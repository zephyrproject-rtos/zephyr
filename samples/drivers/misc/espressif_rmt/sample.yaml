## samples/drivers/misc/espressif_rmt/sample.yaml
```yaml
sample:
  name: espressif_rmt
tests:
  sample.drivers.misc.espressif_rmt:
    tags:
      - drivers
    filter: dt_compat_enabled("espressif,esp32-rmt")
```

## samples/drivers/misc/espressif_rmt/simple_encoder/sample.yaml
```yaml
sample:
  name: espressif_rmt
tests:
  sample.drivers.misc.espressif_rmt.simple_encoder:
    platform_allow:
      - esp32_devkitc/esp32/procpu
      - esp32c3_devkitc/esp32c3
      - esp32c6_devkitc/esp32c6/hpcore
      - esp32h2_devkitm/esp32h2
      - esp32s2_devkitc/esp32s2
      - esp32s3_devkitc/esp32s3/procpu
    tags:
      - drivers
```

## samples/drivers/misc/ft800/sample.yaml
```yaml
sample:
  name: FT800 display sample
tests:
  sample.display.ft800:
    tags: drivers
    depends_on: spi
    platform_allow: nrf52840dk_nrf52840
    extra_args: SHIELD=ftdi_vm800c
    harness: display
    harness_config:
      fixture: spi_display_ft800
```

## samples/drivers/misc/grove_display/sample.yaml
```yaml
sample:
  name: Grove LCD Sample
tests:
  sample.drivers.misc.grove_display:
    tags:
      - drivers
      - display
    harness: grove
    depends_on: i2c
    filter: dt_compat_enabled("seeed,grove-lcd-rgb")
```

## samples/drivers/misc/morse_code/sample.yaml
```yaml
sample:
  name: Morse Code Sample
tests:
  sample.drivers.misc.morse_code:
    tags:
      - drivers
      - morse_code
    harness: grove
    depends_on: counter
    filter: dt_compat_enabled("zephyr,morse-code")
    platform_allow:
      - nrf52840dk_nrf52840
      - nucleo_f767zi
      - nucleo_g474re
      - sam_v71_xult
```

## samples/drivers/misc/stm32_bootloader/sample.yaml
```yaml
sample:
  name: STM32 system bootloader host sample
  description: |
    Demonstrates the standalone bootloader driver and its companion flash
    adapter by programming a small payload into a target STM32 via its
    USART ROM bootloader.
tests:
  sample.drivers.misc.stm32_bootloader:
    build_only: true
    platform_allow:
      - stm32h573i_dk
    tags:
      - drivers
      - flash
      - misc
```

## samples/drivers/misc/vnd7050aj/sample.yaml
```yaml
sample:
  name: VND7050AJ High-Side Driver Sample
  description: A sample application for the VND7050AJ high-side driver.
  platforms:
    - weact_stm32g431_core
    - nrf52840dk_nrf52840
    - nucleo_f401re
    - stm32f4_disco
    - nrf52dk_nrf52832
    - nucleo_f767zi
    - rpi_pico
```

## samples/drivers/modem/at_client/sample.yaml
```yaml
sample:
  description: AT Command Client - bidirectional UART bridge between
    console and cellular modem for AT command communication
  name: AT Command Client
common:
  min_ram: 8
  min_flash: 32
  tags:
    - modem
    - uart
    - at_commands
    - cellular
  depends_on:
    - uart
  harness: console
  harness_config:
    type: multi_line
    ordered: true
    regex:
      - "Console UART pipe registered"
      - "Modem pipe initialized and opened"
      - "Console <-> Modem communication established"
tests:
  sample.modem.at_client:
    tags:
      - modem
      - uart
    filter: dt_chosen_enabled("zephyr,modem-uart")
```

## samples/drivers/modem/hello_hl78xx/Kconfig
```kconfig
# Sierra Wireless HL78XX Sample options

# Copyright (c) 2025 Netfeasa
# SPDX-License-Identifier: Apache-2.0

source "samples/net/common/Kconfig"
source "Kconfig.zephyr"
```

## samples/drivers/modem/hello_hl78xx/boards/nrf9160dk_nrf9160_ns.conf
```kconfig
CONFIG_UART_ASYNC_API=y
CONFIG_UART_1_ASYNC=y
CONFIG_UART_1_INTERRUPT_DRIVEN=n
# Enable HW RX byte counting. This especially matters at higher baud rates.
CONFIG_UART_1_NRF_HW_ASYNC=y
CONFIG_UART_1_NRF_HW_ASYNC_TIMER=1

CONFIG_ENTROPY_GENERATOR=y
CONFIG_TEST_RANDOM_GENERATOR=y

CONFIG_MODEM_HL78XX_DEV_STARTUP_TIME=1000
# Disable AT shell as SLM application has no AT mode user pipes
CONFIG_MODEM_AT_SHELL=n
# Increase log buffer size to accommodate large dumps
CONFIG_LOG_BUFFER_SIZE=65535
CONFIG_MODEM_MODULES_LOG_LEVEL_DBG=y
CONFIG_MODEM_LOG_LEVEL_DBG=y
CONFIG_MODEM_CHAT_LOG_BUFFER_SIZE=1024
CONFIG_MODEM_HL78XX_LOG_CONTEXT_VERBOSE_DEBUG=y
# Print logs and printk() output on uart0.
CONFIG_LOG_BACKEND_UART=y
CONFIG_MODEM_LOG_LEVEL_DBG=y
```

## samples/drivers/modem/hello_hl78xx/sample.yaml
```yaml
sample:
  description: Sample for HL78XX modem
  name: Hello HL78XX sample
common:
  tags:
    - modem
    - hl78xx
  filter: dt_alias_exists("modem")
tests:
  sample.driver.modem.hello_hl78xx:
    platform_allow:
      - nucleo_u575zi_q
    integration_platforms:
      - nucleo_u575zi_q
    extra_args:
      - SHIELD=swir_hl78xx_ev_kit
```

## samples/drivers/mspi/mspi_async/sample.yaml
```yaml
sample:
  name: MSPI Async Sample
tests:
  sample.drivers.mspi.async:
    tags:
      - mspi
    filter: dt_compat_enabled("mspi-aps6404l")
    platform_exclude: hifive_unmatched/fu740/s7 hifive_unmatched/fu740/u74
    harness: console
    harness_config:
      type: multi_line
      ordered: true
    depends_on: mspi
```

## samples/drivers/mspi/mspi_flash/boards/arduino_giga_r1_stm32h747xx_m7.conf
```kconfig
# Copyright (c) 2025 EXALT Technologies.
# SPDX-License-Identifier: Apache-2.0

CONFIG_LOG=y
CONFIG_MSPI_LOG_LEVEL_INF=y
```

## samples/drivers/mspi/mspi_flash/boards/b_u585i_iot02a.conf
```kconfig
# SPDX-FileCopyrightText: Copyright The Zephyr Project Contributors
# SPDX-License-Identifier: Apache-2.0

CONFIG_LOG=y
CONFIG_MSPI_LOG_LEVEL_INF=y

# CONFIG_MSPI_DMA=y to choose transfer with DMA
# activate the MEMMAP based on the xip-config of the mspi device
```

## samples/drivers/mspi/mspi_flash/boards/nrf7120dk_nrf7120_cpuapp.conf
```kconfig
# Copyright (c) 2026 Nordic Semiconductor ASA
# SPDX-License-Identifier: Apache-2.0

CONFIG_MSPI_DMA=y
```

## samples/drivers/mspi/mspi_flash/boards/stm32l496g_disco.conf
```kconfig
# Copyright (c) 2025 EXALT Technologies.
# SPDX-License-Identifier: Apache-2.0

CONFIG_LOG=y
CONFIG_MSPI_LOG_LEVEL_INF=y
CONFIG_HEAP_MEM_POOL_SIZE=8192
CONFIG_MSPI_DMA=y
```

## samples/drivers/mspi/mspi_flash/sample.yaml
```yaml
sample:
  name: MSPI Flash Sample
common:
  tags:
    - drivers
    - mspi
    - flash
  filter: dt_compat_enabled("jedec,spi-nor") or dt_compat_enabled("jedec,mspi-nor")
    or dt_compat_enabled("mspi-atxp032") or dt_compat_enabled("mspi-is25xX0xx")
  harness: console
  harness_config:
    type: multi_line
    ordered: true
    regex:
      - "Test 1: Flash erase"
      - "Flash erase succeeded!"
      - "Test 2: Flash write"
      - "Attempting to write 4 bytes"
      - "Data read matches data written. Good!!"
tests:
  sample.drivers.mspi.flash:
    platform_exclude:
      - hifive_unmatched/fu740/s7
      - hifive_unmatched/fu740/u74
    platform_allow:
      - apollo3p_evb
      - apollo510_evb
      - arduino_giga_r1/stm32h747xx/m7
      - b_u585i_iot02a
      - stm32h573i_dk
      - stm32h735g_disco
      - stm32l496g_disco
      - stm32l562e_dk
    integration_platforms:
      - apollo3p_evb
      - apollo510_evb
  sample.drivers.mspi.flash.memmap:
    extra_configs:
      - CONFIG_MSPI_XIP=y
    platform_allow:
      - stm32h573i_dk
```

## samples/drivers/mspi/mspi_throughput/Kconfig
```kconfig
# Copyright (c) 2026 Nordic Semiconductor ASA
#
# SPDX-License-Identifier: Apache-2.0
#

mainmenu "MSPI Throughput Sample application"

config SAMPLE_MSPI_THROUGHPUT_TOTAL_TRANSFER_SIZE
	int "Total transfer size in bytes"
	default 32768
	range 1024 1048576
	help
	  Total amount of data to transfer during each test case.
	  This value determines how much data is transferred for each
	  buffer size and packet count combination.
	  Default is 32 KB.

source "Kconfig.zephyr"
```

## samples/drivers/mspi/mspi_timing_scan/boards/apollo510_evb.conf
```kconfig
# Copyright (c) 2025 Ambiq Micro Inc. <www.ambiq.com>
# SPDX-License-Identifier: Apache-2.0

CONFIG_MSPI_AMBIQ_TIMING_SCAN=y
CONFIG_LOG=y
CONFIG_LOG_MODE_IMMEDIATE=y
CONFIG_LOG_DEFAULT_LEVEL=3
CONFIG_MSPI_LOG_LEVEL_INF=y
CONFIG_MSPI_INIT_PRIORITY=40
CONFIG_MAIN_STACK_SIZE=8192
```

## samples/drivers/mspi/mspi_timing_scan/sample.yaml
```yaml
sample:
  name: MSPI Flash Sample
tests:
  sample.drivers.mspi.timing_scan.flash:
    tags:
      - mspi
    harness: console
    harness_config:
      type: multi_line
      ordered: true
      regex:
        - "MSPI Timing Scan is successful."
    platform_allow:
      - apollo510_evb
    integration_platforms:
      - apollo510_evb
    depends_on: mspi
    extra_configs:
      - CONFIG_FLASH=y
      - CONFIG_FLASH_INIT_PRIORITY=50
      - CONFIG_FLASH_MSPI_XIP_READ=y
      - CONFIG_MSPI_AMBIQ_TIMING_SCAN_BUFFER_SIZE=8192
      - CONFIG_MSPI_AMBIQ_TIMING_SCAN_DATA_SIZE=131072

  sample.drivers.mspi.timing_scan.memc:
    tags:
      - mspi
    harness: console
    harness_config:
      type: multi_line
      ordered: true
      regex:
        - "MSPI Timing Scan is successful."
    platform_allow:
      - apollo510_evb
    integration_platforms:
      - apollo510_evb
    depends_on: mspi
    extra_configs:
      - CONFIG_MEMC=y
      - CONFIG_MEMC_INIT_PRIORITY=50
```

## samples/drivers/neo_m8/sample.yaml
```yaml
#
# Copyright (c) 2022 Abel Sensors
#
# SPDX-License-Identifier: Apache-2.0


sample:
   description: Demonstration of Neo-M8 GNSS module
   name: Neo-M8 Sample
tests:
   sample.driver.neom8:
      build_only: true
      platform_allow: stm32l1_disco
```

## samples/drivers/nfc/boards/dk6_qn9090.conf
```kconfig
#
# Copyright (c) 2023 Sendrato
#
# SPDX-License-Identifier: Apache-2.0
#

# NFC driver selection for qn9090 DK6 development board
CONFIG_NFC_NT3H2X11=y
CONFIG_NFC_NT3H2X11_2K=y
```
