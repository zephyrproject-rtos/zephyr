## sample.yaml
```
sample:
  name: Morse Code Sample
tests:
  sample.drivers.misc.morse_code:
    tags:
      - drivers
      - morse_code
    harness: grove
    depends_on: counter
    filter: dt_compat_enabled("zephyr,morse-code")
    platform_allow:
      - nrf52840dk_nrf52840
      - nucleo_f767zi
      - nucleo_g474re
      - sam_v71_xult
```

## prj.conf
```kconfig
CONFIG_LOG=y

CONFIG_COUNTER=y
CONFIG_MORSE_CODE=y

CONFIG_SHELL=y
CONFIG_MORSE_CODE_SHELL=y
```

## boards/nrf52840dk_nrf52840.overlay
```dts
/*
 * Copyright (c) 2024 Freedom Veiculos Eletricos
 * Copyright (c) 2024 OS Systems
 *
 * SPDX-License-Identifier: Apache-2.0
 */

/ {
	morse: morse {
		compatible = "zephyr,morse-code";

		speed = <20>;
		gpios = <&gpio0 13 GPIO_ACTIVE_LOW>;
		timer-unit = <&timer0>;
	};
};

&timer0 {
	status = "okay";
};
```

## boards/nucleo_f767zi.overlay
```dts
/*
 * Copyright (c) 2024 Freedom Veiculos Eletricos
 * Copyright (c) 2024 OS Systems
 *
 * SPDX-License-Identifier: Apache-2.0
 */

/ {
	morse: morse {
		compatible = "zephyr,morse-code";

		speed = <20>;
		gpios = <&gpiob 0 GPIO_ACTIVE_HIGH>;
		timer-unit = <&counter2>;
	};
};

&timers2 {
	st,prescaler = <10000>;
	status = "okay";

	counter2: counter {
		status = "okay";
	};
};
```

## boards/nucleo_g474re.overlay
```dts
/*
 * Copyright (c) 2024 Freedom Veiculos Eletricos
 * Copyright (c) 2024 OS Systems
 *
 * SPDX-License-Identifier: Apache-2.0
 */

/ {
	morse: morse {
		compatible = "zephyr,morse-code";

		speed = <20>;
		gpios = <&gpioa 5 GPIO_ACTIVE_HIGH>;
		timer-unit = <&counter2>;
	};
};

&timers2 {
	st,prescaler = <10000>;
	status = "okay";

	counter2: counter {
		status = "okay";
	};
};
```

## boards/sam_v71_xult.overlay
```dts
/*
 * Copyright (c) 2024 Freedom Veiculos Eletricos
 * Copyright (c) 2024 OS Systems
 *
 * SPDX-License-Identifier: Apache-2.0
 */

/ {
	morse: morse {
		compatible = "zephyr,morse-code";

		speed = <20>;
		gpios = <&pioa 23 GPIO_ACTIVE_LOW>;
		timer-unit = <&tc1>;
	};
};

&tc1 {
        clk = <4>;
        status = "okay";
};
```

## src/main.c
```c
/*
 * Copyright (c) 2024 Freedom Veiculos Eletricos
 * Copyright (c) 2024 OS Systems
 *
 * SPDX-License-Identifier: Apache-2.0
 */

#include <zephyr/kernel.h>
#include <zephyr/device.h>

#include <zephyr/drivers/misc/morse_code/morse_code.h>

#include <zephyr/logging/log.h>
LOG_MODULE_REGISTER(app, CONFIG_MORSE_CODE_LOG_LEVEL);

/**
 * @file Send data using morse code.
 */

const uint8_t data[] = "paris";

void morse_cb_handler(void *ctx, int status)
{
	LOG_INF("Status: %d", status);
}

int main(void)
{
	const struct device *const morse = DEVICE_DT_GET(DT_NODELABEL(morse));

	if (!device_is_ready(morse)) {
		return 0;
	}

	morse_code_manage_callback(morse, morse_cb_handler, NULL);
	morse_code_send(morse, data, strlen(data));

	return 0;
}
```
