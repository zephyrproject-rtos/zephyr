/*
 * Copyright (c) 2024 Freedom Veiculos Eletricos
 * Copyright (c) 2024 OS Systems
 *
 * SPDX-License-Identifier: Apache-2.0
 */

/ {
	morse: morse {
		compatible = "zephyr,morse-code";

		speed = <20>;
		gpios = <&gpiob 0 GPIO_ACTIVE_HIGH>;
		timer-unit = <&counter2>;
	};
};

&timers2 {
	st,prescaler = <10000>;
	status = "okay";

	counter2: counter {
		status = "okay";
	};
};
