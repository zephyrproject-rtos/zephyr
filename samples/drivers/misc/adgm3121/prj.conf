## CMakeLists.txt
```
# SPDX-License-Identifier: Apache-2.0

cmake_minimum_required(VERSION 3.20.0)
find_package(Zephyr REQUIRED HINTS $ENV{ZEPHYR_BASE})
project(adgm3121_sample)

target_sources(app PRIVATE src/main.c)
```

## sample.yaml
```
sample:
  name: ADGM3121 MEMS Switch
  description: Demonstrates the ADGM3121 MEMS RF switch driver API
common:
  tags:
    - drivers
    - misc
  harness: console
  harness_config:
    type: one_line
    regex:
      - "ADGM3121 sample completed"
tests:
  sample.drivers.misc.adgm3121:
    filter: dt_compat_enabled("adi,adgm3121-gpio") or dt_compat_enabled("adi,adgm3121")
  sample.drivers.misc.adgm3121.eval_adgm3121:
    extra_args: SHIELD=eval_adgm3121
    platform_allow:
      - nucleo_f413zh
```

## prj.conf
```kconfig
CONFIG_ADGM3121=y
CONFIG_LOG=y
```

## boards/adi_sdp_k1.overlay
```dts
/*
 * Copyright (c) 2026 Analog Devices Inc.
 *
 * SPDX-License-Identifier: Apache-2.0
 */

/ {
	adgm3121: adgm3121 {
		compatible = "adi,adgm3121-gpio";
		/* Arduino header digital pins D4-D7 */
		in1-gpios = <&gpiog 9 GPIO_ACTIVE_HIGH>;  /* D4 */
		in2-gpios = <&gpioa 11 GPIO_ACTIVE_HIGH>; /* D5 */
		in3-gpios = <&gpioa 10 GPIO_ACTIVE_HIGH>; /* D6 */
		in4-gpios = <&gpiog 10 GPIO_ACTIVE_HIGH>; /* D7 */
	};
};
```

## src/main.c
```c
/*
 * Copyright (c) 2026 Analog Devices Inc.
 *
 * SPDX-License-Identifier: Apache-2.0
 */

#include <zephyr/kernel.h>
#include <zephyr/device.h>
#include <zephyr/drivers/misc/adgm3121/adgm3121.h>

#if DT_HAS_COMPAT_STATUS_OKAY(adi_adgm3121)
#define ADGM3121_NODE DT_COMPAT_GET_ANY_STATUS_OKAY(adi_adgm3121)
#elif DT_HAS_COMPAT_STATUS_OKAY(adi_adgm3121_gpio)
#define ADGM3121_NODE DT_COMPAT_GET_ANY_STATUS_OKAY(adi_adgm3121_gpio)
#endif

static const char *const switch_names[] = {"SW1", "SW2", "SW3", "SW4"};

static const char *state_str(enum adgm3121_state state)
{
	return state == ADGM3121_ENABLE ? "ON" : "OFF";
}

int main(void)
{
	const struct device *dev = DEVICE_DT_GET(ADGM3121_NODE);
	enum adgm3121_state state;
	uint8_t mask;
	int ret;

	printk("ADGM3121 MEMS Switch Sample\n");

	if (!device_is_ready(dev)) {
		printk("Error: ADGM3121 device not ready\n");
		return -ENODEV;
	}

	printk("Device ready\n\n");

	/* Toggle each switch individually */
	printk("--- Individual switch control ---\n");
	for (int i = ADGM3121_SW1; i <= ADGM3121_SW4; i++) {
		ret = adgm3121_set_switch_state(dev, i, ADGM3121_ENABLE);
		if (ret) {
			printk("Error enabling %s: %d\n", switch_names[i], ret);
			return ret;
		}

		ret = adgm3121_get_switch_state(dev, i, &state);
		if (ret) {
			printk("Error reading %s: %d\n", switch_names[i], ret);
			return ret;
		}
		printk("%s: %s\n", switch_names[i], state_str(state));

		ret = adgm3121_set_switch_state(dev, i, ADGM3121_DISABLE);
		if (ret) {
			printk("Error disabling %s: %d\n", switch_names[i], ret);
			return ret;
		}
	}

	/* Set multiple switches via bitmask: enable SW1 and SW3 */
	printk("\n--- Bitmask control ---\n");
	ret = adgm3121_set_switches(dev, BIT(ADGM3121_SW1) | BIT(ADGM3121_SW3));
	if (ret) {
		printk("Error setting switches: %d\n", ret);
		return ret;
	}

	ret = adgm3121_get_switches(dev, &mask);
	if (ret) {
		printk("Error reading switches: %d\n", ret);
		return ret;
	}
	printk("Switch mask after setting SW1+SW3: 0x%02x\n", mask);

	for (int i = ADGM3121_SW1; i <= ADGM3121_SW4; i++) {
		printk("  %s: %s\n", switch_names[i],
		       (mask & BIT(i)) ? "ON" : "OFF");
	}

	/* Reset all switches */
	printk("\n--- Reset ---\n");
	ret = adgm3121_reset_switches(dev);
	if (ret) {
		printk("Error resetting switches: %d\n", ret);
		return ret;
	}

	ret = adgm3121_get_switches(dev, &mask);
	if (ret) {
		printk("Error reading switches: %d\n", ret);
		return ret;
	}
	printk("Switch mask after reset: 0x%02x\n", mask);

	printk("\nADGM3121 sample completed\n");
	return 0;
}
```
