/*
 * Copyright (c) 2026 Analog Devices Inc.
 *
 * SPDX-License-Identifier: Apache-2.0
 */

/ {
	adgm3121: adgm3121 {
		compatible = "adi,adgm3121-gpio";
		/* Arduino header digital pins D4-D7 */
		in1-gpios = <&gpiog 9 GPIO_ACTIVE_HIGH>;  /* D4 */
		in2-gpios = <&gpioa 11 GPIO_ACTIVE_HIGH>; /* D5 */
		in3-gpios = <&gpioa 10 GPIO_ACTIVE_HIGH>; /* D6 */
		in4-gpios = <&gpiog 10 GPIO_ACTIVE_HIGH>; /* D7 */
	};
};
