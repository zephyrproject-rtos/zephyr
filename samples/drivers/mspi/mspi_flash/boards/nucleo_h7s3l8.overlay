/*
 * Copyright (c) 2026 STMicroelectronics
 *
 * SPDX-License-Identifier: Apache-2.0
 */

/ {
	aliases {
		/* The sample gets the DT_ALIAS(flash0) as the mspi device */
		flash0 = &ext_flash_ctrl;
	};
};

/*
 * Requires ext memory region ATTR set to ATTR_MPU_IO
 * to Read and Wr in MemoryMapped mode (permission = 0)
 */
