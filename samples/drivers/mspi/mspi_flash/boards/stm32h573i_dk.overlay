/*
 * Copyright (c) 2025 STMicroelectronics
 *
 * SPDX-License-Identifier: Apache-2.0
 */

/ {
	aliases {
		/* The sample gets the DT_ALIAS(flash0) as the mspi device */
		flash0 = &ext_flash_ctrl;
	};
};

&ext_flash_ctrl {
	/* permission = 0 for Rd/Wr */
	memmap-config = <1 0 DT_SIZE_M(64) 0>;
};
