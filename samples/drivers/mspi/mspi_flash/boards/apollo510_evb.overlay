/*
 * Copyright (c) 2025, Ambiq Micro Inc. <www.ambiq.com>
 *
 * SPDX-License-Identifier: Apache-2.0
 */

/ {
	aliases {
		flash0 = &is25wx064;
	};
};

&mspi1 {
	status = "okay";
};

&is25wx064 {
	status = "okay";
};
