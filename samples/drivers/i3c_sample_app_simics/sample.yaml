## samples/drivers/i3c_sample_app_simics/sample.yaml
```yaml
sample:
  name: Demo for (I3C)
tests:
  sample.drivers.i3c.sample_app_simics:
    tags: drivers i3c
    depends_on: i3c
    filter: dt_nodelabel_enabled("i3c0")
    harness: console
```

## samples/drivers/input/gpio_keys/sample.yaml
```yaml
sample:
  name: samples_driver_input_gpio_keys
tests:
  sample.driver.input.gpio_keys.pinctrl:
    tags:
      - gpio
      - pm
      - pinctrl
      - samples
    platform_allow:
      - sam4s_xplained
      - sam4e_xpro
      - sam_e70_xplained
      - sam_v71_xult
```

## samples/drivers/interrupt_controller/intc_riscv_aia/sample.yaml
```yaml
sample:
  description: UART echo demonstrating RISC-V AIA (APLIC + IMSIC)
  name: UART Echo AIA

common:
  tags:
    - riscv
    - interrupt
  integration_platforms:
    - qemu_riscv32/qemu_virt_riscv32_aia
  harness: console
  harness_config:
    type: multi_line
    regex:
      - "RISC-V AIA UART Echo Demo"
      - "Type characters to see interrupt-driven echo"

tests:
  sample.drivers.uart_echo_aia:
    tags:
      - riscv
      - interrupt
    filter: >
      CONFIG_RISCV_APLIC_MSI and
      CONFIG_RISCV_IMSIC
```

## samples/drivers/interrupt_controller/intc_riscv_aia_smp/sample.yaml
```yaml
sample:
  description: UART echo demonstrating RISC-V AIA (APLIC + IMSIC) in SMP configuration
  name: UART Echo AIA SMP

common:
  tags:
    - riscv
    - interrupt
    - smp
  integration_platforms:
    - qemu_riscv32/qemu_virt_riscv32_aia/smp
  harness: console
  harness_config:
    type: multi_line
    regex:
      - "Hart 0: IRQ .* enabled"
      - "Hart 1: EIID .* enabled"

tests:
  sample.drivers.uart_echo_aia_smp:
    tags:
      - riscv
      - interrupt
      - smp
    depends_on:
      - smp
    filter: >
      (CONFIG_MP_MAX_NUM_CPUS > 1) and
      CONFIG_RISCV_APLIC_MSI and
      CONFIG_RISCV_IMSIC
```

## samples/drivers/ipm/ipm_esp32/Kconfig.sysbuild
```kconfig
# Copyright 2022 NXP
#
# SPDX-License-Identifier: Apache-2.0

source "share/sysbuild/Kconfig"
```

## samples/drivers/ipm/ipm_esp32/sample.yaml
```yaml
sample:
  name: ESP32 IPM Sample
tests:
  sample.ipm.ipm_esp32:
    platform_allow:
      - esp32_devkitc_wroom/esp32/procpu
      - esp32_devkitc_wrover/esp32/procpu
    tags:
      - samples
      - ipm
    skip: true
```

## samples/drivers/ipm/ipm_imx/sample.yaml
```yaml
sample:
  description: the sample reads the received data from the Messaging Unit using the
    IPM and transmits it back unchanged
  name: i.MX IPM sample
tests:
  sample.ipm.ipm_imx:
    build_only: true
    filter: CONFIG_SOC_FAMILY_NXP_IMX
    platform_allow:
      - udoo_neo_full/mcimx6x/m4
      - colibri_imx7d/mcimx7d/m4
      - warp7/mcimx7d/m4
    integration_platforms:
      - udoo_neo_full/mcimx6x/m4
    tags:
      - samples
      - ipm
```

## samples/drivers/ipm/ipm_ivshmem/boards/qemu_cortex_a53.conf
```kconfig
CONFIG_PCIE_CONTROLLER=y
CONFIG_PCIE_ECAM=y

# Hungry PCI requires at least 256M of virtual space
CONFIG_KERNEL_VM_SIZE=0x80000000

# Hungry PCI requires phys addresses with more than 32 bits
CONFIG_ARM64_VA_BITS_40=y
CONFIG_ARM64_PA_BITS_40=y

# MSI support requires ITS
CONFIG_GIC_V3_ITS=y

# ITS, in turn, requires dynamic memory (9x64 + alignment constrains)
# Additionally, our test also uses malloc
CONFIG_HEAP_MEM_POOL_SIZE=1048576
```

## samples/drivers/ipm/ipm_ivshmem/sample.yaml
```yaml
sample:
  name: IVSHMEM IPM Sample
tests:
  sample.ipm.ipm_ivshmem:
    build_only: true
    platform_allow: qemu_cortex_a53
    tags:
      - samples
      - ipm
```

## samples/drivers/ipm/ipm_mcux/Kconfig.sysbuild
```kconfig
# Copyright 2022 NXP
#
# SPDX-License-Identifier: Apache-2.0

source "share/sysbuild/Kconfig"

config IPM_REMOTE_BOARD
string
	default "lpcxpresso54114/lpc54114/m0" if $(BOARD) = "lpcxpresso54114"
	default "lpcxpresso55s69/lpc55s69/cpu1" if $(BOARD) = "lpcxpresso55s69"
```

## samples/drivers/ipm/ipm_mcux/remote/sample.yaml
```yaml
sample:
  description: Sample app that sends messages between the two cores on the lpcxpresso54114
    using a mailbox.
  name: IPM MCUX Mailbox Sample
tests:
  sample.ipm.ipm_mcux.remote:
    platform_allow:
      - lpcxpresso54114/lpc54114/m0
      - lpcxpresso55s69/lpc55s69/cpu1
    integration_platforms:
      - lpcxpresso54114/lpc54114/m0
    tags: ipm
    harness: remote
```

## samples/drivers/ipm/ipm_mcux/sample.yaml
```yaml
sample:
  description: Sample app that sends messages between the two cores on the lpcxpresso54114
    using a mailbox.
  name: IPM MCUX Mailbox Sample
tests:
  sample.ipm.ipm_mcux:
    platform_allow:
      - lpcxpresso54114/lpc54114/m4
      - lpcxpresso55s69/lpc55s69/cpu0
    integration_platforms:
      - lpcxpresso54114/lpc54114/m4
    tags: ipm
    harness: console
    sysbuild: true
    harness_config:
      type: multi_line
      regex:
        - "Hello World from MASTER! (.*)"
        - "Received: 1"
        - "Received: 20"
```

## samples/drivers/ipm/ipm_mhu_dual_core/sample.yaml
```yaml
sample:
  description: MHU dual core sample application
  name: ipm_mhu_dual_core
tests:
  sample.ipm.ipm_mhu_dual_core:
    tags: ipm
    platform_allow:
      - v2m_musca_b1/musca_b1
      - v2m_musca_b1/musca_b1/ns
    integration_platforms:
      - v2m_musca_b1/musca_b1
```

## samples/drivers/jesd216/boards/bmd_345_eval.conf
```kconfig
#
# Copyright (c) 2021 Linumiz
#
# SPDX-License-Identifier: Apache-2.0

CONFIG_SPI=n
CONFIG_SPI_NOR=n
CONFIG_NORDIC_QSPI_NOR=y
```

## samples/drivers/jesd216/boards/intel_socfpga_agilex5_socdk.conf
```kconfig
# Copyright (c) 2023, Intel Corporation.
# SPDX-License-Identifier: Apache-2.0

CONFIG_GPIO=y
CONFIG_SPI_NOR_FLASH_LAYOUT_PAGE_SIZE=4096
CONFIG_SPI_NOR_SFDP_MINIMAL=y
```

## samples/drivers/jesd216/boards/mr_canhubk3.conf
```kconfig
# Copyright 2023 NXP
# SPDX-License-Identifier: Apache-2.0

# Override defaults for SPI NOR flash driver
CONFIG_SPI_NOR=n
```

## samples/drivers/jesd216/boards/nrf52840dk_nrf52840.conf
```kconfig
#
# Copyright (c) 2019 Peter Bigot Consulting, LLC
# Copyright (c) 2019 Nordic Semiconductor ASA
#
# SPDX-License-Identifier: Apache-2.0
#

CONFIG_SPI=n
CONFIG_SPI_NOR=n
#CONFIG_NORDIC_QSPI_NOR=y
```

## samples/drivers/jesd216/boards/nrf52840dk_nrf52840_spi.conf
```kconfig
#
# Copyright (c) 2022 Nordic Semiconductor ASA
#
# SPDX-License-Identifier: Apache-2.0
#

CONFIG_SPI=y
CONFIG_SPI_NOR=y
```

## samples/drivers/jesd216/boards/stm32h573i_dk.conf
```kconfig
#
# Copyright (c) 2023 STMicroelectronics
#
# SPDX-License-Identifier: Apache-2.0

CONFIG_FLASH_STM32_OSPI=y
CONFIG_SPI_NOR_SFDP_RUNTIME=y
CONFIG_SPI_NOR=n
```

## samples/drivers/jesd216/sample.yaml
```yaml
sample:
  name: JESD216 Sample
common:
  tags:
    - spi
    - flash
  harness: console
  harness_config:
    type: multi_line
    ordered: true
    regex:
      - "sfdp-bfp ="
      - "jedec-id ="
tests:
  sample.drivers.jesd216:
    platform_exclude:
      - hifive1
      - hifive_unleashed/fu540/e51
      - hifive_unleashed/fu540/u54
      - hifive_unmatched/fu740/s7
      - hifive_unmatched/fu740/u74
      - mimxrt1170_evk/mimxrt1176/cm7
      - mimxrt1170_evk/mimxrt1176/cm4
      - nrf54lm20dk/nrf54lm20a/cpuapp
    filter: dt_compat_enabled("jedec,spi-nor") or dt_compat_enabled("jedec,mspi-nor")
    depends_on: spi
  sample.drivers.jesd216.nrf52840dk_spi:
    extra_args:
      - DTC_OVERLAY_FILE=boards/nrf52840dk_nrf52840_spi.overlay
    platform_allow: nrf52840dk/nrf52840
    integration_platforms:
      - nrf52840dk/nrf52840
  sample.drivers.jesd216.nrf54lm20:
    platform_allow:
      - nrf54lm20dk/nrf54lm20a/cpuapp
    integration_platforms:
      - nrf54lm20dk/nrf54lm20a/cpuapp
    harness_config:
      fixture: external_flash
      type: multi_line
      ordered: true
      regex:
        - "sfdp-bfp ="
        - "jedec-id ="
  sample.drivers.stm32.jesd216:
    filter: dt_compat_enabled("st,stm32-xspi-nor")
      or dt_compat_enabled("st,stm32-ospi-nor")
      or dt_compat_enabled("st,stm32-qspi-nor")
    depends_on: spi
```

## samples/drivers/keyboard_gpio/sample.yaml
```yaml
sample:
  name: keyboard gpio driver sample
tests:
  sample.drivers.input.keyboard_gpio:
    platform_allow: nucleo_h743zi
    tags: drivers
    harness: console
    harness_config:
        type: multi_line
        ordered: true
    depends_on: KEYBOARD_GPIO
```
