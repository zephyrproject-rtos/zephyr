## CMakeLists.txt
```
# SPDX-License-Identifier: Apache-2.0

cmake_minimum_required(VERSION 3.20.0)
find_package(Zephyr REQUIRED HINTS $ENV{ZEPHYR_BASE})
project(basic_radio_rx)

target_sources(app PRIVATE src/main.c)
```

## sample.yaml
```
sample:
  name: Basic Radio RX
  description: Receive packets via the vendor-neutral basic_radio API.
  
```

## prj.conf
```kconfig
CONFIG_BASIC_RADIO=y
CONFIG_GPIO=y
CONFIG_LOG=y
CONFIG_LOG_DEFAULT_LEVEL=3
```

## boards/lp_em_cc2340r5.overlay
```dts
/*
 * Copyright (c) 2026 Texas Instruments Incorporated
 * SPDX-License-Identifier: Apache-2.0
 *
 * basic_radio sample overlay for CC23x0-based LaunchPads.
 *
 * The PHY comes the SmartRF Studio export of the
 * "Generic 1 Mbps / 2 Mbps / Coded" PHY in devicetree form. That file holds
 * the complete radio configuration (images, register segments, TX power
 * table) and one operating mode node per mode, which states the mode's
 * modulation, datarate, deviation and frame format.
 *
 * phy0 selects the 1 Mbps mode and sets the runtime values: frequency
 * (within the mode's characterized range), sync word and TX power.
 *
 * To use another waveform, export it from SmartRF Studio as a .dtsi, add it
 * to the application's boards/ folder, include it here and point
 * ti,radio-mode at one of its operating mode nodes.
 */

#include <ti/cc23x0/radio_config/2-4-ghz-bluetooth-5-le-1-mbps-2-mbps-coded.dtsi>

/ {
	basic_radio0: basic_radio {
		compatible = "ti,cc23x0-basic-radio";
		status = "okay";

		phy0: phy_default {
			compatible = "ti,cc23x0-basic-radio-phy";
			ti,radio-mode = <&ti_phy_2_4_ghz_bluetooth_5_le_1_mbps_2_mbps_coded_1_mbps>;
			frequency-hz = <2450000000>;
			sync-word = <0x930B51DE>;
			tx-power-dbm = <5>;
		};
	};
};
```

## src/main.c
```c
/*
 * Copyright (c) 2026 Texas Instruments Incorporated
 *
 * SPDX-License-Identifier: Apache-2.0
 */

#include <zephyr/device.h>
#include <zephyr/drivers/gpio.h>
#include <zephyr/drivers/basic_radio.h>
#include <zephyr/kernel.h>
#include <zephyr/logging/log.h>

LOG_MODULE_REGISTER(basic_radio_rx, LOG_LEVEL_INF);

#define BASIC_RADIO_NODE 	DT_NODELABEL(basic_radio0)

/* Runtime parameters on top of the boot PHY */
/* 10 Hz units */
#define RADIO_FREQUENCY    245000000U
#define RADIO_SYNC_WORD    0x930B51DEU
#define RADIO_TX_POWER_DBM 5

static const struct device *const rf_dev = DEVICE_DT_GET(BASIC_RADIO_NODE);

#define LED0_NODE DT_ALIAS(led0)
static const struct gpio_dt_spec led = GPIO_DT_SPEC_GET(LED0_NODE, gpios);

#define RX_BUF_LEN CONFIG_BASIC_RADIO_MAX_PACKET_LEN

static uint8_t rx_buf[RX_BUF_LEN];

int main(void)
{
	int ret;
	uint32_t cnt = 0;

	if (!device_is_ready(rf_dev))
	{
		LOG_ERR("basic_radio device not ready");
		return -ENODEV;
	}

	if (!device_is_ready(led.port)) {
		LOG_ERR("LED device not ready");
		return -ENODEV;
	}

	ret = gpio_pin_configure_dt(&led, GPIO_OUTPUT_INACTIVE);
	if (ret != 0) {
		LOG_ERR("LED configure failed: %d", ret);
		return ret;
	}

	struct basic_radio_caps caps;

	ret = basic_radio_get_caps(rf_dev, &caps);
	if (ret == 0) {
		LOG_INF("caps=0x%08x tx_power=[%d, %d] dBm", caps.flags, caps.tx_power_min_dbm,
			caps.tx_power_max_dbm);
	}

	static const struct basic_radio_config cfg = {
		.phy = NULL,
		.frequency = RADIO_FREQUENCY,
		.sync_word = RADIO_SYNC_WORD,
		.max_packet_len = CONFIG_BASIC_RADIO_MAX_PACKET_LEN,
		.tx_power = RADIO_TX_POWER_DBM,
	};
	ret = basic_radio_config(rf_dev, &cfg);

	if (ret != 0)
	{
		LOG_ERR("basic_radio_config failed: %d", ret);
		return ret;
	}

	while (true)
	{
		struct basic_radio_rx_info info = {0};
		LOG_INF("Listening for packets at %u0 Hz", cfg.frequency);
		ret = basic_radio_recv(rf_dev, rx_buf, sizeof(rx_buf), NULL, K_FOREVER, &info);

		cnt++;
		LOG_INF("RX #%u: %d bytes RSSI=%d dBm crc_ok=%d", cnt, ret, info.rssi, (int)info.crc_ok);
		LOG_HEXDUMP_INF(rx_buf, ret, "payload");

		gpio_pin_set_dt(&led, 1);
		k_sleep(K_MSEC(100));
		gpio_pin_set_dt(&led, 0);
	}

	return 0;
}
```
