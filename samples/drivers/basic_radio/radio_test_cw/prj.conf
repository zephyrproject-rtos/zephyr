## CMakeLists.txt
```
# SPDX-License-Identifier: Apache-2.0

cmake_minimum_required(VERSION 3.20.0)
find_package(Zephyr REQUIRED HINTS $ENV{ZEPHYR_BASE})
project(basic_radio_cw)

target_sources(app PRIVATE src/main.c)
```

## sample.yaml
```
sample:
  name: Basic Radio Carrier Wave
  description: Emit an unmodulated CW tone via the vendor-neutral basic_radio API.
  
```

## prj.conf
```kconfig
CONFIG_BASIC_RADIO=y
CONFIG_GPIO=y
CONFIG_LOG=y
CONFIG_LOG_DEFAULT_LEVEL=3
```

## boards/lp_em_cc2340r5.overlay
```dts
/*
 * Copyright (c) 2026 Texas Instruments Incorporated
 * SPDX-License-Identifier: Apache-2.0
 *
 * basic_radio sample overlay for CC23x0-based LaunchPads.
 *
 * The PHY comes from cc2340r5-radio-phys.dtsi, the list of PHYs certified
 * on CC2340R5. Each entry names a SmartRF Studio LRF_Config provided by
 * hal_ti and one operating mode node per mode, which states the mode's
 * modulation, datarate, deviation and frame format.
 *
 * phy0 selects the 1 Mbps mode of the BLE 1 Mbps / 2 Mbps / Coded PHY and
 * sets the runtime values: frequency (within the mode's characterized
 * range), sync word and TX power.
 *
 * To use another certified PHY, point phy-mode at one of the other
 * mode labels. For a custom PHY, see ti,cc23x0-radio-phy-config.yaml.
 */

#include <ti/cc2340r5-radio-phys.dtsi>

/ {
	basic_radio0: basic_radio {
		compatible = "basic-radio-base";
		status = "okay";

		phy0: phy_default {
			phy-mode = <&ti_phy_2_4_ghz_bluetooth_5_le_1_mbps_2_mbps_coded_1_mbps>;
			frequency-hz = <2450000000>;
			sync-word = <0x930B51DE>;
			tx-power-dbm = <5>;
		};
	};
};
```

## src/main.c
```c
/*
 * Copyright (c) 2026 Texas Instruments Incorporated
 *
 * SPDX-License-Identifier: Apache-2.0
 */

#include <zephyr/device.h>
#include <zephyr/drivers/basic_radio.h>
#include <zephyr/kernel.h>
#include <zephyr/logging/log.h>

LOG_MODULE_REGISTER(basic_radio_cw, LOG_LEVEL_INF);

#define BASIC_RADIO_NODE 	DT_NODELABEL(basic_radio0)

static const struct device *const rf_dev = DEVICE_DT_GET(BASIC_RADIO_NODE);

/* 10 Hz units */
#define CW_FREQUENCY     	245000000U
#define CW_TX_POWER_DBM  	5
#define CW_DURATION_MS   	5000U

int main(void)
{
	int ret;

	if (!device_is_ready(rf_dev)) {
		LOG_ERR("basic_radio device not ready");
		return -ENODEV;
	}

	struct basic_radio_caps caps;

	ret = basic_radio_get_caps(rf_dev, &caps);
	if (ret == 0) {
		LOG_INF("caps=0x%08x tx_power=[%d, %d] dBm", caps.flags, caps.tx_power_min_dbm,
			caps.tx_power_max_dbm);
	}

	LOG_INF("Emitting CW at %u0 Hz, %d dBm, for %u ms", CW_FREQUENCY, CW_TX_POWER_DBM, CW_DURATION_MS);

	ret = basic_radio_test_cw(rf_dev, CW_FREQUENCY, CW_TX_POWER_DBM, CW_DURATION_MS);
	if (ret != 0) {
		LOG_ERR("test_cw failed: %d", ret);
		return ret;
	}

	LOG_INF("CW done");
	return 0;
}
```
