## CMakeLists.txt
```
# SPDX-License-Identifier: Apache-2.0

cmake_minimum_required(VERSION 3.28.0)

find_package(Zephyr REQUIRED HINTS $ENV{ZEPHYR_BASE})
project(lora_send)

FILE(GLOB app_sources src/*.c)
target_sources(app PRIVATE ${app_sources})
```

## Kconfig
```
# Copyright (c) 2026 RAKwireless Technology Limited
# SPDX-License-Identifier: Apache-2.0

mainmenu "LoRa send sample application"

config SAMPLE_LORA_GFSK
	bool "Send over the GFSK modem"
	depends on LORA_GFSK
	help
	  Set the radio up for the 50 kbps FSK that LoRaWAN defines as DR7 and
	  send over that modem rather than the LoRa one.

source "Kconfig.zephyr"
```

## sample.yaml
```
common:
  tags: lora
  depends_on: lora
  harness: console
  harness_config:
    type: one_line
    regex:
      - "<inf> lora_send: Data sent 0!"
sample:
  description: Demonstration of LoRa Send functionality
  name: LoRa Send Sample
tests:
  sample.driver.lora.send:
    integration_platforms:
      - b_l072z_lrwan1
  sample.driver.lora.send.lbm:
    filter: dt_compat_enabled("semtech,sx1261") or
      dt_compat_enabled("semtech,sx1262") or
      dt_compat_enabled("semtech,sx1272") or
      dt_compat_enabled("semtech,sx1276")
    integration_platforms:
      - b_l072z_lrwan1
      - rak11720
    extra_configs:
      - CONFIG_LORA_MODULE_BACKEND_LORA_BASICS_MODEM=y
  sample.driver.lora.send.native:
    build_only: true
    extra_args:
      - SHIELD=semtech_sx1261mb2bas
    extra_configs:
      - CONFIG_LORA_MODULE_BACKEND_NATIVE=y
    platform_allow:
      - nrf52840dk/nrf52840
  sample.driver.lora.send.native.stm32wl:
    filter: dt_compat_enabled("st,stm32wl-subghz-radio")
    build_only: true
    extra_configs:
      - CONFIG_LORA_MODULE_BACKEND_NATIVE=y
    integration_platforms:
      - nucleo_wl55jc
```

## prj.conf
```kconfig
CONFIG_LOG=y
CONFIG_LORA=y
CONFIG_PRINTK=y
```

## src/main.c
```c
/*
 * Copyright (c) 2019 Manivannan Sadhasivam
 *
 * SPDX-License-Identifier: Apache-2.0
 */

#include <zephyr/device.h>
#include <zephyr/drivers/lora.h>
#include <errno.h>
#include <zephyr/sys/util.h>
#include <zephyr/kernel.h>

#define DEFAULT_RADIO_NODE DT_ALIAS(lora0)
BUILD_ASSERT(DT_NODE_HAS_STATUS_OKAY(DEFAULT_RADIO_NODE),
	     "No default LoRa radio specified in DT");

#define MAX_DATA_LEN 12

#define LOG_LEVEL CONFIG_LOG_DEFAULT_LEVEL
#include <zephyr/logging/log.h>
LOG_MODULE_REGISTER(lora_send);

char data[MAX_DATA_LEN] = {'h', 'e', 'l', 'l', 'o', 'w', 'o', 'r', 'l', 'd', ' ', '0'};

int main(void)
{
	const struct device *const lora_dev = DEVICE_DT_GET(DEFAULT_RADIO_NODE);
#ifdef CONFIG_SAMPLE_LORA_GFSK
	struct lora_modem_config_gfsk config = {0};
#else
	struct lora_modem_config config = {0};
#endif
	int ret;

	if (!device_is_ready(lora_dev)) {
		LOG_ERR("%s Device not ready", lora_dev->name);
		return 0;
	}

#ifdef CONFIG_SAMPLE_LORA_GFSK
	/* The 50 kbps FSK that LoRaWAN defines as DR7. A backend whose library
	 * writes the sync word, the pulse shape and the whitening itself takes
	 * these and nothing else.
	 */
	config.frequency = 865100000;
	config.bitrate = 50000;
	config.freq_deviation = 25000;
	config.bandwidth = 100000;
	config.pulse_shape = LORA_GFSK_PULSE_SHAPE_BT_1_0;
	config.sync_word[0] = 0xC1;
	config.sync_word[1] = 0x94;
	config.sync_word[2] = 0xC1;
	config.sync_word_len = 3;
	config.preamble_len = 5;
	config.whitening = true;
	config.tx_power = 4;
	config.tx = true;

	ret = lora_config_gfsk(lora_dev, &config);
#else
	config.frequency = 865100000;
	config.bandwidth = BW_125_KHZ;
	config.datarate = SF_10;
	config.preamble_len = 8;
	config.coding_rate = CR_4_5;
	config.iq_inverted = false;
	config.public_network = false;
	config.tx_power = 4;
	config.tx = true;

	ret = lora_config(lora_dev, &config);
#endif
	if (ret < 0) {
		LOG_ERR("LoRa config failed");
		return 0;
	}

	LOG_INF("Expected packet airtime: %u ms", lora_airtime(lora_dev, MAX_DATA_LEN));

	while (1) {
		ret = lora_send(lora_dev, data, MAX_DATA_LEN);
		if (ret < 0) {
			LOG_ERR("LoRa send failed");
			return 0;
		}

		LOG_INF("Data sent %c!", data[MAX_DATA_LEN - 1]);

		/* Send data at 1s interval */
		k_sleep(K_MSEC(1000));

		/* Increment final character to differentiate packets */
		if (data[MAX_DATA_LEN - 1] == '9') {
			data[MAX_DATA_LEN - 1] = '0';
		} else {
			data[MAX_DATA_LEN - 1] += 1;
		}
	}
	return 0;
}
```
