## CMakeLists.txt
```
cmake_minimum_required(VERSION 3.8.2)
include($ENV{ZEPHYR_BASE}/cmake/app/boilerplate.cmake NO_POLICY_SCOPE)
project(LoRaWAN)

target_sources(app PRIVATE src/main.c )
zephyr_sources_ifdef(CONFIG_SYS_POWER_MANAGEMENT src/power.c)
zephyr_sources_ifdef(CONFIG_DEVICE_POWER_MANAGEMENT src/device.c)
```

## sample.yaml
```
sample:
  description: Hello World sample, the simplest Zephyr
    application
  name: hello world
  platforms: all
common:
    tags: samples
    harness: console
    harness_config:
      type: one_line
      regex:
        - "Hello World! (.*)"
tests:
  sample.helloworld.multithread:
    tags: samples
```

## prj.conf
```kconfig
CONFIG_SYS_LOG=y
CONFIG_SYS_LOG_DEFAULT_LEVEL=4
CONFIG_PRINTK=y
CONFIG_HEAP_MEM_POOL_SIZE=256
CONFIG_UART_0_NRF_TX_PIN=22
CONFIG_UART_0_NRF_RX_PIN=34

CONFIG_LORA=y
CONFIG_LORA_DEVICE_USES_UARTE=y
CONFIG_LORA_DEVICE_RN2483=y
CONFIG_LORA_UARTE0=y
CONFIG_LORA_UART0=y
CONFIG_RTT_CONSOLE=y

CONFIG_SYS_POWER_MANAGEMENT=y
CONFIG_SYS_POWER_LOW_POWER_STATE=y
CONFIG_SYS_POWER_DEEP_SLEEP=y
CONFIG_DEVICE_POWER_MANAGEMENT=y
CONFIG_TICKLESS_IDLE=y
CONFIG_GPIO=y

CONFIG_CLOCK_CONTROL_NRF5_K32SRC_RC=y
```

## prj_chris.conf
```kconfig
# Generated by Kconfiglib (https://github.com/ulfalizer/Kconfiglib)
CONFIG_BOARD="nrf52840_pca10056"
CONFIG_UART_0_NRF_TX_PIN=22
CONFIG_UART_0_NRF_RX_PIN=34
CONFIG_UART_0_NRF_RTS_PIN=5
CONFIG_UART_0_NRF_CTS_PIN=7
CONFIG_UART_1_NRF_TX_PIN=32
CONFIG_UART_1_NRF_RX_PIN=13
CONFIG_SOC="nRF52840_QIAA"
CONFIG_SOC_SERIES="nrf52"
CONFIG_NUM_IRQS=48
CONFIG_SYS_CLOCK_HW_CYCLES_PER_SEC=32768
# CONFIG_WATCHDOG is not set
CONFIG_ISR_STACK_SIZE=2048
CONFIG_SYS_POWER_MANAGEMENT=y
CONFIG_NET_CONFIG_IEEE802154_DEV_NAME=""
CONFIG_BUILD_OUTPUT_HEX=y
CONFIG_GPIO=y
CONFIG_GPIO_NRFX=y
CONFIG_SYS_CLOCK_TICKS_PER_SEC=100
# CONFIG_SPI is not set
CONFIG_TEXT_SECTION_OFFSET=0
CONFIG_BOARD_NRF52840_PCA10056=y

#
# Board Options
#
CONFIG_BOARD_ENABLE_DCDC=y

#
# Shields
#
# CONFIG_SOC_SERIES_BEETLE is not set
# CONFIG_SOC_SERIES_MPS2 is not set
# CONFIG_SOC_SERIES_SAM3X is not set
# CONFIG_SOC_SERIES_SAM4S is not set
# CONFIG_SOC_SERIES_SAME70 is not set
# CONFIG_SOC_SERIES_SAMD20 is not set
# CONFIG_SOC_SERIES_SAMD21 is not set
# CONFIG_SOC_SERIES_NRF51X is not set
CONFIG_SOC_SERIES_NRF52X=y
# CONFIG_SOC_SERIES_IMX_6X_M4 is not set
# CONFIG_SOC_SERIES_IMX7_M4 is not set
# CONFIG_SOC_SERIES_IMX_RT is not set
# CONFIG_SOC_SERIES_KINETIS_K6X is not set
# CONFIG_SOC_SERIES_KINETIS_KL2X is not set
# CONFIG_SOC_SERIES_KINETIS_KWX is not set
# CONFIG_SOC_SERIES_LPC54XXX is not set
# CONFIG_SOC_SERIES_EFM32WG is not set
# CONFIG_SOC_SERIES_EFR32FG1P is not set
# CONFIG_SOC_SERIES_STM32F0X is not set
# CONFIG_SOC_SERIES_STM32F1X is not set
# CONFIG_SOC_SERIES_STM32F2X is not set
# CONFIG_SOC_SERIES_STM32F3X is not set
# CONFIG_SOC_SERIES_STM32F4X is not set
# CONFIG_SOC_SERIES_STM32F7X is not set
# CONFIG_SOC_SERIES_STM32L0X is not set
# CONFIG_SOC_SERIES_STM32L4X is not set
# CONFIG_SOC_TI_LM3S6965 is not set
# CONFIG_SOC_SERIES_CC2650 is not set
# CONFIG_SOC_SERIES_CC32XX is not set
# CONFIG_SOC_SERIES_MSP432P4XX is not set

#
# ARM Options
#

#
# SoC Configuration
#
CONFIG_SOC_FAMILY="nordic_nrf"
CONFIG_SOC_FAMILY_NRF=y
CONFIG_HAS_HW_NRF_ACL=y
CONFIG_HAS_HW_NRF_CC310=y
CONFIG_HAS_HW_NRF_CCM=y
CONFIG_HAS_HW_NRF_CLOCK=y
CONFIG_HAS_HW_NRF_COMP=y
CONFIG_HAS_HW_NRF_ECB=y
CONFIG_HAS_HW_NRF_EGU0=y
CONFIG_HAS_HW_NRF_EGU1=y
CONFIG_HAS_HW_NRF_EGU2=y
CONFIG_HAS_HW_NRF_EGU3=y
CONFIG_HAS_HW_NRF_EGU4=y
CONFIG_HAS_HW_NRF_EGU5=y
CONFIG_HAS_HW_NRF_GPIO0=y
CONFIG_HAS_HW_NRF_GPIO1=y
CONFIG_HAS_HW_NRF_GPIOTE=y
CONFIG_HAS_HW_NRF_I2S=y
CONFIG_HAS_HW_NRF_LPCOMP=y
CONFIG_HAS_HW_NRF_MWU=y
CONFIG_HAS_HW_NRF_NFCT=y
CONFIG_HAS_HW_NRF_PDM=y
CONFIG_HAS_HW_NRF_POWER=y
CONFIG_HAS_HW_NRF_PPI=y
CONFIG_HAS_HW_NRF_PWM0=y
CONFIG_HAS_HW_NRF_PWM1=y
CONFIG_HAS_HW_NRF_PWM2=y
CONFIG_HAS_HW_NRF_PWM3=y
CONFIG_HAS_HW_NRF_QDEC=y
CONFIG_HAS_HW_NRF_QSPI=y
CONFIG_HAS_HW_NRF_RNG=y
CONFIG_HAS_HW_NRF_RTC0=y
CONFIG_HAS_HW_NRF_RTC1=y
CONFIG_HAS_HW_NRF_RTC2=y
CONFIG_HAS_HW_NRF_SAADC=y
CONFIG_HAS_HW_NRF_SPI0=y
CONFIG_HAS_HW_NRF_SPI1=y
CONFIG_HAS_HW_NRF_SPI2=y
CONFIG_HAS_HW_NRF_SPIM0=y
CONFIG_HAS_HW_NRF_SPIM1=y
CONFIG_HAS_HW_NRF_SPIM2=y
CONFIG_HAS_HW_NRF_SPIM3=y
CONFIG_HAS_HW_NRF_SPIS0=y
CONFIG_HAS_HW_NRF_SPIS1=y
CONFIG_HAS_HW_NRF_SPIS2=y
CONFIG_HAS_HW_NRF_SWI0=y
CONFIG_HAS_HW_NRF_SWI1=y
CONFIG_HAS_HW_NRF_SWI2=y
CONFIG_HAS_HW_NRF_SWI3=y
CONFIG_HAS_HW_NRF_SWI4=y
CONFIG_HAS_HW_NRF_SWI5=y
CONFIG_HAS_HW_NRF_TEMP=y
CONFIG_HAS_HW_NRF_TIMER0=y
CONFIG_HAS_HW_NRF_TIMER1=y
CONFIG_HAS_HW_NRF_TIMER2=y
CONFIG_HAS_HW_NRF_TIMER3=y
CONFIG_HAS_HW_NRF_TIMER4=y
CONFIG_HAS_HW_NRF_TWI0=y
CONFIG_HAS_HW_NRF_TWI1=y
CONFIG_HAS_HW_NRF_TWIM0=y
CONFIG_HAS_HW_NRF_TWIM1=y
CONFIG_HAS_HW_NRF_TWIS0=y
CONFIG_HAS_HW_NRF_TWIS1=y
CONFIG_HAS_HW_NRF_UART0=y
CONFIG_HAS_HW_NRF_UARTE0=y
CONFIG_HAS_HW_NRF_UARTE1=y
CONFIG_HAS_HW_NRF_USBD=y
CONFIG_HAS_HW_NRF_WDT=y
CONFIG_SOC_NRF52840=y
# CONFIG_SOC_NRF52810_QFAA is not set
# CONFIG_SOC_NRF52832_QFAA is not set
CONFIG_SOC_NRF52840_QIAA=y
CONFIG_SOC_DCDC_NRF52X=y
CONFIG_ARM_MPU_NRF52X=y
# CONFIG_NFCT_PINS_AS_GPIOS is not set
CONFIG_GPIO_AS_PINRESET=y
CONFIG_NRF_ENABLE_ICACHE=y
CONFIG_CPU_CORTEX=y
CONFIG_CPU_CORTEX_M=y

#
# Architecture Floating Point Options
#
CONFIG_CPU_CORTEX_M4=y
CONFIG_ISA_THUMB2=y
CONFIG_CPU_CORTEX_M_HAS_BASEPRI=y
CONFIG_CPU_CORTEX_M_HAS_VTOR=y
CONFIG_CPU_CORTEX_M_HAS_PROGRAMMABLE_FAULT_PRIOS=y
CONFIG_ARMV7_M_ARMV8_M_MAINLINE=y
CONFIG_ARMV7_M_ARMV8_M_FP=y

#
# ARM Cortex-M options
#
CONFIG_LDREX_STREX_AVAILABLE=y
CONFIG_DATA_ENDIANNESS_LITTLE=y
CONFIG_STACK_ALIGN_DOUBLE_WORD=y
# CONFIG_RUNTIME_NMI is not set
CONFIG_FAULT_DUMP=2
CONFIG_XIP=y

#
# ARM Cortex-M0/M0+/M3/M4/M7/M23/M33 options
#
CONFIG_GEN_ISR_TABLES=y
# CONFIG_ZERO_LATENCY_IRQS is not set
# CONFIG_PLATFORM_SPECIFIC_INIT is not set
CONFIG_ARM_CORE_MPU=y
# CONFIG_MPU_STACK_GUARD is not set
CONFIG_ARM_MPU=y
# CONFIG_MPU_ALLOW_FLASH_WRITE is not set
CONFIG_ARCH="arm"
CONFIG_ARCH_DEFCONFIG="arch/arm/defconfig"
# CONFIG_ARC is not set
CONFIG_ARM=y
# CONFIG_X86 is not set
# CONFIG_NIOS2 is not set
# CONFIG_RISCV32 is not set
# CONFIG_XTENSA is not set
# CONFIG_ARCH_POSIX is not set

#
# General Architecture Options
#
# CONFIG_HW_STACK_PROTECTION is not set
# CONFIG_USERSPACE is not set
CONFIG_PRIVILEGED_STACK_SIZE=256
# CONFIG_STACK_GROWS_UP is not set
# CONFIG_SIMPLE_FATAL_ERROR_HANDLER is not set

#
# Interrupt Configuration
#
CONFIG_GEN_IRQ_VECTOR_TABLE=y
CONFIG_GEN_SW_ISR_TABLE=y
CONFIG_GEN_IRQ_START_VECTOR=0
# CONFIG_IRQ_OFFLOAD is not set
CONFIG_ARCH_HAS_STACK_PROTECTION=y
CONFIG_ARCH_HAS_USERSPACE=y
CONFIG_ARCH_HAS_EXECUTABLE_PAGE_BIT=y
CONFIG_ARCH_HAS_THREAD_ABORT=y
CONFIG_SYS_POWER_LOW_POWER_STATE_SUPPORTED=y
CONFIG_SYS_POWER_DEEP_SLEEP_SUPPORTED=y
CONFIG_CPU_HAS_FPU=y
CONFIG_CPU_HAS_MPU=y
CONFIG_MPU_REQUIRES_POWER_OF_TWO_ALIGNMENT=y

#
# Floating Point Options
#
# CONFIG_FLOAT is not set

#
# General Kernel Options
#
CONFIG_MULTITHREADING=y
CONFIG_NUM_COOP_PRIORITIES=16
CONFIG_NUM_PREEMPT_PRIORITIES=15
CONFIG_MAIN_THREAD_PRIORITY=0
CONFIG_COOP_ENABLED=y
CONFIG_PREEMPT_ENABLED=y
CONFIG_PRIORITY_CEILING=0
CONFIG_NUM_METAIRQ_PRIORITIES=0
# CONFIG_SCHED_DEADLINE is not set
CONFIG_MAIN_STACK_SIZE=1024
CONFIG_IDLE_STACK_SIZE=320
CONFIG_THREAD_STACK_INFO=y
# CONFIG_THREAD_CUSTOM_DATA is not set
CONFIG_ERRNO=y
# CONFIG_APPLICATION_MEMORY is not set
CONFIG_SCHED_DUMB=y
# CONFIG_SCHED_SCALABLE is not set
# CONFIG_SCHED_MULTIQ is not set
# CONFIG_WAITQ_SCALABLE is not set
CONFIG_WAITQ_DUMB=y

#
# Kernel Debugging and Metrics
#
# CONFIG_INIT_STACKS is not set
# CONFIG_KERNEL_DEBUG is not set
CONFIG_BOOT_BANNER=y
CONFIG_BOOT_DELAY=0
# CONFIG_BUILD_TIMESTAMP is not set
# CONFIG_EXECUTION_BENCHMARKING is not set
# CONFIG_THREAD_MONITOR is not set

#
# Work Queue Options
#
CONFIG_SYSTEM_WORKQUEUE_STACK_SIZE=1024
CONFIG_SYSTEM_WORKQUEUE_PRIORITY=-1
CONFIG_OFFLOAD_WORKQUEUE_STACK_SIZE=1024
CONFIG_OFFLOAD_WORKQUEUE_PRIORITY=-1

#
# Atomic Operations
#
CONFIG_ATOMIC_OPERATIONS_BUILTIN=y

#
# Timer API Options
#
CONFIG_TIMESLICING=y
CONFIG_TIMESLICE_SIZE=0
CONFIG_TIMESLICE_PRIORITY=0
CONFIG_POLL=y

#
# Other Kernel Object Options
#
CONFIG_NUM_MBOX_ASYNC_MSGS=10
CONFIG_NUM_PIPE_ASYNC_MSGS=10
CONFIG_HEAP_MEM_POOL_SIZE=256
CONFIG_ARCH_HAS_CUSTOM_SWAP_TO_MAIN=y
CONFIG_SYS_CLOCK_EXISTS=y

#
# Initialization Priorities
#
CONFIG_KERNEL_INIT_PRIORITY_OBJECTS=30
CONFIG_KERNEL_INIT_PRIORITY_DEFAULT=40
CONFIG_KERNEL_INIT_PRIORITY_DEVICE=50
CONFIG_APPLICATION_INIT_PRIORITY=90

#
# Security Options
#
CONFIG_RETPOLINE=y
# CONFIG_STACK_CANARIES is not set
CONFIG_STACK_POINTER_RANDOM=0

#
# SMP Options
#
# CONFIG_USE_SWITCH is not set
# CONFIG_SMP is not set
CONFIG_MP_NUM_CPUS=1
CONFIG_PM_CONTROL_APP=y
# CONFIG_PM_CONTROL_OS is not set
CONFIG_SYS_POWER_LOW_POWER_STATE=y
CONFIG_SYS_POWER_DEEP_SLEEP=y
CONFIG_DEVICE_POWER_MANAGEMENT=y
CONFIG_TICKLESS_IDLE=y
CONFIG_TICKLESS_IDLE_THRESH=3
# CONFIG_TICKLESS_KERNEL is not set
# CONFIG_BUSY_WAIT_USES_ALTERNATE_CLOCK is not set
CONFIG_HAS_DTS=y
CONFIG_HAS_DTS_GPIO=y

#
# Device Drivers
#
CONFIG_UART_GENERIC=y
# CONFIG_UART_SHELL is not set
CONFIG_LORA=y
CONFIG_LORA_DEVICE_USES_UARTE=y
# CONFIG_LORA_SHELL is not set
# CONFIG_LORA_DEVICE_DUMMY is not set
CONFIG_LORA_DEVICE_RN2483=y
CONFIG_LORA_UARTE0=y
# CONFIG_IEEE802154 is not set
CONFIG_CONSOLE=y
CONFIG_CONSOLE_INPUT_MAX_LINE_LEN=128
CONFIG_CONSOLE_HAS_DRIVER=y
# CONFIG_UART_CONSOLE is not set
# CONFIG_USB_UART_CONSOLE is not set
# CONFIG_RAM_CONSOLE is not set
CONFIG_RTT_CONSOLE=y
CONFIG_RTT_TX_RETRY_CNT=2
CONFIG_RTT_TX_RETRY_DELAY_MS=2
CONFIG_RTT_TX_RETRY_IN_INTERRUPT=y
# CONFIG_IPM_CONSOLE_SENDER is not set
# CONFIG_IPM_CONSOLE_RECEIVER is not set
# CONFIG_UART_PIPE is not set
# CONFIG_UART_MCUMGR is not set
# CONFIG_TELNET_CONSOLE is not set
# CONFIG_WEBSOCKET_CONSOLE is not set

#
# Ethernet Drivers
#
# CONFIG_SLIP is not set
# CONFIG_NET_LOOPBACK is not set
CONFIG_SERIAL=y

#
# Capabilities
#
CONFIG_SERIAL_HAS_DRIVER=y
CONFIG_SERIAL_SUPPORT_INTERRUPT=y
CONFIG_UART_INTERRUPT_DRIVEN=y
CONFIG_UART_LINE_CTRL=y
CONFIG_UART_DRV_CMD=y

#
# Serial Drivers
#
# CONFIG_UART_NS16550 is not set
# CONFIG_UART_STELLARIS is not set
# CONFIG_UART_NSIM is not set
CONFIG_UART_NRFX=y
# CONFIG_UART_0_NRF_UART is not set
CONFIG_UART_0_NRF_UARTE=y
CONFIG_UART_0_INTERRUPT_DRIVEN=y
# CONFIG_UART_0_NRF_PARITY_BIT is not set
# CONFIG_UART_0_NRF_FLOW_CONTROL is not set
CONFIG_UART_0_NRF_TX_BUFFER_SIZE=32
CONFIG_UART_1_NRF_UARTE=y
CONFIG_UART_1_INTERRUPT_DRIVEN=y
# CONFIG_UART_1_NRF_PARITY_BIT is not set
# CONFIG_UART_1_NRF_FLOW_CONTROL is not set
CONFIG_UART_1_NRF_TX_BUFFER_SIZE=32
CONFIG_NRF_UARTE_PERIPHERAL=y
# CONFIG_UART_ALTERA_JTAG is not set
CONFIG_HW_UARTE0_ENABLED=y

#
# Interrupt Controllers
#
# CONFIG_MULTI_LEVEL_INTERRUPTS is not set

#
# Timer Drivers
#
CONFIG_NRF_RTC_TIMER=y
# CONFIG_SYSTEM_CLOCK_DISABLE is not set
# CONFIG_TIMER_READS_ITS_FREQUENCY_AT_RUNTIME is not set
CONFIG_SYSTEM_CLOCK_INIT_PRIORITY=0
CONFIG_ENTROPY_GENERATOR=y
CONFIG_ENTROPY_NRF5_RNG=y
CONFIG_ENTROPY_NRF5_BIAS_CORRECTION=y
CONFIG_ENTROPY_NRF5_THR_THRESHOLD=4
CONFIG_ENTROPY_NRF5_ISR_THRESHOLD=12
CONFIG_ENTROPY_NRF5_THR_BUF_LEN=4
CONFIG_ENTROPY_NRF5_ISR_BUF_LEN=12
CONFIG_ENTROPY_NRF5_PRI=5
CONFIG_ENTROPY_HAS_DRIVER=y
CONFIG_ENTROPY_NAME="ENTROPY_0"
CONFIG_SYS_LOG_ENTROPY_LEVEL=0
# CONFIG_GROVE is not set
CONFIG_SYS_LOG_GPIO_LEVEL=0
# CONFIG_GPIO_DW is not set
# CONFIG_GPIO_SCH is not set
CONFIG_GPIO_NRF_INIT_PRIORITY=40
CONFIG_GPIO_NRF_P0=y
CONFIG_GPIO_NRF_P1=y
# CONFIG_SHARED_IRQ is not set
# CONFIG_I2C is not set
# CONFIG_I2S is not set
# CONFIG_PWM is not set
# CONFIG_PINMUX is not set
# CONFIG_ADC is not set
# CONFIG_RTC is not set
CONFIG_CLOCK_CONTROL=y
CONFIG_SYS_LOG_CLOCK_CONTROL_LEVEL=0
CONFIG_CLOCK_CONTROL_NRF5=y
CONFIG_CLOCK_CONTROL_NRF5_IRQ_PRIORITY=1
CONFIG_CLOCK_CONTROL_NRF5_M16SRC_DRV_NAME="clk_m16src"
CONFIG_CLOCK_CONTROL_NRF5_K32SRC_DRV_NAME="clk_k32src"
# CONFIG_CLOCK_CONTROL_NRF5_K32SRC_RC is not set
CONFIG_CLOCK_CONTROL_NRF5_K32SRC_XTAL=y
# CONFIG_CLOCK_CONTROL_NRF5_K32SRC_BLOCKING is not set
# CONFIG_CLOCK_CONTROL_NRF5_K32SRC_500PPM is not set
# CONFIG_CLOCK_CONTROL_NRF5_K32SRC_250PPM is not set
# CONFIG_CLOCK_CONTROL_NRF5_K32SRC_150PPM is not set
# CONFIG_CLOCK_CONTROL_NRF5_K32SRC_100PPM is not set
# CONFIG_CLOCK_CONTROL_NRF5_K32SRC_75PPM is not set
# CONFIG_CLOCK_CONTROL_NRF5_K32SRC_50PPM is not set
# CONFIG_CLOCK_CONTROL_NRF5_K32SRC_30PPM is not set
CONFIG_CLOCK_CONTROL_NRF5_K32SRC_20PPM=y
# CONFIG_CLOCK_CONTROL_QUARK_SE is not set
# CONFIG_PTP_CLOCK is not set
# CONFIG_IPM is not set
# CONFIG_AIO_COMPARATOR is not set
# CONFIG_FLASH is not set
# CONFIG_SENSOR is not set
# CONFIG_COUNTER is not set
# CONFIG_DMA is not set
# CONFIG_USB is not set
# CONFIG_CRYPTO is not set
# CONFIG_DISPLAY is not set
# CONFIG_LED_STRIP is not set
# CONFIG_WIFI is not set
# CONFIG_LED is not set
# CONFIG_CAN is not set
CONFIG_MODEM=y
# CONFIG_MODEM_RECEIVER is not set
# CONFIG_MODEM_SHELL is not set
# CONFIG_MODEM_WNCM14A2A is not set
CONFIG_SYS_LOG_MODEM_LEVEL=0
# CONFIG_AUDIO is not set

#
# Build and Link Features
#

#
# Linker Options
#
CONFIG_HAS_FLASH_LOAD_OFFSET=y
# CONFIG_HAVE_CUSTOM_LINKER_SCRIPT is not set
# CONFIG_CUSTOM_RODATA_LD is not set
# CONFIG_CUSTOM_RWDATA_LD is not set
# CONFIG_CUSTOM_SECTIONS_LD is not set
# CONFIG_LINK_WHOLE_ARCHIVE is not set
CONFIG_KERNEL_ENTRY="__start"
CONFIG_CHECK_LINK_MAP=y

#
# Compiler Options
#
CONFIG_CROSS_COMPILE=""
# CONFIG_NATIVE_APPLICATION is not set
CONFIG_SIZE_OPTIMIZATIONS=y
# CONFIG_SPEED_OPTIMIZATIONS is not set
# CONFIG_DEBUG_OPTIMIZATIONS is not set
# CONFIG_NO_OPTIMIZATIONS is not set
CONFIG_COMPILER_OPT=""
# CONFIG_CPLUSPLUS is not set

#
# Build Options
#
CONFIG_KERNEL_BIN_NAME="zephyr"
CONFIG_OUTPUT_STAT=y
CONFIG_OUTPUT_DISASSEMBLY=y
CONFIG_OUTPUT_PRINT_MEMORY_USAGE=y
CONFIG_BUILD_OUTPUT_BIN=y
# CONFIG_BUILD_OUTPUT_EXE is not set
# CONFIG_BUILD_OUTPUT_S19 is not set
# CONFIG_BUILD_OUTPUT_STRIPPED is not set
# CONFIG_APPLICATION_DEFINED_SYSCALL is not set

#
# System Monitoring Options
#
# CONFIG_PERFORMANCE_METRICS is not set
# CONFIG_STATS is not set

#
# Boot Options
#
# CONFIG_IS_BOOTLOADER is not set
# CONFIG_BOOTLOADER_MCUBOOT is not set
# CONFIG_REBOOT is not set

#
# C Library
#
# CONFIG_NEWLIB_LIBC is not set
# CONFIG_STDOUT_CONSOLE is not set
CONFIG_MINIMAL_LIBC_MALLOC_ARENA_SIZE=0

#
# Additional libraries
#
# CONFIG_JSON_LIBRARY is not set
# CONFIG_RING_BUFFER is not set
# CONFIG_BASE64 is not set
# CONFIG_PTHREAD_IPC is not set
# CONFIG_CMSIS_RTOS_V1 is not set

#
# Bluetooth
#
CONFIG_BT=y
CONFIG_BT_HCI=y
# CONFIG_BT_CUSTOM is not set
# CONFIG_BT_HCI_RAW is not set
# CONFIG_BT_PERIPHERAL is not set
# CONFIG_BT_CENTRAL is not set

#
# Broadcaster
#
CONFIG_BT_BROADCASTER=y

#
# Observer
#
# CONFIG_BT_OBSERVER is not set
CONFIG_BT_HCI_VS_EXT=y
CONFIG_BT_DEBUG_NONE=y
# CONFIG_BT_DEBUG_LOG is not set
# CONFIG_BT_DEBUG_MONITOR is not set

#
# Host Stack Configuration
#
CONFIG_BT_HCI_HOST=y
CONFIG_BT_HCI_CMD_COUNT=2
CONFIG_BT_RX_BUF_COUNT=3
CONFIG_BT_RX_BUF_LEN=76
CONFIG_BT_HCI_TX_STACK_SIZE=640
CONFIG_BT_HCI_TX_PRIO=7
# CONFIG_BT_WAIT_NOP is not set
CONFIG_BT_HCI_RESERVE=0
CONFIG_BT_RECV_IS_RX_THREAD=y
CONFIG_BT_RX_STACK_SIZE=1024
CONFIG_BT_RX_PRIO=8
# CONFIG_BT_DEVICE_NAME_DYNAMIC is not set
CONFIG_BT_DEVICE_NAME="Zephyr"
CONFIG_BT_DEVICE_APPEARANCE=0
CONFIG_BT_ID_MAX=1
# CONFIG_BT_TINYCRYPT_ECC is not set
# CONFIG_BT_TESTING is not set
# CONFIG_BT_BREDR is not set

#
# BLE Controller support
#
CONFIG_BT_CTLR=y
CONFIG_BT_LL_SW=y

#
# BLE Controller configuration
#
CONFIG_BT_CTLR_CRYPTO=y
CONFIG_BT_CTLR_RX_PRIO_STACK_SIZE=448
CONFIG_BT_CTLR_RX_PRIO=6
CONFIG_BT_CTLR_FILTER=y
CONFIG_BT_CTLR_HCI_VS_BUILD_INFO=""
CONFIG_BT_CTLR_RX_BUFFERS=1
CONFIG_BT_CTLR_TX_BUFFERS=2
CONFIG_BT_CTLR_TX_BUFFER_SIZE=27
# CONFIG_BT_CTLR_TX_PWR_PLUS_8 is not set
# CONFIG_BT_CTLR_TX_PWR_PLUS_7 is not set
# CONFIG_BT_CTLR_TX_PWR_PLUS_6 is not set
# CONFIG_BT_CTLR_TX_PWR_PLUS_5 is not set
# CONFIG_BT_CTLR_TX_PWR_PLUS_4 is not set
# CONFIG_BT_CTLR_TX_PWR_PLUS_3 is not set
# CONFIG_BT_CTLR_TX_PWR_PLUS_2 is not set
CONFIG_BT_CTLR_TX_PWR_0=y
# CONFIG_BT_CTLR_TX_PWR_MINUS_4 is not set
# CONFIG_BT_CTLR_TX_PWR_MINUS_8 is not set
# CONFIG_BT_CTLR_TX_PWR_MINUS_12 is not set
# CONFIG_BT_CTLR_TX_PWR_MINUS_16 is not set
# CONFIG_BT_CTLR_TX_PWR_MINUS_20 is not set
# CONFIG_BT_CTLR_TX_PWR_MINUS_40 is not set
CONFIG_BT_CTLR_COMPANY_ID=0x05F1
CONFIG_BT_CTLR_SUBVERSION_NUMBER=0xFFFF

#
# BLE Controller features
#
CONFIG_BT_CTLR_CHAN_SEL_2=y
CONFIG_BT_CTLR_MIN_USED_CHAN=y
CONFIG_BT_CTLR_ADV_EXT=y
# CONFIG_BT_CTLR_DTM_HCI is not set
# CONFIG_BT_CTLR_ADVANCED_FEATURES is not set
CONFIG_BT_CTLR_WORKER_PRIO=0
CONFIG_BT_CTLR_JOB_PRIO=0
CONFIG_BT_CTLR_XTAL_ADVANCED=y
CONFIG_BT_CTLR_XTAL_THRESHOLD=1500
CONFIG_BT_CTLR_SCHED_ADVANCED=y
CONFIG_BT_CTLR_RADIO_ENABLE_FAST=y
CONFIG_BT_CTLR_SCAN_REQ_NOTIFY=y

#
# BLE Controller hardware configuration
#
# CONFIG_BT_CTLR_GPIO_PA is not set
# CONFIG_BT_CTLR_GPIO_LNA is not set

#
# BLE Controller debug configuration
#
# CONFIG_BT_CTLR_PROFILE_ISR is not set
# CONFIG_BT_CTLR_DEBUG_PINS is not set
# CONFIG_BT_SHELL is not set

#
# Console
#
CONFIG_CONSOLE_SUBSYS=y

#
# Debugging Options
#
# CONFIG_DEBUG is not set
# CONFIG_TRACING is not set
# CONFIG_STACK_USAGE is not set
# CONFIG_STACK_SENTINEL is not set
CONFIG_PRINTK=y
CONFIG_EARLY_CONSOLE=y
# CONFIG_ASSERT is not set
# CONFIG_FORCE_NO_ASSERT is not set
# CONFIG_OBJECT_TRACING is not set
# CONFIG_OVERRIDE_FRAME_POINTER_DEFAULT is not set
# CONFIG_DEBUG_INFO is not set
# CONFIG_OPENOCD_SUPPORT is not set

#
# Disk
#
# CONFIG_DISK_ACCESS is not set
CONFIG_DISK_ACCESS_MAX_VOLUMES=8
CONFIG_SYS_LOG_DISK_LEVEL=0

#
# File Systems
#
# CONFIG_FILE_SYSTEM is not set
CONFIG_SYS_LOG_FS_LEVEL=0
# CONFIG_NVS is not set

#
# Logging Options
#
CONFIG_SYS_LOG=y
CONFIG_SYS_LOG_SHOW_TAGS=y
# CONFIG_SYS_LOG_SHOW_COLOR is not set
CONFIG_SYS_LOG_DEFAULT_LEVEL=4
CONFIG_SYS_LOG_OVERRIDE_LEVEL=4
# CONFIG_SYS_LOG_EXT_HOOK is not set
# CONFIG_LOG is not set

#
# Management
#
# CONFIG_MCUMGR_SMP_BT is not set
# CONFIG_MCUMGR_SMP_SHELL is not set
# CONFIG_MCUMGR_SMP_UART is not set
CONFIG_MCUMGR_BUF_COUNT=4
CONFIG_MCUMGR_BUF_SIZE=384
CONFIG_MCUMGR_BUF_USER_DATA_SIZE=4

#
# Networking
#
CONFIG_NET_BUF=y
CONFIG_NET_BUF_USER_DATA_SIZE=4
# CONFIG_NET_BUF_LOG is not set
# CONFIG_NET_BUF_POOL_USAGE is not set
# CONFIG_NETWORKING is not set
# CONFIG_CONSOLE_SHELL is not set

#
# DFU options
#
# CONFIG_IMG_MANAGER is not set
CONFIG_ENTROPY_DEVICE_RANDOM_GENERATOR=y
# CONFIG_XOROSHIRO_RANDOM_GENERATOR is not set

#
# Storage
#

#
# General Kernel Options
#
# CONFIG_APP_SHARED_MEM is not set

#
# External Sources
#

#
# HALs
#
CONFIG_HAS_CMSIS=y
# CONFIG_LIBMETAL is not set
CONFIG_LIBMETAL_SRC_PATH="libmetal"
CONFIG_HAS_NRFX=y

#
# Cryptography
#
# CONFIG_TINYCRYPT is not set
# CONFIG_MBEDTLS is not set

#
# Encoding
#
# CONFIG_TINYCBOR is not set
# CONFIG_OPENAMP is not set
CONFIG_OPENAMP_SRC_PATH="open-amp"

#
# Management
#
# CONFIG_MCUMGR is not set

#
# Debug libraries
#
CONFIG_HAS_SEGGER_RTT=y
# CONFIG_SEGGER_SYSTEMVIEW is not set
CONFIG_SEGGER_RTT_MAX_NUM_UP_BUFFERS=3
CONFIG_SEGGER_RTT_MAX_NUM_DOWN_BUFFERS=3
CONFIG_SEGGER_RTT_BUFFER_SIZE_UP=1024
CONFIG_SEGGER_RTT_BUFFER_SIZE_DOWN=64
CONFIG_SEGGER_RTT_PRINTF_BUFFER_SIZE=64
CONFIG_SEGGER_RTT_MODE_NO_BLOCK_SKIP=y
# CONFIG_SEGGER_RTT_MODE_NO_BLOCK_TRIM is not set
# CONFIG_SEGGER_RTT_MODE_BLOCK_IF_FIFO_FULL is not set
CONFIG_SEGGER_RTT_MODE=0
# CONFIG_SEGGER_RTT_MEMCPY_USE_BYTELOOP is not set

#
# Testing
#
# CONFIG_ZTEST is not set
# CONFIG_TEST is not set
CONFIG_TEST_EXTRA_STACKSIZE=0
```

## src/main.c
```c
/*
 * Copyright (c) 2012-2014 Wind River Systems, Inc.
 *
 * SPDX-License-Identifier: Apache-2.0
 */

#include <zephyr.h>
#include <misc/printk.h>
#include <drivers/lora/lora_context.h>
#include <logging/sys_log.h>
#include <power.h>
#include <soc_power.h>
#include <gpio.h>
static struct k_sem quit_lock;
static struct k_thread* pMyThread;

static void lora_joined(void)
{
	SYS_LOG_DBG("Joined LoRa network");
}

static void lora_device_ready(bool success)
{

}

static struct lora_context_cb lora_callbacks = {
		.ready = lora_device_ready,
		.joined = lora_joined
};

void main(void)
{

	struct device *lora_dev = device_get_binding(LORA_DEV_NAME);

    //k_sem_init(&quit_lock, 0, UINT_MAX);

/*
    while(true)
    {
        printk("HI");
#define BUSY_WAIT_DELAY_US		(2 * 1000000)
        k_busy_wait(BUSY_WAIT_DELAY_US);
    }
*/
/*
	lora_context_init(&lora_callbacks);
	struct lora_driver_api* lora_api = (struct lora_driver_api *) lora_dev->driver_api;
	lora_api->callback_register(lora_dev, &lora_callbacks);

    int ret = lora_api->join(lora_dev);*/
SYS_LOG_DBG("Oink");
#define BUSY_WAIT_DELAY_US		(20 * 1000000)

while(true)
{
#define LPS_STATE_ENTER_TO		(30 * 1000)
    k_sleep(300);
  //  k_busy_wait(BUSY_WAIT_DELAY_US);
}

    /*
#define BUSY_WAIT_DELAY_US		(20 * 1000000)
	k_busy_wait(BUSY_WAIT_DELAY_US);
#define LPS_STATE_ENTER_TO		(30 * 1000)
	k_sleep(LPS_STATE_ENTER_TO);*/

	//_sys_soc_suspend(1000*100);
	//while(true);
    //k_sem_take(&quit_lock, K_FOREVER);
}
```

## src/device.c
```c
/*
 * Copyright (c) 2018 Intel Corporation.
 *
 * SPDX-License-Identifier: Apache-2.0
 */

#include <logging/sys_log.h>
#include "test.h"

static struct device *gpiob;
static struct device *device_list;
static int device_count;

/*
 * Example ordered list to store devices on which
 * device power policies would be executed.
 */
#define DEVICE_POLICY_MAX 15
static char device_ordered_list[DEVICE_POLICY_MAX];
static char device_retval[DEVICE_POLICY_MAX];

/* Initialize and configure GPIO */
void gpio_setup(void)
{

	gpiob = device_get_binding(PORT);

	/* Configure button 1 as deep sleep trigger event */
	gpio_pin_configure(gpiob, BUTTON_1, GPIO_DIR_IN
				| GPIO_PUD_PULL_UP);

	/* Configure button 2 as wake source from deep sleep */
	gpio_pin_configure(gpiob, BUTTON_2, GPIO_DIR_IN
				| GPIO_PUD_PULL_UP
				| GPIO_INT | GPIO_INT_LEVEL
				| GPIO_CFG_SENSE_LOW);

	gpio_pin_enable_callback(gpiob, BUTTON_2);
}

void suspend_devices(void)
{

	for (int i = device_count - 1; i >= 0; i--) {
		int idx = device_ordered_list[i];

		/* If necessary  the policy manager can check if a specific
		 * device in the device list is busy as shown below :
		 * if(device_busy_check(&device_list[idx])) {do something}
		 */
		if(device_busy_check(&device_list[idx])) {
			SYS_LOG_DBG("device #%u is busy, can't sleep", idx);
		}

		device_retval[i] = device_set_power_state(&device_list[idx],
						DEVICE_PM_SUSPEND_STATE);

	}
}

void resume_devices(void)
{
	int i;

	for (i = 0; i < device_count; i++) {
		if (!device_retval[i]) {
			int idx = device_ordered_list[i];

			device_set_power_state(&device_list[idx],
						DEVICE_PM_ACTIVE_STATE);
		}
	}
}

void create_device_list(void)
{
	int count;
	int i;

	/*
	 * Following is an example of how the device list can be used
	 * to suspend devices based on custom policies.
	 *
	 * Create an ordered list of devices that will be suspended.
	 * Ordering should be done based on dependencies. Devices
	 * in the beginning of the list will be resumed first.
	 */
	device_list_get(&device_list, &count);
	device_count = 2; /* Reserve for 32KHz, 16MHz, system clock, and uart */
SYS_LOG_DBG("create_device_list");
	for (i = 0; (i < count) && (device_count < DEVICE_POLICY_MAX); i++) {
		if (!strcmp(device_list[i].config->name, "clk_m16src")) {
			device_ordered_list[0] = i;
		} else if (!strcmp(device_list[i].config->name, "sys_clock")) {
			device_ordered_list[1] = i;
		} else if (!strcmp(device_list[i].config->name, "UART_0")) {
			device_ordered_list[2] = i;
		} else {
			device_ordered_list[device_count++] = i;
		}
	}
}
```

## src/power.c
```c
/*
 * Copyright (c) 2018 Intel Corporation.
 *
 * SPDX-License-Identifier: Apache-2.0
 */
#include <zephyr.h>
#include <power.h>
#include <soc_power.h>

#include <string.h>
#include <board.h>
#include <device.h>
#include <gpio.h>
#include <logging/sys_log.h>

/* In Tickless Kernel mode, time is passed in milliseconds instead of ticks */
#define TICKS_TO_SECONDS_MULTIPLIER 1000
#define TIME_UNIT_STRING "milliseconds"

#define MIN_TIME_TO_SUSPEND	((SECONDS_TO_SLEEP * \
				  TICKS_TO_SECONDS_MULTIPLIER) - \
				  (TICKS_TO_SECONDS_MULTIPLIER / 2))

#ifdef CONFIG_TICKLESS_KERNEL
#define SECS_TO_TICKS		1000
#else
#define SECS_TO_TICKS		100
#endif

#define LPS_MAX_THR		(60 * SECS_TO_TICKS)
#define LPS_1_MAX_THR		(120 * SECS_TO_TICKS)

/* Suspend Devices based on Ordered List */
void suspend_devices(void);
/* Resume Devices */
void resume_devices(void);

static int post_ops_done = 1;
static int pm_state;

/* This Function decides which Low Power Mode to Enter based on Idleness.
 * In actual Application this decision can be made using time (ticks)
 * And RTC timer can be programmed to wake the device after time elapsed.
 */
static int pm_policy_get_state(s32_t ticks)
{
	/*
	 * Power Management Policy:
	 * 0 - 60 Sec:  Enter Constant Latency Mode
	 * 61 - 120 Sec: Enter Low Power state
	 * 121 and above : Enter Deep Sleep state
	 */
	if ((ticks != K_FOREVER) && ticks <= LPS_MAX_THR) {
		return SYS_POWER_STATE_CPU_LPS;
	} else if ((ticks > LPS_MAX_THR) &&
			(ticks <= LPS_1_MAX_THR)) {
		return SYS_POWER_STATE_CPU_LPS_1;
	} else {
		return SYS_POWER_STATE_DEEP_SLEEP;
	}
}

static void low_power_state_exit(void)
{
	/* Perform some Application specific task on Low Power Mode Exit */

	/* Turn on suspended peripherals/clocks as necessary */
	//SYS_LOG_DBG("-- Low Power State exit !");
}

static int low_power_state_entry(void)
{
	if (pm_state == SYS_POWER_STATE_CPU_LPS) {
        //SYS_LOG_DBG("--> Entering into Constant Latency State -");
	} else {
        //SYS_LOG_DBG("--> Entering into Low Power State -");
	}
	_sys_soc_set_power_state(pm_state);
	return SYS_PM_LOW_POWER_STATE;
}

static void low_power_suspend_exit(void)
{
	/* Turn on peripherals and restore device states as necessary */
	resume_devices();
    //SYS_LOG_DBG("-- Low Power Suspend State exit!\n");
}

static int low_power_suspend_entry(void)
{
    SYS_LOG_DBG("--> Entering into Deep Sleep State -");
	/* Don't need pm idle exit event notification */
	_sys_soc_pm_idle_exit_notification_disable();
	/* Save device states and turn off peripherals as necessary */
	suspend_devices();
	_sys_soc_set_power_state(SYS_POWER_STATE_DEEP_SLEEP);
	 /* Exiting from Deep Sleep State */
	low_power_suspend_exit();

	return SYS_PM_DEEP_SLEEP;
}

/* Function name : _sys_soc_suspend
 * Return Value : Power Mode Entered Success/Failure
 * Input : Idleness in number of Ticks
 *
 * Description: All request from Idle thread to Enter into
 * Low Power Mode or Deep Sleep State land in this function
 */
int _sys_soc_suspend(s32_t ticks)
{
	int ret = SYS_PM_NOT_HANDLED;

	post_ops_done = 0;
/*
	if ((ticks != K_FOREVER) && (ticks < MIN_TIME_TO_SUSPEND)) {
		printk("Not enough time for PM operations " TIME_UNIT_STRING
							" : %d).\n", ticks);_sys_soc_suspend
		return SYS_PM_NOT_HANDLED;
	}
*/
	pm_state = pm_policy_get_state(ticks);

	switch (pm_state) {
	case SYS_POWER_STATE_CPU_LPS:
	case SYS_POWER_STATE_CPU_LPS_1:
		/* Do CPU LPS operations */
	SYS_LOG_DBG("\nlow_power_state_entry");
		//ret = low_power_state_entry();
		break;
	case SYS_POWER_STATE_DEEP_SLEEP:
		/* Do Low Power Suspend operations */
		// TODO ret = low_power_suspend_entry();
		break;
	default:
		/* No PM operations */
    SYS_LOG_DBG("\nNo PM operations done\n");
		ret = SYS_PM_NOT_HANDLED;
		break;
	}

	if (ret != SYS_PM_NOT_HANDLED) {
		/*
		 * Do any arch or soc specific post operations specific to the
		 * power state.
		 */
		if (!post_ops_done) {
			if ((pm_state == SYS_POWER_STATE_CPU_LPS_1) ||
					(pm_state == SYS_POWER_STATE_CPU_LPS)) {
				low_power_state_exit();
			}
			post_ops_done = 1;
			_sys_soc_power_state_post_ops(pm_state);
		}
	}

	return ret;
}

void _sys_soc_resume(void)
{
	/*
	 * This notification is called from the ISR of the event
	 * that caused exit from kernel idling after PM operations.
	 *
	 * Some CPU low power states require enabling of interrupts
	 * atomically when entering those states. The wake up from
	 * such a state first executes code in the ISR of the interrupt
	 * that caused the wake. This hook will be called from the ISR.
	 * For such CPU LPS states, do post operations and restores here.
	 * The kernel scheduler will get control after the ISR finishes
	 * and it may schedule another thread.
	 *
	 * Call _sys_soc_pm_idle_exit_notification_disable() if this
	 * notification is not required.
	 */
	if (!post_ops_done) {
		if (pm_state == SYS_POWER_STATE_CPU_LPS) {
			low_power_state_exit();
		}
		post_ops_done = 1;
		_sys_soc_power_state_post_ops(pm_state);
	}
}
```
