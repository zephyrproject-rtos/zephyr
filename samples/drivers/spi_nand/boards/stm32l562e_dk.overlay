/*
 * Copyright (c) 2022-2025 Macronix International Co., Ltd.
 *
 * SPDX-License-Identifier: Apache-2.0
 */

&spi3 {
	pinctrl-0 = <&spi3_sck_pg9 &spi3_mosi_pb5 &spi3_miso_pb4>;
	cs-gpios = <&gpioe 0 (GPIO_ACTIVE_LOW | GPIO_PULL_UP)>;
	status = "okay";

	mx31lf1ge4bc: spi_nand_flash@0 {
		compatible = "jedec,spi-nand";
		reg = <0>;
		spi-max-frequency = <500000>;
		id = [c2 14];
		cs-wait-delay = <0>;
		flash-size = <134217728>;
		page-size = <2048>;
		status = "okay";
	};
};
