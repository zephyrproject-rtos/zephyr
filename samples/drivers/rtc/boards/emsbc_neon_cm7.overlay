/*
 * Copyright (c) 2026 emtrion GmbH
 *
 * SPDX-License-Identifier: Apache-2.0
 */

/ {
	aliases {
		rtc = &rtc;
	};
};

&rtc {
	clocks = <&rcc STM32_CLOCK(APB1, 28)>, <&rcc STM32_SRC_LSE RTC_SEL(1)>;
	status = "okay";

	backup_regs {
		status = "okay";
	};
};
