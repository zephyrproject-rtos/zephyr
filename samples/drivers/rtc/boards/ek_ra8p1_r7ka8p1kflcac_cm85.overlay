/*
 * Copyright (c) 2025 Renesas Electronics Corporation
 * SPDX-License-Identifier: Apache-2.0
 */

/ {
	aliases {
		rtc = &rtc;
	};
};

&rtc {
	interrupts = <95 1>;
	interrupt-names = "cup";
	status = "okay";
};
