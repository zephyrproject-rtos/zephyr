/*
 * Copyright (c) 2024, Muhammad Waleed Badar <walid.badar@gmail.com>
 *
 * SPDX-License-Identifier: Apache-2.0
 */

&i2c0 {
	status = "okay";
	clock-frequency = <I2C_BITRATE_STANDARD>;
	sda-gpios = <&gpio0 21 GPIO_OPEN_DRAIN>;
	scl-gpios = <&gpio0 22 GPIO_OPEN_DRAIN>;
	pinctrl-0 = <&i2c0_default>;
	pinctrl-names = "default";

	rtc0: ds1307@68 {
        compatible = "maxim,ds1307";
        reg = <0x68>;
    };
};
