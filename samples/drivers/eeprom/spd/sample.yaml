## samples/drivers/eeprom/spd/sample.yaml
```yaml
sample:
  description: Serial Presence Detect (SPD) EEPROM sample
  name: spd sample
common:
  platform_allow: intel_rpl_s_crb intel_adl_rvp
  build_only: true
tests:
  sample.drivers.eeprom.spd:
    tags: smbus spd
```

## samples/drivers/efi_gop/sample.yaml
```yaml
# SPDX-License-Identifier: Apache-2.0

sample:
  description: LVGL on EFI GOP display (x86_64 UEFI)
  name: efi_gop

common:
  tags:
    - display
    - gui
    - lvgl
    - efi
    - gop
    - x86
  modules:
    - lvgl

tests:
  sample.drivers.efi_gop.qemu_x86_64:
    platform_allow:
      - qemu_x86_64
    filter: dt_chosen_enabled("zephyr,display")
    min_flash: 512
    min_ram: 64
    harness: none
    extra_args: "-DOVERLAY_FILE=boards/qemu_x86_64.overlay"
```

## samples/drivers/enc28j60/sample.yaml
```yaml
common:
  tags: net ethernet enc28j60
  depends_on: netif
  min_flash: 140
  harness: net
sample:
  description: Simple sample application that uses enc28j60
    Ethernet controller.
  name: enc28j60 sample
tests:
  # Create a whitelisted entry for each supported board
  sample.driver.enc28j60.black_f407ve:
    platform_whitelist: black_f407ve
```

## samples/drivers/entropy/sample.yaml
```yaml
sample:
  name: Sample for the entropy gathering driver
tests:
  sample.driver.entropy:
    tags: crypto
    filter: CONFIG_ENTROPY_HAS_DRIVER
    harness: console
    harness_config:
      type: multi_line
      ordered: true
      regex:
        - "Entropy Example! (.*)"
        - "entropy device is (.*), name is (.*)"
        - "(  0x([0-9a-f]){2}){9}"
```

## samples/drivers/espi/Kconfig
```kconfig
# Private config options for eSPI sample app

# Copyright (c) 2019 Intel Corporation
# SPDX-License-Identifier: Apache-2.0

mainmenu "Enhanced Serial Peripheral Interface application"

config ESPI_VIRTUAL_WIRE_TIMEOUT
	int "Timeout for virtual wires"
	default 5000
	help
	  Timeout for virtual wires

config ESPI_USE_BOARD_POWER
	bool "Use board power"
	depends on $(dt_nodelabel_enabled,board_power)
	select GPIO
	default y

config ESPI_CAF_FLASH_REGION
	int "eSPI CAF flash test region start address"
	default 466944
	help
	  Starting address in SPI flash memory for eSPI CAF flash test.
	  Test will perform read/write operations to this region,
	  so it should be erased and not used for other purposes.
	  Refer to sample documentation for details.
source "Kconfig.zephyr"
```

## samples/drivers/espi/boards/mec172xevb_assy6906.conf
```kconfig
# eSPI + mec172xevb_assy6906
CONFIG_ESPI=y
CONFIG_LOG=y
CONFIG_LOG_BUFFER_SIZE=4096
CONFIG_LOG_PROCESS_THREAD_SLEEP_MS=100
# Disable only for this board to check notifications
CONFIG_ESPI_AUTOMATIC_WARNING_ACKNOWLEDGE=n
# Sample code doesn't handle ACPI host communication
CONFIG_ESPI_PERIPHERAL_HOST_IO=n
# Test TAF flash portal read/erase/write on EVB
CONFIG_ESPI_TAF=y
CONFIG_SPI=y
CONFIG_SPI_XEC_QMSPI_LDMA=y
```

## samples/drivers/espi/boards/mec_assy6941_mec1753_qlj.conf
```kconfig
# eSPI + mec_assy6941/mec1753_qlj
CONFIG_ESPI=y
CONFIG_LOG=y
CONFIG_LOG_BUFFER_SIZE=4096
CONFIG_LOG_PROCESS_THREAD_SLEEP_MS=100
# Disable only for this board to check notifications
CONFIG_ESPI_AUTOMATIC_WARNING_ACKNOWLEDGE=n
# Sample code doesn't handle ACPI host communication
CONFIG_ESPI_PERIPHERAL_HOST_IO=n
# Test TAF flash portal read/erase/write on EVB
CONFIG_ESPI_TAF=y
# Zephyr has limited SPI to full-duplex
CONFIG_SPI=y
CONFIG_FLASH=y
CONFIG_FLASH_JESD216_API=y

# standalone
CONFIG_ESPI_USE_BOARD_POWER=y

# Enable debug log messages in eSPI
# CONFIG_ESPI_LOG_LEVEL_DBG=y

# disables compiler optimizations
# CONFIG_DEBUG=y
```

## samples/drivers/espi/boards/npcx4m8f_evb.conf
```kconfig
CONFIG_LOG=y
CONFIG_LOG_BUFFER_SIZE=4096
CONFIG_LOG_PROCESS_THREAD_SLEEP_MS=100

# Enable correct VW behavior
CONFIG_ESPI_VWIRE_VALID_BIT_CHECK=n

# Enable eSPI VWire send check to ensure host receives the sent VWire signals.
CONFIG_ESPI_NPCX_VWIRE_ENABLE_SEND_CHECK=y

# Enable eSPI flash channel and test
CONFIG_ESPI_FLASH_CHANNEL=y
```

## samples/drivers/espi/dts/bindings/intel-rvp,board-power.yaml
```yaml
# SPDX-License-Identifier: Apache-2.0

compatible: "intel-rvp,board-power"

description: |
  Board GPIO power rails binding for Modular Embedded Controller cards that are connected to
  Intel RVP and get power from it.
  Provides GPIOs involved in eSPI controller-target handshake also known as power sequencing.
  Intended for use in board device trees where power rail status and ready signaling are required.

properties:
  pwrg-gpios:
    type: phandle-array
    required: true
    description: |
      Board GPIO input(s) used to detect that power rails are stable.

  rsm-gpios:
    type: phandle-array
    required: true
    description: |
      Board GPIO output(s) used to notify the controller/target that power has
      stabilized and minimum initialization is complete, so the controller/target
      can proceed with further handshake or initialization.
```

## samples/drivers/espi/dts/bindings/mec15xx-board-power.yaml
```yaml
# Copyright (c) 2020, Intel Corporation
# SPDX-License-Identifier: Apache-2.0

compatible: "microchip,mec15xx-board-power"

description: |
    This binding provides MEC15xx board gpio power rails resources to
    build and run samples/drives/espi in Zephyr.
    GPIOs required before performing a eSPI host-slave handshake

properties:
   pwrg-gpios:
        type: phandle-array
        required: true
        description: |
          Board GPIO input used to detect that power rails are stable.

   rsm-gpios:
        type: phandle-array
        required: true
        description: |
          Board GPIO output used to notify eSPI master to ackwnowledge
          power has stabilized and bare minimum initialization in eSPI slave
          is complete so eSPI master can proceed with eSPI handshake.
```

## samples/drivers/espi/sample.yaml
```yaml
sample:
  description: A basic demo to showcase eSPI driver usage and handshake with
    eSPI master
  name: eSPI driver sample
tests:
  sample.drivers.espi:
    tags: drivers espi
    filter: dt_compat_enabled("microchip,mec15xx-board-power")
    depends_on: espi
    harness: console
    harness_config:
      fixture: espi_device_connect
      type: multi_line
      ordered: true
      regex:
        - "Hello eSPI test (.*)"
        - "eSPI test - I/O initialization...complete"
        - "eSPI slave configured successfully!"
        - "eSPI test - callbacks initialization... complete"
        - "eSPI test - Power initialization...complete"
        - "eSPI BUS reset (.*)"
        - "espi: Hello eSPI test mec1501modular_assy6885"
        - "espi: eSPI slave configured successfully"
        - "espi: eSPI test - callbacks initialization..."
        - "espi: complete"
        - "espi: eSPI test - callbacks registration..."
        - "espi: complete"
        - "espi: eSPI BUS reset 1"
        - "espi: VW channel is ready"
        - "espi: Flash channel is ready"
        - "espi: Test eSPI write flash"
        - "espi: 16 write flash transactions completed"
        - "espi: 16 write flash transactions completed"
        - "espi: Test eSPI read flash"
        - "espi: 16 read flash transactions completed"
        - "espi: 16 read flash transactions completed"
        - "espi: eSPI test - Handshake with eSPI master..."
        - "espi: 1st phase completed"
        - "espi: 2nd phase completed"
        - "espi: PLT_RST changed 1"
        - "espi: 3rd phase completed"
        - "espi: get_pch_temp:"
        - "espi: OOB transaction completed rcvd: 4 bytes"
        - "espi: Postcode fe"
        - "espi: Postcode 7f"
        - "espi: eSPI sample completed"
```

## samples/drivers/ethernet/eth_ivshmem/boards/qemu_cortex_a53.conf
```kconfig
# Jailhouse requires ARMv8-A non-secure mode
CONFIG_ARMV8_A_NS=y

# QEMU PCI requires at least 256M of virtual space
CONFIG_KERNEL_VM_SIZE=0x80000000

# QEMU PCI requires physical addresses with more than 32 bits
CONFIG_ARM64_VA_BITS_40=y
CONFIG_ARM64_PA_BITS_40=y

# PCIe config
CONFIG_PCIE_CONTROLLER=y
CONFIG_PCIE_ECAM=y

# Required for PCIe INTx interrupts
CONFIG_DYNAMIC_INTERRUPTS=y

# Disable unwanted default configs
CONFIG_NET_DRIVERS=n
CONFIG_NET_SLIP_TAP=n
```

## samples/drivers/fan/speed/boards/b_u585i_iot02a.conf
```kconfig
# Copyright The Zephyr Project Contributors
# SPDX-License-Identifier: Apache-2.0

CONFIG_GPIO=y
CONFIG_FAN_PWM_TACHOMETER=y
CONFIG_FAN_PWM_TACHOMETER_POLL=y
```

## samples/drivers/firmware/arm_scmi/boards/rpi_5.conf
```kconfig
# Copyright (c) 2024 EPAM Systems
# SPDX-License-Identifier: Apache-2.0

CONFIG_ARM_SCMI_BASE_AGENT_HELPERS=y
CONFIG_RESET=y
```

## samples/drivers/firmware/scmi/boards/rpi_5.conf
```kconfig
# Copyright (c) 2026 EPAM Systems
# SPDX-License-Identifier: Apache-2.0

CONFIG_LOG=y
CONFIG_LOG_MODE_MINIMAL=y
CONFIG_PRINTK=y
CONFIG_SHELL=y

CONFIG_EARLY_CONSOLE=y

CONFIG_ARM_SCMI=y

CONFIG_CLOCK_CONTROL=y

CONFIG_ARM_SCMI_BASE_EXT_REV=y
CONFIG_ARM_SCMI_BASE_AGENT_HELPERS=y
```

## samples/drivers/firmware/scmi/sample.yaml
```yaml
sample:
  name: scmi
  description: This sample demonstrates the interaction between an agent
    running Zephyr and the platform via SCMI.
tests:
  sample.drivers.firmware.scmi:
    build_only: true
    filter: CONFIG_ARM_SCMI
    integration_platforms:
      - imx95_evk/mimx9596/m7
      - imx95_evk/mimx9596/a55
```

## samples/drivers/flash_shell/Kconfig
```kconfig
# Copyright (c) 2020, Linaro Ltd.
# SPDX-License-Identifier: Apache-2.0

source "Kconfig.zephyr"

if ARM_MPU
config MPU_ALLOW_FLASH_WRITE
	def_bool y
endif
```

## samples/drivers/flash_shell/boards/ch32v00x_core.conf
```kconfig
CONFIG_USE_DT_CODE_PARTITION=y

# Shrink the defaults to fit within the 52 KiB of flash and 8 KiB of RAM.
CONFIG_FLASH_SHELL_TEST_COMMANDS=n
CONFIG_FLASH_SHELL_BUFFER_SIZE=0x400
CONFIG_MAIN_STACK_SIZE=440
CONFIG_ISR_STACK_SIZE=256
CONFIG_LOG_MODE_MINIMAL=y
CONFIG_KERNEL_SHELL=n
CONFIG_DATE_SHELL=n
```

## samples/drivers/flash_shell/boards/gd32vf103c_starter.conf
```kconfig
# This board only has 32KB SRAM, can not afford 16 KB memory pool, use 8KB instead.
CONFIG_HEAP_MEM_POOL_SIZE=8192
```

## samples/drivers/flash_shell/sample.yaml
```yaml
sample:
  description: Shell commands for inspecting flash driver behavior
  name: Flash shell
tests:
  sample.drivers.flash.shell:
    tags:
      - flash
      - shell
    filter: CONFIG_FLASH_HAS_DRIVER_ENABLED and dt_chosen_enabled('zephyr,flash-controller')
            and not CONFIG_SOC_SERIES_BSIM_NRFXX
    platform_exclude:
      - stm32h7s78_dk
      - gd32f350r_eval
    harness: shell
    extra_configs:
      - arch:posix:CONFIG_NATIVE_UART_0_ON_STDINOUT=y
    min_ram: 12
    integration_platforms:
      - qemu_x86
      - native_sim
```

## samples/drivers/fpga/fpga_controller/boards/icev_wireless.conf
```kconfig
CONFIG_LOG=y
CONFIG_FLASH=y
CONFIG_SHELL=y
CONFIG_SPI=y
CONFIG_PINCTRL=y
CONFIG_ICE40_FPGA=y
CONFIG_FPGA_SHELL=y
CONFIG_FLASH_PAGE_LAYOUT=y
CONFIG_HEAP_MEM_POOL_SIZE=16384
CONFIG_SHELL_BACKEND_SERIAL_INTERRUPT_DRIVEN=n
CONFIG_CRC=y
CONFIG_CRC_SHELL=y
```

## samples/drivers/fpga/fpga_controller/sample.yaml
```yaml
sample:
  name: FPGA Controller sample

common:
  tags: FPGA
  build_only: true

tests:
  sample.drivers.fpga_controller:
    platform_allow: quick_feather icev_wireless
  sample.drivers.fpga_controller.shell:
    platform_allow: quick_feather icev_wireless
    extra_args: CONF_FILE="prj_shell.conf"
```

## samples/drivers/gnss/boards/mimxrt1062_fmurt6.conf
```kconfig
# Copyright 2024 NXP
# SPDX-License-Identifier: Apache-2.0

CONFIG_UART_INTERRUPT_DRIVEN=y
```

## samples/drivers/gnss/boards/vmu_rt1170_mimxrt1176_cm7.conf
```kconfig
# Copyright (c) 2025 Croxel Inc.
# Copyright (c) 2025 CogniPilot Foundation
# SPDX-License-Identifier: Apache-2.0

CONFIG_SHELL=n
CONFIG_SERIAL=y
CONFIG_UART_INTERRUPT_DRIVEN=y
```
