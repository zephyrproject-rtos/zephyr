## samples/drivers/gnss/sample.yaml
```yaml
# Copyright (c) 2023 Trackunit Corporation
# SPDX-License-Identifier: Apache-2.0

sample:
  name: GNSS sample
tests:
  sample.drivers.gnss:
    tags:
      - drivers
      - gnss
    filter: dt_alias_exists("gnss")
    integration_platforms:
      - mimxrt1062_fmurt6
```

## samples/drivers/gnss_rtk/sample.yaml
```yaml
# Copyright (c) 2023 Trackunit Corporation
# SPDX-License-Identifier: Apache-2.0

sample:
  name: GNSS RTK sample
tests:
  sample.drivers.gnss.rtk:
    tags:
      - drivers
      - gnss
    filter: dt_alias_exists("gnss")
    integration_platforms:
      - mimxrt1062_fmurt6
```

## samples/drivers/gpio/button_interrupt/sample.yaml
```yaml
sample:
  name: Button interrupt sample
tests:
  sample.gpio.button_interrupt:
    tags:
      - button
      - gpio
    filter: dt_enabled_alias_with_parent_compat("sw0", "gpio-keys")
    integration_platforms:
      - nrf52833dk/nrf52820
    depends_on: gpio
    harness: button
```

## samples/drivers/gpio/custom_dts_binding/dts/bindings/power-output.yaml
```yaml
# Copyright (c) 2020 Martin Jäger / Libre Solar
# SPDX-License-Identifier: Apache-2.0

description: GPIO pin to switch a power output on or off

compatible: "power-output"

properties:
  gpios:
    type: phandle-array
    required: true
```

## samples/drivers/gpio/custom_dts_binding/sample.yaml
```yaml
sample:
  name: GPIO driver sample with custom DTS binding
tests:
  sample.drivers.gpio.custom_dts_binding:
    tags: GPIO
    platform_whitelist: nucleo_l073rz
    depends_on: gpio
    harness: console
    harness_config:
      type: multi_line
      regex:
        - "Initializing pin ([0-9]*) on port (.*) with inactive level."
        - "Waiting one second."
        - "Setting pin to active level."
```

## samples/drivers/gpio/max22190_gpio_button_diag/sample.yaml
```yaml
sample:
  name: GPIO diagnostic sample
tests:
  sample.drivers.gpio.max22190_gpio_button_diag:
    tags:
      - button
      - gpio
      - gpio_diagnostics
    filter: dt_enabled_alias_with_parent_compat("sw0", "gpio-keys")
    integration_platforms:
      - adi_sdp_k1
    depends_on: gpio
    harness: button
```

## samples/drivers/gpio/sample.yaml
```yaml
sample:
  name: GPIO toggling
tests:
  sample.driver.gpio:
    tags: drivers
    filter: dt_compat_enabled_with_alias("gpio-leds", "led0") and
            dt_compat_enabled_with_alias("gpio-keys", "sw0")
    harness: console
    harness_config:
        type: one_line
        regex:
            - "Toggling (.*)"
    depends_on: gpio
```

## samples/drivers/haptics/cs40l26/boards/nucleo_f401re.conf
```kconfig
# Copyright (c) 2026 Cirrus Logic, Inc.
# SPDX-License-Identifier: Apache-2.0

# Add debug logging for Nucleo sample only due to size considerations
CONFIG_HAPTICS_LOG_LEVEL_DBG=y
```

## samples/drivers/haptics/cs40l26/sample.yaml
```yaml
sample:
  name: CS40L26 Haptic Driver Sample
tests:
  sample.haptics.cs40l26:
    build_only: true
    tags: haptics
    platform_allow:
      - nucleo_f401re
```

## samples/drivers/haptics/cs40l5x/boards/crd40l50.conf
```kconfig
# Required to use shell interface with the SEGGER J-Link
CONFIG_SERIAL=y
CONFIG_CONSOLE=y
CONFIG_RTT_CONSOLE=y
CONFIG_UART_RTT=y
CONFIG_USE_SEGGER_RTT=y
CONFIG_SHELL_BACKEND_RTT=y
CONFIG_SEGGER_RTT_BUFFER_SIZE_DOWN=32

# Reduce size of the sample application
CONFIG_SHELL_MINIMAL=y
```

## samples/drivers/haptics/cs40l5x/boards/nucleo_f401re.conf
```kconfig
# SPDX-FileCopyrightText: Copyright The Zephyr Project Contributors
# SPDX-License-Identifier: Apache-2.0

# Add debug logging for Nucleo sample only due to size considerations
CONFIG_HAPTICS_LOG_LEVEL_DBG=y
```

## samples/drivers/haptics/cs40l5x/sample.yaml
```yaml
sample:
  name: CS40L5x Haptic Driver Sample
tests:
  sample.haptics.cs40l5x:
    build_only: true
    tags: haptics
    platform_allow:
      - nucleo_f401re
      - crd40l50
```

## samples/drivers/haptics/drv2605/sample.yaml
```yaml
sample:
  name: DRV2605 Haptic Driver sample
tests:
  sample.haptics.drv2605:
    build_only: true
    tags: haptics
    platform_allow:
      - adafruit_qt_py_rp2040/rp2040
    extra_args:
      - platform:adafruit_qt_py_rp2040/rp2040:SHIELD="adafruit_drv2605l"
```

## samples/drivers/ht16k33/sample.yaml
```yaml
sample:
  description: Demonstration of the HT16K33 LED driver with keyscan
  name: HT16K33 sample
tests:
  sample.drivers.ht16k33:
    platform_allow:
      - nrf52840dk/nrf52840
      - adafruit_qt_py_rp2040/rp2040
    extra_args:
      - platform:adafruit_qt_py_rp2040/rp2040:SHIELD="adafruit_ht16k33"
    harness: TBD
    tags: LED
```

## samples/drivers/hwspinlock/Kconfig.sysbuild
```kconfig
# Copyright 2025 NXP
# SPDX-License-Identifier: Apache-2.0

source "share/sysbuild/Kconfig"

config REMOTE_BOARD
	string "The board used for remote target"
	default "mcx_n9xx_evk/mcxn947/cpu1" if $(BOARD) = "mcx_n9xx_evk"
	default "frdm_mcxn947/mcxn947/cpu1" if $(BOARD) = "frdm_mcxn947"
```

## samples/drivers/hwspinlock/remote/boards/mimxrt700_evk_mimxrt798s_cm33_cpu1.conf
```kconfig
# Copyright 2026 NXP
# SPDX-License-Identifier: Apache-2.0

CONFIG_BUILD_OUTPUT_HEX=y
CONFIG_SECOND_CORE_MCUX=y
CONFIG_BUILD_OUTPUT_INFO_HEADER=y
CONFIG_GLIKEY_MCUX_GLIKEY=y
```

## samples/drivers/hwspinlock/sample.yaml
```yaml
# Copyright 2025-2026 NXP
# SPDX-License-Identifier: Apache-2.0

sample:
  name: hwspinlock sample

common:
  sysbuild: true
  tags:
    - drivers
    - hwspinlock
    - mbox

tests:
  sample.drivers.hwspinlock:
    filter: dt_compat_enabled("nxp,sema42")
    platform_allow:
      - mcx_n9xx_evk/mcxn947/cpu0
      - frdm_mcxn947/mcxn947/cpu0
      - mimxrt700_evk/mimxrt798s/cm33_cpu0
      - mimxrt1180_evk/mimxrt1189/cm33
    integration_platforms:
      - mcx_n9xx_evk/mcxn947/cpu0
      - frdm_mcxn947/mcxn947/cpu0
      - mimxrt700_evk/mimxrt798s/cm33_cpu0
      - mimxrt1180_evk/mimxrt1189/cm33
```

## samples/drivers/hwspinlock_shell/sample.yaml
```yaml
sample:
  name: HWSPINLOCK shell
common:
  tags:
    - drivers
    - hwspinlock
    - shell
  platform_allow:
    - imx95_evk/mimx9596/m7
    - imx943_evk/mimx94398/m33
  integration_platforms:
    - imx95_evk/mimx9596/m7
    - imx943_evk/mimx94398/m33
tests:
  sample.drivers.hwspinlock.shell:
    harness: console
    harness_config:
      type: one_line
      regex:
        - "hwspinlock shell sample ready"
```

## samples/drivers/i2c/custom_target/sample.yaml
```yaml
sample:
  name: I2C custom target sample
tests:
  sample.drivers.i2c.custom_target:
    tags: i2c_target
    platform_allow:
      - lpcxpresso55s69/lpc55s69/cpu0
    harness: TBD
```

## samples/drivers/i2c/role_switch_echo/Kconfig
```kconfig
# Copyright 2026 NXP
# SPDX-License-Identifier: Apache-2.0

source "Kconfig.zephyr"

menu "I2C role-switch echo sample"

choice ROLE_SWITCH_ECHO_ROLE
	prompt "Sample role"
	default ROLE_SWITCH_ECHO_ROLE_REQUESTER

config ROLE_SWITCH_ECHO_ROLE_REQUESTER
	bool "Requester role"

config ROLE_SWITCH_ECHO_ROLE_RESPONDER
	bool "Responder role"

endchoice

config ROLE_SWITCH_ECHO_LOCAL_ADDR
	int "Local target address"
	default 17 if ROLE_SWITCH_ECHO_ROLE_REQUESTER
	default 16 if ROLE_SWITCH_ECHO_ROLE_RESPONDER
	range 0 127
	help
	  Local 7-bit I2C target address used by this board.

config ROLE_SWITCH_ECHO_REMOTE_ADDR
	int "Remote target address"
	default 16 if ROLE_SWITCH_ECHO_ROLE_REQUESTER
	default 17 if ROLE_SWITCH_ECHO_ROLE_RESPONDER
	range 0 127
	help
	  Remote 7-bit I2C target address used by the peer board.

config ROLE_SWITCH_ECHO_COUNT
	int "Number of echo transactions"
	default 100
	range 1 100000
	help
	  Number of echo transactions to run before printing final status.

config ROLE_SWITCH_ECHO_INTERVAL_MS
	int "Requester interval in milliseconds"
	default 500
	range 1 60000
	help
	  Delay between requester transmissions.

config ROLE_SWITCH_ECHO_PAYLOAD_SIZE
	int "Payload size in bytes"
	default 8
	range 1 32
	help
	  Number of payload bytes used in each echo transaction.

endmenu
```

## samples/drivers/i2c/rtio_loopback/Kconfig
```kconfig
# Copyright The Zephyr Project Contributors
# SPDX-License-Identifier: Apache-2.0

mainmenu "I2C RTIO Loopback Test"

config I2C_RTIO_LOOPBACK_DATA_READ_MAX_SIZE
	int "Max data size used for testing I2C read transfers"
	default 2

config I2C_RTIO_LOOPBACK_DATA_WRITE_MAX_SIZE
	int "Max data size used for testing I2C write transfers"
	default 6

source "Kconfig.zephyr"
```

## samples/drivers/i2c/rtio_loopback/boards/bl54l15u_dvk_nrf54l15_cpuapp.conf
```kconfig
# Copyright (c) 2024 Nordic Semiconductor ASA
# Copyright (c) 2025 Ezurio LLC
# SPDX-License-Identifier: Apache-2.0

CONFIG_I2C_NRFX_TWIS_BUF_SIZE=256
```

## samples/drivers/i2c/rtio_loopback/boards/nrf5340dk_nrf5340_cpuapp.conf
```kconfig
# Copyright (c) 2024 Nordic Semiconductor ASA
# SPDX-License-Identifier: Apache-2.0

CONFIG_I2C_TARGET_BUFFER_MODE=y
```
