/*
 * Copyright 2024 NXP
 *
 * SPDX-License-Identifier: Apache-2.0
 */

/ {
	aliases {
		gnss = &lpuart3;
	};
};

&lpuart3 {
	status = "okay";
	current-speed = <115200>;

	u_blox_m8: u-blox,m8 {
		status = "okay";
		compatible = "u-blox,m8";
		uart-baudrate = <115200>;
	};
};
