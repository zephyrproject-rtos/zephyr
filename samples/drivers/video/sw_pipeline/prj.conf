## CMakeLists.txt
```
# SPDX-License-Identifier: Apache-2.0

cmake_minimum_required(VERSION 3.20.0)
find_package(Zephyr REQUIRED HINTS $ENV{ZEPHYR_BASE})
project(video_sw_pipeline)

include(${ZEPHYR_BASE}/samples/subsys/usb/common/common.cmake)
target_sources(app PRIVATE src/main.c src/pipeline.c)
```

## Kconfig
```
# Copyright The Zephyr Project Contributors
# SPDX-License-Identifier: Apache-2.0

# Source common USB sample options used to initialize new experimental USB
# device stack. The scope of these options is limited to USB samples in project
# tree, you cannot use them in your own application.
source "samples/subsys/usb/common/Kconfig.sample_usbd"

source "Kconfig.zephyr"
```

## sample.yaml
```
sample:
  name: Video software pipeline sample
tests:
  sample.drivers.video.sw_pipeline:
    depends_on: usbd
    tags: usb video pixel
    integration_platforms:
      - rpi_pico
    extra_args:
      - SNIPPET=video-sw-generator
  sample.drivers.video.sw_pipeline.camera:
    depends_on: usbd
    tags: usb video pixel
    filter: dt_chosen_enabled("zephyr,camera")
```

## prj.conf
```kconfig
CONFIG_LOG=y
CONFIG_PIXEL=y
CONFIG_POLL=y
CONFIG_SAMPLE_USBD_PID=0x0011
CONFIG_SAMPLE_USBD_PRODUCT="Video Software Pipeline Example"
CONFIG_UDC_DRIVER_LOG_LEVEL_WRN=y
CONFIG_USBD_LOG_LEVEL_WRN=y
CONFIG_USBD_VIDEO_CLASS=y
CONFIG_USBD_VIDEO_LOG_LEVEL_WRN=y
CONFIG_USB_DEVICE_STACK_NEXT=y
CONFIG_VIDEO=y
CONFIG_VIDEO_BUFFER_POOL_NUM_MAX=4
CONFIG_VIDEO_BUFFER_POOL_SZ_MAX=24576
CONFIG_VIDEO_LOG_LEVEL_WRN=y
CONFIG_VIDEO_SW_GENERATOR=y
CONFIG_VIDEO_SW_PIPELINE=y
```

## app.overlay
```dts
/*
 * Copyright The Zephyr Project Contributors
 *
 * SPDX-License-Identifier: Apache-2.0
 */

/ {
	uvc: uvc {
		compatible = "zephyr,uvc-device";
	};

	video_sw_pipeline: video_sw_pipeline {
		compatible = "zephyr,video-sw-pipeline";
	};
};
```

## src/main.c
```c
/*
 * Copyright (c) 2025 tinyVision.ai Inc.
 *
 * SPDX-License-Identifier: Apache-2.0
 */

#include <stdint.h>
#include <stdlib.h>

#include <sample_usbd.h>

#include <zephyr/device.h>
#include <zephyr/drivers/video.h>
#include <zephyr/drivers/video/sw_pipeline.h>
#include <zephyr/logging/log.h>
#include <zephyr/usb/class/usbd_uvc.h>
#include <zephyr/usb/usbd.h>

LOG_MODULE_REGISTER(sw_pipeline_example, LOG_LEVEL_INF);

int main(void)
{
	const struct device *camera_dev;
	const struct device *pipe_dev;
	const struct device *uvc_dev;
	struct usbd_context *sample_usbd;
	struct video_buffer *vbuf;
	struct video_format fmt = {0};
	struct k_poll_signal sig = {0};
	struct k_poll_event evt[1] = {0};
	k_timeout_t timeout = K_FOREVER;
	int ret;

	camera_dev = DEVICE_DT_GET(DT_CHOSEN(zephyr_camera));
	if (camera_dev == NULL || !device_is_ready(camera_dev)) {
		LOG_ERR("%s is not ready or failed to initialize", camera_dev->name);
		return -ENODEV;
	}

	pipe_dev = DEVICE_DT_GET(DT_NODELABEL(video_sw_pipeline));
	if (pipe_dev == NULL || !device_is_ready(pipe_dev)) {
		LOG_ERR("%s is not ready or failed to initialize", pipe_dev->name);
		return -ENODEV;
	}

	uvc_dev = DEVICE_DT_GET(DT_NODELABEL(uvc));
	if (uvc_dev == NULL || !device_is_ready(uvc_dev)) {
		LOG_ERR("%s is not ready or failed to initialize", uvc_dev->name);
		return -ENODEV;
	}

	video_sw_pipeline_set_source(pipe_dev, camera_dev);
	uvc_set_video_dev(uvc_dev, pipe_dev);

	sample_usbd = sample_usbd_init_device(NULL);
	if (sample_usbd == NULL) {
		return -ENODEV;
	}

	ret = usbd_enable(sample_usbd);
	if (ret != 0) {
		return ret;
	}

	LOG_INF("Waiting the host to select the video format");

	/* Get the video format once it is selected by the host */
	while (true) {
		ret = video_get_format(uvc_dev, VIDEO_EP_IN, &fmt);
		if (ret == 0) {
			break;
		}
		if (ret != -EAGAIN) {
			LOG_ERR("Failed to get the video format");
			return ret;
		}

		k_sleep(K_MSEC(10));
	}

	LOG_INF("The host selected format %ux%u '%s'",
		fmt.width, fmt.height, VIDEO_FOURCC_TO_STR(fmt.pixelformat));

	LOG_INF("Preparing %u buffers of %u bytes",
		CONFIG_VIDEO_BUFFER_POOL_NUM_MAX, fmt.pitch * fmt.height);

	/* Half of the buffers between the camera device and the pipeline device */
	for (int i = 0; i < CONFIG_VIDEO_BUFFER_POOL_NUM_MAX / 2; i++) {
		vbuf = video_buffer_alloc(fmt.pitch * fmt.height, K_NO_WAIT);
		if (vbuf == NULL) {
			LOG_ERR("Failed to allocate the video buffer");
			return -ENOMEM;
		}

		ret = video_enqueue(camera_dev, VIDEO_EP_OUT, vbuf);
		if (ret != 0) {
			LOG_ERR("Failed to enqueue video buffer");
			return ret;
		}
	}

	/* Half of the buffers between the pipeline device and the sink device */
	for (int i = 0; i < CONFIG_VIDEO_BUFFER_POOL_NUM_MAX / 2; i++) {
		vbuf = video_buffer_alloc(fmt.pitch * fmt.height, K_NO_WAIT);
		if (vbuf == NULL) {
			LOG_ERR("Failed to allocate the video buffer");
			return -ENOMEM;
		}

		ret = video_enqueue(pipe_dev, VIDEO_EP_OUT, vbuf);
		if (ret != 0) {
			LOG_ERR("Failed to enqueue video buffer");
			return ret;
		}
	}

	LOG_DBG("Preparing signaling for %s input/output", camera_dev->name);

	k_poll_signal_init(&sig);
	k_poll_event_init(&evt[0], K_POLL_TYPE_SIGNAL, K_POLL_MODE_NOTIFY_ONLY, &sig);

	ret = video_set_signal(camera_dev, VIDEO_EP_OUT, &sig);
	if (ret != 0) {
		LOG_WRN("Failed to setup the signal on %s output endpoint", camera_dev->name);
		timeout = K_MSEC(1);
	}

	ret = video_set_signal(pipe_dev, VIDEO_EP_OUT, &sig);
	if (ret != 0) {
		LOG_WRN("Failed to setup the signal on %s output endpoint", pipe_dev->name);
		timeout = K_MSEC(1);
	}

	ret = video_set_signal(uvc_dev, VIDEO_EP_IN, &sig);
	if (ret != 0) {
		LOG_WRN("Failed to setup the signal on %s input endpoint", uvc_dev->name);
		timeout = K_MSEC(1);
	}

	LOG_INF("Starting the video transfer");

	ret = video_stream_start(camera_dev);
	if (ret != 0) {
		LOG_ERR("Failed to start %s", camera_dev->name);
		return ret;
	}

	ret = video_stream_start(pipe_dev);
	if (ret != 0) {
		LOG_ERR("Failed to start %s", pipe_dev->name);
		return ret;
	}

	while (true) {
		ret = k_poll(evt, ARRAY_SIZE(evt), timeout);
		if (ret != 0 && ret != -EAGAIN) {
			LOG_ERR("Poll exited with status %d", ret);
			return ret;
		}

		if (video_dequeue(camera_dev, VIDEO_EP_OUT, &vbuf, K_NO_WAIT) == 0) {
			LOG_DBG("Dequeued %p from %s, enqueueing to %s",
				(void *)vbuf, camera_dev->name, uvc_dev->name);

			ret = video_enqueue(pipe_dev, VIDEO_EP_IN, vbuf);
			if (ret != 0) {
				LOG_ERR("Failed to enqueue video buffer to %s", pipe_dev->name);
				return ret;
			}
		}

		if (video_dequeue(pipe_dev, VIDEO_EP_IN, &vbuf, K_NO_WAIT) == 0) {
			LOG_DBG("Dequeued %p from %s, enqueueing to %s",
				(void *)vbuf, pipe_dev->name, uvc_dev->name);

			ret = video_enqueue(camera_dev, VIDEO_EP_OUT, vbuf);
			if (ret != 0) {
				LOG_ERR("Failed to enqueue video buffer to %s", uvc_dev->name);
				return ret;
			}
		}

		if (video_dequeue(pipe_dev, VIDEO_EP_OUT, &vbuf, K_NO_WAIT) == 0) {
			LOG_DBG("Dequeued %p from %s, enqueueing to %s",
				(void *)vbuf, pipe_dev->name, uvc_dev->name);

			ret = video_enqueue(uvc_dev, VIDEO_EP_IN, vbuf);
			if (ret != 0) {
				LOG_ERR("Failed to enqueue video buffer to %s", uvc_dev->name);
				return ret;
			}
		}

		if (video_dequeue(uvc_dev, VIDEO_EP_IN, &vbuf, K_NO_WAIT) == 0) {
			LOG_DBG("Dequeued %p from %s, enqueueing to %s",
				(void *)vbuf, uvc_dev->name, pipe_dev->name);

			ret = video_enqueue(pipe_dev, VIDEO_EP_OUT, vbuf);
			if (ret != 0) {
				LOG_ERR("Failed to enqueue video buffer to %s", pipe_dev->name);
				return ret;
			}
		}

		k_poll_signal_reset(&sig);
	}

	CODE_UNREACHABLE;
	return 0;
}
```

## src/pipeline.c
```c
/*
 * Copyright (c) 2025 tinyVision.ai Inc.
 *
 * SPDX-License-Identifier: Apache-2.0
 */

#include <stdint.h>
#include <stdlib.h>

#include <zephyr/device.h>
#include <zephyr/drivers/video.h>
#include <zephyr/drivers/video/sw_pipeline.h>
#include <zephyr/logging/log.h>
#include <zephyr/pixel/formats.h>
#include <zephyr/pixel/resize.h>
#include <zephyr/sys/util.h>

LOG_MODULE_REGISTER(sw_pipeline_definition, LOG_LEVEL_INF);

#define WIDTH_IN 64
#define HEIGHT_IN 64

#define WIDTH_OUT 128
#define HEIGHT_OUT 32

/* Color tuning converting one line of data */
void app_tune_rgb24line(const uint8_t *rgb24in, uint8_t *rgb24out, uint16_t width)
{
	for (size_t w = 0; w < width; w++) {
		rgb24out[w * 3 + 0] = CLAMP((-64 + rgb24in[w * 3 + 0]) * 2, 0x00, 0xff);
		rgb24out[w * 3 + 1] = CLAMP((-64 + rgb24in[w * 3 + 1]) * 1, 0x00, 0xff);
		rgb24out[w * 3 + 2] = CLAMP((-64 + rgb24in[w * 3 + 2]) * 2, 0x00, 0xff);
	}
}

/* Declare the pipeline elements and their intermediate buffers */
PIXEL_RGB565LESTREAM_TO_RGB24STREAM(step_rgb565_to_rgb24, WIDTH_IN, HEIGHT_IN);
PIXEL_SUBSAMPLE_RGB24STREAM(step_resize_rgb24, WIDTH_IN, HEIGHT_IN);
PIXEL_RGB24LINE_DEFINE(step_tune_rgb24, app_tune_rgb24line, WIDTH_OUT, HEIGHT_OUT);
PIXEL_RGB24STREAM_TO_YUYVSTREAM_BT709(step_rgb24_to_yuyv, WIDTH_OUT, HEIGHT_OUT);

int app_init_pipeline(void)
{
	const struct device *dev = DEVICE_DT_GET(DT_NODELABEL(video_sw_pipeline));
	struct pixel_stream *strm;

	/* Build the pipeline */
	strm = pixel_stream(&step_rgb565_to_rgb24, &step_resize_rgb24, &step_tune_rgb24,
			    &step_rgb24_to_yuyv, NULL);

	/* Load it into the driver */
	video_sw_pipeline_set_pipeline(dev, strm, VIDEO_PIX_FMT_RGB565, WIDTH_IN, HEIGHT_IN,
				       VIDEO_PIX_FMT_YUYV, WIDTH_OUT, HEIGHT_OUT);

	return 0;
}

/* Initialize before UVC so it can generate the USB descriptors from the formats above */
SYS_INIT(app_init_pipeline, POST_KERNEL, CONFIG_KERNEL_INIT_PRIORITY_DEVICE);
```
