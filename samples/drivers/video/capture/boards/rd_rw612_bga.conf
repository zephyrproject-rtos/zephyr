## samples/drivers/video/capture/boards/rd_rw612_bga.conf
```kconfig
CONFIG_UHC_DRIVER=y
CONFIG_USB_HOST_STACK=y
CONFIG_USBH_VIDEO_CLASS=y

# Video buffer configuration
CONFIG_VIDEO_BUFFER_POOL_SZ_MAX=154000
CONFIG_VIDEO_BUFFER_POOL_NUM_MAX=1
CONFIG_VIDEO_BUFFER_POOL_ALIGN=32


# Memory configuration for USB transfers
CONFIG_HEAP_MEM_POOL_SIZE=70000
CONFIG_MAIN_STACK_SIZE=80960
CONFIG_USBH_USB_DEVICE_HEAP=8912
CONFIG_UHC_BUF_POOL_SIZE=4096
```

## samples/drivers/video/capture/boards/stm32h747i_disco_stm32h747xx_m7.conf
```kconfig
# OV5640 resolutions, RGBP:
# 160x120
# 320x240
# 480x272

CONFIG_VIDEO_FRAME_WIDTH=160
CONFIG_VIDEO_FRAME_HEIGHT=120
CONFIG_VIDEO_PIXEL_FORMAT="RGBP"
CONFIG_VIDEO_BUFFER_POOL_SZ_MAX=50000
CONFIG_VIDEO_BUFFER_POOL_NUM_MAX=3
CONFIG_MAIN_STACK_SIZE=2048

CONFIG_VIDEO_LOG_LEVEL_DBG=y
```

## samples/drivers/video/capture/boards/stm32mp135f_dk.conf
```kconfig
CONFIG_VIDEO_PIXEL_FORMAT="RGBP"
CONFIG_VIDEO_FRAME_WIDTH=480
CONFIG_VIDEO_FRAME_HEIGHT=272
CONFIG_VIDEO_BUFFER_POOL_HEAP_SIZE=524000
CONFIG_VIDEO_SOURCE_CROP_LEFT=80
CONFIG_VIDEO_SOURCE_CROP_TOP=104
CONFIG_VIDEO_SOURCE_CROP_WIDTH=480
CONFIG_VIDEO_SOURCE_CROP_HEIGHT=272
```

## samples/drivers/video/capture/boards/stm32n6570_dk.conf
```kconfig
CONFIG_VIDEO_FRAME_WIDTH=800
CONFIG_VIDEO_FRAME_HEIGHT=480
CONFIG_VIDEO_PIXEL_FORMAT="RGBP"
CONFIG_VIDEO_BUFFER_POOL_BUF_SZ=800000
CONFIG_VIDEO_BUFFER_POOL_NUM_BUFS=2
CONFIG_MAIN_STACK_SIZE=2048
```

## samples/drivers/video/capture/boards/stm32n6570_dk_stm32n657xx_fsbl.conf
```kconfig
CONFIG_VIDEO_FRAME_WIDTH=800
CONFIG_VIDEO_FRAME_HEIGHT=480
CONFIG_VIDEO_PIXEL_FORMAT="RGBP"
CONFIG_VIDEO_BUFFER_POOL_SZ_MAX=800000
CONFIG_VIDEO_BUFFER_POOL_HEAP_SIZE=1600000
CONFIG_VIDEO_BUFFER_POOL_NUM_MAX=2
CONFIG_MAIN_STACK_SIZE=2048
```

## samples/drivers/video/capture/boards/xiao_esp32s3_procpu.conf
```kconfig
CONFIG_DMA=y
CONFIG_VIDEO_ESP32S3=y
CONFIG_VIDEO_BUFFER_POOL_SZ_MAX=40000
CONFIG_VIDEO_BUFFER_POOL_NUM_MAX=3
CONFIG_CLOCK_CONTROL_ESP32_CAM=y
```

## samples/drivers/video/capture/sample.yaml
```yaml
sample:
  name: Video capture
tests:
  sample.video.capture:
    tags:
      - video
      - shield
      - samples
    extra_args:
      - platform:mimxrt1064_evk/mimxrt1064:SHIELD="dvp_fpc24_mt9m114;rk043fn66hs_ctg"
      - platform:mimxrt1170_evk/mimxrt1176/cm7:SHIELD="nxp_btb44_ov5640;rk055hdmipi4ma0"
      - platform:mimxrt1170_evk@B/mimxrt1176/cm7:SHIELD="nxp_btb44_ov5640;rk055hdmipi4ma0"
      - platform:frdm_mcxn947/mcxn947/cpu0:SHIELD="dvp_20pin_ov7670;lcd_par_s035_8080"
      - platform:frdm_mcxn236/mcxn236:SHIELD="dvp_20pin_ov7670;lcd_par_s035_8080"
      - platform:stm32h7b3i_dk:SHIELD="st_b_cams_omv_mb1683"
    extra_configs:
      - CONFIG_TEST=y
      - CONFIG_FPU=y
    harness: console
    harness_config:
      fixture: fixture_camera
      type: multi_line
      ordered: true
      regex:
        - "Got frame \\d+"
        - "size: \\d+;"
        - "timestamp \\d+"
        - "Pattern OK"
    platform_allow:
      - arduino_nicla_vision/stm32h747xx/m7
      - mimxrt1064_evk/mimxrt1064
      - mimxrt1170_evk/mimxrt1176/cm7
      - mimxrt1170_evk@B/mimxrt1176/cm7
      - frdm_mcxn947/mcxn947/cpu0
      - frdm_mcxn236/mcxn236
      - mm_swiftio
      - esp32s3_eye/esp32s3/procpu
      - stm32h7b3i_dk
    depends_on: video
    integration_platforms:
      - mimxrt1064_evk/mimxrt1064
      - mimxrt1170_evk/mimxrt1176/cm7
  sample.video.capture.shell:
    tags:
      - video
      - samples
      - shell
    extra_configs:
      - CONFIG_VIDEO_SHELL=y
      - CONFIG_FPU=y
      - CONFIG_DISPLAY=n
    extra_args:
      - platform:native_sim/native/64:SNIPPET="video-sw-generator"
    harness: console
    harness_config:
      type: one_line
      regex:
        - "Letting the user control the device with the video shell"
    platform_allow:
      - native_sim/native/64
    integration_platforms:
      - native_sim/native/64
```

## samples/drivers/video/capture_to_lvgl/Kconfig
```kconfig
# VIDEO resolution settings

# Copyright (c) 2024 Charles Dias <charlesdias.cd@outlook.com>
# SPDX-License-Identifier: Apache-2.0

mainmenu "Video capture to LVGL sample application"

menu "Video capture configuration"

config VIDEO_SOURCE_CROP_LEFT
	int "Crop area left value"
	default 0
	help
	   Left value of the crop area within the video source.

config VIDEO_SOURCE_CROP_TOP
	int "Crop area top value"
	default 0
	help
	   Top value of the crop area within the video source.

config VIDEO_SOURCE_CROP_WIDTH
	int "Crop area width value"
	default 0
	help
	   Width value of the crop area within the video source.
	   If set to 0, the crop is not applied.

config VIDEO_SOURCE_CROP_HEIGHT
	int "Crop area height value"
	default 0
	help
	   Height value of the crop area within the video source.
	   If set to 0, the crop is not applied.

config VIDEO_WIDTH
	int "Define the width of the video"
	default 320

config VIDEO_HEIGHT
	int "Define the height of the video"
	default 240

config VIDEO_HFLIP
	bool "Horizontal flip"
	default n

config VIDEO_VFLIP
	bool "Vertical flip"
	default n

endmenu

source "Kconfig.zephyr"
```

## samples/drivers/video/capture_to_lvgl/boards/ek_ra8d1.conf
```kconfig
CONFIG_VIDEO_BUFFER_POOL_SZ_MAX=160000
CONFIG_VIDEO_BUFFER_POOL_HEAP_SIZE=320000
```

## samples/drivers/video/capture_to_lvgl/boards/mini_stm32h743.conf
```kconfig
#
# Copyright (c) 2024 Charles Dias <charlesdias.cd@outlook.com>
#
# SPDX-License-Identifier: Apache-2.0
#

CONFIG_LOG_BUFFER_SIZE=2048

CONFIG_VIDEO_BUFFER_POOL_SZ_MAX=102400
CONFIG_VIDEO_WIDTH=160
CONFIG_VIDEO_HEIGHT=120
```

## samples/drivers/video/capture_to_lvgl/boards/stm32n6570_dk.conf
```kconfig
CONFIG_VIDEO_WIDTH=800
CONFIG_VIDEO_HEIGHT=480
CONFIG_VIDEO_BUFFER_POOL_HEAP_SIZE=1600000
CONFIG_VIDEO_BUFFER_POOL_NUM_MAX=2
CONFIG_MAIN_STACK_SIZE=4096
```

## samples/drivers/video/capture_to_lvgl/boards/stm32n6570_dk_stm32n657xx_sb.conf
```kconfig
CONFIG_VIDEO_WIDTH=800
CONFIG_VIDEO_HEIGHT=480
CONFIG_VIDEO_BUFFER_POOL_BUF_SZ=800000
CONFIG_VIDEO_BUFFER_POOL_NUM_BUFS=2
CONFIG_MAIN_STACK_SIZE=4096
```

## samples/drivers/video/capture_to_lvgl/sample.yaml
```yaml
sample:
  name: Video capture to LVGL
tests:
  sample.video.capture_to_lvgl:
    tags:
      - video
      - samples
    platform_allow:
      - mini_stm32h743
    depends_on: video
    integration_platforms:
      - mini_stm32h743
```

## samples/drivers/video/pipeline/Kconfig
```kconfig
# Copyright (c) 2024 Espressif Systems (Shanghai) Co., Ltd.
# Copyright 2025 NXP
#
# SPDX-License-Identifier: Apache-2.0

mainmenu "Video pipeline sample application"

menu "Video pipeline configuration"

config VIDEO_SOURCE_CROP_LEFT
	int "Crop area left value"
	default 0
	help
	   Left value of the crop area within the video source.

config VIDEO_SOURCE_CROP_TOP
	int "Crop area top value"
	default 0
	help
	   Top value of the crop area within the video source.

config VIDEO_SOURCE_CROP_WIDTH
	int "Crop area width value"
	default 0
	help
	   Width value of the crop area within the video source.
	   If set to 0, the crop is not applied.

config VIDEO_SOURCE_CROP_HEIGHT
	int "Crop area height value"
	default 0
	help
	   Height value of the crop area within the video source.
	   If set to 0, the crop is not applied.

config VIDEO_FRAME_HEIGHT
	int "Height of the video frame"
	default 0
	help
	  Height of the video frame. If set to 0, the default height is used.

config VIDEO_FRAME_WIDTH
	int "Width of the video frame"
	default 0
	help
	  Width of the video frame. If set to 0, the default width is used.

config VIDEO_PIXEL_FORMAT
	string "Pixel format of the video frame"
	help
	  Pixel format of the video frame. If not set, the default pixel format is used.

config VIDEO_CTRL_HFLIP
	int "Mirror the video frame horizontally"
	range 0 1
	default 0
	help
	  If set, mirror the video frame horizontally

config VIDEO_CTRL_VFLIP
	int "Mirror the video frame vertically"
	range 0 1
	default 0
	help
	  If set, mirror the video frame vertically

config VIDEO_ROTATION_ANGLE
	int "Rotate the video frame by a specified angle"
	range 0 270
	default 0
	help
	   Specify one of these values {0, 90, 180, 270} in degree to rotate the video frame

config PROP_NUM_BUFS
	int "Number of buffers the source provides before stopping"
	default 0
	help
	   If not set or set to 0, the source will run forever

endmenu

source "Kconfig.zephyr"
```

## samples/drivers/video/pipeline/boards/ek_ra8d1.conf
```kconfig
CONFIG_VIDEO_FRAME_WIDTH=320
CONFIG_VIDEO_FRAME_HEIGHT=240
CONFIG_MP_CAPSFILTER=y
CONFIG_VIDEO_BUFFER_POOL_SZ_MAX=155000
```

## samples/drivers/video/pipeline/boards/mimxrt1170_evk_mimxrt1176_cm7.conf
```kconfig
CONFIG_VIDEO_BUFFER_POOL_NUM_MAX=3
CONFIG_VIDEO_BUFFER_POOL_HEAP_SIZE=11060400
CONFIG_VIDEO_ROTATION_ANGLE=270
CONFIG_VIDEO_FRAME_WIDTH=1280
CONFIG_VIDEO_FRAME_HEIGHT=720
CONFIG_MP_CAPSFILTER=y
```

## samples/drivers/video/pipeline/boards/native_sim_64.conf
```kconfig
CONFIG_VIDEO_FRAME_WIDTH=320
CONFIG_VIDEO_FRAME_HEIGHT=240
CONFIG_MP_CAPSFILTER=y
CONFIG_PROP_NUM_BUFS=100
```

## samples/drivers/video/shell/sample.yaml
```yaml
sample:
  name: Video shell
tests:
  sample.video.shell:
    tags: video
    extra_args:
      - platform:mimxrt1170_evk/mimxrt1176/cm7:SHIELD="nxp_btb44_ov5640"
    harness: console
    harness_config:
      type: multi_line
      regex:
        - "You can now start using the video shell"
    platform_allow:
      - mimxrt1170_evk/mimxrt1176/cm7
      - native_sim
    integration_platforms:
      - mimxrt1170_evk/mimxrt1176/cm7
      - native_sim
```

## samples/drivers/video/sw_pipeline/sample.yaml
```yaml
sample:
  name: Video software pipeline sample
tests:
  sample.drivers.video.sw_pipeline:
    depends_on: usbd
    tags: usb video pixel
    integration_platforms:
      - rpi_pico
    extra_args:
      - SNIPPET=video-sw-generator
  sample.drivers.video.sw_pipeline.camera:
    depends_on: usbd
    tags: usb video pixel
    filter: dt_chosen_enabled("zephyr,camera")
```

## samples/drivers/video/tcpserversink/Kconfig
```kconfig
# Copyright (c) 2024 Espressif Systems (Shanghai) Co., Ltd.
# Copyright (c) 2025 STMicroelectronics.
# SPDX-License-Identifier: Apache-2.0

mainmenu "TCP camera streaming sample application"

menu "Video capture configuration"

config VIDEO_SOURCE_CROP_LEFT
	int "Crop area left value"
	default 0
	help
	   Left value of the crop area within the video source.

config VIDEO_SOURCE_CROP_TOP
	int "Crop area top value"
	default 0
	help
	   Top value of the crop area within the video source.

config VIDEO_SOURCE_CROP_WIDTH
	int "Crop area width value"
	default 0
	help
	   Width value of the crop area within the video source.
	   If set to 0, the crop is not applied.

config VIDEO_SOURCE_CROP_HEIGHT
	int "Crop area height value"
	default 0
	help
	   Height value of the crop area within the video source.
	   If set to 0, the crop is not applied.

config VIDEO_FRAME_HEIGHT
	int "Height of the video frame"
	default 0
	help
	  Height of the video frame. If set to 0, the default height is used.

config VIDEO_FRAME_WIDTH
	int "Width of the video frame"
	default 0
	help
	  Width of the video frame. If set to 0, the default width is used.

config VIDEO_PIXEL_FORMAT
	string "Pixel format of the video frame"
	help
	  Pixel format of the video frame. If not set, the default pixel format is used.

config VIDEO_CAPTURE_N_BUFFERING
	int "Capture N-buffering"
	default 2
	help
	  Framerate versus memory usage tradeoff.
	  "2" allows to capture while sending data (optimal framerate).
	  "1" allows to reduce memory usage but capture framerate is lower.
	  If not set defaults to "2".

config VIDEO_CTRL_HFLIP
	bool "Mirror the video frame horizontally"
	help
	  If set, mirror the video frame horizontally

config VIDEO_CTRL_VFLIP
	bool "Mirror the video frame vertically"
	help
	  If set, mirror the video frame vertically

config VIDEO_ENCODED_PIXEL_FORMAT
	string "Pixel format of the encoded frame"
	default VIDEO_PIX_FMT_H264
	help
	  Compression format used by the video encoder if enabled.
	  If not set defaults to H264 video bitstream with startcodes.

endmenu

source "Kconfig.zephyr"
```

## samples/drivers/video/tcpserversink/boards/stm32n6570_dk.conf
```kconfig
# Video buffer pool
CONFIG_VIDEO_BUFFER_POOL_SZ_MAX=10000000
CONFIG_VIDEO_BUFFER_POOL_NUM_MAX=10

# Camera interface
CONFIG_VIDEO_STM32_DCMIPP_SENSOR_PIXEL_FORMAT="pRAA"
CONFIG_VIDEO_STM32_DCMIPP_SENSOR_WIDTH=2592
CONFIG_VIDEO_STM32_DCMIPP_SENSOR_HEIGHT=1944
CONFIG_FPU=y

# Capture
CONFIG_VIDEO_FRAME_WIDTH=1920
CONFIG_VIDEO_FRAME_HEIGHT=1080
CONFIG_VIDEO_PIXEL_FORMAT="NV12"
CONFIG_VIDEO_CAPTURE_N_BUFFERING=2

# Video encoder
CONFIG_VIDEO_STM32_VENC=y
CONFIG_MAIN_STACK_SIZE=4096

# Network buffers
CONFIG_NET_BUF_RX_COUNT=4
CONFIG_NET_BUF_TX_COUNT=8
```

## samples/drivers/video/tcpserversink/boards/stm32n6570_dk_jpegenc.conf
```kconfig
# Video buffer pool
CONFIG_VIDEO_BUFFER_POOL_HEAP_SIZE=616000
CONFIG_VIDEO_BUFFER_POOL_NUM_MAX=4

CONFIG_FPU=y

# Capture
CONFIG_VIDEO_CAPTURE_N_BUFFERING=2

# Video encoder
CONFIG_VIDEO_ENCODER_JPEG=y
CONFIG_MAIN_STACK_SIZE=4096
CONFIG_VIDEO_ENCODED_PIXEL_FORMAT="JPEG"

# Default frame size
CONFIG_VIDEO_PIXEL_FORMAT="NV12"
CONFIG_VIDEO_FRAME_WIDTH=320
CONFIG_VIDEO_FRAME_HEIGHT=240

# Network buffers
CONFIG_NET_BUF_RX_COUNT=4
CONFIG_NET_BUF_TX_COUNT=8
```

## samples/drivers/video/tcpserversink/boards/stm32n6570_dk_stm32n657xx_sb.conf
```kconfig
# Video buffer pool
CONFIG_VIDEO_BUFFER_POOL_SZ_MAX=10000000
CONFIG_VIDEO_BUFFER_POOL_NUM_MAX=10

CONFIG_FPU=y

# Capture
CONFIG_VIDEO_CAPTURE_N_BUFFERING=2

# Video encoder
CONFIG_MAIN_STACK_SIZE=4096

# Network buffers
CONFIG_NET_BUF_RX_COUNT=4
CONFIG_NET_BUF_TX_COUNT=8
```
