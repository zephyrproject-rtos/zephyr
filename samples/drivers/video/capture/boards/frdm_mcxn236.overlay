/*
 * Copyright 2025 NXP
 *
 * SPDX-License-Identifier: Apache-2.0
 */

/ {
	chosen {
		/* Switch to flexcomm2_lpuart2(P4_2,P4_3), since default console
		 * pins are duplicated with camera header pins
		 */
		zephyr,console = &flexcomm2_lpuart2;
		zephyr,shell-uart = &flexcomm2_lpuart2;
	};
};
