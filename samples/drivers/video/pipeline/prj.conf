## CMakeLists.txt
```
# SPDX-License-Identifier: Apache-2.0

cmake_minimum_required(VERSION 3.20.0)
find_package(Zephyr REQUIRED HINTS $ENV{ZEPHYR_BASE})
project(video_pipeline)

FILE(GLOB app_sources src/*.c)
target_sources(app PRIVATE ${app_sources})
```

## Kconfig
```
# Copyright (c) 2024 Espressif Systems (Shanghai) Co., Ltd.
# Copyright 2025 NXP
#
# SPDX-License-Identifier: Apache-2.0

mainmenu "Video pipeline sample application"

menu "Video pipeline configuration"

config VIDEO_SOURCE_CROP_LEFT
	int "Crop area left value"
	default 0
	help
	   Left value of the crop area within the video source.

config VIDEO_SOURCE_CROP_TOP
	int "Crop area top value"
	default 0
	help
	   Top value of the crop area within the video source.

config VIDEO_SOURCE_CROP_WIDTH
	int "Crop area width value"
	default 0
	help
	   Width value of the crop area within the video source.
	   If set to 0, the crop is not applied.

config VIDEO_SOURCE_CROP_HEIGHT
	int "Crop area height value"
	default 0
	help
	   Height value of the crop area within the video source.
	   If set to 0, the crop is not applied.

config VIDEO_FRAME_HEIGHT
	int "Height of the video frame"
	default 0
	help
	  Height of the video frame. If set to 0, the default height is used.

config VIDEO_FRAME_WIDTH
	int "Width of the video frame"
	default 0
	help
	  Width of the video frame. If set to 0, the default width is used.

config VIDEO_FRAME_RATE
	int "Frame rate of the video stream"
	default 0
	help
	  Frame rate of the video stream. If set to 0, the default frame rate is used.

config VIDEO_PIXEL_FORMAT
	string "Pixel format of the video frame"
	help
	  Pixel format of the video frame. If not set, the default pixel format is used.

config VIDEO_CTRL_HFLIP
	int "Mirror the video frame horizontally"
	range 0 1
	default 0
	help
	  If set, mirror the video frame horizontally

config VIDEO_CTRL_VFLIP
	int "Mirror the video frame vertically"
	range 0 1
	default 0
	help
	  If set, mirror the video frame vertically

config VIDEO_ROTATION_ANGLE
	int "Rotate the video frame by a specified angle"
	range 0 270
	default 0
	help
	   Specify one of these values {0, 90, 180, 270} in degree to rotate the video frame

config PROP_NUM_BUFS
	int "Number of buffers the source provides before stopping"
	default 0
	help
	   If not set or set to 0, the source will run forever

endmenu

source "Kconfig.zephyr"
```

## sample.yaml
```
sample:
  name: Video Pipeline sample

tests:
  sample.video.pipeline:
    tags:
    - video
    - samples
    platform_allow:
    - native_sim/native/64
    - mimxrt1064_evk/mimxrt1064
    - mimxrt1170_evk/mimxrt1176/cm7
    - mimxrt1170_evk@B/mimxrt1176/cm7
    - frdm_mcxn947/mcxn947/cpu0
    - frdm_mcxn236/mcxn236
    - esp32s3_eye/esp32s3/procpu
    - stm32h7b3i_dk
    - ek_ra8d1/r7fa8d1bhecbd
    - mm_swiftio
    - arduino_nicla_vision/stm32h747xx/m7
    integration_platforms:
    - native_sim/native/64
    - mimxrt1064_evk/mimxrt1064
    - mimxrt1170_evk/mimxrt1176/cm7
    extra_args:
    - platform:native_sim/native/64:DTC_OVERLAY_FILE="dummy_dc.overlay"
    - platform:native_sim/native/64:SNIPPET="video-sw-generator"
    - platform:mimxrt1064_evk/mimxrt1064:SHIELD="dvp_fpc24_mt9m114;rk043fn66hs_ctg"
    - platform:mimxrt1170_evk/mimxrt1176/cm7:SHIELD="nxp_btb44_ov5640;rk055hdmipi4ma0"
    - platform:mimxrt1170_evk@B/mimxrt1176/cm7:SHIELD="nxp_btb44_ov5640;rk055hdmipi4ma0"
    - platform:frdm_mcxn947/mcxn947/cpu0:SHIELD="dvp_20pin_ov7670;lcd_par_s035_8080"
    - platform:frdm_mcxn236/mcxn236:SHIELD="dvp_20pin_ov7670;lcd_par_s035_8080"
    - platform:stm32h7b3i_dk:SHIELD="st_b_cams_omv_mb1683"
    - platform:ek_ra8d1/r7fa8d1bhecbd:SHIELD="dvp_20pin_ov7670;rtkmipilcdb00000be"
    extra_configs:
    - CONFIG_TEST=y
    - CONFIG_PROP_NUM_BUFS=100
    - platform:native_sim/native/64:CONFIG_SDL_DISPLAY=n
    harness: console
    harness_config:
      type: one_line
      regex:
      - "EOS message from element"
```

## prj.conf
```kconfig
CONFIG_LOG=y

CONFIG_MP=y
CONFIG_MP_PLUGIN_ZVID=y
CONFIG_MP_PLUGIN_ZDISP=y

CONFIG_VIDEO=y
CONFIG_DISPLAY=y

CONFIG_SHELL=y
CONFIG_DEVICE_SHELL=y

CONFIG_MAIN_STACK_SIZE=4000
CONFIG_HEAP_MEM_POOL_SIZE=7000
```

## boards/arduino_nicla_vision_stm32h747xx_m7.conf
```kconfig
CONFIG_VIDEO_BUFFER_POOL_SZ_MAX=160000
CONFIG_DMA=y

CONFIG_MAIN_STACK_SIZE=4096

CONFIG_SERIAL=y
CONFIG_CONSOLE=y
CONFIG_UART_CONSOLE=y
CONFIG_UART_LINE_CTRL=y
```

## boards/ek_ra8d1.conf
```kconfig
CONFIG_VIDEO_FRAME_WIDTH=320
CONFIG_VIDEO_FRAME_HEIGHT=240
CONFIG_MP_CAPSFILTER=y
CONFIG_VIDEO_BUFFER_POOL_HEAP_SIZE=310000
```

## boards/esp32s3_eye_procpu.conf
```kconfig
CONFIG_VIDEO_BUFFER_POOL_HEAP_SIZE=230400
CONFIG_ESP_SPIRAM=y
CONFIG_SPIRAM_MODE_OCT=y
CONFIG_DMA_ESP32_MAX_DESCRIPTOR_NUM=64
CONFIG_VIDEO_BUFFER_USE_SHARED_MULTI_HEAP=y
CONFIG_VIDEO_BUFFER_SMH_ATTRIBUTE=2
CONFIG_VIDEO_FRAME_HEIGHT=240
CONFIG_VIDEO_FRAME_WIDTH=240
CONFIG_VIDEO_PIXEL_FORMAT="RGBP"
CONFIG_MP_CAPSFILTER=y
CONFIG_VIDEO_CTRL_VFLIP=1

CONFIG_VIDEO_BUFFER_POOL_ALIGN=32
```

## boards/frdm_mcxn236.conf
```kconfig
CONFIG_VIDEO_BUFFER_POOL_HEAP_SIZE=80000
CONFIG_VIDEO_FRAME_WIDTH=320
CONFIG_VIDEO_FRAME_HEIGHT=240
CONFIG_MP_CAPSFILTER=y
```

## boards/mimxrt1170_evk_mimxrt1176_cm7.conf
```kconfig
CONFIG_VIDEO_BUFFER_POOL_NUM_MAX=3
CONFIG_VIDEO_BUFFER_POOL_HEAP_SIZE=11060400
CONFIG_VIDEO_ROTATION_ANGLE=270
CONFIG_VIDEO_FRAME_WIDTH=1280
CONFIG_VIDEO_FRAME_HEIGHT=720
CONFIG_MP_CAPSFILTER=y
```

## boards/native_sim_64.conf
```kconfig
CONFIG_VIDEO_FRAME_WIDTH=320
CONFIG_VIDEO_FRAME_HEIGHT=240
CONFIG_MP_CAPSFILTER=y
CONFIG_PROP_NUM_BUFS=100
```

## dummy_dc.overlay
```dts
/*
 * Copyright (c) 2021 Nordic Semiconductor ASA
 *
 * SPDX-License-Identifier: Apache-2.0
 */

/ {
	chosen {
		zephyr,display = &dummy_dc;
	};

	dummy_dc: dummy_dc {
		compatible = "zephyr,dummy-dc";
		height = <720>;
		width = <1280>;
	};
};
```

## boards/stm32h7b3i_dk.overlay
```dts
/*
 * Copyright (c) 2025 Charles Dias <charlesdias.cd@outlook.com>
 *
 * SPDX-License-Identifier: Apache-2.0
 *
 */

/delete-node/ &sram1;
/delete-node/ &sram2;

/* Increase the SRAM0 bank memory size to accommodate the VIDEO_BUFFER_POOL_SZ_MAX configuration. */
&sram0 {
	reg = <0x24000000 DT_SIZE_K(1024)>;
};
```

## src/main.c
```c
/*
 * Copyright 2025 NXP
 *
 * SPDX-License-Identifier: Apache-2.0
 */

#include <zephyr/drivers/video.h>
#include <zephyr/drivers/video-controls.h>
#include <zephyr/logging/log.h>
#include <zephyr/sys/util_macro.h>

#include <mp.h>

LOG_MODULE_REGISTER(main, CONFIG_LOG_DEFAULT_LEVEL);

#define PIPE_ID             0
#define VID_SRC_ID          1
#define CAPS_FILTER_ID      2
#define VID_TRANS_ID        3
#define DISP_SINK_ID        4

int main(void)
{
	int ret;
	struct mp_pipeline pipe = {0};
	struct mp_zvid_src vid_src = {0};
	struct mp_zdisp_sink disp_sink = {0};

	MP_ELEMENT_INIT(&pipe, mp_pipeline_init, PIPE_ID);
	MP_ELEMENT_INIT(&vid_src, mp_zvid_src_init, VID_SRC_ID);
	MP_ELEMENT_INIT(&disp_sink, mp_zdisp_sink_init, DISP_SINK_ID);

	struct video_rect __maybe_unused crop = {
		CONFIG_VIDEO_SOURCE_CROP_LEFT, CONFIG_VIDEO_SOURCE_CROP_TOP,
		CONFIG_VIDEO_SOURCE_CROP_WIDTH, CONFIG_VIDEO_SOURCE_CROP_HEIGHT};

	/* clang-format off */
	ret = mp_object_set_properties(MP_OBJECT(&vid_src),
		COND_CODE_0(CONFIG_PROP_NUM_BUFS, (), (PROP_NUM_BUFS, CONFIG_PROP_NUM_BUFS,))
		COND_CODE_0(CONFIG_VIDEO_SOURCE_CROP_WIDTH, (), (PROP_ZVID_CROP, &crop,))
		IF_ENABLED(CONFIG_VIDEO_CTRL_HFLIP, (VIDEO_CID_HFLIP, CONFIG_VIDEO_CTRL_HFLIP,))
		IF_ENABLED(CONFIG_VIDEO_CTRL_VFLIP, (VIDEO_CID_VFLIP, CONFIG_VIDEO_CTRL_VFLIP,))
		PROP_LIST_END);
	/* clang-format on */
	if (ret < 0) {
		goto err;
	}

	/* Caps filter element */
#if (CONFIG_MP_CAPSFILTER)
	struct mp_caps_filter caps_filter = {0};

	MP_ELEMENT_INIT(&caps_filter, mp_caps_filter_init, CAPS_FILTER_ID);

	/* clang-format off */
	struct mp_caps *caps = mp_caps_new(MP_MEDIA_VIDEO,
		COND_CODE_0(CONFIG_VIDEO_FRAME_WIDTH,
			(), (MP_CAPS_IMAGE_WIDTH, MP_TYPE_UINT, CONFIG_VIDEO_FRAME_WIDTH,))
		COND_CODE_0(CONFIG_VIDEO_FRAME_HEIGHT,
			(), (MP_CAPS_IMAGE_HEIGHT, MP_TYPE_UINT, CONFIG_VIDEO_FRAME_HEIGHT,))
		COND_CODE_0(CONFIG_VIDEO_FRAME_RATE,
			(), (MP_CAPS_FRAME_RATE, MP_TYPE_UINT_FRACTION, CONFIG_VIDEO_FRAME_RATE, 1,))
		MP_CAPS_END);
	/* clang-format on */

	if (caps == NULL) {
		goto err;
	}

	if (strcmp(CONFIG_VIDEO_PIXEL_FORMAT, "") != 0) {
		mp_structure_append(mp_caps_get_structure(caps, 0), MP_CAPS_PIXEL_FORMAT,
				    mp_value_new(MP_TYPE_UINT,
						 VIDEO_FOURCC_FROM_STR(CONFIG_VIDEO_PIXEL_FORMAT)));
	}

	ret = mp_object_set_properties(MP_OBJECT(&caps_filter), PROP_CAPS, caps, PROP_LIST_END);
	mp_caps_unref(caps);
	if (ret < 0) {
		goto err;
	}
#endif

	/* Video transform element */
#if (DT_HAS_CHOSEN(zephyr_videotrans))
	struct mp_zvid_transform vid_trans = {0};

	MP_ELEMENT_INIT(&vid_trans, mp_zvid_transform_init, VID_TRANS_ID);

	/* clang-format off */
	ret = mp_object_set_properties(MP_OBJECT(&vid_trans),
		COND_CODE_0(CONFIG_VIDEO_ROTATION_ANGLE,
			(), (VIDEO_CID_ROTATE, CONFIG_VIDEO_ROTATION_ANGLE,)) PROP_LIST_END);
	/* clang-format on */
	if (ret < 0) {
		goto err;
	}
#endif

	/* clang-format off */
	/* Add elements to the pipeline - order does not matter */
	if (!mp_bin_add(MP_BIN(&pipe),
			MP_ELEMENT(&vid_src),
			IF_ENABLED(CONFIG_MP_CAPSFILTER, (MP_ELEMENT(&caps_filter),))
			IF_ENABLED(DT_HAS_CHOSEN(zephyr_videotrans), (MP_ELEMENT(&vid_trans),))
		 	MP_ELEMENT(&disp_sink), NULL)) {
		LOG_ERR("Failed to add elements");
		goto err;
	}
	/* Link elements together - order does matter */
	if (!mp_element_link(MP_ELEMENT(&vid_src),
			IF_ENABLED(CONFIG_MP_CAPSFILTER, (MP_ELEMENT(&caps_filter),))
			IF_ENABLED(DT_HAS_CHOSEN(zephyr_videotrans), (MP_ELEMENT(&vid_trans),))
			MP_ELEMENT(&disp_sink), NULL)) {
		LOG_ERR("Failed to link elements");
		goto err;
	}
	/* clang-format on */

	/* Start playing */
	if (mp_element_set_state(MP_ELEMENT(&pipe), MP_STATE_PLAYING) != MP_STATE_CHANGE_SUCCESS) {
		LOG_ERR("Failed to start pipeline");
		goto err;
	}

	/* Handle message from the pipeline */
	struct mp_bus *bus = mp_element_get_bus(MP_ELEMENT(&pipe));
	/* Wait until an Error or an EOS - blocking */
	struct mp_message *msg = mp_bus_pop_msg(bus, MP_MESSAGE_ERROR | MP_MESSAGE_EOS);

	if (msg != NULL) {
		switch (msg->type) {
		case MP_MESSAGE_ERROR:
			LOG_INF("ERROR message from element %d", msg->src->id);
			break;
		case MP_MESSAGE_EOS:
			LOG_INF("EOS message from element %d", msg->src->id);
			break;
		default:
			LOG_ERR("Unexpected message from element %d", msg->src->id);
			break;
		}
	}

	/* TODO: Stop pipeline and free allocated resources */
	mp_message_destroy(msg);

	return 0;

err:
	LOG_ERR("Aborting sample");
	return 0;
}
```
