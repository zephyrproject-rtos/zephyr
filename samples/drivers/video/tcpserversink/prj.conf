## Kconfig
```
# Copyright (c) 2024 Espressif Systems (Shanghai) Co., Ltd.
# Copyright (c) 2025 STMicroelectronics.
# SPDX-License-Identifier: Apache-2.0

mainmenu "TCP camera streaming sample application"

menu "Video capture configuration"

config VIDEO_SOURCE_CROP_LEFT
	int "Crop area left value"
	default 0
	help
	   Left value of the crop area within the video source.

config VIDEO_SOURCE_CROP_TOP
	int "Crop area top value"
	default 0
	help
	   Top value of the crop area within the video source.

config VIDEO_SOURCE_CROP_WIDTH
	int "Crop area width value"
	default 0
	help
	   Width value of the crop area within the video source.
	   If set to 0, the crop is not applied.

config VIDEO_SOURCE_CROP_HEIGHT
	int "Crop area height value"
	default 0
	help
	   Height value of the crop area within the video source.
	   If set to 0, the crop is not applied.

config VIDEO_FRAME_HEIGHT
	int "Height of the video frame"
	default 0
	help
	  Height of the video frame. If set to 0, the default height is used.

config VIDEO_FRAME_WIDTH
	int "Width of the video frame"
	default 0
	help
	  Width of the video frame. If set to 0, the default width is used.

config VIDEO_PIXEL_FORMAT
	string "Pixel format of the video frame"
	help
	  Pixel format of the video frame. If not set, the default pixel format is used.

config VIDEO_CAPTURE_N_BUFFERING
	int "Capture N-buffering"
	default 2
	help
	  Framerate versus memory usage tradeoff.
	  "2" allows to capture while sending data (optimal framerate).
	  "1" allows to reduce memory usage but capture framerate is lower.
	  If not set defaults to "2".

config VIDEO_CTRL_HFLIP
	bool "Mirror the video frame horizontally"
	help
	  If set, mirror the video frame horizontally

config VIDEO_CTRL_VFLIP
	bool "Mirror the video frame vertically"
	help
	  If set, mirror the video frame vertically

config VIDEO_ENCODED_PIXEL_FORMAT
	string "Pixel format of the encoded frame"
	default VIDEO_PIX_FMT_H264
	help
	  Compression format used by the video encoder if enabled.
	  If not set defaults to H264 video bitstream with startcodes.

endmenu

if WIFI
config SAMPLE_WIFI_SSID
	string "WIFI SSID - Network name"
	default "my_network"
config SAMPLE_WIFI_PSK
	string "WIFI PSK - Network password key"
	default "secret_passwd"
endif

source "Kconfig.zephyr"
```

## sample.yaml
```
sample:
  name: Video TCP server sink
tests:
  sample.drivers.video.tcpserversink:
    build_only: true
    tags:
      - video
      - net
      - socket
      - shield
    platform_allow:
      - mimxrt1064_evk/mimxrt1064
      - stm32n6570_dk/stm32n657xx/sb
    depends_on:
      - video
      - netif
    integration_platforms:
      - mimxrt1064_evk/mimxrt1064
      - stm32n6570_dk/stm32n657xx/sb
    extra_args:
      - platform:mimxrt1064_evk/mimxrt1064:SHIELD=dvp_fpc24_mt9m114
      - platform:stm32n6570_dk/stm32n657xx/sb:FILE_SUFFIX=venc
      - platform:stm32n6570_dk/stm32n657xx/sb:SHIELD=st_b_cams_imx_mb1854
```

## prj.conf
```kconfig
# Generic networking options
CONFIG_NETWORKING=y
CONFIG_NET_DHCPV4=n
CONFIG_NET_TCP=y
CONFIG_NET_IPV4=y
CONFIG_NET_SOCKETS=y
CONFIG_POSIX_API=y

# Kernel options
CONFIG_MAIN_STACK_SIZE=2048
CONFIG_ENTROPY_GENERATOR=y
CONFIG_TEST_RANDOM_GENERATOR=y
CONFIG_INIT_STACKS=y

# Logging
CONFIG_NET_LOG=y
CONFIG_LOG=y
CONFIG_NET_STATISTICS=y
CONFIG_PRINTK=y

# Network buffers
CONFIG_NET_PKT_RX_COUNT=16
CONFIG_NET_PKT_TX_COUNT=64
CONFIG_NET_BUF_RX_COUNT=16
CONFIG_NET_BUF_TX_COUNT=512
CONFIG_NET_BUF_DATA_SIZE=1024

CONFIG_NET_CONTEXT_NET_PKT_POOL=y

# IP address options
CONFIG_NET_IF_UNICAST_IPV6_ADDR_COUNT=3
CONFIG_NET_IF_MCAST_IPV6_ADDR_COUNT=4
CONFIG_NET_MAX_CONTEXTS=10

# Network shell
CONFIG_NET_SHELL=y

# Network application options and configuration
CONFIG_NET_CONFIG_SETTINGS=y
CONFIG_NET_CONFIG_MY_IPV4_ADDR="192.0.2.1"

CONFIG_VIDEO=y
```

## overlay-wifi.conf
```kconfig
# Copyright (c) 2026 Mario Paja
# SPDX-License-Identifier: Apache-2.0

CONFIG_WIFI=y
CONFIG_NET_L2_WIFI_MGMT=y

CONFIG_NET_PKT_RX_COUNT=8
CONFIG_NET_PKT_TX_COUNT=8
CONFIG_NET_BUF_RX_COUNT=20
CONFIG_NET_BUF_TX_COUNT=20

CONFIG_NET_CONFIG_AUTO_INIT=n

CONFIG_SAMPLE_WIFI_SSID="<SSID>"
CONFIG_SAMPLE_WIFI_PSK="<PASSWD>"
```

## boards/stm32n6570_dk.conf
```kconfig
# Video buffer pool
CONFIG_VIDEO_BUFFER_POOL_SZ_MAX=10000000
CONFIG_VIDEO_BUFFER_POOL_NUM_MAX=10

# Camera interface
CONFIG_VIDEO_STM32_DCMIPP_SENSOR_PIXEL_FORMAT="pRAA"
CONFIG_VIDEO_STM32_DCMIPP_SENSOR_WIDTH=2592
CONFIG_VIDEO_STM32_DCMIPP_SENSOR_HEIGHT=1944
CONFIG_FPU=y

# Capture
CONFIG_VIDEO_FRAME_WIDTH=1920
CONFIG_VIDEO_FRAME_HEIGHT=1080
CONFIG_VIDEO_PIXEL_FORMAT="NV12"
CONFIG_VIDEO_CAPTURE_N_BUFFERING=2

# Video encoder
CONFIG_VIDEO_STM32_VENC=y
CONFIG_MAIN_STACK_SIZE=4096
CONFIG_VIDEO_ENCODED_PIXEL_FORMAT="H264"

# Network buffers
CONFIG_NET_BUF_RX_COUNT=4
CONFIG_NET_BUF_TX_COUNT=8
```

## boards/stm32n6570_dk_jpegenc.conf
```kconfig
# Video buffer pool
CONFIG_VIDEO_BUFFER_POOL_HEAP_SIZE=616000
CONFIG_VIDEO_BUFFER_POOL_NUM_MAX=4

CONFIG_FPU=y

# Capture
CONFIG_VIDEO_CAPTURE_N_BUFFERING=2

# Video encoder
CONFIG_VIDEO_ENCODER_JPEG=y
CONFIG_MAIN_STACK_SIZE=4096
CONFIG_VIDEO_ENCODED_PIXEL_FORMAT="JPEG"

# Default frame size
CONFIG_VIDEO_PIXEL_FORMAT="NV12"
CONFIG_VIDEO_FRAME_WIDTH=320
CONFIG_VIDEO_FRAME_HEIGHT=240

# Network buffers
CONFIG_NET_BUF_RX_COUNT=4
CONFIG_NET_BUF_TX_COUNT=8
```

## boards/stm32n6570_dk_stm32n657xx_fsbl_venc.conf
```kconfig
# Video buffer pool
CONFIG_VIDEO_BUFFER_POOL_SZ_MAX=1000000
CONFIG_VIDEO_BUFFER_POOL_NUM_MAX=10

CONFIG_FPU=y

# Capture
CONFIG_VIDEO_CAPTURE_N_BUFFERING=2

# Video encoder
CONFIG_VIDEO_ENCODER_H264=y
CONFIG_MAIN_STACK_SIZE=4096
CONFIG_VIDEO_ENCODED_PIXEL_FORMAT="H264"

# Default frame size
CONFIG_VIDEO_PIXEL_FORMAT="NV12"
CONFIG_VIDEO_FRAME_WIDTH=1920
CONFIG_VIDEO_FRAME_HEIGHT=1080

# Network buffers
CONFIG_NET_BUF_RX_COUNT=4
CONFIG_NET_BUF_TX_COUNT=8
```

## boards/stm32n6570_dk_stm32n657xx_sb.conf
```kconfig
# Video buffer pool
CONFIG_VIDEO_BUFFER_POOL_SZ_MAX=10000000
CONFIG_VIDEO_BUFFER_POOL_NUM_MAX=10

CONFIG_FPU=y

# Capture
CONFIG_VIDEO_CAPTURE_N_BUFFERING=2

# Video encoder
CONFIG_MAIN_STACK_SIZE=4096

# Network buffers
CONFIG_NET_BUF_RX_COUNT=4
CONFIG_NET_BUF_TX_COUNT=8
```

## boards/stm32n6570_dk_stm32n657xx_sb_venc.conf
```kconfig
# SPDX-FileCopyrightText: Copyright The Zephyr Project Contributors
# SPDX-License-Identifier: Apache-2.0

# Video buffer pool
CONFIG_VIDEO_BUFFER_POOL_HEAP_SIZE=10000000
CONFIG_VIDEO_BUFFER_POOL_NUM_MAX=10

CONFIG_FPU=y

# Capture
CONFIG_VIDEO_CAPTURE_N_BUFFERING=2

# Video encoder
CONFIG_VIDEO_ENCODER_H264=y
CONFIG_MAIN_STACK_SIZE=4096
CONFIG_VIDEO_ENCODED_PIXEL_FORMAT="H264"

# Default frame size
CONFIG_VIDEO_PIXEL_FORMAT="NV12"
CONFIG_VIDEO_FRAME_WIDTH=1920
CONFIG_VIDEO_FRAME_HEIGHT=1080

# Network buffers
CONFIG_NET_BUF_RX_COUNT=4
CONFIG_NET_BUF_TX_COUNT=8
```

## boards/stm32n6570_dk_stm32n657xx_fsbl_jpegenc.overlay
```dts
/*
 * Copyright (c) 2025 STMicroelectronics
 * SPDX-License-Identifier: Apache-2.0
 */

/ {
	chosen {
		zephyr,videoenc = &jpeg;
	};
};
```

## boards/stm32n6570_dk_stm32n657xx_sb.overlay
```dts
/*
 * Copyright (c) 2025 STMicroelectronics.
 *
 * SPDX-License-Identifier: Apache-2.0
 */

/ {
	chosen {
		zephyr,videoenc = &venc;
	};
};

&venc {
	status = "okay";
};
```

## src/main.c
```c
/*
 * Copyright (c) 2019 Linaro Limited
 * Copyright 2025 NXP
 * Copyright (c) 2025 STMicroelectronics.
 *
 * SPDX-License-Identifier: Apache-2.0
 */

#include <zephyr/device.h>
#include <zephyr/drivers/video.h>
#include <zephyr/drivers/video-controls.h>
#include <zephyr/kernel.h>
#include <zephyr/logging/log.h>
#include <zephyr/net/socket.h>

#include <zephyr/posix/netinet/in.h>
#include <zephyr/posix/sys/socket.h>
#include <zephyr/posix/arpa/inet.h>
#include <zephyr/posix/unistd.h>
#include <zephyr/posix/poll.h>

#if defined(CONFIG_WIFI)

#include <zephyr/net/net_if.h>
#include <zephyr/net/net_ip.h>
#include <zephyr/net/wifi_mgmt.h>
#include <zephyr/net/net_event.h>
#include <zephyr/net/net_mgmt.h>

#endif /* CONFIG_WIFI */

LOG_MODULE_REGISTER(main, CONFIG_LOG_DEFAULT_LEVEL);

#if defined(CONFIG_WIFI)

#define WIFI_SSID CONFIG_SAMPLE_WIFI_SSID
#define WIFI_PSK  CONFIG_SAMPLE_WIFI_PSK

#define STATIC_IP      CONFIG_NET_CONFIG_MY_IPV4_ADDR
#define STATIC_GW      CONFIG_NET_CONFIG_MY_IPV4_GW
#define STATIC_NETMASK CONFIG_NET_CONFIG_MY_IPV4_NETMASK

static K_SEM_DEFINE(wifi_connected_sem, 0, 1);

static struct net_mgmt_event_callback wifi_cb;

static void wifi_event_handler(struct net_mgmt_event_callback *cb, uint64_t mgmt_event,
			       struct net_if *iface)
{
	if (mgmt_event == NET_EVENT_WIFI_CONNECT_RESULT) {
		const struct wifi_status *status = (const struct wifi_status *)cb->info;
		if (status->status == 0) { /* 0 = success */
			LOG_INF("WiFi connected");
			k_sem_give(&wifi_connected_sem);
		} else {
			LOG_ERR("WiFi connection failed: %d", status->status);
		}
	}
}

static int connect_wifi(void)
{
	struct net_if *iface = net_if_get_default();
	struct wifi_connect_req_params params = {
		.ssid = WIFI_SSID,
		.ssid_length = strlen(WIFI_SSID),
		.psk = WIFI_PSK,
		.psk_length = strlen(WIFI_PSK),
		.channel = WIFI_CHANNEL_ANY,
		.security = WIFI_SECURITY_TYPE_PSK,
		.band = WIFI_FREQ_BAND_2_4_GHZ, /* or _5_GHZ */
		.mfp = WIFI_MFP_OPTIONAL,
	};

	/* Register for wifi events */
	net_mgmt_init_event_callback(&wifi_cb, wifi_event_handler, NET_EVENT_WIFI_CONNECT_RESULT);
	net_mgmt_add_event_callback(&wifi_cb);

	LOG_INF("Connecting to SSID: %s", WIFI_SSID);
	int ret = net_mgmt(NET_REQUEST_WIFI_CONNECT, iface, &params, sizeof(params));
	if (ret) {
		LOG_ERR("WiFi connect request failed: %d", ret);
		return ret;
	}

	/* Wait for connection */
	if (k_sem_take(&wifi_connected_sem, K_SECONDS(30))) {
		LOG_ERR("WiFi connection timeout");
		return -ETIMEDOUT;
	}

	/* Set static IP — must be done after interface is up */
	struct in_addr ip, gw, nm;

	net_addr_pton(AF_INET, STATIC_IP, &ip);
	net_addr_pton(AF_INET, STATIC_GW, &gw);
	net_addr_pton(AF_INET, STATIC_NETMASK, &nm);

	net_if_ipv4_addr_add(iface, &ip, NET_ADDR_MANUAL, 0);
	net_if_ipv4_set_gw(iface, &gw);
	net_if_ipv4_set_netmask_by_addr(iface, &ip, &nm);

	LOG_INF("Static IP set: %s", STATIC_IP);
	return 0;
}

#endif /* CONFIG_WIFI */

#define MY_PORT          5000
#define MAX_CLIENT_QUEUE 1

static ssize_t sendall(int sock, const void *buf, size_t len)
{
	while (len) {
		ssize_t out_len = send(sock, buf, len, 0);

		if (out_len < 0) {
			return out_len;
		}
		buf = (const char *)buf + out_len;
		len -= out_len;
	}

	return 0;
}

#if DT_HAS_CHOSEN(zephyr_videoenc)
const struct device *encoder_dev;

int configure_encoder(void)
{
	struct video_buffer *buffer;
	struct video_format fmt;
	struct video_caps caps;
	uint32_t size;
	int i;

	encoder_dev = DEVICE_DT_GET(DT_CHOSEN(zephyr_videoenc));
	if (!device_is_ready(encoder_dev)) {
		LOG_ERR("%s: encoder video device not ready.", encoder_dev->name);
		return -1;
	}

	/* Get capabilities */
	caps.type = VIDEO_BUF_TYPE_OUTPUT;
	if (video_get_caps(encoder_dev, &caps)) {
		LOG_ERR("Unable to retrieve video capabilities");
		return -1;
	}

	LOG_INF("- Encoder output capabilities:");
	i = 0;
	while (caps.format_caps[i].pixelformat) {
		const struct video_format_cap *fcap = &caps.format_caps[i];
		/* fourcc to string */
		LOG_INF("  %s width [%u; %u; %u] height [%u; %u; %u]",
			VIDEO_FOURCC_TO_STR(fcap->pixelformat), fcap->width_min, fcap->width_max,
			fcap->width_step, fcap->height_min, fcap->height_max, fcap->height_step);
		i++;
	}

	caps.type = VIDEO_BUF_TYPE_INPUT;
	if (video_get_caps(encoder_dev, &caps)) {
		LOG_ERR("Unable to retrieve video capabilities");
		return -1;
	}

	LOG_INF("- Encoder input capabilities:");
	i = 0;
	while (caps.format_caps[i].pixelformat) {
		const struct video_format_cap *fcap = &caps.format_caps[i];
		/* fourcc to string */
		LOG_INF("  %s width [%u; %u; %u] height [%u; %u; %u]",
			VIDEO_FOURCC_TO_STR(fcap->pixelformat), fcap->width_min, fcap->width_max,
			fcap->width_step, fcap->height_min, fcap->height_max, fcap->height_step);
		i++;
	}

	/* Get default/native format */
	fmt.type = VIDEO_BUF_TYPE_OUTPUT;
	if (video_get_format(encoder_dev, &fmt)) {
		LOG_ERR("Unable to retrieve video format");
		return -1;
	}

	LOG_INF("Video encoder device detected, format: %s %ux%u",
		VIDEO_FOURCC_TO_STR(fmt.pixelformat), fmt.width, fmt.height);

#if CONFIG_VIDEO_FRAME_HEIGHT
	fmt.height = CONFIG_VIDEO_FRAME_HEIGHT;
#endif

#if CONFIG_VIDEO_FRAME_WIDTH
	fmt.width = CONFIG_VIDEO_FRAME_WIDTH;
#endif

	/* Set output format */
	if (strcmp(CONFIG_VIDEO_ENCODED_PIXEL_FORMAT, "")) {
		fmt.pixelformat = VIDEO_FOURCC_FROM_STR(CONFIG_VIDEO_ENCODED_PIXEL_FORMAT);
	}

	LOG_INF("- Video encoder output format: %s %ux%u", VIDEO_FOURCC_TO_STR(fmt.pixelformat),
		fmt.width, fmt.height);

	fmt.type = VIDEO_BUF_TYPE_OUTPUT;
	if (video_set_format(encoder_dev, &fmt)) {
		LOG_ERR("Unable to set format");
		return -1;
	}

	/* Alloc output buffer */
	size = fmt.size;
	if (size == 0) {
		LOG_ERR("Encoder driver must set format size");
		return -1;
	}

	buffer = video_buffer_aligned_alloc(size, CONFIG_VIDEO_BUFFER_POOL_ALIGN, K_NO_WAIT);
	if (buffer == NULL) {
		LOG_ERR("Unable to alloc compressed video buffer size=%d", size);
		return -1;
	}

	buffer->type = VIDEO_BUF_TYPE_OUTPUT;
	if (video_enqueue(encoder_dev, buffer)) {
		LOG_ERR("Unable to enqueue encoder output buf");
		return -1;
	}

	/* Set input format */
	if (strcmp(CONFIG_VIDEO_PIXEL_FORMAT, "")) {
		fmt.pixelformat = VIDEO_FOURCC_FROM_STR(CONFIG_VIDEO_PIXEL_FORMAT);
	}

	LOG_INF("- Video encoder input format: %s %ux%u", VIDEO_FOURCC_TO_STR(fmt.pixelformat),
		fmt.width, fmt.height);

	fmt.type = VIDEO_BUF_TYPE_INPUT;
	if (video_set_format(encoder_dev, &fmt)) {
		LOG_ERR("Unable to set input format");
		return -1;
	}

	/* Start video encoder */
	if (video_stream_start(encoder_dev, VIDEO_BUF_TYPE_INPUT)) {
		LOG_ERR("Unable to start video encoder (input)");
		return -1;
	}
	if (video_stream_start(encoder_dev, VIDEO_BUF_TYPE_OUTPUT)) {
		LOG_ERR("Unable to start video encoder (output)");
		return -1;
	}

	return 0;
}

int encode_frame(struct video_buffer *in, struct video_buffer **out)
{
	int ret;

	in->type = VIDEO_BUF_TYPE_INPUT;
	ret = video_enqueue(encoder_dev, in);
	if (ret) {
		LOG_ERR("Unable to enqueue encoder input buf");
		return ret;
	}

	(*out)->type = VIDEO_BUF_TYPE_OUTPUT;
	ret = video_dequeue(encoder_dev, out, K_FOREVER);
	if (ret) {
		LOG_ERR("Unable to dequeue encoder output buf");
		return ret;
	}

	ret = video_dequeue(encoder_dev, &in, K_FOREVER);
	if (ret) {
		LOG_ERR("Unable to dequeue encoder input buf");
		return ret;
	}

	return 0;
}

void stop_encoder(void)
{
	if (video_stream_stop(encoder_dev, VIDEO_BUF_TYPE_OUTPUT)) {
		LOG_ERR("Unable to stop encoder (output)");
	}

	if (video_stream_stop(encoder_dev, VIDEO_BUF_TYPE_INPUT)) {
		LOG_ERR("Unable to stop encoder (input)");
	}
}
#endif

int main(void)
{
#if defined(CONFIG_WIFI)
	if (connect_wifi()) {
		LOG_ERR("Failed to connect to WiFi");
		return 0;
	}
#endif

	struct sockaddr_in addr, client_addr;
	socklen_t client_addr_len = sizeof(client_addr);
	struct video_buffer *buffers[CONFIG_VIDEO_CAPTURE_N_BUFFERING];
	struct video_buffer *vbuf = &(struct video_buffer){};
#if DT_HAS_CHOSEN(zephyr_videoenc)
	struct video_buffer *vbuf_out = &(struct video_buffer){};
#endif
	int ret, sock, client;
	struct video_format fmt;
	struct video_caps caps;
	struct video_frmival frmival;
	struct video_frmival_enum fie;
	enum video_buf_type type = VIDEO_BUF_TYPE_OUTPUT;
	const struct device *video_dev;
#if (CONFIG_VIDEO_SOURCE_CROP_WIDTH && CONFIG_VIDEO_SOURCE_CROP_HEIGHT) || \
	CONFIG_VIDEO_FRAME_HEIGHT || CONFIG_VIDEO_FRAME_WIDTH
	struct video_selection sel = {
		.type = VIDEO_BUF_TYPE_OUTPUT,
	};
#endif
	int i = 0;
#if CONFIG_VIDEO_FRAME_HEIGHT || CONFIG_VIDEO_FRAME_WIDTH
	int err;
#endif
	const struct device *last_dev = NULL;
	struct video_ctrl_query cq = {.id = VIDEO_CTRL_FLAG_NEXT_CTRL};
	struct video_control ctrl = {.id = VIDEO_CID_HFLIP, .val = 1};
	int tp_set_ret = -ENOTSUP;

	video_dev = DEVICE_DT_GET(DT_CHOSEN(zephyr_camera));
	if (!device_is_ready(video_dev)) {
		LOG_ERR("%s: video device not ready.", video_dev->name);
		return 0;
	}

	/* Prepare Network */
	(void)memset(&addr, 0, sizeof(addr));
	addr.sin_family = AF_INET;
	addr.sin_port = htons(MY_PORT);

	sock = socket(AF_INET, SOCK_STREAM, IPPROTO_TCP);
	if (sock < 0) {
		LOG_ERR("Failed to create TCP socket: %d", errno);
		return 0;
	}

	ret = bind(sock, (struct sockaddr *)&addr, sizeof(addr));
	if (ret < 0) {
		LOG_ERR("Failed to bind TCP socket: %d", errno);
		close(sock);
		return 0;
	}

	ret = listen(sock, MAX_CLIENT_QUEUE);
	if (ret < 0) {
		LOG_ERR("Failed to listen on TCP socket: %d", errno);
		close(sock);
		return 0;
	}

	/* Get capabilities */
	caps.type = type;
	if (video_get_caps(video_dev, &caps)) {
		LOG_ERR("Unable to retrieve video capabilities");
		return 0;
	}

	LOG_INF("- Capabilities:");
	while (caps.format_caps[i].pixelformat) {
		const struct video_format_cap *fcap = &caps.format_caps[i];
		/* fourcc to string */
		LOG_INF("  %s width [%u; %u; %u] height [%u; %u; %u]",
			VIDEO_FOURCC_TO_STR(fcap->pixelformat), fcap->width_min, fcap->width_max,
			fcap->width_step, fcap->height_min, fcap->height_max, fcap->height_step);
		i++;
	}

	/* Get default/native format */
	fmt.type = type;
	if (video_get_format(video_dev, &fmt)) {
		LOG_ERR("Unable to retrieve video format");
		return 0;
	}

	LOG_INF("Video device detected, format: %s %ux%u",
		VIDEO_FOURCC_TO_STR(fmt.pixelformat), fmt.width, fmt.height);

	/* Set the crop setting if necessary */
#if CONFIG_VIDEO_SOURCE_CROP_WIDTH && CONFIG_VIDEO_SOURCE_CROP_HEIGHT
	sel.target = VIDEO_SEL_TGT_CROP;
	sel.rect.left = CONFIG_VIDEO_SOURCE_CROP_LEFT;
	sel.rect.top = CONFIG_VIDEO_SOURCE_CROP_TOP;
	sel.rect.width = CONFIG_VIDEO_SOURCE_CROP_WIDTH;
	sel.rect.height = CONFIG_VIDEO_SOURCE_CROP_HEIGHT;
	if (video_set_selection(video_dev, &sel)) {
		LOG_ERR("Unable to set selection crop");
		return 0;
	}
	LOG_INF("Selection crop set to (%u,%u)/%ux%u", sel.rect.left, sel.rect.top, sel.rect.width,
		sel.rect.height);
#endif

#if CONFIG_VIDEO_FRAME_HEIGHT || CONFIG_VIDEO_FRAME_WIDTH
#if CONFIG_VIDEO_FRAME_HEIGHT
	fmt.height = CONFIG_VIDEO_FRAME_HEIGHT;
#endif

#if CONFIG_VIDEO_FRAME_WIDTH
	fmt.width = CONFIG_VIDEO_FRAME_WIDTH;
#endif

	/*
	 * Check (if possible) if targeted size is same as crop
	 * and if compose is necessary
	 */
	sel.target = VIDEO_SEL_TGT_CROP;
	err = video_get_selection(video_dev, &sel);
	if (err < 0 && err != -ENOSYS) {
		LOG_ERR("Unable to get selection crop");
		return 0;
	}

	if (err == 0 && (sel.rect.width != fmt.width || sel.rect.height != fmt.height)) {
		sel.target = VIDEO_SEL_TGT_COMPOSE;
		sel.rect.left = 0;
		sel.rect.top = 0;
		sel.rect.width = fmt.width;
		sel.rect.height = fmt.height;
		err = video_set_selection(video_dev, &sel);
		if (err < 0 && err != -ENOSYS) {
			LOG_ERR("Unable to set selection compose");
			return 0;
		}
	}
#endif

	if (strcmp(CONFIG_VIDEO_PIXEL_FORMAT, "")) {
		fmt.pixelformat = VIDEO_FOURCC_FROM_STR(CONFIG_VIDEO_PIXEL_FORMAT);
	}

	LOG_INF("- Video format: %s %ux%u", VIDEO_FOURCC_TO_STR(fmt.pixelformat), fmt.width,
		fmt.height);

	if (video_set_format(video_dev, &fmt)) {
		LOG_ERR("Unable to set format");
		return 0;
	}

	if (!video_get_frmival(video_dev, &frmival)) {
		LOG_INF("- Default frame rate : %f fps",
			1.0 * frmival.denominator / frmival.numerator);
	}

	LOG_INF("- Supported frame intervals for the default format:");
	memset(&fie, 0, sizeof(fie));
	fie.format = &fmt;
	while (video_enum_frmival(video_dev, &fie) == 0) {
		if (fie.type == VIDEO_FRMIVAL_TYPE_DISCRETE) {
			LOG_INF("   %u/%u", fie.discrete.numerator, fie.discrete.denominator);
		} else {
			LOG_INF("   [min = %u/%u; max = %u/%u; step = %u/%u]",
				fie.stepwise.min.numerator, fie.stepwise.min.denominator,
				fie.stepwise.max.numerator, fie.stepwise.max.denominator,
				fie.stepwise.step.numerator, fie.stepwise.step.denominator);
		}
		fie.index++;
	}

	/* Get supported controls */
	LOG_INF("- Supported controls:");
	cq.dev = video_dev;
	while (!video_query_ctrl(&cq)) {
		if (cq.dev != last_dev) {
			last_dev = cq.dev;
			LOG_INF("\t\tdevice: %s", cq.dev->name);
		}
		video_print_ctrl(&cq);
		cq.id |= VIDEO_CTRL_FLAG_NEXT_CTRL;
	}

	/* Set controls */
	if (IS_ENABLED(CONFIG_VIDEO_CTRL_HFLIP)) {
		video_set_ctrl(video_dev, &ctrl);
	}

	if (IS_ENABLED(CONFIG_VIDEO_CTRL_VFLIP)) {
		ctrl.id = VIDEO_CID_VFLIP;
		video_set_ctrl(video_dev, &ctrl);
	}

	if (IS_ENABLED(CONFIG_TEST)) {
		ctrl.id = VIDEO_CID_TEST_PATTERN;
		tp_set_ret = video_set_ctrl(video_dev, &ctrl);
	}

	/* Alloc Buffers */
	for (i = 0; i < ARRAY_SIZE(buffers); i++) {
		/*
		 * For some hardwares, such as the PxP used on i.MX RT1170 to do image rotation,
		 * buffer alignment is needed in order to achieve the best performance
		 */
		buffers[i] = video_buffer_aligned_alloc(fmt.size, CONFIG_VIDEO_BUFFER_POOL_ALIGN,
							K_NO_WAIT);
		if (buffers[i] == NULL) {
			LOG_ERR("Unable to alloc video buffer");
			return 0;
		}
		buffers[i]->type = type;
	}

	/* Connection loop */
	do {
		bool disconnected = false;

		LOG_INF("TCP: Waiting for client...");

		client = accept(sock, (struct sockaddr *)&client_addr, &client_addr_len);
		if (client < 0) {
			LOG_ERR("Failed to accept: %d", errno);
			return 0;
		}

		LOG_INF("TCP: Accepted connection");

#if DT_HAS_CHOSEN(zephyr_videoenc)
		if (configure_encoder()) {
			LOG_ERR("Unable to configure video encoder");
			return 0;
		}
#endif

		/* Enqueue Buffers */
		for (i = 0; i < ARRAY_SIZE(buffers); i++) {
			ret = video_enqueue(video_dev, buffers[i]);
			if (ret) {
				LOG_ERR("Unable to enqueue video buf");
				return 0;
			}
		}

		/* Start video capture */
		if (video_stream_start(video_dev, type)) {
			LOG_ERR("Unable to start video");
			return 0;
		}

		LOG_INF("Stream started");

		/* Capture loop */
		i = 0;
		vbuf->type = type;
		do {
			ret = video_dequeue(video_dev, &vbuf, K_FOREVER);
			if (ret) {
				LOG_ERR("Unable to dequeue video buf");
				return 0;
			}

#if DT_HAS_CHOSEN(zephyr_videoenc)
			encode_frame(vbuf, &vbuf_out);

			vbuf->type = VIDEO_BUF_TYPE_INPUT;
			ret = video_enqueue(video_dev, vbuf);
			if (ret) {
				LOG_ERR("Unable to enqueue video buf");
				return 0;
			}

			LOG_INF("Sending compressed frame %d (size=%d bytes)", i++,
				vbuf_out->bytesused);
			/* Send compressed video buffer to TCP client */
			ret = sendall(client, vbuf_out->buffer, vbuf_out->bytesused);
			disconnected = ret && ret != -EAGAIN;

			vbuf_out->type = VIDEO_BUF_TYPE_OUTPUT;
			ret = video_enqueue(encoder_dev, vbuf_out);
			if (ret) {
				LOG_ERR("Unable to enqueue encoder output buf");
				return 0;
			}

#else
			LOG_INF("Sending frame %d", i++);
			/* Send video buffer to TCP client */
			ret = sendall(client, vbuf->buffer, vbuf->bytesused);
			disconnected = ret && ret != -EAGAIN;

			vbuf->type = VIDEO_BUF_TYPE_INPUT;
			ret = video_enqueue(video_dev, vbuf);
			if (ret) {
				LOG_ERR("Unable to enqueue video buf");
				return 0;
			}
#endif
			if (disconnected) {
				/* client disconnected */
				LOG_ERR("TCP: Client disconnected %d", ret);
				close(client);
			}

		} while (!ret && !disconnected);

		/* stop capture */
		if (video_stream_stop(video_dev, type)) {
			LOG_ERR("Unable to stop video");
			return 0;
		}

#if DT_HAS_CHOSEN(zephyr_videoenc)
		stop_encoder();
#endif

		/* Flush remaining buffers */
		do {
			vbuf->type = VIDEO_BUF_TYPE_INPUT;
			ret = video_dequeue(video_dev, &vbuf, K_NO_WAIT);
		} while (!ret);

	} while (1);
}
```
