## samples/drivers/video/tcpserversink/boards/stm32n6570_dk_venc.conf
```kconfig
# Video buffer pool
CONFIG_VIDEO_BUFFER_POOL_HEAP_SIZE=10000000
CONFIG_VIDEO_BUFFER_POOL_NUM_MAX=10

CONFIG_FPU=y

# Capture
CONFIG_VIDEO_CAPTURE_N_BUFFERING=2

# Video encoder
CONFIG_VIDEO_ENCODER_H264=y
CONFIG_MAIN_STACK_SIZE=4096
CONFIG_VIDEO_ENCODED_PIXEL_FORMAT="H264"

# Default frame size
CONFIG_VIDEO_PIXEL_FORMAT="NV12"
CONFIG_VIDEO_FRAME_WIDTH=1920
CONFIG_VIDEO_FRAME_HEIGHT=1080

# Network buffers
CONFIG_NET_BUF_RX_COUNT=4
CONFIG_NET_BUF_TX_COUNT=8
```

## samples/drivers/video/tcpserversink/boards/xiao_esp32s3_esp32s3_procpu_sense.conf
```kconfig
CONFIG_VIDEO_BUFFER_POOL_HEAP_SIZE=1382400
CONFIG_ESP_SPIRAM=y
CONFIG_SPIRAM_MODE_OCT=y
CONFIG_VIDEO_BUFFER_POOL_ALIGN=32
CONFIG_DMA_ESP32_MAX_DESCRIPTOR_NUM=64
CONFIG_VIDEO_BUFFER_USE_SHARED_MULTI_HEAP=y
CONFIG_VIDEO_BUFFER_SMH_ATTRIBUTE=2
CONFIG_VIDEO_FRAME_HEIGHT=120
CONFIG_VIDEO_FRAME_WIDTH=160
CONFIG_VIDEO_PIXEL_FORMAT="RGBP"

CONFIG_VIDEO_CAPTURE_N_BUFFERING=10
CONFIG_VIDEO_BUFFER_POOL_NUM_MAX=10
```

## samples/drivers/video/tcpserversink/sample.yaml
```yaml
sample:
  name: Video TCP server sink
tests:
  sample.video.tcpserversink:
    build_only: true
    tags:
      - video
      - net
      - socket
      - shield
    platform_allow:
      - mimxrt1064_evk/mimxrt1064
      - stm32n6570_dk/stm32n657xx/sb
    depends_on:
      - video
      - netif
    integration_platforms:
      - mimxrt1064_evk/mimxrt1064
      - stm32n6570_dk/stm32n657xx/sb
    extra_args:
      - platform:mimxrt1064_evk/mimxrt1064:SHIELD=dvp_fpc24_mt9m114
      - platform:stm32n6570_dk/stm32n657xx/sb:FILE_SUFFIX=venc
      - platform:stm32n6570_dk/stm32n657xx/sb:SHIELD=st_b_cams_imx_mb1854
```

## samples/drivers/virtualization/ivshmem/doorbell/boards/qemu_cortex_a53.conf
```kconfig
CONFIG_PCIE_CONTROLLER=y
CONFIG_PCIE_ECAM=y

# Hungry PCI requires at least 256M of virtual space
CONFIG_KERNEL_VM_SIZE=0x80000000

# Hungry PCI requires phys addresses with more than 32 bits
CONFIG_ARM64_VA_BITS_40=y
CONFIG_ARM64_PA_BITS_40=y

# MSI support requires ITS
CONFIG_GIC_V3_ITS=y

# ITS, in turn, requires dynamic memory (9x64 + alignment constrains)
# Additionally, our test also uses malloc
CONFIG_HEAP_MEM_POOL_SIZE=1048576

# Memory for userspace test
# The default ivshmem memory size is 4MB (4194304), but libc uses the arena as well
CONFIG_COMMON_LIBC_MALLOC_ARENA_SIZE=8388608
```

## samples/drivers/virtualization/ivshmem/doorbell/boards/qemu_x86_64.conf
```kconfig
# The test requires dynamic memory for kernel and userspace
# This is enough memory for a 4KB ivshmem shared memory
CONFIG_HEAP_MEM_POOL_SIZE=4096
CONFIG_COMMON_LIBC_MALLOC_ARENA_SIZE=8192
```

## samples/drivers/virtualization/ivshmem/doorbell/sample.yaml
```yaml
sample:
  description: ivshmem-doorbell sample application
  name: ivshmem_doorbell_sample
tests:
  sample.virtualization.ivshmem.doorbell.arm64:
    build_only: true
    platform_allow:
      - qemu_cortex_a53
      - qemu_kvm_arm64
    tags:
      - userspace
      - ivshmem
  sample.virtualization.ivshmem.doorbell.x64:
    build_only: true
    platform_allow: qemu_x86_64
    tags:
      - userspace
      - ivshmem
```

## samples/drivers/virtualization/vhost/Kconfig
```kconfig
# Copyright (c) 2025 Omori Fuma
# SPDX-License-Identifier: Apache-2.0

config GPIO_LINE_NAME_0
        string "Set name of line 0"

config GPIO_LINE_NAME_1
        string "Set name of line 1"

config GPIO_LINE_NAME_2
        string "Set name of line 2"

config GPIO_LINE_NAME_3
        string "Set name of line 3"

config GPIO_LINE_NAME_4
        string "Set name of line 4"

config GPIO_LINE_NAME_5
        string "Set name of line 5"

config GPIO_LINE_NAME_6
        string "Set name of line 6"

config GPIO_LINE_NAME_7
        string "Set name of line 7"

config GPIO_LINE_NAME_8
        string "Set name of line 8"

config GPIO_LINE_NAME_9
        string "Set name of line 9"

config GPIO_LINE_NAME_10
        string "Set name of line 10"

config GPIO_LINE_NAME_11
        string "Set name of line 11"

config GPIO_LINE_NAME_12
        string "Set name of line 12"

config GPIO_LINE_NAME_13
        string "Set name of line 13"

config GPIO_LINE_NAME_14
        string "Set name of line 14"

config GPIO_LINE_NAME_15
        string "Set name of line 15"

config GPIO_LINE_NAME_16
        string "Set name of line 16"

config GPIO_LINE_NAME_17
        string "Set name of line 17"

config GPIO_LINE_NAME_18
        string "Set name of line 18"

config GPIO_LINE_NAME_19
        string "Set name of line 19"

config GPIO_LINE_NAME_20
        string "Set name of line 20"

config GPIO_LINE_NAME_21
        string "Set name of line 21"

config GPIO_LINE_NAME_22
        string "Set name of line 22"

config GPIO_LINE_NAME_23
        string "Set name of line 23"

config GPIO_LINE_NAME_24
        string "Set name of line 24"

config GPIO_LINE_NAME_25
        string "Set name of line 25"

config GPIO_LINE_NAME_26
        string "Set name of line 26"

config GPIO_LINE_NAME_27
        string "Set name of line 27"

config GPIO_LINE_NAME_28
        string "Set name of line 28"

config GPIO_LINE_NAME_29
        string "Set name of line 29"

config GPIO_LINE_NAME_30
        string "Set name of line 30"

config GPIO_LINE_NAME_31
        string "Set name of line 31"

source "Kconfig.zephyr"
```

## samples/drivers/virtualization/vhost/sample.yaml
```yaml
sample:
  description: VHost driver sample for VIRTIO backend implementation
  name: vhost
common:
  integration_platforms:
    - xenvm
  platform_allow: xenvm
  harness: console
  harness_config:
    type: multi_line
    regex:
      - "VHost device ready"
      - "VHost sample application started"
  timeout: 60
  depends_on: vhost
tests:
  sample.drivers.virtualization.vhost:
    tags: drivers virtualization vhost xen
    min_ram: 32
    extra_args: CONFIG_LOG_MODE_IMMEDIATE=y
```

## samples/drivers/w1/scanner/sample.yaml
```yaml
sample:
  name: 1-Wire scanner sample

common:
  harness: console
  tags:
    - w1

tests:
  sample.drivers.w1.scanner.ds2482-800:
    depends_on: arduino_i2c
    extra_args: DTC_OVERLAY_FILE=ds2482-800.overlay
    platform_allow: nrf52840dk/nrf52840
    harness_config:
      type: one_line
      regex:
        - "Number of devices found on bus: .*"
      fixture: w1_scanner_ds2482_800
  sample.drivers.w1.scanner.ds2484:
    depends_on: arduino_i2c
    extra_args: DTC_OVERLAY_FILE=ds2484.overlay
    platform_allow:
      - nrf52840dk/nrf52840
      - nucleo_g0b1re
    harness_config:
      type: one_line
      regex:
        - "Number of devices found on bus: .*"
      fixture: w1_scanner_ds2484
  sample.drivers.w1.scanner.ds2485:
    depends_on: arduino_i2c
    extra_args: DTC_OVERLAY_FILE=ds2485.overlay
    platform_allow:
      - nrf52840dk/nrf52840
      - nucleo_g0b1re
    harness_config:
      type: one_line
      regex:
        - "Number of devices found on bus: .*"
      fixture: w1_scanner_ds2485
  sample.drivers.w1.scanner.w1_serial:
    depends_on:
      - arduino_serial
    extra_args: DTC_OVERLAY_FILE=w1_serial.overlay
    platform_allow:
      - nrf52840dk/nrf52840
      - nucleo_g0b1re
    harness_config:
      type: one_line
      regex:
        - "Number of devices found on bus: .*"
      fixture: w1_scanner_w1_serial
  sample.drivers.w1.scanner.max:
    depends_on: w1
    platform_allow:
      - max32655evkit/max32655/m4
      - max32666evkit/max32666/cpu0
      - max32666fthr/max32666/cpu0
      - max32690evkit/max32690/m4
      - max78000evkit/max78000/m4
      - max78000fthr/max78000/m4
      - max78002evkit/max78002/m4
    integration_platforms:
      - max32655evkit/max32655/m4
    harness_config:
      type: one_line
      regex:
        - "Number of devices found on bus: .*"
      fixture: w1_scanner_w1_max
```

## samples/drivers/watchdog/boards/longan_nano_lite.conf
```kconfig
# Copyright (c) 2022 TOKITA Hiroshi <tokita.hiroshi@gmail.com>
# SPDX-License-Identifier: Apache-2.0

CONFIG_GD32_DBG_SUPPORT=y
```

## samples/drivers/watchdog/sample.yaml
```yaml
sample:
  name: Watchdog Driver Sample
common:
  tags:
    - drivers
    - watchdog
  harness: console
  harness_config:
    type: multi_line
    ordered: true
    regex:
      - "Watchdog sample application"
      - "Feeding watchdog..."
      - "Waiting for reset..."
      - "Watchdog sample application"
  depends_on: watchdog
tests:
  sample.drivers.watchdog:
    filter: not (CONFIG_SOC_FAMILY_STM32 or CONFIG_SOC_FAMILY_GD_GD32 or SOC_SERIES_GD32VF103)
    platform_exclude:
      - s32z2xxdc2/s32z270/rtu0
      - s32z2xxdc2/s32z270/rtu1
      - s32z2xxdc2@D/s32z270/rtu0
      - s32z2xxdc2@D/s32z270/rtu1
      - panb511evb/nrf54l15/cpuapp
      - panb511evb/nrf54l15/cpuflpr
      - panb511evb/nrf54l15/cpuflpr/xip
      - nrf54l15dk/nrf54l15/cpuapp/ns
      - nrf54l15dk/nrf54l10/cpuapp/ns
      - bl54l15_dvk/nrf54l10/cpuapp/ns
      - bl54l15_dvk/nrf54l15/cpuapp/ns
      - bl54l15u_dvk/nrf54l15/cpuapp/ns
  sample.drivers.watchdog.stm32_wwdg:
    extra_args: DTC_OVERLAY_FILE=boards/stm32_wwdg.overlay
    filter: dt_compat_enabled("st,stm32-window-watchdog")
    platform_allow:
      - b_u585i_iot02a
      - nucleo_c031c6
      - nucleo_f091rc
      - nucleo_f103rb
      - nucleo_f207zg
      - nucleo_f429zi
      - nucleo_f746zg
      - nucleo_g071rb
      - nucleo_g474re
      - nucleo_l073rz
      - nucleo_l152re
      - nucleo_wb55rg
      - nucleo_wl55jc
      - stm32f3_disco
      - stm32l562e_dk
      - disco_l475_iot1
      - stm32h573i_dk
    integration_platforms:
      - nucleo_f103rb
  sample.drivers.watchdog.stm32h7_wwdg:
    extra_args: DTC_OVERLAY_FILE=boards/stm32h7_wwdg.overlay
    filter: dt_compat_enabled("st,stm32-window-watchdog")
    # filter CONFIG_SOC_SERIES_STM32H7X and dt_compat_enabled
    # seems to ignore extra_args
    platform_allow:
      - nucleo_h723zg
      - nucleo_h745zi_q/stm32h745xx/m4
      - nucleo_h743zi
      - stm32h735g_disco
      - nucleo_h753zi
      - stm32h750b_dk
      - stm32h7b3i_dk
      - stm32h745i_disco/stm32h745xx/m4
      - nucleo_h755zi_q/stm32h755xx/m4
      - stm32h747i_disco/stm32h747xx/m4
    integration_platforms:
      - nucleo_h743zi
  sample.drivers.watchdog.stm32_iwdg:
    extra_args: DTC_OVERLAY_FILE=boards/stm32_iwdg.overlay
    filter: dt_compat_enabled("st,stm32-watchdog")
    platform_allow:
      - b_u585i_iot02a
      - nucleo_c031c6
      - nucleo_f091rc
      - nucleo_f103rb
      - nucleo_f207zg
      - nucleo_f429zi
      - nucleo_f746zg
      - nucleo_g071rb
      - nucleo_g474re
      - nucleo_h743zi
      - nucleo_l073rz
      - nucleo_l152re
      - nucleo_wb55rg
      - nucleo_wl55jc
      - stm32f3_disco
      - stm32l562e_dk
      - disco_l475_iot1
      - stm32h573i_dk
    integration_platforms:
      - nucleo_f103rb
  sample.drivers.watchdog.gd32_fwdgt:
    filter: dt_compat_enabled("gd,gd32-fwdgt")
    extra_args: DTC_OVERLAY_FILE=boards/gd32_fwdgt.overlay
    platform_allow:
      - gd32e103v_eval
      - gd32e507v_start
      - gd32f350r_eval
      - gd32f403z_eval
      - gd32f450i_eval
      - gd32f450z_eval
      - gd32f470i_eval
      - gd32vf103c_starter
      - gd32vf103v_eval
      - longan_nano
    integration_platforms:
      - gd32e103v_eval
  sample.drivers.watchdog.gd32_wwdgt:
    filter: dt_compat_enabled("gd,gd32-wwdgt")
    extra_args: DTC_OVERLAY_FILE=boards/gd32_wwdgt.overlay
    platform_allow:
      - gd32e103v_eval
      - gd32e507v_start
      - gd32f350r_eval
      - gd32f403z_eval
      - gd32f450i_eval
      - gd32f450z_eval
      - gd32f470i_eval
      - gd32vf103c_starter
      - gd32vf103v_eval
      - longan_nano
    integration_platforms:
      - gd32e103v_eval
  sample.drivers.watchdog.s32z270dc2_r52:
    build_only: true
    platform_allow:
      - s32z2xxdc2/s32z270/rtu0
      - s32z2xxdc2/s32z270/rtu1
      - s32z2xxdc2@D/s32z270/rtu0
      - s32z2xxdc2@D/s32z270/rtu1
    integration_platforms:
      - s32z2xxdc2/s32z270/rtu0
```

## samples/edf/sample.yaml
```yaml
sample:
  description: A basic Earliest Deadline First (EDF) example
  name: Earliest Deadline First (EDF) sample
common:
  tags: EDF
tests:
  sample.subsys.basic.edf:
    build_only: true
    platform_allow:
      - qemu_x86
      - qemu_riscv32
      - qemu_cortex_a53
    integration_platforms:
      - qemu_riscv32
    tags: edf
```

## samples/epoch_time/sample.yaml
```yaml
sample:
  name: epoch time sample app
  description: gettimeofday() and settimeofday() work on zephyr project
tests:
    - test:
        build_only: true
        platform_whitelist: frdm_k64f
        tags: samples tests
```

## samples/ext/nffs/sample.yaml
```yaml
sample:
  description: TBD
  name: TBD
tests:
  - test_nrf5:
      build_only: true
      extra_args: CONF_FILE="nrf5.conf"
      platform_whitelist: nrf52_pca10040 nrf52840_pca10056
      tags: NFFS
```

## samples/fuel_gauge/boards/adafruit_feather_esp32s2.conf
```kconfig
CONFIG_POWER_DOMAIN=y
CONFIG_GPIO=y
CONFIG_PM_DEVICE=y
CONFIG_PM_DEVICE_POWER_DOMAIN=y
```

## samples/fuel_gauge/max17048/sample.yaml
```yaml
sample:
  name: MAX17048 Sensor sample
tests:
  sample.sensor.max17048:
    build_only: true
    platform_allow: nrf52dk_nrf52832
    integration_platforms:
      - nrf52dk_nrf52832
    tags: fuel_gauge
```

## samples/fuel_gauge/sample.yaml
```yaml
sample:
  name: Fuel Gauge Sensor Sample
tests:
  sample.sensor.fuel_gauge:
    build_only: true
    platform_allow:
      - nrf52840dk/nrf52840
      - adafruit_feather_esp32s2@B
      - adafruit_feather_esp32s2@C
      - adafruit_feather_esp32s2_tft
      - adafruit_feather_esp32s2_tft_reverse/esp32s2
      - adafruit_feather_esp32s3/esp32s3/procpu
    integration_platforms:
      - nrf52840dk/nrf52840
      - adafruit_feather_esp32s2@B
      - adafruit_feather_esp32s2@C
      - adafruit_feather_esp32s2_tft
      - adafruit_feather_esp32s2_tft_reverse/esp32s2
      - adafruit_feather_esp32s3/esp32s3/procpu
    tags: fuel_gauge
```

## samples/gpio_basic/sample.yaml
```yaml
sample:
  description: GPIO application sample, the simplest Zephyr
    application
  name: gpio_shakti_app
common:
  tags: introduction
  integration_platforms:
    - native_posix
  harness: console
  harness_config:
    type: one_line
    regex:
      - "gpio_shakti_app! (.*)"
tests:
  sample.basic.gpioshaktiapp:
    tags: introduction
```

## samples/gpio_testcase/sample.yaml
```yaml
sample:
  description: gpio_test sample, the simplest Zephyr
    application
  name: gpio_testcase
common:
    tags: introduction
    integration_platforms:
      - native_posix
    harness: console
    harness_config:
      type: few lines
      regex:
        - "(.*)"
tests:
  sample.basic.gpio_testcase:
    tags: introduction
```

## samples/grove/lcd/sample.yaml
```yaml
sample:
  name: Grove LCD Sample
tests:
  test:
    platform_whitelist: arduino_101_sss quark_d2000_crb
      arduino_due
    tags: drivers
    harness: grove
```
