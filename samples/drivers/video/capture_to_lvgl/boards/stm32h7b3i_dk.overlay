/*
 * Copyright (c) 2024 Charles Dias <charlesdias.cd@outlook.com>
 *
 * SPDX-License-Identifier: Apache-2.0
 *
 */

/delete-node/ &sram1;
/delete-node/ &sram2;

&sram0 {
	reg = <0x24000000 DT_SIZE_K(1024)>;
};
