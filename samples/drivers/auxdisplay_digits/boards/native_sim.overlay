/*
 * Copyright (c) 2024-2025 Chen Xingyu <hi@xingrz.me>
 *
 * SPDX-License-Identifier: Apache-2.0
 */

&gpio0 {
	ngpios = <11>;
};

/ {
	auxdisplay_0: auxdisplay {
		compatible = "gpio-7-segment";
		status = "okay";
		columns = <3>;
		rows = <1>;
		segment-gpios = <&gpio0 0 0>,  /* A */
				<&gpio0 1 0>,  /* B */
				<&gpio0 2 0>,  /* C */
				<&gpio0 3 0>,  /* D */
				<&gpio0 4 0>,  /* E */
				<&gpio0 5 0>,  /* F */
				<&gpio0 6 0>,  /* G */
				<&gpio0 7 0>;  /* DP */
		digit-gpios = <&gpio0 8 0>,  /* DIG1 */
			      <&gpio0 9 0>,  /* DIG2 */
			      <&gpio0 10 0>;  /* DIG3 */
		refresh-period-ms = <1>;
	};
};
