/*
 * Copyright (c) 2025 Philipp Steiner
 *
 * SPDX-License-Identifier: Apache-2.0
 */

/ {
	aliases {
		fuel-gauge0 = &max17048;
	};
};

&i2c0 {
	max17048: max17048@36 {
		compatible = "maxim,max17048";
		status = "okay";
		reg = <0x36>;
		power-domains = <&i2c_reg>;
	};
};
