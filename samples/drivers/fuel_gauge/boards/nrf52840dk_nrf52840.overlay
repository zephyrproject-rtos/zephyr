/*
 * Copyright (c) 2023 Alvaro Garcia Gomez <maxpowel@gmail.com>
 *
 * SPDX-License-Identifier: Apache-2.0
 */

/ {
	aliases {
		fuel-gauge0 = &max17048;
	};
};

&i2c0 {
	compatible = "nordic,nrf-twim";
	pinctrl-0 = <&i2c0_default>;
	pinctrl-1 = <&i2c0_sleep>;
	pinctrl-names = "default", "sleep";
	status = "okay";

	max17048: max17048@36 {
		compatible = "maxim,max17048";
		reg = <0x36>;
		status = "okay";
	};
};
