## samples/drivers/led_max7219/sample.yaml
```yaml
sample:
  description: Demonstration of the MAX7219 LED driver
  name: MAX7219 sample
tests:
  sample.drivers.led.max7219:
    platform_allow: stm32_min_dev_black
    filter: dt_compat_enabled("maxim,max7219")
    tags: LED
```

## samples/drivers/led_max7219/testcase.yaml
```yaml
sample:
  name: led_max7219
  description: Simple driver for max7219 led display.
tests:
  sample.driver.led_max7219:
    platform_whitelist: nrf51_pca10028 nrf52_pca10040 nrf52840_pca10056
    tags: LED SPI
    harness: console
    harness_config:
      type: one_line
      regex:
        - "Animation test complete."
```

## samples/drivers/led_pca9633/sample.yaml
```yaml
sample:
  description: Demonstration of the PCA9633 LED driver
  name: PCA9633 sample
tests:
  sample.drivers.led.pca9633:
    platform_allow: stm32373c_eval
    tags: LED
```

## samples/drivers/led_pca_common/sample.yaml
```yaml
sample:
  description: Demonstration of the PCA_COMMON driver
  name: PCA_COMMON sample
tests:
  sample.drivers.led.pca_common:
    depends_on: arduino_i2c
    build_only: true
    tags: LED
```

## samples/drivers/led_pwm/sample.yaml
```yaml
sample:
  description: Demonstration of the PWM LED driver
  name: PWM LED sample
tests:
  sample.drivers.led.led_pwm:
    filter: dt_compat_enabled("pwm-leds")
    tags: LED
    depends_on: pwm
    platform_exclude: reel_board
    timeout: 20
    harness: console
    harness_config:
      type: multi_line
      ordered: true
      regex:
        - "Found device \\S+"
        - "Testing LED \\d+"
        - "Turned on"
        - "Turned off"
        - "Increasing brightness gradually"
        - "Blinking on: 0.1 sec, off: 0.1 sec"
        - "(Blinking on: 1 sec, off: 1 sec|Cycle period not supported)"
        - "Turned off, loop end"
```

## samples/drivers/led_rgb/sample.yaml
```yaml
sample:
  description: Demonstration of the RGB LED driver
  name: RGB LED sample
tests:
  sample.drivers.led.led_rgb:
    filter: dt_compat_enabled("rgb-leds")
    tags: LED
    depends_on: led
```

## samples/drivers/led_strip/Kconfig
```kconfig
# Copyright (c) 2019 Nordic Semiconductor ASA
# SPDX-License-Identifier: Apache-2.0

menu "WS2812 Sample Configuration"

config SAMPLE_LED_UPDATE_DELAY
	int "Delay between LED updates in ms"
	default 50
	help
	  Delay between LED updates in ms.

endmenu

source "Kconfig.zephyr"
```

## samples/drivers/led_strip/boards/nrf52dk_nrf52832.conf
```kconfig
# This driver only uses spi_write() with the SPIM instance it allocates,
# so PAN 58 doesn't matter, because the RX length is always 0.
CONFIG_SOC_NRF52832_ALLOW_SPIM_DESPITE_PAN_58=y
```

## samples/drivers/led_strip/sample.yaml
```yaml
sample:
  description: Demonstration of the LED strip driver
  name: LED strip sample
tests:
  sample.drivers.led_strip:
    tags: LED
    filter: dt_alias_exists("led-strip")
    harness_config:
      fixture: fixture_led_strip
    integration_platforms:
      - mimxrt1050_evk
```

## samples/drivers/led_tlc59731/sample.yaml
```yaml
sample:
  description: Demonstration of the TLC59731 RGB LED driver
  name: TLC59731 sample
tests:
  sample.drivers.led.tlc59731:
    tags: LED
    filter: dt_compat_enabled("ti,tlc59731")
    harness_config:
      fixture: fixture_led_tlc59731
    integration_platforms:
      - stm32wb5mm_dk
```

## samples/drivers/led_ws2812/Kconfig
```kconfig
# Copyright (c) 2019 Nordic Semiconductor ASA
# SPDX-License-Identifier: Apache-2.0

# Use the SPI driver by default, unless the GPIO driver is
# specifically configured in.
config SPI
	default y

menu "WS2812 Sample Configuration"

config SAMPLE_LED_UPDATE_DELAY
	int "Delay between LED updates in ms"
	default 50
	help
	  Delay between LED updates in ms.

endmenu

source "Kconfig.zephyr"
```

## samples/drivers/led_ws2812/boards/96b_carbon.conf
```kconfig
CONFIG_POLL=y
CONFIG_SPI=y

CONFIG_SPI_STM32=y
CONFIG_SPI_STM32_INTERRUPT=y
CONFIG_SPI_2=y

CONFIG_WS2812_STRIP=y
```
