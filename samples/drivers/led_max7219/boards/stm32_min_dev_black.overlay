&spi1 {
	status = "okay";
	cs-gpios = <&gpioa 4 GPIO_ACTIVE_LOW>;

	max7219: max7219@0 {
		compatible = "maxim,max7219";
		status = "okay";
		label = "MAX7219";
		reg = <0>;
		spi-max-frequency = <1000000>;
		num-cascading = <1>;
		intensity = <0>;
		scan-limit = <7>;
	};
};
