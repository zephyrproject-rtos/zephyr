/*
 * Copyright (c) 2019 Peter Bigot Consulting, LLC
 *
 * SPDX-License-Identifier: Apache-2.0
 */

&i2c0 { /* SDA 0, SCL 1 */
	ds3231@68 {
		compatible = "maxim,ds3231";
		reg = <0x68>;
		label = "DS3231";
		isw-gpios = <&gpio1 1 0>;
		32k-gpios = <&gpio1 2 0>;
	};
};
