/*
 * SPDX-License-Identifier: Apache-2.0
 * Copyright (c) 2026 Siratul Islam
 */

/ {
	aliases {
		biometrics = &biometrics_emul;
	};

	biometrics_emul: biometrics-emul {
		compatible = "zephyr,biometrics-emul";
		status = "okay";
	};
};
