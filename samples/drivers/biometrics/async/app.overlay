/*
 * SPDX-License-Identifier: Apache-2.0
 * Copyright (c) 2026 Siratul Islam <siratul.islam@linux.dev>
 */

/ {
	aliases {
		biometrics = &ai10;
	};
};

&uart1 {
	status = "okay";
	current-speed = <115200>;
	pinctrl-0 = <&uart1_default>;
	pinctrl-names = "default";

	ai10: biometrics {
		compatible = "hilink,ai10";
	};
};
