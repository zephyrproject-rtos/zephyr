## prj.conf
```kconfig
CONFIG_GPIO=y
CONFIG_FLASH=y
```

## src/main.c
```c
/*
 * Copyright (c) 2016 Intel Corporation
 *
 * SPDX-License-Identifier: Apache-2.0
 */

#include <stdio.h>
#include <string.h>
#include <zephyr/kernel.h>
#include <zephyr/device.h>
#include<zephyr/devicetree.h>
#include <zephyr/drivers/gpio.h>
#include <zephyr/drivers/flash.h>

/* 1000 msec = 1 sec */
#define SLEEP_TIME_MS   1000

/* The devicetree node identifier for the "led0" alias. */
#define LED0_NODE DT_ALIAS(led0)

#define MAIN_BASE_ADDRESS 0x00020000

#define FLASH_0_NODE DT_NODELABEL(flashctl)

/*
 * A build error on this line means your board is unsupported.
 * See the sample documentation for information on how to fix this.
 */
static const struct gpio_dt_spec led = GPIO_DT_SPEC_GET(LED0_NODE, gpios);
const struct device *const dev = DEVICE_DT_GET(FLASH_0_NODE);
uint8_t read_data[2048] = {0};
unsigned char write_data[] = {
  0x2e, 0x2e, 0x20, 0x72, 0x61, 0x77, 0x3a, 0x3a, 0x20, 0x68, 0x74, 0x6d,
  0x6c, 0x0a, 0x0a, 0x20, 0x20, 0x20, 0x3c, 0x61, 0x20, 0x68, 0x72, 0x65,
  0x66, 0x3d, 0x22, 0x68, 0x74, 0x74, 0x70, 0x73, 0x3a, 0x2f, 0x2f, 0x77,
  0x77, 0x77, 0x2e, 0x7a, 0x65, 0x70, 0x68, 0x79, 0x72, 0x70, 0x72, 0x6f,
  0x6a, 0x65, 0x63, 0x74, 0x2e, 0x6f, 0x72, 0x67, 0x22, 0x3e, 0x0a, 0x20,
  0x20, 0x20, 0x20, 0x20, 0x3c, 0x70, 0x20, 0x61, 0x6c, 0x69, 0x67, 0x6e,
  0x3d, 0x22, 0x63, 0x65, 0x6e, 0x74, 0x65, 0x72, 0x22, 0x3e, 0x0a, 0x20,
  0x20, 0x20, 0x20, 0x20, 0x20, 0x20, 0x3c, 0x70, 0x69, 0x63, 0x74, 0x75,
  0x72, 0x65, 0x3e, 0x0a, 0x20, 0x20, 0x20, 0x20, 0x20, 0x20, 0x20, 0x20,
  0x20, 0x3c, 0x73, 0x6f, 0x75, 0x72, 0x63, 0x65, 0x20, 0x6d, 0x65, 0x64,
  0x69, 0x61, 0x3d, 0x22, 0x28, 0x70, 0x72, 0x65, 0x66, 0x65, 0x72, 0x73,
  0x2d, 0x63, 0x6f, 0x6c, 0x6f, 0x72, 0x2d, 0x73, 0x63, 0x68, 0x65, 0x6d,
  0x65, 0x3a, 0x20, 0x64, 0x61, 0x72, 0x6b, 0x29, 0x22, 0x20, 0x73, 0x72,
  0x63, 0x73, 0x65, 0x74, 0x3d, 0x22, 0x64, 0x6f, 0x63, 0x2f, 0x5f, 0x73,
  0x74, 0x61, 0x74, 0x69, 0x63, 0x2f, 0x69, 0x6d, 0x61, 0x67, 0x65, 0x73,
  0x2f, 0x6c, 0x6f, 0x67, 0x6f, 0x2d, 0x72, 0x65, 0x61, 0x64, 0x6d, 0x65,
  0x2d, 0x64, 0x61, 0x72, 0x6b, 0x2e, 0x73, 0x76, 0x67, 0x22, 0x3e, 0x0a,
  0x20, 0x20, 0x20, 0x20, 0x20, 0x20, 0x20, 0x20, 0x20, 0x3c, 0x73, 0x6f,
  0x75, 0x72, 0x63, 0x65, 0x20, 0x6d, 0x65, 0x64, 0x69, 0x61, 0x3d, 0x22,
  0x28, 0x70, 0x72, 0x65, 0x66, 0x65, 0x72, 0x73, 0x2d, 0x63, 0x6f, 0x6c,
  0x6f, 0x72, 0x2d, 0x73, 0x63, 0x68, 0x65, 0x6d, 0x65, 0x3a, 0x20, 0x6c,
  0x69, 0x67, 0x68, 0x74, 0x29, 0x22, 0x20, 0x73, 0x72, 0x63, 0x73, 0x65,
  0x74, 0x3d, 0x22, 0x64, 0x6f, 0x63, 0x2f, 0x5f, 0x73, 0x74, 0x61, 0x74,
  0x69, 0x63, 0x2f, 0x69, 0x6d, 0x61, 0x67, 0x65, 0x73, 0x2f, 0x6c, 0x6f,
  0x67, 0x6f, 0x2d, 0x72, 0x65, 0x61, 0x64, 0x6d, 0x65, 0x2d, 0x6c, 0x69,
  0x67, 0x68, 0x74, 0x2e, 0x73, 0x76, 0x67, 0x22, 0x3e, 0x0a, 0x20, 0x20,
  0x20, 0x20, 0x20, 0x20, 0x20, 0x20, 0x20, 0x3c, 0x69, 0x6d, 0x67, 0x20,
  0x73, 0x72, 0x63, 0x3d, 0x22, 0x64, 0x6f, 0x63, 0x2f, 0x5f, 0x73, 0x74,
  0x61, 0x74, 0x69, 0x63, 0x2f, 0x69, 0x6d, 0x61, 0x67, 0x65, 0x73, 0x2f,
  0x6c, 0x6f, 0x67, 0x6f, 0x2d, 0x72, 0x65, 0x61, 0x64, 0x6d, 0x65, 0x2d,
  0x6c, 0x69, 0x67, 0x68, 0x74, 0x2e, 0x73, 0x76, 0x67, 0x22, 0x3e, 0x0a,
  0x20, 0x20, 0x20, 0x20, 0x20, 0x20, 0x20, 0x3c, 0x2f, 0x70, 0x69, 0x63,
  0x74, 0x75, 0x72, 0x65, 0x3e, 0x0a, 0x20, 0x20, 0x20, 0x20, 0x20, 0x3c,
  0x2f, 0x70, 0x3e, 0x0a, 0x20, 0x20, 0x20, 0x3c, 0x2f, 0x61, 0x3e, 0x0a,
  0x0a, 0x20, 0x20, 0x20, 0x3c, 0x61, 0x20, 0x68, 0x72, 0x65, 0x66, 0x3d,
  0x22, 0x68, 0x74, 0x74, 0x70, 0x73, 0x3a, 0x2f, 0x2f, 0x62, 0x65, 0x73,
  0x74, 0x70, 0x72, 0x61, 0x63, 0x74, 0x69, 0x63, 0x65, 0x73, 0x2e, 0x63,
  0x6f, 0x72, 0x65, 0x69, 0x6e, 0x66, 0x72, 0x61, 0x73, 0x74, 0x72, 0x75,
  0x63, 0x74, 0x75, 0x72, 0x65, 0x2e, 0x6f, 0x72, 0x67, 0x2f, 0x70, 0x72,
  0x6f, 0x6a, 0x65, 0x63, 0x74, 0x73, 0x2f, 0x37, 0x34, 0x22, 0x3e, 0x3c,
  0x69, 0x6d, 0x67, 0x20, 0x73, 0x72, 0x63, 0x3d, 0x22, 0x68, 0x74, 0x74,
  0x70, 0x73, 0x3a, 0x2f, 0x2f, 0x62, 0x65, 0x73, 0x74, 0x70, 0x72, 0x61,
  0x63, 0x74, 0x69, 0x63, 0x65, 0x73, 0x2e, 0x63, 0x6f, 0x72, 0x65, 0x69,
  0x6e, 0x66, 0x72, 0x61, 0x73, 0x74, 0x72, 0x75, 0x63, 0x74, 0x75, 0x72,
  0x65, 0x2e, 0x6f, 0x72, 0x67, 0x2f, 0x70, 0x72, 0x6f, 0x6a, 0x65, 0x63,
  0x74, 0x73, 0x2f, 0x37, 0x34, 0x2f, 0x62, 0x61, 0x64, 0x67, 0x65, 0x22,
  0x3e, 0x3c, 0x2f, 0x61, 0x3e, 0x0a, 0x20, 0x20, 0x20, 0x3c, 0x61, 0x20,
  0x68, 0x72, 0x65, 0x66, 0x3d, 0x22, 0x68, 0x74, 0x74, 0x70, 0x73, 0x3a,
  0x2f, 0x2f, 0x73, 0x63, 0x6f, 0x72, 0x65, 0x63, 0x61, 0x72, 0x64, 0x2e,
  0x64, 0x65, 0x76, 0x2f, 0x76, 0x69, 0x65, 0x77, 0x65, 0x72, 0x2f, 0x3f,
  0x75, 0x72, 0x69, 0x3d, 0x67, 0x69, 0x74, 0x68, 0x75, 0x62, 0x2e, 0x63,
  0x6f, 0x6d, 0x2f, 0x7a, 0x65, 0x70, 0x68, 0x79, 0x72, 0x70, 0x72, 0x6f,
  0x6a, 0x65, 0x63, 0x74, 0x2d, 0x72, 0x74, 0x6f, 0x73, 0x2f, 0x7a, 0x65,
  0x70, 0x68, 0x79, 0x72, 0x22, 0x3e, 0x3c, 0x69, 0x6d, 0x67, 0x20, 0x73,
  0x72, 0x63, 0x3d, 0x22, 0x68, 0x74, 0x74, 0x70, 0x73, 0x3a, 0x2f, 0x2f,
  0x61, 0x70, 0x69, 0x2e, 0x73, 0x65, 0x63, 0x75, 0x72, 0x69, 0x74, 0x79,
  0x73, 0x63, 0x6f, 0x72, 0x65, 0x63, 0x61, 0x72, 0x64, 0x73, 0x2e, 0x64,
  0x65, 0x76, 0x2f, 0x70, 0x72, 0x6f, 0x6a, 0x65, 0x63, 0x74, 0x73, 0x2f,
  0x67, 0x69, 0x74, 0x68, 0x75, 0x62, 0x2e, 0x63, 0x6f, 0x6d, 0x2f, 0x7a,
  0x65, 0x70, 0x68, 0x79, 0x72, 0x70, 0x72, 0x6f, 0x6a, 0x65, 0x63, 0x74,
  0x2d, 0x72, 0x74, 0x6f, 0x73, 0x2f, 0x7a, 0x65, 0x70, 0x68, 0x79, 0x72,
  0x2f, 0x62, 0x61, 0x64, 0x67, 0x65, 0x22, 0x3e, 0x3c, 0x2f, 0x61, 0x3e,
  0x0a, 0x20, 0x20, 0x20, 0x3c, 0x61, 0x20, 0x68, 0x72, 0x65, 0x66, 0x3d,
  0x22, 0x68, 0x74, 0x74, 0x70, 0x73, 0x3a, 0x2f, 0x2f, 0x67, 0x69, 0x74,
  0x68, 0x75, 0x62, 0x2e, 0x63, 0x6f, 0x6d, 0x2f, 0x7a, 0x65, 0x70, 0x68,
  0x79, 0x72, 0x70, 0x72, 0x6f, 0x6a, 0x65, 0x63, 0x74, 0x2d, 0x72, 0x74,
  0x6f, 0x73, 0x2f, 0x7a, 0x65, 0x70, 0x68, 0x79, 0x72, 0x2f, 0x61, 0x63,
  0x74, 0x69, 0x6f, 0x6e, 0x73, 0x2f, 0x77, 0x6f, 0x72, 0x6b, 0x66, 0x6c,
  0x6f, 0x77, 0x73, 0x2f, 0x74, 0x77, 0x69, 0x73, 0x74, 0x65, 0x72, 0x2e,
  0x79, 0x61, 0x6d, 0x6c, 0x3f, 0x71, 0x75, 0x65, 0x72, 0x79, 0x3d, 0x62,
  0x72, 0x61, 0x6e, 0x63, 0x68, 0x25, 0x33, 0x41, 0x6d, 0x61, 0x69, 0x6e,
  0x22, 0x3e, 0x3c, 0x69, 0x6d, 0x67, 0x20, 0x73, 0x72, 0x63, 0x3d, 0x22,
  0x68, 0x74, 0x74, 0x70, 0x73, 0x3a, 0x2f, 0x2f, 0x67, 0x69, 0x74, 0x68,
  0x75, 0x62, 0x2e, 0x63, 0x6f, 0x6d, 0x2f, 0x7a, 0x65, 0x70, 0x68, 0x79,
  0x72, 0x70, 0x72, 0x6f, 0x6a, 0x65, 0x63, 0x74, 0x2d, 0x72, 0x74, 0x6f,
  0x73, 0x2f, 0x7a, 0x65, 0x70, 0x68, 0x79, 0x72, 0x2f, 0x61, 0x63, 0x74,
  0x69, 0x6f, 0x6e, 0x73, 0x2f, 0x77, 0x6f, 0x72, 0x6b, 0x66, 0x6c, 0x6f,
  0x77, 0x73, 0x2f, 0x74, 0x77, 0x69, 0x73, 0x74, 0x65, 0x72, 0x2e, 0x79,
  0x61, 0x6d, 0x6c, 0x2f, 0x62, 0x61, 0x64, 0x67, 0x65, 0x2e, 0x73, 0x76,
  0x67, 0x3f, 0x65, 0x76, 0x65, 0x6e, 0x74, 0x3d, 0x70, 0x75, 0x73, 0x68,
  0x22, 0x3e, 0x3c, 0x2f, 0x61, 0x3e, 0x0a, 0x0a, 0x0a, 0x54, 0x68, 0x65,
  0x20, 0x5a, 0x65, 0x70, 0x68, 0x79, 0x72, 0x20, 0x50, 0x72, 0x6f, 0x6a,
  0x65, 0x63, 0x74, 0x20, 0x69, 0x73, 0x20, 0x61, 0x20, 0x73, 0x63, 0x61,
  0x6c, 0x61, 0x62, 0x6c, 0x65, 0x20, 0x72, 0x65, 0x61, 0x6c, 0x2d, 0x74,
  0x69, 0x6d, 0x65, 0x20, 0x6f, 0x70, 0x65, 0x72, 0x61, 0x74, 0x69, 0x6e,
  0x67, 0x20, 0x73, 0x79, 0x73, 0x74, 0x65, 0x6d, 0x20, 0x28, 0x52, 0x54,
  0x4f, 0x53, 0x29, 0x20, 0x73, 0x75, 0x70, 0x70, 0x6f, 0x72, 0x74, 0x69,
  0x6e, 0x67, 0x0a, 0x6d, 0x75, 0x6c, 0x74, 0x69, 0x70, 0x6c, 0x65, 0x20,
  0x68, 0x61, 0x72, 0x64, 0x77, 0x61, 0x72, 0x65, 0x20, 0x61, 0x72, 0x63,
  0x68, 0x69, 0x74, 0x65, 0x63, 0x74, 0x75, 0x72, 0x65, 0x73, 0x2c, 0x20,
  0x6f, 0x70, 0x74, 0x69, 0x6d, 0x69, 0x7a, 0x65, 0x64, 0x20, 0x66, 0x6f,
  0x72, 0x20, 0x72, 0x65, 0x73, 0x6f, 0x75, 0x72, 0x63, 0x65, 0x20, 0x63,
  0x6f, 0x6e, 0x73, 0x74, 0x72, 0x61, 0x69, 0x6e, 0x65, 0x64, 0x20, 0x64,
  0x65, 0x76, 0x69, 0x63, 0x65, 0x73, 0x2c, 0x0a, 0x61, 0x6e, 0x64, 0x20,
  0x62, 0x75, 0x69, 0x6c, 0x74, 0x20, 0x77, 0x69, 0x74, 0x68, 0x20, 0x73,
  0x65, 0x63, 0x75, 0x72, 0x69, 0x74, 0x79, 0x20, 0x69, 0x6e, 0x20, 0x6d,
  0x69, 0x6e, 0x64, 0x2e, 0x0a, 0x0a, 0x54, 0x68, 0x65, 0x20, 0x5a, 0x65,
  0x70, 0x68, 0x79, 0x72, 0x20, 0x4f, 0x53, 0x20, 0x69, 0x73, 0x20, 0x62,
  0x61, 0x73, 0x65, 0x64, 0x20, 0x6f, 0x6e, 0x20, 0x61, 0x20, 0x73, 0x6d,
  0x61, 0x6c, 0x6c, 0x2d, 0x66, 0x6f, 0x6f, 0x74, 0x70, 0x72, 0x69, 0x6e,
  0x74, 0x20, 0x6b, 0x65, 0x72, 0x6e, 0x65, 0x6c, 0x20, 0x64, 0x65, 0x73,
  0x69, 0x67, 0x6e, 0x65, 0x64, 0x20, 0x66, 0x6f, 0x72, 0x20, 0x75, 0x73,
  0x65, 0x20, 0x6f, 0x6e, 0x0a, 0x72, 0x65, 0x73, 0x6f, 0x75, 0x72, 0x63,
  0x65, 0x2d, 0x63, 0x6f, 0x6e, 0x73, 0x74, 0x72, 0x61, 0x69, 0x6e, 0x65,
  0x64, 0x20, 0x73, 0x79, 0x73, 0x74, 0x65, 0x6d, 0x73, 0x3a, 0x20, 0x66,
  0x72, 0x6f, 0x6d, 0x20, 0x73, 0x69, 0x6d, 0x70, 0x6c, 0x65, 0x20, 0x65,
  0x6d, 0x62, 0x65, 0x64, 0x64, 0x65, 0x64, 0x20, 0x65, 0x6e, 0x76, 0x69,
  0x72, 0x6f, 0x6e, 0x6d, 0x65, 0x6e, 0x74, 0x61, 0x6c, 0x20, 0x73, 0x65,
  0x6e, 0x73, 0x6f, 0x72, 0x73, 0x20, 0x61, 0x6e, 0x64, 0x0a, 0x4c, 0x45,
  0x44, 0x20, 0x77, 0x65, 0x61, 0x72, 0x61, 0x62, 0x6c, 0x65, 0x73, 0x20,
  0x74, 0x6f, 0x20, 0x73, 0x6f, 0x70, 0x68, 0x69, 0x73, 0x74, 0x69, 0x63,
  0x61, 0x74, 0x65, 0x64, 0x20, 0x73, 0x6d, 0x61, 0x72, 0x74, 0x20, 0x77,
  0x61, 0x74, 0x63, 0x68, 0x65, 0x73, 0x20, 0x61, 0x6e, 0x64, 0x20, 0x49,
  0x6f, 0x54, 0x20, 0x77, 0x69, 0x72, 0x65, 0x6c, 0x65, 0x73, 0x73, 0x20,
  0x67, 0x61, 0x74, 0x65, 0x77, 0x61, 0x79, 0x73, 0x2e, 0x0a, 0x0a, 0x54,
  0x68, 0x65, 0x20, 0x5a, 0x65, 0x70, 0x68, 0x79, 0x72, 0x20, 0x6b, 0x65,
  0x72, 0x6e, 0x65, 0x6c, 0x20, 0x73, 0x75, 0x70, 0x70, 0x6f, 0x72, 0x74,
  0x73, 0x20, 0x6d, 0x75, 0x6c, 0x74, 0x69, 0x70, 0x6c, 0x65, 0x20, 0x61,
  0x72, 0x63, 0x68, 0x69, 0x74, 0x65, 0x63, 0x74, 0x75, 0x72, 0x65, 0x73,
  0x2c, 0x20, 0x69, 0x6e, 0x63, 0x6c, 0x75, 0x64, 0x69, 0x6e, 0x67, 0x20,
  0x41, 0x52, 0x4d, 0x20, 0x28, 0x43, 0x6f, 0x72, 0x74, 0x65, 0x78, 0x2d,
  0x41, 0x2c, 0x0a, 0x43, 0x6f, 0x72, 0x74, 0x65, 0x78, 0x2d, 0x52, 0x2c,
  0x20, 0x43, 0x6f, 0x72, 0x74, 0x65, 0x78, 0x2d, 0x4d, 0x29, 0x2c, 0x20,
  0x49, 0x6e, 0x74, 0x65, 0x6c, 0x20, 0x78, 0x38, 0x36, 0x2c, 0x20, 0x41,
  0x52, 0x43, 0x2c, 0x20, 0x4e, 0x69, 0x6f, 0x73, 0x20, 0x49, 0x49, 0x2c,
  0x20, 0x54, 0x65, 0x6e, 0x73, 0x69, 0x6c, 0x69, 0x63, 0x61, 0x20, 0x58,
  0x74, 0x65, 0x6e, 0x73, 0x61, 0x2c, 0x20, 0x61, 0x6e, 0x64, 0x20, 0x52,
  0x49, 0x53, 0x43, 0x2d, 0x56, 0x2c, 0x0a, 0x53, 0x50, 0x41, 0x52, 0x43,
  0x2c, 0x20, 0x4d, 0x49, 0x50, 0x53, 0x2c, 0x20, 0x61, 0x6e, 0x64, 0x20,
  0x61, 0x20, 0x6c, 0x61, 0x72, 0x67, 0x65, 0x20, 0x6e, 0x75, 0x6d, 0x62,
  0x65, 0x72, 0x20, 0x6f, 0x66, 0x20, 0x60, 0x73, 0x75, 0x70, 0x70, 0x6f,
  0x72, 0x74, 0x65, 0x64, 0x20, 0x62, 0x6f, 0x61, 0x72, 0x64, 0x73, 0x60,
  0x5f, 0x2e, 0x0a, 0x0a, 0x2e, 0x2e, 0x20, 0x62, 0x65, 0x6c, 0x6f, 0x77,
  0x20, 0x69, 0x6e, 0x63, 0x6c, 0x75, 0x64, 0x65, 0x64, 0x20, 0x69, 0x6e,
  0x20, 0x64, 0x6f, 0x63, 0x2f, 0x69, 0x6e, 0x74, 0x72, 0x6f, 0x64, 0x75,
  0x63, 0x74, 0x69, 0x6f, 0x6e, 0x2f, 0x69, 0x6e, 0x74, 0x72, 0x6f, 0x64,
  0x75, 0x63, 0x74, 0x69, 0x6f, 0x6e, 0x2e, 0x72, 0x73, 0x74, 0x0a, 0x0a,
  0x0a, 0x47, 0x65, 0x74, 0x74, 0x69, 0x6e, 0x67, 0x20, 0x53, 0x74, 0x61,
  0x72, 0x74, 0x65, 0x64, 0x0a, 0x2a, 0x2a, 0x2a, 0x2a, 0x2a, 0x2a, 0x2a,
  0x2a, 0x2a, 0x2a, 0x2a, 0x2a, 0x2a, 0x2a, 0x2a, 0x0a, 0x0a, 0x57, 0x65,
  0x6c, 0x63, 0x6f, 0x6d, 0x65, 0x20, 0x74, 0x6f, 0x20, 0x5a, 0x65, 0x70,
  0x68, 0x79, 0x72, 0x21, 0x20, 0x53, 0x65, 0x65, 0x20, 0x74, 0x68, 0x65,
  0x20, 0x60, 0x49, 0x6e, 0x74, 0x72, 0x6f, 0x64, 0x75, 0x63, 0x74, 0x69,
  0x6f, 0x6e, 0x20, 0x74, 0x6f, 0x20, 0x5a, 0x65, 0x70, 0x68, 0x79, 0x72,
  0x60, 0x5f, 0x20, 0x66, 0x6f, 0x72, 0x20, 0x61, 0x20, 0x68, 0x69, 0x67,
  0x68, 0x2d, 0x6c, 0x65, 0x76, 0x65, 0x6c, 0x20, 0x6f, 0x76, 0x65, 0x72,
  0x76, 0x69, 0x65, 0x77, 0x2c, 0x0a, 0x61, 0x6e, 0x64, 0x20, 0x74, 0x68,
  0x65, 0x20, 0x64, 0x6f, 0x63, 0x75, 0x6d, 0x65, 0x6e, 0x74, 0x61, 0x74,
  0x69, 0x6f, 0x6e, 0x27, 0x73, 0x20, 0x60, 0x47, 0x65, 0x74, 0x74, 0x69,
  0x6e, 0x67, 0x20, 0x53, 0x74, 0x61, 0x72, 0x74, 0x65, 0x64, 0x20, 0x47,
  0x75, 0x69, 0x64, 0x65, 0x60, 0x5f, 0x20, 0x74, 0x6f, 0x20, 0x73, 0x74,
  0x61, 0x72, 0x74, 0x20, 0x64, 0x65, 0x76, 0x65, 0x6c, 0x6f, 0x70, 0x69,
  0x6e, 0x67, 0x2e, 0x0a, 0x0a, 0x2e, 0x2e, 0x20, 0x73, 0x74, 0x61, 0x72,
  0x74, 0x5f, 0x69, 0x6e, 0x63, 0x6c, 0x75, 0x64, 0x65, 0x5f, 0x68, 0x65,
  0x72, 0x65, 0x0a, 0x0a, 0x43, 0x6f, 0x6d, 0x6d, 0x75, 0x6e, 0x69, 0x74,
  0x79, 0x20, 0x53, 0x75, 0x70, 0x70, 0x6f, 0x72, 0x74, 0x0a, 0x2a, 0x2a,
  0x2a, 0x2a, 0x2a, 0x2a, 0x2a, 0x2a, 0x2a, 0x2a, 0x2a, 0x2a, 0x2a, 0x2a,
  0x2a, 0x2a, 0x2a, 0x0a, 0x0a, 0x43, 0x6f, 0x6d, 0x6d, 0x75, 0x6e, 0x69,
  0x74, 0x79, 0x20, 0x73, 0x75, 0x70, 0x70, 0x6f, 0x72, 0x74, 0x20, 0x69,
  0x73, 0x20, 0x70, 0x72, 0x6f, 0x76, 0x69, 0x64, 0x65, 0x64, 0x20, 0x76,
  0x69, 0x61, 0x20, 0x6d, 0x61, 0x69, 0x6c, 0x69, 0x6e, 0x67, 0x20, 0x6c,
  0x69, 0x73, 0x74, 0x73, 0x20, 0x61, 0x6e, 0x64, 0x20, 0x44, 0x69, 0x73,
  0x63, 0x6f, 0x72, 0x64, 0x3b, 0x20, 0x73, 0x65, 0x65, 0x20, 0x74, 0x68,
  0x65, 0x20, 0x52, 0x65, 0x73, 0x6f, 0x75, 0x72, 0x63, 0x65, 0x73, 0x0a,
  0x62, 0x65, 0x6c, 0x6f, 0x77, 0x20, 0x66, 0x6f, 0x72, 0x20, 0x64, 0x65,
  0x74, 0x61, 0x69, 0x6c, 0x73, 0x2e, 0x0a, 0x0a, 0x2e, 0x2e, 0x20, 0x5f,
  0x70, 0x72, 0x6f, 0x6a, 0x65, 0x63, 0x74, 0x2d, 0x72, 0x65, 0x73, 0x6f,
  0x75, 0x72, 0x63, 0x65, 0x73, 0x3a, 0x0a, 0x0a, 0x52, 0x65, 0x73, 0x6f,
  0x75, 0x72, 0x63, 0x65, 0x73, 0x0a, 0x2a, 0x2a, 0x2a, 0x2a, 0x2a, 0x2a,
  0x2a, 0x2a, 0x2a, 0x0a, 0x0a, 0x48, 0x65, 0x72, 0x65, 0x27, 0x73, 0x20,
  0x61, 0x20, 0x71, 0x75, 0x69, 0x63, 0x6b, 0x20
};

int main(void)
{
	int ret;
	bool led_state = true;

	if (!gpio_is_ready_dt(&led)) {
		return 0;
	}

	ret = gpio_pin_configure_dt(&led, GPIO_OUTPUT_ACTIVE);
	if (ret < 0) {
		return 0;
	}

	ret = flash_erase(dev, MAIN_BASE_ADDRESS, 2048);
	if (ret < 0) {
		printk("Failed to erase flash %d\n", ret);
		return ret;
	}

	ret = flash_write(dev, MAIN_BASE_ADDRESS, &write_data[0], strlen(write_data));
	if (ret < 0) {
		printk("Failed to write flash %d\n", ret);
		return ret;
	}

	ret = flash_read(dev, MAIN_BASE_ADDRESS, &read_data[0], sizeof(read_data));
	if (ret < 0) {
		printk("Failed to read data from flash %d\n", ret);
		return ret;
	}

	printk("Read data = %s\n", read_data);

	while (1) {
		ret = gpio_pin_toggle_dt(&led);
		if (ret < 0) {
			return 0;
		}

		led_state = !led_state;
		printf("LED state: %s\n", led_state ? "ON" : "OFF");
		k_msleep(SLEEP_TIME_MS);
	}
	return 0;
}

unsigned int README_rst_len = 2048;
```
