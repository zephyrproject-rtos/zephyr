/* SPDX-License-Identifier: Apache-2.0 */

/* I2C bus pins are exposed on the ST morpho and Arduino headers.
 *
 *  Bus        SDA                    SCL
 *          Pin   Hdr              Pin   Hdr
 *  i2c1    PB7   CN5:9            PB6   CN5:10/CN10:3
 *  i2c2    PB4   CN9:6/CN10:27     PB5   CN9:5/CN10:29
 *
 * Short Pin PB7 to PB4, and PB6 to PB5, for the test to pass.
 */

/ {
	aliases {
		i2c-controller = &i2c1;
		i2c-controller-target = &i2c2;
	};
};

&i2c1 {
	pinctrl-0 = <&i2c1_scl_pb6 &i2c1_sda_pb7>;
	pinctrl-names = "default";
	clock-frequency = <I2C_BITRATE_FAST>;
	status = "okay";
};

&i2c2 {
	pinctrl-0 = <&i2c2_scl_pb5 &i2c2_sda_pb4>;
	pinctrl-names = "default";
	clock-frequency = <I2C_BITRATE_FAST>;
	status = "okay";
};
