## samples/drivers/i2c/rtio_loopback/boards/nrf54h20dk_nrf54h20_cpuapp.conf
```kconfig
# Copyright (c) 2024 Nordic Semiconductor ASA
# SPDX-License-Identifier: Apache-2.0

CONFIG_I2C_NRFX_TWIS_BUF_SIZE=256
```

## samples/drivers/i2c/rtio_loopback/boards/nrf54lm20dk_nrf54lm20a_cpuapp.conf
```kconfig
# Copyright (c) 2025 Nordic Semiconductor ASA
# SPDX-License-Identifier: Apache-2.0

CONFIG_I2C_NRFX_TWIS_BUF_SIZE=256
```

## samples/drivers/i2c/rtio_loopback/boards/nrf7120dk_nrf7120e_cpuapp.conf
```kconfig
#
# Copyright (c) 2026 Nordic Semiconductor ASA
#
# SPDX-License-Identifier: Apache-2.0
#

CONFIG_I2C_NRFX_TWIS_BUF_SIZE=256
```

## samples/drivers/i2c/rtio_loopback/boards/ophelia4ev_nrf54l15_cpuapp.conf
```kconfig
# Copyright (c) 2025 Würth Elektronik eiSos GmbH & Co. KG
# SPDX-License-Identifier: Apache-2.0

CONFIG_I2C_NRFX_TWIS_BUF_SIZE=256
```

## samples/drivers/i2c/rtio_loopback/sample.yaml
```yaml
sample:
  name: I2C RTIO loopback sample
tests:
  sample.drivers.i2c.rtio_loopback:
    tags:
      - rtio
      - i2c_target
    platform_allow:
      - b_u585i_iot02a
```

## samples/drivers/i2c/target_eeprom/sample.yaml
```yaml
sample:
  name: I2C target sample
tests:
  sample.drivers.i2c.target:
    tags: i2c_target
    filter: dt_nodelabel_enabled("target_eeprom")
    platform_allow:
      - lpcxpresso55s69/lpc55s69/cpu0
    harness: TBD
  sample.drivers.i2c.target.kinetis:
    tags: i2c_target
    filter: dt_nodelabel_enabled("target_eeprom")
    platform_allow:
      - frdm_ke17z
      - frdm_ke17z512
    harness: console
    harness_config:
      type: multi_line
      regex:
        - "i2c target sample"
        - "i2c target driver registered"
        - "i2c target driver unregistered"
```

## samples/drivers/i2c_fujitsu_fram/sample.yaml
```yaml
sample:
  name: Demo for Fujitsu MB85RC256V FRAM (I2C)
tests:
  sample.drivers.i2c.fujitsu_fram:
    tags: drivers
    depends_on: i2c
    filter: dt_nodelabel_enabled("i2c0")
    harness: console
    harness_config:
        type: one_line
        regex:
            - "Data comparison successful."
        fixture: fixture_i2c_FRAM
```

## samples/drivers/i2c_lcd_2004/sample.yaml
```yaml
sample:
  name: Display text using LCD 2004 through I2C
tests:
  sample.drivers.i2c.lcd_2004:
    tags: display
    depends_on: gpio, i2c
    filter: dt_nodelabel_enabled("i2c0"), CONFIG_I2C
    harness: display
```

## samples/drivers/i2c_scanner/sample.yaml
```yaml
sample:
  name: I2C scanner
tests:
  sample.driver.i2c_scanner:
    platform_whitelist: nrf52840_blip nrf51_ble400
    tags: drivers
    depends_on: i2c
    harness: console
    harness_config:
        type: one_line
        regex:
            - "0x50 FOUND"
        fixture: fixture_i2c_FRAM
```

## samples/drivers/i2c_slave_master_test/sample.yaml
```yaml
sample:
  name: I2C sample
tests:
  sample.drivers.i2c:
    tags: drivers i2c
    depends_on: i2c
    filter: dt_enabled_alias_with_parent_compat("i2c0", "i2c1")
    harness: console
    harness_config:
      type: multi_line
      ordered: true
      regex:
        - "MSR RX: 01: 0x0B"
        - "MSR RX: 02: 0x0C"
        - "MSR RX: 03: 0x0D"
        - "MSR RX: 04: 0x0E"
        - "MSR RX: 05: 0x0F"
        - "MSR RX: 06: 0x10"
        - "MSR RX: 07: 0x11"
        - "MSR RX: 08: 0x12"
        - "MSR RX: 09: 0x13"
        - "MSR RX: 10: 0x14"
```

## samples/drivers/i2s/dmic_i2s/Kconfig
```kconfig
# Copyright (c) 2025 Ambiq Micro Inc.
# SPDX-License-Identifier: Apache-2.0

source "Kconfig.zephyr"

config SAMPLE_FREQ
	int "Sample rate"
	default 16000
	help
	  Sample frequency of the system.

config I2S_DMIC_INPUT
	bool "Use DMIC as an audio input"
	default n

config I2S_LOOPBACK
	bool "Use I2S loopback mode"
	default n

if I2S_DMIC_INPUT

config DMIC_CHANNELS
	int "Number of DMIC channels"
	default 2
	help
	  Count of DMIC & I2S channels to capture and streaming.

endif

config I2S_ONLY_CHANNELS
	int "Number of I2S only mode output channels"
	default 2
```

## samples/drivers/i2s/dmic_i2s/sample.yaml
```yaml
sample:
  name: dmic i2s sample
tests:
  sample.drivers.i2s.dmic_i2s:
    tags: i2s
    platform_allow:
      - apollo510_evb
    harness: console
    harness_config:
      type: multi_line
      regex:
        - "DMIC I2S sample"
        - "Streams stopped"
```

## samples/drivers/i2s/echo/Kconfig
```kconfig
# Copyright (c) 2021 Nordic Semiconductor ASA
# Copyright (c) 2025 Croxel Inc.
# SPDX-License-Identifier: Apache-2.0

source "Kconfig.zephyr"

config I2C
	default $(dt_compat_on_bus,$(DT_COMPAT_WOLFSON_WM8731),i2c) \
		|| $(dt_compat_on_bus,$(DT_COMPAT_ADI_MAX9867),i2c)

config TOGGLE_ECHO_EFFECT_SW0
	bool "Toggle echo effect when pressing sw0"
	depends on $(dt_alias_enabled,sw0)
	select GPIO
	default y

config STOP_START_STREAMS_SW1
	bool "Start/stop I2S streams when pressing sw1"
	depends on $(dt_alias_enabled,sw1)
	select GPIO
	default y
```

## samples/drivers/i2s/echo/boards/dnesp32s3b_procpu.conf
```kconfig
# Copyright (c) 2025 Chen Xingyu <hi@xingrz.me>
# SPDX-License-Identifier: Apache-2.0

CONFIG_REGULATOR=y
```

## samples/drivers/i2s/echo/boards/esp32s3_box3_procpu.conf
```kconfig
CONFIG_I2C=y
CONFIG_GPIO=y
CONFIG_AUDIO=y
CONFIG_AUDIO_CODEC=y
CONFIG_ES8311=y
CONFIG_HEAP_MEM_POOL_SIZE=32768
```

## samples/drivers/i2s/echo/boards/max32655fthr_max32655_m4.conf
```kconfig
#
# Copyright 2026 NXP
#
# SPDX-License-Identifier: Apache-2.0
#

# On MAX32655FTHR, MAX9867 MCLK is connected to external 12.2880 crystal,
# thus using target mode.
CONFIG_USE_CODEC_CLOCK=y
```

## samples/drivers/i2s/echo/boards/mimxrt1060_evk_mimxrt1062_qspi_C.conf
```kconfig
#
# Copyright 2025 NXP
#
# SPDX-License-Identifier: Apache-2.0
#

CONFIG_HEAP_MEM_POOL_SIZE=81920
CONFIG_AUDIO=y
CONFIG_AUDIO_CODEC=y
```

## samples/drivers/i2s/echo/boards/native_sim_native.conf
```kconfig
# Copyright 2026 NXP
# SPDX-License-Identifier: Apache-2.0

CONFIG_AUDIO=y
CONFIG_AUDIO_CODEC=y
CONFIG_I2S_NATIVE_SIM_RX_FILE_PATH="/tmp/native_sim_i2s_echo_in.pcm"
CONFIG_I2S_NATIVE_SIM_TX_FILE_PATH="/tmp/native_sim_i2s_echo_out.pcm"
```

## samples/drivers/i2s/echo/boards/nrf5340dk_nrf5340_cpuapp.conf
```kconfig
#
# Copyright The Zephyr Project Contributors
#
# SPDX-License-Identifier: Apache-2.0
#

CONFIG_I2S_NRFX_ALLOW_MCK_BYPASS=y
```

## samples/drivers/i2s/echo/dts/bindings/wolfson,wm8731.yaml
```yaml
# Copyright (c) 2021 Nordic Semiconductor ASA
# SPDX-License-Identifier: Apache-2.0

# This binding has been added solely for the purpose of the overlay files used
# in the drivers/i2s/echo sample. That's why it is located in this sample source
# directory. It can be moved and made available more widely if the need arises.

description: WM8731 Audio CODEC

compatible: "wolfson,wm8731"

include: i2c-device.yaml
```

## samples/drivers/i2s/echo/sample.yaml
```yaml
sample:
  name: I2S echo sample
tests:
  sample.drivers.i2s.echo:
    tags: i2s
    filter: dt_nodelabel_enabled("i2s_rxtx") or
            (dt_nodelabel_enabled("i2s_rx") and dt_nodelabel_enabled("i2s_tx"))
    integration_platforms:
      - nrf52840dk/nrf52840
      - nrf5340dk/nrf5340/cpuapp
      - esp32s3_lcd_ev/esp32s3/procpu
    platform_exclude: litex_vexriscv
    harness: console
    harness_config:
      type: one_line
      regex:
        - "I2S echo sample"
```

## samples/drivers/i2s/i2s_codec/Kconfig
```kconfig
# Copyright (c) 2024 NXP
# SPDX-License-Identifier: Apache-2.0

source "Kconfig.zephyr"

config I2S_INIT_BUFFERS
	int "Initial count of audio data blocks"
	default 4
	help
	  Controls the initial count of audio data blocks, which are (optionally)
	  filled by data from the DMIC peripheral and played back by the I2S
	  output peripheral.

config SAMPLE_FREQ
	int "Sample rate"
	default 16000
	help
	  Sample frequency of the system.

config USE_CODEC_CLOCK
	bool "I2S BCK is generated by a selected codec device"
	help
	  If selected, the I2S selected peripheral will be configured to consume
	  (receive) the I2S BCK and WS signals and the codec will be configured
	  to generate those. If not selected, the I2S peripheral will generate
	  them and the codec will be expected to consume them.

config USE_DMIC
	bool "Use DMIC as an audio input"

if USE_DMIC

config DMIC_CHANNELS
	int "Number of DMIC channels"
	default 1
	help
	  Count of DMIC channels to capture and process.

endif
```

## samples/drivers/i2s/i2s_codec/boards/imx95_evk_mimx9596_m7.conf
```kconfig
# Copyright 2026 NXP
# SPDX-License-Identifier: Apache-2.0
CONFIG_NOCACHE_MEMORY=y
CONFIG_I2S_HAS_PLL_SETTING=n
CONFIG_GPIO=y
CONFIG_GPIO_PCAL64XXA=y
CONFIG_GPIO_HOGS=y
CONFIG_SAMPLE_FREQ=16000
CONFIG_EXTRA_BLOCKS=2
CONFIG_I2S_INIT_BUFFERS=2
CONFIG_USE_DMIC=y
CONFIG_DMIC_CHANNELS=2
CONFIG_SAMPLE_WIDTH=32
CONFIG_BYTES_PER_SAMPLE=4
```

## samples/drivers/i2s/i2s_codec/boards/lpcxpresso55s69_cpu0.conf
```kconfig
#
# Copyright 2025 NXP
#
# SPDX-License-Identifier: Apache-2.0
#

CONFIG_USE_CODEC_CLOCK=y

# Sample rate decreased because of memory size
CONFIG_SAMPLE_FREQ=8000
```
