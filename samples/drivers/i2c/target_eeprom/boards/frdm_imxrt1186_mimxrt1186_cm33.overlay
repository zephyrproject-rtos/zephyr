/*
 * Copyright 2026 NXP
 *
 * SPDX-License-Identifier: Apache-2.0
 */

&lpi2c3 {
	eeprom0: eeprom@54 {
		reg = <0x54>;
		size = <256>;
		compatible = "zephyr,i2c-target-eeprom";
		status = "okay";
	};
};

target_eeprom: &eeprom0 {};
