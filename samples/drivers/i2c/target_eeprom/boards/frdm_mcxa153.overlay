/*
 * Copyright 2025 NXP
 *
 * SPDX-License-Identifier: Apache-2.0
 */

&lpi2c0 {
	eeprom0: eeprom@54 {
		compatible = "zephyr,i2c-target-eeprom";
		reg = <0x54>;
		size = <256>;
		status = "okay";
	};
};
