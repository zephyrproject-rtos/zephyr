/*
 * Copyright 2025 Ambiq Micro Inc.
 *
 * SPDX-License-Identifier: Apache-2.0
 */

&ios0 {
	i2c_ios0: i2c {
		compatible = "ambiq,ios-i2c";
		status = "okay";
		fifo-threshold = <16>;
		pinctrl-0 = <&ios_i2c0_default>;
		pinctrl-names = "default";

		eeprom0: eeprom@10 {
			compatible = "zephyr,i2c-target-eeprom";
			reg = <0x10>;
			size = <256>;
			status = "okay";
		};
	};
};

target_eeprom: &eeprom0 {};
