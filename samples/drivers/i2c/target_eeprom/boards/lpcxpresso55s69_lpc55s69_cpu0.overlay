/*
 * Copyright (c) 2024 Open Pixel Systems
 *
 * SPDX-License-Identifier: Apache-2.0
 */

&flexcomm4 {
	status = "okay";

	eeprom0: eeprom@50 {
		compatible = "zephyr,i2c-target-eeprom";
		reg = <0x50>;
		size = <256>;
		status = "okay";
	};
};
