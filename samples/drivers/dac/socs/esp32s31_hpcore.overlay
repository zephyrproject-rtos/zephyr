/*
 * Copyright (c) 2026 Espressif Systems (Shanghai) Co., Ltd.
 *
 * SPDX-License-Identifier: Apache-2.0
 */

/ {
	zephyr,user {
		dac = <&dac>;
		dac-channel-id = <0>;
		dac-resolution = <12>;
	};
};

&dac {
	status = "okay";
};
