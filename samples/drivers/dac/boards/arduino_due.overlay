/*
 * SPDX-FileCopyrightText: Copyright The Zephyr Project Contributors
 * SPDX-License-Identifier: Apache-2.0
 */

/ {
	zephyr,user {
		dac = <&dacc>;
		dac-channel-id = <0>;
		dac-resolution = <12>;
	};
};
