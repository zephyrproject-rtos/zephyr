/*
 * SPDX-FileCopyrightText: Copyright The Zephyr Project Contributors
 * SPDX-License-Identifier: Apache-2.0
 */

/ {
	zephyr,user {
		dac = <&dac1>;
		dac-channel-id = <1>;
		dac-resolution = <12>;
	};
};
