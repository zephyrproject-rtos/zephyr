/*
 * Copyright 2026 NXP
 *
 * SPDX-License-Identifier: Apache-2.0
 */

/ {
	chosen {
		zephyr,console = &lpuart3;
		zephyr,shell-uart = &lpuart3;
	};

	/*
	 * DAC0 output signal port is J1-4(P2_2).
	 */
	zephyr,user {
		dac = <&dac0>;
		dac-channel-id = <0>;
		dac-resolution = <12>;
	};
};

&lpuart3 {
	status = "okay";
};
