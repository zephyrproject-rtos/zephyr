/*
 * Copyright (c) 2026 Silicon Laboratories Inc.
 *
 * SPDX-License-Identifier: Apache-2.0
 */

#include <zephyr/dt-bindings/dac/silabs-vdac.h>

/ {
	zephyr,user {
		dac = <&vdac1>;
		dac-channel-id = <0>;
		dac-resolution = <12>;
	};
};

/* VDAC1 CH0 main-output is PB2 (F10 WSTK-pin), connected to LED0. */
&vdac1 {
	status = "okay";
	voltage-reference = "AVDD";

	channel@0 {
		main-output;
	};
};
