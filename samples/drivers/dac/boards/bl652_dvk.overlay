/*
 * Copyright 2021 Laird Connectivity
 *
 * SPDX-License-Identifier: Apache-2.0
 */

&i2c0 {
	dac0: mcp4725@60 {
		compatible = "microchip,mcp4725";
		reg = <0x60>;
		label = "MCP4725";
		#io-channel-cells = <1>;
	};
};
