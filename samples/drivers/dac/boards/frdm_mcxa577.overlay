/*
 * Copyright 2026 NXP
 *
 * SPDX-License-Identifier: Apache-2.0
 */

/ {
	/*
	 * On the FRDM-MCXA577 board, DAC0 output signal port is J8-23 (P2_2).
	 */
	zephyr,user {
		dac = <&dac0>;
		dac-channel-id = <0>;
		dac-resolution = <12>;
	};
};
