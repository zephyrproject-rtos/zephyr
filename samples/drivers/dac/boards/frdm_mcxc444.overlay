/*
 * Copyright 2025 NXP
 *
 * SPDX-License-Identifier: Apache-2.0
 */

/* Users can measure the DAC output on J6-2. */
/ {
	zephyr,user {
		dac = <&dac>;
		dac-channel-id = <0>;
		dac-resolution = <12>;
	};
};
