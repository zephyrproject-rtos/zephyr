/*
 * Copyright (C) 2023 Intel Corporation
 *
 * SPDX-License-Identifier: Apache-2.0
 */

#include <zephyr/dt-bindings/gpio/gpio.h>

/*
 * MT25QU256ABA connected to spi pheripheral
 */

&gpio1 {
	status = "okay";
};

&spi0 {
	status = "okay";
	cs-gpios = <&gpio1 17 GPIO_ACTIVE_LOW>;
	mt25qu: mx25r6435f@0  {
		compatible = "jedec,spi-nor";
		reg = <0>;
		spi-max-frequency = <1000000>;
		jedec-id = [20 BB 22];
		size = <2147483648>;
	};
};
