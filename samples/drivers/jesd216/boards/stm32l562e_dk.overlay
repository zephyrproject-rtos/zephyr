/*
 * Copyright (c) 2022, STMicroelectronics
 *
 * SPDX-License-Identifier: Apache-2.0
 */

&mx25lm51245 {
	/* example of sfdp-bfp table Version 1.6 */
	sfdp-bfp = [
		53 46 44 50 06 01 02 ff
		00 06 01 10 30 00 00 ff
		c2 00 01 04 10 01 00 ff
		84 00 01 02 c0 00 00 ff
		00 00 00 00 00 00 00 00
		00 00 00 00 00 00 00 00
		e5 20 fb ff ff ff ff 1f
		44 eb 08 6b 08 3b 04 bb
		fe ff ff ff ff ff 00 ff
		ff ff 44 eb 0c 20 0f 52
		10 d8 00 ff d6 49 c5 00
		81 df 04 e3 44 03 67 38
		30 b0 30 b0 f7 bd d5 5c
		4a 9e 29 ff f0 50 f9 85
		00 00 00 00 00 00 00 00
		00 00 00 00 00 00 00 00
		00 00 00 00 00 00 00 00
		00 00 00 00 00 00 00 00
		00 00 00 00 00 00 00 00
		00 00 00 00 00 00 00 00
		00 00 00 00 00 00 00 00
		00 00 00 00 00 00 00 00
		00 00 00 00 00 00 00 00
		00 00 00 00 00 00 00 00
		7f ef ff ff 21 5c dc ff
	];
};
