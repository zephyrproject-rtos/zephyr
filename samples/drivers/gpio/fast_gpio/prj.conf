## CMakeLists.txt
```
# SPDX-FileCopyrightText: Copyright (c) 2026 Infineon Technologies AG,
# SPDX-FileCopyrightText: or an affiliate of Infineon Technologies AG. All rights reserved.
#
# SPDX-License-Identifier: Apache-2.0

cmake_minimum_required(VERSION 3.20.0)
find_package(Zephyr REQUIRED COMPONENTS HINTS $ENV{ZEPHYR_BASE})
project(fast_gpio)

target_sources(app PRIVATE src/main.c src/consumer.c)

if(CONFIG_FAST_GPIO_CLAIM)
  # The application decides what is combined into one translation unit:
  # the gpio source set plus the application hot path, fused by CMake's
  # unity build in GROUP mode. Everything else, such as consumer.c,
  # compiles as a normal standalone translation unit and dispatches
  # through the device api vtable.
  zephyr_source_set_claim(gpio TARGET app UNITY_GROUP fast_gpio)
  set_target_properties(app PROPERTIES
    UNITY_BUILD ON
    UNITY_BUILD_MODE GROUP
    UNITY_BUILD_UNIQUE_ID ZEPHYR_KERNEL_UNITY_ID
  )
  set_source_files_properties(${CMAKE_CURRENT_SOURCE_DIR}/src/main.c
    TARGET_DIRECTORY app PROPERTIES UNITY_GROUP fast_gpio)
endif()
```

## Kconfig
```
# SPDX-FileCopyrightText: Copyright (c) 2026 Infineon Technologies AG,
# SPDX-FileCopyrightText: or an affiliate of Infineon Technologies AG. All rights reserved.
#
# SPDX-License-Identifier: Apache-2.0

mainmenu "Fast GPIO source set sample"

config FAST_GPIO_CLAIM
	bool "Claim the gpio source set into the application"
	default y
	help
	  Claim the gpio source set out of its libraries and combine it
	  with the application hot path in one translation unit using
	  CMake's unity build. The GPIO driver stays enabled and
	  registered normally; only where it is compiled changes. Disable
	  to build the same application against the driver in its usual
	  library, with every call dispatched through the device api
	  vtable.

source "Kconfig.zephyr"
```

## prj.conf
```kconfig
CONFIG_GPIO=y
CONFIG_SPEED_OPTIMIZATIONS=y
```

## lto.conf
```kconfig
CONFIG_LTO=y
CONFIG_ISR_TABLES_LOCAL_DECLARATION=y
# The kit_pse84_eval defconfigs set CODE_DATA_RELOCATION=y but nothing
# in the PSE84 build relocates code, and LTO depends on it being off.
CONFIG_CODE_DATA_RELOCATION=n
```

## boards/kit_pse84_eval_pse846gps2dbzc4a_m33.overlay
```dts
/*
 * SPDX-FileCopyrightText: Copyright (c) 2026 Infineon Technologies AG,
 * SPDX-FileCopyrightText: or an affiliate of Infineon Technologies AG. All rights reserved.
 *
 * SPDX-License-Identifier: Apache-2.0
 */

/*
 * Move the toggle pin from the red LED to Arduino A3 (P15.5, header
 * J2.7, 1.8 V) so the burst can be probed with a scope. The J2 analog
 * header pins are routed directly to the MCU pads; the J3/J4 digital
 * headers sit behind dual voltage level translators that cannot slew
 * at the measured toggle rates. The application reads the pin through
 * the led0 alias, so only the gpios property changes.
 */

&gpio_prt15 {
	status = "okay";
};

&led_red {
	gpios = <&gpio_prt15 5 GPIO_ACTIVE_HIGH>;
};
```

## src/main.c
```c
/*
 * SPDX-FileCopyrightText: Copyright (c) 2026 Infineon Technologies AG,
 * SPDX-FileCopyrightText: or an affiliate of Infineon Technologies AG. All rights reserved.
 *
 * SPDX-License-Identifier: Apache-2.0
 */

#include <zephyr/kernel.h>
#include <zephyr/drivers/gpio.h>

static const struct gpio_dt_spec led = GPIO_DT_SPEC_GET(DT_ALIAS(led0), gpios);

#ifdef __GNUC__
#define FAST_GPIO_FLATTEN __attribute__((flatten))
#else
#define FAST_GPIO_FLATTEN
#endif

/* Inline the whole GPIO call stack into the loop body, overriding the
 * inliner's cost heuristics: the port ops are address-taken by the api
 * vtable, which makes the compiler reluctant to also inline the
 * devirtualized direct calls.
 */
FAST_GPIO_FLATTEN
int main(void)
{

	(void)gpio_pin_configure_dt(&led, GPIO_OUTPUT_INACTIVE);

	printk("fast_gpio: toggling %s pin %u\n", led.port->name, led.pin);

	/* Sixteen toggles back to back, then a pause. Unrolling amortizes
	 * the loop branch so the steady state gap between edges is the
	 * sustained bus write throughput to the GPIO block, and the pause
	 * makes each burst stand alone on a scope: trigger on the first
	 * edge after the quiet gap.
	 */
	while (1) {
		(void)gpio_pin_toggle_dt(&led);
		(void)gpio_pin_toggle_dt(&led);
		(void)gpio_pin_toggle_dt(&led);
		(void)gpio_pin_toggle_dt(&led);
		(void)gpio_pin_toggle_dt(&led);
		(void)gpio_pin_toggle_dt(&led);
		(void)gpio_pin_toggle_dt(&led);
		(void)gpio_pin_toggle_dt(&led);
		(void)gpio_pin_toggle_dt(&led);
		(void)gpio_pin_toggle_dt(&led);
		(void)gpio_pin_toggle_dt(&led);
		(void)gpio_pin_toggle_dt(&led);
		(void)gpio_pin_toggle_dt(&led);
		(void)gpio_pin_toggle_dt(&led);
		(void)gpio_pin_toggle_dt(&led);
		(void)gpio_pin_toggle_dt(&led);

		k_busy_wait(10);
	}

	return 0;
}
```

## src/consumer.c
```c
/*
 * SPDX-FileCopyrightText: Copyright (c) 2026 Infineon Technologies AG,
 * SPDX-FileCopyrightText: or an affiliate of Infineon Technologies AG. All rights reserved.
 *
 * SPDX-License-Identifier: Apache-2.0
 */

/* A separate translation unit using the generic GPIO API, to show the
 * driver keeps working normally for code outside the fused translation
 * unit: these calls dispatch through the device api vtable like any
 * other driver consumer.
 */
#include <zephyr/kernel.h>
#include <zephyr/drivers/gpio.h>

static const struct gpio_dt_spec led_other = GPIO_DT_SPEC_GET(DT_ALIAS(led1), gpios);

void consumer_blink(void)
{
	(void)gpio_pin_configure_dt(&led_other, GPIO_OUTPUT_INACTIVE);

	for (int i = 0; i < 10; i++) {
		(void)gpio_pin_toggle_dt(&led_other);
	}
}
```
