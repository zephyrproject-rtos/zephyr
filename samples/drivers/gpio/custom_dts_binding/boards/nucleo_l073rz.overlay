/*
 * Copyright (c) 2020 Martin Jäger / Libre Solar
 *
 * SPDX-License-Identifier: Apache-2.0
 */

/ {
	load_switch: load_switch {
		compatible = "power-output";
                /* using built-in LED pin for demonstration */
		gpios = <&gpioa 5 GPIO_ACTIVE_HIGH>;
	};
};
