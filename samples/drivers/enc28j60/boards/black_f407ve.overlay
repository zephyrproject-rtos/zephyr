/*
 * Copyright (c) 2020 Intel Corporation
 *
 * SPDX-License-Identifier: Apache-2.0
 */

&spi2 {
	status = "okay";
	cs-gpios = <&gpioe 7 0>;

	enc28j60@0 {
		compatible = "microchip,enc28j60";
		spi-max-frequency = <1000000>;
		local-mac-address = [00 00 00 00 04 8f];
		int-gpios = <&gpioe 8 GPIO_ACTIVE_LOW>;
		status = "okay";
		label = "ETH_0";
		reg = <0>;
	};
};
