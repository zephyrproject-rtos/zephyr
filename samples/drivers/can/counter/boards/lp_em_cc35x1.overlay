/*
 * Copyright (c) 2026 Conclusive Engineering Sp. z o.o.
 *
 * SPDX-License-Identifier: Apache-2.0
 */

/ {
	aliases {
		led0 = &red_led;
	};

	chosen {
		zephyr,canbus = &can0;
	};
};

&can0 {
	status = "okay";
};
