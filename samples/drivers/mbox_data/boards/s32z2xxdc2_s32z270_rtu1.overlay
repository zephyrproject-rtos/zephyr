/*
 * Copyright 2025 NXP
 *
 * SPDX-License-Identifier: Apache-2.0
 */

/ {
	mbox-consumer {
		compatible = "vnd,mbox-consumer";
		mboxes = <&mru4 0>, <&mru4 0>;
		mbox-names = "tx", "rx";
	};
};

&mru4 {
	rx-channels = <1>;
	status = "okay";
};
