/*
 * Copyright 2026 NXP
 *
 * SPDX-License-Identifier: Apache-2.0
 */

/ {
	mbox-consumer {
		compatible = "vnd,mbox-consumer";
		mboxes = <&mbox_b 0>, <&mbox_b 1>;
		mbox-names = "tx", "rx";
	};
};
