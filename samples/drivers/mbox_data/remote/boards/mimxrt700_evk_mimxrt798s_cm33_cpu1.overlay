/*
 * Copyright 2025 NXP
 *
 * SPDX-License-Identifier: Apache-2.0
 */

/ {
	mbox-consumer {
		compatible = "vnd,mbox-consumer";
		mboxes = <&mbox1_b 2>, <&mbox1_b 3>;
		mbox-names = "tx", "rx";
	};
};
