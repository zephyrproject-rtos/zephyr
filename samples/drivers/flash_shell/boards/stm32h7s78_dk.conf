## samples/drivers/flash_shell/boards/stm32h7s78_dk.conf
```kconfig
# Copyright (c) 2026 EXALT Technologies
# SPDX-License-Identifier: Apache-2.0

CONFIG_LOG=n
CONFIG_MSPI=y
CONFIG_SHELL_MINIMAL=y
CONFIG_SIZE_OPTIMIZATIONS=y
```

## samples/drivers/gpio/fast_gpio/Kconfig
```kconfig
# SPDX-FileCopyrightText: Copyright (c) 2026 Infineon Technologies AG,
# SPDX-FileCopyrightText: or an affiliate of Infineon Technologies AG. All rights reserved.
#
# SPDX-License-Identifier: Apache-2.0

mainmenu "Fast GPIO source set sample"

config FAST_GPIO_CLAIM
	bool "Claim the gpio source set into the application"
	default y
	help
	  Claim the gpio source set out of its libraries and combine it
	  with the application hot path in one translation unit using
	  CMake's unity build. The GPIO driver stays enabled and
	  registered normally; only where it is compiled changes. Disable
	  to build the same application against the driver in its usual
	  library, with every call dispatched through the device api
	  vtable.

source "Kconfig.zephyr"
```

## samples/drivers/hash_bench/Kconfig
```kconfig
# SPDX-FileCopyrightText: Copyright (c) 2026 STMicroelectronics
# SPDX-License-Identifier: Apache-2.0

source "Kconfig.zephyr"

config HASH_BENCH_IO_ALIGNMENT_BYTES
	int "Alignment (bytes) for hash bench IO buffers"
	default 4
	help
	  Alignment (in bytes) applied to the hash bench input and output
	  buffers. Some crypto drivers require IO buffers handed to them to
	  be cache-line aligned so that the driver's cache-maintenance
	  operations do not corrupt unrelated data sharing a partial cache
	  line. Boards whose crypto driver has this requirement should
	  override this value (typically to the D-Cache line size) via a
	  board overlay.
```

## samples/drivers/i2s/echo/boards/mimxrt1064_evk.conf
```kconfig
#
# Copyright 2026 NXP
#
# SPDX-License-Identifier: Apache-2.0
#

CONFIG_SAMPLE_USE_CODEC_CLOCK=y
```

## samples/drivers/i2s/i2s_codec/boards/kit_pse84_eval_pse846gps2dbzc4a_m55.conf
```kconfig
# SPDX-FileCopyrightText: Copyright (c) 2026 Infineon Technologies AG,
# SPDX-FileCopyrightText: or an affiliate of Infineon Technologies AG. All rights reserved.
#
# SPDX-License-Identifier: Apache-2.0

CONFIG_I2S_MCLK_FREQUENCY=10240000
```

## samples/drivers/i2s/i2s_codec/boards/mimxrt2660_evk_mimxrt2663_cm85.conf
```kconfig
#
# SPDX-FileCopyrightText: Copyright 2026 NXP
#
# SPDX-License-Identifier: Apache-2.0
#

CONFIG_HEAP_MEM_POOL_SIZE=81920
CONFIG_USE_DMIC=n
CONFIG_I2S_MCLK_FREQUENCY=24576000
```

## samples/drivers/i2s/output/Kconfig
```kconfig
# Copyright (c) 2026 Mario Paja
# SPDX-License-Identifier: Apache-2.0

config SAMPLE_I2S_OPT_BIT_CLK_GATED
	bool "Run I2S bit clock only while sending data"
	default y if SOC_FAMILY_STM32
	default y if I2S_SILABS_USART
	help
	  Enable I2S bit clock (BCLK) so that it runs
	  only while audio data is actively being transmitted.

config SAMPLE_I2S_FORMAT_PDM
	bool "Transmit with the PDM data format"
	help
	  Configure the stream with I2S_FMT_DATA_FORMAT_PDM instead of
	  I2S_FMT_DATA_FORMAT_I2S.

config HEAP_MEM_POOL_ADD_SIZE_SAMPLE
	int
	default 256 if SOC_FAMILY_STM32 && I2S_STM32_SAI

source "Kconfig.zephyr"
```

## samples/drivers/i2s/rtio_loopback/Kconfig
```kconfig
# SPDX-FileCopyrightText: Copyright 2026 Nordic Semiconductor ASA
# SPDX-License-Identifier: Apache-2.0

source "Kconfig.zephyr"

mainmenu "I2S RTIO loopback"

config SAMPLE_BUFFER_COUNT
	int "Number of TX and RX buffers respectively"
	default 8

choice SAMPLE_WORD_SIZE
	prompt "Word size (sample width)"
	default SAMPLE_WORD_SIZE_16

config SAMPLE_WORD_SIZE_8
	bool "Use 8-bit word size (sample width)"

config SAMPLE_WORD_SIZE_16
	bool "Use 16-bit word size (sample width)"

endchoice # SAMPLE_WORD_SIZE

config SAMPLE_FRAME_CLK_FREQ
	int "Frame clock frequency in Hz"
	default 44100
	range 8000 192000

config SAMPLE_FRAME_COUNT
	int "Number of frames in TX and RX buffers respectively"
	default 256

config SAMPLE_STREAM_COUNT
	int "Number of buffers which will be submitted and consumed before sample is complete"
	default 256

config SAMPLE_STREAM_BUFFER_COUNT
	int "The stream buffer count"
	default 4

config SAMPLE_SIGNAL_FREQ
	int "The streamed sawtooth signal frequency in Hertz"
	default 1000
	range 10 10000

config SAMPLE_SIGNAL_ATTENUATION
	int "The attenuation factor of the streamed sawtooth signal (1/value)"
	default 1
	range 1 20

config SAMPLE_STREAM_DELAY
	int "Delay between TX stream and RX stream in frames"
	default 0
```

## samples/drivers/led/is31fl37x3/Kconfig
```kconfig
# SPDX-License-Identifier: Apache-2.0
# Copyright 2023 Daniel DeGrasse <daniel@degrasse.com>

source "Kconfig.zephyr"

config LED_ROW_COUNT
	int "Number of rows in the LED matrix"
	default 11 if DT_HAS_ISSI_IS31FL3743B_ENABLED
	default 12
	help
	  Set this to match the number of SW connections
	  wired up to your LED controller. The sample will only attempt
	  to drive LEDs within this range. The IS31FL3733 has 12 SW lines,
	  and the IS31FL3743B has 11.

config LED_COLUMN_COUNT
	int "Number of columns in the LED matrix"
	default 18 if DT_HAS_ISSI_IS31FL3743B_ENABLED
	default 16
	help
	  Set this to match the number of CS connections wired
	  up to your LED controller. The sample will only attempt to drive
	  LEDs within this range. The IS31FL3733 has 16 CS lines and the
	  IS31FL3743B has 18.
```

## samples/drivers/lora/receive/Kconfig
```kconfig
# Copyright (c) 2026 RAKwireless Technology Limited
# SPDX-License-Identifier: Apache-2.0

mainmenu "LoRa receive sample application"

config SAMPLE_LORA_GFSK
	bool "Receive over the GFSK modem"
	depends on LORA_GFSK
	help
	  Set the radio up for the 50 kbps FSK that LoRaWAN defines as DR7 and
	  receive over that modem rather than the LoRa one.

source "Kconfig.zephyr"
```

## samples/drivers/lora/send/Kconfig
```kconfig
# Copyright (c) 2026 RAKwireless Technology Limited
# SPDX-License-Identifier: Apache-2.0

mainmenu "LoRa send sample application"

config SAMPLE_LORA_GFSK
	bool "Send over the GFSK modem"
	depends on LORA_GFSK
	help
	  Set the radio up for the 50 kbps FSK that LoRaWAN defines as DR7 and
	  send over that modem rather than the LoRa one.

source "Kconfig.zephyr"
```

## samples/drivers/mbox_data/Kconfig
```kconfig
# Copyright 2024 NXP
#
# SPDX-License-Identifier: Apache-2.0

source "Kconfig.zephyr"

config INCLUDE_REMOTE_DIR
	bool "Include remote core header directory"
	help
	  Include remote build header files. Can be used if primary image
	  needs to be aware of size or base address of secondary image

config MBOX_DATA_MAX_MSG_SIZE
	int "Maximum mbox message size in bytes"
	default 4
	help
	  Maximum supported message size for the sample buffers. Defaults to
	  4 bytes; boards whose mbox driver supports a larger MTU can override
	  this via a board-specific config fragment.
```

## samples/drivers/mbox_data/boards/frdm_mcxl255_mcxl255_cpu0.conf
```kconfig
CONFIG_SOC_MCXL255_SECOND_CORE=y
CONFIG_INCLUDE_REMOTE_DIR=y
CONFIG_BUILD_OUTPUT_HEX=y
```

## samples/drivers/mbox_data/boards/kit_t2g_c2d6m_lite_cyt4dnjbzs_m0p.conf
```kconfig
# SPDX-FileCopyrightText: Copyright (c) 2026 Linumiz
#
# SPDX-License-Identifier: Apache-2.0

CONFIG_MBOX_DATA_MAX_MSG_SIZE=8
```
