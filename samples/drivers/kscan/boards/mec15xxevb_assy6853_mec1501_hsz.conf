## samples/drivers/kscan/sample.yaml
```yaml
sample:
  name: KSCAN driver sample
tests:
  sample.drivers.kscan:
    tags:
      - drivers
      - kscan
    harness: console
    harness_config:
      type: multi_line
      ordered: true
      regex:
        - "kb data(.*)"
      fixture: fixture_connect_keyboard
    depends_on: kscan
    filter: dt_chosen_enabled("zephyr,keyboard-scan")
  sample.drivers.kscan.rk055hdmipi4m:
    tags: drivers kscan
    harness: console
    harness_config:
      type: multi_line
      ordered: true
      regex:
        - "kb data(.*)"
      fixture: fixture_connect_rk055hdmipi4m
    depends_on: kscan
    extra_args: SHIELD="rk055hdmipi4m"
    platform_allow: mimxrt1170_evk_cm7 mimxrt595_evk_cm33
```

## samples/drivers/kscan_touch/sample.yaml
```yaml
sample:
  name: KSCAN touch driver api sample
tests:
  sample.drivers.kscan_touch:
    tags:
      - drivers
      - kscan_touch
    harness: console
    harness_config:
      type: multi_line
      ordered: true
      regex:
        - "kb data(.*)"
    depends_on: kscan:touch
```

## samples/drivers/lcd_hd44780/sample.yaml
```yaml
sample:
  name: Display text strings on HD44780 based 20x4 LCD controller
tests:
  sample.drivers.lcd.hd44780:
    platform_allow: arduino_due/sam3x8e
    tags: display
    harness: display
    depends_on: gpio
```

## samples/drivers/led/apa102c_bitbang/sample.yaml
```yaml
sample:
  name: Utilize APA102C LED
tests:
  sample.drivers.led.apa102c_bitbang:
    tags: LED
    filter: dt_alias_exists("gpio-0")
    depends_on: gpio
```

## samples/drivers/led/basic/sample.yaml
```yaml
sample:
  description: Demonstration of an LED driver
  name: Basic LED sample
tests:
  sample.drivers.led.basic:
    tags: led
    platform_allow:
      - nrf52840dk/nrf52840
    integration_platforms:
      - nrf52840dk/nrf52840
    build_only: true

  sample.drivers.led.basic.nrf52840dk_matrix:
    tags: led
    platform_allow:
      - nrf52840dk/nrf52840
    integration_platforms:
      - nrf52840dk/nrf52840
    build_only: true
    extra_args:
      - DTC_OVERLAY_FILE=boards/nrf52840dk_nrf52840_simulated_matrix.overlay
```

## samples/drivers/led/is31fl319x/sample.yaml
```yaml
sample:
  description: Demonstration of the IS31FL319x LED driver
  name: is31fl319x sample
tests:
  sample.drivers.led.is31fl319x:
    filter: dt_compat_enabled("issi,is31fl3194") or dt_compat_enabled("issi,is31fl3197")
    tags: LED
    depends_on: i2c
    integration_platforms:
      - arduino_nicla_sense_me
```

## samples/drivers/led/is31fl3216a/sample.yaml
```yaml
sample:
  description: Demonstration of the is31fl3216a LED driver
  name: is31fl3216a sample
tests:
  sample.drivers.led.is31fl3216a:
    filter: dt_compat_enabled("issi,is31fl3216a")
    tags: LED
    depends_on: i2c
```

## samples/drivers/led/is31fl3733/Kconfig
```kconfig
# SPDX-License-Identifier: Apache-2.0
# Copyright 2023 Daniel DeGrasse <daniel@degrasse.com>

source "Kconfig.zephyr"

config LED_ROW_COUNT
	int "Number of rows in IS31FL3733 matrix"
	default 12
	help
	  Set this to match the number of SW LED sink connections
	  wired up to your IS31FL3733 LED driver. The sample will only attempt
	  to drive LEDs within this range.

config LED_COLUMN_COUNT
	int "Number of columns in IS31FL3733 matrix"
	default 16
	help
	  Set this to match the number of CS LED source connections wired up
	  to your IS31FL3733 LED driver. The sample will only attempt to drive
	  LEDs within this range.
```

## samples/drivers/led/is31fl3733/sample.yaml
```yaml
sample:
  description: Demonstration of the IS31FL3733 LED driver
  name: IS31FL3733 sample
tests:
  sample.drivers.led.is31fl3733:
    filter: dt_compat_enabled("issi,is31fl3733")
    tags: LED
    depends_on: i2c
```

## samples/drivers/led/is31fl3743/Kconfig
```kconfig
# SPDX-License-Identifier: Apache-2.0
# Copyright 2023 Daniel DeGrasse <daniel@degrasse.com>
# Copyright 2025-2026 Framework Computer Inc

source "Kconfig.zephyr"

config LED_ROW_COUNT
	int "Number of rows in IS31FL3743 matrix"
	default 11
	help
	  Set this to match the number of SW LED sink connections
	  wired up to your IS31FL3743 LED driver. The sample will only attempt
	  to drive LEDs within this range.

config LED_COLUMN_COUNT
	int "Number of columns in IS31FL3743 matrix"
	default 18
	help
	  Set this to match the number of CS LED source connections wired up
	  to your IS31FL3743 LED driver. The sample will only attempt to drive
	  LEDs within this range.

config LED_RGB
	bool "Whether the LEDs connected are RGB"
	default y
	help
	  Set this to treat the LEDs as RGB LEDs that are sequentially connected, like in the
	  datasheet. example. The sample will run some more color specific demos.
```

## samples/drivers/led/is31fl3743/sample.yaml
```yaml
sample:
  description: Demonstration of the IS31FL3743 LED driver
  name: IS31FL3743 sample
tests:
  sample.drivers.led.is31fl3743:
    filter: dt_compat_enabled("issi,is31fl3743")
    tags: LED
    depends_on: i2c
```

## samples/drivers/led/led_strip/Kconfig
```kconfig
# Copyright (c) 2019 Nordic Semiconductor ASA
# SPDX-License-Identifier: Apache-2.0

menu "WS2812 Sample Configuration"

config SAMPLE_LED_UPDATE_DELAY
	int "Delay between LED updates in ms"
	default 50
	help
	  Delay between LED updates in ms.

config SAMPLE_LED_BRIGHTNESS
	int "LED brightness"
	default 16
	range 1 255
	help
	  Brightness level of each LED. Defaults to a low value to make
	  it easier to distinguish colors.

endmenu

source "Kconfig.zephyr"
```

## samples/drivers/led/led_strip/boards/nrf52dk_nrf52832.conf
```kconfig
# This driver only uses spi_write() with the SPIM instance it allocates,
# so PAN 58 doesn't matter, because the RX length is always 0.
CONFIG_NRF52_ANOMALY_58_WORKAROUND=y
```

## samples/drivers/led/led_strip/boards/nucleo_c071rb.conf
```kconfig
# SPDX-FileCopyrightText: Copyright The Zephyr Project Contributors
# SPDX-License-Identifier: Apache-2.0

CONFIG_SPI_STM32_DMA=y
```

## samples/drivers/led/lp55xx/sample.yaml
```yaml
sample:
  description: Demonstration of the LP55XX LED driver
  name: LP55XX sample
tests:
  sample.drivers.led.lp55xx:
    platform_allow: nrf52840dk/nrf52840 croxel_cx1825
    tags: led
    harness: TBD
```

## samples/drivers/led/lp5815/sample.yaml
```yaml
# SPDX-License-Identifier: Apache-2.0

sample:
  description: Demonstration of the LP5815 RGB LED driver
  name: LP5815 sample
tests:
  sample.drivers.led.lp5815:
    build_only: true
    tags: LED
```

## samples/drivers/led/pwm/Kconfig
```kconfig
# Copyright (c) 2024 TOKITA Hiroshi
# SPDX-License-Identifier: Apache-2.0

config BLINK_DELAY_SHORT
	int "Blinking delay for short cycle demo"
	default 100
	help
	  Specifies the LED on/off delay in milliseconds for short cycle
	  blinking demonstration.
	  If set to 0, the short-cycle blinking demo will not be performed.

config BLINK_DELAY_LONG
	int "Blinking delay for long cycle demo"
	default 1000
	help
	  Specifies the LED on/off delay in milliseconds for long cycle
	  blinking demonstration.
	  If set to 0, the long-cycle blinking demo will not be performed.

config FADE_DELAY
	int "Delay time for fade demo"
	default 10
	help
	  Specifies the delay in milliseconds for the fade demo of the
	  PWM-LED sample.
	  The brightness gradually increases by one level each time this
	  delay elapses.

config BLINK_DELAY_AUTO_FALLBACK
	bool "Enable automatic fallback to calculated delays"
	default y
	help
	  When enabled, if the configured blink delays fail (e.g., exceed
	  PWM period), the sample will automatically calculate appropriate
	  delays from the LED's PWM period.

config BLINK_DELAY_SHORT_LED_PERIOD_DIV
	int "Divisor for auto-calculating short blink delay from PWM period"
	default 10
	depends on BLINK_DELAY_AUTO_FALLBACK
	help
	  When CONFIG_BLINK_DELAY_SHORT exceeds the timer's range, this divisor
	  is used to automatically calculate the short blink delay from the
	  LED's PWM period defined in the devicetree.

	  Formula: delay_ms = (pwm_period_ms / DIVISOR / 2)

	  The division by 2 is because the delay applies to each phase
	  (on OR off) separately, not the total period.

config BLINK_DELAY_LONG_LED_PERIOD_DIV
	int "Divisor for auto-calculating long blink delay from PWM period"
	default 1
	depends on BLINK_DELAY_AUTO_FALLBACK
	help
	  When CONFIG_BLINK_DELAY_LONG exceeds the timer's range, this divisor
	  is used to automatically calculate the long blink delay from the
	  LED's PWM period defined in the devicetree.

	  Formula: delay_ms = (pwm_period_ms / DIVISOR / 2)

	  The division by 2 is because the delay applies to each phase
	  (on OR off) separately, not the total period.

source "Kconfig.zephyr"
```

## samples/drivers/led/pwm/boards/frdm_ke15z.conf
```kconfig
# FTM on KE15Z tops out at ~1048 ms period (SOSC 8 MHz / prescaler 128).
# led_blink(on, off) = total period, so cap each delay at ~500 ms.
CONFIG_BLINK_DELAY_LONG=500
```
