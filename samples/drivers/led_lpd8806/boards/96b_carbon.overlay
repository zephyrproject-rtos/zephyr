/*
 * Copyright (c) 2019, Linaro Limited
 *
 * SPDX-License-Identifier: Apache-2.0
 */

&spi2 {

	led_strip@0 {
		compatible = "colorway,lpd8806";
		reg = <0>;
		spi-max-frequency = <2000000>;
		label = "LPD8806";
	};
};
