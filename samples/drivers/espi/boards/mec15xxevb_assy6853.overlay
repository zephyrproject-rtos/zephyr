/*
 * Copyright (c) 2020 Intel Corporation
 *
 * SPDX-License-Identifier: Apache-2.0
 */

/ {
	board_power: resources {
		compatible = "intel-rvp,board-power";
		pwrg-gpios = <MCHP_GPIO_DECODE_012 GPIO_ACTIVE_HIGH>;
		rsm-gpios = <MCHP_GPIO_DECODE_054 GPIO_ACTIVE_HIGH>;
	};
};

&espi_saf0 {
	status = "okay";
};

&spi0 {
	status = "okay";
	port-sel = <0>;
	chip-select = <0>;
	lines = <4>;
};
