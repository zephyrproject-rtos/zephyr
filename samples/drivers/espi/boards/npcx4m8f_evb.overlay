/*
 * Copyright (c) 2026 Nuvoton Technology Corporation.
 *
 * SPDX-License-Identifier: Apache-2.0
 */

/ {
	board_power: resources {
		compatible = "intel-rvp,board-power";
		/* GPIO72 */
		pwrg-gpios = <&gpio7 2 GPIO_ACTIVE_HIGH>;
		/* GPIOA5 */
		rsm-gpios = <&gpioa 5 GPIO_ACTIVE_HIGH>;
	};
};

&espi0 {
	status = "okay";
	pinctrl-0 = <&espi_lpc_gp46_47_51_52_53_54_55_57>;
	pinctrl-names = "default";
};
