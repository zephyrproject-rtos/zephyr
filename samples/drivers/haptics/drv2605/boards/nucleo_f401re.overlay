/*
 * Copyright (c) 2024 Cirrus Logic, Inc.
 *
 * SPDX-License-Identifier: Apache-2.0
 */

#include <zephyr/dt-bindings/i2c/i2c.h>

&arduino_i2c {
	clock-frequency = <I2C_BITRATE_STANDARD>;
	status = "okay";

	haptic: drv2605@5a {
		compatible = "ti,drv2605";
		reg = <0x5a>;

		ti,actuator-mode = "LRA";
		ti,loop-gain = "HIGH";
		ti,feedback-brake-factor = "2X";
		status = "okay";
	};
};
