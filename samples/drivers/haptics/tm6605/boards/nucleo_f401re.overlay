/*
 * Copyright (c) 2026 Anuj Deshpande
 *
 * SPDX-License-Identifier: Apache-2.0
 */

#include <zephyr/dt-bindings/i2c/i2c.h>

&arduino_i2c {
	clock-frequency = <I2C_BITRATE_STANDARD>;
	status = "okay";

	haptic: tm6605@2d {
		compatible = "titanmec,tm6605";
		reg = <0x2d>;
		status = "okay";
	};
};
