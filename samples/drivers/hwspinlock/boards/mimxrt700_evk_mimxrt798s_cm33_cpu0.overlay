/*
 * Copyright 2026 NXP
 *
 * SPDX-License-Identifier: Apache-2.0
 */

/ {
	mbox-consumer {
		compatible = "vnd,mbox-consumer";
		mboxes = <&mbox1_a 1>, <&mbox1_a 0>;
		mbox-names = "tx", "rx";
	};

	hwspinlock_consumer {
		compatible = "vnd,hwspinlock-consumer";
		hwlocks = <&sema420 0>;
		hwlock-names = "gate0";
	};
};
