/*
 * Copyright 2025 NXP
 *
 * SPDX-License-Identifier: Apache-2.0
 */

/ {
	mbox_consumer {
		compatible = "vnd,mbox-consumer";
		mboxes = <&mbox 1>, <&mbox 0>;
		mbox-names = "tx", "rx";
	};

	hwspinlock_consumer {
		compatible = "vnd,hwspinlock-consumer";
		hwlocks = <&sema42 0>;
		hwlock-names = "gate0";
	};
};
