/*
 * Copyright 2026 NXP
 *
 * SPDX-License-Identifier: Apache-2.0
 */

/ {
	mbox-consumer {
		compatible = "vnd,mbox-consumer";
		mboxes = <&mbox1_b 0>, <&mbox1_b 1>;
		mbox-names = "tx", "rx";
	};

	hwspinlock_consumer {
		compatible = "vnd,hwspinlock-consumer";
		hwlocks = <&sema1 0>;
		hwlock-names = "gate0";
	};
};
