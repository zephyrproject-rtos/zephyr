/*
 * Copyright (c) 2022 Tokita, Hiroshi <tokita.hiroshi@gmail.com>
 *
 * SPDX-License-Identifier: Apache-2.0
 */

/ {
	aliases {
		watchdog0 = &wwdgt;
	};
};

&fwdgt {
	status = "disabled";
};

&wwdgt {
	status = "okay";
};
