## CMakeLists.txt
```
# SPDX-License-Identifier: Apache-2.0

cmake_minimum_required(VERSION 3.28.0)
find_package(Zephyr REQUIRED HINTS $ENV{ZEPHYR_BASE})
project(watchdog)

target_sources(app PRIVATE src/main.c)
```

## sample.yaml
```
sample:
  name: Watchdog Driver Sample
common:
  tags:
    - drivers
    - watchdog
  harness: console
  harness_config:
    type: multi_line
    ordered: true
    regex:
      - "Watchdog sample application"
      - "Feeding watchdog..."
      - "Waiting for reset..."
      - "Watchdog sample application"
  depends_on: watchdog
tests:
  sample.drivers.watchdog:
    filter: dt_alias_exists("watchdog0") and
      not (CONFIG_SOC_FAMILY_STM32 or CONFIG_SOC_FAMILY_GD_GD32 or SOC_SERIES_GD32VF103)
    platform_exclude:
      - s32z2xxdc2/s32z270/rtu0
      - s32z2xxdc2/s32z270/rtu1
      - s32z2xxdc2@D/s32z270/rtu0
      - s32z2xxdc2@D/s32z270/rtu1
      - s32k5xxcvb/s32k566/r52
      - panb611evb/nrf54l15/cpuapp
      - panb611evb/nrf54l15/cpuapp/ns
      - panb611evb/nrf54l15/cpuflpr
      - panb611evb/nrf54l15/cpuflpr/xip
      - nrf54lm20dk/nrf54lm20a/cpuapp/ns
      - nrf54lm20dk/nrf54lm20b/cpuapp/ns
      - nrf54l15dk/nrf54l15/cpuapp/ns
      - nrf54l15dk/nrf54l10/cpuapp/ns
      - nrf54l15tag/nrf54l15/cpuapp
      - nrf54l15tag/nrf54l15/cpuapp/ns
      - nrf54l15tag/nrf54l15/cpuflpr
      - nrf54l15tag/nrf54l15/cpuflpr/xip
      - nrf7120dk/nrf7120/cpuapp/ns
      - bl54l15_dvk/nrf54l10/cpuapp/ns
      - bl54l15_dvk/nrf54l15/cpuapp/ns
      - raytac_an54lq_db_15/nrf54l15/cpuapp/ns
      - raytac_an54lv_db_15/nrf54l15/cpuapp/ns
  sample.drivers.watchdog.stm32_wwdg:
    extra_args: DTC_OVERLAY_FILE=boards/stm32_wwdg.overlay
    filter: dt_compat_enabled("st,stm32-window-watchdog")
    platform_allow:
      - b_u585i_iot02a
      - nucleo_c031c6
      - nucleo_f091rc
      - nucleo_f103rb
      - nucleo_f207zg
      - nucleo_f429zi
      - nucleo_f746zg
      - nucleo_g071rb
      - nucleo_g474re
      - nucleo_l073rz
      - nucleo_l152re
      - nucleo_u385rg_q
      - nucleo_wb55rg
      - nucleo_wl55jc
      - stm32f3_disco
      - stm32l562e_dk
      - disco_l475_iot1
      - stm32h573i_dk
    integration_platforms:
      - nucleo_f103rb
  sample.drivers.watchdog.stm32h7_wwdg:
    extra_args: DTC_OVERLAY_FILE=boards/stm32h7_wwdg.overlay
    filter: dt_compat_enabled("st,stm32-window-watchdog")
    # filter CONFIG_SOC_SERIES_STM32H7X and dt_compat_enabled
    # seems to ignore extra_args
    platform_allow:
      - nucleo_h723zg
      - nucleo_h745zi_q/stm32h745xx/m4
      - nucleo_h743zi
      - stm32h735g_disco
      - nucleo_h753zi
      - stm32h750b_dk
      - stm32h7b3i_dk
      - stm32h745i_disco/stm32h745xx/m4
      - nucleo_h755zi_q/stm32h755xx/m4
      - stm32h747i_disco/stm32h747xx/m4
    integration_platforms:
      - nucleo_h753zi
  sample.drivers.watchdog.stm32_iwdg:
    extra_args: DTC_OVERLAY_FILE=boards/stm32_iwdg.overlay
    filter: dt_compat_enabled("st,stm32-watchdog")
    platform_allow:
      - b_u585i_iot02a
      - nucleo_c031c6
      - nucleo_f091rc
      - nucleo_f103rb
      - nucleo_f207zg
      - nucleo_f429zi
      - nucleo_f746zg
      - nucleo_g071rb
      - nucleo_g474re
      - nucleo_h743zi
      - nucleo_h753zi
      - nucleo_l073rz
      - nucleo_l152re
      - nucleo_u385rg_q
      - nucleo_wb55rg
      - nucleo_wl55jc
      - stm32f3_disco
      - stm32l562e_dk
      - disco_l475_iot1
      - stm32h573i_dk
    integration_platforms:
      - nucleo_f103rb
  sample.drivers.watchdog.stm32_iwdg_ewi:
    extra_args: DTC_OVERLAY_FILE=boards/stm32_iwdg.overlay
    filter: dt_compat_enabled("st,stm32-watchdog")
    extra_configs:
      - CONFIG_IWDG_STM32_EARLY_WAKEUP=y
    platform_allow:
      - nucleo_h563zi
      - nucleo_h7s3l8
      - nucleo_u083rc
      - nucleo_u385rg_q
      - nucleo_u575zi_q
      - b_u585i_iot02a
      - nucleo_wba55cg
    integration_platforms:
      - nucleo_wba55cg
  sample.drivers.watchdog.gd32_fwdgt:
    filter: dt_compat_enabled("gd,gd32-fwdgt")
    extra_args: DTC_OVERLAY_FILE=boards/gd32_fwdgt.overlay
    platform_allow:
      - gd32e103v_eval
      - gd32e507v_start
      - gd32f350r_eval
      - gd32f403z_eval
      - gd32f450i_eval
      - gd32f450z_eval
      - gd32f470i_eval
      - gd32vf103c_starter
      - gd32vf103v_eval
      - longan_nano
    integration_platforms:
      - gd32e103v_eval
  sample.drivers.watchdog.gd32_wwdgt:
    filter: dt_compat_enabled("gd,gd32-wwdgt")
    extra_args: DTC_OVERLAY_FILE=boards/gd32_wwdgt.overlay
    platform_allow:
      - gd32e103v_eval
      - gd32e507v_start
      - gd32f350r_eval
      - gd32f403z_eval
      - gd32f450i_eval
      - gd32f450z_eval
      - gd32f470i_eval
      - gd32vf103c_starter
      - gd32vf103v_eval
      - longan_nano
    integration_platforms:
      - gd32e103v_eval
  sample.drivers.watchdog.nxp_s32_swt:
    build_only: true
    platform_allow:
      - s32z2xxdc2/s32z270/rtu0
      - s32z2xxdc2/s32z270/rtu1
      - s32z2xxdc2@D/s32z270/rtu0
      - s32z2xxdc2@D/s32z270/rtu1
      - s32k5xxcvb/s32k566/r52
    integration_platforms:
      - s32z2xxdc2/s32z270/rtu0
```

## prj.conf
```kconfig
CONFIG_LOG=y
CONFIG_LOG_MODE_IMMEDIATE=y
CONFIG_WDT_LOG_LEVEL_DBG=y
CONFIG_WATCHDOG=y
CONFIG_WDT_DISABLE_AT_BOOT=n
```

## boards/adp_xc7k_ae350_clic.conf
```kconfig
CONFIG_XIP=y
CONFIG_DCACHE=n
```

## boards/ch32v003evt.conf
```kconfig
CONFIG_LOG_MODE_MINIMAL=y
```

## boards/disco_l475_iot1.conf
```kconfig
CONFIG_CLOCK_STM32_APB1_PRESCALER=16
```

## boards/esp32_devkitc_procpu.conf
```kconfig
CONFIG_HEAP_MEM_POOL_SIZE=256
```

## boards/intel_socfpga_agilex5_socdk.conf
```kconfig
CONFIG_WDT_DW_RESET_MODE=2
CONFIG_WDT_DW_PAUSE_BY_DBG=y
```

## boards/longan_nano_lite.conf
```kconfig
# Copyright (c) 2022 TOKITA Hiroshi <tokita.hiroshi@gmail.com>
# SPDX-License-Identifier: Apache-2.0

CONFIG_GD32_DBG_SUPPORT=y
```

## boards/adp_xc7k_ae350.overlay
```dts
/*
 * Copyright (c) 2023 Andes Technology Corporation.
 *
 * SPDX-License-Identifier: Apache-2.0
 */

/ {
	aliases {
		watchdog0 = &wdt;
	};
};
```

## boards/adp_xc7k_ae350_clic.overlay
```dts
/*
 * Copyright (c) 2025 Andes Technology Corporation.
 *
 * SPDX-License-Identifier: Apache-2.0
 */

/ {
	aliases {
		watchdog0 = &wdt;
	};
};
```

## boards/am243x_evm_am2434_m4.overlay
```dts
/*
 * Copyright (c) 2025 Texas Instruments Incorporated
 *
 * SPDX-License-Identifier: Apache-2.0
 */

/ {
	aliases {
		watchdog0 = &mcu_rti0;
	};
};
```

## boards/am243x_evm_am2434_r5f0_0.overlay
```dts
/*
 * Copyright (c) 2025 Texas Instruments Incorporated
 *
 * SPDX-License-Identifier: Apache-2.0
 */

/ {
	aliases {
		watchdog0 = &main_rti8;
	};
};
```

## boards/bl54l15_dvk_nrf54l15_cpuflpr.overlay
```dts
/*
 * Copyright 2024 Nordic Semiconductor ASA
 * Copyright 2025 Ezurio LLC
 * SPDX-License-Identifier: Apache-2.0
 */

&wdt31 {
	status = "okay";
};
```

## boards/bl54l15u_dvk_nrf54l15_cpuflpr.overlay
```dts
/*
 * Copyright 2024 Nordic Semiconductor ASA
 * Copyright 2025 Ezurio LLC
 * SPDX-License-Identifier: Apache-2.0
 */

watchdog0: &wdt31 {
	status = "okay";
};
```

## src/main.c
```c
/*
 * Copyright (c) 2015 Intel Corporation
 * Copyright (c) 2018 Nordic Semiconductor
 * Copyright (c) 2019 Centaur Analytics, Inc
 * Copyright 2023 NXP
 *
 * SPDX-License-Identifier: Apache-2.0
 */

#include <zephyr/kernel.h>
#include <zephyr/device.h>
#include <zephyr/drivers/watchdog.h>
#include <zephyr/sys/printk.h>
#include <stdbool.h>

#define WDT_FEED_TRIES 5

/*
 * To use this sample the devicetree's /aliases must have a 'watchdog0' property.
 */
#if DT_HAS_COMPAT_STATUS_OKAY(st_stm32_window_watchdog)
#define WDT_MAX_WINDOW  100U
#elif DT_HAS_COMPAT_STATUS_OKAY(nordic_nrf_wdt)
/* Nordic supports a callback, but it has 61.2 us to complete before
 * the reset occurs, which is too short for this sample to do anything
 * useful.  Explicitly disallow use of the callback.
 */
#define WDT_ALLOW_CALLBACK 0
#elif DT_HAS_COMPAT_STATUS_OKAY(adi_max42500_watchdog)
#define WDT_ALLOW_CALLBACK 0
#define WDT_MAX_WINDOW 128U
#define WDT_OPT 0
#elif DT_HAS_COMPAT_STATUS_OKAY(raspberrypi_pico_watchdog)
#define WDT_ALLOW_CALLBACK 0
#elif DT_HAS_COMPAT_STATUS_OKAY(gd_gd32_wwdgt)
#define WDT_MAX_WINDOW 24U
#define WDT_MIN_WINDOW 18U
#define WDG_FEED_INTERVAL 12U
#elif DT_HAS_COMPAT_STATUS_OKAY(intel_tco_wdt)
#define WDT_ALLOW_CALLBACK 0
#define WDT_MAX_WINDOW 3000U
#elif DT_HAS_COMPAT_STATUS_OKAY(nxp_fs26_wdog)
#define WDT_MAX_WINDOW  1024U
#define WDT_MIN_WINDOW	320U
#define WDT_OPT 0
#define WDG_FEED_INTERVAL (WDT_MIN_WINDOW + ((WDT_MAX_WINDOW - WDT_MIN_WINDOW) / 4))
#elif DT_HAS_COMPAT_STATUS_OKAY(renesas_ra_wdt)
#define WDT_ALLOW_CALLBACK 0
#elif DT_HAS_COMPAT_STATUS_OKAY(wch_iwdg)
#define WDT_ALLOW_CALLBACK 0
#define WDT_OPT            0
#elif DT_HAS_COMPAT_STATUS_OKAY(sifli_sf32lb_wdt)
#define WDT_ALLOW_CALLBACK 0
#define WDT_OPT            0
#elif DT_HAS_COMPAT_STATUS_OKAY(xen_watchdog)
#define WDT_ALLOW_CALLBACK 0
#define WDT_MAX_WINDOW     2000U
#define WDT_OPT            0
#elif DT_HAS_COMPAT_STATUS_OKAY(andestech_atcwdt200)
#define WDT_MAX_WINDOW 500U
#elif DT_HAS_COMPAT_STATUS_OKAY(infineon_match_wdt) ||                                             \
	DT_HAS_COMPAT_STATUS_OKAY(infineon_match_wdt_srss_v1) ||                                   \
	DT_HAS_COMPAT_STATUS_OKAY(infineon_match_wdt_srsslt)
/* The match interrupt does not come right before the reset, and the counter cannot pause */
#define WDT_ALLOW_CALLBACK 0
#define WDT_OPT            0
#endif
#if DT_HAS_COMPAT_STATUS_OKAY(nordic_nrf_gswdt)
#if !defined(CONFIG_NRFS_GSWDT_SERVICE_ENABLED)
#define WDT_MAX_WINDOW  6000U
#endif
#define WDT_ALLOW_CALLBACK 0
#define WDT_OPT            0
#endif

#ifndef WDT_ALLOW_CALLBACK
#define WDT_ALLOW_CALLBACK 1
#endif

#ifndef WDT_MAX_WINDOW
#define WDT_MAX_WINDOW  1000U
#endif

#ifndef WDT_MIN_WINDOW
#define WDT_MIN_WINDOW  0U
#endif

#ifndef WDG_FEED_INTERVAL
#define WDG_FEED_INTERVAL 50U
#endif

#ifndef WDT_OPT
#define WDT_OPT WDT_OPT_PAUSE_HALTED_BY_DBG
#endif

#if WDT_ALLOW_CALLBACK
static void wdt_callback(const struct device *wdt_dev, int channel_id)
{
	static bool handled_event;

	if (handled_event) {
		return;
	}

	wdt_feed(wdt_dev, channel_id);

	printk("Handled things..ready to reset\n");
	handled_event = true;
}
#endif /* WDT_ALLOW_CALLBACK */

int main(void)
{
	int err;
	int wdt_channel_id;
	const struct device *const wdt = DEVICE_DT_GET(DT_ALIAS(watchdog0));

	printk("Watchdog sample application\n");

	if (!device_is_ready(wdt)) {
		printk("%s: device not ready.\n", wdt->name);
		return 0;
	}

	struct wdt_timeout_cfg wdt_config = {
		/* Reset SoC when watchdog timer expires. */
		.flags = WDT_FLAG_RESET_SOC,

		/* Expire watchdog after max window */
		.window.min = WDT_MIN_WINDOW,
		.window.max = WDT_MAX_WINDOW,
	};

#if WDT_ALLOW_CALLBACK
	/* Set up watchdog callback. */
	wdt_config.callback = wdt_callback;

	printk("Attempting to test pre-reset callback\n");
#else /* WDT_ALLOW_CALLBACK */
	printk("Callback in RESET_SOC disabled for this platform\n");
#endif /* WDT_ALLOW_CALLBACK */

	wdt_channel_id = wdt_install_timeout(wdt, &wdt_config);
	if (wdt_channel_id == -ENOTSUP) {
		/* IWDG driver for STM32 doesn't support callback */
		printk("Callback support rejected, continuing anyway\n");
		wdt_config.callback = NULL;
		wdt_channel_id = wdt_install_timeout(wdt, &wdt_config);
	}
	if (wdt_channel_id < 0) {
		printk("Watchdog install error\n");
		return 0;
	}

	err = wdt_setup(wdt, WDT_OPT);
	if (err < 0) {
		printk("Watchdog setup error\n");
		return 0;
	}

#if WDT_MIN_WINDOW != 0
	/* Wait opening window. */
	k_msleep(WDT_MIN_WINDOW);
#endif
	/* Feeding watchdog. */
	printk("Feeding watchdog %d times\n", WDT_FEED_TRIES);
	for (int i = 0; i < WDT_FEED_TRIES; ++i) {
		printk("Feeding watchdog...\n");
		wdt_feed(wdt, wdt_channel_id);
		k_sleep(K_MSEC(WDG_FEED_INTERVAL));
	}

	/* Waiting for the SoC reset. */
	printk("Waiting for reset...\n");
	while (1) {
		k_yield();
	}
	return 0;
}
```

## src/iwdg_main.c
```c
/*
 * Copyright (c) 2017 RnDity Sp. z o.o.
 *
 * SPDX-License-Identifier: Apache-2.0
 */

#include <zephyr.h>
#include <watchdog.h>
#include <misc/printk.h>

/*
 * The independent watchdog (IWDG) is clocked by its own dedicated
 * 40kHz (STM32F1X or STM32F3X) or 32kHz (STM32F4X or STM32L4X)
 * low-speed internal clock (LSI).
 *
 * Sample application is dedicated to STM32 family.
 *
 * For STM32F1X/STM32F3X family:
 *     prescaler register should be set to 'divider /16' and the reload
 *     register to 2500.
 *
 * For STM32F4X/STM32L4X family:
 *     prescaler register should be set to 'divider /16' and the reload
 *     register to 2000.
 *
 * Then it takes 1 second a reset signal is generated.
 */

#define TIMEOUT_VALID		900
#define TIMEOUT_INVALID		1100

void main(void)
{
	struct device *iwdg = device_get_binding("IWDG");
	struct k_timer iwdg_timer;
	struct wdt_config config;
	u8_t counter = 0U;

	wdt_enable(iwdg);

	k_timer_init(&iwdg_timer, NULL, NULL);

	/* Set IWDG timeout to 1 second. */
	config.timeout = 1000000;
	wdt_set_config(iwdg, &config);

	while (1) {
		printk("Welcome...\n");

		if (counter % 2 == 0) {
			/* Less than IWDG reload value. */
			k_timer_start(&iwdg_timer, K_MSEC(TIMEOUT_VALID), 0);
		} else {
			/* More than IWDG reload value. */
			k_timer_start(&iwdg_timer, K_MSEC(TIMEOUT_INVALID), 0);
		}

		counter++;
		/* Wait till application timer expires. */
		k_timer_status_sync(&iwdg_timer);

		printk("Watchdog refreshed...\n");
		k_sleep(2);
		wdt_reload(iwdg);
	}
}
```
