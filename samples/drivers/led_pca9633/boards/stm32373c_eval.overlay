/* SPDX-License-Identifier: Apache-2.0 */

&i2c1 {
	status = "okay";
	clock-frequency = <I2C_BITRATE_STANDARD>;

	pca9633@62 {
		compatible = "nxp,pca9633";
		reg = <0x62>;
		label = "PCA9633";
	};
};
