/*
 * Copyright (c) 2022 STMicroelectronics
 *
 * SPDX-License-Identifier: Apache-2.0
 */

&octospi1 {
            dmas = <&dma1 1 0x16 0x480>; /* request for OCTOSPI1 fifo THreshold */
            dma-names = "tx_rx";
};

&mdma {
	status = "okay";
};
