/*
 * Copyright (c) 2024 Nordic Semiconductor ASA
 *
 * SPDX-License-Identifier: Apache-2.0
 */

&gpio6 {
	status = "okay";
	zephyr,pm-device-runtime-auto;
};

&exmif {
	status = "okay";
	zephyr,pm-device-runtime-auto;
};

&mx25uw63 {
	status = "okay";
};
