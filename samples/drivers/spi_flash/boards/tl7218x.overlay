/*
 * SPDX-License-Identifier: Apache-2.0
 *
 * Copyright (c) 2023 Telink Semiconductor (Shanghai) Co., Ltd.
 */

/ {
	aliases {
		spi-flash0 = &spi1_cs0_flash;
	};
};

&gspi {
	status = "okay";
		spi1_cs0_flash: p25q16@0 {
		compatible = "jedec,spi-nor";
		/* 16777216 bits = 2 Mbytes */
		size = <0x1000000>;
		reg = <0>;
		spi-max-frequency = <24000000>;
		jedec-id = [ef 40 16];
		status = "okay";
	};
};
