/*
 * Copyright (c) 2024 STMicroelectronics
 *
 * SPDX-License-Identifier: Apache-2.0
 */

&xspi1 {
	/* request 57 for XSPI1 */
	dmas = <&gpdma1 57 STM32_DMA_PERIPH_TX>,
	       <&gpdma1 57 STM32_DMA_PERIPH_RX>;
	dma-names = "tx", "rx";
};

&gpdma1 {
	status = "okay";
};
