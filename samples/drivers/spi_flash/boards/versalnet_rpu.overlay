/*
 * Copyright (c) 2026 Advanced Micro Devices, Inc. All Rights Reserved.
 *
 * SPDX-License-Identifier: Apache-2.0
 */

&spi1 {
	status = "okay";

	flash@2 {
		compatible = "jedec,spi-nor";
		reg = <2>;
		spi-max-frequency = <8000000>;
		jedec-id = [c2 25 36]; /* mx25u3235f */
		size = <0x2000000>; /* 32MB */
		has-dpd;
		t-enter-dpd = <10000>;
		t-exit-dpd = <35000>;
	};
};
