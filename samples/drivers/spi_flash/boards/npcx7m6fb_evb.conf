## samples/drivers/spi_flash/boards/npcx7m6fb_evb.conf
```kconfig
#
# Copyright (c) 2021 Nuvoton Technology Corporation.
#
# SPDX-License-Identifier: Apache-2.0
#

CONFIG_SPI_NOR=y
```

## samples/drivers/spi_flash/boards/nrf52840_mdk.conf
```kconfig
#
# Copyright (c) 2020 Stephane D'Alu
#
# SPDX-License-Identifier: Apache-2.0
#

CONFIG_SPI=n
CONFIG_NORDIC_QSPI_NOR=y
```

## samples/drivers/spi_flash/boards/nrf52840_pca10056.conf
```kconfig
#
# Copyright (c) 2019 Peter Bigot Consulting, LLC
#
# SPDX-License-Identifier: Apache-2.0
#

CONFIG_SPI_NOR=y
```

## samples/drivers/spi_flash/boards/nrf52840dk_nrf52840.conf
```kconfig
#
# Copyright (c) 2019 Peter Bigot Consulting, LLC
# Copyright (c) 2019 Nordic Semiconductor ASA
#
# SPDX-License-Identifier: Apache-2.0
#

CONFIG_NORDIC_QSPI_NOR=y
```

## samples/drivers/spi_flash/boards/nrf5340dk_nrf5340_cpuapp.conf
```kconfig
#
# Copyright (c) 2020 Nordic Semiconductor ASA
#
# SPDX-License-Identifier: Apache-2.0
#

CONFIG_SPI=n
CONFIG_NORDIC_QSPI_NOR=y
```

## samples/drivers/spi_flash/boards/rv32m1_vega_ri5cy.conf
```kconfig
#
# Copyright (c) 2019 Karsten Koenig <karsten.koenig.030@gmail.com>
#
# SPDX-License-Identifier: Apache-2.0
#

CONFIG_SPI_NOR=y
```

## samples/drivers/spi_flash/boards/sama7g54_ek.conf
```kconfig
# Copyright (c) 2026 Microchip Technology  Inc. and its subsidiaries
#
# SPDX-License-Identifier: Apache-2.0

CONFIG_ARM_MMU_NUM_L2_TABLES=320
```

## samples/drivers/spi_flash/boards/stm32h573i_dk.conf
```kconfig
# SPDX-FileCopyrightText: Copyright The Zephyr Project Contributors
# SPDX-License-Identifier: Apache-2.0

CONFIG_LOG=y
CONFIG_FLASH_LOG_LEVEL_INF=y
```

## samples/drivers/spi_flash/sample.yaml
```yaml
sample:
  name: SPI Flash Sample
common:
  tags:
    - spi
    - flash
  depends_on: spi
tests:
  sample.drivers.spi.flash:
    filter: dt_compat_enabled("jedec,spi-nor") or dt_compat_enabled("st,stm32-qspi-nor")
      or dt_compat_enabled("st,stm32-ospi-nor") or dt_compat_enabled("st,stm32-xspi-nor")
      or dt_compat_enabled("nordic,qspi-nor") or dt_compat_enabled("jedec,mspi-nor")
    platform_exclude:
      - hifive_unmatched/fu740/s7
      - hifive_unmatched/fu740/u74
      - nrf54lm20dk/nrf54lm20a/cpuapp
    harness: console
    harness_config:
      type: multi_line
      ordered: true
      regex:
        - "Test 1: Flash erase"
        - "Flash erase succeeded!"
        - "Test 2: Flash write"
        - "Attempting to write 4 bytes"
        - "Data read matches data written. Good!!"
  sample.drivers.spi.flash.stm32.memmap:
    filter: dt_compat_enabled("st,stm32-qspi-nor")
      or dt_compat_enabled("st,stm32-ospi-nor")
      or dt_compat_enabled("st,stm32-xspi-nor")
    integration_platforms:
      - stm32h573i_dk
    extra_configs:
      - CONFIG_STM32_MEMMAP=y
    harness: console
    harness_config:
      type: multi_line
      ordered: true
      regex:
        - "Test 1: Flash erase"
        - "Flash erase succeeded!"
        - "Test 2: Flash write"
        - "Attempting to write 4 bytes"
        - "Data read matches data written. Good!!"
  sample.drivers.spi.flash.nrf54lm20:
    platform_allow:
      - nrf54lm20dk/nrf54lm20a/cpuapp
    integration_platforms:
      - nrf54lm20dk/nrf54lm20a/cpuapp
    harness: console
    harness_config:
      fixture: external_flash
      type: multi_line
      ordered: true
      regex:
        - "Test 1: Flash erase"
        - "Flash erase succeeded!"
        - "Test 2: Flash write"
        - "Attempting to write 4 bytes"
        - "Data read matches data written. Good!!"
```

## samples/drivers/spi_flash_at45/sample.yaml
```yaml
sample:
  name: SPI Flash AT45 Sample
tests:
  sample.drivers.spi.flash.at45.build:
    tags:
      - spi
      - flash
    depends_on: spi
    filter: dt_compat_enabled("atmel,at45")
    build_only: true
  sample.drivers.spi.flash.at45.build.page_layout:
    extra_args: EXTRA_CONF_FILE="overlay-page_layout.conf"
    tags:
      - spi
      - flash
    depends_on: spi
    filter: dt_compat_enabled("atmel,at45")
    build_only: true
  sample.drivers.spi.flash.at45.build.pm:
    extra_args: EXTRA_CONF_FILE="overlay-pm.conf"
    tags:
      - spi
      - flash
    depends_on: spi
    filter: dt_compat_enabled("atmel,at45")
    build_only: true
  sample.drivers.spi.flash.at45.build.page_layout_pm:
    extra_args: EXTRA_CONF_FILE="overlay-page_layout.conf;overlay-pm.conf"
    tags:
      - spi
      - flash
    depends_on: spi
    filter: dt_compat_enabled("atmel,at45")
    build_only: true
  sample.drivers.spi.flash.at45:
    extra_args: EXTRA_CONF_FILE="overlay-page_layout.conf;overlay-pm.conf"
    tags:
      - spi
      - flash
    depends_on: spi
    filter: dt_compat_enabled("atmel,at45")
    harness: console
    harness_config:
      type: multi_line
      ordered: true
      regex:
        - "Using \\w+, chip size: \\d+ bytes \\(page: \\d+\\)"
        - "Reading the first byte of the test region ... OK"
        - "Preparing test content starting with 0x[0-9a-f]{2}."
        - "Writing the first half of the test region... OK"
        - "Writing the second half of the test region... OK"
        - "Reading the whole test region... OK"
        - "Checking the read content... OK"
        - "Putting the flash device into low power state... OK"
      fixture: atmel_at45
```

## samples/drivers/spi_fujitsu_fram/sample.yaml
```yaml
sample:
  name: SPI FRAM Module Sample
tests:
  sample.drivers.spi.fujitsu_fram:
    tags: drivers fram
    harness: fram
    depends_on: gpio spi
    filter: dt_alias_exists("spi-1")
```

## samples/drivers/spi_nand/boards/stm32l562e_dk.conf
```kconfig
#
# Copyright (c) 2022 Macronix International Co., Ltd.
#
# SPDX-License-Identifier: Apache-2.0
#

CONFIG_SPI=y
CONFIG_SPI_NAND=y
CONFIG_SPI_ASYNC=y
CONFIG_SPI_LOG_LEVEL_INF=y
CONFIG_SPI_STM32_DMA=y
```

## samples/drivers/spi_nand/sample.yaml
```yaml
sample:
  name: SPI NAND Flash Sample
tests:
  sample.drivers.spi.nand.flash:
    tags: spi nand
    filter: dt_compat_enabled("jedec,spi-nand")
    harness: console
    harness_config:
        type: multi_line
        ordered: true
        regex:
            - "Test 1: Flash erase"
            - "Flash erase succeeded!"
            - "Test 2: Flash write"
            - "Attempting to write 4 bytes"
            - "Data read matches data written. Good!!"
    depends_on: spi
```

## samples/drivers/stepper/basic/Kconfig
```kconfig
# SPDX-FileCopyrightText: Copyright (c) 2025 Jilay Sandeep Pandya
# SPDX-License-Identifier: Apache-2.0

mainmenu "TMC50XX sample application"

config STEPS_PER_REV
	int "Steps per revolution"
	default 200

config PING_PONG_N_REV
	int "Change direction every N revolutions"
	default 1

source "Kconfig.zephyr"
```

## samples/drivers/stepper/generic/Kconfig
```kconfig
# SPDX-FileCopyrightText: Copyright (c) 2025 Jilay Sandeep Pandya
# SPDX-License-Identifier: Apache-2.0

mainmenu "Stepper generic sample application"

config STEPS_PER_REV
	int "Steps per revolution"
	default 200

config STEP_INTERVAL_NS
	int "Step interval (ns)"
	default 1000000

config PING_PONG_N_REV
	int "Change direction every N revolutions"
	default 1

config RAMP_ACCELERATION
	int "Ramp acceleration micro-step/s²"
	default 100

config RAMP_MAX_VELOCITY
	int "Ramp max velocity micro-steps/s"
	default 1000

config RAMP_DECELERATION
	int "Ramp deceleration micro-step/s²"
	default 100

config MONITOR_THREAD_TIMEOUT_MS
	int "Monitor thread timeout (ms)"
	default 1000

config MONITOR_THREAD_STACK_SIZE
	int "Monitor thread stack size"
	default 1024

source "Kconfig.zephyr"
```

## samples/drivers/stepper/generic/sample.yaml
```yaml
sample:
  name: Generic Stepper Sample
tests:
  sample.drivers.stepper.generic:
    harness: stepper
    tags: stepper
    platform_allow: nucleo_g071rb
    depends_on: gpio input
```

## samples/drivers/stepper/tmc50xx/Kconfig
```kconfig
# SPDX-FileCopyrightText: Copyright (c) 2025 Jilay Sandeep Pandya
# SPDX-License-Identifier: Apache-2.0

mainmenu "TMC50XX sample application"

config STEPS_PER_REV
	int "Steps per revolution"
	default 200

config PING_PONG_N_REV
	int "Change direction every N revolutions"
	default 1

config MAX_VELOCITY_MULTIPLIER
	int "Max velocity multiplier"
	default 1

source "Kconfig.zephyr"
```

## samples/drivers/stepper/tmc50xx/sample.yaml
```yaml
sample:
  name: TMC50XX Stepper Sample
tests:
  sample.drivers.stepper.tmc50xx:
    harness: stepper
    tags: stepper
    platform_allow: nucleo_g071rb
    depends_on: spi
```

## samples/drivers/stepper/tmc522x/Kconfig
```kconfig
# SPDX-FileCopyrightText: Copyright (c) 2026 Cherrence Sarip <Cherrence.sarip@analog.com>
# SPDX-License-Identifier: Apache-2.0

mainmenu "TMC522x sample application"

config STEPS_PER_REV
	int "Steps per revolution"
	default 200

config PING_PONG_N_REV
	int "Change direction every N revolutions"
	default 1

source "Kconfig.zephyr"
```

## samples/drivers/stepper/tmcm3216/Kconfig
```kconfig
# SPDX-FileCopyrightText: Copyright (c) 2025 Alexis Czezar C Torreno
# SPDX-License-Identifier: Apache-2.0

mainmenu "TMCM-3216 sample application"

config STEPS_PER_REV
	int "Steps per revolution"
	default 200

config PING_PONG_N_REV
	int "Change direction every N revolutions"
	default 1

config MAX_VELOCITY
	int "Maximum velocity in usteps/s"
	default 50000

config MAX_ACCELERATION
	int "Maximum acceleration in usteps/s^2"
	default 1000

config MAX_DECELERATION
	int "Maximum deceleration in usteps/s^2"
	default 1000

source "Kconfig.zephyr"
```

## samples/drivers/stepper/tmcm3216/sample.yaml
```yaml
sample:
  name: TMCM-3216 Stepper Sample
tests:
  sample.drivers.stepper.tmcm3216:
    harness: stepper
    tags: stepper
    platform_allow: nucleo_u575zi_q
    depends_on: serial gpio
```

## samples/drivers/timeaware_gpio/sample.yaml
```yaml
sample:
  name: timeaware_gpio
tests:
  sample.drivers.misc.timeaware_gpio:
    tags:
      - drivers
    filter: dt_compat_enabled("intel,timeaware-gpio")
```

## samples/drivers/uart/async_api/boards/stm32h7s78_dk.conf
```kconfig
#
# Copyright (c) 2026 STMicroelectronics
#
# SPDX-License-Identifier: Apache-2.0
#
CONFIG_DCACHE=n
```
