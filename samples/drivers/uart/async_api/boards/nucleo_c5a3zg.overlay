/*
 * Copyright (c) 2026 STMicroelectronics
 *
 * SPDX-License-Identifier: Apache-2.0
 */

&lpuart1 {
	dmas = <&lpdma1 3 23 STM32_DMA_PERIPH_TX>,
	       <&lpdma1 4 22 STM32_DMA_PERIPH_RX>;
	dma-names = "tx", "rx";
};
