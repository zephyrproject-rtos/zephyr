/*
 * SPDX-FileCopyrightText: <text>Copyright (c) 2026 Infineon Technologies AG,
 * or an affiliate of Infineon Technologies AG. All rights reserved.</text>
 *
 * SPDX-License-Identifier: Apache-2.0
 */

&dma0 {
	#address-cells = <1>;
	#size-cells = <0>;
	compatible = "infineon,dma";
	status = "okay";
};

dut: &scb5 {
	dmas = <&dma0 22>, <&dma0 23>;
	dma-names = "tx", "rx";
};
