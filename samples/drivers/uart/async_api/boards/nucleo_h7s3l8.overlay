/*
 * Copyright (c) 2026 Mario Paja
 *
 * SPDX-License-Identifier: Apache-2.0
 */

&usart3 {
	dmas = <&gpdma1 0 78 STM32_DMA_PERIPH_TX>,
	       <&gpdma1 1 77 STM32_DMA_PERIPH_RX>;
	dma-names = "tx", "rx";
};
