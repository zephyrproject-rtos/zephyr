/*
 * SPDX-License-Identifier: Apache-2.0
 *
 * Copyright (c) 2026 Smile
 */

&usart1 {
	dmas = <&gpdma1 0 25 STM32_DMA_PERIPH_TX>,
	       <&gpdma1 1 24 STM32_DMA_PERIPH_RX>;
	dma-names = "tx", "rx";
};

&gpdma1 {
	status = "okay";
};
