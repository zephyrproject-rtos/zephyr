/*
 * Copyright (c) Qingsong Gou <gouqs@hotmail.com>
 * SPDX-License-Identifier: Apache-2.0
 */

&usart1 {
	dmas = <&dmac 1 SF32LB52X_DMA_REQ_USART1_TX SF32LB_DMA_PL_LOW>,
	       <&dmac 2 SF32LB52X_DMA_REQ_USART1_RX SF32LB_DMA_PL_LOW>;
	dma-names = "tx", "rx";
};
