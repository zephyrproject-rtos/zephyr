/*
 * Copyright (c) 2025 Silicon Laboratories Inc.
 *
 * SPDX-License-Identifier: Apache-2.0
 */

&dma0 {
	status = "okay";
};

&usart0 {
	dmas = <&dma0 DMA_REQSEL_USART0TXBL>,
	       <&dma0 DMA_REQSEL_USART0RXDATAV>;
	dma-names = "tx", "rx";
};
