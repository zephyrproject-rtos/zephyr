/*
 * SPDX-FileCopyrightText: Copyright (c) 2026 Infineon Technologies AG,
 * SPDX-FileCopyrightText: or an affiliate of Infineon Technologies AG. All rights reserved.
 *
 * SPDX-License-Identifier: Apache-2.0
 */

&dma0 {
	status = "okay";
};

&scb2 {
	compatible = "infineon,uart";
	status = "okay";
	current-speed = <115200>;

	clocks = <&peri0_group1_16bit_0>;

	pinctrl-0 = <&p6_7_scb2_uart_tx &p6_5_scb2_uart_rx>;
	pinctrl-names = "default";

	dmas = <&dma0 0>, <&dma0 1>;
	dma-names = "tx", "rx";
	mux-states = <&trigmux0 PSE84_PERI_0_TRIG_OUT_MUX_0_PDMA0_TR_IN0 IFX_TRIGMUX_EDGE
		      PSE84_PERI_0_TRIG_IN_MUX_0_SCB_TX_TR_OUT2>,
		     <&trigmux0 PSE84_PERI_0_TRIG_OUT_MUX_0_PDMA0_TR_IN1 IFX_TRIGMUX_LEVEL
		      PSE84_PERI_0_TRIG_IN_MUX_0_SCB_RX_TR_OUT2>;
	mux-state-names = "tx", "rx";
};

&trigmux0 {
	status = "okay";
};

&peri0_group1_16bit_0 {
	status = "okay";
	clock-div = <109>;
};
