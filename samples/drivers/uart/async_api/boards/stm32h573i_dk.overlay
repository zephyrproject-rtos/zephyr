/*
 * Copyright (c) 2025 STMicroelectronics
 *
 * SPDX-License-Identifier: Apache-2.0
 */

dut: &usart1 {
	dmas = <&gpdma1 22 STM32_DMA_PERIPH_TX>,
	       <&gpdma1 21 STM32_DMA_PERIPH_RX>;
	dma-names = "tx", "rx";
};
