/*
 * Copyright (c) 2025 STMicroelectronics
 *
 * SPDX-License-Identifier: Apache-2.0
 */

&usart2 {
	dmas = <&dmamux1 3 53 STM32_DMA_PERIPH_TX>,
	       <&dmamux1 4 52 STM32_DMA_PERIPH_RX>;
	dma-names = "tx", "rx";
};
