/*
 * Copyright (C) 2025 Savoir-faire Linux, Inc.
 *
 * SPDX-License-Identifier: Apache-2.0
 */

&uart5 {
	dmas = <&hpdma3 1 18 (STM32_DMA_PERIPH_TX)>,
	       <&hpdma3 0 17 (STM32_DMA_PERIPH_RX)>;
	dma-names = "tx", "rx";
	fifo-enable;
};

&hpdma3 {
	status = "okay";
};
