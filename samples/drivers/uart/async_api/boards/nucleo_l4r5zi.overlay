/*
 * Copyright (c) 2026 Waqar Ahmed
 *
 * SPDX-License-Identifier: Apache-2.0
 */

&lpuart1 {
	status = "okay";
	pinctrl-0 = <&lpuart1_tx_pg7 &lpuart1_rx_pg8>;
	pinctrl-names = "default";
	current-speed = <115200>;

	dmas = <&dmamux1 5 34 STM32_DMA_PERIPH_TX>,
	       <&dmamux1 4 35 STM32_DMA_PERIPH_RX>;
	dma-names = "tx", "rx";
};

&dma1 {
	status = "okay";
};

&dmamux1 {
	status = "okay";
};
