/*
 * Copyright (c) 2025 STMicroelectronics
 *
 * SPDX-License-Identifier: Apache-2.0
 */

&usart2 {
	dmas = <&dmamux1 5 53 STM32_DMA_PERIPH_TX>,
	       <&dmamux1 4 52 STM32_DMA_PERIPH_RX>;
	dma-names = "tx", "rx";
};

&dma1 {
	status = "okay";
};

&dmamux1 {
	status = "okay";
};
