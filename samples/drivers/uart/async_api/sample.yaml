## samples/drivers/uart/async_api/sample.yaml
```yaml
sample:
  name: UART ASYNC API driver sample
tests:
  sample.drivers.uart.async_api:
    integration_platforms:
      - nrf52840dk/nrf52840
    tags:
      - serial
      - uart
    filter: CONFIG_SERIAL and
            CONFIG_UART_ASYNC_API and
            dt_chosen_enabled("zephyr,shell-uart") and
            not CONFIG_UART_MCUX_LPUART
    harness: keyboard
  sample.drivers.uart.async_api.lpuart:
    tags:
      - serial
      - uart
    filter: CONFIG_SERIAL and
            CONFIG_UART_ASYNC_API and
            dt_chosen_enabled("zephyr,shell-uart") and
            CONFIG_UART_MCUX_LPUART and
            not CONFIG_CPU_HAS_DCACHE
    depends_on: dma
    harness: keyboard
  sample.drivers.uart.async_api.console:
    integration_platforms:
      - nucleo_g071rb/stm32g071xx
    filter: CONFIG_SERIAL and
            CONFIG_UART_ASYNC_API and
            dt_chosen_enabled("zephyr,shell-uart")
    harness: console
    harness_config:
      type: multi_line
      regex:
        - "Loop (.*) Sending (.*)"
        - "RX is now enabled"
        - "Loop (.*) Sending (.*)"
        - "RX is now disabled"
```

## samples/drivers/uart/basic_async_rx/sample.yaml
```yaml
sample:
  name: Basic Async RX
  description: |
    Simple application that receives data on UART1 RX and outputs to console.
  platforms: lp_mspm0g3507

tests:
  sample.drivers.uart.basic_async_rx:
    tags: uart
    harness: console
    harness_config:
      type: one_line
      regex:
        - "RX enabled and listening on PA18"
```

## samples/drivers/uart/echo_bot/sample.yaml
```yaml
sample:
  name: UART driver sample
tests:
  sample.drivers.uart:
    integration_platforms:
      - qemu_x86
    tags:
      - serial
      - uart
    filter: CONFIG_SERIAL and
            CONFIG_UART_INTERRUPT_DRIVEN and
            dt_chosen_enabled("zephyr,shell-uart")
    harness: pytest
```

## samples/drivers/uart/echo_bot_rs485/sample.yaml
```yaml
sample:
  name: UART RS485 Echo Bot
  description: RS485 echo bot sample using UART with transceiver control
tests:
  sample.drivers.uart.rs485:
    platform_allow:
      - same54_xpro
    integration_platforms:
      - same54_xpro
    tags:
      - serial
      - uart
      - rs485
    filter: CONFIG_SERIAL and
            CONFIG_UART_INTERRUPT_DRIVEN and
            CONFIG_GPIO and
            dt_chosen_enabled("zephyr,shell-uart")
    harness: keyboard
```

## samples/drivers/uart/native_tty/sample.yaml
```yaml
sample:
  name: Native TTY sample
tests:
  sample.drivers.uart.native_tty:
    build_only: true
    platform_allow:
      - native_sim
    tags:
      - serial
      - uart
```

## samples/drivers/uart/passthrough/boards/nucleo_l4a6zg.conf
```kconfig
# Copyright (c) 2025 Joel Guittet
# SPDX-License-Identifier: Apache-2.0

CONFIG_UART_BITBANG=y
```

## samples/drivers/uart/passthrough/sample.yaml
```yaml
sample:
  name: UART Passthrough
tests:
  sample.drivers.uart.passthrough:
    platform_allow:
      - nucleo_l476rg
    tags:
      - serial
      - uart
    harness: keyboard
```

## samples/drivers/uart/stm32/single_wire/sample.yaml
```yaml
sample:
  name: STM32 Single Wire UART sample
tests:
  sample.drivers.uart.stm32.single_wire:
    platform_allow: stm32f3_disco
    tags: drivers uart
    harness: console
    harness_config:
      fixture: single_line_uart_loopback
      type: one_line
      regex:
        - "Received c"
```

## samples/drivers/uart/uart_rs485/sample.yaml
```yaml
sample:
  name: UART RS48API
tests:
  sample.drivers.uart.кrs485:
    platform_allow:
      - nucleo_f411re
    tags:
      - serial
      - uart
      - rs485
    harness: keyboard
```

## samples/drivers/ublox_sara_n310/sample.yaml
```yaml
sample:
  name: N310 Modem Sample
tests:
  sample.drivers.ublox_sara_n310:
    tags: modem net
    depends_on: gpio modem net
```

## samples/drivers/usb/vbus_detect/sample.yaml
```yaml
# Copyright (c) 2026 Leica Geosystems AG
# SPDX-License-Identifier: Apache-2.0

sample:
  name: USB VBUS Detection Sample
  description: Demonstrates USB VBUS detection using GPIO

common:
  tags:
    - usb
    - vbus
    - gpio

tests:
  sample.drivers.usb.vbus_detect:
    platform_allow:
      - disco_l475_iot1
    build_only: true
```

## samples/drivers/video/arducam_mega_full-featured/sample.yaml
```yaml
sample:
  name: arducam mega camera full-featured test
tests:
  sample.video.arducam_mega_full-featured:
    build_only: true
    tags: video
    platform_allow:
      - rpi_pico
    integration_platforms:
      - rpi_pico
```

## samples/drivers/video/capture/Kconfig
```kconfig
# Copyright (c) 2024 Espressif Systems (Shanghai) Co., Ltd.
# SPDX-License-Identifier: Apache-2.0

mainmenu "Video capture sample application"

menu "Video capture configuration"

config VIDEO_SOURCE_CROP_LEFT
	int "Crop area left value"
	default 0
	help
	   Left value of the crop area within the video source.

config VIDEO_SOURCE_CROP_TOP
	int "Crop area top value"
	default 0
	help
	   Top value of the crop area within the video source.

config VIDEO_SOURCE_CROP_WIDTH
	int "Crop area width value"
	default 0
	help
	   Width value of the crop area within the video source.
	   If set to 0, the crop is not applied.

config VIDEO_SOURCE_CROP_HEIGHT
	int "Crop area height value"
	default 0
	help
	   Height value of the crop area within the video source.
	   If set to 0, the crop is not applied.

config VIDEO_FRAME_HEIGHT
	int "Height of the video frame"
	default 0
	help
	  Height of the video frame. If set to 0, the default height is used.

config VIDEO_FRAME_WIDTH
	int "Width of the video frame"
	default 0
	help
	  Width of the video frame. If set to 0, the default width is used.

config VIDEO_PIXEL_FORMAT
	string "Pixel format of the video frame"
	help
	  Pixel format of the video frame. If not set, the default pixel format is used.

config VIDEO_CTRL_HFLIP
	bool "Mirror the video frame horizontally"
	help
	  If set, mirror the video frame horizontally

config VIDEO_CTRL_VFLIP
	bool "Mirror the video frame vertically"
	help
	  If set, mirror the video frame vertically

config VIDEO_SHELL_AND_CAPTURE
	bool "Capture video even if the video shell is enabled"
	depends on VIDEO_SHELL
	default n
	help
	  If set, the video capture is enabled even if the video shell is also enabled.

endmenu

source "Kconfig.zephyr"
```

## samples/drivers/video/capture/boards/Kconfig.nxp_jpegdec
```kconfig
# Copyright 2026 NXP
# SPDX-License-Identifier: Apache-2.0

config VIDEO_NXP_JPEGDEC_CSC
	bool "Convert pixel format NV12 to RGB565"
	default y
	help
	   Use software implemented CSC function to convert
	   the NV12 pixel format to RGB565 for the display driver
	   to use
```

## samples/drivers/video/capture/boards/arduino_nicla_vision_stm32h747xx_m7.conf
```kconfig
CONFIG_VIDEO_BUFFER_POOL_NUM_MAX=2
CONFIG_VIDEO_BUFFER_POOL_SZ_MAX=160000
CONFIG_DMA=y

CONFIG_MAIN_STACK_SIZE=4096

CONFIG_SERIAL=y
CONFIG_CONSOLE=y
CONFIG_UART_CONSOLE=y
CONFIG_UART_LINE_CTRL=y
```

## samples/drivers/video/capture/boards/ek_ra8d1.conf
```kconfig
CONFIG_VIDEO_FRAME_WIDTH=320
CONFIG_VIDEO_FRAME_HEIGHT=240
CONFIG_VIDEO_BUFFER_POOL_SZ_MAX=155000
CONFIG_VIDEO_BUFFER_POOL_NUM_MAX=2
CONFIG_VIDEO_BUFFER_POOL_HEAP_SIZE=310000
```

## samples/drivers/video/capture/boards/esp32s3_eye_procpu.conf
```kconfig
CONFIG_VIDEO_BUFFER_POOL_HEAP_SIZE=230400
CONFIG_VIDEO_BUFFER_POOL_NUM_MAX=2
CONFIG_ESP_SPIRAM=y
CONFIG_SPIRAM_MODE_OCT=y
CONFIG_VIDEO_BUFFER_POOL_ALIGN=32
CONFIG_DMA_ESP32_MAX_DESCRIPTOR_NUM=64
CONFIG_VIDEO_BUFFER_USE_SHARED_MULTI_HEAP=y
CONFIG_VIDEO_BUFFER_SMH_ATTRIBUTE=2
CONFIG_VIDEO_FRAME_HEIGHT=240
CONFIG_VIDEO_FRAME_WIDTH=240
CONFIG_VIDEO_PIXEL_FORMAT="RGBP"
CONFIG_VIDEO_CTRL_VFLIP=y
```

## samples/drivers/video/capture/boards/frdm_mcxn236.conf
```kconfig
CONFIG_VIDEO_BUFFER_POOL_HEAP_SIZE=80000
CONFIG_VIDEO_BUFFER_POOL_SZ_MAX=40000
CONFIG_VIDEO_FRAME_WIDTH=320
CONFIG_VIDEO_FRAME_HEIGHT=240
```

## samples/drivers/video/capture/boards/imx95_evk_mimx9596_m7_ddr.conf
```kconfig
CONFIG_VIDEO_BUFFER_POOL_NUM_MAX=4
CONFIG_VIDEO_BUFFER_POOL_HEAP_SIZE=16000000
CONFIG_PM_DEVICE=y
CONFIG_VIDEO_CAM_NUM_BUFS=3
```

## samples/drivers/video/capture/boards/mimxrt1064_evk.conf
```kconfig
# Leverage PXP to mirror image by flipping
CONFIG_DMA=y
CONFIG_MCUX_ELCDIF_PXP=y
CONFIG_MCUX_ELCDIF_PXP_FLIP_HORIZONTAL=y

# Workaround for issue where the CSI driver needs to initialize before
# the camera sensor, so that it can provide clock for the camera device
CONFIG_CHECK_INIT_PRIORITIES=n
```

## samples/drivers/video/capture/boards/mimxrt700_evk_mimxrt798s_cm33_cpu0.conf
```kconfig
#
# Copyright 2026 NXP
#
# SPDX-License-Identifier: Apache-2.0
#

# CONFIG_VIDEO_PIXEL_FORMAT="JPEG"
# CONFIG_VIDEO_TRANSFORM="nxp_jpegdec"
CONFIG_VIDEO_PIXEL_FORMAT="PNG "
CONFIG_VIDEO_TRANSFORM="nxp_pngdec"
CONFIG_VIDEO_FRAME_WIDTH=320
CONFIG_VIDEO_FRAME_HEIGHT=160
CONFIG_VIDEO_BUFFER_POOL_HEAP_SIZE=400000
CONFIG_DCACHE=n
CONFIG_VIDEO_CAM_NUM_BUFS=1
CONFIG_HEAP_MEM_POOL_SIZE=103000
```
