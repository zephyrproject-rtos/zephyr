/*
 * Copyright (c) 2022 Intel Corporation
 *
 * SPDX-License-Identifier: Apache-2.0
 */

#include <zephyr/dt-bindings/pcie/pcie.h>

&smbus0 {
	eeprom2: smbus_eeprom@50 {
		compatible = "jedec,smbus-eeprom";
		reg = <0x50>;
		size = <0x100>;

		status = "okay";
	};
};
