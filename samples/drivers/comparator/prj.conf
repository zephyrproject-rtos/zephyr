## CMakeLists.txt
```
# SPDX-License-Identifier: Apache-2.0

cmake_minimum_required(VERSION 3.20.0)

find_package(Zephyr REQUIRED HINTS $ENV{ZEPHYR_BASE})
project(comparator)

target_sources(app PRIVATE src/main.c)
```

## sample.yaml
```
sample:
  name: Comparator driver sample
tests:
  sample.drivers.comparator:
    filter: dt_nodelabel_enabled("comp_dev")
    integration_platforms:
      - nrf52840dk_nrf52840
      - nrf5340dk_nrf5340_cpuapp
    harness: console
    harness_config:
      type: multi_line
      ordered: true
      regex:
        - "Comparator driver sample on .*"
        - "Comparator started"
```

## prj.conf
```kconfig
CONFIG_COMPARATOR=y
CONFIG_REGULATOR=y
```

## boards/lp_mspm0g3507.overlay
```dts
&comp0 {
	status = "okay";
	positive-inputs = <2>;
	negative-inputs = <0>;
	pinctrl-0 = <&comp0_out_pa7>;
	pinctrl-names = "default";
	mode = "fast";
	reference-source = "int_vref";
	reference-terminal = "neg";
	filter-enable;
	filter-delay = <2700>;
	window-mode-enable;
	window-companion =<&comp1>;
	window-signal-input = <0>;
	window-upper-threshold = <2>;
	window-lower-threshold = <2>;
	vref = <&vref0>;
};

&comp1 {
	status = "okay";
	pinctrl-0 = <&comp1_out_pa3>;
	pinctrl-names = "default";
};

&vref0 {
	status = "okay";
};
```

## boards/lp_mspm0l2228.overlay
```dts
&comp0 {
	status = "okay";
	positive-inputs = <1>;
	negative-inputs = <0>;
	pinctrl-0 = <&comp0_out_pa03>;
	pinctrl-names = "default";
	mode = "fast";
	reference-source = "int_vref";
	reference-terminal = "neg";
	filter-enable;
	filter-delay = <2700>;
	vref = <&vref0>;
};
&vref0 {
	status = "okay";
};
```

## boards/nrf52840dk_nrf52840.overlay
```dts
comp_dev: &comp {
	compatible = "nordic,nrf-comp";
	status = "okay";

	initial-configuration {
		input-positive = < NRF_COMP_POS_AIN1 >; /* P0.03 */
		input-negative = < NRF_COMP_NEG_SE_VDD >;
		flags = < (COMPARATOR_FLAG_SIGNAL_BELOW |
			   COMPARATOR_FLAG_SIGNAL_ABOVE |
			   NRF_COMP_FLAG_SE_THDOWN(47) |
			   NRF_COMP_FLAG_SE_THUP(55)) >;
	};
};
```

## boards/nrf5340dk_nrf5340_cpuapp.overlay
```dts
comp_dev: &comp {
	compatible = "nordic,nrf-lpcomp";
	status = "okay";

	initial-configuration {
		input-positive = < NRF_LPCOMP_POS_AIN0 >; /* P0.04 */
		input-negative = < NRF_LPCOMP_NEG_VDD_7_8 >;
		flags = < (COMPARATOR_FLAG_SIGNAL_BELOW |
			   COMPARATOR_FLAG_SIGNAL_ABOVE |
			   NRF_LPCOMP_FLAG_ENABLE_HYSTERESIS) >;
	};
};
```

## src/main.c
```c
/*
 * Copyright (c) 2025 Linumiz GmbH
 *
 * SPDX-License-Identifier: Apache-2.0
 */

#include <zephyr/kernel.h>
#include <zephyr/drivers/comparator.h>

void comp_callback(const struct device *dev, void *user_data)
{
	int val;

	val = comparator_get_output(dev);
	printk("Comparator triggered! Output: %d\n", val);
}

int main(void)
{
	const struct device *comp = DEVICE_DT_GET(DT_NODELABEL(comp0));
	int ret;

	if (!device_is_ready(comp)) {
		printk("Comparator not ready\n");
		return 0;
	}

	comparator_set_trigger_callback(comp, comp_callback, NULL);

	ret = comparator_set_trigger(comp, COMPARATOR_TRIGGER_RISING_EDGE);
	if (ret < 0) {
		printk("failed to set trigger\n");
		return 0;
	}

	return 0;
}
```
