## CMakeLists.txt
```
# Copyright (c) 2024 Nordic Semiconductor
# SPDX-License-Identifier: Apache-2.0

cmake_minimum_required(VERSION 3.20.0)
find_package(Zephyr REQUIRED HINTS $ENV{ZEPHYR_BASE})
project(comparator_sample)

target_sources(app PRIVATE src/main.c)
```

## sample.yaml
```
# Copyright (c) 2024 Nordic Semiconductor ASA
# SPDX-License-Identifier: Apache-2.0

sample:
  name: Comparator wakeup sample
tests:
  sample.drivers.comparator.wakeup:
    tags:
      - drivers
      - comparator
    filter: dt_alias_exists("comparator")
```

## prj.conf
```kconfig
# Copyright (c) 2024 Nordic Semiconductor ASA
# SPDX-License-Identifier: Apache-2.0

CONFIG_COMPARATOR=y
CONFIG_POWEROFF=y
```

## boards/nrf5340dk_nrf5340_cpuapp.overlay
```dts
/*
 * Copyright (c) 2024 Nordic Semiconductor
 *
 * SPDX-License-Identifier: Apache-2.0
 */

/{
	aliases {
		comparator = &comp;
	};
};

&comp {
	compatible = "nordic,nrf-lpcomp";
	positive-input = "INPUT_0"; /* P0.04 */
	external-reference = "REF1"; /* P0.05 */
	reference-selection = "EXT_REF";
	hysteresis = "ENABLED";
	status = "okay";
};
```

## src/main.c
```c
/*
 * Copyright (c) 2024 Nordic Semiconductor
 *
 * SPDX-License-Identifier: Apache-2.0
 */

#include <zephyr/drivers/comparator.h>
#include <zephyr/kernel.h>
#include <zephyr/sys/poweroff.h>
#include <stdio.h>

const struct device *sample_comparator = DEVICE_DT_GET(DT_ALIAS(comparator));

int main(void)
{
	int ret;

	ret = comparator_set_trigger(sample_comparator, COMPARATOR_TRIGGER_BOTH_EDGES);
	if (ret < 0) {
		printf("failed to set comparator trigger (ret = %i)\n", ret);
	}

	printf("delay before poweroff\n");
	k_msleep(5000);

	printf("check if trigger is pending to clear it\n");
	ret = comparator_trigger_is_pending(sample_comparator);
	if (ret == 1) {
		printf("comparator trigger was %s\n", "pending");
	} else if (ret == 0) {
		printf("comparator trigger was %s\n", "not pending");
	} else {
		printf("failed to check if comparator trigger was pending (ret = %i)\n", ret);
	}

	printf("poweroff\n");
	sys_poweroff();
	return 0;
}
```
