## samples/arch/smp/pi/sample.yaml
```yaml
sample:
  description: Calculation of Pi independently in
    a number of threads
  name: SMP Pi
common:
  platform_key:
    - arch
  tags:
    - smp
  depends_on:
    - smp
  integration_platforms:
    - qemu_x86_64
  harness: console
  harness_config:
    type: multi_line
    ordered: true
    regex:
      - "Calculate first [0-9]+ digits of Pi independently by [0-9]+ threads.(.*)"
      - "Pi value calculated by thread #[0-9]+: [0-9]+(.*)"
      - "All [0-9]+ threads executed by [0-9]+ cores in [0-9]+ msec(.*)"
tests:
  sample.smp.pi: {}
```

## samples/arch/smp/pktqueue/sample.yaml
```yaml
sample:
  description: Processing multiple queues in a number of threads
  name: SMP Pktqueue
common:
  tags: introduction
  harness: console
  harness_config:
    type: multi_line
    ordered: true
    regex:
      - "RESULT: OK(.*)"

tests:
  sample.smp.pktqueue:
    tags:
      - introduction
      - kernel
    depends_on:
      - smp
    filter: (CONFIG_MP_MAX_NUM_CPUS > 1)
    integration_platforms:
      - qemu_x86_64
```

## samples/audio/sof/boards/intel_adsp_cavs15.conf
```kconfig
CONFIG_APOLLOLAKE=y
CONFIG_INTEL_DMIC=y
CONFIG_INTEL_SSP=y
CONFIG_CORE_COUNT=1
CONFIG_LP_MEMORY_BANKS=2
CONFIG_HP_MEMORY_BANKS=8
CONFIG_PERFORMANCE_COUNTERS=y
CONFIG_COMP_SRC_SMALL=y
```

## samples/audio/sof/boards/intel_adsp_cavs18.conf
```kconfig
CONFIG_CANNONLAKE=y
CONFIG_INTEL_DMIC=y
CONFIG_INTEL_SSP=y
CONFIG_INTEL_ALH=y
CONFIG_LP_MEMORY_BANKS=1
CONFIG_HP_MEMORY_BANKS=47
CONFIG_PERFORMANCE_COUNTERS=y
```

## samples/audio/sof/sample.yaml
```yaml
sample:
  description: Audio with SOF
  name: sof
common:
    tags: audio
tests:
  sample.audio.sof:
    tags: sof
    build_only: true
    platform_allow: intel_adsp_cavs15
    integration_platforms:
      - intel_adsp_cavs15
```

## samples/authentication/bluetooth/central_auth/sample.yaml
```yaml
sample:
  description: Auth central sample app
  name: Auth Central
tests:
  sample.central_auth:
    build_only: true
    harness: bluetooth
    platform_allow: nrf52840dk_nrf52840
    tags: bluetooth authentication
```

## samples/authentication/bluetooth/peripheral_auth/sample.yaml
```yaml
sample:
  description: Auth peripheral sample app
  name: Auth Peripheral
tests:
  sample.peripheral_auth:
    build_only: true
    harness: bluetooth
    platform_allow: nrf52840dk_nrf52840
    tags: bluetooth authentication
```

## samples/authentication/multi_instance/auth_client/sample.yaml
```yaml
sample:
  description: Auth Multi Instance Client sample app
  name: Auth Client Multi Instance
tests:
  sample.auth_client_multi:
    build_only: true
    harness: bluetooth
    platform_allow: nrf52840dk_nrf52840
    tags: bluetooth authentication
```

## samples/authentication/multi_instance/auth_server/sample.yaml
```yaml
sample:
  description: Auth Multi Instance Server sample app
  name: Auth Server Multi Instance
tests:
  sample.auth_server_multi:
    build_only: true
    harness: bluetooth
    platform_allow: nrf52840dk_nrf52840
    tags: bluetooth authentication
```

## samples/authentication/serial/auth_client/sample.yaml
```yaml
sample:
  description: Auth Client serial transport sample app
  name: Auth Client Serial
tests:
  sample.auth_client_serial:
    build_only: true
    harness: bluetooth
    platform_allow: nrf52840dk_nrf52840
    tags: authentication
```

## samples/authentication/serial/auth_server/sample.yaml
```yaml
sample:
  description: Auth Server serial transport sample app
  name: Auth Server Serial
tests:
  sample.auth_server_serial:
    build_only: true
    harness: bluetooth
    platform_allow: nrf52840dk_nrf52840
    tags: authentication
```

## samples/basic/blink_led/boards/nrf52810_pca10040.conf
```kconfig
# The nrfx Hardware PWM driver cannot be used in this sample since the driver
# does not allow to set a period longer than ~262 ms. Disabling this driver
# will make the nRF SW PWM driver enabled by default.
CONFIG_PWM_NRFX=n
```

## samples/basic/blink_led/sample.yaml
```yaml
sample:
  name: Blink LED (PWM based)
tests:
  sample.basic.blink_led:
    # FIXME: We should remove those and just rely on depends_on
    filter: dt_alias_exists("pwm-led0")
    tags: drivers pwm
    depends_on: pwm
    harness: led
```

## samples/basic/blinky/boards/intel_socfpga_agilex_socdk.conf
```kconfig
# Copyright (c) 2023, Intel Corporation.
# SPDX-License-Identifier: Apache-2.0

CONFIG_STDOUT_CONSOLE=y
CONFIG_PRINTK=y
```

## samples/basic/blinky/boards/pico_plus2_rp2350b_m33_w.conf
```kconfig
# the LED is connected to the wifi controller
CONFIG_NETWORKING=y
CONFIG_WIFI=y
CONFIG_MAIN_STACK_SIZE=2048
CONFIG_TEST_RANDOM_GENERATOR=y
```

## samples/basic/blinky/boards/rpi_pico_rp2040_w.conf
```kconfig
CONFIG_ENTROPY_GENERATOR=y
CONFIG_TEST_RANDOM_GENERATOR=y

CONFIG_NETWORKING=y
CONFIG_WIFI=y
CONFIG_CYW43439=y
```

## samples/basic/blinky/sample.yaml
```yaml
sample:
  name: Blinky Sample
tests:
  sample.basic.blinky:
    tags:
      - LED
      - gpio
    filter: dt_enabled_alias_with_parent_compat("led0", "gpio-leds")
    depends_on: gpio
    harness: led
    integration_platforms:
      - frdm_k64f
```

## samples/basic/blinky_led/boards/rpi_pico_rp2040_w.conf
```kconfig
CONFIG_NETWORKING=y

CONFIG_ENTROPY_GENERATOR=y
CONFIG_TEST_RANDOM_GENERATOR=y

CONFIG_WIFI=y
CONFIG_CYW43439=y

CONFIG_LED_PICO_W=y
```

## samples/basic/blinky_led/sample.yaml
```yaml
sample:
  name: Blinky LED Sample
tests:
  sample.basic.blinky_led:
    tags:
      - LED
      - gpio
    filter: dt_enabled_alias_with_parent_compat("led0", "gpio-leds")
    depends_on: gpio
    harness: led
    integration_platforms:
      - frdm_k64f
```

## samples/basic/blinky_pwm/sample.yaml
```yaml
sample:
  name: Blink LED (PWM based)
tests:
  sample.basic.blink_led:
    filter: dt_alias_exists("pwm-led0") and dt_compat_enabled("pwm-leds")
    tags:
      - drivers
      - pwm
    depends_on: pwm
    harness: led
    platform_exclude: rpi_pico/rp2040/w
```

## samples/basic/button/sample.yaml
```yaml
sample:
  name: Button Sample
tests:
  sample.basic.button:
    integration_platforms:
      - nrf52833dk/nrf52820
    build_only: true
```
