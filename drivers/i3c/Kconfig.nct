## drivers/i3c/Kconfig.nct
```kconfig
# NCT I3C driver configuration options

# Copyright (c) 2024 Nuvoton Technology Corporation.
# SPDX-License-Identifier: Apache-2.0

config I3C_NCT
	bool "Nuvoton NCT enhance super I/O (eSIO) I3C driver"
	depends on DT_HAS_NUVOTON_NCT_I3C_ENABLED
	select I3C_IBI_WORKQUEUE if I3C_USE_IBI
	default y
	help
	  This option enables the I3C driver for NCT family of
	  processors.
	  Say y if you wish to use I3C channels on NCT MCU.

config I3C_NCT_DMA
	bool "Nuvoton NCT enhance super I/O (eSIO) I3C driver DMA support"
	depends on I3C_NCT
	default y
	help
	  Enable DMA support for nct I3C.

config I3C_NCT_EXT_DEVICE
	bool "Enable NCT I3C external device support"
	depends on I3C
	help
	  Enable support for NCT I3C external device driver.

comment "Initialization Priority"

config I3C_TARGET_INIT_PRIORITY
	int "I3C Target Init Priority"
	# Default is just after CONFIG_KERNEL_INIT_PRIORITY_DEVICE
	default 50
	help
	  This is for setting up I3C target device driver instance

# to support 2.6 only
source "drivers/i3c/slave/Kconfig"
```

## drivers/i3c/Kconfig.npcm
```kconfig
# NPCM I3C driver configuration options

# Copyright (c) 2024 Nuvoton Technology Corporation.
# SPDX-License-Identifier: Apache-2.0

config I3C_NPCM
	bool "Nuvoton NPCM enhance super I/O (eSIO) I3C driver"
	depends on DT_HAS_NUVOTON_NPCM_I3C_ENABLED
	select I3C_IBI_WORKQUEUE if I3C_USE_IBI
	default y
	help
	  This option enables the I3C driver for NPCM family of
	  processors.
	  Say y if you wish to use I3C channels on NPCM MCU.

config I3C_NPCM_DMA
	bool "Nuvoton NPCM enhance super I/O (eSIO) I3C driver DMA support"
	depends on I3C_NPCM
	default y
	help
	  Enable DMA support for npcm I3C.
```

## drivers/i3c/Kconfig.npcx
```kconfig
# NPCX I3C driver configuration options

# Copyright (c) 2024 Nuvoton Technology Corporation.
# SPDX-License-Identifier: Apache-2.0

DT_I3C_NPCX := $(dt_nodelabel_path,i3c0)

config I3C_NPCX
	bool "Nuvoton NPCX embedded controller (EC) I3C driver"
	depends on DT_HAS_NUVOTON_NPCX_I3C_ENABLED
	select RESET
	select I3C_IBI_WORKQUEUE if I3C_USE_IBI
	select PINCTRL
	default y
	help
	  This option enables the I3C driver for NPCX family of
	  processors.
	  Say y if you wish to use I3C channels on NPCX MCU.

# Expose this option when the 'reg' property includes the MDMA base address
# as the second group in the phandle-array.
# i.e. I3C node example in dtsi file.
# i3c0: i3c@400f0000 {
#	....
#	/* reg[0]: I3C_1 register, reg[1]: MDMA5 register */
#	reg-names = "i3c1", "mdma5";
#	reg = <0x400f0000 0x2000>,
#	      <0x40011500 0x100>;
#  	....
# }
config I3C_NPCX_DMA
	bool "Nuvoton NPCX embedded controller (EC) serial driver DMA support"
	depends on I3C_NPCX && "$(dt_node_reg_addr_hex,$(DT_I3C_NPCX),1)" != 0
	default y
	help
	  Enable support for npcx I3C DMA mode.
```

## drivers/i3c/Kconfig.nxp
```kconfig
# Copyright (c) 2022 Intel Corporation
#
# SPDX-License-Identifier: Apache-2.0

DT_COMPAT_NXP_MCUX_I3C := nxp,mcux-i3c

module = I3C_MCUX
module-str = i3c-mcux
source "subsys/logging/Kconfig.template.log_config"

config I3C_MCUX
	bool "MCUX I3C driver"
	depends on HAS_MCUX
	depends on DT_HAS_NXP_MCUX_I3C_ENABLED
	select PINCTRL
	select I3C_IBI_WORKQUEUE if I3C_USE_IBI
	default y
	help
	  Enable mcux I3C driver.

config I3C_NXP_TRANSFER_TIMEOUT
	int "Transfer timeout [ms]"
	default 500
	depends on I3C_MCUX
	help
	  Timeout in milliseconds used for each I3C transfer.
	  0 means that the driver should use the K_FOREVER value,
	  i.e. it should wait as long as necessary.
```

## drivers/i3c/Kconfig.renesas
```kconfig
# Copyright (c) 2025 Renesas Electronics Corporation
# SPDX-License-Identifier: Apache-2.0

config I3C_RENESAS_RA
	bool "Renesas RA I3C driver support"
	default y
	depends on DT_HAS_RENESAS_RA_I3C_ENABLED
	select USE_RA_FSP_I3C
	select PINCTRL
	help
	  Enable support for I3C on Renesas RA microcontrollers.
```

## drivers/i3c/Kconfig.sedi
```kconfig
#
# Copyright (c) 2024 Intel Corporation.
#
# SPDX-License-Identifier: Apache-2.0
#

module = I3C_SEDI
module-str = i3c-sedi
source "subsys/logging/Kconfig.template.log_config"

config I3C_SEDI
	bool "Design Ware I3C based on SEDI"
	default n
	help
	  Include I3C drivers in the system configuration.

if I3C_SEDI

config GPIO_DEV
	string "GPIO instance name"
	depends on GPIO_SEDI
	default "GPIO0"
	help
	  GPIO instance name

config ISH_STATIC_I3C_MODE
	bool "Enable ISH static sensor mode"
	default y

endif #I3C_SEDI
```

## drivers/i3c/Kconfig.stm32
```kconfig
# Copyright (c) 2024 EXALT Technologies.
#
# SPDX-License-Identifier: Apache-2.0

module = I3C_STM32
module-str = i3c_stm32

source "subsys/logging/Kconfig.template.log_config"
config I3C_STM32
	bool "STM32 I3C driver support"
	depends on DT_HAS_ST_STM32_I3C_ENABLED
	select I3C_IBI_WORKQUEUE if I3C_USE_IBI
	select PINCTRL
	default y
	help
	  Enable support for I3C on STM32 microcontrollers.

if I3C_STM32

config I3C_STM32_DMA
	bool "STM32 I3C DMA driver support"
	select DMA
	help
	  Enables support for I3C DMA mode on STM32 microcontrollers.

config I3C_STM32_DMA_FIFO_HEAP_SIZE
	int "Status FIFO and control FIFO heap"
	depends on I3C_STM32_DMA
	default 2048
	help
	  Configures the heap size for dynamically allocating the regions for
	  storing status FIFO and control FIFO words which will be used by the DMA.
	  This value depends on the maximum number of messages that will be sent
	  during a single transfer. 2KB guarantees enough heap size for sending 256
	  messages on a single transfer.

endif # I3C_STM32
```

## drivers/i3c/Kconfig.test
```kconfig
# Copyright (c) 2021, Commonwealth Scientific and Industrial Research
# Organisation (CSIRO) ABN 41 687 119 230.
# Copyright (c) 2023 STMicroelectronics
#
# SPDX-License-Identifier: Apache-2.0

# Hidden option for turning on the dummy driver for vnd,i3c devices
# used in testing.
config I3C_TEST
	def_bool DT_HAS_VND_I3C_ENABLED
	depends on DT_HAS_VND_I3C_ENABLED
```

## drivers/i3c/mux/Kconfig.renesas
```kconfig
# Copyright (c) 2022 Google LLC
# SPDX-License-Identifier: Apache-2.0

config I3C_RENESAS_IMX3112
	bool "Renesas I3C 2:1 bus multiplexer imx3112"
	help
	   Enable the renesas imx3112 mux

config I3C_RENESAS_MUX_INIT_PRIORITY
	int "I3C Renesas Mux Init Priority"
	# Default is just after I3C_CONTROLLER_INIT_PRIORITY
	depends on I3C_RENESAS_IMX3112
	default 51
	help
	  This is used for setting up an I3C renesas mux, by configuring
	  the electrical parameters and doing device discovery.

	  Note that this needs to be done before the device driver
	  instances of the connected I3C devices start
	  initializing those devices, but after the bus controller finishes
	  initialization.

	  Additionally, since each individual channel in the
	  mux (controlled by I3C_RENESAS_CHANNEL_INIT_PRIORITY) has its own init
	  function, the mux init must be completed before.

	  In summary, in a typical I3C bus using a mux, the order of priorities should be:
	  1. I3C_CONTROLLER_INIT_PRIORITY
	  2. I3C_RENESAS_MUX_INIT_PRIORITY
	  3. I3C_RENESAS_CHANNEL_INIT_PRIORITY
	  4. I3C_TARGET_INIT_PRIORITY


config I3C_RENESAS_CHANNEL_INIT_PRIORITY
	int "I3C Renesas Mux Init Priority"
	# Default is just after I3C_RENESAS_MUX_INIT_PRIORITY
	default 52
	depends on I3C_RENESAS_IMX3112
	help
	  This is used for setting up an I3C renesas mux channels by
	  doing device discovery in each channel. This priority should be higher than
	  I3C_RENESAS_MUX_INIT_PRIORITY but lower than that of the devices attached
	  to this channel.
```

## drivers/i3c/slave/Kconfig
```kconfig
# I3C Slave configuration options

# Copyright (c) 2021 ASPEED Technology Inc.
# SPDX-License-Identifier: Apache-2.0

#
# I3C slave options
#
menuconfig I3C_SLAVE
	bool "I3C Slave Drivers"
	help
	  Enable I3C Slave Driver Configuration

if I3C_SLAVE

config I3C_SLAVE_INIT_PRIORITY
	int "Init priority"
	default 60
	help
	  I3C Slave device driver initialization priority.

	source "drivers/i3c/slave/Kconfig.i3c_slave_mqueue"

endif # I3C_SLAVE
```

## drivers/i3c/slave/Kconfig.i3c_slave_mqueue
```kconfig
# I3C Slave mqueue configuration options

# Copyright (c) 2021 Aspeed Technology Inc.
# SPDX-License-Identifier: Apache-2.0

config I3C_SLAVE_MQUEUE
	bool "I3C Slave MQueue driver"
	default y
	help
	  Enable I3C slave mqueue driver
```

## drivers/ieee802154/Kconfig
```kconfig
# IEEE 802.15.4 driver configuration options

# Copyright (c) 2015 Intel Corporation
# SPDX-License-Identifier: Apache-2.0

#
# IEEE 802.15.4 options
#
menuconfig IEEE802154
	bool "IEEE 802.15.4 drivers"
	depends on NETWORKING
	default y if NET_L2_PHY_IEEE802154

if IEEE802154

config IEEE802154_NET_IF_NO_AUTO_START
	bool "IEEE 802.15.4 interface without auto-start"
	help
	  This option allows user to set any configuration and/or filter before
	  the radio becomes operational. For instance, the EUI-64 value can be
	  configured using net_if_set_link_addr(iface, mac, 8,
	  NET_LINK_IEEE802154).
	  When all configurations are done net_if_up() has to be invoked to
	  bring the interface up.

	  This option can be useful when using OpenThread or Zigbee. If you
	  have any doubt about this option leave it as default value.

if !NET_L2_PHY_IEEE802154
config IEEE802154_RAW_MODE
	bool "IEEE 802.15.4 driver without the MAC stack"
	select NET_RAW_MODE
	help
	  This option enables using the drivers in a so-called "raw" mode,
	  i.e. without a MAC stack (the net L2 layer for 802.15.4 will not
	  be built). Used only for very specific cases, such as wpan_serial
	  and wpanusb samples.
endif # !NET_L2_PHY_IEEE802154

config IEEE802154_RDEV
	bool
	help
	  PHY is a ranging-capable device (RDEV)

config IEEE802154_VENDOR_OUI_ENABLE
	bool "Support setting Vendor Organizationally Unique Identifier"
	help
	  This option enables setting custom vendor
	  OUI using IEEE802154_VENDOR_OUI. After enabling,
	  user is obliged to set IEEE802154_VENDOR_OUI value,
	  as this option has no default value.

if IEEE802154_VENDOR_OUI_ENABLE

config IEEE802154_VENDOR_OUI
	int "Vendor Organizationally Unique Identifier"
	help
	  Custom vendor OUI, which makes 24 most-significant
	  bits of MAC address

endif # IEEE802154_VENDOR_OUI_ENABLE

source "drivers/ieee802154/Kconfig.b91"

source "drivers/ieee802154/Kconfig.cc2520"

source "drivers/ieee802154/Kconfig.kw41z"

source "drivers/ieee802154/Kconfig.mcr20a"

source "drivers/ieee802154/Kconfig.nrf5"

source "drivers/ieee802154/Kconfig.cc1200"

source "drivers/ieee802154/Kconfig.cc13xx_cc26xx"

source "drivers/ieee802154/Kconfig.rf2xx"

source "drivers/ieee802154/Kconfig.dw1000"

source "drivers/ieee802154/Kconfig.uart_pipe"

config IEEE802154_2015
	bool "Support for IEEE 802.15.4-2015 frames (DEPRECATED)"
	select DEPRECATED
	help
	  Enable radio driver support for IEEE 802.15.4-2015 frames, including security handling of frames and ACKs.

config IEEE802154_CSL_ENDPOINT
	bool "Support for CSL Endpoint"
	help
	  Make this device a CSL (coordinated sampled listening) endpoint with delayed
	  reception handling and CSL IE injection.

config IEEE802154_CSL_DEBUG
	bool "Support for CSL debugging"
	depends on IEEE802154_CSL_ENDPOINT
	help
	  Enable support for CSL debugging by avoiding sleep state in favor of receive state.

module = IEEE802154_DRIVER
module-str = IEEE 802.15.4 driver
module-help = Sets log level for IEEE 802.15.4 Device Drivers.
source "subsys/logging/Kconfig.template.log_config"

endif # IEEE802154
```

## drivers/ieee802154/Kconfig.atm
```kconfig
# Copyright (c) 2023-2025 Atmosic
# SPDX-License-Identifier: Apache-2.0

menuconfig IEEE802154_ATM34
	bool "Atmosic ATM34 15.4 driver support"
	default y
	depends on DT_HAS_ATMOSIC_ATM34_IEEE802154_ENABLED
	select ATM_EUI

if IEEE802154_ATM34

config IEEE802154_ATM34_RX_STACK_SIZE
	int "Driver's internal RX thread stack size"
	default 800
	help
	  This option sets the driver's stack size for its internal RX thread.

config IEEE802154_ATM34_AUTO_CRC
	bool "Controls HW transmit and receive of CRC"
	default y

config IEEE802154_ATM34_DELAY_TRX_ACC
	int "Clock accuracy for delayed operations"
	default 255
	help
	  Accuracy of the clock used for scheduling radio delayed operations (delayed transmission
	  or delayed reception), in ppm.

endif
```

## drivers/ieee802154/Kconfig.b91
```kconfig
# Copyright (c) 2021 Telink Semiconductor
# SPDX-License-Identifier: Apache-2.0

# Telink B91 RF configuration options

menuconfig IEEE802154_TELINK_B91
	bool "Telink B91 RF driver"
	depends on NETWORKING

if IEEE802154_TELINK_B91

config IEEE802154_B91_DRV_NAME
	string "b91 IEEE 802.15.4 Driver's name"
	default "IEEE802154_b91"
	help
	  This option sets the driver name

config IEEE802154_B91_INIT_PRIO
	int "Telink B91 IEEE 802.15.4 initialization priority"
	default 80
	help
	  Set the initialization priority number. Do not mess with it unless
	  you know what you are doing.

config IEEE802154_B91_SET_TXRX_DELAY_US
	int "Tx/Rx modes switching delay time (us)"
	default 120
	help
	  Delay time needed for PLL stabilization during Tx/Rx modes switching.

config IEEE802154_B91_CCA_RSSI_THRESHOLD
	int "CCA procedure RSSI threshold"
	default -50
	help
	  CCA procedure returns true if the current RSSI value is less than
	  this parameter.

config IEEE802154_B91_RANDOM_MAC
	bool "Random MAC address"
	default y
	help
	  Generate a random MAC address dynamically.

if ! IEEE802154_B91_RANDOM_MAC

config IEEE802154_B91_MAC4
	hex "MAC Address Byte 4"
	default 0
	range 0 0xff
	help
	  This is the byte 4 of the MAC address.

config IEEE802154_B91_MAC5
	hex "MAC Address Byte 5"
	default 0
	range 0 0xff
	help
	  This is the byte 5 of the MAC address.

config IEEE802154_B91_MAC6
	hex "MAC Address Byte 6"
	default 0
	range 0 0xff
	help
	  This is the byte 6 of the MAC address.

config IEEE802154_B91_MAC7
	hex "MAC Address Byte 7"
	default 0
	range 0 0xff
	help
	  This is the byte 7 of the MAC address.

endif # ! IEEE802154_B91_RANDOM_MAC
endif # IEEE802154_TELINK_B91
```
