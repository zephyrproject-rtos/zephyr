## drivers/ieee802154/Kconfig.b9x
```kconfig
# Copyright (c) 2021-2024 Telink Semiconductor
# SPDX-License-Identifier: Apache-2.0

# Telink B9X RF configuration options

menuconfig IEEE802154_TELINK_B9X
	bool "Telink B9X RF driver"
	default y
	depends on DT_HAS_TELINK_B9X_ZB_ENABLED

if IEEE802154_TELINK_B9X

config IEEE802154_B9X_INIT_PRIO
	int "Telink B9X IEEE 802.15.4 initialization priority"
	default 80
	help
	  Set the initialization priority number. Do not mess with it unless
	  you know what you are doing.

config IEEE802154_B9X_SET_TXRX_DELAY_US
	int "Tx/Rx modes switching delay time (us)"
	default 120
	help
	  Delay time needed for PLL stabilization during Tx/Rx modes switching.

config IEEE802154_B9X_CCA_RSSI_THRESHOLD
	int "CCA procedure RSSI threshold"
	default -50
	help
	  CCA procedure returns true if the current RSSI value is less than
	  this parameter.

choice IEEE802154_B9X_MAC_TYPE
	prompt "IEEE802154 MAC address type"
	default IEEE802154_B9X_MAC_RANDOM
config IEEE802154_B9X_MAC_RANDOM
	bool "Random MAC address"
config IEEE802154_B9X_MAC_FLASH
	bool "MAC address from flash"
config IEEE802154_B9X_MAC_STATIC
	bool "MAC address precompiled"
endchoice

config IEEE802154_B9X_DELAY_TRX_ACC
	int "Clock accuracy for delayed operations"
	default 40
	help
	  Accuracy of the clock used for scheduling radio delayed operations (delayed transmission
	  or delayed reception), in ppm.

if IEEE802154_B9X_MAC_STATIC

config IEEE802154_B9X_MAC4
	hex "MAC Address Byte 4"
	default 0
	range 0 0xff
	help
	  This is the byte 4 of the MAC address.

config IEEE802154_B9X_MAC5
	hex "MAC Address Byte 5"
	default 0
	range 0 0xff
	help
	  This is the byte 5 of the MAC address.

config IEEE802154_B9X_MAC6
	hex "MAC Address Byte 6"
	default 0
	range 0 0xff
	help
	  This is the byte 6 of the MAC address.

config IEEE802154_B9X_MAC7
	hex "MAC Address Byte 7"
	default 0
	range 0 0xff
	help
	  This is the byte 7 of the MAC address.

endif # IEEE802154_B9X_MAC_STATIC

config IEEE802154_TELINK_B9X_ENCRYPTION
	bool "Telink 802.15.4 AES-CCM* authentication & encryption"

endif # IEEE802154_TELINK_B9X
```

## drivers/ieee802154/Kconfig.bflb
```kconfig
# Bouffalo Lab IEEE 802.15.4 configuration options

# Copyright The Zephyr Project Contributors
# SPDX-License-Identifier: Apache-2.0

menuconfig IEEE802154_BFLB
	bool "Bouffalo Lab IEEE 802.15.4 Driver"
	default y
	depends on DT_HAS_BFLB_IEEE802154_ENABLED
	# the BL70x/BL70xL platform shims attach blob ISRs at runtime
	select DYNAMIC_INTERRUPTS if SOC_SERIES_BL70X || SOC_SERIES_BL70XL
	select BFLB_PHYRF

if IEEE802154_BFLB

config IEEE802154_BFLB_INIT_PRIO
	int "Bouffalo Lab IEEE 802.15.4 initialization priority"
	default 80
	help
	  Set the initialization priority number. Do not mess with it unless
	  you know what you are doing.

endif # IEEE802154_BFLB
```

## drivers/ieee802154/Kconfig.cc1101
```kconfig
# SPDX-License-Identifier: Apache-2.0

menuconfig IEEE802154_CC1101
	bool "TI CC1101 Driver support"
	depends on NETWORKING
	select NET_L2_IEEE802154_SUB_GHZ

if IEEE802154_CC1101

config IEEE802154_CC1101_DRV_NAME
	string "TI CC1101 Driver's name"
	default "cc1101"
	help
	  This option sets the driver name

config IEEE802154_CC1101_RANDOM_MAC
	bool "Random MAC address"
	default y
	help
	  Generate a random MAC address dynamically.

if ! IEEE802154_CC1101_RANDOM_MAC

config IEEE802154_CC1101_MAC4
	hex "MAC Address Byte 4"
	default 0
	range 0 0xff
	help
	  This is the byte 4 of the MAC address.

config IEEE802154_CC1101_MAC5
	hex "MAC Address Byte 5"
	default 0
	range 0 0xff
	help
	  This is the byte 5 of the MAC address.

config IEEE802154_CC1101_MAC6
	hex "MAC Address Byte 6"
	default 0
	range 0 0xff
	help
	  This is the byte 6 of the MAC address.

config IEEE802154_CC1101_MAC7
	hex "MAC Address Byte 7"
	default 0
	range 0 0xff
	help
	  This is the byte 7 of the MAC address.

endif # IEEE802154_CC1101_RANDOM_MAC

endif # IEEE802154_CC1101
```

## drivers/ieee802154/Kconfig.cc1200
```kconfig
# TI CC1200 configuration options

# SPDX-License-Identifier: Apache-2.0

menuconfig IEEE802154_CC1200
	bool "TI CC1200 Driver support"
	depends on NETWORKING
	select NET_L2_IEEE802154_SUB_GHZ

if IEEE802154_CC1200

config IEEE802154_CC1200_DRV_NAME
	string "TI CC1200 Driver's name"
	default "cc1200"
	help
	  This option sets the driver name

config IEEE802154_CC1200_RX_STACK_SIZE
	int "Driver's internal RX thread stack size"
	default 800
	help
	  This option sets the driver's stack size for its internal RX thread.
	  The default value should be sufficient, but in case it proves to be
	  a too little one, this option makes it easy to play with the size.

config IEEE802154_CC1200_INIT_PRIO
	int "CC1200 initialization priority"
	default 80
	help
	  Set the initialization priority number. Do not mess with it unless
	  you know what you are doing. Beware cc1200 requires gpio and spi to
	  be ready first (and sometime gpio should be the very first as spi
	  might need it too). And of course it has to start before the net stack.

config IEEE802154_CC1200_RANDOM_MAC
	bool "Random MAC address"
	default y
	help
	  Generate a random MAC address dynamically.

if ! IEEE802154_CC1200_RANDOM_MAC

config IEEE802154_CC1200_MAC4
	hex "MAC Address Byte 4"
	default 0
	range 0 0xff
	help
	  This is the byte 4 of the MAC address.

config IEEE802154_CC1200_MAC5
	hex "MAC Address Byte 5"
	default 0
	range 0 0xff
	help
	  This is the byte 5 of the MAC address.

config IEEE802154_CC1200_MAC6
	hex "MAC Address Byte 6"
	default 0
	range 0 0xff
	help
	  This is the byte 6 of the MAC address.

config IEEE802154_CC1200_MAC7
	hex "MAC Address Byte 7"
	default 0
	range 0 0xff
	help
	  This is the byte 7 of the MAC address.

endif # IEEE802154_CC1200_RANDOM_MAC

config IEEE802154_CC1200_XOSC
	int "Value of the Crystal oscillator in kHz"
	default 40000
	help
	  This sets the XOSC value, it must be between 38400 and 40000.
	  This value should follow what has been set in the RF settings via
	  SmartRF tool. Do not touch this unless you know what you are doing.

config IEEE802154_CC1200_RF_PRESET
	bool "Use TI CC1200 RF pre-sets"
	default y

choice
	prompt "TI CC1200 RF preset"
	default IEEE802154_CC1200_RF_SET_0
	depends on IEEE802154_CC1200_RF_PRESET
	help
	  Set the RF preset you want to use.

config IEEE802154_CC1200_RF_SET_0
	bool "868MHz - 50Kbps - 2-GFSK - IEEE 802.15.4g compliant - ETSI"

config IEEE802154_CC1200_RF_SET_1
	bool "920MHz - 50Kbps - 2-GFSK - IEEE 802.15.4g compliant - ARIB"

config IEEE802154_CC1200_RF_SET_2
	bool "434MHz - 50Kbps - 2-GFSK - IEEE 802.15.4g compliant - ETSI"

endchoice

config IEEE802154_CC1200_CCA_THRESHOLD
	int "Value in dbm of the CCA threshold"
	default -91
	help
	  Set the CCA threshold. See datasheet's AGC_CS_THR register for
	  more information. Do not touch this unless you know what you are doing.

config IEEE802154_CC1200_RSSI_OFFSET
	int "Value in dbm of the RSSI offset"
	default -81
	help
	  Set the gain adjustment. See datasheet's AGC_GAIN_ADJUST register for
	  more information. Do not touch this unless you know what you are doing.

# Do no touch below settings unless you know what you are doing
config IEEE802154_CC1200_SETTLING_CFG
	hex
	default 0x03

config IEEE802154_CC1200_PKTCFG0
	hex
	default 0x20

config IEEE802154_CC1200_PKTCFG1
	hex
	default 0x03

config IEEE802154_CC1200_PKTCFG2
	hex
	default 0x00

config IEEE802154_CC1200_RFEND_CFG1
	hex
	default 0x3F

config IEEE802154_CC1200_RFEND_CFG0
	hex
	default 0x00

endif # IEEE802154_CC1200
```

## drivers/ieee802154/Kconfig.cc13xx_cc26xx
```kconfig
# TI CC13xx / CC26xx IEEE 802.15.4 configuration options

# Copyright (c) 2019 Brett Witherspoon
# SPDX-License-Identifier: Apache-2.0

menuconfig IEEE802154_CC13XX_CC26XX
	bool "TI CC13xx / CC26xx IEEE 802.15.4 driver support"
	select CRC
	default y
	depends on DT_HAS_TI_CC13XX_CC26XX_IEEE802154_ENABLED

if IEEE802154_CC13XX_CC26XX

config IEEE802154_CC13XX_CC26XX_INIT_PRIO
	int "TI CC13xx / CC26xx IEEE 802.15.4 initialization priority"
	default 80
	help
	  Set the initialization priority number.

config IEEE802154_CC13XX_CC26XX_RADIO_TX_RETRIES
	int "Radio Transmission attempts"
	default NET_L2_IEEE802154_RADIO_TX_RETRIES if NET_L2_IEEE802154
	default 3
	range 1 7
	help
	  Number of transmission attempts radio driver should do, before
	  replying it could not send the packet.

config IEEE802154_CC13XX_CC26XX_RADIO_CSMA_CA_MAX_BO
	int "CSMA maximum backoffs"
	default NET_L2_IEEE802154_RADIO_CSMA_CA_MAX_BO if NET_L2_IEEE802154_RADIO_CSMA_CA
	default 4
	range 1 5
	help
	  The maximum number of backoffs the CSMA-CA algorithm will attempt
	  before declaring a channel access failure.

config IEEE802154_CC13XX_CC26XX_RADIO_CSMA_CA_MIN_BE
	int "CSMA MAC minimum backoff exponent"
	default NET_L2_IEEE802154_RADIO_CSMA_CA_MIN_BE if NET_L2_IEEE802154_RADIO_CSMA_CA
	default 3
	range 1 8
	help
	  The minimum value of the backoff exponent (BE) in the CSMA-CA
	  algorithm.

config IEEE802154_CC13XX_CC26XX_RADIO_CSMA_CA_MAX_BE
	int "CSMA MAC maximum backoff exponent"
	default NET_L2_IEEE802154_RADIO_CSMA_CA_MAX_BE if NET_L2_IEEE802154_RADIO_CSMA_CA
	default 5
	range 1 8
	help
	  The maximum value of the backoff exponent (BE) in the CSMA-CA
	  algorithm.

endif # IEEE802154_CC13XX_CC26XX

menuconfig IEEE802154_CC13XX_CC26XX_SUB_GHZ
	bool "TI CC13xx / CC26xx IEEE 802.15.4g driver support"
	default y
	depends on DT_HAS_TI_CC13XX_CC26XX_IEEE802154_SUBGHZ_ENABLED
	select NET_L2_IEEE802154_SUB_GHZ if NET_L2_IEEE802154

if IEEE802154_CC13XX_CC26XX_SUB_GHZ

config IEEE802154_CC13XX_CC26XX_SUB_GHZ_NUM_RX_BUF
	int "TI CC13xx / CC26xx IEEE 802.15.4g receive buffer count"
	default 2
	help
	  This option allows the user to configure the number of
	  receive buffers.

config IEEE802154_CC13XX_CC26XX_SUB_GHZ_CS_THRESHOLD
	int "TI CC13xx / CC26xx IEEE 802.15.4g Carrier Sense Threshold in dBm"
	default -70
	help
	  This option sets RSSI threshold for carrier sense in the CSMA/CA
	  algorithm.

config IEEE802154_CC13XX_CC26XX_SUB_GHZ_INIT_PRIO
	int "TI CC13xx / CC26xx IEEE 802.15.4g initialization priority"
	default 80
	help
	  Set the initialization priority number.

config IEEE802154_CC13XX_CC26XX_SUB_GHZ_RADIO_TX_RETRIES
	int "Radio Transmission attempts"
	default NET_L2_IEEE802154_RADIO_TX_RETRIES if NET_L2_IEEE802154
	default 3
	range 1 7
	help
	  Number of transmission attempts radio driver should do, before
	  replying it could not send the packet.

config IEEE802154_CC13XX_CC26XX_SUB_GHZ_CUSTOM_RADIO_SETUP
	bool "Use custom radio setup structures (advanced)"
	default n
	help
	  Imports the radio setup structure from an external module instead of using
	  the default one.
	  Allows overriding the RF modulation / protocol settings.

config IEEE802154_CC13XX_CC26XX_SUB_GHZ_CUSTOM_POWER_TABLE
	bool "Use custom power table structure (advanced)"
	default n
	help
	  Imports the radio power table from an external module.
	  Allows overriding the RF modulation settings.

endif # IEEE802154_CC13XX_CC26XX_SUB_GHZ
```

## drivers/ieee802154/Kconfig.cc2520
```kconfig
# TI CC2520 configuration options

# Copyright (c) 2017 Intel Corporation
# SPDX-License-Identifier: Apache-2.0

menuconfig IEEE802154_CC2520
	bool "TI CC2520 Driver support"
	depends on NETWORKING

if IEEE802154_CC2520

config IEEE802154_CC2520_RX_STACK_SIZE
	int "Driver's internal RX thread stack size"
	default 800
	help
	  This option sets the driver's stack size for its internal RX thread.
	  The default value should be sufficient, but in case it proves to be
	  a too little one, this option makes it easy to play with the size.

config IEEE802154_CC2520_INIT_PRIO
	int "CC2520 initialization priority"
	default 80
	help
	  Set the initialization priority number. Do not mess with it unless
	  you know what you are doing. Beware cc2520 requires gpio and spi to
	  be ready first (and sometime gpio should be the very first as spi
	  might need it too). And of course it has to start before the net stack.

config IEEE802154_CC2520_RANDOM_MAC
	bool "Random MAC address"
	default y
	help
	  Generate a random MAC address dynamically.

if ! IEEE802154_CC2520_RANDOM_MAC

config IEEE802154_CC2520_MAC4
	hex "MAC Address Byte 4"
	default 0
	range 0 0xff
	help
	  This is the byte 4 of the MAC address.

config IEEE802154_CC2520_MAC5
	hex "MAC Address Byte 5"
	default 0
	range 0 0xff
	help
	  This is the byte 5 of the MAC address.

config IEEE802154_CC2520_MAC6
	hex "MAC Address Byte 6"
	default 0
	range 0 0xff
	help
	  This is the byte 6 of the MAC address.

config IEEE802154_CC2520_MAC7
	hex "MAC Address Byte 7"
	default 0
	range 0 0xff
	help
	  This is the byte 7 of the MAC address.

endif # IEEE802154_CC2520_RANDOM_MAC

config IEEE802154_CC2520_CRYPTO
	bool "Hardware crypto helper on cc2520"
	depends on NET_L2_IEEE802154_SECURITY
	help
	  This option will expose the hardware AES encryption from CC2520.
	  Such feature should not be used for anything but 802.15.4 security.
	  The crypto device exposed will only support synchronous CCM operation.

config IEEE802154_CC2520_CRYPTO_DRV_NAME
	string "TI CC2520 Crypto Driver's name"
	default "cc2520_crypto"
	depends on IEEE802154_CC2520_CRYPTO
	help
	  This option sets the driver name for the crypto part found on CC2520.

config IEEE802154_CC2520_CRYPTO_INIT_PRIO
	int "TI CC2520 crypto device initialization priority"
	default 81
	depends on IEEE802154_CC2520_CRYPTO
	help
	  Set the initialization priority number. Do not mess with it unless
	  you know what you are doing. It should be initialized after CC2520
	  as it shares the same runtime context.

endif # IEEE802154_CC2520
```

## drivers/ieee802154/Kconfig.dw1000
```kconfig
# Copyright (c) 2020 PHYTEC Messtechnik GmbH
# SPDX-License-Identifier: Apache-2.0

menuconfig IEEE802154_DW1000
	bool "Decawave DW1000 Driver support"
	default y
	depends on DT_HAS_DECAWAVE_DW1000_ENABLED
	select SPI

if IEEE802154_DW1000

config IEEE802154_DW1000_SNIFF_ONT
	int "SNIFF on time"
	default 0
	range 0 15
	help
	  SNIFF on time in unit of PAC. The minimum on time is the duration
	  of two PACs. The SNIFF counter always adds 1 PAC unit to the on-time
	  count. The SNIFF_ONT value should be in range of 1-15.
	  Zero value disables SNIFF mode.

config IEEE802154_DW1000_SNIFF_OFFT
	int "SNIFF off time"
	default 16
	range 1 255
	help
	  SNIFF off time in unit of approximate 1 microsecond.

config IEEE802154_DW1000_INIT_PRIO
	int "DW1000 initialization priority"
	default 80
	help
	  Set the initialization priority number. Do not mess with it unless
	  you know what you are doing. Beware DW1000 requires gpio and spi to
	  be ready first (and sometime gpio should be the very first as spi
	  might need it too). And of course it has to start before the net stack.

config IEEE802154_DW1000_ENABLE_MANUAL_TX_POWER_CONTROL
	bool "Manual TX Power Control"
	help
	  Manual TX Power control disables Smart TX Power Control and makes
	  TX power independent of data rate and frame length. Direct control
	  of the power to the PHR part and the rest of the transmit frame
	  separately.
	  Smart TX power control applies at the 6.8 Mbps data rate. When sending
	  short data frames at this rate (and providing that the frame
	  transmission rate is < 1 frame per millisecond) it is possible to
	  increase the transmit power and still remain within regulatory power limits
	  which are typically specified as average power per millisecond.

endif
```
