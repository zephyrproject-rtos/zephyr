## drivers/flash/Kconfig.stm32f3x
```kconfig
# Kconfig - ST Microelectronics STM32F3x MCUs Flash driver config
#
# Copyright (c) 2016 RnDity Sp. z o.o.
#
# SPDX-License-Identifier: Apache-2.0
#

if FLASH && SOC_SERIES_STM32F3X

menuconfig SOC_FLASH_STM32
	bool
	prompt "STM32 flash driver"
	depends on SOC_SERIES_STM32F3X && FLASH
	default n
	help
	 Enable STM32F3X series MCUs flash driver.

config SOC_FLASH_STM32_DEV_NAME
	string "STM32 flash device name"
	depends on SOC_FLASH_STM32
	default "FLASH_STM32"
	help
	 Specify the device name for the flash driver.

endif
```

## drivers/flash/Kconfig.stm32fxx
```kconfig
# Kconfig - ST Microelectronics STM32F3x MCUs Flash driver config
#
# Copyright (c) 2016 RnDity Sp. z o.o.
#
# SPDX-License-Identifier: Apache-2.0
#

if FLASH && SOC_FAMILY_STM32

menuconfig SOC_FLASH_STM32
	bool
	prompt "STM32 flash driver"
	depends on (SOC_SERIES_STM32F3X || SOC_SERIES_STM32F4X)
	default y
	help
	 Enable STM32F3x OR STM32F4x series flash driver.

config SOC_FLASH_STM32_DEV_NAME
	string "STM32 flash device name"
	depends on SOC_FLASH_STM32
	default "FLASH_STM32"
	help
	 Specify the device name for the flash driver.

endif
```

## drivers/flash/Kconfig.tlx
```kconfig
# Copyright (c) 2021-2023 Telink Semiconductor
# SPDX-License-Identifier: Apache-2.0

config SOC_FLASH_TELINK_TLX
	bool "Telink Semiconductor TLx flash driver"
	default y
	depends on DT_HAS_TELINK_TLX_FLASH_CONTROLLER_ENABLED
	select FLASH_HAS_PAGE_LAYOUT
	select FLASH_HAS_DRIVER_ENABLED
	help
	  Enables Telink TLx flash driver.
```

## drivers/flash/Kconfig.w25qxxdv
```kconfig
#
# Copyright (c) 2018 Intel Corporation
#
# SPDX-License-Identifier: Apache-2.0
#


menuconfig SPI_FLASH_W25QXXDV
	bool "SPI NOR Flash Winbond W25QXXDV"
	select FLASH_HAS_DRIVER_ENABLED
	depends on SPI

if SPI_FLASH_W25QXXDV

config SPI_FLASH_W25QXXDV_INIT_PRIORITY
	int
	default 80
	help
	  Device driver initialization priority.
	  Device is connected to SPI bus, it has to
	  be initialized after SPI driver.

config SPI_FLASH_W25QXXDV_GPIO_CS_WAIT_DELAY
	int "Delay time in us"
	default 0
	help
	This is the wait delay (in us) to allow for CS switching to take effect

endif # SPI_FLASH_W25QXXDV
```

## drivers/flash/Kconfig.w91
```kconfig
# Copyright (c) 2024 Telink Semiconductor
# SPDX-License-Identifier: Apache-2.0

config SOC_FLASH_TELINK_W91
	bool "Telink Semiconductor W91 flash driver"
	default y
	depends on DT_HAS_TELINK_W91_FLASH_CONTROLLER_ENABLED
	select FLASH_HAS_PAGE_LAYOUT
	select FLASH_HAS_DRIVER_ENABLED
	help
	  Enables Telink W91 flash driver.
```

## drivers/flash/Kconfig.wch
```kconfig
# SPDX-FileCopyrightText: Copyright Michael Hope <michaelh@juju.nz>
# SPDX-License-Identifier: Apache-2.0

config SOC_FLASH_CH32V
	bool "WCH CH32V flash driver"
	default y
	depends on DT_HAS_WCH_CH32V_FLASH_CONTROLLER_ENABLED
	select FLASH_HAS_DRIVER_ENABLED
	select FLASH_HAS_PAGE_LAYOUT
	select FLASH_HAS_EXPLICIT_ERASE
	help
	  Enable the WCH CH32V series on-chip flash driver.
```

## drivers/flash/Kconfig.xmc4xxx
```kconfig
# Copyright (c) 2022 Schlumberger
# SPDX-License-Identifier: Apache-2.0

config SOC_FLASH_XMC4XXX
	bool "XMC4XXX flash driver"
	default y
	depends on DT_HAS_INFINEON_XMC4XXX_FLASH_CONTROLLER_ENABLED
	select FLASH_HAS_PAGE_LAYOUT
	select FLASH_HAS_DRIVER_ENABLED
	help
	  Enables XMC4XXX flash driver.
```

## drivers/flash/flash_mspi_nor/Kconfig
```kconfig
# Copyright (c) 2025 Tenstorrent AI ULC
# SPDX-License-Identifier: Apache-2.0

menuconfig FLASH_MSPI_NOR
	bool "Generic MSPI NOR Flash"
	default y
	depends on DT_HAS_JEDEC_MSPI_NOR_ENABLED
	select FLASH_MSPI
	select FLASH_HAS_EXPLICIT_ERASE
	select FLASH_JESD216
	select GPIO if $(dt_compat_any_has_prop,$(DT_COMPAT_JEDEC_MSPI_NOR),reset-gpios)

if FLASH_MSPI_NOR

config FLASH_MSPI_NOR_LAYOUT_PAGE_SIZE
	int "Page size to use for FLASH_LAYOUT feature"
	depends on FLASH_PAGE_LAYOUT
	default 65536
	help
	  When CONFIG_FLASH_PAGE_LAYOUT is used, this driver will support that
	  API. By default the page size corresponds to the block size (65536).
	  Other options include the 32K-byte erase size (32768), the sector
	  size (4096), or any non-zero multiple of the sector size.

endif # FLASH_MSPI_NOR
```

## drivers/fpga/Kconfig
```kconfig
# FPGA driver configuration options

# Copyright (c) 2021-2022 Antmicro <www.antmicro.com>
# SPDX-License-Identifier: Apache-2.0

menuconfig FPGA
	bool "Field-Programmable Gate Array (FPGA) drivers"
	help
	  Enable support for FPGA drivers.

if FPGA

module = fpga
module-str = fpga
source "subsys/logging/Kconfig.template.log_config"

config FPGA_INIT_PRIORITY
	int "Init priority"
	default 75
	help
	  FPGA device drivers initialization priority

config FPGA_SHELL
	bool "FPGA Shell"
	depends on SHELL && FPGA
	help
	  Enable FPGA Shell support.

source "drivers/fpga/Kconfig.eos_s3"
source "drivers/fpga/Kconfig.ice40"
source "drivers/fpga/Kconfig.mpfs"
source "drivers/fpga/Kconfig.zynqmp"

endif # FPGA
```

## drivers/fpga/Kconfig.altera_agilex_bridge
```kconfig
# FPGA ALTERA driver configuration options

# Copyright (c) 2024, Intel Corporation. All rights reserved.
# SPDX-License-Identifier: Apache-2.0

config ALTERA_AGILEX_BRIDGE_FPGA
	bool "ALTERA fpga driver"
	depends on ARM_SIP_SVC_SUBSYS
	help
	  Enable ALTERA FPGA driver.
```

## drivers/fpga/Kconfig.eos_s3
```kconfig
# FPGA EOS S3 driver configuration options

# Copyright (c) 2021 Antmicro <www.antmicro.com>
# SPDX-License-Identifier: Apache-2.0

config EOS_S3_FPGA
	bool "EOS S3 fpga driver"
	help
	  Enable EOS S3 FPGA driver.
```

## drivers/fpga/Kconfig.ice40
```kconfig
# Copyright (c) 2022 Meta
# SPDX-License-Identifier: Apache-2.0

menuconfig ICE40_FPGA
	bool "Lattice iCE40 fpga driver"
	default y
	depends on (DT_HAS_LATTICE_ICE40_FPGA_ENABLED || \
		   DT_HAS_LATTICE_ICE40_FPGA_BITBANG_ENABLED)
	imply CRC
	depends on SPI
	help
	  Enable support for the Lattice iCE40 fpga driver.

if ICE40_FPGA

config ICE40_FPGA_SPI
	bool "Lattice iCE40 fpga SPI driver"
	default y
	depends on DT_HAS_LATTICE_ICE40_FPGA_ENABLED
	help
	  Enable support for the Lattice iCE40 fpga SPI driver.

config ICE40_FPGA_BITBANG
	bool "Lattice iCE40 fpga driver GPIO bitbang"
	default y
	select EXPERIMENTAL
	depends on DT_HAS_LATTICE_ICE40_FPGA_BITBANG_ENABLED
	help
	  Enable support for the Lattice iCE40 fpga GPIO bitbang driver.

endif # ICE40_FPGA
```

## drivers/fpga/Kconfig.mpfs
```kconfig
# FPGA Microchip PolarFire SOC driver configuration options

# Copyright (c) 2023 Microchip Technology Inc.
# SPDX-License-Identifier: Apache-2.0

config MPFS_FPGA
	bool "Microchip PolarFire SOC FPGA driver"
	depends on SPI
	help
	  Enable support for the Microchip PolarFire SOC FPGA driver.
```

## drivers/fpga/Kconfig.rs_xcb
```kconfig
# FPGA Rapid Silicon FCB, ICB, PCB driver configuration options

# Copyright (c) 2024 Rapid Silicon
# SPDX-License-Identifier: Apache-2.0

menuconfig RS_FPGA
	bool "RS_xCB Drivers"
	depends on DT_HAS_RAPIDSI_RIGEL_ENABLED
	help
		Select Rapid Silicon FCB, ICB or PCB Driver 

	if RS_FPGA

		config RS_RTOS_PORT
			bool "Enable Zephyr Specific Code changes."
			default n
			
		config RS_XCB_INIT_PRIORITY
			int "Provide initialization priority of FCB, ICB and PCB Drivers"
			default 60
			
		config RS_FPGA_FCB
			bool "FPGA Configuration Block"
			default n
			depends on DT_HAS_RAPIDSI_FCB_ENABLED
			select RS_RTOS_PORT
			help
				Enable FCB Driver.
			if RS_FPGA_FCB
				config RS_FPGA_FCB_METADATA_SIZE
					int "Enter the FCB Configuration Meta Data / Header Size in bytes for FCB Driver"
					default 16
					help
					  This is the size of the metadat used by FCB driver to process user configuration.
					  User should look at the layout of the metadata in the user manual of the FCB.
			endif

		config RS_FPGA_ICB
			bool "Input / Output Configuration Block"
			default n
			depends on DT_HAS_RAPIDSI_ICB_ENABLED
			select RS_RTOS_PORT
			help
				Enable ICB Driver.
			if RS_FPGA_ICB
				config RS_FPGA_ICB_METADATA_SIZE
					int "Enter the ICB Configuration Meta Data / Header Size in bytes for ICB Driver"
					default 20
					help
					  This is the size of the metadat used by ICB driver to process user configuration.
					  User should look at the layout of the metadata in the user manual of the ICB.
			endif


		config RS_FPGA_PCB
			bool "BRAM Preload Configuration Block"
			default n
			depends on DT_HAS_RAPIDSI_PCB_ENABLED
			select RS_RTOS_PORT
			help
				Enable PCB Driver.
			if RS_FPGA_PCB
				config RS_FPGA_PCB_METADATA_SIZE
					int "Enter the PCB Configuration Meta Data / Header Size in bytes for PCB Driver"
					default 28
					help
					  This is the size of the metadat used by PCB driver to process user configuration.
					  User should look at the layout of the metadata in the user manual of the PCB.
			endif

	endif
```

## drivers/fpga/Kconfig.slg471x5
```kconfig
# Copyright 2024 Vogl Electronic GmbH
# SPDX-License-Identifier: Apache-2.0

config SLG471X5_FPGA
	bool "Renesas SLG47105/SLG47115 GreenPAK Configurable Mixed-Signal IC"
	default y
	depends on DT_HAS_RENESAS_SLG47105_ENABLED || DT_HAS_RENESAS_SLG47115_ENABLED
	select SPI
	help
	  Enable Renesas SLG47105/SLG47115 driver support.
```

## drivers/fpga/Kconfig.slg47910
```kconfig
# Copyright 2026 Sameer Srivastava <l1zard78@proton.me>
# SPDX-License-Identifier: Apache-2.0

config SLG47910_FPGA
	bool "Renesas SLG47910 FPGA"
	default y
	depends on DT_HAS_RENESAS_SLG47910_ENABLED
	select SPI
	select GPIO
	help
	  Enable Renesas SLG47910 driver support.
```

## drivers/fpga/Kconfig.zynqmp
```kconfig
# FPGA ZYNQMP driver configuration options

# Copyright (c) 2021-2022 Antmicro <www.antmicro.com>
# SPDX-License-Identifier: Apache-2.0

config ZYNQMP_FPGA
	bool "ZYNQMP fpga driver"
	help
	  Enable ZYNQMP FPGA driver.
```

## drivers/fram/Kconfig
```kconfig
# FRAM driver configuration options

# Copyright (c) 2019 Vestas Wind Systems A/S
# SPDX-License-Identifier: Apache-2.0

menuconfig FRAM
	bool "FRAM hardware support"
	help
	  Enable support for FRAM hardware.

if FRAM

module = FRAM
module-str = fram
source "subsys/logging/Kconfig.template.log_config"

config FRAM_INIT_PRIORITY
	int "FRAM init priority"
	default KERNEL_INIT_PRIORITY_DEVICE
	help
	  FRAM driver device initialization priority.

config FRAM_SHELL
	bool "Enable FRAM shell"
	default y
	depends on SHELL
	help
	  Enable the FRAM shell with FRAM related commands.

config FRAM_SHELL_BUFFER_SIZE
	int "FRAM shell buffer size"
	default 256
	depends on FRAM_SHELL
	help
	  Size of the buffer used for FRAM read/write commands in
	  the FRAM shell.

endif # FRAM
```

## drivers/fuel_gauge/Kconfig
```kconfig
# Copyright 2022 Google LLC
#
# SPDX-License-Identifier: Apache-2.0

menuconfig FUEL_GAUGE
	bool "Battery fuel gauge drivers"
	help
	  Enable battery fuel gauge driver configuration.

if FUEL_GAUGE

module = FUEL_GAUGE
module-str = fuel_gauge
source "subsys/logging/Kconfig.template.log_config"

config FUEL_GAUGE_INIT_PRIORITY
	int "Battery Fuel Gauge init priority"
	default 90
	help
	  Battery fuel gauge initialization priority.

source "drivers/fuel_gauge/max17048/Kconfig"
source "drivers/fuel_gauge/sbs_gauge/Kconfig"
source "drivers/fuel_gauge/bq27z746/Kconfig"

endif # FUEL_GAUGE
```

## drivers/fuel_gauge/adp5360/Kconfig
```kconfig
# Copyright (c) 2026, Analog Devices, Inc.
# SPDX-License-Identifier: Apache-2.0

config FUEL_GAUGE_ADP5360
	bool "ADP5360 Fuel Gauge"
	default y
	depends on DT_HAS_ADI_ADP5360_FUEL_GAUGE_ENABLED
	select MFD
	help
	  Enable I2C-based driver for ADP5360 Fuel Gauge.

if FUEL_GAUGE_ADP5360

config FUEL_GAUGE_ADP5360_INIT_PRIORITY
	int "Fuel Gauge ADP5360 Init Priority"
	default 90
	help
	  Init priority for the Analog Devices ADP5360 Fuel Gauge Subsystem.

endif #FUEL_GAUGE_ADP5360
```

## drivers/fuel_gauge/axp2101/Kconfig
```kconfig
# Zephyr axp2101 fuel-gauge device

# Copyright (c) 2025 Felix Moessbauer
# SPDX-License-Identifier: Apache-2.0

config FUEL_GAUGE_AXP2101
	bool "X-Powers AXP2101 fuel gauge"
	default y
	depends on DT_HAS_X_POWERS_AXP2101_FUEL_GAUGE_ENABLED
	depends on DT_HAS_X_POWERS_AXP2101_ENABLED
	select I2C
	select MFD
	help
	  Enable driver for the x-powers axp2101 fuel gauge device.
```

## drivers/fuel_gauge/bq27427/Kconfig
```kconfig
# SPDX-FileCopyrightText: Copyright The Zephyr Project Contributors
#
# SPDX-License-Identifier: Apache-2.0

config BQ27427
	bool "BQ27427 Fuel Gauge"
	default y
	depends on DT_HAS_TI_BQ27427_ENABLED
	select I2C
	help
	  Enable I2C-based driver for BQ27427 Fuel Gauge.
```

## drivers/fuel_gauge/bq27z746/Kconfig
```kconfig
# Copyright (c) 2023, ithinx GmbH
# Copyright (c) 2023, Tonies GmbH
#
# SPDX-License-Identifier: Apache-2.0

config BQ27Z746
	bool "BQ27Z746 Fuel Gauge"
	default y
	depends on DT_HAS_TI_BQ27Z746_ENABLED
	select I2C
	help
	  Enable I2C-based driver for BQ27Z746 Fuel Gauge.

config EMUL_BQ27Z746
	bool "Emulate an BQ27Z746 fuel gague"
	default y
	depends on EMUL
	depends on BQ27Z746
	help
	  It provides readings which follow a simple sequence, thus allowing
	  test code to check that things are working as expected.
```

## drivers/fuel_gauge/composite/Kconfig
```kconfig
# Zephyr composite fuel-gauge device

# Copyright (c) 2024 Embeint Inc
# SPDX-License-Identifier: Apache-2.0

config FUEL_GAUGE_COMPOSITE
	bool "Zephyr composite fuel gauge"
	default y
	depends on DT_HAS_ZEPHYR_FUEL_GAUGE_COMPOSITE_ENABLED
	help
	  Enable driver for the Zephyr composite fuel gauge device.

config FUEL_GAUGE_COMPOSITE_DATA_VALIDITY_MS
	int "Data from sensor_fetch is cached for this long"
	depends on FUEL_GAUGE_COMPOSITE
	default 150
	help
	  To ensure that data is consistent across multiple calls to
	  fuel_gauge_get_prop, sensor_fetch is only called if at least
	  this long has passed since the previous call.
```

## drivers/fuel_gauge/lc709203f/Kconfig
```kconfig
# Copyright (c) 2025 Philipp Steiner <philipp.steiner1987@gmail.com>
#
# SPDX-License-Identifier: Apache-2.0

config LC709203F
	bool "LC709203F Fuel Gauge"
	default y
	depends on DT_HAS_ONNN_LC709203F_ENABLED
	select CRC
	select I2C
	help
	  Enable I2C-based driver for LC709203F Fuel Gauge.

config EMUL_LC709203F
	bool "Emulate an LC709203F fuel gauge"
	default y
	depends on EMUL
	depends on LC709203F
	help
	  It provides readings which follow a simple sequence, thus allowing
	  test code to check that things are working as expected.
```
