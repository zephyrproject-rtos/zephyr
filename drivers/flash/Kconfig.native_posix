## drivers/flash/Kconfig.nrf_rram
```kconfig
#
# Copyright (c) 2024 Nordic Semiconductor ASA
#
# SPDX-License-Identifier: Apache-2.0
#

menuconfig SOC_FLASH_NRF_RRAM
	bool "Nordic Semiconductor flash driver for nRF RRAM"
	default y
	depends on DT_HAS_NORDIC_RRAM_CONTROLLER_ENABLED
	select NRFX_RRAMC if !BUILD_WITH_TFM
	select FLASH_HAS_DRIVER_ENABLED
	select FLASH_HAS_PAGE_LAYOUT
	select FLASH_HAS_NO_EXPLICIT_ERASE
	select FLASH_NRF_FORCE_ALT
	select MPU_ALLOW_FLASH_WRITE if ARM_MPU
	help
	  Enables Nordic Semiconductor flash driver for nRF RRAM controllers.
	  The entire contiguous block of RRAM gets logically divided into pages,
	  but partial erase is always supported.

if SOC_FLASH_NRF_RRAM

config NRF_RRAM_WRITE_BUFFER_SIZE
	int "Internal write-buffer size"
	default 32 if !SOC_FLASH_NRF_RADIO_SYNC_NONE
	default 1
	range 0 32
	help
	  Number of 128-bit words.
	  Maximum buffer size can be configured to the value of 32 (128-bit words).
	  Set 0 to disable write-buffer.

config NRF_RRAM_READYNEXT_TIMEOUT_VALUE
	int "Preload timeout value for waiting for a next write in RRAMC clock cycles"
	default 128
	range 0 4095
	help
	  Set 0 to disable ready next timeout counter.

choice SOC_FLASH_NRF_RADIO_SYNC_CHOICE
	prompt "Nordic nRFx flash driver synchronization"
	default SOC_FLASH_NRF_RADIO_SYNC_TICKER if BT_LL_SW_SPLIT
	default SOC_FLASH_NRF_RADIO_SYNC_NONE
	help
	  synchronization between flash memory driver and radio.

config SOC_FLASH_NRF_RADIO_SYNC_TICKER
	bool "Nordic nRFx flash driver synchronized with radio"
	depends on BT_LL_SW_SPLIT
	help
	  Enable synchronization between flash memory driver and radio using
	  Bluetooth LE LL controller ticker API.

config SOC_FLASH_NRF_RADIO_SYNC_NONE
	bool "none"
	help
	  disable synchronization between flash memory driver and radio.
endchoice

config SOC_FLASH_NRF_TIMEOUT_MULTIPLIER
	int "Multiplier for flash operation timeouts [x0.1]"
	depends on !SOC_FLASH_NRF_RADIO_SYNC_NONE
	default 15
	help
	  This is a multiplier that will be divided by 10 that is applied
	  to the flash erase and write operations timeout. The base for
	  the multiplication would allow erasing all nRF flash pages in
	  blocking mode.

config NRF_RRAM_REGION_ADDRESS_RESOLUTION
	hex
	default 0x400
	help
	  RRAMC's region protection address resolution.
	  Applies to region with configurable start address.

config NRF_RRAM_REGION_SIZE_UNIT
	hex
	default 0x400
	help
	  Base unit for the size of RRAMC's region protection.

endif # SOC_FLASH_NRF_RRAM
```

## drivers/flash/Kconfig.numaker
```kconfig
# NUMAKER GPIO driver configuration options

# Copyright (c) 2023 Nuvoton Technology Corporation.
# SPDX-License-Identifier: Apache-2.0

config SOC_FLASH_NUMAKER
	bool "Nuvoton NuMaker MCU flash driver"
	default y
	select FLASH_HAS_PAGE_LAYOUT
	select FLASH_HAS_DRIVER_ENABLED
	select HAS_NUMAKER_FMC
	depends on DT_HAS_NUVOTON_NUMAKER_FMC_ENABLED
	help
	  This option enables the FMC driver for Nuvoton NuMaker family of
	  processors.
	  Say y if you wish to enable NuMaker FMC.
```

## drivers/flash/Kconfig.numaker_rmc
```kconfig
# NUMAKER GPIO driver configuration options

# Copyright (c) 2024 Nuvoton Technology Corporation.
# SPDX-License-Identifier: Apache-2.0

config SOC_FLASH_NUMAKER_RMC
	bool "Nuvoton NuMaker MCU embedded RRAM memory controller"
	default y
	select FLASH_HAS_PAGE_LAYOUT
	select FLASH_HAS_DRIVER_ENABLED
	select HAS_NUMAKER_RMC
	depends on DT_HAS_NUVOTON_NUMAKER_RMC_ENABLED
	help
	  This option enables the RMC driver for Nuvoton NuMaker family of
	  processors.
	  Say y if you wish to enable NuMaker RMC.
```

## drivers/flash/Kconfig.nxp_qspi_nor
```kconfig
# Copyright (c) 2020 Softube AB
# SPDX-License-Identifier: Apache-2.0

menuconfig NXP_QSPI_NOR
		bool "NXP QSPI NOR Flash"
		select FLASH_HAS_DRIVER_ENABLED
		select FLASH_HAS_PAGE_LAYOUT
		help
			Enable support for NXP QSPI NOR Flash driver using FlexSPI.

if NXP_QSPI_NOR

config NXP_QSPI_NOR_QE_BIT
	bool "Quad Enable bit number in Status Register"
	default true

config NXP_QSPI_NOR_INIT_PRIORITY
	int
	default 80
	help
	  Device driver initialization priority.

config NXP_QSPI_NOR_RAM_WRITE_BUFFER_SIZE
	int "Size of a ram-based buffer to support non-blocking writes"
	default 0
	help
	  Copy write data to static ram buffer to support non-blocking writes

endif # NXP_QSPI_NOR
```

## drivers/flash/Kconfig.nxp_s32
```kconfig
# Copyright 2023 NXP
# SPDX-License-Identifier: Apache-2.0

config FLASH_NXP_S32_QSPI_NOR
	bool "NXP S32 QSPI NOR driver"
	default y
	depends on DT_HAS_NXP_S32_QSPI_NOR_ENABLED
	select MEMC
	select FLASH_HAS_PAGE_LAYOUT
	select FLASH_HAS_DRIVER_ENABLED
	select FLASH_JESD216
	select FLASH_HAS_EXPLICIT_ERASE
	help
	  Enable the Flash driver for a NOR Serial Flash Memory device connected
	  to an NXP S32 QSPI bus.

if FLASH_NXP_S32_QSPI_NOR

config FLASH_NXP_S32_QSPI_NOR_SFDP_RUNTIME
	bool "Read flash parameters at runtime"
	help
	  Read flash device characteristics from the device at runtime.
	  This option should provide functionality for all supported
	  JESD216-compatible devices, with the following notes:
	  - Quad Enable Requirements bitfield (DW15) must be present in the SFDP
	    tables to configure Quad mode. Otherwise it defaults to Dual or
	    Single mode as supported by the device.
	  - Soft Reset bitfield (DW16) must be present in the SFDP tables to
	    automatically reset the device at initialization time.
	  - 0-X-X mode discovery not yet implemented by the HAL.

	  If not selected, the driver uses a fixed configuration assuming 256 By
	  page size and 4 KiBy, 32 KiBy and 64 KiBy erase instructions. The
	  device size and jedec-id properties must be set in devicetree node.

config FLASH_NXP_S32_QSPI_VERIFY_ERASE
	bool "Verify memory after erased"
	help
	  Verify contents of memory after erased.

config FLASH_NXP_S32_QSPI_VERIFY_WRITE
	bool "Verify memory after written"
	help
	  Verify contents of memory after written.

config FLASH_NXP_S32_QSPI_LAYOUT_PAGE_SIZE
	int "Page size to use for FLASH_LAYOUT feature"
	default 4096
	help
	  When CONFIG_FLASH_PAGE_LAYOUT is used this driver will support that API.
	  By default the page size corresponds to the sector size (4096) for a NOR
	  flash memory. Other options may include the 32K-byte erase size (32768),
	  the block size (65536), or any non-zero multiple of the sector size.

endif # FLASH_NXP_S32_QSPI_NOR
```

## drivers/flash/Kconfig.nxp_s32_xspi
```kconfig
# Copyright 2025 NXP
# SPDX-License-Identifier: Apache-2.0

config FLASH_NXP_S32_XSPI_HYPERRAM
	bool "NXP S32 XSPI HYPERRAM driver"
	default y
	depends on DT_HAS_NXP_S32_XSPI_HYPERRAM_ENABLED
	select MEMC
	select FLASH_HAS_PAGE_LAYOUT
	select FLASH_HAS_DRIVER_ENABLED
	select FLASH_HAS_EXPLICIT_ERASE
	help
	  Enable the Flash driver for a HyperRAM Memory device connected
	  to an NXP S32 XSPI bus.

if FLASH_NXP_S32_XSPI_HYPERRAM

config FLASH_NXP_S32_XSPI_LAYOUT_PAGE_SIZE
	int "Page size to use for FLASH_LAYOUT feature"
	default 4096
	help
	  When CONFIG_FLASH_PAGE_LAYOUT is used this driver will support that API.
	  By default the page size is set to 4096 bytes. HyperRAM is a volatile
	  memory and does not require erase operations like NOR flash. This page
	  size is used for memory layout reporting purposes only.

endif # FLASH_NXP_S32_XSPI_HYPERRAM
```

## drivers/flash/Kconfig.pic32cxsg
```kconfig
# Microchip PIC32CXSG flash driver config

# Copyright (c) 2024 Microchip
# SPDX-License-Identifier: Apache-2.0

menuconfig SOC_FLASH_PIC32CXSG
	bool "Microchip PIC32CXSG flash driver"
	default y
	depends on DT_HAS_PIC32CXSG_NVMCTRL_ENABLED
	select FLASH_HAS_PAGE_LAYOUT
	select FLASH_HAS_DRIVER_ENABLED
	select MPU_ALLOW_FLASH_WRITE if ARM_MPU
	help
	  Enable the Microchip PIC32CXSG series internal flash driver.

config SOC_FLASH_PIC32CXSG_EMULATE_BYTE_PAGES
	bool "Emulate byte-sized pages"
	depends on SOC_FLASH_PIC32CXSG
	default y
	help
	  Emulate a device with byte-sized pages by doing a
	  read/modify/erase/write.
```

## drivers/flash/Kconfig.qmsi
```kconfig
#
# Copyright (c) 2018 Intel Corporation
#
# SPDX-License-Identifier: Apache-2.0
#

menuconfig SOC_FLASH_QMSI
	bool "QMSI flash driver"
	depends on QMSI && FLASH
	select FLASH_HAS_DRIVER_ENABLED
	help
	  Enable QMSI Quark flash driver.

if SOC_FLASH_QMSI

config SOC_FLASH_QMSI_DEV_NAME
	string "QMSI flash device name"
	default "QUARK_FLASH"
	help
	  Specify the device name for the flash driver.

config SOC_FLASH_QMSI_CLK_COUNT_US
	int "System clk count per microsecond"
	default 32
	help
	  Specify the system clk cycles per microsecond.

config SOC_FLASH_QMSI_WAIT_STATES
	int "The number of flash wait states"
	default 1
	help
	  Specify the number of wait states for Quark flash.

config SOC_FLASH_QMSI_SYS_SIZE
	hex "SOC system flash size"
	help
	  Specify system flash size on the Quark SOC.

config SOC_FLASH_QMSI_API_REENTRANCY
	bool "flash driver API reentrancy for QMSI shim driver"
	help
	 Enable support for QMSI flash driver API reentrancy.

endif # SOC_FLASH_QMSI
```

## drivers/flash/Kconfig.qspi.nrf
```kconfig
# Kconfig.spi -  Nordic QSPI Flash driver configuration options

#
# Copyright (c) 2018 Findlay Feng
#
# SPDX-License-Identifier: Apache-2.0
#

config QSPI_FLASH_NRF
	bool "Nordic Semiconductor nRF QSPI flash driver"
	depends on SOC_FAMILY_NRF && HAS_HW_NRF_QSPI
	default n
	select NRFX_QSPI
	select HAS_DTS_SPI
	help
	  Enables Nordic Semiconductor nRF QSPI flash driver.

if QSPI_FLASH_NRF

choice
	prompt "QSPI read Opcode"
	default QSPI_FLASH_NRF_READOC_READ4IO

config QSPI_FLASH_NRF_READOC_FASTREAD
	bool "Read bytes at higher speed"
	help
		Single data line SPI. (opcode 0x0B).

config QSPI_FLASH_NRF_READOC_READ2O
	bool "Dual-read output"
	help
		Dual data line SPI. (opcode 0x3B).

config QSPI_FLASH_NRF_READOC_READ2IO
	bool "Dual-read input/output"
	help
		Dual data line SPI. (opcode 0xBB).

config QSPI_FLASH_NRF_READOC_READ4O
	bool "Quad-read output"
	help
		Quad data line SPI. (opcode 0x6B).

config QSPI_FLASH_NRF_READOC_READ4IO
	bool "Quad-read input/output"
	help
		Quad data line SPI. (opcode 0xEB).

endchoice

choice
	prompt "QSPI write Opcode"
	default QSPI_FLASH_NRF_WRITEOC_PP4IO

config QSPI_FLASH_NRF_WRITEOC_PP
	bool "Page program"
	help
		Single data line SPI. (opcode 0x0B).

config QSPI_FLASH_NRF_WRITEOC_PP2O
	bool "Dual-page program output"
	help
		Dual data line SPI. (opcode 0x3B).

config QSPI_FLASH_NRF_WRITEOC_PP4O
	bool "Quad-page program output"
	help
		Dual data line SPI. (opcode 0xBB).

config QSPI_FLASH_NRF_WRITEOC_PP4IO
	bool "Quad-page program input/output"
	help
		Quad data line SPI. (opcode 0x6B).

endchoice

choice
	prompt "QSPI addressing mode"
	default QSPI_FLASH_NRF_ADDRMODE_24BIT

config QSPI_FLASH_NRF_ADDRMODE_24BIT
	bool "24-bit"
	help
		24-bit addressing.

config QSPI_FLASH_NRF_ADDRMODE_32BIT
	bool "32-bit"
	help
		32-bit addressing.
endchoice

choice
	prompt "QSPI SPI mode."
	default QSPI_NRF_MODE_0

config QSPI_NRF_MODE_0
	bool "mode 0"
	help
		Mode 0 (CPOL=0, CPHA=0).

config QSPI_NRF_MODE_1
	bool "mode 1"
	help
		Mode 1 (CPOL=1, CPHA=1).

endchoice

config QSPI_FLASH_NRF_DPM
	bool "Deep Power-down Mode"
	default n
	help
		Enable the Deep Power-down Mode (DPM) feature.

config QSPI_FLASH_NRF_DELAY
	int "QSPI CS delay"
	range 0 255
	default 1
	help
	  Minimum amount of time that the CSN pin must stay high
	  before it can go low again. Value is specified in number of
	  16 MHz periods (62.5 ns).

config QSPI_FLASH_NRF_DEV_MX25R6435F
	bool "NOR Flash MX25R6435F"
	default n
	help
		MX25R6435F Chip initialization

endif # QSPI_FLASH
```

## drivers/flash/Kconfig.renesas_ra
```kconfig
# Renesas RA Family

# Copyright (c) 2024-2025 Renesas Electronics Corporation
# SPDX-License-Identifier: Apache-2.0

config SOC_FLASH_RENESAS_RA_HP
	bool "RA Flash HP driver"
	depends on DT_HAS_RENESAS_RA_FLASH_HP_CONTROLLER_ENABLED
	default y
	select FLASH_HAS_DRIVER_ENABLED
	select FLASH_PAGE_LAYOUT
	select FLASH_HAS_PAGE_LAYOUT
	select FLASH_HAS_EXPLICIT_ERASE
	select FLASH_HAS_EX_OP if(SOC_SERIES_RA8M1 || SOC_SERIES_RA8D1 || SOC_SERIES_RA8T1)
	select USE_RA_FSP_FLASH_HP
	help
	  Enable Flash High-Performance driver for RA series

if SOC_FLASH_RENESAS_RA_HP

config FLASH_RENESAS_RA_HP_WRITE_PROTECT
	bool "Extended operation for flash write protection control"
	help
	  Enables flash extended operation to enable/disable flash write
	  protection from external devices

config FLASH_RENESAS_RA_HP_BGO
	bool "Background operations feature"
	default y
	help
	  Enable Background operations (BGOs)

config FLASH_RENESAS_RA_HP_CHECK_BEFORE_READING
	bool "Verify area before reading it"
	default $(dt_nodelabel_bool_prop,flash1,erase-value-undefined)
	help
	  Do a blank check flash command before reading an area.
	  This feature prevents erroneous reading. Values read from an
	  area of the data flash that has been erased but not programmed
	  are undefined.

endif # SOC_FLASH_RENESAS_RA_HP

config SOC_FLASH_RENESAS_RA_LP
	bool "RA Flash LP driver"
	depends on DT_HAS_RENESAS_RA_FLASH_LP_CONTROLLER_ENABLED
	default y
	select FLASH_HAS_DRIVER_ENABLED
	select FLASH_PAGE_LAYOUT
	select FLASH_HAS_PAGE_LAYOUT
	select FLASH_HAS_EXPLICIT_ERASE
	select USE_RA_FSP_FLASH_LP
	help
	  Enable Flash Low-Power driver for RA series

if SOC_FLASH_RENESAS_RA_LP

config FLASH_RENESAS_RA_LP_BGO
	bool "Background operations feature"
	default y
	help
	  Enable Background operations (BGOs)

endif # SOC_FLASH_RENESAS_RA_LP

config SOC_FLASH_RENESAS_RA_MRAM
	bool "RA Flash MRAM driver"
	depends on DT_HAS_RENESAS_RA_MRAM_CONTROLLER_ENABLED
	default y
	select FLASH_HAS_DRIVER_ENABLED
	select FLASH_PAGE_LAYOUT
	select FLASH_HAS_PAGE_LAYOUT
	select FLASH_HAS_NO_EXPLICIT_ERASE
	select USE_RA_FSP_MRAM
	help
	  Enable Flash MRAM driver for RA series
```

## drivers/flash/Kconfig.renesas_ra_ospi
```kconfig
# Renesas RA Family

# Copyright (c) 2024-2025 Renesas Electronics Corporation
# SPDX-License-Identifier: Apache-2.0

config FLASH_RENESAS_RA_OSPI_B
	bool "Renesas RA Octal-SPI driver"
	default y
	depends on DT_HAS_RENESAS_RA_OSPI_B_NOR_ENABLED
	select FLASH_HAS_DRIVER_ENABLED
	select FLASH_HAS_PAGE_LAYOUT
	select FLASH_HAS_EXPLICIT_ERASE
	select USE_RA_FSP_OSPI_B_NOR_FLASH
	select FLASH_JESD216
	select FLASH_HAS_EX_OP
	select PINCTRL
	help
	  Enable Octal-SPI Nor flash driver for RA series
```

## drivers/flash/Kconfig.renesas_ra_qspi
```kconfig
# Renesas RA Family

# Copyright (c) 2024-2025 Renesas Electronics Corporation
# SPDX-License-Identifier: Apache-2.0

config FLASH_RENESAS_RA_QSPI
	bool "RA Quad-SPI driver"
	default y
	depends on DT_HAS_RENESAS_RA_QSPI_NOR_ENABLED
	select FLASH_HAS_DRIVER_ENABLED
	select FLASH_HAS_PAGE_LAYOUT
	select FLASH_HAS_EXPLICIT_ERASE
	select USE_RA_FSP_QSPI_NOR_FLASH
	select FLASH_HAS_EX_OP
	select FLASH_JESD216
	select PINCTRL
	help
	  Enable Quad-SPI Nor flash driver for RA series
```

## drivers/flash/Kconfig.renesas_rx
```kconfig
# Renesas RX Family

# Copyright (c) 2025 Renesas Electronics Corporation
# SPDX-License-Identifier: Apache-2.0

config SOC_FLASH_RENESAS_RX
	bool "RX flash driver"
	depends on DT_HAS_RENESAS_RX_FLASH_ENABLED
	default y
	select FLASH_HAS_DRIVER_ENABLED
	select FLASH_PAGE_LAYOUT
	select FLASH_HAS_PAGE_LAYOUT
	select FLASH_HAS_EXPLICIT_ERASE
	select USE_RX_RDP_FLASH
	help
	  Flash driver for RX series

if SOC_FLASH_RENESAS_RX

config FLASH_RENESAS_RX_BGO_ENABLED
	bool "RX flash BGO feature"
	default $(dt_nodelabel_bool_prop,data_flash,bgo-enable)
	help
	  Renesas RX flash BGO (Background Operation) feature
	  for RX series. This feature allows the flash driver to
	  perform background operations, such as erase and write,
	  while the CPU is executing other tasks. This only applies
	  to the data flash region.

config RX_FLASH_TYPE1
	bool
	depends on SOC_SERIES_RX130
	default y
	help
	  RX flash driver type 1

endif
```
