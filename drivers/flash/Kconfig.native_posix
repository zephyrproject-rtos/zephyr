## drivers/flash/Kconfig.native_posix
```kconfig
# Kconfig - Native POSIX Flash driver
#
# Copyright (c) 2019, Jan Van Winkel (jan.van_winkel@dxplore.eu)
#
# SPDX-License-Identifier: Apache-2.0

menuconfig FLASH_NATIVE_POSIX
	bool
	prompt "Native POSIX Flash driver"
	select FLASH_HAS_DRIVER_ENABLED
	select FLASH_HAS_PAGE_LAYOUT
	help
	  Enable Native POSIX flash driver.

if FLASH_NATIVE_POSIX

config FLASH_NATIVE_POSIX_SECTOR_SIZE
	int "Sector size"
	default 8
	help
	  This option specifies the sector size of the Native POSIX flash in KB

endif # FLASH_NATIVE_POSIX
```

## drivers/flash/Kconfig.nct_fiu
```kconfig
# NCT FIU Flash driver configuration options

# Copyright (c) 2025 Nuvoton Technology Corporation.
# SPDX-License-Identifier: Apache-2.0

config FLASH_NCT_FIU_QSPI
	bool "Nuvoton NCT FIU QSPI Bus Flash driver"
	default y
	depends on DT_HAS_NUVOTON_NCT_FIU_QSPI_ENABLED
	help
	  This option enables the FIU QSPI Bus Flash driver for NCT family
	  of processors.

config FLASH_NCT_FIU_SUPP_DRA_4B_ADDR
	bool "4 byte address support in Direct Read Access mode"
	default y
	help
	  Selected if NCT series supports 4 byte address mode in Direct Read
	  Access mode.
```

## drivers/flash/Kconfig.nct_nor
```kconfig
# NCT SPI-NOR driver configuration options

# Copyright (c) 2025 Nuvoton Technology Corporation.
# SPDX-License-Identifier: Apache-2.0

config FLASH_NCT_NOR
	bool "Nuvoton NCT Enhanced Super I/O (eSIO) SPI-NOR Flash driver"
	default y
	depends on DT_HAS_NUVOTON_NCT_NOR_ENABLED
	depends on FLASH_NCT_FIU_QSPI || FLASH_NCT_SPIM_QSPI || FLASH_NCT_SPIP_QSPI
	select FLASH_HAS_DRIVER_ENABLED
	select FLASH_HAS_PAGE_LAYOUT
	select FLASH_JESD216
	select FLASH_HAS_EX_OP
	help
	  This option enables the SPI-NOR Flash driver for NCT family of
	  processors.

config FLASH_NCT_NOR_INIT
	bool "SPI-NOR flash feature during driver initialization"
	default y
	depends on FLASH_NCT_NOR
	help
	  This option enables the SPI-NOR Flash features such as Quad-Enable,
	  4-byte address support and so on during driver initialization. Disable
	  it if SPI-NOR devices are not ready during driver initialization.
```

## drivers/flash/Kconfig.nct_spip
```kconfig
# NCT SPIM Flash driver configuration options

# Copyright (c) 2024 Nuvoton Technology Corporation.
# SPDX-License-Identifier: Apache-2.0

config FLASH_NCT_SPIP_QSPI
	bool "Nuvoton NCT SPIP QSPI Bus Flash driver"
	default y
	depends on DT_HAS_NUVOTON_NCT_SPIP_QSPI_ENABLED
	help
	  This option enables the SPIP QSPI Bus Flash driver for NCT family
	  of processors.

config FLASH_NCT_SPIP_SUPP_DRA_4B_ADDR
	bool "4 byte address support in Direct Read Access mode"
	default y
	help
	  Selected if NCT series supports 4 byte address mode in Direct Read
	  Access mode.
```

## drivers/flash/Kconfig.nios2_qspi
```kconfig
# SPDX-License-Identifier: Apache-2.0

config SOC_FLASH_NIOS2_QSPI
	bool "Nios-II QSPI flash driver"
	default y
	depends on HAS_ALTERA_HAL
	depends on DT_HAS_ALTR_NIOS2_QSPI_NOR_ENABLED
	select FLASH_HAS_DRIVER_ENABLED
	select FLASH_HAS_EXPLICIT_ERASE
	help
	  Enables the Nios-II QSPI flash driver.
```

## drivers/flash/Kconfig.nor
```kconfig
# Copyright (c) 2018 Savoir-Faire Linux.
# Copyright (c) 2024 Nordic Semiconductor ASA
#
# SPDX-License-Identifier: Apache-2.0

menuconfig SPI_NOR
	bool "SPI NOR Flash"
	default y
	depends on DT_HAS_JEDEC_SPI_NOR_ENABLED
	select FLASH_HAS_DRIVER_ENABLED
	select FLASH_HAS_EXPLICIT_ERASE
	select FLASH_HAS_PAGE_LAYOUT
	select FLASH_JESD216
	select FLASH_HAS_EX_OP
	select SPI

if SPI_NOR

choice SPI_NOR_SFDP
	prompt "Source for Serial Flash Discoverable Parameters"
	default SPI_NOR_SFDP_MINIMAL

config SPI_NOR_SFDP_MINIMAL
	bool "Fixed flash configuration"
	help
	  Synthesize a minimal configuration assuming 256 By page size (or as
	  set by the page-size devicetree property) and
	  standard 4 KiBy and 64 KiBy erase instructions.  Requires the size and
	  jedec-id properties in the devicetree jedec,spi-nor node.

config SPI_NOR_SFDP_DEVICETREE
	bool "Basic Flash Parameters from devicetree node"
	help
	  The JESD216 Basic Flash Parameters table must be provided in the
	  sfdp-bfp property in devicetree.  The size and jedec-id properties are
	  also required.

config SPI_NOR_SFDP_RUNTIME
	bool "Read flash parameters at runtime"
	help
	  Read all flash device characteristics from the device at runtime.
	  This option is the most flexible as it should provide functionality
	  for all supported JESD216-compatible devices.

endchoice

config SPI_NOR_INIT_PRIORITY
	int
	default 80
	help
	  Device driver initialization priority.
	  Device is connected to SPI bus, it has to
	  be initialized after SPI driver.

config SPI_NOR_CS_WAIT_DELAY
	int "Delay time in us"
	default 0
	help
	  This is the wait delay (in us) to allow for CS switching to take effect

config SPI_NOR_SLEEP_WHILE_WAITING_UNTIL_READY
	bool "Sleep while waiting for flash operations to complete"
	default y
	help
	  Flash operations can take anywhere from 1ms to 240 seconds to
	  complete. Enabling this option adds a delay between polls on the
	  status register for slow operations. Disabling this option can
	  result in significant flash savings if this driver is the only user
	  of "k_sleep". This can be the case when building as a bootloader.

config SPI_NOR_FLASH_LAYOUT_PAGE_SIZE
	int "Page size to use for FLASH_LAYOUT feature"
	default 65536
	help
	  When CONFIG_FLASH_PAGE_LAYOUT is used this driver will support
	  that API.  By default the page size corresponds to the block
	  size (65536).  Other options include the 32K-byte erase size
	  (32768), the sector size (4096), or any non-zero multiple of the
	  sector size.

config SPI_NOR_IDLE_IN_DPD
	bool "Use Deep Power-Down mode when flash is not being accessed."
	help
	  Where supported deep power-down mode can reduce current draw
	  to as little as 0.1% of standby current.  However it takes
	  some milliseconds to enter and exit from this mode.

	  Select this option for applications where device power
	  management is not enabled, the flash remains inactive for
	  long periods, and when used the impact of waiting for mode
	  enter and exit delays is acceptable.

endif # SPI_NOR
```

## drivers/flash/Kconfig.nordic_qspi_nor
```kconfig
# Copyright (c) 2019, Nordic Semiconductor ASA
# SPDX-License-Identifier: Apache-2.0

menuconfig NORDIC_QSPI_NOR
	bool "QSPI NOR Flash"
	default y
	depends on DT_HAS_NORDIC_QSPI_NOR_ENABLED
	select FLASH_HAS_DRIVER_ENABLED
	select NRFX_QSPI
	select FLASH_JESD216
	select PINCTRL
	help
	  Enable support for nrfx QSPI driver with EasyDMA.

if NORDIC_QSPI_NOR

config NORDIC_QSPI_NOR_INIT_PRIORITY
	int "Init priority"
	default 41
	help
	  Device driver initialization priority.

config NORDIC_QSPI_NOR_FLASH_LAYOUT_PAGE_SIZE
	int "Page size to use for FLASH_LAYOUT feature"
	default 65536
	help
	  When CONFIG_FLASH_PAGE_LAYOUT is used this driver will support
	  that API.  By default the page size corresponds to the block
	  size (65536).  Other option include the sector size (4096).

config NORDIC_QSPI_NOR_STACK_WRITE_BUFFER_SIZE
	int "Size of a stack-based buffer to handle writes not supported by QSPI"
	default 4
	help
	  The QSPI peripheral uses DMA and can only write data that is read
	  from a word-aligned location in RAM. A non-zero value here enables
	  a stack buffer to be used for any source data that does not meet
	  these restrictions. Such data will be copied into this buffer to
	  allow the write to proceed. Multiple transfers will be initiated
	  if the data is larger than the configured size.
	  Must be a multiple of 4. When set to 0, the feature is disabled.

config NORDIC_QSPI_NOR_XIP
	bool "XIP (eXecute in place)"
	depends on SOC_NRF5340_CPUAPP
	help
	  Enable setting up the QSPI NOR driver to allow for execution of code
	  stored in QSPI XIP region. Note that for this functionality to work,
	  the QSPI NOR init priority must be set so that no XIP code in the
	  QSPI NOR flash chip is executed until the driver has been setup.
	  This will also disable power management for the QSPI NOR flash chip.

endif # NORDIC_QSPI_NOR
```

## drivers/flash/Kconfig.npcm_fiu
```kconfig
# NPCM FIU Flash driver configuration options

# Copyright (c) 2024 Nuvoton Technology Corporation.
# SPDX-License-Identifier: Apache-2.0

config FLASH_NPCM_FIU_QSPI
	bool "Nuvoton NPCM FIU QSPI Bus Flash driver"
	default y
	depends on DT_HAS_NUVOTON_NPCM_FIU_QSPI_ENABLED
	help
	  This option enables the FIU QSPI Bus Flash driver for NPCM family
	  of processors.

config FLASH_NPCM_FIU_SUPP_DRA_4B_ADDR
	bool "4 byte address support in Direct Read Access mode"
	default y
	help
	  Selected if NPCM series supports 4 byte address mode in Direct Read
	  Access mode.
```

## drivers/flash/Kconfig.npcx_fiu
```kconfig
# NPCX Flash driver configuration options

# Copyright (c) 2023 Nuvoton Technology Corporation.
# SPDX-License-Identifier: Apache-2.0

config FLASH_NPCX_FIU_QSPI
	bool "Nuvoton NPCX QSPI Bus Flash driver"
	default y
	depends on DT_HAS_NUVOTON_NPCX_FIU_QSPI_ENABLED
	select PINCTRL
	help
	  This option enables the QSPI Bus Flash driver for NPCX family of
	  processors.

config FLASH_NPCX_FIU_NOR
	bool "Nuvoton NPCX embedded controller (EC) QSPI NOR Flash driver"
	default y
	depends on DT_HAS_NUVOTON_NPCX_FIU_NOR_ENABLED
	depends on FLASH_NPCX_FIU_QSPI
	select FLASH_HAS_DRIVER_ENABLED
	select FLASH_HAS_PAGE_LAYOUT
	select FLASH_HAS_EXPLICIT_ERASE
	select FLASH_JESD216
	select FLASH_HAS_EX_OP
	help
	  This option enables the QSPI NOR Flash driver for NPCX family of
	  processors.

if FLASH_NPCX_FIU_QSPI

config FLASH_NPCX_FIU_NOR_INIT
	bool "QSPI NOR flash feature during driver initialization"
	default y
	depends on FLASH_NPCX_FIU_NOR
	help
	  This option enables the QSPI NOR Flash features such as Quad-Enable,
	  4-byte address support and so on during driver initialization. Disable
	  it if QSPI NOR devices are not ready during driver initialization.

config FLASH_NPCX_FIU_DRA_V1
	bool "Direct Read Access version 1 support"
	default y if SOC_SERIES_NPCX9
	help
	  This option enables DRA V1 support.

config FLASH_NPCX_FIU_DRA_V2
	bool "Direct Read Access version 2 support"
	default y if SOC_SERIES_NPCX4
	help
	  This option enables DRA V1 support.

config FLASH_NPCX_FIU_SUPP_DRA_4B_ADDR
	bool "4 byte address support in Direct Read Access mode"
	default y if FLASH_NPCX_FIU_DRA_V1 || \
		     FLASH_NPCX_FIU_DRA_V2
	help
	  Selected if NPCX series supports 4 byte address mode in Direct Read
	  Access mode.

config FLASH_NPCX_FIU_SUPP_DRA_2_DEV
	bool "4 byte address support in Direct Read Access mode"
	default y if FLASH_NPCX_FIU_DRA_V1 || \
		     FLASH_NPCX_FIU_DRA_V2
	help
	  Selected if NPCX series supports two external SPI devices in Direct
	  Read Access (DRA) on QSPI bus.

DT_NPCX_FIU_LOW_DEV_SWAP := $(dt_nodelabel_bool_prop,qspi_fiu1,flash-dev-inv)
config FLASH_NPCX_FIU_SUPP_LOW_DEV_SWAP
	bool "Inverse the access of the two external flashes"
	default y if SOC_SERIES_NPCX4 && FLASH_NPCX_FIU_SUPP_DRA_2_DEV && \
		     "$(DT_NPCX_FIU_LOW_DEV_SWAP)"
	help
	  Select if it needs to swap the access of the two external flashes.

endif #FLASH_NPCX_FIU_QSPI
```

## drivers/flash/Kconfig.nrf
```kconfig
# SPDX-License-Identifier: Apache-2.0

config FLASH_NRF_FORCE_ALT
	bool
	depends on SOC_COMPATIBLE_NRF
	help
	  This option can be enabled to force an alternative implementation
	  of the flash driver.

menuconfig SOC_FLASH_NRF
	bool "Nordic Semiconductor nRF flash driver"
	default y
	depends on DT_HAS_NORDIC_NRF51_FLASH_CONTROLLER_ENABLED || \
		   DT_HAS_NORDIC_NRF52_FLASH_CONTROLLER_ENABLED || \
		   DT_HAS_NORDIC_NRF53_FLASH_CONTROLLER_ENABLED || \
		   DT_HAS_NORDIC_NRF91_FLASH_CONTROLLER_ENABLED
	depends on !FLASH_NRF_FORCE_ALT
	select FLASH_HAS_PAGE_LAYOUT
	select FLASH_HAS_DRIVER_ENABLED
	select FLASH_HAS_EXPLICIT_ERASE
	select NRFX_NVMC
	select MPU_ALLOW_FLASH_WRITE if ARM_MPU
	help
	  Enables Nordic Semiconductor nRF flash driver.

if SOC_FLASH_NRF

choice SOC_FLASH_NRF_RADIO_SYNC_CHOICE
	prompt "Nordic nRFx flash driver synchronization"
	default SOC_FLASH_NRF_RADIO_SYNC_TICKER if BT_LL_SW_SPLIT
	default SOC_FLASH_NRF_RADIO_SYNC_NONE
	help
	  synchronization between flash memory driver and radio.

config SOC_FLASH_NRF_RADIO_SYNC_TICKER
	bool "Nordic nRFx flash driver synchronized with radio"
	depends on BT_LL_SW_SPLIT
	help
	  Enable synchronization between flash memory driver and radio using
	  BLE LL controller ticker API.

config SOC_FLASH_NRF_RADIO_SYNC_NONE
	bool "none"
	help
	  disable synchronization between flash memory driver and radio.
endchoice

config SOC_FLASH_NRF_PARTIAL_ERASE
	bool "Nordic nRFx flash driver partial erase"
	depends on HAS_HW_NRF_NVMC_PE
	help
	  Enable partial erase feature. Partial erase is performed in time
	  slices instead of blocking MCU, for the time it is needed to
	  complete operation over given area.
	  This allows interrupting flash erase between operations
	  to perform other task by MCU.
	  This feature may also be used for better syncing flash erase
	  operations, when compiled with SOC_FLASH_NRF_RADIO_SYNC_TICKER,
	  with Bluetooth.

config SOC_FLASH_NRF_PARTIAL_ERASE_MS
	int "Partial erase timeout in MS"
	depends on SOC_FLASH_NRF_PARTIAL_ERASE
	default 3
	help
	  This is maximum time, in ms, that NVMC will use to erase part
	  of Flash, before stopping to let CPU resume operation.
	  Minimal timeout is 2ms maximum should not exceed half of
	  FLASH_PAGE_ERASE_MAX_TIME_US im ms.

config SOC_FLASH_NRF_TIMEOUT_MULTIPLIER
	int "Multiplier for flash operation timeouts [x0.1]"
	depends on !SOC_FLASH_NRF_RADIO_SYNC_NONE
	default 15 if SOC_FLASH_NRF_PARTIAL_ERASE && SOC_FLASH_NRF_RADIO_SYNC_TICKER
	default 10
	help
	  This is a multiplier that will be divided by 10 that is applied
	  to the flash erase and write operations timeout. The base for
	  the multiplication would allow erasing all nRF flash pages in
	  blocking mode.

config SOC_FLASH_NRF_UICR
	bool "Access to UICR"
	depends on !TRUSTED_EXECUTION_NONSECURE
	help
	  Enable operations on UICR. Once enabled UICR are written or read as
	  ordinary flash memory. Erase is possible for whole UICR at once.

config SOC_FLASH_NRF_EMULATE_ONE_BYTE_WRITE_ACCESS
	bool "8-bit write block size emulation"
	help
	  When this option is enabled writing chunks less than minimal write
	  block size parameter (imposed by manufacturer) is possible but operation
	  is more complex and requires basic user knowledge about NVMC controller.

endif # SOC_FLASH_NRF
```

## drivers/flash/Kconfig.nrf_mramc
```kconfig
#
# Copyright (c) 2025 Nordic Semiconductor ASA
#
# SPDX-License-Identifier: Apache-2.0
#

config SOC_FLASH_NRF_MRAMC
	bool "Nordic Semiconductor flash driver for MRAM using MRAM Controller"
	default y
	depends on DT_HAS_NORDIC_NRF_MRAMC_ENABLED
	imply NRFX_MRAMC if !BUILD_WITH_TFM
	select FLASH_HAS_DRIVER_ENABLED
	select FLASH_HAS_PAGE_LAYOUT
	select FLASH_HAS_NO_EXPLICIT_ERASE
	imply MPU_ALLOW_FLASH_WRITE if ARM_MPU
	help
	  Enables Nordic Semiconductor flash driver for MRAMC in direct write mode.

config NRF_MRAMC_REGION_ADDRESS_RESOLUTION
	hex
	default 0x400
	help
	  MRAMC's region protection address resolution.
	  Applies to region with configurable start address.

config NRF_MRAMC_REGION_SIZE_UNIT
	hex
	default 0x400
	help
	  Base unit for the size of MRAMC's region protection.

config NRF_MRAMC_MAX_RETRIES
	int "Maximum number of retries for MRAM write/erase operations"
	default 20
	range 1 255
	depends on SOC_FLASH_NRF_MRAMC
	help
	  This option sets the maximum number of retry attempts for MRAM
	  write and erase operations when verification fails. Each retry
	  attempts to rewrite or re-erase the data to ensure reliability.
	  Higher values increase reliability but may impact performance
	  in case of persistent failures.
```
