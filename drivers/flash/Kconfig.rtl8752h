## drivers/flash/Kconfig.spi
```kconfig
# Kconfig.spi - SPI Flash driver configuration options

#
# Copyright (c) 2018 Findlay Feng
#
# SPDX-License-Identifier: Apache-2.0
#

config SPI_FLASH
	bool "SPI NOR Flash"
	depends on SPI && FLASH
	default n
	select FLASH_HAS_DRIVER_ENABLED
	help
	  Enable options for SPI Flash drivers.
	  Identify devices through the SFDP protocol.
	  See https://www.jedec.org/system/files/docs/JESD216B.pdf

if SPI_FLASH

config	SYS_LOG_SPI_FLASH_LEVEL
	int
	prompt "SPI FLASH driver log level"
	depends on SYS_LOG && SPI_FLASH
	default 0
	range 0 4
	help
	  Sets log level for SLIP driver.
	  Levels are:
	  0 OFF, do not write
	  1 ERROR, only write SYS_LOG_ERR
	  2 WARNING, write SYS_LOG_WRN in addition to previous level
	  3 INFO, write SYS_LOG_INF in addition to previous levels
	  4 DEBUG, write SYS_LOG_DBG in addition to previous levels

config SPI_FLASH_SPI_NAME
	string
	prompt "SPI controller device name"
	depends on SPI_FLASH
	default "SPI_0"

config SPI_FLASH_DRV_NAME
	string
	prompt "SPI flash device name"
	depends on SPI_FLASH
	default "SPI_FLASH"

config SPI_FLASH_SPI_SLAVE
	int "SPI slave linked to SPI flash"
	depends on SPI_FLASH
	default 0
	help
	  This option sets the SPI slave number the SPI controller has to switch
	  to when dealing with SPI flash chip.

config SPI_FLASH_INIT_PRIORITY
	int "SPI FLASH driver initialization priority"
	depends on SPI_FLASH
	default 80
	help
	  Device driver initialization priority.
	  Device is connected to SPI bus, it has to
	  be initialized after SPI driver.

config SPI_FLASH_SPI_FREQ_0
	int "SPI system frequency"
	depends on SPI_FLASH
	default 80000000
	help
	  This option sets the SPI controller's frequency. Beware this value
	  depends on the SPI controller being used and also on the system
	  clock.

config SPI_FLASH_GPIO_SPI_CS
	bool "Manage SPI CS through a GPIO pin"
	depends on SPI_FLASH
	default n
	help
	  This option is useful if one needs to manage SPI CS through a GPIO
	  pin to by-pass the SPI controller's CS logic.

config SPI_FLASH_GPIO_SPI_CS_DRV_NAME
	string "GPIO driver's name to use to drive SPI CS through"
	depends on SPI_FLASH_GPIO_SPI_CS
	default ""
	help
	  This option is mandatory to set which GPIO controller to use in order
	  to actually emulate the SPI CS.

config SPI_FLASH_GPIO_SPI_CS_PIN
	int "GPIO PIN to use to drive SPI CS through"
	default 0
	depends on SPI_FLASH_GPIO_SPI_CS
	help
	  This option is mandatory to set which GPIO pin to use in order
	  to actually emulate the SPI CS.

config SPI_FLASH_GPIO_CS_WAIT_DELAY
	int "Delay time in us"
        depends on SPI_FLASH_GPIO_SPI_CS
	default 0
	help
	  This is the wait delay (in us) to allow for CS switching to take effect

endif # SPI_FLASH

gsource "drivers/flash/Kconfig.spi.*"
```

## drivers/flash/Kconfig.spi.microchip
```kconfig
# Kconfig.spi.microchip - SPI Flash driver configuration options

#
# Copyright (c) 2018 Findlay Feng
#
# SPDX-License-Identifier: Apache-2.0
#

config SPI_FLASH_MICROCHIP
	bool "Microchip SFDP table"
	depends on SPI_FLASH
	default n
	help
	  Enable options for Microchip SFDP table.
```

## drivers/flash/Kconfig.spi.w25qxxdv
```kconfig
# Kconfig - SPI Flash driver (W25QXXDV) configuration options

#
# Copyright (c) 2016 Intel Corporation
#
# SPDX-License-Identifier: Apache-2.0
#

config SPI_FLASH_W25QXXDV
	bool
	prompt "SPI NOR Flash Winbond W25QXXDV"
	select FLASH_HAS_DRIVER_ENABLED
	default n

if SPI_FLASH_W25QXXDV

config SPI_FLASH_W25QXXDV_SPI_NAME
	string
	prompt "SPI controller device name"
	depends on SPI_FLASH_W25QXXDV
	default ""

config SPI_FLASH_W25QXXDV_DRV_NAME
	string
	prompt "SPI flash device name"
	depends on SPI_FLASH_W25QXXDV
	default "W25QXXDV"

config SPI_FLASH_W25QXXDV_INIT_PRIORITY
	int
	depends on SPI_FLASH_W25QXXDV
	default 80
	help
	  Device driver initialization priority.
	  Device is connected to SPI bus, it has to
	  be initialized after SPI driver.

config SPI_FLASH_W25QXXDV_SPI_FREQ_0
	int "SPI system frequency"
	depends on SPI_FLASH_W25QXXDV
	default 8000000
	help
	  This option sets the SPI controller's frequency. Beware this value
	  depends on the SPI controller being used and also on the system
	  clock.

config	SPI_FLASH_W25QXXDV_SPI_SLAVE
	int "SPI slave linked to SPI flash"
	depends on SPI_FLASH_W25QXXDV
	default 0
	help
	  This option sets the SPI slave number the SPI controller has to switch
	  to when dealing with WinBond SPI flash chip.

config SPI_FLASH_W25QXXDV_FLASH_SIZE
	int "Flash size in bytes"
	depends on SPI_FLASH_W25QXXDV
	default 2097152
	help
	  This is the flash capacity in bytes.

config SPI_FLASH_W25QXXDV_MAX_DATA_LEN
	int
	range 1 256
	depends on SPI_FLASH_W25QXXDV
	default 256
	help
	  Maximum transmit or receive data length in one user data frame.

endif # SPI_FLASH_W25QXXDV
```

## drivers/flash/Kconfig.spi_nor_gd25q64c
```kconfig
config SPI_NOR_EXTRAS_GD25Q64C
	bool "Provide API to read One Time Program registers of NOR flash"
	depends on SPI_NOR
	help
	  Enable extra functionality for the GD25Q64C SPI NOR IC.
```

## drivers/flash/Kconfig.stm32
```kconfig
# ST Microelectronics STM32 MCUs Flash driver config

# Copyright (c) 2016 RnDity Sp. z o.o.
# Copyright (c) 2017 BayLibre, SAS
# Copyright (c) 2022 Linaro Limited
# Copyright (c) 2023 Google Inc
# SPDX-License-Identifier: Apache-2.0

config STM32_MEMMAP
	bool "NOR Flash in MemoryMapped for XiP"
	depends on XIP && \
		    (DT_HAS_ST_STM32_OSPI_NOR_ENABLED || \
		     DT_HAS_ST_STM32_QSPI_NOR_ENABLED || \
		     DT_HAS_ST_STM32_XSPI_NOR_ENABLED)
	help
	  This option enables the XIP mode for the external NOR flash
	  mounted on STM32 boards.

menuconfig SOC_FLASH_STM32
	bool "STM32 flash driver"
	depends on DT_HAS_ST_STM32_FLASH_CONTROLLER_ENABLED
	select FLASH_HAS_DRIVER_ENABLED
	default y
	select FLASH_HAS_PAGE_LAYOUT
	select FLASH_HAS_EXPLICIT_ERASE
	select MPU_ALLOW_FLASH_WRITE if ARM_MPU
	select USE_STM32_HAL_FLASH if BT_STM32WBA
	select USE_STM32_HAL_FLASH_EX if BT_STM32WBA
	help
	  Enable flash driver for STM32 series

if SOC_FLASH_STM32

config FLASH_STM32_WRITE_PROTECT
	bool "Extended operation for flash write protection control"
	depends on SOC_SERIES_STM32F4X
	select FLASH_HAS_EX_OP
	default n
	help
	  Enables flash extended operation for enabling/disabling flash write
	  protection.

config FLASH_STM32_WRITE_PROTECT_DISABLE_PREVENTION
	bool "Prevent from disabling flash write protection"
	depends on FLASH_STM32_WRITE_PROTECT
	default n
	help
	  If enabled, all requests to disable flash write protection will be
	  blocked.

config FLASH_STM32_READOUT_PROTECTION
	bool "Extended operation for flash readout protection control"
	depends on SOC_SERIES_STM32F4X || SOC_SERIES_STM32L4X || \
			   SOC_SERIES_STM32G4X || SOC_SERIES_STM32F7X
	select FLASH_HAS_EX_OP
	default n
	help
	  Enables flash extended operation for enabling/disabling flash readout
	  protection.

config FLASH_STM32_READOUT_PROTECTION_DISABLE_ALLOW
	bool "Allow disabling readout protection"
	depends on FLASH_STM32_READOUT_PROTECTION
	default n
	help
	  With this option enabled it will be possible to disable readout
	  protection. On STM32 devices it will trigger flash mass erase!

config FLASH_STM32_READOUT_PROTECTION_PERMANENT_ALLOW
	bool "Allow enabling readout protection permanently"
	depends on FLASH_STM32_READOUT_PROTECTION
	default n
	help
	  With this option enabled it will be possible to enable readout
	  protection permanently.

config FLASH_STM32_BLOCK_REGISTERS
	bool "Extended operation for blocking option and control registers"
	select FLASH_HAS_EX_OP
	default n
	help
	  Enables flash extended operations that can be used to disable access
	  to option and control registers until reset. Disabling access to these
	  registers improves system security, because flash content (or
	  protection settings) can't be changed even when exploit was found.

config USE_MICROCHIP_QSPI_FLASH_WITH_STM32
	bool "Include patch for Microchip qspi flash when running with stm32"
	depends on DT_HAS_ST_STM32_QSPI_NOR_ENABLED
	help
	  Set to use Microchip qspi flash memories which supports
	  the Global Block Protection Unlock instruction (ULBPR - 98H),
	  and write with SPI_NOR_CMD_PP_1_1_4 on 4 lines

endif # SOC_FLASH_STM32
```

## drivers/flash/Kconfig.stm32_fmc
```kconfig
# STM32 flexible memory controller configuration options

# Copyright (c) 2025 Endress+Hauser GmbH+Co. KG
# SPDX-License-Identifier: Apache-2.0

DT_STM32_FMC_NAND_HAS_DMA := $(dt_compat_any_has_prop,$(DT_COMPAT_ST_STM32_FMC_NAND),dmas)

config FLASH_STM32_FMC_NAND
	bool "STM32 FMC NAND flash controller"
	default y
	depends on DT_HAS_ST_STM32_FMC_NAND_ENABLED
	select MEMC
	select USE_STM32_LL_FMC
	select DMA if $(DT_STM32_FMC_NAND_HAS_DMA)
	select USE_STM32_HAL_DMA if $(DT_STM32_FMC_NAND_HAS_DMA)
	help
	  Enable parallel NAND flash support on the STM32 family of processors.
```

## drivers/flash/Kconfig.stm32_ospi
```kconfig
# STM32 Octo SPI flash driver configuration options

# Copyright (c) 2022 STMicroelectronics
# SPDX-License-Identifier: Apache-2.0

DT_STM32_OCTOSPI_HAS_DMA := $(dt_compat_any_has_prop,$(DT_COMPAT_ST_STM32_OSPI),dmas)

config FLASH_STM32_OSPI
	bool "STM32 Octo SPI Flash driver"
	default y
	depends on DT_HAS_ST_STM32_OSPI_NOR_ENABLED
	select USE_STM32_HAL_OSPI
	select USE_STM32_LL_DLYB if SOC_SERIES_STM32U5X
	select USE_STM32_HAL_MDMA if SOC_SERIES_STM32H7X
	select FLASH_HAS_DRIVER_ENABLED
	select FLASH_JESD216
	select FLASH_HAS_PAGE_LAYOUT
	select FLASH_HAS_EXPLICIT_ERASE
	select PINCTRL
	select DMA if $(DT_STM32_OCTOSPI_HAS_DMA)
	select USE_STM32_HAL_DMA if $(DT_STM32_OCTOSPI_HAS_DMA)
	select USE_STM32_HAL_DMA_EX if SOC_SERIES_STM32U5X && \
					$(DT_STM32_OCTOSPI_HAS_DMA)
	help
	  Enable OSPI-NOR support on the STM32 family of processors.

if FLASH_STM32_OSPI

config FLASH_STM32_ERRATUM_U5_STOP2_3_CORRUPT_READ
	bool "Workaround for corrupted reads after Stop 2/3 exit"
	default y if PM
	depends on SOC_STM32U595XX || SOC_STM32U599XX || SOC_STM32U5A5XX || SOC_STM32U5A9XX
	help
	  Enable workaround for erratum "OCTOSPI external memory
	  read issue after exiting Stop 2 or Stop 3 mode when using
	  DQS and delay block" documented in section 2.5.13 of errata
	  sheet ES0553 revision 5.

endif # FLASH_STM32_OSPI
```

## drivers/flash/Kconfig.stm32_qspi
```kconfig
# STM32 Quad SPI flash driver configuration options

# Copyright (c) 2020 Piotr Mienkowski
# Copyright (c) 2020 Linaro Limited
# SPDX-License-Identifier: Apache-2.0

DT_STM32_QUADSPI_HAS_DMA := $(dt_compat_any_has_prop,$(DT_COMPAT_ST_STM32_QSPI),dmas)

config FLASH_STM32_QSPI
	bool "STM32 Quad SPI Flash driver"
	default y
	depends on DT_HAS_ST_STM32_QSPI_NOR_ENABLED
	select USE_STM32_HAL_QSPI
	select USE_STM32_HAL_MDMA if SOC_SERIES_STM32H7X
	select FLASH_HAS_DRIVER_ENABLED
	select FLASH_JESD216
	select FLASH_HAS_PAGE_LAYOUT
	select FLASH_HAS_EXPLICIT_ERASE
	select PINCTRL
	select DMA if $(DT_STM32_QUADSPI_HAS_DMA)
	select USE_STM32_HAL_DMA if $(DT_STM32_QUADSPI_HAS_DMA)
	help
	  Enable QSPI-NOR support on the STM32 family of processors.
```

## drivers/flash/Kconfig.stm32_xspi
```kconfig
# STM32 xSPI flash driver configuration options

# Copyright (c) 2024 STMicroelectronics
# SPDX-License-Identifier: Apache-2.0

DT_STM32_XSPI_HAS_DMA := $(dt_compat_any_has_prop,$(DT_COMPAT_ST_STM32_XSPI),dmas)

config FLASH_STM32_XSPI
	bool "STM32 XSPI Flash driver"
	default y
	depends on DT_HAS_ST_STM32_XSPI_ENABLED && DT_HAS_ST_STM32_XSPI_NOR_ENABLED
	select USE_STM32_HAL_XSPI
	select USE_STM32_LL_DLYB
	select FLASH_HAS_DRIVER_ENABLED
	select FLASH_JESD216
	select FLASH_PAGE_LAYOUT
	select FLASH_HAS_PAGE_LAYOUT
	select FLASH_HAS_EXPLICIT_ERASE
	select PINCTRL
	help
	  Enable XSPI-NOR support on the STM32 family of processors.

if FLASH_STM32_XSPI

config FLASH_STM32_XSPI_DMA
	bool "DMA Support for STM32 XSPI Flash"
	depends on $(DT_STM32_XSPI_HAS_DMA)
	default y
	select DMA
	select USE_STM32_HAL_DMA if $(DT_STM32_XSPI_HAS_DMA)
	select USE_STM32_HAL_DMA_EX if (SOC_SERIES_STM32H5X || SOC_SERIES_STM32N6X) && \
					$(DT_STM32_XSPI_HAS_DMA)
	help
	  Enable the DMA mode for XSPI flash driver instance

endif # FLASH_STM32_XSPI
```
