## drivers/flash/Kconfig.rtl8752h
```kconfig
# Copyright(c) 2026, Realtek Semiconductor Corporation.
# SPDX-License-Identifier: Apache-2.0

config SOC_FLASH_RTL8752H
	bool "Realtek RTL8752H flash driver"
	default y
	depends on DT_HAS_REALTEK_RTL8752H_FLASH_CONTROLLER_ENABLED
	select FLASH_HAS_DRIVER_ENABLED
	select FLASH_HAS_PAGE_LAYOUT
	select FLASH_HAS_EXPLICIT_ERASE
	help
	  Enable rtl8752h flash driver.

if SOC_FLASH_RTL8752H

choice
	prompt "Realtek RTL8752H Flash Mode"
	default SOC_FLASH_RTL8752H_1BIT_MODE
	help
	  Selects the flash bit mode to use. The available options are
	  limited by the hardware's supported modes defined in the
	  device tree.

config SOC_FLASH_RTL8752H_1BIT_MODE
	bool "Flash 1-bit mode"
	help
		Set Realtek RTL8752H Flash to 1-bit mode (default).
		This is the standard SPI mode using CLK, CS#, DI, and DO pins.

config SOC_FLASH_RTL8752H_2BIT_MODE
	bool "Flash 2-bit mode (Dual)"
	depends on $(dt_nodelabel_bool_prop,flash,supports-2bit)
	help
		Set Realtek RTL8752H Flash to 2-bit (Dual) mode.
		Uses DI and DO as IO0 and IO1 respectively.

config SOC_FLASH_RTL8752H_4BIT_MODE
	bool "Flash 4-bit mode (Quad)"
	depends on $(dt_nodelabel_bool_prop,flash,supports-4bit)
	help
		Set Realtek RTL8752H Flash to 4-bit (Quad) mode.
		Uses all six pins (DI, DO, WP#, HOLD#) as IO0-IO3.
		Note: The flash used by RTL8752H only partially supports quad-read
		mode. Users should verify the flash model and characteristics in advance.

config SOC_FLASH_RTL8752H_DTR_4BIT_MODE
	bool "Flash 4-bit DTR mode (Quad)"
	depends on $(dt_nodelabel_bool_prop,flash,supports-dtr-4bit)
	help
		Set Realtek RTL8752H Flash to 4-bit DTR (Double Transfer Rate) mode.
		This provides higher performance but requires flash hardware support.

endchoice

config SOC_FLASH_RTL8752H_BIT_MODE
	int
	default 0 if SOC_FLASH_RTL8752H_1BIT_MODE
	default 1 if SOC_FLASH_RTL8752H_2BIT_MODE
	default 2 if SOC_FLASH_RTL8752H_4BIT_MODE
	default 3 if SOC_FLASH_RTL8752H_DTR_4BIT_MODE

endif # SOC_FLASH_RTL8752H
```

## drivers/flash/Kconfig.rtl87x2g
```kconfig
# Copyright(c) 2026, Realtek Semiconductor Corporation.
# SPDX-License-Identifier: Apache-2.0

config SOC_FLASH_RTL87X2G
	bool "Realtek RTL87x2G flash driver"
	default y
	depends on DT_HAS_REALTEK_RTL87X2G_FLASH_CONTROLLER_ENABLED
	select FLASH_HAS_DRIVER_ENABLED
	select FLASH_HAS_PAGE_LAYOUT
	select FLASH_HAS_EXPLICIT_ERASE
	help
	  Enable rtl87x2g flash driver.
```

## drivers/flash/Kconfig.rts5817
```kconfig
# Copyright (c) 2026 Realtek Semiconductor, Inc.
# SPDX-License-Identifier: Apache-2.0

config FLASH_RTS5817_QSPI
	bool "RTS5817 flash driver"
	depends on DT_HAS_REALTEK_RTS5817_QSPI_ENABLED
	default y
	select FLASH_HAS_PAGE_LAYOUT
	select FLASH_HAS_EXPLICIT_ERASE
	select FLASH_HAS_EX_OP
	help
	  Enable RTS5817 Flash driver.

if FLASH_RTS5817_QSPI

config FLASH_RTS5817_WRITE_PROTECTION_AUTO
	bool "Flash write protection auto control"
	depends on !FLASH_EX_OP_ENABLED
	default y
	help
	  Configure whether to control flash write protection automatically.
	  Default is y, so write protection is disabled automatically before
	  writing or erasing, and enabled after operation. If n is selected,
	  write protection is manipulated by extra operation, which means
	  FLASH_EX_OP_ENABLED needs to set y.

config FLASH_RTS5817_WP_CTRL
	bool "Flash WP# pin control"
	depends on $(dt_node_int_prop_int,/soc/quadspi@40000000,bus-width) < 4
	depends on FLASH_EX_OP_ENABLED
	help
	  Configure whether to control the WP# pin of the SPI NOR flash. It depends
	  on FLASH_EX_OP_ENABLED.

endif
```

## drivers/flash/Kconfig.rts5912
```kconfig
# SPDX-License-Identifier: Apache-2.0
#
# Copyright (c) 2025 Realtek Semiconductor Corporation, SIBG-SD7
#

config SOC_FLASH_RTS5912
	bool "Realtek RTS5912 flash driver"
	default y
	depends on DT_HAS_REALTEK_RTS5912_FLASH_CONTROLLER_ENABLED
	select FLASH_HAS_PAGE_LAYOUT
	select FLASH_HAS_DRIVER_ENABLED
	select FLASH_HAS_EXPLICIT_ERASE
	select FLASH_HAS_EX_OP
	select HAS_FLASH_LOAD_OFFSET
	help
	  The flash driver includes support for read, write and
	  erase flash operations. It also supports protection.
	  The rts5912 flash size is 960K byte.
```

## drivers/flash/Kconfig.rv32m1
```kconfig
# Copyright (c) 2019 NXP
# SPDX-License-Identifier: Apache-2.0

config SOC_FLASH_RV32M1
	bool "RV32M1 flash shim driver"
	default y
	depends on DT_HAS_OPENISA_RV32M1_FTFE_ENABLED
	select FLASH_HAS_PAGE_LAYOUT
	select FLASH_HAS_DRIVER_ENABLED
	select FLASH_HAS_EXPLICIT_ERASE
	help
	  Enables the RV32M1 flash shim driver.
	  WARNING: This driver will disable the system interrupts for
	  the duration of the flash erase/write operations. This will
	  have an impact on the overall system performance - whether
	  this is acceptable or not will depend on the use case.
```

## drivers/flash/Kconfig.s3axx04
```kconfig
# Copyright (c) 2025-2026 MASSDRIVER EI (massdriver.space)
# SPDX-License-Identifier: Apache-2.0

config FLASH_S3AXX04
	bool "Netsol S3Axx04 MRAM"
	default y
	depends on DT_HAS_NETSOL_S3AXX04_ENABLED
	select SPI
	select FLASH_HAS_PAGE_LAYOUT
	select FLASH_HAS_DRIVER_ENABLED
	select FLASH_HAS_NO_EXPLICIT_ERASE
	help
	  Enable Flash API-based driver for Netsol S3Axx04 SPI MRAM
```

## drivers/flash/Kconfig.sam
```kconfig
# Atmel SAM flash driver config

# Copyright (c) 2018 Aurelien Jarno
# SPDX-License-Identifier: Apache-2.0

config SOC_FLASH_SAM
	bool "Atmel SAM flash driver"
	default y
	depends on DT_HAS_ATMEL_SAM_FLASH_CONTROLLER_ENABLED
	select FLASH_HAS_PAGE_LAYOUT
	select FLASH_HAS_DRIVER_ENABLED
	select MPU_ALLOW_FLASH_WRITE if ARM_MPU
	help
	  Enable the Atmel SAM series internal flash driver.
```

## drivers/flash/Kconfig.sam0
```kconfig
# Atmel SAM0 flash driver config

# Copyright (c) 2018 Google LLC.
# SPDX-License-Identifier: Apache-2.0

menuconfig SOC_FLASH_SAM0
	bool "Atmel SAM0 flash driver"
	default y
	depends on DT_HAS_ATMEL_SAM0_NVMCTRL_ENABLED
	select FLASH_HAS_PAGE_LAYOUT
	select FLASH_HAS_DRIVER_ENABLED
	select MPU_ALLOW_FLASH_WRITE if ARM_MPU
	help
	  Enable the Atmel SAM0 series internal flash driver.

config SOC_FLASH_SAM0_EMULATE_BYTE_PAGES
	bool "Emulate byte-sized pages"
	depends on SOC_FLASH_SAM0
	default y if SOC_SERIES_SAMC20 || \
		     SOC_SERIES_SAMC21
	help
	  Emulate a device with byte-sized pages by doing a
	  read/modify/erase/write.
```

## drivers/flash/Kconfig.sam_qspi
```kconfig
# Atmel SAM flash driver config

# Copyright (c) 2026 Eve Redero
# SPDX-License-Identifier: Apache-2.0

config FLASH_SAM_QSPI
	bool "Atmel SAM QSPI flash driver"
	default y
	depends on DT_HAS_ATMEL_SAM_FLASH_QSPI_ENABLED
	select FLASH_HAS_PAGE_LAYOUT
	select FLASH_HAS_DRIVER_ENABLED
	select FLASH_HAS_EXPLICIT_ERASE
	select MPU_ALLOW_FLASH_WRITE if ARM_MPU
	help
	  Enable the Atmel SAM series QSPI flash driver.
```

## drivers/flash/Kconfig.semihost
```kconfig
# SPDX-License-Identifier: Apache-2.0
# Copyright (c) 2026 Analog Devices, Inc.

config FLASH_SEMIHOST
	bool "Semihost file-backed flash driver"
	default y
	depends on DT_HAS_ZEPHYR_SEMIHOST_FLASH_ENABLED
	depends on SEMIHOST
	select FLASH_HAS_DRIVER_ENABLED
	select FLASH_HAS_PAGE_LAYOUT
	select FLASH_HAS_EXPLICIT_ERASE
	help
	  Enable a flash driver backed by a file on the semihosting host.
	  Suitable for QEMU targets. Flash data persists in the host file
	  between runs.
```

## drivers/flash/Kconfig.sf32lb_mpi_qspi_nor
```kconfig
# Copyright 2025 Core Devices LLC
# SPDX-License-Identifier: Apache-2.0

config FLASH_SF32LB_MPI_QSPI_NOR
	bool "SiFli SF32LB MPI QSPI NOR driver"
	default y
	depends on DT_HAS_SIFLI_SF32LB_MPI_QSPI_NOR_ENABLED
	select FLASH_HAS_PAGE_LAYOUT
	select FLASH_HAS_DRIVER_ENABLED
	select FLASH_HAS_EXPLICIT_ERASE
	select FLASH_JESD216
	select DMA
	help
	  Enable the flash driver for a NOR serial flash memory device connected
	  to the SiFli SF32LB MPI peripheral.
```

## drivers/flash/Kconfig.si32
```kconfig
# Copyright (c) 2024 GARDENA GmbH
#
# SPDX-License-Identifier: Apache-2.0

config SOC_FLASH_SI32
	bool "Si32 flash driver"
	default y
	depends on DT_HAS_SILABS_SI32_FLASH_CONTROLLER_ENABLED
	select FLASH_HAS_DRIVER_ENABLED
	select FLASH_HAS_EXPLICIT_ERASE
	select FLASH_HAS_PAGE_LAYOUT
	help
	  Enable Si32 flash driver
```

## drivers/flash/Kconfig.silabs
```kconfig
# Copyright (c) 2025 Silicon Laboratories Inc.
# SPDX-License-Identifier: Apache-2.0

config SOC_FLASH_SILABS_S2
	bool "Silicon Labs Series 2 flash driver"
	default y
	depends on DT_HAS_SILABS_SERIES2_FLASH_CONTROLLER_ENABLED
	select FLASH_HAS_DRIVER_ENABLED
	select FLASH_HAS_PAGE_LAYOUT
	select SOC_GECKO_MSC
	select FLASH_HAS_EXPLICIT_ERASE
	select MPU_ALLOW_FLASH_WRITE if ARM_MPU
	help
	  Enable Silicon Labs Series 2 internal flash driver.

if SOC_FLASH_SILABS_S2

config SOC_FLASH_SILABS_S2_DMA_WRITE
	bool "Use DMA for flash write operations"
	depends on DMA
	default y if $(dt_compat_any_has_prop,$(DT_COMPAT_SILABS_SERIES2_FLASH_CONTROLLER),dmas)

config SOC_FLASH_SILABS_S2_DMA_READ
	bool "Use DMA for flash read operations"
	depends on DMA

endif
```

## drivers/flash/Kconfig.simulator
```kconfig
# Flash simulator config

# Copyright (c) 2018 Nordic Semiconductor ASA
# SPDX-License-Identifier: Apache-2.0

menuconfig FLASH_SIMULATOR
	bool "Flash simulator"
	default y
	depends on DT_HAS_ZEPHYR_SIM_FLASH_ENABLED
	select FLASH_HAS_PAGE_LAYOUT
	select FLASH_HAS_DRIVER_ENABLED
	help
	  Enable the flash simulator.

if FLASH_SIMULATOR

config FLASH_SIMULATOR_UNALIGNED_READ
	bool "Allow read access to be unaligned"
	default y
	help
	 If selected, the reading operation does not check if access is aligned.
	 Disable this option only if you want to simulate
	 a specific FLASH interface that requires aligned read access.

config FLASH_SIMULATOR_EXPLICIT_ERASE
	bool "Program-erase device"
	select FLASH_HAS_EXPLICIT_ERASE
	default y
	help
	  Explicit erase (non-erase-on-write) Flash, which is device that requires erase
	  to erase-value prior to write as it only allows to change bits from erase-value
	  to the opposite.

config FLASH_SIMULATOR_RAMLIKE
	bool
	default y if !FLASH_SIMULATOR_EXPLICIT_ERASE
	select FLASH_HAS_NO_EXPLICIT_ERASE
	select FLASH_SIMULATOR_DOUBLE_WRITES
	help
	  This is used for setting FLASH_HAS_NO_EXPLICIT_ERASE.

config FLASH_SIMULATOR_DOUBLE_WRITES
	bool "Allow program units to be programmed more than once"
	help
	 If selected, writing to a non-erased program unit will succeed, otherwise, it will return an error.
	 Keep in mind that write operations can only change value of a bit from erase-value to the
	 opposite.
	 This option does not impact FLASH_SIMULATOR_RAMLIKE.
	 In case when FLASH_SIMULATOR_EXPLICIT_ERASE is selected multiple writes to the same bit
	 but only change from erase-value to opposite will be registered.

config FLASH_SIMULATOR_PROVISION
	bool "Initialize flash in QEMU from an image file to simulate provisioning."
	help
	  This option maps simulated flash to a memory file on QEMU targets. This
	  file can be a pre-built binary image so that flash will be pre-populated.

DT_COMPAT_Z_SIM_FLASH:=zephyr,sim-flash
DT_NODELABEL_ENABLED_WITH_Z_SIM_FLASH:=$(dt_nodelabel_enabled_with_compat,sim_flash_controller,$(DT_COMPAT_Z_SIM_FLASH))
DT_NODELABEL_SIM_FLASH_MEMORY_REGION:=$(dt_node_ph_prop_path,$(dt_nodelabel_path,sim_flash_controller),memory-region)

config FLASH_SIMULATOR_BASE_ADDRESS
	hex
	depends on $(DT_NODELABEL_ENABLED_WITH_Z_SIM_FLASH)
	default $(dt_node_reg_addr_hex,$(DT_NODELABEL_SIM_FLASH_MEMORY_REGION))

config FLASH_SIMULATOR_SIZE
	int
	depends on $(DT_NODELABEL_ENABLED_WITH_Z_SIM_FLASH)
	default $(dt_node_reg_size_int,$(DT_NODELABEL_SIM_FLASH_MEMORY_REGION))

config FLASH_SIMULATOR_SIMULATE_TIMING
	bool "Hardware timing simulation"

if FLASH_SIMULATOR_SIMULATE_TIMING

config FLASH_SIMULATOR_MIN_READ_TIME_US
	int "Minimum read time (µS)"
	default 2
	range 1 1000000

config FLASH_SIMULATOR_MIN_WRITE_TIME_US
	int "Minimum write time (µS)"
	default 100
	range 1 1000000

config FLASH_SIMULATOR_MIN_ERASE_TIME_US
	int "Minimum erase time (µS)"
	default 2000
	range 1 1000000

endif

config FLASH_SIMULATOR_STATS
	bool "flash operations statistic"
	default y
	select STATS
	select STATS_NAMES
	help
	  Gather statistic measurement for flash simulator operations using the
	  statistic subsystem.

config FLASH_SIMULATOR_STAT_PAGE_COUNT
	int "Pages under statistic"
	depends on FLASH_SIMULATOR_STATS
	range 1 256
	default 256
	help
	  Only up to this number of beginning pages will be tracked
	  while catching dedicated flash operations and thresholds.
	  This number is not automatic because implementation uses
	  UNTIL_REPEAT() macro, which is limited to take explicitly
	  number of iterations.
	  This is why it's not possible to calculate the number of pages with
	  preprocessor using DT properties.

endif # FLASH_SIMULATOR
```

## drivers/flash/Kconfig.siwx91x
```kconfig
# Copyright (c) 2024 Silicon Laboratories Inc.
# SPDX-License-Identifier: Apache-2.0

config SOC_FLASH_SILABS_SIWX91X
	bool "Silicon Labs SiWx91x flash driver"
	default y
	depends on DT_HAS_SILABS_SIWX91X_FLASH_CONTROLLER_ENABLED
	select FLASH_HAS_DRIVER_ENABLED
	select FLASH_HAS_EXPLICIT_ERASE
	select FLASH_HAS_PAGE_LAYOUT
	# Flash controller is handled by the network coprocessor
	select WISECONNECT_NETWORK_STACK
	help
	  Enable flash controller for flash embedded on Silicon Labs SiWx91x
	  chips.
```

## drivers/flash/Kconfig.smartbond
```kconfig
# Copyright (c) 2022 Renesas Electronics Corporation
# SPDX-License-Identifier: Apache-2.0

config SOC_FLASH_SMARTBOND
	bool "Renesas SmartBond(tm) flash driver"
	default y
	depends on DT_HAS_RENESAS_SMARTBOND_FLASH_CONTROLLER_ENABLED
	select FLASH_HAS_PAGE_LAYOUT
	select FLASH_HAS_DRIVER_ENABLED
	select MPU_ALLOW_FLASH_WRITE if ARM_MPU
	help
	  Enable flash driver for Renesas SmartBond(tm) MCU family.
```
