## drivers/flash/Kconfig.mchp
```kconfig
# Copyright (c) 2025 Microchip Technology Inc.
# SPDX-License-Identifier: Apache-2.0

config FLASH_MCHP_NVMCTRL_G1
	bool "Microchip G1 Flash Driver for NVMCTRL"
	default y
	depends on DT_HAS_MICROCHIP_NVMCTRL_G1_FLASH_ENABLED
	select FLASH_HAS_PAGE_LAYOUT
	select FLASH_HAS_EX_OP
	select FLASH_EX_OP_ENABLED
	select FLASH_HAS_DRIVER_ENABLED
	select FLASH_HAS_EXPLICIT_ERASE
	select MPU_ALLOW_FLASH_WRITE if ARM_MPU
	help
	  Enable Flash driver for Microchip Non Volatile Memory Controller.

config FLASH_HAS_UNALIGNED_WRITE
	bool "Provide unaligned write support"
	depends on FLASH_MCHP_NVMCTRL_G1
	help
	  Enable this option to allow the Zephyr flash API to write data to flash
	  memory at offsets that are not aligned to the device's write block size
	  When enabled, the driver will handle unaligned writes internally, typically
	  using read-modify-write operations to ensure data integrity. This allows
	  applications to write data starting at any offset within the flash memory
	  space, not just at aligned addresses.
```

## drivers/flash/Kconfig.mcux
```kconfig
# SPDX-License-Identifier: Apache-2.0

config SOC_FLASH_MCUX
	bool "MCUX flash shim driver"
	default y
	depends on DT_HAS_NXP_KINETIS_FTFA_ENABLED || \
		   DT_HAS_NXP_KINETIS_FTFE_ENABLED || \
		   DT_HAS_NXP_KINETIS_FTFL_ENABLED || \
		   DT_HAS_NXP_IAP_FMC55_ENABLED || \
		   DT_HAS_NXP_IAP_FMC553_ENABLED || \
		   DT_HAS_NXP_MSF1_ENABLED
	select FLASH_HAS_PAGE_LAYOUT
	select FLASH_HAS_DRIVER_ENABLED
	select FLASH_HAS_EXPLICIT_ERASE
	select MPU_ALLOW_FLASH_WRITE if ARM_MPU
	help
	  Enables the MCUX flash shim driver.
	  WARNING: This driver will disable the system interrupts for
	  the duration of the flash erase/write operations. This will
	  have an impact on the overall system performance - whether
	  this is acceptable or not will depend on the use case.

if SOC_FLASH_MCUX

config CHECK_BEFORE_READING
	bool "Verify area before reading it"
	default y if SOC_SERIES_LPC55XXX
	help
	  Do a margin check flash command before reading an area.
	  This feature prevents erroneous/forbidden reading. Some ECC enabled
	  devices will crash when reading an erased or wrongly programmed area.

config MCUX_FLASH_K4_API
	bool
	help
	  Set from SOC level configuration if the platform is meant to use the
	  flash_k4 SDK IAP API.

endif # SOC_FLASH_MCUX

if DT_HAS_NXP_IMX_FLEXSPI_ENABLED

menu "Flexspi flash driver"

config FLASH_MCUX_FLEXSPI_NOR
	bool "MCUX FlexSPI NOR driver"
	default y
	depends on DT_HAS_NXP_IMX_FLEXSPI_NOR_ENABLED
	select FLASH_HAS_PAGE_LAYOUT
	select FLASH_HAS_DRIVER_ENABLED
	select FLASH_HAS_EXPLICIT_ERASE
	select FLASH_JESD216
	select MEMC
	select MEMC_MCUX_FLEXSPI

config FLASH_MCUX_FLEXSPI_MX25UM51345G
	bool "MCUX FlexSPI MX25UM51345G driver"
	default y
	depends on DT_HAS_NXP_IMX_FLEXSPI_MX25UM51345G_ENABLED
	select FLASH_HAS_PAGE_LAYOUT
	select FLASH_HAS_DRIVER_ENABLED
	select FLASH_HAS_EXPLICIT_ERASE
	select MEMC
	select MEMC_MCUX_FLEXSPI

config FLASH_MCUX_FLEXSPI_HYPERFLASH
	bool "MCUX FlexSPI HYPERFLASH driver"
	default y
	depends on DT_HAS_NXP_IMX_FLEXSPI_HYPERFLASH_ENABLED
	select FLASH_HAS_PAGE_LAYOUT
	select FLASH_HAS_DRIVER_ENABLED
	select FLASH_HAS_EXPLICIT_ERASE
	select MEMC
	select MEMC_MCUX_FLEXSPI

endmenu

if FLASH_MCUX_FLEXSPI_MX25UM51345G

choice FLASH_MCUX_FLEXSPI_MX25UM51345G_OPI_MODE
	prompt "FlexSPI MX25UM51345G OPI mode"
	default FLASH_MCUX_FLEXSPI_MX25UM51345G_OPI_DTR
	help
	  Select the MX25UM51345G octal flash operation mode(Octal I/O STR
	  or Octal I/O DTR).

config FLASH_MCUX_FLEXSPI_MX25UM51345G_OPI_STR
	bool "STR"

config FLASH_MCUX_FLEXSPI_MX25UM51345G_OPI_DTR
	bool "DTR"

endchoice

endif # FLASH_MCUX_FLEXSPI_MX25UM51345G

config FLASH_MCUX_FLEXSPI_NOR_WRITE_BUFFER
	bool "MCUX FlexSPI NOR write RAM buffer"
	default y
	depends on (FLASH_MCUX_FLEXSPI_NOR || FLASH_MCUX_FLEXSPI_MX25UM51345G)
	help
	  Copy the data to a RAM buffer before writing it to the flash.
	  This prevents faults when the data to write would be located on the
	  flash itself.

config FLASH_MCUX_FLEXSPI_HYPERFLASH_WRITE_BUFFER
	bool "MCUX FlexSPI HYPERFLASH write RAM buffer"
	default y
	depends on FLASH_MCUX_FLEXSPI_HYPERFLASH
	help
	  Copy the data to a RAM buffer before writing it to the flash.
	  This prevents faults when the data to write would be located on the
	  flash itself.

# Avoid RWW hazards by defaulting logging to disabled
choice FLASH_LOG_LEVEL_CHOICE
	default FLASH_LOG_LEVEL_OFF if FLASH_MCUX_FLEXSPI_XIP
endchoice

endif # DT_HAS_NXP_IMX_FLEXSPI_ENABLED

config FLASH_MCUX_XSPI
	bool "MCUX XSPI flash driver"
	default y
	depends on DT_HAS_NXP_XSPI_NOR_ENABLED
	select MEMC
	select MEMC_MCUX_XSPI
	select FLASH_HAS_DRIVER_ENABLED
	select FLASH_HAS_PAGE_LAYOUT
	select FLASH_HAS_EXPLICIT_ERASE
	help
	  Enable the mcux xspi flash driver.

# MCUX C40 internal flash driver
config SOC_FLASH_MCUX_C40
	bool "MCUX C40 flash driver"
	default y
	depends on DT_HAS_NXP_C40_FLASH_CONTROLLER_ENABLED
	depends on DT_HAS_NXP_C40_FLASH_ENABLED
	select FLASH_HAS_DRIVER_ENABLED
	select FLASH_HAS_EXPLICIT_ERASE
	select FLASH_HAS_PAGE_LAYOUT
	# C40 uses controller commands, not CPU stores to flash
	# so we are not relaxing MPU for ROM writes.
	# Relocate driver/HAL when XIP so erase/program run from SRAM:
	imply CODE_DATA_RELOCATION if XIP
	imply CODE_DATA_RELOCATION_SRAM if XIP
	help
	  Enable the NXP MCUX C40 internal flash driver
	  Provides Zephyr flash driver using MCUX C40 HAL.

config SOC_FLASH_MCUX_C40_APPLY_PROTECTION
	bool "Apply default protection windows (IVT/MCUboot) at init"
	depends on SOC_FLASH_MCUX_C40
	default y if XIP
	help
	  When enabled, the driver locks/unlocks protection for well-known
	  regions derived from devicetree (e.g. ivt_header, ivt_pad, mcuboot)
	  during driver init. Useful on XIP systems to keep IVT/bootloader
	  areas read-only. Disable if your bootloader/policy manages this.
```

## drivers/flash/Kconfig.mimxrt
```kconfig
config SOC_FLASH_IMXRT
	bool "Flash Driver for NXP iMXRT familly"
	depends on SOC_SERIES_IMX_RT
	select FLASH_HAS_PAGE_LAYOUT
	select FLASH_HAS_DRIVER_ENABLED
	select CODE_DATA_RELOCATION
	help
		Driver for external flash over FlexSPI interface. Work for Hyperflash memory.
		This will enable CODE_DATA_RELOCATION, as RAM run is required while writing the
		external flash.
		QSPI will be implemented in future release.


if SOC_FLASH_IMXRT

choice FLASH_IMXRT_FLASH_TYPE
	prompt "Attached memory type"
	default FLASH_IMXRT_HYPERFLASH_S26KL

config FLASH_IMXRT_HYPERFLASH_S26KL
	bool "Cypress S26KLxxx HyperFlash family"

	help
		Support Cypress Hyperflash S26KLxxx family attached to FlexSPI

config FLASH_IMXRT_QSPI_IS25WP
	bool "IS25WP QSPI NOR flash"

	help
		Support QSPI NOR flash IS25WP family attached to FlexSPI

endchoice

config FLASH_IMXRT_MEMCPY_READ
	bool "Use memcpy() for read instead of FlexSPI IP bus commands"
	default n
	help
		This option enable to use memcpy() to read data from flash as the
		external flash memory is memory mapped on iMXRT microcontroller.
		This option enable to take advantage of the data cache, but it might
		not be what you want. If disabled, the driver will read the data over the
		FlexSPI's IP bus interface.

endif #SOC_FLASH_IMXRT
```

## drivers/flash/Kconfig.mspi
```kconfig
# Copyright (c) 2025 Ambiq Micro Inc. <www.ambiq.com>
# SPDX-License-Identifier: Apache-2.0

menu "MSPI flash device driver"

config FLASH_MSPI
	bool
	select FLASH_HAS_DRIVER_ENABLED
	select MSPI
	help
	  MSPI flash drivers are enabled.

config FLASH_MSPI_EMUL_DEVICE
	bool "MSPI flash device emulator"
	default y
	depends on DT_HAS_ZEPHYR_MSPI_EMUL_FLASH_ENABLED
	select FLASH_MSPI
	select FLASH_HAS_PAGE_LAYOUT
	select FLASH_HAS_EXPLICIT_ERASE

config FLASH_MSPI_ATXP032
	bool "MSPI ATXP032 driver"
	default y
	depends on DT_HAS_MSPI_ATXP032_ENABLED
	select FLASH_MSPI
	select FLASH_HAS_PAGE_LAYOUT
	select FLASH_HAS_EXPLICIT_ERASE
	select FLASH_JESD216
	select MSPI_AMBIQ_CONTROLLER if SOC_FAMILY_AMBIQ

config FLASH_MSPI_IS25XX0XX
	bool "MSPI IS25L/WX064/032 driver"
	default y
	depends on DT_HAS_MSPI_IS25XX0XX_ENABLED
	select FLASH_MSPI
	select FLASH_HAS_PAGE_LAYOUT
	select FLASH_HAS_EXPLICIT_ERASE
	select FLASH_JESD216
	select MSPI_AMBIQ_CONTROLLER if SOC_FAMILY_AMBIQ

menuconfig FLASH_MSPI_NOR
	bool "Generic MSPI NOR Flash"
	default y
	depends on DT_HAS_JEDEC_MSPI_NOR_ENABLED
	select FLASH_MSPI
	select FLASH_HAS_EXPLICIT_ERASE
	select FLASH_JESD216
	select GPIO if $(dt_compat_any_has_prop,$(DT_COMPAT_JEDEC_MSPI_NOR),reset-gpios) \
		    || $(dt_compat_any_has_prop,$(DT_COMPAT_JEDEC_MSPI_NOR),supply-gpios)

if FLASH_MSPI_NOR

config FLASH_MSPI_NOR_USE_SFDP
	bool "Use Serial Flash Discoverable Parameters (SFDP)"
	default $(dt_compat_any_has_prop,$(DT_COMPAT_JEDEC_MSPI_NOR),sfdp-bfp)
	help
	  Use information from SFDP for setting up flash command transfers
	  and for configuring the flash chip.

	  Currently, only build time processing of SFDP structures is supported,
	  based on dts arrays provided as flash node properties like `sfdp-bfp`,
	  `sfdp-ff05`, and `sfdp-ff84`. Depending on the IO mode used, some or
	  all of these properties are required for building the flash driver.
	  Data for these properties can be obtained with the `drivers/jesd216`
	  sample. If a given SFDP table is not available in a flash chip,
	  the related property can be defined as an empty array - this will
	  prevent a related build assertion from failing and default values
	  will be assigned to parameters that would otherwise be read from
	  that SFDP table.

config FLASH_MSPI_NOR_LAYOUT_PAGE_SIZE
	int "Page size to use for FLASH_LAYOUT feature"
	depends on FLASH_PAGE_LAYOUT
	default 65536
	help
	  When CONFIG_FLASH_PAGE_LAYOUT is used, this driver will support that
	  API. By default the page size corresponds to the block size (65536).
	  Other options include the 32K-byte erase size (32768), the sector
	  size (4096), or any non-zero multiple of the sector size.

endif # FLASH_MSPI_NOR

endmenu

if FLASH_MSPI

config FLASH_MSPI_HANDLE_CACHE
	bool "Turn on cache handling in flash peripheral drivers"
	default y
	depends on CACHE_MANAGEMENT && DCACHE
	help
	  Disable this if cache has been handled in upper layers.

config FLASH_MSPI_RANGE_HANDLE_CACHE_SIZE
	int "Threshold to do cache handling by range or in full, size in bytes"
	default SOC_AMBIQ_DCACHE_SIZE if SOC_SERIES_APOLLO5X
	default 0
	help
	  If size is larger than this number, it is uneconomical to handle cache in range.
	  However, this is a number by experience and could be platform specific.

config FLASH_MSPI_XIP_READ
	bool "Turn on XIP read in flash_read"
	depends on MSPI_XIP
	help
	  Enable this for those controllers that supports XIP and wishes to
	  flash_read using XIP.

endif # FLASH_MSPI
```

## drivers/flash/Kconfig.mspm0
```kconfig
# SPDX-License-Identifier: Apache-2.0
# Copyright (c) 2024 Texas Instruments

config SOC_FLASH_MSPM0
	bool "MSPM0 Flash driver"
	default y
	depends on DT_HAS_TI_MSPM0_FLASH_CONTROLLER_ENABLED
	select FLASH_HAS_DRIVER_ENABLED
	select FLASH_HAS_PAGE_LAYOUT
	help
	  This option enables the TI MSPM0 Flash controller driver.

config FLASH_MSPM0_LAYOUT_PAGE_SIZE
	int "Page size to use for FLASH_LAYOUT feature"
	default 1024
	help
		When CONFIG_FLASH_PAGE_LAYOUT is used this driver will support that API.
		By default the page size corresponds to the sector size (1024) for MSPM0
		flash memory. Other options may include the XK-byte erase size (X),
		the block size (Y), or any non-zero multiple of the sector size.
```

## drivers/flash/Kconfig.mt29f4g08
```kconfig
# MT29F4G08 NAND flash driver configuration options

# Copyright (c) 2025 Endress+Hauser GmbH+Co. KG
# SPDX-License-Identifier: Apache-2.0

menuconfig FLASH_STM32_FMC_MT29F4G08
	bool "MT29F4G08 NAND flash driver via STM32 FMC"
	default y
	depends on DT_HAS_MICRON_MT29F4G08_ENABLED
	depends on FLASH_STM32_FMC_NAND
	select FLASH_HAS_DRIVER_ENABLED
	select FLASH_HAS_EX_OP
	select FLASH_HAS_EXPLICIT_ERASE
	select FLASH_HAS_PAGE_LAYOUT
	help
	  Enable flash memory specific support for Micron MT29F4G08 via STM32 flexible memory
	  controller.

if FLASH_STM32_FMC_MT29F4G08

config FLASH_MT29F4G08_ECC
	bool "MT29F4G08 On-Die ECC"
	default y
	help
	  Enable on-die ECC feature of Micron MT29F4G08.

endif # FLASH_STM32_FMC_MT29F4G08
```

## drivers/flash/Kconfig.mx25r6435f
```kconfig
#
# Copyright (c) 2018 Sigma Connectivity.
#
# SPDX-License-Identifier: Apache-2.0
#


menuconfig SPI_FLASH_MX25R6435F
	bool "SPI NOR Flash MXSMIO MX25R6435F"
	select FLASH_HAS_DRIVER_ENABLED
	depends on SPI

if SPI_FLASH_MX25R6435F

config SPI_FLASH_MX25R6435F_SPI_NAME
	string "SPI controller device name"
	default "SPI_2"

config SPI_FLASH_MX25R6435F_DRV_NAME
	string "SPI flash device name"
	default "spi_flash"

config SPI_FLASH_MX25R6435F_INIT_PRIORITY
	int
	default 80
	help
	  Device driver initialization priority.
	  Device is connected to SPI bus, it has to
	  be initialized after SPI driver.

config SPI_FLASH_MX25R6435F_SPI_FREQ_0
	int "SPI system frequency"
	default 1000000
	help
	  This option sets the SPI controller's frequency. Beware this value
	  depends on the SPI controller being used and also on the system
	  clock.

config SPI_FLASH_MX25R6435F_SPI_SLAVE
	int "SPI slave linked to SPI flash"
	default 0
	help
	  This option sets the SPI slave number the SPI controller has to switch
	  to when dealing with MXSMIO SPI flash chip.

config SPI_FLASH_MX25R6435F_GPIO_SPI_CS
	bool "Manage SPI CS through a GPIO pin"
	help
	This option is useful if one needs to manage SPI CS through a GPIO
	pin to by-pass the SPI controller's CS logic.

config SPI_FLASH_MX25R6435F_GPIO_SPI_CS_DRV_NAME
	string "GPIO driver's name to use to drive SPI CS through"
	depends on SPI_FLASH_MX25R6435F_GPIO_SPI_CS
	default "flash_gpio"
	help
	This option is mandatory to set which GPIO controller to use in order
	to actually emulate the SPI CS.

config SPI_FLASH_MX25R6435F_GPIO_SPI_CS_PIN
	int "GPIO PIN to use to drive SPI CS through"
	default 17
	depends on SPI_FLASH_MX25R6435F_GPIO_SPI_CS
	help
	This option is mandatory to set which GPIO pin to use in order
	to actually emulate the SPI CS.

config SPI_FLASH_MX25R6435F_GPIO_CS_WAIT_DELAY
	int "Delay time in us"
	default 1
	depends on SPI_FLASH_MX25R6435F_GPIO_SPI_CS
	help
	This is the wait delay (in us) to allow for CS switching to take effect

config SPI_FLASH_MX25R6435F_FLASH_SIZE
	int "Flash size in bytes"
	default 67108864
	help
	This is the flash capacity in bytes.

config SPI_FLASH_MX25R6435F_DEVICE_ID
	hex "Device ID in hex"
	default 0x00c22817
	help
	This is the device ID of the flash chip to use, which is 0x00c22817 for
	the MX25R6435F

endif # SPI_FLASH_MX25R6435F
```
