## drivers/flash/Kconfig.cadence_qspi_nor
```kconfig
# Copyright (c) 2022 - 2023 Intel Corporation.
# SPDX-License-Identifier: Apache-2.0

# Macro to find node in device tree
DT_CHOSEN_CAD_QSPI_NODE := qspi

config FLASH_CAD_QSPI_NOR
	bool "Cadence Quad SPI Flash driver"
	default y
	depends on DT_HAS_CDNS_QSPI_NOR_ENABLED
	select FLASH_HAS_PAGE_LAYOUT
	select FLASH_HAS_DRIVER_ENABLED
	help
	  Enable Cadence QSPI-NOR support.

if FLASH_CAD_QSPI_NOR

config CAD_QSPI_INTERRUPT_SUPPORT
	bool
	def_bool $(dt_node_has_prop,$(DT_CHOSEN_CAD_QSPI_NODE),interrupts)
	help
	  Enable Cadence QSPI Interrupt Support.

config CAD_QSPI_MICRON_N25Q_SUPPORT
	bool "Cadence Quad SPI Micron N25Q Support"
	default y
	help
	  Enable Micron N25Q Support.

config CAD_QSPI_NOR_SUBSECTOR_SIZE
	hex "Cadence Quad SPI subsector size"
	default 0x1000
	help
	  Set the Cadence Quad SPI subsector size.

config QSPI_ADDR_BYTES
	int "Access QSPI address memory size in bytes"
	default 2
	help
	  Set the address memory size in bytes when
	  accessing QSPI.

config QSPI_BYTES_PER_DEV
	int "Set QSPI to read / write how many bytes per device"
	default 256
	help
	  Set the size for a QSPI to read / write per device.

config QSPI_BYTES_PER_BLOCK
	int "Set QSPI to read / write how many bytes per block"
	default 16
	help
	  Set the size for a QSPI to read / write per block.

endif # FLASH_CAD_QSPI_NOR
```

## drivers/flash/Kconfig.cc13xx_cc26xx
```kconfig
# Copyright (c) 2022 Piotr Dymacz
# SPDX-License-Identifier: Apache-2.0

config SOC_FLASH_CC13XX_CC26XX
	bool "TI SimpleLink CC13xx/CC26xx flash controller driver"
	default y
	depends on DT_HAS_TI_CC13XX_CC26XX_FLASH_CONTROLLER_ENABLED
	select FLASH_HAS_PAGE_LAYOUT
	select FLASH_HAS_DRIVER_ENABLED
	select FLASH_HAS_EXPLICIT_ERASE
	select MPU_ALLOW_FLASH_WRITE if ARM_MPU
	help
	  Enables TI SimpleLink CC13xx/CC26xx flash controller driver.

config CC13XX_CC26XX_FLASH_TO_FLASH_SUPPORT
	bool "Support of flash to flash write operation"
	default n
	depends on SOC_FLASH_CC13XX_CC26XX
	help
	  Writing data in flash from a flash address is forbidden.
	  This enables a buffer to read data from the flash and then
	  write data to flash.
	  This may be required by settings subsystem to write a pair of key and value
	  if the key name is a const string located in the flash address space.
```

## drivers/flash/Kconfig.cc23x0
```kconfig
# Copyright (c) 2024 Texas Instruments Incorporated
# Copyright (c) 2024 BayLibre, SAS
#
# SPDX-License-Identifier: Apache-2.0

config SOC_FLASH_CC23X0
	bool "TI SimpleLink CC23x0 flash controller driver"
	default y
	depends on DT_HAS_TI_CC23X0_FLASH_CONTROLLER_ENABLED
	select FLASH_HAS_PAGE_LAYOUT
	select FLASH_HAS_DRIVER_ENABLED
	select MPU_ALLOW_FLASH_WRITE if ARM_MPU
	help
	  Enables TI SimpleLink CC23x0 flash controller driver.
```

## drivers/flash/Kconfig.disk_flash
```kconfig
# Disk flash emulator config

# Copyright (c) 2023 Endress+Hauser AG
# SPDX-License-Identifier: Apache-2.0

config DISK_FLASH_DRIVER
	bool "Use the flash on disk emulator"
	default y
	depends on DT_HAS_ZEPHYR_DISK_FLASH_ENABLED
	select FLASH_HAS_DRIVER_ENABLED
	help
	  This option enables the flash on disk emulator
	  which can be used to emulate a flash on a disk
	  device like sd-card or ramdisk.
```

## drivers/flash/Kconfig.eeprom
```kconfig
# Copyright (c) 2025 MASSDRIVER EI (massdriver.space)
# SPDX-License-Identifier: Apache-2.0

config FLASH_EEPROM
	bool "EEPROM to Flash driver"
	default y
	depends on DT_HAS_ZEPHYR_EEPROM_TO_FLASH_ENABLED
	select FLASH_HAS_PAGE_LAYOUT
	select FLASH_HAS_DRIVER_ENABLED
	select FLASH_HAS_NO_EXPLICIT_ERASE
	help
	  Enables the EEPROM to Flash driver.
```

## drivers/flash/Kconfig.emulator
```kconfig
# Kconfig - Flash driver emulator config
#
# SPDX-License-Identifier: Apache-2.0

if FLASH && FLASH_EMULATOR

config FLASH_EMULATOR_BASE_ADDR
	hex
	prompt "Base address of the flash"
	default 0x00
	depends on FLASH_EMULATOR
	help
	 The base address of the flash.

config FLASH_EMULATOR_ERASE_UNIT
	int
	prompt "Erase unit size in bytes"
	default 4096
	range 1 65536
	depends on FLASH_EMULATOR
	help
	 The smallest area of flash memory that can be indipendently erased.

config FLASH_EMULATOR_WRITE_UNIT
	int
	prompt "Program unit size in bytes"
	default 4
	range 1 4096
	depends on FLASH_EMULATOR
	help
	 The smallest area of flash memory that can be indipendently programmed.

config FLASH_EMULATOR_FLASH_SIZE
	int
	prompt "Flash size in erase units"
	default 4
	range 1 65536
	depends on FLASH_EMULATOR
	help
	 The size of the emulated flash area expressed in erase units.

config FLASH_EMULATOR_EMULATE_TIMING
	bool
	prompt "Enable flash timing emulation"
	default n

config FLASH_EMULATOR_MIN_READ_TIME_US
	int
	prompt "Minimum read time (µS)"
	depends on FLASH_EMULATOR && FLASH_EMULATOR_EMULATE_TIMING
	default 2
	range 1 3000000

config FLASH_EMULATOR_MIN_WRITE_TIME_US
	int
	prompt "Minimum write time (µS)"
	depends on FLASH_EMULATOR && FLASH_EMULATOR_EMULATE_TIMING
	default 100
	range 1 3000000

config FLASH_EMULATOR_MIN_ERASE_TIME_US
	int
	prompt "Minimum erase time (µS)"
	depends on FLASH_EMULATOR && FLASH_EMULATOR_EMULATE_TIMING
	default 2000
	range 1 3000000

config FLASH_EMULATOR_EMULATE_FAILURES
	bool
	prompt "Enable flash failure emulation"
	default n

config FLASH_EMULATOR_READ_API_FAILURE_RATE
	int
	prompt "Read API failure rate"
	default 0
	range 0 100
	depends on FLASH_EMULATOR && FLASH_EMULATOR_EMULATE_FAILURES
	help
	 This setting controls the read operation failure rate.
	 It can be useful for testing purposes.

config FLASH_EMULATOR_READ_HW_FAILURE_RATE
	int
	prompt "Hardware read failure rate"
	default 0
	range 0 100
	depends on FLASH_EMULATOR && FLASH_EMULATOR_EMULATE_FAILURES
	help
	 This setting controls the read operation failure rate.
	 It can be useful for testing purposes.

config FLASH_EMULATOR_WRITE_API_FAILURE_RATE
	int
	prompt "Write API failure rate"
	default 0
	range 0 100
	depends on FLASH_EMULATOR && FLASH_EMULATOR_EMULATE_FAILURES
	help
	 This setting controls the write operation failure rate.
	 It can be useful for testing purposes.

 config FLASH_EMULATOR_WRITE_HW_FAILURE_RATE
	int
	prompt "Hardware write failure rate"
	default 0
	range 0 100
	depends on FLASH_EMULATOR && FLASH_EMULATOR_EMULATE_FAILURES
	help
	 This setting controls the write operation failure rate.
	 It can be useful for testing purposes.

config FLASH_EMULATOR_ERASE_API_FAILURE_RATE
	int
	prompt "Erase API failure rate"
	default 0
	range 0 100
	depends on FLASH_EMULATOR && FLASH_EMULATOR_EMULATE_FAILURES
	help
	 This setting controls the erase operation failure rate.
	 It can be useful for testing purposes.

	config FLASH_EMULATOR_ERASE_HW_FAILURE_RATE
	int
	prompt "Hardware erase failure rate"
	default 0
	range 0 100
	depends on FLASH_EMULATOR && FLASH_EMULATOR_EMULATE_FAILURES
	help
	 This setting controls the erase operation failure rate.
	 It can be useful for testing purposes.

endif
```

## drivers/flash/Kconfig.ene
```kconfig
# Copyright (c) 2025-2026 ENE Technology Inc.
# SPDX-License-Identifier: Apache-2.0

config FLASH_ENE_KB106X
	bool "ENE_KB106X flash driver"
	default y
	depends on DT_HAS_ENE_KB106X_FLASH_CONTROLLER_ENABLED
	select FLASH_HAS_PAGE_LAYOUT
	select FLASH_HAS_DRIVER_ENABLED
	select FLASH_HAS_EXPLICIT_ERASE
	select FLASH_HAS_EX_OP
	help
	  Enable flash driver for ENE_KB106X series

config FLASH_ENE_EFLASH_PROTECT
	bool "Extended operation for eflash protection control"
	depends on FLASH_ENE_KB106X
	help
	  Enables flash extended operation for enabling flash
	  protection.
```

## drivers/flash/Kconfig.gd32
```kconfig
# Copyright (c) 2022 BrainCo Inc.
# SPDX-License-Identifier: Apache-2.0

config SOC_FLASH_GD32
	bool "GigaDevice GD32 flash driver"
	default y
	depends on (GD32_NV_FLASH_V1 || GD32_NV_FLASH_V2 || GD32_NV_FLASH_V3)
	select FLASH_HAS_DRIVER_ENABLED
	select FLASH_HAS_PAGE_LAYOUT
	select FLASH_HAS_EXPLICIT_ERASE
	select MPU_ALLOW_FLASH_WRITE if ARM_MPU
	help
	  Enable the GigaDevice GD32 flash driver.

config GD32_NV_FLASH_V1
	bool
	default y
	depends on DT_HAS_GD_GD32_NV_FLASH_V1_ENABLED
	help
	  Enable the generic backend for GD32 FMC v1 flash driver.

config GD32_NV_FLASH_V2
	bool
	default y
	depends on DT_HAS_GD_GD32_NV_FLASH_V2_ENABLED
	help
	  Enable the generic backend for GD32 FMC v2 flash driver.

config GD32_NV_FLASH_V3
	bool
	default y
	depends on DT_HAS_GD_GD32_NV_FLASH_V3_ENABLED
	help
	  Enable the generic backend for GD32 FMC v3 flash driver.
```

## drivers/flash/Kconfig.gecko
```kconfig
# Silicon Labs Gecko flash driver config

# Copyright (c) 2018, Piotr Mienkowski
# SPDX-License-Identifier: Apache-2.0

config SOC_FLASH_GECKO
	bool "Silicon Labs Gecko flash driver"
	default y
	depends on DT_HAS_SILABS_GECKO_FLASH_CONTROLLER_ENABLED
	select FLASH_HAS_DRIVER_ENABLED
	select FLASH_HAS_PAGE_LAYOUT
	select SOC_GECKO_MSC
	select MPU_ALLOW_FLASH_WRITE if ARM_MPU
	help
	  Enable Silicon Labs Gecko series internal flash driver.
```

## drivers/flash/Kconfig.ifx_cat1
```kconfig
# Infineon CAT1 Flash configuration options

# Copyright (c) 2023 Cypress Semiconductor Corporation (an Infineon company) or
# an affiliate of Cypress Semiconductor Corporation
#
# SPDX-License-Identifier: Apache-2.0

config FLASH_INFINEON_CAT1
	bool "Infineon CAT1 FLASH driver"
	default y
	depends on DT_HAS_INFINEON_CAT1_FLASH_CONTROLLER_ENABLED && DT_HAS_FIXED_PARTITIONS_ENABLED
	select FLASH_HAS_PAGE_LAYOUT
	select FLASH_HAS_DRIVER_ENABLED
	select USE_INFINEON_FLASH
	select FLASH_HAS_EXPLICIT_ERASE
	help
	  Enable the Flash driver for Infineon CAT1 family.

config INFINEON_CAT1_QSPI_FLASH
	bool "Infineon CAT1 QSPI FLASH driver"
	default y
	depends on DT_HAS_INFINEON_CAT1_QSPI_FLASH_ENABLED && DT_HAS_FIXED_PARTITIONS_ENABLED
	select FLASH_HAS_PAGE_LAYOUT
	select FLASH_HAS_DRIVER_ENABLED
	select USE_INFINEON_FLASH
	select USE_INFINEON_SMIF
	select PINCTRL
	select FLASH_HAS_EXPLICIT_ERASE
	help
	  Enable the QSPI Flash driver for Infineon CAT1 family.


config MPU_ALLOW_FLASH_WRITE
	bool "Add MPU access to write to flash"
	help
	  Enable this to allow MPU RWX access to flash memory.

if FLASH_MSPI_NOR
config FLASH_MSPI_INFINEON_S28HX512T
	bool "MSPI Infineon S28HX512T driver"
	default y
	depends on DT_HAS_INFINEON_S28HX512T_ENABLED
	select FLASH_HAS_PAGE_LAYOUT
	select FLASH_HAS_EXPLICIT_ERASE

if FLASH_MSPI_INFINEON_S28HX512T
config FLASH_MSPI_INFINEON_S28HX512T_EARLY_FIXUP_RESET
	bool "Perform initial software reset at 8D-8D-8D"
	default n
	help
	  Some bootloaders may put the flash in the highest possible configuration
	  before transferring control to Zephyr. One such case is the TI ROM
	  bootloader. This property replaces the original software reset sequence
	  such that 8D-8D-8D configuration is applied before doing the software
	  reset to go back to 1S-1S-1S.
endif #FLASH_MSPI_INFINEON_S28HX512T
endif #FLASH_MSPI_NOR
```

## drivers/flash/Kconfig.infineon_pdl
```kconfig
# Copyright (c) 2025 Infineon Technologies AG,
# or an affiliate of Infineon Technologies AG.
#
# SPDX-License-Identifier: Apache-2.0

config FLASH_INFINEON_PSOC4
	bool "Infineon PSoC4 FLASH driver"
	default y
	depends on DT_HAS_INFINEON_PSOC4_FLASH_ENABLED
	select FLASH_HAS_DRIVER_ENABLED
	select FLASH_HAS_PAGE_LAYOUT
	select FLASH_HAS_NO_EXPLICIT_ERASE
	select USE_INFINEON_FLASH
	help
	  Enable the Flash driver for Infineon PSoC4 family.
```

## drivers/flash/Kconfig.intel_pflash_cfi01
```kconfig
# Intel CFI01 flash driver config

# Copyright (c) 2026 Analog Devices, Inc
# SPDX-License-Identifier: Apache-2.0

config FLASH_INTEL_PFLASH_CFI01
	bool "Intel CFI01 parallel flash (QEMU pflash)"
	default y
	depends on DT_HAS_INTEL_PFLASH_CFI01_ENABLED
	select FLASH_HAS_DRIVER_ENABLED
	select FLASH_HAS_EXPLICIT_ERASE
	select FLASH_HAS_PAGE_LAYOUT
	help
	  Enable the Intel CFI01 flash driver for QEMU pflash device.
	  This driver supports memory-mapped Intel CFI01 parallel flash
	  devices with uniform sector sizes.
```

## drivers/flash/Kconfig.it51xxx_m1k
```kconfig
# Copyright (c) 2025 ITE Corporation. All Rights Reserved.
# SPDX-License-Identifier: Apache-2.0

config SOC_FLASH_ITE_IT51XXX_M1K
	bool "ITE IT51XXX manual flash 1k driver"
	default y
	depends on DT_HAS_ITE_IT51XXX_MANUAL_FLASH_1K_ENABLED
	select FLASH_HAS_PAGE_LAYOUT
	select FLASH_HAS_DRIVER_ENABLED
	select PINCTRL
	help
	  The flash M1K driver supports read (up to 1K), write (1K), and erase (4K)
	  operations. Accessible flash regions include internal e-Flash or external
	  SPI flash via FSCE# or FSCE1#
```

## drivers/flash/Kconfig.it8xxx2
```kconfig
# FLASH configuration options

# Copyright (c) 2021 ITE Corporation. All Rights Reserved.
# SPDX-License-Identifier: Apache-2.0

config SOC_FLASH_ITE_IT8XXX2
	bool "ITE IT8XXX2 flash driver"
	default y
	depends on DT_HAS_ITE_IT8XXX2_FLASH_CONTROLLER_ENABLED
	select SOC_IT51XXX_USE_ILM if SOC_SERIES_IT51XXX
	select SOC_IT8XXX2_USE_ILM if SOC_SERIES_IT8XXX2
	select FLASH_HAS_PAGE_LAYOUT
	select FLASH_HAS_DRIVER_ENABLED
	select FLASH_HAS_EXPLICIT_ERASE
	select HAS_FLASH_LOAD_OFFSET
	help
	  The flash driver includes support for read, write and
	  erase flash operations. It also supports protection.
	  The it8xxx2 flash size is 1M byte.
```

## drivers/flash/Kconfig.le25s20xa
```kconfig
# Copyright (c) 2026 Cirrus Logic, Inc.
# SPDX-License-Identifier: Apache-2.0

config SPI_FLASH_LE25S20XA
	bool "Onsemi LE25S20XA SPI Flash Memory"
	default y
	depends on DT_HAS_ONNN_LE25S20XA_ENABLED
	select FLASH_HAS_DRIVER_ENABLED
	select FLASH_HAS_PAGE_LAYOUT
	select FLASH_HAS_EXPLICIT_ERASE
	select SPI
	help
	  Enable support for LE25S20XA SPI flash chips.

if SPI_FLASH_LE25S20XA

config SPI_FLASH_LE25S20XA_WRITE_PROTECT
	def_bool $(dt_compat_any_has_prop,$(DT_COMPAT_ONNN_LE25S20XA),wp-gpios)

config SPI_FLASH_LE25S20XA_READ_ONLY
	def_bool $(dt_compat_all_has_prop,$(DT_COMPAT_ONNN_LE25S20XA),read-only,true)

endif #SPI_FLASH_LE25S20XA
```

## drivers/flash/Kconfig.lpc
```kconfig
# Copyright (c) 2020 NXP
# SPDX-License-Identifier: Apache-2.0

config SOC_FLASH_LPC
	bool "LPC flash shim driver"
	default y
	depends on DT_HAS_NXP_IAP_FMC11_ENABLED || \
		DT_HAS_NXP_IAP_FMC54_ENABLED
	select FLASH_HAS_PAGE_LAYOUT
	select FLASH_HAS_DRIVER_ENABLED
	select FLASH_HAS_EXPLICIT_ERASE
	help
	  Enables the LPC IAP flash shim driver.
	  WARNING: This driver will disable the system interrupts for
	  the duration of the flash erase/write operations. This will
	  have an impact on the overall system performance - whether
	  this is acceptable or not will depend on the use case.
```

## drivers/flash/Kconfig.lpc84x
```kconfig
# Copyright (c) 2026, Aerlync Labs Inc.
# SPDX-License-Identifier: Apache-2.0

config FLASH_SOC_LPC84X_IAP
	bool "NXP LPC84x ROM IAP + FMC MMIO flash driver"
	default y
	depends on DT_HAS_NXP_IAP_FMC84X_ENABLED
	select FLASH_HAS_PAGE_LAYOUT
	select FLASH_HAS_DRIVER_ENABLED
	select FLASH_HAS_EXPLICIT_ERASE
	help
	  Flash driver for NXP LPC844/LPC845 devices.
```

## drivers/flash/Kconfig.max32
```kconfig
# Copyright (c) 2023 Analog Devices, Inc.
# SPDX-License-Identifier: Apache-2.0

config SOC_FLASH_MAX32
	bool "ADI MAX32 flash driver"
	default y
	depends on DT_HAS_ADI_MAX32_FLASH_CONTROLLER_ENABLED
	select FLASH_HAS_DRIVER_ENABLED
	select FLASH_HAS_EXPLICIT_ERASE
	select FLASH_HAS_PAGE_LAYOUT
	help
	  Enable MAX32 internal flash driver.
```
