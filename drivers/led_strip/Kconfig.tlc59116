## drivers/lpm/Kconfig.renesas_ra2
```kconfig
# Copyright (c) 2023-2024 MUNIC SA
# SPDX-License-Identifier: Apache-2.0

config LPM_RA2
	bool
	depends on DT_HAS_RENESAS_RA2_LPM_ENABLED
	default y
	help
	  Enable low power mode controller for RA2 family.
```

## drivers/mbox/Kconfig
```kconfig
# Copyright (c) 2021 Carlo Caione <ccaione@baylibre.com>
# Copyright 2024 NXP
# SPDX-License-Identifier: Apache-2.0

menuconfig MBOX
	bool "Multi-Channel Inter-Processor Mailbox (MBOX) drivers"
	help
	  Include multi-channel interrupt-based inter-processor mailboxes
	  drivers in system configuration

if MBOX

# Include these first so that any properties (e.g. defaults) below can be
# overridden (by defining symbols in multiple locations)
source "drivers/mbox/Kconfig.nrfx"
source "drivers/mbox/Kconfig.nxp_s32"
source "drivers/mbox/Kconfig.nxp_imx"
source "drivers/mbox/Kconfig.nxp_mailbox"
source "drivers/mbox/Kconfig.andes"
source "drivers/mbox/Kconfig.nrf_vevif_task"
source "drivers/mbox/Kconfig.nrf_vevif_event"
source "drivers/mbox/Kconfig.nrf_bellboard"
source "drivers/mbox/Kconfig.stm32_hsem"
source "drivers/mbox/Kconfig.esp32"
source "drivers/mbox/Kconfig.ivshmem"
source "drivers/mbox/Kconfig.ti_omap"


config MBOX_INIT_PRIORITY
	int "MBOX init priority"
	default 40
	help
	  MBOX driver device initialization priority.

module = MBOX
module-str = mbox
source "subsys/logging/Kconfig.template.log_config"

endif # MBOX
```

## drivers/mbox/Kconfig.adi_max32
```kconfig
# Copyright 2025 Analog Devices, Inc
# SPDX-License-Identifier: Apache-2.0

config MBOX_ADI_MAX32_SEMA
	bool "ADI MAX32 SEMA mailbox driver"
	default y
	depends on DT_HAS_ADI_MBOX_MAX32_SEMA_ENABLED
	help
	  Driver for ADI MAX32 SEMA peripheral mailbox
	  functionality.
```

## drivers/mbox/Kconfig.ambiq
```kconfig
# Copyright (c) 2025 Ambiq Micro, Inc.
#
# SPDX-License-Identifier: Apache-2.0
#

config MBOX_AMBIQ
	bool "Ambiq mailbox driver"
	default y
	depends on DT_HAS_AMBIQ_MBOX_IPC_ENABLED
	select AMBIQ_HAL
	help
	  Enable the driver for Ambiq mailbox.
```

## drivers/mbox/Kconfig.andes
```kconfig
# Kconfig Andes mbox configuration options
#
# Copyright (c) 2022 Andes Technology Corporation.
#
# SPDX-License-Identifier: Apache-2.0
#

config MBOX_ANDES_PLIC_SW
	bool "MBOX Andes PLIC-SW driver"
	default y
	depends on DT_HAS_ANDESTECH_MBOX_PLIC_SW_ENABLED
	depends on PLIC_SUPPORTS_SOFT_INTERRUPT
	select DYNAMIC_INTERRUPTS
	help
	  Enable the driver for the Andes PLIC-SW based MBOX controller.
```

## drivers/mbox/Kconfig.brcm_bcm2711
```kconfig
# Copyright (c) 2026 Muhammad Waleed Badar
# SPDX-License-Identifier: Apache-2.0

config MBOX_BCM2711
	bool "Broadcom BCM2711 mailbox driver"
	default y
	depends on DT_HAS_BRCM_BCM2711_MBOX_ENABLED
	help
	  Driver for Broadcom BCM2711 mailbox used to communicate with the VideoCore.
```

## drivers/mbox/Kconfig.esp32
```kconfig
# Copyright 2024 Felipe Neves
# SPDX-License-Identifier: Apache-2.0

config MBOX_ESP32
	bool "ESP32 Soft mailbox driver"
	default y
	depends on DT_HAS_ESPRESSIF_MBOX_ESP32_ENABLED
	help
	  Driver for ESP32 mailbox based on its doorbell mechanism.

if MBOX_ESP32

config MBOX_ESP32_LP_READY_TIMEOUT_US
	int "Time to wait for the LP core to be ready, in microseconds"
	default 20000
	depends on SOC_ESP32C5_HPCORE || SOC_ESP32C6_HPCORE || SOC_ESP32P4_HPCORE
	help
	  The application is held back this long for the LP core to be ready to
	  service the mailbox, so a first send is not lost. On expiry it boots
	  anyway and mbox_send() reports -EBUSY until the LP core shows up.

endif # MBOX_ESP32
```
