## drivers/led_strip/Kconfig.tlc59116
```kconfig
# Copyright (c) 2025 Tridonic GmbH & Co KG
#
# SPDX-License-Identifier: Apache-2.0

config TLC59116_STRIP
	bool "TLC59116 (and compatible) LED strip driver"
	depends on I2C
	depends on DT_HAS_TI_TLC59116_ENABLED
	default y
	help
	  Enable LED strip driver for TLC59116 devices
```

## drivers/led_strip/Kconfig.tlc5971
```kconfig
# Copyright (c) 2022 Esco Medical ApS
#
# SPDX-License-Identifier: Apache-2.0

config TLC5971_STRIP
	bool "TLC5971 (and compatible) LED strip driver"
	depends on SPI
	help
	  Enable LED strip driver for daisy chains of TLC5971-ish devices
```

## drivers/led_strip/Kconfig.tlc59731
```kconfig
# Copyright (c) 2024 Javad Rahimipetroudi <javad.rahimipetroudi@mind.be>
# SPDX-License-Identifier: Apache-2.0

config TLC59731_STRIP
	bool "TLC59731 LED controller"
	default y
	depends on DT_HAS_TI_TLC59731_ENABLED
	select GPIO
	help
	  Enable driver for the Texas Instruments TLC59731 EasySet LED
	  controllers.
```

## drivers/led_strip/Kconfig.ws2812
```kconfig
# Copyright (c) 2017 Linaro Limited
# Copyright (c) 2019 Nordic Semiconductor ASA
#
# SPDX-License-Identifier: Apache-2.0

# The following blog post is an excellent resource about pulse timing:
#
# https://wp.josh.com/2014/05/13/ws2812-neopixels-are-not-so-finicky-once-you-get-to-know-them/

config WS2812_STRIP_SPI
	bool "WS2812 LED strip SPI driver"
	default y
	depends on DT_HAS_WORLDSEMI_WS2812_SPI_ENABLED
	select SPI if $(dt_compat_on_bus,$(DT_COMPAT_WORLDSEMI_WS2812_SPI),spi)
	help
	  Enable driver for WS2812 (and compatibles) LED strip using SPI.
	  The SPI driver is portable, but requires significantly more
	  memory (1 byte of overhead per bit of pixel data).

config WS2812_STRIP_SPI_PREAMBLE_SUPPORT
	bool "WS2812 LED strip SPI preamble support"
	default n
	depends on WS2812_STRIP_SPI
	help
	  Enables support for spi-empty-preamble-frames to support platforms with
	  MOSI high during inactive bus behaviours e.g. the I.MX RT series MCUs

config WS2812_STRIP_SPI_POSTAMBLE_SUPPORT
	bool "WS2812 LED strip SPI postamble support"
	default n
	depends on WS2812_STRIP_SPI
	help
	  Enables support for spi-empty-postamble-frames to support platforms with
	  MOSI high during inactive bus behaviours e.g. the I.MX RT series MCUs

config WS2812_STRIP_I2S
	bool "WS2812 LED strip I2S driver"
	default y
	depends on DT_HAS_WORLDSEMI_WS2812_I2S_ENABLED
	select I2S if $(dt_compat_on_bus,$(DT_COMPAT_WORLDSEMI_WS2812_I2S),i2s)
	help
	  Enable driver for WS2812 (and compatibles) LED strip using I2S.
	  Uses the I2S peripheral, memory usage is 4 bytes per color,
	  times the number of pixels. A few more for the start and end
	  delay. The reset delay has a coarse resolution of ~20us.

config WS2812_STRIP_GPIO
	bool "WS2812 LED strip GPIO driver"
	# Only an Cortex-M0 inline assembly implementation for the nRF51
	# is supported currently.
	default y
	depends on DT_HAS_WORLDSEMI_WS2812_GPIO_ENABLED
	depends on SOC_SERIES_NRF51X
	select LED_STRIP_RGB_SCRATCH
	help
	  Enable driver for WS2812 (and compatibles) LED strip directly controlling with GPIO.
	  The GPIO driver does bit-banging with inline assembly,
	  and is not available on all SoCs.

	  Note that this driver is not compatible with the Everlight B1414
	  controller.

config WS2812_STRIP_RPI_PICO_PIO
	bool "WS2812 LED strip Raspberry Pi Pico PIO driver"
	default y
	depends on DT_HAS_WORLDSEMI_WS2812_RPI_PICO_PIO_ENABLED
	select PICOSDK_USE_PIO
	help
	  Enable driver for WS2812 (and compatibles) LED strip using
	  the RaspberryPi Pico's PIO.
```

## drivers/led_strip/Kconfig.ws2812b_sw
```kconfig
#
# Copyright (c) 2018 Intel Corporation
#
# SPDX-License-Identifier: Apache-2.0
#

menuconfig WS2812B_SW
	bool "Enable WS2812B software-based LED strip driver"
	# Only an Cortex-M0 inline assembly implementation for the nRF51
	# is supported currently.
	depends on SOC_SERIES_NRF51X
	help
	  A software-based (bit-banging) LED strip driver for daisy
	  chains of WS2812B devices. This driver implements the signal
	  sending with software-based bit-banging. If a more efficient
	  option, such as SPI, is available, another driver is recommended
	  to be used.

if WS2812B_SW

config WS2812B_SW_NAME
	string "Driver name"
	default "ws2812b_sw"
	help
	  Device name for WS2812B LED strip.

config WS2812B_SW_GPIO_NAME
	string "GPIO port that the LED strip is connected to"
	default "GPIO_0" if SOC_FAMILY_NRF
	help
	  GPIO port name.

config WS2812B_SW_GPIO_PIN
	int "GPIO pin that the LED strip is connected to"
	default 3 if BOARD_BBC_MICROBIT # P0
	help
	  GPIO pin number that the LED strip is connected to.

endif
```

## drivers/lin/Kconfig.skeleton
```kconfig
# Copyright (c) 2025 Renesas Electronics Corporation
# SPDX-License-Identifier: Apache-2.0

config LIN_SKELETON
	bool "LIN Skeleton Driver"
	default y
	depends on DT_HAS_ZEPHYR_LIN_SKELETON_ENABLED
	help
	  Enable the LIN Skeleton driver for testing and development purposes.
	  This is a minimal implementation that does not interact with real hardware.
	  It is intended for use in simulation or as a template for developing new LIN drivers.
```

## drivers/lin/transceiver/Kconfig
```kconfig
# LIN transceiver configuration options

# Copyright (c) 2025 Renesas Electronics Corporation
# SPDX-License-Identifier: Apache-2.0

menu "LIN transceiver drivers"

config LIN_TRANSCEIVER_INIT_PRIORITY
	int "LIN transceiver driver init priority"
	default 45
	help
	  LIN transceiver device driver initialization priority.

config LIN_TRANSCEIVER_GPIO
	bool "GPIO controlled LIN transceiver"
	default y
	depends on DT_HAS_LIN_TRANSCEIVER_GPIO_ENABLED
	select GPIO
	help
	  Enable support for GPIO controlled LIN transceivers.

endmenu
```

## drivers/lora/Kconfig.daphnisi
```kconfig
#
# Copyright (c) 2025 Würth Elektronik eiSos GmbH & Co. KG
#
# SPDX-License-Identifier: Apache-2.0
#

config WSEN_DAPHNISI
	bool "Daphnis-I driver"
	default y
	depends on DT_HAS_WE_WSEN_DAPHNIS_I_ENABLED && !LORAWAN
	select SERIAL
	select UART_INTERRUPT_DRIVEN
	select HAS_WEMODULES
	select GPIO
	help
	  Enable the Daphnis-I driver

	  Although this driver exposes the LoRa Device API, this will
	  not allow you to send raw LoRa packets therefore the packets
	  sent using this driver will only be able to be received by another
	  Daphnis-I module.
```

## drivers/lora/Kconfig.rylrxxx
```kconfig
#
# Copyright (c) 2024 David Ullmann
#
# SPDX-License-Identifier: Apache-2.0
#

config LORA_RYLRXXX
	bool "Reyax LYLR driver"
	depends on DT_HAS_REYAX_RYLRXXX_ENABLED
	select MODEM_MODULES
	select MODEM_CHAT
	select MODEM_PIPE
	select MODEM_BACKEND_UART
	select GPIO
	help
	  Enable the Reyax LYLR driver

if LORA_RYLRXXX

config LORA_RYLRXX_CMD_BUF_SIZE
	int "cmd buffer size"
	default 256
	help
	  Configure the cmd buffer size

config RYLRXXX_UNSOLICITED_RX_MSGQ_SIZE
	int "number of message to store in message queue"
	default 1
	help
	  Configure the size of message queue

config RYLRXXX_RADIO_CMD_RESPONSE_TIMEOUT_MS
	int "timeout when waiting for response from radio serial interface after send cmd"
	default 500
	help
	  Configure the number of milliseconds before timing out when waiting for acknowledgment from radio after sending cmd

config RYLRXXX_MODEM_BUFFERS_SIZE
	int "size of buffers for modem library"
	default 512
	help
	  Configure the size of buffers for modem library

endif # LORA_RYLRXXX
```

## drivers/lora/Kconfig.sx1276
```kconfig
#
# Copyright (c) 2019 Manivannan Sadhasivam
#
# SPDX-License-Identifier: Apache-2.0
#

config LORA_SX1276
	bool "Semtech SX1276 driver"
	select HAS_SEMTECH_RADIO_DRIVERS
	select HAS_SEMTECH_LORAMAC
	select HAS_SEMTECH_SX1276
	depends on SPI
	help
	  Enable LoRa driver for Semtech SX1276.
```

## drivers/lora/Kconfig.sx12xx
```kconfig
#
# Copyright (c) 2019 Manivannan Sadhasivam
#
# SPDX-License-Identifier: Apache-2.0
#

config LORA_SX127X
	bool "Semtech SX127x driver"
	default y
	depends on DT_HAS_SEMTECH_SX1272_ENABLED || DT_HAS_SEMTECH_SX1276_ENABLED || DT_HAS_SEMTECH_SX1278_ENABLED
	select HAS_SEMTECH_SX1272 if DT_HAS_SEMTECH_SX1272_ENABLED
	select HAS_SEMTECH_SX1276 if DT_HAS_SEMTECH_SX1276_ENABLED || DT_HAS_SEMTECH_SX1278_ENABLED
	select SPI
	select GPIO
	help
	  Enable LoRa driver for Semtech SX1272 and SX1276/SX1278

config LORA_SX126X
	bool "Semtech SX126x driver"
	default y
	depends on DT_HAS_SEMTECH_SX1261_ENABLED || DT_HAS_SEMTECH_SX1262_ENABLED \
		|| DT_HAS_SEMTECH_SX1268_ENABLED || DT_HAS_SEMTECH_LLCC68_ENABLED
	select HAS_SEMTECH_SX126X
	select SPI
	select GPIO
	help
	  Enable LoRa driver for Semtech SX1261, SX1262/SX1268, and LLCC68

config LORA_STM32WL_SUBGHZ_RADIO
	bool "STM32WL SUBGHZ radio driver"
	default y
	depends on DT_HAS_ST_STM32WL_SUBGHZ_RADIO_ENABLED
	select HAS_SEMTECH_SX126X
	select SPI
	select GPIO
	help
	  Enable LoRa driver for STM32WL SUBGHZ radio.
```

## drivers/lora/lora_basics_modem/Kconfig
```kconfig
#
# Copyright (c) 2025 Embeint Inc
#
# SPDX-License-Identifier: Apache-2.0
#

if LORA_MODULE_BACKEND_LORA_BASICS_MODEM

config LORA_BASICS_MODEM_ASYNC_RX_MAX_PAYLOAD
	int "Maximum size payload that can be received by async RX"
	default 256
	help
	  A buffer of this size is allocated on the system workqueue stack when
	  running the async RX handler.

choice LORA_BASICS_MODEM_RSSI_REPORT_TYPE
	prompt "Type of RSSI to report to the application layer"
	default LORA_BASICS_MODEM_RSSI_REPORT_TYPE_SIGNAL

config LORA_BASICS_MODEM_RSSI_REPORT_TYPE_PACKET
	bool "Report the packet RSSI (rssi_pkt_in_dbm)"
	help
	  The packet RSSI is the strength of the signal in the configured band.
	  Once the LoRa signal goes below the noise floor, this value with stay
	  at the signal strength of the noise floor.

config LORA_BASICS_MODEM_RSSI_REPORT_TYPE_SIGNAL
	bool "Report the signal RSSI (signal_rssi_pkt_in_dbm)"
	help
	  The signal RSSI is an estimate of the strength of the received LoRa
	  signal. In contrast to the packet RSSI, this value will continue to
	  decrease below the noise floor as the signal approaches the sensitivity
	  limits of the receiver.

endchoice

endif
```

## drivers/lora/native/lr11xx/Kconfig
```kconfig
# Copyright (c) 2026 MASSDRIVER EI (massdriver.space)
# SPDX-License-Identifier: Apache-2.0

config LORA_LR11XX_NATIVE
	bool "Semtech LR11XX native driver (experimental)"
	default y
	depends on LORA_MODULE_BACKEND_NATIVE
	depends on DT_HAS_SEMTECH_LR1121_ENABLED
	select SPI
	select GPIO
	help
	  Enable native driver for Semtech LR11xx LoRa transceivers.
	  This is an experimental driver that does not depend on loramac-node
	  or lora-basics-modem external modules.

config LORA_LR11XX_NATIVE_SLEEP
	bool "Sleep mode power management"
	default y
	depends on LORA_LR11XX_NATIVE
	help
	  Place the LR11xx radio into sleep mode when idle to reduce
	  power consumption (~1.6 uA vs ~1.25 mA in standby). Disable
	  to keep the radio in standby for faster response times.
```

## drivers/lora/native/sx126x/Kconfig
```kconfig
# Copyright (c) 2026 Carlo Caione <ccaione@baylibre.com>
# SPDX-License-Identifier: Apache-2.0

config LORA_SX126X_NATIVE
	bool "Semtech SX126x native driver (experimental)"
	default y
	depends on LORA_MODULE_BACKEND_NATIVE
	depends on DT_HAS_SEMTECH_SX1262_ENABLED || DT_HAS_SEMTECH_SX1261_ENABLED || \
		   DT_HAS_ST_STM32WL_SUBGHZ_RADIO_ENABLED
	select SPI
	select GPIO
	help
	  Enable native driver for Semtech SX1261/SX1262 LoRa transceivers,
	  including the STM32WL integrated sub-GHz radio.
	  This is an experimental driver that does not depend on loramac-node
	  or lora-basics-modem external modules.

config LORA_SX126X_NATIVE_STM32WL
	bool
	default y
	depends on LORA_SX126X_NATIVE
	depends on DT_HAS_ST_STM32WL_SUBGHZ_RADIO_ENABLED
	help
	  STM32WL Sub-GHz radio support for the native SX126x driver.

config LORA_SX126X_NATIVE_STANDALONE
	bool
	default y
	depends on LORA_SX126X_NATIVE
	depends on DT_HAS_SEMTECH_SX1262_ENABLED || DT_HAS_SEMTECH_SX1261_ENABLED
	help
	  Standalone SX1261/SX1262 support for the native SX126x driver.
```

## drivers/lora_lbm/Kconfig
```kconfig
# LoRa Basics Modem drivers configuration options
#
# Copyright (c) 2024 Semtech Corporation - Félix Piédallu
#
# SPDX-License-Identifier: Apache-2.0

#FIXME: Might be renamed LORA_DRIVERS
menuconfig LORA_BASICS_MODEM_DRIVERS
	bool "LoRa drivers from the new LoRa Basics Modem stack [EXPERIMENTAL]"
	select POLL
	select EXPERIMENTAL
	select ZEPHYR_LORA_BASICS_MODEM_MODULE
	depends on !LORA
	help
	  Include LoRa drivers from the new LoRa Basics Modem stack in the system configuration.

if LORA_BASICS_MODEM_DRIVERS

module = LORA_BASICS_MODEM_DRIVERS
module-str = lora-lbm
source "subsys/logging/Kconfig.template.log_config"

rsource "Kconfig.lr11xx"
rsource "Kconfig.sx12xx"

config LORA_BASICS_MODEM_DRIVERS_INIT_PRIORITY
	int "Init priority"
	default 50


config LORA_BASICS_MODEM_DRIVERS_EVENT_TRIGGER
	bool

choice
	prompt "Event trigger mode"
	default LORA_BASICS_MODEM_DRIVERS_EVENT_TRIGGER_GLOBAL_THREAD
	help
	  Specify the type of triggering to be used by the LORA_BASICS_MODEM_DRIVERS driver.

config LORA_BASICS_MODEM_DRIVERS_EVENT_TRIGGER_NONE
	bool "No trigger on event"

config LORA_BASICS_MODEM_DRIVERS_EVENT_TRIGGER_GLOBAL_THREAD
	bool "Use global thread"
	depends on GPIO
	select LORA_BASICS_MODEM_DRIVERS_EVENT_TRIGGER

config LORA_BASICS_MODEM_DRIVERS_EVENT_TRIGGER_OWN_THREAD
	bool "Use own thread"
	depends on GPIO
	select LORA_BASICS_MODEM_DRIVERS_EVENT_TRIGGER

endchoice

config LORA_BASICS_MODEM_DRIVERS_EVENT_TRIGGER_THREAD_PRIORITY
	int "Thread priority"
	depends on LORA_BASICS_MODEM_DRIVERS_EVENT_TRIGGER_OWN_THREAD
	default 10
	help
	  Priority of thread used by the driver to handle interrupts.

config LORA_BASICS_MODEM_DRIVERS_EVENT_TRIGGER_THREAD_STACK_SIZE
	int "Thread stack size"
	depends on LORA_BASICS_MODEM_DRIVERS_EVENT_TRIGGER_OWN_THREAD
	default 1024
	help
	  Stack size of thread used by the driver to handle interrupts.

config LORA_BASICS_MODEM_DRIVERS_HAL_WAIT_ON_BUSY_TIMEOUT_MSEC
	int "Time to wait on BUSY pin in ms before aborting"
	default 600000
	help
	  Busy pin wait time in milliseconds. As WiFi and GPS scanning can take
	  seconds/minutes, the default is set to 10 minutes.


config LORA_BASICS_MODEM_DRIVERS_RAL_RALF
	bool "LoRa Radio Abstration Layer from the new LoRa Basics Modem stack"
	default y
	help
	  Include the Radio Abstration Layer from the new LoRa Basics Modem stack

# TODO: LORA_SHELL

endif # LORA_BASICS_MODEM_DRIVERS
```

## drivers/lora_lbm/Kconfig.lr11xx
```kconfig
# Copyright (c) 2024 Semtech Corporation - Félix Piédallu
# SPDX-License-Identifier: Apache-2.0

# LoRa transceiver drivers configuration options

config SEMTECH_LR11XX
	bool "Semtech LR11xx family LoRa transceiver driver"
	default y
	depends on DT_HAS_SEMTECH_LR1110_ENABLED || DT_HAS_SEMTECH_LR1120_ENABLED || DT_HAS_SEMTECH_LR1121_ENABLED
	select SPI
	select GPIO
	help
	  Enable driver for the LR11xx family LoRa transceiver driver


if SEMTECH_LR11XX

config LR11XX_USE_CRC_OVER_SPI
	bool "Use CRC over SPI communication"

endif # SEMTECH_LR11XX
```

## drivers/lora_lbm/Kconfig.sx12xx
```kconfig
# Copyright (c) 2024 Semtech Corporation
# SPDX-License-Identifier: Apache-2.0

# LoRa transceiver drivers configuration options

config SEMTECH_SX126X
	bool "Semtech SX126x family LoRa transceiver driver"
	default y
	depends on DT_HAS_SEMTECH_SX1261_NEW_ENABLED || DT_HAS_SEMTECH_SX1262_NEW_ENABLED || DT_HAS_SEMTECH_SX1268_NEW_ENABLED || DT_HAS_ST_STM32WL_SUBGHZ_RADIO_ENABLED
	select SPI
	select GPIO
	help
	  Enable driver for the SX126x family and stm32wl embedded LoRa transceiver driver
```

## drivers/lpm/Kconfig
```kconfig
#
# Copyright (c) 2024 MUNIC SA
#
# SPDX-License-Identifier: Apache-2.0
#

# Top-level configuration file for Renesas LPM drivers.

menuconfig LPM
	bool "Low Power Module drivers"
	help
	  Include LPM drivers in the system configuration.

if LPM

module = LPM
module-str = lpm
source "subsys/logging/Kconfig.template.log_config"

source "drivers/lpm/Kconfig.renesas_ra2"

endif
```
