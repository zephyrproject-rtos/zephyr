## drivers/mpc/arm_tz_mpc/Kconfig
```kconfig
# SPDX-FileCopyrightText: Copyright (c) 2026 Infineon Technologies AG,
# SPDX-FileCopyrightText: or an affiliate of Infineon Technologies AG. All rights reserved.
#
# SPDX-License-Identifier: Apache-2.0

config ARM_TZ_MPC
	bool "ARM TrustZone Memory Protection Controller (TZ-MPC) driver"
	depends on ARM_SECURE_FIRMWARE
	default y if DT_HAS_ARM_TZ_MPC_ENABLED
	select MPC
	help
	  Enables the driver for ARM TrustZone MPC (PL523 or compatible)
	  peripherals.  When enabled, arm_tz_mpc_configure_all() programs
	  the block LUT of each enabled arm,tz-mpc DTS node according to
	  the nonsecure-ranges property.
```

## drivers/mpc/infineon_mpc/Kconfig
```kconfig
# SPDX-FileCopyrightText: Copyright (c) 2026 Infineon Technologies AG,
# SPDX-FileCopyrightText: or an affiliate of Infineon Technologies AG. All rights reserved.
#
# SPDX-License-Identifier: Apache-2.0

config INFINEON_MPC
	bool "Infineon Memory Protection Controller driver"
	depends on ARM_SECURE_FIRMWARE
	default y if DT_HAS_INFINEON_MPC_ENABLED
	select MPC
	help
	  Enables the devicetree-driven driver for the Infineon Memory
	  Protection Controller.  mpc_configure_all() programs each enabled
	  "infineon,mpc" node's violation response and controlled memory
	  regions from the protection-context configuration expressed in the DTS.
```

## drivers/mpc/infineon_mxs40_mpc/Kconfig
```kconfig
# SPDX-FileCopyrightText: <text>Copyright (c) 2026 Infineon Technologies AG,
# or an affiliate of Infineon Technologies AG. All rights reserved.</text>
#
# SPDX-License-Identifier: Apache-2.0

config INFINEON_MXS40_MPC
	bool "Infineon MXS40 Memory Protection Controller driver"
	depends on ARM_SECURE_FIRMWARE
	default y if DT_HAS_INFINEON_MXS40_MPC_ENABLED
	select MPC
	help
	  Enables the devicetree-driven driver for the Infineon MXS40 Memory
	  Protection Controller.  mpc_configure_all() programs each enabled
	  "infineon,mxs40-mpc" node's violation response and controlled memory
	  regions from the protection-context configuration expressed in the DTS.
```

## drivers/mspi/Kconfig.bitbang
```kconfig
# SPDX-FileCopyrightText: Copyright The Zephyr Project Contributors
# SPDX-License-Identifier: Apache-2.0

config MSPI_BITBANG
	bool "Bitbang MSPI controller driver"
	default y
	depends on DT_HAS_ZEPHYR_MSPI_BITBANG_CONTROLLER_ENABLED
	select GPIO
	help
	  Enable the bitbang MSPI controller driver.
```

## drivers/mspi/Kconfig.esp32
```kconfig
# Copyright 2026 Pavel Maloletkov
# SPDX-License-Identifier: Apache-2.0

config MSPI_ESP32
	bool "ESP32 MSPI driver"
	default y
	depends on DT_HAS_ESPRESSIF_ESP32_MSPI_ENABLED
	select PINCTRL
	select GPIO if $(dt_compat_any_has_prop,$(DT_COMPAT_ESPRESSIF_ESP32_MSPI),ce-gpios)
	select MSPI_DMA if $(dt_compat_any_has_prop,$(DT_COMPAT_ESPRESSIF_ESP32_MSPI),dma-enabled,True)
	help
	  Enable ESP32 MSPI driver. This driver provides support for the
	  ESP32 SPI peripherals through the Zephyr MSPI interface.

if MSPI_ESP32

config MSPI_ESP32_DMA_MAX_BUFFER_SIZE
	int "Longest DMA transaction (bytes)"
	default 4092
	range 64 4092
	help
	  Longest data phase the driver hands to the DMA in one transaction.
	  Longer packets are split into pieces with CS held between them.

config MSPI_ESP32_INTERRUPT
	bool "ESP32 MSPI interrupt mode"
	default y
	help
	  Signal transfer completion using the SPI "transaction done"
	  interrupt instead of busy-polling the hardware from the calling
	  thread. This lets other threads run while a transfer is in
	  flight, instead of spinning the calling thread's CPU for the full
	  duration of every transfer. Requires an "interrupts" property on
	  the MSPI controller's devicetree node.

config MSPI_ESP32_PSRAM_DMA
	bool "Transfer directly out of PSRAM buffers"
	depends on ESP_SPIRAM && SOC_GDMA_SUPPORTED && SOC_PSRAM_DMA_CAPABLE
	help
	  Hand cache-line aligned PSRAM buffers straight to the DMA instead of
	  copying them into internal RAM first.

	  This removes the copy, but the DMA must then feed the transmit FIFO
	  straight from PSRAM at the full bus rate. PSRAM bandwidth is shared
	  with instruction fetch and any other external-RAM traffic, so when it
	  cannot keep up the FIFO underruns and the transfer is silently
	  corrupted. The intermediate copy otherwise decouples the two rates.

	  Only enable this if the bus clock is low enough that PSRAM can sustain
	  it, and verify the resulting data.

endif # MSPI_ESP32
```

## drivers/mspi/Kconfig.mchp
```kconfig
# Copyright (c) 2026 Microchip Technology Inc.
# SPDX-License-Identifier: Apache-2.0

config MSPI_MCHP_G1
	bool "Microchip MSPI G1 QSPI driver"
	default y
	depends on DT_HAS_MICROCHIP_QSPI_G1_MSPI_ENABLED
	depends on CLOCK_CONTROL
	depends on PINCTRL
	help
	  Enable support for the Microchip MSPI Group 1 (G1) QSPI driver.
```

## drivers/mspi/Kconfig.mchp_xec
```kconfig
# Microchip XEC MSPI driver configuration
#
# Copyright (c) 2026 Microchip Technology Inc. and its subsidiaries.
# SPDX-License-Identifier: Apache-2.0

config MSPI_MCHP_XEC_QMSPI
	bool "Microchip XEC QMSPI MSPI controller driver"
	default y
	depends on DT_HAS_MICROCHIP_XEC_QMSPI_CONTROLLER_ENABLED
	select PINCTRL
	select PINCTRL_KEEP_SLEEP_STATE
	help
	  Enable MSPI driver for Microchip MEC174x/MEC175x/MEC165xB QMSPI controller.
	  Supports PIO transfers using descriptors and the 8-byte TX/RX FIFOs.
	  Uses register definitions from
	  soc/microchip/mec/common/reg/mec_qmspi.h.

	  Pin assignments are board-specific; add QMSPI pinctrl nodes to
	  the board DTS and reference them via pinctrl-0 on the qspi0 node.

if MSPI_MCHP_XEC_QMSPI

config MSPI_MCHP_XEC_QMSPI_LDMA
	bool "QMSPI Local-DMA data path"
	default y
	depends on MSPI_DMA
	help
	  Use the QMSPI controller's three TX and three RX Local-DMA channels
	  for command, address, and data phases when an MSPI request specifies
	  xfer_mode=MSPI_DMA. Length-override on each channel drives the byte
	  count, bypassing the descriptor 15-bit NQUNITS limit.

	  When this is disabled, MSPI_DMA requests are rejected and only the
	  PIO (FIFO) path is built.

endif # MSPI_MCHP_XEC_QMSPI

config MSPI_MCHP_XEC_GPSPI_V2
	bool "Microchip XEC GPSPI MSPI driver"
	default y
	depends on DT_HAS_MICROCHIP_XEC_GPSPI_V2_CONTROLLER_ENABLED
	select PINCTRL
	select PINCTRL_KEEP_SLEEP_STATE
	help
	  Enable MSPI master driver for the Microchip MEC174x/MEC175x/MEC165xB
	  GPSPI block (compatible "microchip,xec-gpspi-v2").

	  Features:
	    - Standard (1-bit) and Dual (2-bit) wire modes
	    - All four CPOL/CPHA combinations (mspi_cpp_mode 0..3)
	    - 16-bit clock divider (up to clock_frequency / 2 bit-rate)
	    - Hardware chip-enable on CE0 / CE1 with programmable
	      CS_TIMING (assert / deassert / inter-frame gap)
	    - Synchronous and asynchronous transceive on both
	      MSPI_PIO and MSPI_DMA paths

	  Returns -ENOTSUP for: DDR data rate, Quad / split-line io_modes,
	  active-high CE, big-endian transfers, dqs_enable, op_mode
	  peripheral, and per-packet total > 0x7FFF bytes
	  (CONTROL.XFR_LENGTH limit).
```

## drivers/mspi/Kconfig.nxp
```kconfig
# Copyright 2026 NXP
# SPDX-License-Identifier: Apache-2.0

config MSPI_NXP_QSPI
	bool "NXP QSPI controller driver"
	default y
	depends on DT_HAS_NXP_QSPI_ENABLED
	select PINCTRL
	help
	  Enable MSPI driver for NXP QSPI controllers.

config MSPI_NXP_QSPI_BUSY_TIMEOUT_US
	int "NXP QSPI busy-wait timeout in microseconds"
	depends on MSPI_NXP_QSPI
	default 1000000
	help
	  Maximum time in microseconds to wait for the QSPI controller to
	  complete an IP command or for the TX FIFO to drain.

config MSPI_NXP_LPC_SPIFI
	bool "NXP LPC SPIFI controller driver"
	default y
	depends on DT_HAS_NXP_LPC_SPIFI_ENABLED
	select PINCTRL
	imply MSPI_MEMMAP
	help
	  Enable MSPI driver for the NXP LPC SPIFI controller.

config MSPI_NXP_LPC_SPIFI_TIMEOUT_US
	int "NXP LPC SPIFI command timeout in microseconds"
	depends on MSPI_NXP_LPC_SPIFI
	default 1000000
	help
	  Maximum time in microseconds to wait for a SPIFI command to complete.
```

## drivers/mspi/Kconfig.rpi_pico
```kconfig
# Copyright (c) 2026 WIZnet Co., Ltd.
# SPDX-License-Identifier: Apache-2.0

config MSPI_RPI_PICO_PIO
	bool "Raspberry Pi Pico PIO MSPI controller"
	default y
	depends on DT_HAS_RASPBERRYPI_PICO_MSPI_PIO_ENABLED
	depends on RESET
	select PINCTRL
	select PICOSDK_USE_PIO
	select DMA
	help
	  Enable the PIO based MSPI controller for RP2040/RP2350.
	  Supports MSPI_IO_MODE_QUAD_1_4_4 for devices such as the
	  WIZnet W6300 Ethernet controller.

	  The PIO FIFOs are fed and drained by DMA, so the controller node
	  needs a TX and an RX channel in dmas/dma-names.
```

## drivers/mspi/Kconfig.test
```kconfig
# Copyright (c) 2026 Muhammad Waleed Badar
# SPDX-License-Identifier: Apache-2.0

config MSPI_TEST
	def_bool DT_HAS_VND_MSPI_ENABLED
	depends on DT_HAS_VND_MSPI_ENABLED
```

## drivers/mux/Kconfig.infineon_trigmux
```kconfig
# SPDX-FileCopyrightText: Copyright (c) 2026 Linumiz
# SPDX-License-Identifier: Apache-2.0

config MUX_INFINEON_TRIGMUX
	bool "Infineon trigger multiplexer MUX driver"
	default y
	depends on DT_HAS_INFINEON_TRIGMUX_ENABLED
	help
	  Enable the Infineon PERI trigger multiplexer driver.
```

## drivers/mux/Kconfig.ti_am13e230_xbar_in
```kconfig
# SPDX-FileCopyrightText: 2026 Texas Instruments Incorporated
# SPDX-License-Identifier: Apache-2.0

config MUX_TI_AM13E230_XBAR_IN
	bool "TI AM13E230 Input XBAR driver"
	default y
	depends on DT_HAS_TI_AM13E230_XBAR_IN_ENABLED
	help
	  Enable the TI AM13E230 Input XBAR (crossbar) multiplexer driver.
```

## drivers/mux/Kconfig.ti_am13e230_xbar_out
```kconfig
# SPDX-FileCopyrightText: 2026 Texas Instruments Incorporated
# SPDX-License-Identifier: Apache-2.0

config MUX_TI_AM13E230_XBAR_OUT
	bool "TI AM13E230 Output XBAR driver"
	default y
	depends on DT_HAS_TI_AM13E230_XBAR_OUT_ENABLED
	help
	  Enable the TI AM13E230 Output XBAR (crossbar) multiplexer driver.
```

## drivers/mux/Kconfig.ti_am13e2_xbar
```kconfig
# SPDX-FileCopyrightText: 2026 Texas Instruments Incorporated
# SPDX-License-Identifier: Apache-2.0

TI_AM13E2_XBAR_PWREN_PROP := ti,pwren

config MUX_TI_AM13E2_XBAR_IN
	bool "TI AM13E2 Input XBAR driver"
	default y
	depends on DT_HAS_TI_AM13E2_XBAR_IN_ENABLED
	select SYSCON if \
		$(dt_compat_any_has_prop,$(DT_COMPAT_TI_AM13E2_XBAR_IN),$(TI_AM13E2_XBAR_PWREN_PROP))
	help
	  Enable the TI AM13E2 Input XBAR (crossbar) multiplexer driver.

config MUX_TI_AM13E2_XBAR_OUT
	bool "TI AM13E2 Output XBAR driver"
	default y
	depends on DT_HAS_TI_AM13E2_XBAR_OUT_ENABLED
	select SYSCON if \
		$(dt_compat_any_has_prop,$(DT_COMPAT_TI_AM13E2_XBAR_OUT),$(TI_AM13E2_XBAR_PWREN_PROP))
	help
	  Enable the TI AM13E2 Output XBAR (crossbar) multiplexer driver.
```

## drivers/mux/Kconfig.wch_ch446q
```kconfig
# SPDX-FileCopyrightText: Copyright The Zephyr Project Contributors
# SPDX-License-Identifier: Apache-2.0

config MUX_WCH_CH446Q
	bool "WCH CH446Q analog crosspoint switch MUX driver"
	default y
	depends on DT_HAS_WCH_CH446Q_ENABLED
	select GPIO
	help
	  Enable the WCH CH446Q 8x16 analog crosspoint switch, in serial
	  address mode, as a MUX controller. Each X line is a control line
	  whose state is the bitmask of the Y lines it connects to.

if MUX_WCH_CH446Q

config MUX_WCH_CH446Q_INIT_PRIORITY
	int "CH446Q init priority"
	default 60
	help
	  Device initialization priority. The CH446Q is driven through GPIO
	  lines, often on an I2C GPIO expander, so it must initialize later
	  than that GPIO controller while still being earlier than any MUX
	  consumer that references it.

endif # MUX_WCH_CH446Q
```

## drivers/nfc/Kconfig
```kconfig
# Copyright (c) 2026 RAKwireless Technology Limited
# SPDX-License-Identifier: Apache-2.0

menuconfig NFC_DRIVERS
	bool "Near Field Communication (NFC) drivers [EXPERIMENTAL]"
	select EXPERIMENTAL
	help
	  Enable NFC controller driver configuration.

if NFC_DRIVERS

module = NFC_DRIVERS
module-str = NFC_DRIVERS
source "subsys/logging/Kconfig.template.log_config"

config NFC_INIT_PRIORITY
	int "NFC driver init priority"
	default 80
	help
	  NFC controller driver device initialization priority.

source "drivers/nfc/pn53x/Kconfig"

endif # NFC_DRIVERS
```

## drivers/nfc/mfrc522/Kconfig
```kconfig
# Copyright (c) 2026 RAKwireless Technology Limited
# SPDX-License-Identifier: Apache-2.0

config NFC_MFRC522
	bool "NXP MFRC522 reader"
	default y
	depends on DT_HAS_NXP_MFRC522_ENABLED
	select SPI
	help
	  Enable the NXP MFRC522 ISO/IEC 14443A reader.
```

## drivers/nfc/nfc_emul/Kconfig
```kconfig
# Copyright (c) 2026 RAKwireless Technology Limited
# SPDX-License-Identifier: Apache-2.0

config NFC_EMUL
	bool "Emulated NFC controller"
	default y
	depends on DT_HAS_ZEPHYR_NFC_EMUL_ENABLED
	help
	  Enable the emulated NFC controller. This is a fake driver in that it
	  does not talk to real hardware; exchanges are driven by a script the
	  application supplies. It is used to test the NFC driver API on a host
	  build.
```

## drivers/nfc/pn53x/Kconfig
```kconfig
# Copyright (c) 2026 RAKwireless Technology Limited
# SPDX-License-Identifier: Apache-2.0

config NFC_PN53X
	bool "NXP PN53x NFC controller"
	default y
	depends on DT_HAS_NXP_PN53X_ENABLED
	select I2C if $(dt_compat_on_bus,$(DT_COMPAT_NXP_PN53X),i2c)
	help
	  Enable the NXP PN53x (PN531/PN532/PN533) NFC controller, which resolves
	  and activates targets in its own firmware.

if NFC_PN53X

config NFC_PN53X_POLL_STACK_SIZE
	int "PN53x poll thread stack size"
	default 2048
	help
	  Stack size of the per-device thread that runs offloaded target polling.
	  The user target callback runs in this context, including any
	  nfc_offload_exchange() calls, which use sizable frame buffers.

endif # NFC_PN53X
```

## drivers/nvmem_provider/Kconfig
```kconfig
# SPDX-FileCopyrightText: Copyright The Zephyr Project Contributors
# SPDX-FileCopyrightText: Copyright (c) 2026 Basalte bv
# SPDX-License-Identifier: Apache-2.0

menuconfig NVMEM_PROVIDER
	bool "NVMEM provider drivers"
	default y
	depends on NVMEM
	help
	  Enable drivers implementing the NVMEM provider device API to natively
	  expose NVMEM cells, in addition to the memory device APIs the NVMEM
	  subsystem dispatches to.

if NVMEM_PROVIDER

config NVMEM_PROVIDER_PSA
	bool
	help
	  Enabled when a PSA Secure Storage NVMEM provider is selected.

config NVMEM_PROVIDER_PSA_ITS
	bool "PSA Internal Trusted Storage NVMEM provider"
	default y
	depends on DT_HAS_ZEPHYR_NVMEM_PSA_ITS_ENABLED
	depends on TFM_PARTITION_INTERNAL_TRUSTED_STORAGE || SECURE_STORAGE
	select NVMEM_PROVIDER_PSA
	help
	  Expose PSA Internal Trusted Storage entries as NVMEM cells.

config NVMEM_PROVIDER_PSA_PS
	bool "PSA Protected Storage NVMEM provider"
	default y
	depends on DT_HAS_ZEPHYR_NVMEM_PSA_PS_ENABLED
	depends on TFM_PARTITION_PROTECTED_STORAGE || SECURE_STORAGE
	select NVMEM_PROVIDER_PSA
	help
	  Expose PSA Protected Storage entries as NVMEM cells.

config NVMEM_PROVIDER_PSA_WRITE
	bool "Write support for PSA Secure Storage backed NVMEM cells"
	default y
	depends on NVMEM_PROVIDER_PSA
	help
	  Allow writing to NVMEM cells backed by PSA Secure Storage entries.

	  Writing part of a cell reads, modifies and rewrites the whole
	  backing entry, as the PSA Secure Storage APIs only support
	  whole-entry writes.

config NVMEM_PROVIDER_PSA_WRITE_BUF_SIZE
	int "PSA Secure Storage entry read-modify-write buffer size"
	depends on NVMEM_PROVIDER_PSA_WRITE
	default SECURE_STORAGE_ITS_MAX_DATA_SIZE if SECURE_STORAGE
	default 128
	help
	  Size of the buffer used to read-modify-write a whole PSA Secure
	  Storage entry when writing part of an NVMEM cell. Partial writes
	  to entries larger than this buffer fail with -ENOBUFS.

endif # NVMEM_PROVIDER
```

## drivers/opamp/Kconfig.mspm0_opa
```kconfig
# TI MSPM0 Family

# SPDX-FileCopyrightText: Copyright (c) 2026 Linumiz
# SPDX-License-Identifier: Apache-2.0

config OPA_MSPM0
	bool "TI MSPM0 OPA driver"
	default y
	select PINCTRL
	depends on DT_HAS_TI_MSPM0_OPA_ENABLED
```
