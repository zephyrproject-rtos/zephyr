## drivers/opamp/Kconfig.mspm0_opamp
```kconfig
# TI MSPM0 Family

# Copyright (c) 2026, Linumiz
# SPDX-License-Identifier: Apache-2.0

config OPAMP_MSPM0
	bool "TI MSPM0 OPA driver"
	default y
	select PINCTRL
	depends on DT_HAS_TI_MSPM0_OPAMP_ENABLED
```

## drivers/opamp/Kconfig.mspm0_opamp_opa
```kconfig
# TI MSPM0 Family

# SPDX-FileCopyrightText: Copyright (c) 2026 Linumiz
# SPDX-License-Identifier: Apache-2.0

config OPAMP_MSPM0_OPA
	bool "TI MSPM0 OPA driver"
	default y
	select PINCTRL
	depends on DT_HAS_TI_MSPM0_OPA_ENABLED
```

## drivers/otp/Kconfig.adi_axi_sysid
```kconfig
# Copyright (c) 2026 Analog Devices, Inc.
# SPDX-License-Identifier: Apache-2.0

config OTP_ADI_AXI_SYSID
	bool "Analog Devices AXI System ID ROM (read-only OTP)"
	default y
	depends on DT_HAS_ADI_AXI_SYSID_ENABLED
	help
	  Enable the read-only OTP driver for the Analog Devices AXI
	  System ID core. The core exposes an FPGA build-information ROM
	  (board / product / git data) that is presented through the
	  standard OTP API.
```

## drivers/otp/Kconfig.gpio_straps
```kconfig
# SPDX-License-Identifier: Apache-2.0
# SPDX-FileCopyrightText: Copyright The Zephyr Project Contributors

config OTP_GPIO_STRAPS
	bool "GPIO strap identity (read-only OTP)"
	default y
	depends on DT_HAS_ZEPHYR_GPIO_STRAPS_ENABLED
	select GPIO
	help
	  Enable the read-only OTP driver for an identity value encoded on GPIO
	  strap pins, such as a board revision. The pins are sampled once at
	  init and the value is presented through the standard OTP API.
```
