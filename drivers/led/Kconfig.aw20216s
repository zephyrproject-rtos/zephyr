## drivers/led/Kconfig.aw20216s
```kconfig
# Copyright (c) 2020 Seagate Technology LLC
# SPDX-License-Identifier: Apache-2.0

config AW20216S
	bool "Awinic AW20216S LED driver"
	default y
	depends on DT_HAS_AWINIC_AW20216S_ENABLED
	select SPI
	help
	  Awinic AW20216S LED driver.
```

## drivers/led/Kconfig.axp192
```kconfig
# Copyright (c) 2024 TOKITA Hiroshi
# SPDX-License-Identifier: Apache-2.0

config LED_AXP192_AXP2101
	bool "X-Powers AXP192/AXP2101 LED driver"
	default y
	depends on DT_HAS_X_POWERS_AXP192_LED_ENABLED || DT_HAS_X_POWERS_AXP2101_LED_ENABLED
	depends on DT_HAS_X_POWERS_AXP192_ENABLED || DT_HAS_X_POWERS_AXP2101_ENABLED
	select I2C
	select MFD
	help
	  Enable the AXP192/AXP2101 LED driver.

	  AXP192 and AXP2101 are multi-functional integrated Power Management IC (PMIC).
	  This driver is for its LED controller feature.
	  This LED controller can control the lighting using a register,
	  and can also light up in response to the charging status.
```

## drivers/led/Kconfig.axp2101
```kconfig
# Copyright (c) 2024 TOKITA Hiroshi
# SPDX-License-Identifier: Apache-2.0

config LED_AXP2101
	bool "AXP2101 LED driver"
	default y
	depends on DT_HAS_X_POWERS_AXP2101_LED_ENABLED
	select I2C
	select MFD
	help
	  Enable the AXP2101 LED driver.
```

## drivers/led/Kconfig.dac
```kconfig
# Copyright (c) 2025 Prevas A/S
# SPDX-License-Identifier: Apache-2.0

config LED_DAC
	bool "DAC LED driver"
	default y
	depends on DT_HAS_DAC_LEDS_ENABLED
	select DAC
	help
	  Enable DAC LED driver.

	  The driver is normally used with a VCCS (Voltage Controlled Current
	  Source) between the DAC and the LED.

	  It might be possible to use this driver to supply an LED directly
	  from a DAC, but LED_PWM is most likely more suited for this purpose.
	  If the DAC is used without a VCCS, its capabilities should be checked
	  carefully, and the output buffer should be enabled.
```

## drivers/led/Kconfig.fake
```kconfig
# Fake LED controller configuration options

# SPDX-FileCopyrightText: Copyright (c) 2026 Henrik Brix Andersen <henrik@brixandersen.dk>
# SPDX-License-Identifier: Apache-2.0

config LED_FAKE
	bool "Fake LED controller driver"
	default y
	depends on DT_HAS_ZEPHYR_FAKE_LEDS_ENABLED
	help
	  Enable support for the FFF-based fake LED controller driver.
```

## drivers/led/Kconfig.fvp
```kconfig
# Copyright (c) 2026 Arm Limited (or its affiliates)
# SPDX-License-Identifier: Apache-2.0

config FVP_S6LEDS
	bool "FVP LED driver"
	default y
	depends on DT_HAS_ARM_FVP_LEDS_ENABLED
	help
	  Enable driver for Arm FVP LEDs. These are labelled as "S6LEDs" in the FVP GUI.
```

## drivers/led/Kconfig.gpio
```kconfig
# Copyright (c) 2021 Nordic Semiconductor ASA
# SPDX-License-Identifier: Apache-2.0

config LED_GPIO
	bool "GPIO LED driver"
	default y
	depends on DT_HAS_GPIO_LEDS_ENABLED
	select GPIO
	help
	  Enable driver for GPIO LEDs.
```

## drivers/led/Kconfig.ht16k33
```kconfig
# Copyright (c) 2019 Henrik Brix Andersen <henrik@brixandersen.dk>
# SPDX-License-Identifier: Apache-2.0

menuconfig HT16K33
	bool "HT16K33 LED driver"
	depends on I2C
	help
	  Enable LED driver for HT16K33.

	  The HT16K33 is a memory mapping, multifunction LED
	  controller driver. The controller supports up to 128 LEDs
	  (up to 16 rows and 8 commons).

config HT16K33_KEYSCAN
	bool "Enable keyscan support"
	depends on (HT16K33 && GPIO)
	select GPIO_HT16K33
	help
	  Enable keyscan child device support in the HT16K33 LED
	  driver.

	  The keyscan functionality itself is handled by the
	  HT16K33 GPIO driver.

if HT16K33_KEYSCAN

config HT16K33_KEYSCAN_IRQ_THREAD_STACK_SIZE
	int "Stack size for keyscan interrupt request handler thread"
	default 400
	help
	  Size of the stack used for internal thread for keyscan
	  interrupt processing.

config HT16K33_KEYSCAN_IRQ_THREAD_PRIO
	int "Priority for keyscan interrupt request handler thread"
	default 2
	help
	  Priority level for internal thread for keyscan interrupt
	  processing.

config HT16K33_KEYSCAN_DEBOUNCE_MSEC
	int "Keyscan debounce interval in milliseconds"
	default 50
	range 20 1000
	help
	  Keyscan debounce interval in milliseconds.

config HT16K33_KEYSCAN_POLL_MSEC
	int "Keyscan poll interval in milliseconds"
	default 200
	range 20 10000
	help
	  Keyscan poll interval in milliseconds. Polling is only used
	  if no interrupt line is present.

endif # HT16K33_KEYSCAN
```

## drivers/led/Kconfig.is31fl3194
```kconfig
# Copyright (c) 2024 Arduino SA
# SPDX-License-Identifier: Apache-2.0

config IS31FL3194
	bool "IS31FL3194 LED driver"
	default y
	depends on DT_HAS_ISSI_IS31FL3194_ENABLED
	select I2C
	help
	  Enable LED driver for Lumissil Microsystems (a division of ISSI)
	  IS31FL3194. This chip supports one RGB LED or 3 independent LEDs.
```

## drivers/led/Kconfig.is31fl319x
```kconfig
# Copyright (c) 2024 Arduino SA
# SPDX-License-Identifier: Apache-2.0

config IS31FL319X
	bool "IS31FL319x LED driver"
	default y
	depends on DT_HAS_ISSI_IS31FL3194_ENABLED || DT_HAS_ISSI_IS31FL3197_ENABLED
	select I2C
	help
	  Enable LED driver for Lumissil Microsystems (a division of ISSI).
	  This driver supports both multicolor (e.g. RGB, RGBW) and monochrome
	  (i.e. single-channel) LEDs. Mixed configurations are also supported.

	  Supported models
	  - IS31FL3194 (3 channels)
	  - IS31FL3197 (4 channels)
```

## drivers/led/Kconfig.is31fl3216a
```kconfig
# Copyright (c) 2023 Endor AG
# SPDX-License-Identifier: Apache-2.0

config IS31FL3216A
	bool "IS31FL3216A LED driver"
	default y
	depends on DT_HAS_ISSI_IS31FL3216A_ENABLED
	select I2C
	help
	  Enable LED driver for Lumissil Microsystems (a division of ISSI)
	  IS31FL3216A. This chip supports up to 16 PWM controlled LEDs.
```

## drivers/led/Kconfig.is31fl3238
```kconfig
# Copyright (c) 2026 Moritz Gericke
# SPDX-License-Identifier: Apache-2.0

config IS31FL3238
	bool "IS31FL3238 LED driver"
	default y
	depends on DT_HAS_ISSI_IS31FL3238_ENABLED
	select I2C
	help
	  Enable LED driver for Lumissil Microsystems (a division of ISSI)
	  IS31FL3238. This chip supports up to 18 PWM controlled LEDs.
```

## drivers/led/Kconfig.is31fl3733
```kconfig
# Copyright 2023 Daniel DeGrasse <daniel@degrasse.com>
# SPDX-License-Identifier: Apache-2.0

config IS31FL3733
	bool "IS31FL3733 LED driver"
	default y
	depends on DT_HAS_ISSI_IS31FL3733_ENABLED
	select I2C
	help
	  Enable LED driver for IS31FL3733.
	  IS31FL3733 is a matrix LED driver, capable of a maximum of 3.29 mA
	  per LED, or 42 mA total across all LEDs in the 12x16 dot matrix.
```

## drivers/led/Kconfig.is31fl3743
```kconfig
# Copyright 2023 Daniel DeGrasse <daniel@degrasse.com>
# Copyright 2025-2026 Framework Computer Inc
# SPDX-License-Identifier: Apache-2.0

config IS31FL3743
	bool "IS31FL3743 LED driver"
	default y
	depends on DT_HAS_ISSI_IS31FL3743_ENABLED
	select I2C
	help
	  Enable LED driver for IS31FL3743.
	  IS31FL3743 is a matrix LED driver, capable of a maximum of 3.03 mA
	  per LED, or 34.5 mA total across all LEDs in the 18x11 dot matrix.
```

## drivers/led/Kconfig.led_gpio
```kconfig
# Copyright (c) 2019 Nordic Semiconductor ASA
# SPDX-License-Identifier: Apache-2.0

config LED_GPIO
	bool "LED GPIO driver"
	depends on GPIO
	help
	  This option enables support for the LEDs connected to GPIO
	  outputs. To be useful the particular board must have LEDs
	  and they must be connected to the GPIO lines.

if LED_GPIO

config LED_SOFTWARE_BLINK
	bool "Software blink"
	help
	 Support for an LED software blink based on
	 system timers

module = LED_GPIO
module-str = LED GPIO
source "${ZEPHYR_BASE}/subsys/logging/Kconfig.template.log_config"

endif # LED_GPIO
```

## drivers/led/Kconfig.leds-group-multicolor
```kconfig
# Copyright (c) 2025 Seagate Technology LLC
# SPDX-License-Identifier: Apache-2.0

config LEDS_GROUP_MULTICOLOR
	bool "LEDs group multi-color driver"
	default y
	depends on DT_HAS_LEDS_GROUP_MULTICOLOR_ENABLED
	help
	  Enable this driver to supports multi-color LEDs built with several
	  monochromatic LEDs.

	  See the leds-group-multicolor DT binding for details.
```

## drivers/led/Kconfig.linux-leds
```kconfig
# Copyright 2026 Google LLC
# SPDX-License-Identifier: Apache-2.0

config NATIVE_LINUX_LEDS
	bool "Native Linux LEDs based LED device"
	default y
	depends on DT_HAS_ZEPHYR_NATIVE_LINUX_LEDS_ENABLED
	depends on ARCH_POSIX
	help
	  Enable a native_sim LED driver backed by Linux sysfs LEDs.
	  Each DT `native-linux-leds` child node provides a Linux LED name (as
	  found under /sys/class/leds) via the 'path' property, and Zephyr LED
	  brightness requests are mapped to /sys/class/leds/<path>/brightness.
```

## drivers/led/Kconfig.lp3943
```kconfig
#
# Copyright (c) 2018 Linaro Limited
#
# SPDX-License-Identifier: Apache-2.0
#

config LP3943
	bool "LP3943 LED driver"
	depends on I2C
	help
	  Enable LED driver for LP3943.

	  LP3943 LED driver has 16 channels each with multi-programmable
	  states at a specified rate. Each channel can drive up to 25 mA
	  per LED.
```

## drivers/led/Kconfig.lp503x
```kconfig
# Copyright (c) 2020 Seagate Technology LLC
# SPDX-License-Identifier: Apache-2.0

config LP503X
	bool "LP503X LED controller"
	default y
	depends on DT_HAS_TI_LP503X_ENABLED
	select I2C
	help
	  Enable driver for the Texas Instruments LP5030 and LP5036 I2C LED
	  controllers. They are respectively supporting up to 10 and 12 LEDs.
```

## drivers/led/Kconfig.lp5562
```kconfig
# Copyright (c) 2018 Workaround GmbH
# SPDX-License-Identifier: Apache-2.0

config LP5562
	bool "LP5562 LED driver"
	default y
	depends on DT_HAS_TI_LP5562_ENABLED
	select I2C
	help
	  Enable LED driver for LP5562.

	  LP5562 LED driver has 4 channels (RGBW). Each channel can drive up to
	  25.5 mA per LED.
```

## drivers/led/Kconfig.lp5569
```kconfig
# Copyright (c) 2023 Phytec Messtechnik GmbH
# SPDX-License-Identifier: Apache-2.0

config LP5569
	bool "LP5569 LED driver"
	default y
	depends on DT_HAS_TI_LP5569_ENABLED
	select I2C
	help
	  Enable LED driver for LP5569. LP5569 LED driver has 9 channels.
	  Each channel can drive up to 25.5 mA per LED.
```

## drivers/led/Kconfig.lp55xx
```kconfig
# Copyright (c) 2018 Workaround GmbH
# Copyright (c) 2024 Croxel Inc.
# SPDX-License-Identifier: Apache-2.0

config LP55XX
	bool "LP55XX LED driver"
	default y
	depends on DT_HAS_TI_LP5562_ENABLED || DT_HAS_TI_LP5521_ENABLED
	select I2C
	help
	  Enable LED driver for LP5562/LP5521.

	  LP5562 LED driver has 4 channels (RGBW). Each channel can drive up to
	  25.5 mA per LED.
	  LP5521 LED driver has 3 channels (RGB). Each channel can drive up to
	  25.5 mA per LED.
```

## drivers/led/Kconfig.lp5815
```kconfig
# Copyright (c) 2026 Kristina Kisiuk, Aliensense
# SPDX-License-Identifier: Apache-2.0


config LP5815
	bool "LP5815 LED driver"
	default y
	depends on DT_HAS_TI_LP5815_ENABLED
	select I2C
	help
	  Enable LED driver for LP5815. LP5815 LED driver has 3 channels.
	  Each channel can drive up to 25.5 mA per LED.
```

## drivers/led/Kconfig.lp586x
```kconfig
# SPDX-FileCopyrightText: Copyright (c) 2026 Draeger
# SPDX-License-Identifier: Apache-2.0

config LP586X
	bool "LP586X LED matrix controller"
	default y
	depends on \
		DT_HAS_TI_LP5860_ENABLED || \
		DT_HAS_TI_LP5861_ENABLED || \
		DT_HAS_TI_LP5862_ENABLED || \
		DT_HAS_TI_LP5864_ENABLED || \
		DT_HAS_TI_LP5866_ENABLED || \
		DT_HAS_TI_LP5868_ENABLED
	select I2C
	help
	  Enable driver for the Texas Instruments LP586X I2C LED
	  matrix controllers. It supports: LP5860, LP5861, LP5862,
	  LP5864, LP5866 and LP5868.
```

## drivers/led/Kconfig.max7219
```kconfig
# Copyright (c) 2022 Jimmy Ou <yanagiis@gmail.com>
# SPDX-License-Identifier: Apache-2.0

DT_COMPAT_MAXIM_MAX7219 := maxim,max7219

menuconfig MAX7219
	bool "MAX7219 LED drivers"
	default $(dt_compat_enabled,$(DT_COMPAT_MAXIM_MAX7219))
	depends on SPI
	help
	  Enable driver for the Maxim MAX7219 SPI LED controllers.
	  It is supporting up to 64 individual LEDs.

config MAX7219_INITIALIZATION_DELAY
	int "MAX7219 initialization delay in milliseconds"
	depends on MAX7219
	default 0
	range 0 2147483647
	help
	  This option delays MAX7219 initialization for the specified
	  amount of milliseconds. This is used to allow MAX7219 get ready
	  before initialing.
```
