## drivers/led/Kconfig.modulino
```kconfig
# Copyright (c) 2025 Google, LLC
# SPDX-License-Identifier: Apache-2.0

config MODULINO_BUTTONS_LEDS
	bool "Arduino Modulino buttons LEDs"
	default y
	depends on DT_HAS_ARDUINO_MODULINO_BUTTONS_LEDS_ENABLED
	select I2C
	help
	  Enable driver Arduino Modulino Buttons LEDs.
```

## drivers/led/Kconfig.ncp5623
```kconfig
# Copyright (c) 2023 NXP Semiconductors
# Copyright (c) 2023 Cognipilot Foundation
# SPDX-License-Identifier: Apache-2.0

config NCP5623
	bool "NCP5623 LED driver"
	default y
	depends on DT_HAS_ONNN_NCP5623_ENABLED
	select I2C
	help
	  Enable driver for the Onsemi NCP5623 I2C LED controller.
	  The controller and the driver support two hardware configurations:
	   - one three-channel (RGB) LED
	   - or three single-channel LEDs
```

## drivers/led/Kconfig.npm10xx
```kconfig
# Copyright (c) 2026 Nordic Semiconductor ASA
# SPDX-License-Identifier: Apache-2.0

config LED_NPM10XX
	bool "nPM10xx LED driver"
	default y
	depends on DT_HAS_NORDIC_NPM10XX_LED_ENABLED
	select I2C
	help
	  Enable the nPM10xx LED driver.
```

## drivers/led/Kconfig.npm13xx
```kconfig
# Copyright (c) 2023 Nordic Semiconductor ASA
# SPDX-License-Identifier: Apache-2.0

config LED_NPM13XX
	bool "nPM13xx LED driver"
	default y
	depends on DT_HAS_NORDIC_NPM1300_LED_ENABLED || DT_HAS_NORDIC_NPM1304_LED_ENABLED
	select I2C
	select MFD
	help
	  Enable the nPM13xx LED driver.
```

## drivers/led/Kconfig.pca9533
```kconfig
# Copyright (c) 2025 Van Petrosyan
# SPDX-License-Identifier: Apache-2.0

config PCA9533
	bool "PCA9533 LED driver"
	default y
	depends on DT_HAS_NXP_PCA9533_ENABLED
	select I2C
	help
	  Enable driver support for the NXP PCA9533 4-bit LED dimmer.
```

## drivers/led/Kconfig.pca953x
```kconfig
# Copyright (c) 2025 Van Petrosyan
# SPDX-License-Identifier: Apache-2.0

config PCA953X
	bool "PCA953x LED driver"
	default y
	depends on \
		DT_HAS_NXP_PCA9530_ENABLED || \
		DT_HAS_NXP_PCA9531_ENABLED || \
		DT_HAS_NXP_PCA9532_ENABLED || \
		DT_HAS_NXP_PCA9533_ENABLED
	select I2C
	help
	  Enable driver support for the NXP PCA953x LED dimmer series.
```

## drivers/led/Kconfig.pca9633
```kconfig
# Copyright (c) 2018 Savoir-Faire Linux
# SPDX-License-Identifier: Apache-2.0

config PCA9633
	bool "PCA9633 LED driver"
	default y
	depends on DT_HAS_NXP_PCA9633_ENABLED
	select I2C
	help
	  Enable LED driver for PCA9633.

	  PCA9633 LED driver has 4 channels each with multi-programmable
	  states. Each channel can drive up to 25 mA per LED.
```

## drivers/led/Kconfig.pca9956
```kconfig
# Copyright (c) 2022 Esco Medical Aps
# SPDX-License-Identifier: Apache-2.0

config PCA9956
	bool "PCA9956 LED driver"
	depends on I2C
	help
	  Enable LED driver for PCA9956.

	  PCA9956 LED driver has 24 channels each with multi-programmable
	  states. Each channel can drive up to 57 mA per LED.
```

## drivers/led/Kconfig.pca_common
```kconfig
# Copyright (c) 2018 Savoir-Faire Linux
# SPDX-License-Identifier: Apache-2.0

config PCA_COMMON
	bool "Driver for PCA LED drivers family"
	depends on I2C
	help
	  Enable driver for PCA LED drivers family.
	  Supports PCA9633 with 4 channels.
```

## drivers/led/Kconfig.pico_w
```kconfig
# Copyright (c) 2025 Beechwoods Software, Inc.
# SPDX-License-Identifier: Apache-2.0

config LED_PICO_W
	bool "Pico W LED driver"
	default y
	depends on DT_HAS_RASPBERRYPI_PICO_W_ENABLED
	depends on NETWORKING
	depends on WIFI
	depends on CYW43439
	help
	  Enable support for Pico W LED controllers.
```

## drivers/led/Kconfig.pwm
```kconfig
# Copyright (c) 2020 Seagate Technology LLC
# SPDX-License-Identifier: Apache-2.0

config LED_PWM
	bool "PWM LED driver"
	default y
	depends on DT_HAS_PWM_LEDS_ENABLED
	select PWM
	help
	  Enable driver for PWM LEDs.
```

## drivers/led/Kconfig.rgb
```kconfig
# Copyright (c) 2023 Prevas A/S
# SPDX-License-Identifier: Apache-2.0

config LED_RGB
	bool "RGB LED driver"
	default y
	depends on LED && DT_HAS_RGB_LEDS_ENABLED
	help
	  Enable driver for emulating one RGB LED, using three individual LEDs.

if LED_RGB

config LED_RGB_INIT_PRIORITY
	int "RGB LED init priority"
	default 91
	range 0 99
	help
	  RGB led initialization priority. Must initialize after the individual LED drivers

endif
```

## drivers/led/Kconfig.sct2024
```kconfig
# Copyright (c) 2025 Hubert Miś
# SPDX-License-Identifier: Apache-2.0

config LED_SCT2024
	bool "SCT2024 LED controller support"
	default y
	depends on DT_HAS_SCT_SCT2024_ENABLED
	select SPI
	help
	  This option enables support for the SCT2024 LED controller driver.
	  The SCT2024 is a 16-channel constant current LED driver that
	  communicates over SPI.
```

## drivers/led/Kconfig.tlc59108
```kconfig
# Copyright (c) 2021 Sky Hero SA
# SPDX-License-Identifier: Apache-2.0

config TLC59108
	bool "TLC59108 LED driver"
	default y
	depends on DT_HAS_TI_TLC59108_ENABLED
	select I2C
	help
	  Enable LED driver for TLC59108.
```

## drivers/led/Kconfig.tlc59116
```kconfig
# Copyright (c) 2025 Tridonic GmbH & Co KG
#
# SPDX-License-Identifier: Apache-2.0

config TLC59116
	bool "TLC59116 LED driver"
	default y
	depends on DT_HAS_TI_TLC59116_ENABLED
	depends on I2C
	help
	  Enable LED driver for TLC59116.
```

## drivers/led/Kconfig.xec
```kconfig
# Copyright (c) 2022 Microchip Technology Inc.
# SPDX-License-Identifier: Apache-2.0

config LED_XEC
	bool "Microchip XEC BB-LED driver"
	default y
	depends on DT_HAS_MICROCHIP_XEC_BBLED_ENABLED
	select PINCTRL
	help
	  Enable driver for the Microchip XEC Breathing-Blinking
	  LED controller for MEC15xx and MEC172x
```

## drivers/led/is31fl3194/Kconfig
```kconfig
# Copyright 2022 Benjamin Björnsson <benjamin.bjornsson@gmail.com>.
# SPDX-License-Identifier: Apache-2.0

config IS31FL3194
	bool "IS31FL3194 LED controller"
	depends on (I2C && LED)
	help
	  Enable driver for the Lumissil IS31FL3194 I2C LED
	  controllers supporting up to 3 LEDs.
```

## drivers/led_matrix/Kconfig
```kconfig
# SPDX-License-Identifier: Apache-2.0

source "drivers/led_matrix/arduino_uno_q/Kconfig.uno_q"

config LED_MATRIX
	bool "LED Matrix drivers"
	help
	  Enable LED matrix drivers.
```

## drivers/led_matrix/arduino_uno_q/Kconfig.uno_q
```kconfig
# Copyright (c) 2026 Shankar Sridhar
# SPDX-License-Identifier: Apache-2.0

menuconfig LED_MATRIX
	bool "LED Matrix drivers"
	help
	  Enable LED matrix drivers.

if LED_MATRIX

config LED_MATRIX_UNO_Q
	bool "Arduino UNO Q LED Matrix Driver"
	depends on DT_HAS_ARDUINO_UNO_Q_LEDMATRIX_ENABLED
	depends on GPIO
	help
		Enable driver for the Arduino UNO Q onboard 8x13 LED matrix.
	  	Provides a display_api-compatible interface using a packed binary
	  	buffer format.

if LED_MATRIX_UNO_Q

config LED_MATRIX_UNO_Q_PIXEL_PERIOD_US
	int "UNO_Q LED matrix pixel period (microseconds)"
	default 100
	range 50 500
	help
	  Duration in microseconds for which each column is illuminated
	  during one scan cycle. Lower values increase refresh rate but
	  reduce per-pixel brightness. Higher values increase brightness
	  but may introduce visible flicker.
	  Minimum: 50 us. Maximum: 500 us. Default: 100 us.

config LED_MATRIX_UNO_Q_INIT_PRIORITY
	int "UNO_Q LED Matrix initialization priority"
	default 90
	help
	  Must be higher (later) than the GPIO driver priority so that
	  GPIO is available when the matrix driver initializes.

config CONFIG_LED_MATRIX_UNO_Q_LOG_LEVEL
	int "LED Matrix Driver Log level"
	depends on LOG
	default 3
	range 0 4
	help
	  Sets log level for the LED matrix driver.
	  Levels are:
	  0 OFF
	  1 ERROR
	  2 WARNING
	  3 INFO
	  4 DEBUG

module = LED_MATRIX_UNO_Q
module-str = led_matrix_uno_q
source "subsys/logging/Kconfig.template.log_config"

endif # LED_MATRIX_UNO_Q

endif # LED_MATRIX
```

## drivers/led_strip/Kconfig
```kconfig
# Top-level configuration file for LED strip drivers.

# Copyright (c) 2017 Linaro Limited
# Copyright (c) 2018 Intel Corporation
# SPDX-License-Identifier: Apache-2.0

menuconfig LED_STRIP
	bool "LED strip drivers"
	help
	  Include LED strip drivers in the system configuration.

if LED_STRIP

module = LED_STRIP
module-str = LED strip
source "subsys/logging/Kconfig.template.log_config"

config LED_STRIP_INIT_PRIORITY
	int "LED strip initialization priority"
	default 90
	help
	  System initialization priority for LED strip drivers.

# Hidden option. The extra byte enables efficient serialization and transmission
# for drivers which require 4 B on wire for every 3 B of color, e.g. APA102, but
# is not normally needed.
config LED_STRIP_RGB_SCRATCH
	bool

source "drivers/led_strip/Kconfig.lpd880x"

source "drivers/led_strip/Kconfig.ws2812"

source "drivers/led_strip/Kconfig.apa102"

source "drivers/led_strip/Kconfig.tlc5971"

endif # LED_STRIP
```

## drivers/led_strip/Kconfig.apa102
```kconfig
#
# Copyright (c) 2018 Google LLC.
#
# SPDX-License-Identifier: Apache-2.0
#

config APA102_STRIP
	bool "APA102 SPI LED strip driver"
	default y
	depends on DT_HAS_APA_APA102_ENABLED
	select SPI if $(dt_compat_on_bus,$(DT_COMPAT_APA_APA102),spi)
	select LED_STRIP_RGB_SCRATCH
	help
	  Enable the LED strip driver for a chain of APA102 RGB LEDs.
	  These are sold as DotStar by Adafruit and Superled by others.
```

## drivers/led_strip/Kconfig.fake
```kconfig
# Fake LED strip configuration options

# Copyright (c) 2025 Gielen De Maesschalck <gielen.de.maesschalck@gmail.com>
# SPDX-License-Identifier: Apache-2.0

config FAKE_LED_STRIP
	bool "Fake LED strip driver"
	default y
	depends on DT_HAS_ZEPHYR_FAKE_LED_STRIP_ENABLED
	help
	  Enable support for the FFF-based fake led strip driver.
```

## drivers/led_strip/Kconfig.lpd880x
```kconfig
#
# Copyright (c) 2017 Linaro Limited
#
# SPDX-License-Identifier: Apache-2.0
#

config LPD880X_STRIP
	bool "Enable LPD880x SPI LED strip driver"
	depends on SPI
	help
		Enable LED strip driver for daisy chains of LPD880x
		(LPD8803, LPD8806, or compatible) devices.

		Each LPD880x LED driver chip has some output channels
		(3 channels for LPD8803, 6 for LPD8806), whose PWM
		duty cycle can be set at 7 bit resolution via a
		reduced SPI interface (MOSI and CLK lines only).
		Each chip also includes data and clock out pins for
		daisy chaining LED strips.
```

## drivers/led_strip/Kconfig.modulino
```kconfig
# Copyright (c) 2025 Google, LLC
# SPDX-License-Identifier: Apache-2.0

config MODULINO_PIXELS
	bool "Arduino Modulino Pixels"
	default y
	depends on DT_HAS_ARDUINO_MODULINO_PIXELS_ENABLED
	select I2C
	help
	  Enable driver Arduino Modulino Pixels.
```

## drivers/led_strip/Kconfig.rpi_pico
```kconfig
# Copyright (c) 2024 TOKITA Hiroshi
#
# SPDX-License-Identifier: Apache-2.0

config RASPBERRYPI_PICO_WS2812_CONTROLLER_PIO
	bool "Raspberry Pi Pico PIO based WS2812 controller"
	default y
	depends on DT_HAS_RASPBERRYPI_PICO_WS2812_CONTROLLER_PIO_ENABLED
	select PICOSDK_USE_PIO
	help
	  Use the PIO as WS2812 LED strip controller
```
