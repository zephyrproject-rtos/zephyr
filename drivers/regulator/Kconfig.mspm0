## drivers/regulator/Kconfig.mspm0
```kconfig
# Copyright (c) 2026, Linumiz
# SPDX-License-Identifier: Apache-2.0

config REGULATOR_MSPM0_VREF
	bool "TI MSPM0 VREF peripheral driver"
	depends on REGULATOR
	depends on DT_HAS_TI_MSPM0_VREF_ENABLED
	default y
	select USE_MSPM0_DL_VREF
	help
	  Enable the MSPM0 VREF driver

config REGULATOR_MSPM0_VREF_INIT_PRIORITY
	int "MSPM0 VREF peripheral driver init priority"
	default KERNEL_INIT_PRIORITY_DEVICE
	depends on REGULATOR_MSPM0_VREF
	help
	  Init priority for the MSPM0 VREF peripheral.
```

## drivers/regulator/Kconfig.npm1100
```kconfig
# Copyright (c) 2023 Nordic Semiconductor ASA
# SPDX -License-Identifier: Apache-2.0

config REGULATOR_NPM1100
	bool "nPM1100 PMIC regulator driver"
	default y
	depends on DT_HAS_NORDIC_NPM1100_ENABLED
	help
	  Enable the Nordic nPM1100 PMIC regulator driver

config REGULATOR_NPM1100_INIT_PRIORITY
	int "nPM1100 regulator driver init priority"
	default KERNEL_INIT_PRIORITY_DEVICE
	depends on REGULATOR_NPM1100
	help
	  Init priority for the Nordic nPM1100 regulator driver.
```

## drivers/regulator/Kconfig.npm1300
```kconfig
# Copyright (c) 2023 Nordic Semiconductor ASA
# SPDX -License-Identifier: Apache-2.0

config REGULATOR_NPM1300
	bool "nPM1300 PMIC regulator driver"
	default y
	depends on DT_HAS_NORDIC_NPM1300_REGULATOR_ENABLED
	select I2C
	select MFD
	help
	  Enable the Nordic nPM1300 PMIC regulator driver

if REGULATOR_NPM1300

config REGULATOR_NPM1300_COMMON_INIT_PRIORITY
	int "nPM1300 regulator driver init priority (common part)"
	default 75
	help
	  Init priority for the Nordic nPM1300 regulator driver (common part).
	  It must be greater than I2C init priority.

config REGULATOR_NPM1300_INIT_PRIORITY
	int "nPM1300 regulator driver init priority"
	default 76
	help
	  Init priority for the Nordic nPM1300 regulator driver. It must be
	  greater than REGULATOR_NPM1300_COMMON_INIT_PRIORITY.

endif
```

## drivers/regulator/Kconfig.npm13xx
```kconfig
# Copyright (c) 2023 Nordic Semiconductor ASA
# SPDX-License-Identifier: Apache-2.0

config REGULATOR_NPM13XX
	bool "nPM13xx PMIC regulator driver"
	default y
	depends on DT_HAS_NORDIC_NPM1300_REGULATOR_ENABLED || DT_HAS_NORDIC_NPM1304_REGULATOR_ENABLED
	select I2C
	select MFD
	help
	  Enable the Nordic nPM13xx PMIC regulator driver

if REGULATOR_NPM13XX

config REGULATOR_NPM13XX_COMMON_INIT_PRIORITY
	int "nPM13xx regulator driver init priority (common part)"
	default 85
	help
	  Init priority for the Nordic nPM13xx regulator driver (common part).
	  It must be greater than I2C init priority.

config REGULATOR_NPM13XX_INIT_PRIORITY
	int "nPM13xx regulator driver init priority"
	default 86
	help
	  Init priority for the Nordic nPM13xx regulator driver. It must be
	  greater than REGULATOR_NPM13XX_COMMON_INIT_PRIORITY.

endif
```

## drivers/regulator/Kconfig.npm2100
```kconfig
# Copyright (c) 2024 Nordic Semiconductor ASA
# SPDX-License-Identifier: Apache-2.0

config REGULATOR_NPM2100
	bool "nPM2100 PMIC regulator driver"
	default y
	depends on DT_HAS_NORDIC_NPM2100_REGULATOR_ENABLED
	select I2C
	select MFD
	help
	  Enable the Nordic nPM2100 PMIC regulator driver

if REGULATOR_NPM2100

config REGULATOR_NPM2100_COMMON_INIT_PRIORITY
	int "nPM2100 regulator driver init priority (common part)"
	default 85
	help
	  Init priority for the Nordic nPM2100 regulator driver (common part).
	  It must be greater than I2C init priority.

config REGULATOR_NPM2100_INIT_PRIORITY
	int "nPM2100 regulator driver init priority"
	default 86
	help
	  Init priority for the Nordic nPM2100 regulator driver. It must be
	  greater than REGULATOR_NPM2100_COMMON_INIT_PRIORITY.

endif
```

## drivers/regulator/Kconfig.npm6001
```kconfig
# Copyright (c) 2022 Nordic Semiconductor ASA
# SPDX -License-Identifier: Apache-2.0

config REGULATOR_NPM6001
	bool "nPM6001 PMIC regulator driver"
	default y
	depends on DT_HAS_NORDIC_NPM6001_REGULATOR_ENABLED
	select I2C
	select MFD
	help
	  Enable the Nordic nPM6001 PMIC regulator driver

config REGULATOR_NPM6001_INIT_PRIORITY
	int "nPM6001 regulator driver init priority"
	default 76
	depends on REGULATOR_NPM6001
	help
	  Init priority for the Nordic nPM6001 regulator driver.
```

## drivers/regulator/Kconfig.nrf54l
```kconfig
# Copyright (c) 2025 Nordic Semiconductor ASA
# SPDX-License-Identifier: Apache-2.0

config REGULATOR_NRF54L
	bool "nRF54L regulator driver"
	default y
	depends on DT_HAS_NORDIC_NRF54L_REGULATORS_ENABLED

if REGULATOR_NRF54L

config REGULATOR_NRF54L_HIBERNATE_MIN_UPTIME_MS
	int "Minimum uptime before permitting system hibernate"
	default 1000
	help
	  When entering system hibernate, the debugger will be
	  disconnected. This guard prevents the SoC from entering
	  system hibernate before a debugger can be connected.
	  For production, this guard should be kept at a minimum
	  to preserve power.

endif # REGULATOR_NRF54L
```

## drivers/regulator/Kconfig.nrf_vregusb
```kconfig
# Copyright Nordic Semiconductor ASA
# SPDX-License-Identifier: Apache-2.0

config REGULATOR_NRF_VREGUSB
	bool "Nordic USB VBUS regulator driver"
	default y
	depends on DT_HAS_NORDIC_VREGUSB_REGULATOR_ENABLED
	help
	  Enable Nordic USB VBUS regulator driver.

config REGULATOR_NRF_VREGUSB_INIT_PRIORITY
	int "Nordic VBUS regulator driver init priority"
	default KERNEL_INIT_PRIORITY_DEVICE
	depends on REGULATOR_NRF_VREGUSB
	help
	  Init priority for the Nordic USB VBUS regulator driver.
```

## drivers/regulator/Kconfig.nxp_vref
```kconfig
# Copyright 2023 NXP
# SPDX-License-Identifier: Apache-2.0

config REGULATOR_NXP_VREF
	bool "NXP VREF peripheral driver"
	default y
	depends on DT_HAS_NXP_VREF_ENABLED
	help
	  Enable the NXP VREF driver

config REGULATOR_NXP_VREF_INIT_PRIORITY
	int "NXP VREF peripheral driver init priority"
	default 45
	depends on DT_HAS_NXP_VREF_ENABLED
	help
	  Init priority for the NXP VREF peripheral.
```

## drivers/regulator/Kconfig.nxp_vrefv1
```kconfig
# Copyright 2025 NXP
# SPDX-License-Identifier: Apache-2.0

config REGULATOR_NXP_VREFV1
	bool "NXP VREF peripheral driver"
	default y
	depends on DT_HAS_NXP_VREFV1_ENABLED
	help
	  Enable the NXP VREF driver

config REGULATOR_NXP_VREFV1_INIT_PRIORITY
	int "NXP VREF peripheral driver init priority"
	default 45
	depends on REGULATOR_NXP_VREFV1
	help
	  Init priority for the NXP VREF peripheral.

config REGULATOR_NXP_VREFV1_READY_TIMEOUT_MS
	int "NXP VREF ready timeout (ms)"
	default 10
	depends on REGULATOR_NXP_VREFV1
	help
	  Timeout in milliseconds to wait for the VREF
	  to become ready.
```

## drivers/regulator/Kconfig.pca9420
```kconfig
# Copyright (c) 2021, NXP
# SPDX-License-Identifier: Apache-2.0

config REGULATOR_PCA9420
	bool "NXP PCA9420 PMIC regulator driver"
	default y
	depends on DT_HAS_NXP_PCA9420_ENABLED
	select I2C
	help
	  Enable the NXP PCA9420 PMIC regulator driver

if REGULATOR_PCA9420

config REGULATOR_PCA9420_COMMON_INIT_PRIORITY
	int "NXP PCA9420 regulator driver init priority (common part)"
	default 75
	help
	  Init priority for the NXP PCA9420 regulator driver (common part). It
	  must be greater than I2C init priority.

config REGULATOR_PCA9420_INIT_PRIORITY
	int "NXP PCA9420 regulator driver init priority"
	default 76
	help
	  Init priority for the NXP PCA9420 regulator driver. It must be
	  greater than REGULATOR_PCA9420_COMMON_INIT_PRIORITY.

endif
```

## drivers/regulator/Kconfig.pf1550
```kconfig
# Copyright (c) 2024 Arduino SA
# SPDX-License-Identifier: Apache-2.0

config REGULATOR_PF1550
	bool "NXP PF1550 PMIC regulator driver"
	default y
	depends on DT_HAS_NXP_PF1550_REGULATOR_ENABLED
	select I2C
	select MFD
	help
	  Enable the NXP PF1550 PMIC regulator driver
```

## drivers/regulator/Kconfig.pmic
```kconfig
# Copyright (c) 2021, NXP
# SPDX -License-Identifier: Apache-2.0

config REGULATOR_PMIC
	bool "PMIC Regulator Driver"
	default y
	depends on DT_HAS_REGULATOR_PMIC_ENABLED
	select I2C
	help
	  Enable the pmic regulator driver

config PMIC_REGULATOR_INIT_PRIORITY
	int "Regulator Init priority"
	depends on REGULATOR_PMIC
	default 75
	help
	  I2C based regulator init priority.
	  Must be greater than KERNEL_INIT_PRIORITY_DEVICE so I2C is initialized,
	  and less than SDMMC_INIT_PRIORITY, since the SDMMC driver uses an I2C
	  PMIC regulator
```

## drivers/regulator/Kconfig.rts5817
```kconfig
# Copyright (c) 2026 Realtek Semiconductor, Inc.
# SPDX-License-Identifier: Apache-2.0

config REGULATOR_RTS5817
	bool "RTS5817 Regulator Driver"
	default y
	depends on DT_HAS_REALTEK_RTS5817_REGULATOR_ENABLED
	help
	  This option enables the regulator driver for RTS5817.

if REGULATOR_RTS5817

config REGULATOR_RTS5817_INIT_PRIORITY
	int "RTS5817 regulator driver init priority"
	default 80
	help
	  Init priority for the RTS5817 regulator driver.

endif
```

## drivers/regulator/Kconfig.sf32lb
```kconfig
# Copyright (c) 2025 SiFli Technologies(Nanjing) Co., Ltd
# SPDX-License-Identifier: Apache-2.0

config REGULATOR_SF32LB_LDO
	bool "SiFli SF32LB series internal LDO regulator driver"
	default y
	depends on DT_HAS_SIFLI_SF32LB52X_LDO_ENABLED
	help
	  Enable support for the SF32LB52x internal peripheral LDOs:
	  - LDO18: 1.8V for PSRAM (VDDSIP)
	  - LDO2_3V3: 3.3V for peripherals
	  - LDO3_3V3: 3.3V for peripherals

config REGULATOR_SF32LB_LDO_INIT_PRIORITY
	int "SF32LB LDO regulator init priority"
	default 20
	depends on REGULATOR_SF32LB_LDO
	help
	  Init priority for SF32LB LDO regulator. Must be lower than
	  drivers that depend on it (like PSRAM).
```

## drivers/regulator/Kconfig.stm32_vrefbuf
```kconfig
# Copyright 2025 CodeWrights GmbH
# SPDX-License-Identifier: Apache-2.0

config REGULATOR_STM32_VREFBUF
	bool "STM32 VREFBUF regulator driver"
	default y
	depends on DT_HAS_ST_STM32_VREFBUF_ENABLED
	help
	  Enable the STM32 VREFBUF regulator driver.

if REGULATOR_STM32_VREFBUF

config REGULATOR_STM32_VREFBUF_INIT_PRIORITY
	int "STM32 VREFBUF regulator driver init priority"
	default 45
	help
	  Init priority for the STM32 VREFBUF regulator driver.

config REGULATOR_STM32_SOFTWARE_TRIM
	bool "Software copy of trimming data from OTP"
	default y
	depends on $(dt_compat_any_has_prop,$(DT_COMPAT_ST_STM32_VREFBUF),nvmem-cells)
	depends on NVMEM
	help
	  Copy trimming data from OTP in software when changing voltage range.

	  On some series (such as STM32WB), trimming data is not automatically
	  loaded by hardware from OTP when changing voltage range; in this case,
	  this option should be enabled to ensure correct VREFBUF output voltage.

	  The `VREFBUF trimming` section of the VREFBUF chapter in Reference Manuals
	  indicates whether or not trimming data is loaded automatically by hardware.

endif # REGULATOR_STM32_VREFBUF
```

## drivers/regulator/Kconfig.tps55287
```kconfig
# SPDX-FileCopyrightText: Copyright The Zephyr Project Contributors
# SPDX-License-Identifier: Apache-2.0

config REGULATOR_TPS55287
	bool "TPS55287 regulator driver"
	default y
	depends on DT_HAS_TI_TPS55287_ENABLED
	select I2C
	help
	  Enable support for the TPS55287 regulator.

if REGULATOR_TPS55287

config REGULATOR_TPS55287_INIT_PRIORITY
	int "TPS55287 regulator driver init priority"
	default I2C_INIT_PRIORITY
	help
	  Init priority for the TPS55287 regulator driver. This must be higher
	  or equal to the parent I2C bus init priority.

endif
```

## drivers/remoteproc/Kconfig
```kconfig
# Copyright (c) 2026 Simon Maurer <mail@maurer.systems>
# SPDX-License-Identifier: Apache-2.0

menuconfig REMOTEPROC
	bool "OpenAMP RemoteProc device driver"
	help
	  Enable support for the OpenAMP Remote Processor (RemoteProc)
	  device driver.

if REMOTEPROC

config OPENAMP_RESOURCE_TABLE
	bool "OpenAMP resource table support"
	imply OPENAMP
	default y
	depends on DT_HAS_OPENAMP_RESOURCE_TABLE_ENABLED
	help
	  Include the OpenAMP resource table in the generated binary.

	  The resource table is used by the Linux remoteproc framework
	  and the OpenAMP library to describe shared resources such as
	  memory regions and virtio devices.

config OPENAMP_RPMSG_VDEV
	bool "OpenAMP RPMsg VirtIO device"
	imply OPENAMP
	default y
	depends on DT_HAS_OPENAMP_RPMSG_VIRTIO_DEVICE_ENABLED
	help
	  Enable the driver for the OpenAMP RPMsg VirtIO device.

config RPMSG_VDEV_INIT_PRIORITY
	int "RPMsg VirtIO device init priority"
	default 40
	depends on OPENAMP_RPMSG_VDEV
	help
	  Initialization priority of the RPMsg VirtIO device driver.

config RPMSG_VDEV_THREAD_STACK_SIZE
	int "RPMsg VirtIO thread stack size"
	default 2048
	depends on OPENAMP_RPMSG_VDEV
	help
	  Stack size (in bytes) used by the internal RPMsg VirtIO
	  driver thread.

config RPMSG_VDEV_THREAD_PRIORITY
	int "RPMsg VirtIO thread priority"
	default 8
	depends on OPENAMP_RPMSG_VDEV
	help
	  Thread priority of the RPMsg VirtIO driver thread.

module = RPROC
module-str = rproc
source "subsys/logging/Kconfig.template.log_config"

endif # REMOTEPROC
```

## drivers/renesas_ra_lpm/Kconfig
```kconfig
#
# Copyright (c) 2024 MUNIC SA
#
# SPDX-License-Identifier: Apache-2.0
#

# Top-level configuration file for Renesas LPM drivers.

menuconfig RENESAS_RA_LPM
	bool "Renesas RA Low Power Module drivers"
	help
	  Include LPM drivers in the system configuration.

if RENESAS_RA_LPM

module = RENESAS_RA_LPM
module-str = renesas_ra_lpm
source "subsys/logging/Kconfig.template.log_config"

source "drivers/renesas_ra_lpm/Kconfig.renesas_ra2"

endif
```

## drivers/renesas_ra_lpm/Kconfig.renesas_ra2
```kconfig
# Copyright (c) 2023-2024 MUNIC SA
# SPDX-License-Identifier: Apache-2.0

config RENESAS_RA_LPM_RA2
	bool
	depends on DT_HAS_RENESAS_RA2_LPM_ENABLED
	default y
```

## drivers/reset/Kconfig
```kconfig
# Reset Controller driver configuration options

# Copyright (c) 2022 Andrei-Edward Popa <andrei.popa105@yahoo.com>
# SPDX-License-Identifier: Apache-2.0

#
# Reset Controller options
#
menuconfig RESET
	bool "Reset controller drivers"
	help
	  Reset Controller drivers. Reset node represents a region containing
	  information about reset controller device. The typical use-case is
	  for some other node's drivers to acquire a reference to the reset
	  controller node together with some reset information.

if RESET

config RESET_INIT_PRIORITY
	int "Reset controller driver init priority"
	default 35
	help
	  This option controls the priority of the reset controller device
	  initialization. Higher priority ensures that the device is
	  initialized earlier in the startup cycle. If unsure, leave at default
	  value

comment "Reset controller Drivers"

# zephyr-keep-sorted-start
rsource "Kconfig.aspeed"
rsource "Kconfig.focaltech"
rsource "Kconfig.gd32"
rsource "Kconfig.intel_socfpga"
rsource "Kconfig.lpc_syscon"
rsource "Kconfig.mchp"
rsource "Kconfig.mchp_mss"
rsource "Kconfig.mmio"
rsource "Kconfig.npcx"
rsource "Kconfig.numaker"
rsource "Kconfig.nxp_mrcc"
rsource "Kconfig.nxp_rstctl"
rsource "Kconfig.rpi_pico"
rsource "Kconfig.rts5817"
rsource "Kconfig.sf32lb"
rsource "Kconfig.stm32"
# zephyr-keep-sorted-stop

endif # RESET
```

## drivers/reset/Kconfig.aspeed
```kconfig
# Copyright (c) 2022 ASPEED Technology Inc.
# SPDX-License-Identifier: Apache-2.0

config RESET_AST10X0
	bool "ASPEED reset driver"
	default y
	depends on DT_HAS_ASPEED_AST10X0_RESET_ENABLED
	help
	  This option enables the reset driver for ASPEED AST10X0 series SOC.
```

## drivers/reset/Kconfig.at32
```kconfig
# Copyright (c) 2022 Teslabs Engineering S.L.
# SPDX-License-Identifier: Apache-2.0

config RESET_AT32
	bool "AT32 Reset Controller Driver"
	default y
	depends on DT_HAS_AT_AT32_RCTL_ENABLED
```

## drivers/reset/Kconfig.ch32
```kconfig
# Copyright (c) 2025 Fiona Behrens
# SPDX-License-Identifier: Apache-2.0

config RESET_WCH_CH32
	bool "CH32 Reset Controller Driver"
	default y
	depends on DT_HAS_WCH_CH32_RCC_RCTL_ENABLED
```
