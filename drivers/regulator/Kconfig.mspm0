## drivers/reset/Kconfig.focaltech
```kconfig
# Copyright (c) 2025, FocalTech Systems CO.,Ltd
# SPDX-License-Identifier: Apache-2.0

config RESET_FOCALTECH_FT9001
	bool "FocalTech FT9001 Reset Control Module driver"
	default y
	depends on DT_HAS_FOCALTECH_FT9001_CPM_RCTL_ENABLED
	help
	  Enable reset control driver for FocalTech FT9001 SoC.
	  This driver provides support for controlling peripheral
	  resets through the Reset Control Module which manages
	  reset signals for various on-chip peripherals including
	  UART, SPI, I2C, CAN, USB, crypto engines, and memory
	  controllers.
```
