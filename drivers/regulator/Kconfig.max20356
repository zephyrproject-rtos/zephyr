## drivers/regulator/Kconfig.max20356
```kconfig
# Copyright (c) 2026 Analog Devices, Inc.
# SPDX-License-Identifier: Apache-2.0

config REGULATOR_MAX20356
	bool "MAX20356/MAX20358 PMIC regulator driver"
	default y
	depends on DT_HAS_ADI_MAX20356_REGULATOR_ENABLED
	select MFD
	help
	  Enable the Analog Devices MAX20356/MAX20358 PMIC regulator driver.
	  Each rail (buck1-3, buck-boost, ldo1-4, lsw1-3) is a devicetree child
	  node driven through the MAX20356 MFD parent.

if REGULATOR_MAX20356

config REGULATOR_MAX20356_SPI_DVS
	bool "MAX20356 SPI Support for Regulator DVS configuration"
	default y
	select SPI
	depends on $(dt_compat_any_has_prop,$(DT_COMPAT_ADI_MAX20356), spi-dvs) || \
		$(dt_compat_any_has_prop,$(DT_COMPAT_ADI_MAX20358), spi-dvs)
	help
	  Enable SPI for DVS control configuration.

config REGULATOR_MAX20356_COMMON_INIT_PRIORITY
	int "MAX20356 regulator driver init priority (common part)"
	default 86
	help
	  Init priority for the MAX20356/MAX20358 regulator driver (common
	  part). It must be greater than the MFD parent init priority.

config REGULATOR_MAX20356_INIT_PRIORITY
	int "MAX20356 regulator driver init priority"
	default 87
	help
	  Init priority for the MAX20356/MAX20358 regulator rails. It must be
	  greater than REGULATOR_MAX20356_COMMON_INIT_PRIORITY.

endif # REGULATOR_MAX20356
```

## drivers/regulator/Kconfig.max20362
```kconfig
# Copyright (c) 2025 Analog Devices Inc.
# SPDX-License-Identifier: Apache-2.0

config REGULATOR_MAX20362
	bool "MAX20362 PMIC regulator device driver"
	default y
	depends on DT_HAS_ADI_MAX20362_REGULATOR_ENABLED
	select I2C
	help
	  Enable the Analog Devices MAX20362 PMIC regulator device driver

if REGULATOR_MAX20362

config REGULATOR_ADI_MAX20362_COMMON_INIT_PRIORITY
	int "MAX20362 regulator driver init priority (common part)"
	default 86
	help
	  Init priority for the ADI MAX20362 regulator driver
	  (common part). It must be greater than I2C init priority.

config REGULATOR_ADI_MAX20362_INIT_PRIORITY
	int "MAX20362 regulator driver init priority"
	default 87
	help
	  Init priority for the ADI MAX20362 regulator driver. It must be
	  greater than REGULATOR_ADI_MAX20362_COMMON_INIT_PRIORITY

endif
```

## drivers/regulator/Kconfig.npm10xx
```kconfig
# Copyright (c) 2026 Nordic Semiconductor
# SPDX-License-Identifier: Apache-2.0

config REGULATOR_NPM10XX
	bool "nPM10xx regulator driver"
	default y
	depends on DT_HAS_NORDIC_NPM10XX_REGULATOR_ENABLED && DT_HAS_NORDIC_NPM10XX_ENABLED
	select I2C
	select MFD
	help
	  Enable the Nordic nPM10xx regulator driver.

if REGULATOR_NPM10XX

config REGULATOR_NPM10XX_COMMON_INIT_PRIORITY
	int "nPM10xx regulator driver init priority (common part)"
	default 85
	help
	  Init priority for the Nordic nPM10xx regulator driver (common part).
	  It must be greater than MFD init priority.

config REGULATOR_NPM10XX_INIT_PRIORITY
	int "nPM10xx regulator driver init priority"
	default 86
	help
	  Init priority for the Nordic nPM10xx regulator driver. It must be
	  greater than REGULATOR_NPM10XX_COMMON_INIT_PRIORITY.

endif
```

## drivers/regulator/Kconfig.nxp_spc_bandgap
```kconfig
# SPDX-FileCopyrightText: Copyright 2026 NXP
# SPDX-License-Identifier: Apache-2.0

config REGULATOR_NXP_SPC_BANDGAP
	bool "NXP SPC bandgap buffer driver"
	default y
	depends on DT_HAS_NXP_SPC_BANDGAP_BUFFER_ENABLED
	help
	  Enable the NXP SPC buffered bandgap output driver.

config REGULATOR_NXP_SPC_BANDGAP_INIT_PRIORITY
	int "NXP SPC bandgap buffer driver init priority"
	default 45
	depends on REGULATOR_NXP_SPC_BANDGAP
	help
	  Init priority for the NXP SPC buffered bandgap output.
```

## drivers/regulator/Kconfig.pca9422
```kconfig
# Copyright 2025 NXP
# SPDX-License-Identifier: Apache-2.0

config REGULATOR_PCA9422
	bool "NXP PCA9422 PMIC regulator driver"
	default y
	depends on DT_HAS_NXP_PCA9422_REGULATOR_ENABLED
	select I2C
	select MFD
	help
	  Enable the NXP PCA9422 PMIC regulator driver

if REGULATOR_PCA9422

config REGULATOR_PCA9422_INIT_PRIORITY
	int "NXP PCA9422 regulator driver init priority"
	default MFD_INIT_PRIORITY
	help
	  Init priority for the NXP PCA9422 regulator driver.

endif
```

## drivers/regulator/Kconfig.rpi_pico
```kconfig
# Copyright (c) 2023 TOKITA Hiroshi <tokita.hiroshi@fujitsu.com>
# SPDX-License-Identifier: Apache-2.0

config REGULATOR_RPI_PICO
	bool "Raspberry Pi Pico regulator driver"
	default y
	depends on DT_HAS_RASPBERRYPI_CORE_SUPPLY_REGULATOR_ENABLED
	help
	  Enable support for the Raspberry Pi Pico regulator.

if REGULATOR_RPI_PICO

config REGULATOR_RPI_PICO_INIT_PRIORITY
	int "Raspberry Pi Pico regulator driver init priority"
	default 20
	help
	  Init priority for the Raspberry Pi Pico regulator driver.
	  Must precede clock control initialization when supplying the core
	  voltage required for higher clock frequencies.

endif
```

## drivers/regulator/Kconfig.stpmic1
```kconfig
# Copyright (c) 2026 STMicroelectronics
# SPDX-License-Identifier: Apache-2.0

config REGULATOR_STPMIC1
	bool "STMicroelectronics STPMIC1 PMIC regulator driver"
	default y
	depends on DT_HAS_ST_STPMIC1_ENABLED
	select I2C
	help
	  Enable the STMicroelectronics STPMIC1 PMIC regulator driver.

if REGULATOR_STPMIC1

config REGULATOR_STPMIC1_INIT_PRIORITY
	int "STPMIC1 regulator driver init priority"
	default 70
	help
	  Init priority for the STPMIC1 regulator driver. It cannot be lower
	  than the I2C init priority (50), which is the default so that the rails
	  are on before the devices they supply are initialized.

endif
```

## drivers/regulator/Kconfig.ti_tp6287x
```kconfig
# Copyright (c) 2026 Carl Zeiss Meditec AG
# SPDX-License-Identifier: Apache-2.0

config REGULATOR_TI_TPS6287X
	bool "TPS6287x regulator driver"
	default y
	depends on DT_HAS_TI_TPS6287X_ENABLED
	select I2C
	help
	  Enable support for the TPS6287x regulator.

if REGULATOR_TI_TPS6287X

config REGULATOR_TPS6287X_INIT_PRIORITY
	int "TPS6287x regulator driver init priority"
	default I2C_INIT_PRIORITY
	help
	  Init priority for the TPS6287x regulator driver. This must be higher
	  or equal to the parent I2C bus init priority.

endif
```

## drivers/regulator/Kconfig.tle927x
```kconfig
# SPDX-FileCopyrightText: Copyright (c) 2026 Deere & Company
# SPDX-FileCopyrightText: Copyright (c) 2026 Linumiz
# SPDX-License-Identifier: Apache-2.0

config REGULATOR_TLE927X
	bool "Infineon TLE927x SBC VCC2 regulator driver"
	default y
	depends on DT_HAS_INFINEON_TLE927X_VCC2_ENABLED
	depends on MFD_TLE927X
	select REGULATOR_THREAD_SAFE_REFCNT
	help
	  Enable the Infineon TLE927x SBC VCC2 regulator driver. The refcount is
	  made thread safe because the rail may be switched from more than one
	  thread context.

if REGULATOR_TLE927X

config REGULATOR_TLE927X_INIT_PRIORITY
	int "TLE927x regulator driver init priority"
	default 78
	help
	  Init priority for the TLE927x regulator driver. It must be strictly
	  greater than MFD_TLE927X_INIT_PRIORITY: any SPI command moves the SBC
	  from Init to Normal mode and the parent must own that transition.

endif # REGULATOR_TLE927X
```

## drivers/relay/Kconfig
```kconfig
# Copyright (c) 2026 Siemens AG
# SPDX-License-Identifier: Apache-2.0

menuconfig RELAY
	bool "Relay drivers [EXPERIMENTAL]"
	select EXPERIMENTAL
	help
	  Enable the relay driver class. Provides a hardware-agnostic on/off
	  relay output API implemented by backend drivers.

if RELAY

module = RELAY
module-str = relay
source "subsys/logging/Kconfig.template.log_config"

config RELAY_SHELL
	bool "Relay shell"
	depends on SHELL
	help
	  Enable shell commands to turn relays on and off and to read back their
	  state, for any relay device in the system.

source "drivers/relay/Kconfig.gpio"

endif # RELAY
```

## drivers/relay/Kconfig.gpio
```kconfig
# Copyright (c) 2026 Siemens AG
# SPDX-License-Identifier: Apache-2.0

config RELAY_GPIO
	bool "GPIO relay driver"
	default y
	depends on DT_HAS_ZEPHYR_GPIO_RELAY_ENABLED
	select GPIO
	help
	  Enable the GPIO relay driver. Implements the relay API for a relay
	  switched by a single GPIO.

if RELAY_GPIO

config RELAY_GPIO_INIT_PRIORITY
	int "GPIO relay init priority"
	default KERNEL_INIT_PRIORITY_DEVICE
	help
	  Device initialization priority for the GPIO relay. Must be greater than
	  or equal to the GPIO controller's init priority so the controller is
	  ready first.

endif # RELAY_GPIO
```

## drivers/relay/Kconfig.pwm
```kconfig
# Copyright (c) 2026 Siemens AG
# SPDX-License-Identifier: Apache-2.0

config RELAY_PWM
	bool "PWM relay driver"
	default y
	depends on DT_HAS_ZEPHYR_PWM_RELAY_ENABLED
	select PWM
	help
	  Enable the hardware-agnostic PWM relay driver. Implements the relay API
	  on top of a single standard Zephyr PWM channel and owns all relay state,
	  hold-level and pull-in/hold current-profile logic.

if RELAY_PWM

config RELAY_PWM_INIT_PRIORITY
	int "PWM relay init priority"
	default 91
	help
	  Device initialization priority for the PWM relay. Must be greater than
	  the PWM backend's init priority so the backend is ready first.

endif # RELAY_PWM
```

## drivers/reset/Kconfig.arm_scmi
```kconfig
# Copyright (c) 2026 EPAM Systems
# SPDX-License-Identifier: Apache-2.0

config RESET_ARM_SCMI
	bool "ARM SCMI reset driver"
	depends on ARM_SCMI_RESET_HELPERS
	default y
	help
	  Enable ARM SCMI reset driver based on Reset domain management protocol.

if RESET_ARM_SCMI

config RESET_ARM_SCMI_INIT_PRIORITY
	int "ARM SCMI Reset driver initialization priority"
	default 60 if ARM_SCMI_OPTEE_TRANSPORT
	default RESET_INIT_PRIORITY

endif # RESET_ARM_SCMI
```

## drivers/reset/Kconfig.py32
```kconfig
# SPDX-FileCopyrightText: Copyright The Zephyr Project Contributors
# SPDX-License-Identifier: Apache-2.0

config RESET_PY32
	bool "Puya PY32 reset driver"
	default y
	depends on DT_HAS_PUYA_PY32_RCC_RCTL_ENABLED
	help
	  Enable the reset driver for Puya PY32 microcontrollers.
```

## drivers/reset/Kconfig.rockchip
```kconfig
# Copyright (c) 2026 KylinSoft Corporation
# SPDX-License-Identifier: Apache-2.0

config RESET_ROCKCHIP_RK3588
	bool "Rockchip RK3588 CRU reset controller"
	default y
	depends on DT_HAS_ROCKCHIP_RK3588_CRU_RST_ENABLED
	help
	  Enable reset control for the Rockchip RK3588 CRU.
```

## drivers/reset/Kconfig.wch
```kconfig
# SPDX-FileCopyrightText: Copyright The Zephyr Project Contributors
# SPDX-License-Identifier: Apache-2.0

config RESET_WCH_CH32
	bool "CH32 Reset Controller Driver"
	default y
	depends on DT_HAS_WCH_CH32_RCC_RCTL_ENABLED
```

## drivers/retained_mem/Kconfig.rv3028
```kconfig
# Copyright (c) 2026 Janez Ugovsek <janez@ugovsek.info>
# SPDX-License-Identifier: Apache-2.0

config RETAINED_MEM_RV3028
	bool "Micro Crystal RV3028 user RAM driver"
	default y
	depends on DT_HAS_MICROCRYSTAL_RV3028_RAM_ENABLED
	depends on DT_HAS_MICROCRYSTAL_RV3028_ENABLED
	select MFD
	help
	  Enable the user RAM child driver for the Micro Crystal RV3028.
	  The two bytes of battery-backed user RAM are exposed through the
	  retained memory API.

config RETAINED_MEM_RV3028_INIT_PRIORITY
	int "RV3028 Retained mem initialization priority"
	depends on RETAINED_MEM_RV3028
	default 52
	help
	  Initialization priority for the Micro Crystal RV3028 retained
	  memory driver.
	  It must be later than the initialization priority of RV3028
	  MFD (parent) driver.
```

## drivers/rfid/Kconfig
```kconfig
# Copyright (c) 2026 Luke Bugbee <lbugbee@protonmail.com>
# SPDX-License-Identifier: Apache-2.0

# Top-level configuration file for RFID drivers.

menuconfig RFID
	bool "RFID drivers"
	help
	  Include RFID drivers in the system configuration.

if RFID

module = RFID
module-str = RFID
source "subsys/logging/Kconfig.template.log_config"

config RFID_INIT_PRIORITY
	int "RFID initialization priority"
	default 90
	help
	  System initialization priority for RFID drivers.

# zephyr-keep-sorted-start
source "drivers/rfid/mfrc522/Kconfig"
# zephyr-keep-sorted-stop

endif # RFID
```

## drivers/rfid/mfrc522/Kconfig
```kconfig
# Copyright (c) 2026 Luke Bugbee <lbugbee@protonmail.com>
# SPDX-License-Identifier: Apache-2.0

config MFRC522
	bool "MFRC522 RFID reader"
	default y
	select SPI
	select GPIO
	help
	  Enable thew MFRC522 driver.
```

## drivers/rtc/Kconfig.cc35xx
```kconfig
# Copyright (c) 2025 Conclusive Engineering Sp. z o.o.
# SPDX-License-Identifier: Apache-2.0

config RTC_TI_CC35XX
	bool "TI Simplelink cc35xx RTC driver"
	default y
	depends on DT_HAS_TI_CC35XX_RTC_TIMER_ENABLED
	help
	  TI Simplelink cc35xx Real-Time Clock (RTC) driver.

config RTC_TI_CC35XX_EPOCH_YEAR
	int "Epoch year for TI cc35xx RTC"
	default 2020
	depends on RTC_TI_CC35XX
	help
	  TI Simplelink cc35xx RTC driver epoch year.
```

## drivers/rtc/Kconfig.emul
```kconfig
# Copyright (c) 2022 Bjarki Arge Andreasen
# SPDX-License-Identifier: Apache-2.0

config RTC_EMUL
	bool "Emulated RTC driver"
	default y
	depends on DT_HAS_ZEPHYR_RTC_EMUL_ENABLED
	help
	  Enable emulated Real-Time Clock (RTC) driver.

if RTC_EMUL

config RTC_EMUL_INIT_DATETIME
	bool "Initialize emulated RTC time from host wall-clock"
	depends on ARCH_POSIX
	help
	  Seed the emulated RTC with the host's current wall-clock time.

endif
```

## drivers/rtc/Kconfig.infineon
```kconfig
# Infineon CAT1 RTC configuration options

# SPDX-FileCopyrightText: Copyright (c) 2026 Infineon Technologies AG,
# SPDX-FileCopyrightText: or an affiliate of Infineon Technologies AG. All rights reserved.
#
# SPDX-License-Identifier: Apache-2.0

config RTC_INFINEON_CAT1
	bool "Infineon CAT1 RTC driver"
	default y
	depends on DT_HAS_INFINEON_RTC_ENABLED
	select USE_INFINEON_RTC
	help
	  This option enables the RTC driver for Infineon CAT1 family.

config RTC_INFINEON_SKIP_SECURE_INIT
	bool "Infineon RTC init skip"
	default y if BUILD_WITH_TFM || PSOC_EDGE_M55_SRF_SUPPORT
	help
	  This option limits the scope of the init, if a board's core
	  is running in a nonsecure TF-M state.
```

## drivers/rtc/Kconfig.lpf3
```kconfig
# Copyright (c) 2026 Texas Instruments.
# SPDX-License-Identifier: Apache-2.0

config RTC_LPF3
	bool "TI Simplelink RTC driver for LPF3 devices"
	default y
	depends on DT_HAS_TI_LPF3_RTC_TIMER_ENABLED
	help
	  TI Simplelink LPF3 Real-Time Clock (RTC) driver.
```

## drivers/rtc/Kconfig.msp432p4xx
```kconfig
# Copyright (c) 2026 Gail Rojas
# SPDX-License-Identifier: Apache-2.0

config RTC_MSP432P4XX
	bool "TI MSP432P4XX RTC_C driver"
	default y
	depends on DT_HAS_TI_MSP432P4XX_RTC_ENABLED
	help
	  Real-time clock driver for the RTC_C peripheral on TI MSP432P4XX SoCs.
```

## drivers/rtc/Kconfig.pcf85263a
```kconfig
# Copyright (c) 2026 Foss Analytical A/S
# SPDX-License-Identifier: Apache-2.0

config RTC_PCF85263A
	bool "NXP PCF85263A Real-Time Clock driver"
	default y
	depends on DT_HAS_NXP_PCF85263A_ENABLED
	select I2C
	help
	  Enable NXP PCF85263A I2C driver.
```
