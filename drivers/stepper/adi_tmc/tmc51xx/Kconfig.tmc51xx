## drivers/stepper/adi_tmc/tmc51xx/Kconfig.tmc51xx
```kconfig
# SPDX-FileCopyrightText: Copyright (c) 2025 Prevas A/S
# SPDX-FileCopyrightText: Copyright (c) 2025 Jilay Sandeep Pandya
# SPDX-License-Identifier: Apache-2.0

config STEPPER_ADI_TMC51XX
	bool "Activate trinamic tmc51xx"
	depends on DT_HAS_ADI_TMC51XX_ENABLED
	select STEPPER_ADI_TMC_UART if $(dt_compat_on_bus,$(DT_COMPAT_ADI_TMC51XX),uart)
	select STEPPER_ADI_TMC_SPI if $(dt_compat_on_bus,$(DT_COMPAT_ADI_TMC51XX),spi)
	default y

if STEPPER_ADI_TMC51XX

config STEPPER_ADI_TMC51XX_STEPPER_CTRL
	bool "Activate trinamic tmc51xx motion controller"
	depends on DT_HAS_ADI_TMC51XX_STEPPER_CTRL_ENABLED
	depends on DT_HAS_ADI_TMC51XX_STEPPER_DRIVER_ENABLED
	default y

config STEPPER_ADI_TMC51XX_STEPPER_DRIVER
	bool "Activate trinamic tmc51xx stepper driver"
	depends on DT_HAS_ADI_TMC51XX_STEPPER_DRIVER_ENABLED
	default y

module = TMC51XX
module-str = tmc51xx
source "drivers/stepper/adi_tmc/Kconfig.tmc_rampgen_template"

endif # STEPPER_ADI_TMC51XX
```

## drivers/stepper/adi_tmc/tmcm3216/Kconfig.tmcm3216
```kconfig
# SPDX-FileCopyrightText: Copyright (c) 2025 Alexis Czezar C Torreno
# SPDX-License-Identifier: Apache-2.0

config STEPPER_ADI_TMCM3216
	bool "Activate trinamic tmcm3216"
	depends on DT_HAS_ADI_TMCM3216_ENABLED
	select STEPPER_ADI_TMCM_RS485
	select GPIO
	default y

if STEPPER_ADI_TMCM3216

config STEPPER_ADI_TMCM3216_STEPPER_CTRL
	bool "Activate trinamic tmcm3216 motion controller"
	depends on DT_HAS_ADI_TMCM3216_STEPPER_CTRL_ENABLED
	depends on DT_HAS_ADI_TMCM3216_STEPPER_DRIVER_ENABLED
	default y

config STEPPER_ADI_TMCM3216_STEPPER_DRIVER
	bool "Activate trinamic tmcm3216 stepper driver"
	depends on DT_HAS_ADI_TMCM3216_STEPPER_DRIVER_ENABLED
	default y

endif # STEPPER_ADI_TMCM3216
```

## drivers/stepper/allegro/Kconfig
```kconfig
# SPDX-FileCopyrightText: Copyright (c) 2025 Carl Zeiss Meditec AG
# SPDX-License-Identifier: Apache-2.0

comment "Allegro Stepper Drivers"

# zephyr-keep-sorted-start
rsource "Kconfig.a4979"
# zephyr-keep-sorted-stop
```

## drivers/stepper/allegro/Kconfig.a4979
```kconfig
# SPDX-FileCopyrightText: Copyright (c) 2025 Carl Zeiss Meditec AG
# SPDX-License-Identifier: Apache-2.0

config A4979_STEPPER
	bool "Activate allegro A4979 stepper driver"
	default y
	depends on DT_HAS_ALLEGRO_A4979_ENABLED
	select STEP_DIR_STEPPER
	help
	  Microstepping motor driver for stepper motors.
```

## drivers/stepper/allegro/Kconfig.a4988
```kconfig
# SPDX-FileCopyrightText: Copyright (c) 2024 Armin Kessler <armin.kessler@me.com>
# SPDX-License-Identifier: Apache-2.0

config A4988_STEPPER
	bool "Activate driver for A4988 stepper motor driver"
	default y
	depends on DT_HAS_ALLEGRO_A4988_ENABLED
	select STEP_DIR_STEPPER
	select STEPPER_STEP_DIR_GENERATE_ISR_SAFE_EVENTS
	help
	  Microstepping motor driver for stepper motors.
```

## drivers/stepper/closed_loop/Kconfig
```kconfig
# Copyright (c) 2026 Contributors to the Zephyr Project
# SPDX-License-Identifier: Apache-2.0

config STEPPER_CLOSED_LOOP
	bool "Closed-loop stepper controller with encoder feedback"
	default y
	depends on DT_HAS_ZEPHYR_STEPPER_CLOSED_LOOP_ENABLED
	depends on STEPPER
	select PID_CONTROLLER
	select STEPPER_CTRL_EVENT_HANDLER
	select SENSOR
	help
	  Enable a composite stepper_ctrl driver that reads encoder
	  position via the sensor API and uses a PID controller to
	  correct the open-loop stepper position. Requires an encoder
	  sensor device and an inner stepper_ctrl device configured
	  via devicetree.

if STEPPER_CLOSED_LOOP

config STEPPER_CLOSED_LOOP_INIT_PRIORITY
	int "Closed-loop stepper init priority"
	default 91
	help
	  Device initialization priority for the closed-loop stepper
	  controller. Must be higher (later) than CONFIG_STEPPER_INIT_PRIORITY
	  (default 90) to ensure the inner stepper controller and encoder
	  sensor are initialized first.

config STEPPER_CLOSED_LOOP_THREAD_STACK_SIZE
	int "Control loop thread stack size"
	default 1024
	help
	  Stack size for the closed-loop feedback control thread.

config STEPPER_CLOSED_LOOP_THREAD_PRIORITY
	int "Control loop thread priority"
	default 5
	help
	  Cooperative priority of the closed-loop control thread.
	  Should be higher priority (lower number) than the application
	  thread to ensure timely position corrections.

config STEPPER_CLOSED_LOOP_MAX_ENCODER_FAILURES
	int "Maximum consecutive encoder read failures before fault"
	default 10
	help
	  Number of consecutive encoder read failures tolerated before
	  a fault event is raised and the motor is stopped for safety.

config FAKE_ENCODER
	bool "Fake encoder sensor for testing"
	default y
	depends on DT_HAS_ZEPHYR_FAKE_ENCODER_ENABLED
	help
	  Enable a fake encoder sensor device for testing closed-loop
	  stepper controllers without real hardware.

endif # STEPPER_CLOSED_LOOP
```

## drivers/stepper/event_handler/Kconfig
```kconfig
# Copyright (c) 2026 Navimatix GmbH
# SPDX-License-Identifier: Apache-2.0

config STEPPER_CTRL_EVENT_HANDLER
	bool
	help
	  Enable common helper code for stepper_ctrl drivers to manage and dispatch event callbacks.

if STEPPER_CTRL_EVENT_HANDLER

config STEPPER_CTRL_ISR_SAFE_EVENTS
	bool "Guarantee that callbacks are executed in a non-ISR context"
	default y
	help
	  Route event callbacks through a work queue when triggered from ISR context. Multiple
	  events can be pending and are processed sequentially.

config STEPPER_CTRL_EVENT_QUEUE_LEN
	int "Maximum number of pending stepper_ctrl events"
	default 4
	depends on STEPPER_CTRL_ISR_SAFE_EVENTS
	help
	  The maximum number of stepper_ctrl events per driver instance that can
	  be pending before new events are dropped.

endif # STEPPER_CTRL_EVENT_HANDLER
```

## drivers/stepper/gpio_stepper/Kconfig
```kconfig
# Copyright (c) 2025 Jilay Sandeep Pandya
# SPDX-License-Identifier: Apache-2.0

comment "GPIO Stepper Controllers"

rsource "common/Kconfig"
rsource "Kconfig.gpio_step_dir"
rsource "Kconfig.h_bridge"
```

## drivers/stepper/gpio_stepper/Kconfig.gpio_step_dir
```kconfig
# SPDX-FileCopyrightText: Copyright (c) 2025 Jilay Sandeep Pandya
# SPDX-License-Identifier: Apache-2.0

config STEPPER_GPIO_STEP_DIR_STEPPER_CTRL
	bool "Activate driver for gpio step dir stepper control"
	select GPIO_STEPPER
	depends on DT_HAS_ZEPHYR_GPIO_STEP_DIR_STEPPER_CTRL_ENABLED
	select STEP_DIR_STEPPER
	default y
```

## drivers/stepper/gpio_stepper/Kconfig.h_bridge
```kconfig
# SPDX-FileCopyrightText: Copyright (c) 2024 Carl Zeiss Meditec AG
# SPDX-FileCopyrightText: Copyright (c) 2024 Jilay Sandeep Pandya
# SPDX-License-Identifier: Apache-2.0

config STEPPER_H_BRIDGE_STEPPER_CTRL
	bool "Activate driver for gpio h-bridge stepper control"
	select GPIO_STEPPER
	depends on DT_HAS_ZEPHYR_H_BRIDGE_STEPPER_CTRL_ENABLED
	default y
```

## drivers/stepper/gpio_stepper/common/Kconfig
```kconfig
# Copyright (c) 2025 Jilay Sandeep Pandya
# SPDX-License-Identifier: Apache-2.0

config GPIO_STEPPER
	bool
	select STEPPER_CTRL_EVENT_HANDLER
	help
	  Enable library used for gpio based stepper controllers.

if GPIO_STEPPER

config GPIO_STEPPER_COUNTER_TIMING
	bool "Counter use for step timing"
	select COUNTER
	default y
	help
	  Enable usage of a counter device for accurate stepping.

endif # GPIO_STEPPER
```

## drivers/stepper/gpio_stepper/step_dir/Kconfig
```kconfig
# Copyright (c) 2024 Fabian Blatz <fabianblatz@gmail.com>
# SPDX-License-Identifier: Apache-2.0

comment "Stepper Step-Dir Common"

config STEP_DIR_STEPPER
	bool
	help
	  Enable library used for step direction stepper drivers.

if STEP_DIR_STEPPER

config STEP_DIR_STEPPER_COUNTER_TIMING
	bool "Counter use for stepping"
	select COUNTER
	default y
	help
	  Enable usage of a counter device for accurate stepping.

module = STEP_DIR
module-str = step_dir
source "drivers/stepper/Kconfig.stepper_event_template"

endif # STEP_DIR_STEPPER
```

## drivers/stepper/interface/Kconfig
```kconfig
# Copyright (c) 2024 Fabian Blatz <fabianblatz@gmail.com>
# Copyright (c) 2025 Andre Stefanov
# SPDX-License-Identifier: Apache-2.0

config STEPPER_INTERFACE_STEP_DIR
	bool
	help
	  Enable library used for step/dir stepper drivers.
```

## drivers/stepper/motion_controller/Kconfig
```kconfig
# SPDX-FileCopyrightText: Copyright (c) 2023 Carl Zeiss Meditec AG
# SPDX-FileCopyrightText: Copyright (c) 2025 Andre Stefanov <mail@andrestefanov.de>
# SPDX-License-Identifier: Apache-2.0

comment "Stepper motion controller"

rsource "ramp/Kconfig"
```

## drivers/stepper/motion_controller/ramp/Kconfig
```kconfig
# SPDX-FileCopyrightText: Copyright (c) 2025 Jilay Sandeep Pandya
# SPDX-FileCopyrightText: Copyright (c) 2025 Andre Stefanov
# SPDX-License-Identifier: Apache-2.0

config STEPPER_RAMP_CONSTANT
	bool "Constant ramp control"
	default y
	help
	  Enable simple ramp allowing only constant velocities without
	  any acceleration. This ramp is used by default if none other
	  is provided. It also enables execution of an emergency stop.

config STEPPER_RAMP_TRAPEZOIDAL
	bool "Trapezoidal ramp control"
	help
	  Enable trapezoidal ramp control for stepper drivers.
	  The trapezoidal ramp control is implemented as a state machine
	  and can be used with any stepper driver.
```

## drivers/stepper/ramp/Kconfig
```kconfig
# SPDX-FileCopyrightText: Copyright (c) 2025 Jilay Sandeep Pandya
# SPDX-License-Identifier: Apache-2.0

menuconfig STEPPER_RAMP
	bool "Ramp control"
	help
	  Enable ramp control for stepper drivers.

if STEPPER_RAMP

config STEPPER_RAMP_TRAPEZOIDAL
	bool "Trapezoidal ramp control"
	help
	  Enable trapezoidal ramp control for stepper drivers.
	  The trapezoidal ramp control is implemented as a state machine
	  and can be used with any stepper driver.

endif
```

## drivers/stepper/step_dir/Kconfig
```kconfig
# Copyright (c) 2024 Fabian Blatz <fabianblatz@gmail.com>
# SPDX-License-Identifier: Apache-2.0

comment "Stepper Step-Dir Common"

config STEP_DIR_STEPPER
	bool
	help
	  Enable library used for step direction stepper drivers.
```

## drivers/stepper/stepper_timing_sources/Kconfig
```kconfig
# SPDX-FileCopyrightText: Copyright (c) 2025 Jilay Sandeep Pandya
# SPDX-License-Identifier: Apache-2.0

config STEPPER_TIMING_SOURCES
	bool "Stepper Timing Sources"
	help
	  Enable timing sources for stepper

if STEPPER_TIMING_SOURCES

config STEPPER_TIMING_SOURCES_COUNTER_TIMING
	bool "Counter use for stepping"
	select COUNTER
	default y
	help
	  Enable usage of a counter device for accurate stepping.

endif
```

## drivers/stepper/ti/Kconfig
```kconfig
# SPDX-FileCopyrightText: Copyright (c) 2024 Navimatix GmbH
# SPDX-License-Identifier: Apache-2.0

comment "TI Stepper Drivers"

rsource "Kconfig.drv84xx"
```

## drivers/stepper/ti/Kconfig.drv8424
```kconfig
# SPDX-FileCopyrightText: Copyright (c) 2024 Navimatix GmbH
# SPDX-License-Identifier: Apache-2.0

config DRV8424
	bool "TI DRV8424 stepper motor driver"
	default y
	depends on DT_HAS_TI_DRV8424_ENABLED
	select STEP_DIR_STEPPER
	select STEPPER_STEP_DIR_GENERATE_ISR_SAFE_EVENTS
	help
	  Enable driver for TI DRV8424 stepper motor driver.
```

## drivers/stepper/ti/Kconfig.drv84xx
```kconfig
# SPDX-FileCopyrightText: Copyright (c) 2024 Navimatix GmbH
# SPDX-License-Identifier: Apache-2.0

config DRV84XX
	bool "TI DRV84XX stepper motor driver"
	default y
	depends on DT_HAS_TI_DRV84XX_ENABLED
	select STEPPER_TI
	select STEP_DIR_STEPPER
	help
	  Enable driver for TI DRV84XX stepper motor driver.
```

## drivers/stepper_control/Kconfig
```kconfig
# SPDX-FileCopyrightText: Copyright (c) 2025 Jilay Sandeep Pandya
# SPDX-License-Identifier: Apache-2.0

menuconfig STEPPER_CONTROL
	bool "Stepper Motion Controller"
	select STEPPER
	help
	  Enable support for stepper motor control.

if STEPPER_CONTROL

module = STEPPER_CONTROL
module-str = stepper_control
source "subsys/logging/Kconfig.template.log_config"

config STEPPER_CONTROL_INIT_PRIORITY
	int "Stepper motor control init priority"
	default 90
	help
	  Stepper motor control initialization priority.

comment "Stepper Control Drivers"

# zephyr-keep-sorted-start
rsource "Kconfig.zephyr_stepper_control"
rsource "adi_tmc/Kconfig"
# zephyr-keep-sorted-stop

endif # STEPPER_CONTROL
```

## drivers/stepper_control/Kconfig.zephyr_stepper_control
```kconfig
# SPDX-FileCopyrightText: Copyright (c) 2025 Jilay Sandeep Pandya
# SPDX-License-Identifier: Apache-2.0

config ZEPHYR_STEPPER_CONTROL
	bool "Zephyr SW based Stepper motor control"
	depends on DT_HAS_ZEPHYR_STEPPER_CONTROL_ENABLED
	default y
```

## drivers/stepper_control/adi_tmc/Kconfig
```kconfig
# SPDX-FileCopyrightText: Copyright (c) 2025 Jilay Sandeep Pandya
# SPDX-License-Identifier: Apache-2.0

menuconfig STEPPER_CONTROL_ADI_TMC
	bool "Activate trinamic tmc stepper motion controller"
	depends on STEPPER_CONTROL
	default y

if STEPPER_CONTROL_ADI_TMC

config STEPPER_ADI_TMC_SPI
	bool "Use Trinamic Stepper Controller with SPI"
	depends on STEPPER_ADI_TMC
	select SPI
	help
	  A Trinamic Stepper Motion Controller with SPI is enabled

comment "Trinamic Stepper Control Drivers"

rsource "Kconfig.tmc50xx"

endif # STEPPER_CONTROL_ADI_TMC
```

## drivers/stepper_control/adi_tmc/Kconfig.tmc_rampgen_template
```kconfig
# SPDX-FileCopyrightText: Copyright (c) 2024 Jilay Sandeep Pandya
# SPDX-License-Identifier: Apache-2.0

config STEPPER_ADI_$(module)_RAMPSTAT_POLL_INTERVAL_IN_MSEC
	int "$(module-str) poll ramp status interval in ms"
	depends on !$(dt_compat_any_has_prop,$(DT_COMPAT_ADI_$(module)),diag0-gpios)
	default 100
	help
	  When DIAG0 pin is not available, the driver automatically falls back to
	  polling. This setting controls how frequently (in milliseconds) the driver
	  polls the ramp status register to detect events like position reached, stall
	  or end stop triggered.

config STEPPER_ADI_$(module)_RAMPSTAT_POLL_STALLGUARD_LOG
	bool "log $(module-str) stallguard"
	default n
	help
	  Enable stallguard log while polling rampstat.

config STEPPER_ADI_$(module)_RAMP_GEN
	bool "Use $(module-str) with Ramp Generator"
	depends on STEPPER_ADI_$(module)
	default y
	help
	  Enable ramp generator for trinamic stepper controller.
```
