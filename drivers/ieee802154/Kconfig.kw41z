## drivers/ieee802154/Kconfig.tlx
```kconfig
# Copyright (c) 2024 Telink Semiconductor
# SPDX-License-Identifier: Apache-2.0

# Telink TLX RF configuration options

menuconfig IEEE802154_TELINK_TLX
	bool "Telink TLX RF driver"
	default y
	depends on DT_HAS_TELINK_TLX_ZB_ENABLED

if IEEE802154_TELINK_TLX

config IEEE802154_TLX_INIT_PRIO
	int "Telink TLX IEEE 802.15.4 initialization priority"
	default 80
	help
	  Set the initialization priority number. Do not mess with it unless
	  you know what you are doing.

config IEEE802154_TLX_SET_TXRX_DELAY_US
	int "Tx/Rx modes switching delay time (us)"
	default 120
	help
	  Delay time needed for PLL stabilization during Tx/Rx modes switching.

config IEEE802154_TLX_CCA_RSSI_THRESHOLD
	int "CCA procedure RSSI threshold"
	default -50
	help
	  CCA procedure returns true if the current RSSI value is less than
	  this parameter.

choice IEEE802154_TLX_MAC_TYPE
	prompt "IEEE802154 MAC address type"
	default IEEE802154_TLX_MAC_RANDOM
config IEEE802154_TLX_MAC_RANDOM
	bool "Random MAC address"
config IEEE802154_TLX_MAC_FLASH
	bool "MAC address from flash"
config IEEE802154_TLX_MAC_STATIC
	bool "MAC address precompiled"
endchoice

config IEEE802154_TLX_DELAY_TRX_ACC
	int "Clock accuracy for delayed operations"
	default 40
	help
	  Accuracy of the clock used for scheduling radio delayed operations (delayed transmission
	  or delayed reception), in ppm.

config IEEE802154_TLX_OPTIMIZATION
	bool "Optimize 802.15.4 RF performance for TLX SoCs"
	default n
	help
	  Improve RF performance in IEEE 802.15.4 communication on TLX SoCs.


if IEEE802154_TLX_MAC_STATIC

config IEEE802154_TLX_MAC4
	hex "MAC Address Byte 4"
	default 0
	range 0 0xff
	help
	  This is the byte 4 of the MAC address.

config IEEE802154_TLX_MAC5
	hex "MAC Address Byte 5"
	default 0
	range 0 0xff
	help
	  This is the byte 5 of the MAC address.

config IEEE802154_TLX_MAC6
	hex "MAC Address Byte 6"
	default 0
	range 0 0xff
	help
	  This is the byte 6 of the MAC address.

config IEEE802154_TLX_MAC7
	hex "MAC Address Byte 7"
	default 0
	range 0 0xff
	help
	  This is the byte 7 of the MAC address.

endif # IEEE802154_TLX_MAC_STATIC

config IEEE802154_TELINK_TLX_ENCRYPTION
	bool "Telink 802.15.4 AES-CCM* authentication & encryption"

endif # IEEE802154_TELINK_TLX
```

## drivers/ieee802154/Kconfig.uart_pipe
```kconfig
# Copyright (c) 2015 Intel Corporation
# SPDX-License-Identifier: Apache-2.0

menuconfig IEEE802154_UPIPE
	bool "UART PIPE fake radio driver support for QEMU"
	default y
	depends on (BOARD_QEMU_X86 || BOARD_QEMU_CORTEX_M3) && \
		   DT_HAS_ZEPHYR_IEEE802154_UART_PIPE_ENABLED
	select UART_PIPE

if IEEE802154_UPIPE

config IEEE802154_UPIPE_HW_FILTER
	bool "Hw Filtering"
	default y
	help
	  This option assure the driver will process just frames addressed to him.

config IEEE802154_UPIPE_RANDOM_MAC
	bool "Random MAC address"
	default y
	help
	  Generate a random MAC address dynamically.

if ! IEEE802154_UPIPE_RANDOM_MAC

config IEEE802154_UPIPE_MAC4
	hex "MAC Address Byte 4"
	default 0
	range 0 0xff
	help
	  This is the byte 4 of the MAC address.

config IEEE802154_UPIPE_MAC5
	hex "MAC Address Byte 5"
	default 0
	range 0 0xff
	help
	  This is the byte 5 of the MAC address.

config IEEE802154_UPIPE_MAC6
	hex "MAC Address Byte 6"
	default 0
	range 0 0xff
	help
	  This is the byte 6 of the MAC address.

config IEEE802154_UPIPE_MAC7
	hex "MAC Address Byte 7"
	default 0
	range 0 0xff
	help
	  This is the byte 7 of the MAC address.

endif # IEEE802154_UPIPE_RANDOM_MAC

endif # IEEE802154_UPIPE
```

## drivers/ieee802154/Kconfig.w91
```kconfig
# Copyright (c) 2025 Telink Semiconductor
# SPDX-License-Identifier: Apache-2.0

# Telink W91 RF configuration options

config IEEE802154_TELINK_W91
	bool "Telink W91 RF driver"
	default y
	select SERIAL
	select UART_INTERRUPT_DRIVEN
	depends on DT_HAS_TELINK_W91_ZB_ENABLED

if IEEE802154_TELINK_W91

endif # IEEE802154_TELINK_W91
```

## drivers/ilc/Kconfig
```kconfig
# Copyright (c) 2023 Intel Corporation
# SPDX-License-Identifier: Apache-2.0

#
# Interrupt latency counter options
#
menuconfig ILC
	bool "Interrupt latency counter drivers"
	help
	  To enable Interrupt latency counter driver. The ilc node represents
	  a region containing information about  Interrupt latency counter device.

if ILC

module = ILC_SOFT_IP_FPGA
module-str = ilc_soft_ip_fpga
source "subsys/logging/Kconfig.template.log_config"

config ILC_INIT_PRIORITY
	int "Interrupt latency counter driver init priority"
	default 90
	help
	  This option controls the priority of the Interrupt latency counter device
	  initialization. Higher priority ensures that the device is initialized
	  earlier in the startup cycle. If unsure, leave at default
	  value

config ILC_SHELL
	bool "Support for ILC interface shell commands"
	default y
	depends on SHELL
	help
	  Display to enable ILC interface shell commands

comment "Interrupt latency counter drivers"

rsource "Kconfig.ilc_intel_soc_fpga"

endif # ILC
```

## drivers/ilc/Kconfig.ilc_intel_soc_fpga
```kconfig
# Copyright (c) 2023 Intel Corporation
# SPDX-License-Identifier: Apache-2.0

config ILC_INTEL_SOC_FPGA
	bool "Intel SoC FPGA Interrupt Latency Counter driver"
	depends on DT_HAS_SHARED_IRQ_ENABLED
	depends on DT_HAS_INTEL_ILC_ENABLED
	help
	 Enable the interrupt latency counter driver for Intel SoC FPGA device.
```

## drivers/input/Kconfig
```kconfig
# Copyright 2023 Google LLC
# SPDX-License-Identifier: Apache-2.0

if INPUT

menu "Input drivers"

# zephyr-keep-sorted-start
source "drivers/input/Kconfig.adc_keys"
source "drivers/input/Kconfig.analog_axis"
source "drivers/input/Kconfig.cap1203"
source "drivers/input/Kconfig.cf1133"
source "drivers/input/Kconfig.chsc6x"
source "drivers/input/Kconfig.cst816s"
source "drivers/input/Kconfig.esp32"
source "drivers/input/Kconfig.evdev"
source "drivers/input/Kconfig.ft5336"
source "drivers/input/Kconfig.gpio_kbd_matrix"
source "drivers/input/Kconfig.gpio_keys"
source "drivers/input/Kconfig.gpio_qdec"
source "drivers/input/Kconfig.gt911"
source "drivers/input/Kconfig.ili2132a"
source "drivers/input/Kconfig.it8xxx2"
source "drivers/input/Kconfig.kbd_matrix"
source "drivers/input/Kconfig.npcx"
source "drivers/input/Kconfig.pat912x"
source "drivers/input/Kconfig.paw32xx"
source "drivers/input/Kconfig.pinnacle"
source "drivers/input/Kconfig.pmw3610"
source "drivers/input/Kconfig.sbus"
source "drivers/input/Kconfig.sdl"
source "drivers/input/Kconfig.stmpe811"
source "drivers/input/Kconfig.touch"
source "drivers/input/Kconfig.xec"
source "drivers/input/Kconfig.xpt2046"
# zephyr-keep-sorted-stop

endmenu # Input Drivers

endif # INPUT
```

## drivers/input/Kconfig.adafruit_seesaw_gamepad
```kconfig
# Copyright (c) 2026 Charles Dias
# SPDX-License-Identifier: Apache-2.0

config INPUT_ADAFRUIT_SEESAW_GAMEPAD
	bool "Adafruit Mini I2C Gamepad with seesaw"
	default y
	depends on DT_HAS_ADAFRUIT_SEESAW_GAMEPAD_ENABLED
	select I2C
	help
	  Enable driver for the Adafruit Mini I2C Gamepad with seesaw
	  (product 5743). Reports a 2-axis joystick (ABS_X/ABS_Y) and
	  6 buttons (A, B, X, Y, Start, Select) via the Zephyr input
	  subsystem.
```

## drivers/input/Kconfig.adc_keys
```kconfig
# Copyright (c) 2024 Chen Xingyu <hi@xingrz.me>
# SPDX-License-Identifier: Apache-2.0

config INPUT_ADC_KEYS
	bool "ADC attached resistor ladder buttons"
	default y
	depends on DT_HAS_ADC_KEYS_ENABLED
	depends on ADC
	help
	  Enable support for ADC attached resistor ladder buttons.
```

## drivers/input/Kconfig.analog_axis
```kconfig
# Copyright 2023 Google LLC
# SPDX-License-Identifier: Apache-2.0

config INPUT_ANALOG_AXIS
	bool "ADC based analog axis input driver"
	default y
	depends on DT_HAS_ANALOG_AXIS_ENABLED
	depends on MULTITHREADING
	select ADC
	help
	  ADC based analog axis input driver

if INPUT_ANALOG_AXIS

config INPUT_ANALOG_AXIS_THREAD_STACK_SIZE
	int "Stack size for the analog axis thread"
	default 762
	help
	  Size of the stack used for the analog axis thread.

config INPUT_ANALOG_AXIS_THREAD_PRIORITY
	int "Priority for the analog axis thread"
	default 0
	help
	  Priority level of the analog axis thread.

config INPUT_ANALOG_AXIS_SETTINGS
	bool "Analog axis settings support"
	default y
	depends on SETTINGS
	help
	  Settings support for the analog axis driver, exposes a
	  analog_axis_calibration_save() function to save the calibration into
	  settings and load them automatically on startup.

config INPUT_ANALOG_AXIS_SETTINGS_MAX_AXES
	int "Maximum number of axes supported in the settings."
	default 8
	help
	  Maximum number of axes that can have calibration value saved in
	  settings.

endif
```

## drivers/input/Kconfig.bee_keyscan
```kconfig
# Copyright (c) 2026, Realtek Semiconductor Corporation
# SPDX-License-Identifier: Apache-2.0

config INPUT_BEE_KEYSCAN
	bool "Realtek Bee series input keyscan driver"
	default y
	depends on DT_HAS_REALTEK_BEE_KEYSCAN_ENABLED
	select INPUT_KBD_MATRIX
	select HAL_REALTEK_BEE_KEYSCAN
	select PINCTRL
	help
	  This option enables the input keyscan driver for Realtek Bee SoCs.

config BEE_INPUT_KEYSCAN_AUTOSCAN_MODE
	bool "Config scanmode for bee keyscan"
	default n
	depends on INPUT_BEE_KEYSCAN
	help
	  In auto mode, scanning is triggered by hardware, resulting in shorter and more precise intervals.
	  This is suitable for latency-sensitive scenarios requiring higher scanning speeds.
	  In manual mode, the system can enter sleep mode between scans when the PM feature is enabled.
	  This is suitable for power-sensitive scenarios where energy efficiency is the priority.
```

## drivers/input/Kconfig.bflb
```kconfig
# Copyright (c) 2025 MASSDRIVER EI (massdriver.space)
# SPDX-License-Identifier: Apache-2.0

config INPUT_BFLB_IRX
	bool "Bouffalolab Infrared Receiver"
	default y
	depends on DT_HAS_BFLB_IRX_ENABLED
	select GPIO
	help
	  This option enables the driver for the Bouffalolab Infrared Receiver Peripheral.
```

## drivers/input/Kconfig.cap1203
```kconfig
# Copyright (c) 2022 Keiya Nobuta
# SPDX-License-Identifier: Apache-2.0

menuconfig INPUT_CAP1203
	bool "CAP1203 3-cannel capacitive touch sensor driver"
	default y
	depends on DT_HAS_MICROCHIP_CAP1203_ENABLED
	select I2C
	help
	  Enable driver for microchip CAP1203 3-cannel capacitive
	  touch sensor.

if INPUT_CAP1203

config INPUT_CAP1203_POLL
	bool "Polling"
	help
	  Enable polling mode when interrupt GPIO is not specified.

config INPUT_CAP1203_PERIOD
	int "Sample period"
	depends on INPUT_CAP1203_POLL
	default 10
	help
	  Sample period in milliseconds when in polling mode.

endif # INPUT_CAP1203
```

## drivers/input/Kconfig.cap12xx
```kconfig
# Copyright (c) 2022 Keiya Nobuta
# SPDX-License-Identifier: Apache-2.0

config INPUT_CAP12XX
	bool "Microchip CAP12xx multi-channel capacitive touch sensor driver"
	default y
	depends on DT_HAS_MICROCHIP_CAP12XX_ENABLED
	select I2C
	help
	  Enable driver for Microchip CAP12xx multi-channel capacitive
	  touch sensor.
```

## drivers/input/Kconfig.cf1133
```kconfig
# Copyright (c) 2024 Kickmaker
# SPDX-License-Identifier: Apache-2.0

menuconfig INPUT_CF1133
	bool "CF1133 capacitive touch panel driver"
	default y
	depends on DT_HAS_SITRONIX_CF1133_ENABLED
	select I2C
	help
	  Enable driver for Sitronix capacitive touch panel
	  controller. This driver should support CF1133.

if INPUT_CF1133

config INPUT_CF1133_INTERRUPT
	bool "Interrupt"
	default y
	help
	  Enable interrupt support (requires all instances
	  of CF1133 have the INT gpio connected).

config INPUT_CF1133_PERIOD_MS
	int "Sample period"
	depends on !INPUT_CF1133_INTERRUPT
	default 10
	help
	  Sample period in milliseconds when in polling mode.

endif # INPUT_CF1133
```
