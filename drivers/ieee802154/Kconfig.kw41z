## drivers/ieee802154/Kconfig.kw41z
```kconfig
# NXP KW41Z configuration options

# Copyright (c) 2017 Linaro Limited
# SPDX-License-Identifier: Apache-2.0

menuconfig IEEE802154_KW41Z
	bool "NXP KW41Z Driver support"
	default y
	depends on DT_HAS_NXP_KW41Z_IEEE802154_ENABLED
	select REQUIRES_FULL_LIBC

if IEEE802154_KW41Z

config IEEE802154_KW41Z_INIT_PRIO
	int "KW41Z initialization priority"
	default 80
	help
	  Set the initialization priority number. Do not change it unless
	  you know what you are doing. It has to start before the net stack.

config KW41_DBG_TRACE
	bool "Simplified debug tracing of events"
	help
	  The value depends on your debugging needs. This generates an encoded
	  trace of events without going to debug logging to avoid timing impact
	  on running code. The buffer is post analyzed via the debugger.
endif
```

## drivers/ieee802154/Kconfig.mcr20a
```kconfig
# Kconfig.mcr20a - NXP MCR20A configuration options
#
#
# Copyright (c) 2017 PHYTEC Messtechnik GmbH
#
# SPDX-License-Identifier: Apache-2.0
#

menuconfig  IEEE802154_MCR20A
	bool "NXP MCR20A Driver support"
	depends on NETWORKING && SPI

if IEEE802154_MCR20A

config IEEE802154_MCR20A_DRV_NAME
	string "NXP MCR20A Driver's name"
	default "mcr20a"
	help
	  This option sets the driver name

config MCR20A_IS_PART_OF_KW2XD_SIP
	bool "MCR20A device is part of KW2xD SiP"
	help
	  If this option is set, the driver does not perform a hardware
	  reset and the CLK_OUT frequency is not set, instead these settings
	  are performed during the initialization of the SoC.

choice
	prompt "CLK_OUT frequency"
	default MCR20A_CLK_OUT_4MHZ if MCR20A_IS_PART_OF_KW2XD_SIP
	default MCR20A_CLK_OUT_DISABLED
	help
	  Configuration of the MCR20A clock output pin.

config MCR20A_CLK_OUT_DISABLED
	bool "Disabled"

config MCR20A_CLK_OUT_32MHZ
	bool "32 MHz"

config MCR20A_CLK_OUT_16MHZ
	bool "16 MHz"

config MCR20A_CLK_OUT_8MHZ
	bool "8 MHz"

config MCR20A_CLK_OUT_4MHZ
	bool "4 MHz"

config MCR20A_CLK_OUT_1MHZ
	bool "1 MHz"

config MCR20A_CLK_OUT_250KHZ
	bool "250 kHz"

config MCR20A_CLK_OUT_62500HZ
	bool "62500 Hz"

config MCR20A_CLK_OUT_32768HZ
	bool "32768 Hz"

endchoice

config IEEE802154_MCR20A_RX_STACK_SIZE
	int "Driver's internal RX thread stack size"
	default 800
	help
	  This option sets the driver's stack size for its internal RX thread.
	  The default value should be sufficient, but in case it proves to be
	  a too little one, this option makes it easy to play with the size.

config IEEE802154_MCR20A_INIT_PRIO
	int "MCR20A initialization priority"
	default 80
	help
	  Set the initialization priority number. Do not mess with it unless
	  you know what you are doing. Beware mcr20a requires gpio and spi to
	  be ready first (and sometime gpio should be the very first as spi
	  might need it too). And of course it has to start before the net stack.


endif
```

## drivers/ieee802154/Kconfig.mcux
```kconfig
menuconfig IEEE802154_MCUX
	bool "MCUX drivers"
	default n
	help
	  Support for NXP MCUX IEEE 802.15.4 drivers.

source "drivers/ieee802154/Kconfig.fsci"

source "drivers/ieee802154/Kconfig.kw41z"
```

## drivers/ieee802154/Kconfig.mcxw
```kconfig
# NXP MCXW 802.15.4 configuration options

# Copyright 2025 NXP
# SPDX-License-Identifier: Apache-2.0

menuconfig IEEE802154_MCXW
	bool "NXP MCXW series IEEE 802.15.4 Driver"
	default y
	depends on DT_HAS_NXP_MCXW_IEEE802154_ENABLED
	depends on COUNTER

if IEEE802154_MCXW

config IEEE802154_MCXW_INIT_PRIO
	int "Initial priority for the IEEE802154 driver"
	default 80

config IEEE802154_MCXW_RX_STACK_SIZE
	int "Driver's internal RX thread stack size"
	default 800


config IEEE802154_MCXW_CSL_ACCURACY
	int "Csl accuracy for delayed operations"
	default 100


endif
```

## drivers/ieee802154/Kconfig.native_posix
```kconfig
# Copyright (c) 2020, Nordic Semiconductor ASA
# SPDX-License-Identifier: Apache-2.0

config IEEE802154_NATIVE_POSIX
	bool	"Enable native posix ieee 802154 driver"
	default n
	depends on NETWORKING && BOARD_NATIVE_POSIX

config IEEE802154_NATIVE_POSIX_DRV_NAME
	string "Native Posix Ieee 802154 driver name"
	default "natpos_802154"
	depends on NETWORKING && BOARD_NATIVE_POSIX
```

## drivers/ieee802154/Kconfig.nrf5
```kconfig
# Nordic Semiconductor nRF5 802.15.4 configuration options

# Copyright (c) 2017 Nordic Semiconductor ASA
# SPDX-License-Identifier: Apache-2.0

menuconfig IEEE802154_NRF5
	bool "nRF52 series IEEE 802.15.4 Driver"
	default y
	depends on DT_HAS_NORDIC_NRF_IEEE802154_ENABLED
	select NRF_802154_RADIO_DRIVER if HAS_HW_NRF_RADIO_IEEE802154
	select NRF_802154_SER_HOST if !HAS_HW_NRF_RADIO_IEEE802154

if IEEE802154_NRF5

config IEEE802154_NRF5_RX_STACK_SIZE
	int "Driver's internal RX thread stack size"
	default 800
	help
	  This option sets the driver's stack size for its internal RX thread.
	  The default value should be sufficient, but in case it proves to be
	  a too little one, this option makes it easy to play with the size.

config IEEE802154_NRF5_INIT_PRIO
	int "nRF52 IEEE 802.15.4 initialization priority"
	default 80
	help
	  Set the initialization priority number. Do not mess with it unless
	  you know what you are doing.

config IEEE802154_NRF5_EXT_IRQ_MGMT
	bool
	help
	  The driver may manage radio IRQs by itself, or use an external
	  radio IRQ provider. When radio IRQs are managed by an external
	  provider, the driver shall not configure radio IRQs.

	  Enable this option when external radio IRQ provider is enabled in
	  the system. One example of external radio IRQ provider could be
	  a radio arbiter used in dynamic multiprotocol applications.

config IEEE802154_NRF5_UICR_EUI64_ENABLE
	bool "Support usage of EUI64 value stored in UICR registers"
	depends on !IEEE802154_VENDOR_OUI_ENABLE
	depends on SOC_SERIES_NRF52X || SOC_SERIES_NRF53X
	help
	  This option enables setting custom vendor EUI64 value
	  stored in User information configuration registers (UICR).
	  Notice that this disables the default setting of EUI64
	  value from Factory information configuration registers
	  (FICR).

if IEEE802154_NRF5_UICR_EUI64_ENABLE

config IEEE802154_NRF5_UICR_EUI64_REG
	int "UICR base register for the EUI64 value"
	range 0 30 if SOC_SERIES_NRF52X
	range 0 190 if SOC_SERIES_NRF53X
	default 0
	help
	  Base of the two consecutive registers from the UICR customer
	  section in which custom EUI64 is stored.

endif # IEEE802154_NRF5_UICR_EUI64_ENABLE

config IEEE802154_NRF5_FCS_IN_LENGTH
	bool "Include FCS field in the overall packet length"
	default y if IEEE802154_RAW_MODE || NET_L2_OPENTHREAD
	help
	  Some 802.15.4 L2 implementations expect that FCS length is included in
	  the overall packet length while others not. Allow to configure this
	  behavior, based on the selected upper layer.

config IEEE802154_NRF5_DELAY_TRX_ACC
	int "Clock accuracy for delayed operations"
	default CLOCK_CONTROL_NRF_ACCURACY if (CLOCK_CONTROL_NRF && (CLOCK_CONTROL_NRF_ACCURACY < 255))
	default 255
	help
	  Accuracy of the clock used for scheduling radio delayed operations (delayed transmission
	  or delayed reception), in ppm.

config IEEE802154_NRF5_LOG_RX_FAILURES
	bool "Frame reception failures logging"
	help
	  There are few cases where the frame reception failure can happen because of
	  internal cause. These cases are reported forward by general code error.

	  This options enables logging the reason of frame reception failure.
	  It can be helpful for the network traffic analyze but it generates also
	  a lot of log records in a stress environment.

config IEEE802154_NRF5_MULTIPLE_CCA
	bool "Support for multiple CCA attempts before transmission"
	help
	  When this option is enabled the OpenThread capability
	  IEEE802154_OPENTHREAD_HW_MULTIPLE_CCA is supported by the ieee802154_nrf5.

endif
```

## drivers/ieee802154/Kconfig.ot_spinel
```kconfig
# OpenThread Host options

# Copyright (c) 2022, Basalte bv
# SPDX-License-Identifier: Apache-2.0

menuconfig IEEE802154_OPENTHREAD_HOST_SPINEL
	bool "OpenThread Spinel driver"
	depends on NET_L2_OPENTHREAD

if IEEE802154_OPENTHREAD_HOST_SPINEL

config IEEE802154_OPENTHREAD_HOST_SPINEL_DRV_NAME
	string "OpenThread Spinel Driver's name"
	default "IEEE802154_ot_spinel"
	help
	  This option sets the driver name

endif
```

## drivers/ieee802154/Kconfig.rf2xx
```kconfig
# ATMEL AT86RF23x/212x configuration options

# Copyright (c) 2019 Gerson Fernando Budke
# SPDX-License-Identifier: Apache-2.0

menuconfig IEEE802154_RF2XX
	bool "ATMEL RF2XX Driver support"
	default y
	depends on DT_HAS_ATMEL_RF2XX_ENABLED
	select SPI
	select GPIO
	select NET_L2_IEEE802154_SUB_GHZ if NET_L2_IEEE802154

if IEEE802154_RF2XX

config IEEE802154_RF2XX_RX_STACK_SIZE
	int "Driver's internal RX thread stack size"
	default 800
	help
	  This option sets the driver's stack size for its internal RX thread.
	  The default value should be sufficient, but in case it proves to be
	  a too little one, this option makes it easy to play with the size.

config IEEE802154_RF2XX_INIT_PRIO
	int "RF2X initialization priority"
	default 80
	help
	  Set the initialization priority number. Do not mess with it unless
	  you know what you are doing. Beware rf2xx requires gpio and spi to
	  be ready first (and sometime gpio should be the very first as spi
	  might need it too). And of course it has to start before the net stack.

endif
```

## drivers/ieee802154/Kconfig.s2lp
```kconfig
# ST Microelectronics s2lp 802.15.4 radio configuration options

# Copyright (c) 2021 Nikos Oikonomou <nikoikonomou92@gmail.com>
# SPDX-License-Identifier: Apache-2.0

menuconfig IEEE802154_S2LP
	bool "ST S2LP Driver support"
	depends on NETWORKING && SPI
	select NET_L2_IEEE802154_SUB_GHZ if NET_L2_IEEE802154

if IEEE802154_S2LP

config IEEE802154_S2LP_DRV_NAME
	string "S2LP Driver's name"
	default "IEEE802154_S2LP"
	help
	  This option sets the driver name

config IEEE802154_S2LP_RX_THREAD_PRIO
	int
	default 2
	help
	  Hidden option for Rx thread priority.

config IEEE802154_S2LP_RX_STACK_SIZE
	int "Driver's internal RX thread stack size"
	default 800
	help
	  This option sets the driver's stack size for its internal RX thread.
	  The default value should be sufficient, but in case it proves to be
	  a too little one, this option makes it easy to play with the size.

config IEEE802154_S2LP_INIT_PRIO
	int "S2LP initialization priority"
	default 80
	help
	  Set the initialization priority number. Do not mess with it unless
	  you know what you are doing.

config IEEE802154_S2LP_SNIFF_MODE
	bool "Enables SNIFF Mode feature"
	help
	  If enabled the driver will utilize the radio's SNIFF Mode feature.

config IEEE802154_S2LP_FREQUENCY_BASE
	int "S2LP frequency base in Hz"
	default 868000000
	help
	  The frequency base that will be used for the computation of the
	  operational frequency.

config IEEE802154_S2LP_MAX_FREQUENCY
	int "S2LP maximum supported frequency in Hz"
	default 930000000

config IEEE802154_S2LP_CHANNEL_SPACE
	int "S2LP frequency spacing in Hz"
	default 100000
	help
	  The frequency spacing that will be used for the computation of the
	  operational frequency.

config IEEE802154_S2LP_DATARATE
	int "S2LP desired datarate in bps"
	default 38400

endif
```

## drivers/ieee802154/Kconfig.silabs_efr32
```kconfig
# SPDX-FileCopyrightText: Copyright (c) 2026 Silicon Laboratories Inc.
# SPDX-License-Identifier: Apache-2.0
#
# Silicon Laboratories EFR32 802.15.4 configuration options

menuconfig IEEE802154_SILABS_EFR32
	bool "Silabs EFR32 IEEE 802.15.4 Driver"
	default y
	depends on DT_HAS_SILABS_EFR32_IEEE802154_ENABLED
	depends on ZEPHYR_HAL_SILABS_MODULE_BLOBS || BUILD_ONLY_NO_BLOBS
	depends on SOC_GECKO_HAS_RADIO
	select SOC_GECKO_USE_RAIL
	select PSA_CRYPTO
	select SILABS_SISDK_PROTOCOL_CRYPTO

if IEEE802154_SILABS_EFR32

config IEEE802154_SILABS_EFR32_INIT_PRIO
	int "Silabs EFR32 IEEE 802.15.4 initialization priority"
	default 80
	help
	  Set the initialization priority number.

config IEEE802154_SILABS_EFR32_BG_RX_PRIORITY
	int "Background RX scheduler priority"
	range 1 255
	default 255
	help
	  Priority used for the EFR32 802.15.4 background RX scheduler slot.
	  Background RX is the passive receive state when the device is not
	  transmitting. In RAIL's multiprotocol scheduler a higher numeric
	  value means lower priority, so the default 255 keeps background
	  RX as the lowest-priority activity. Only relevant on multiprotocol
	  builds (e.g. concurrent BLE + 802.15.4).

config IEEE802154_SILABS_EFR32_TX_PRIORITY_MIN
	int "TX scheduler priority (initial)"
	range 1 255
	default 100
	help
	  Priority used for the first attempt of an 802.15.4 TX in RAIL's
	  multiprotocol scheduler. Smaller numeric values mean higher
	  priority. Only relevant on multiprotocol builds (e.g. concurrent
	  BLE + 802.15.4).

config IEEE802154_SILABS_EFR32_SRC_MATCH_SHORT_MAX
	int "Source-match short-address table size"
	default OPENTHREAD_MAX_CHILDREN if NET_L2_OPENTHREAD
	default 16
	help
	  Maximum number of short addresses tracked in the driver's soft
	  source-match table for outgoing-ACK Frame Pending decisions. In
	  OpenThread builds this defaults to OPENTHREAD_MAX_CHILDREN so the
	  router can track Frame Pending for every sleepy child.

config IEEE802154_SILABS_EFR32_SRC_MATCH_EXT_MAX
	int "Source-match extended-address table size"
	default OPENTHREAD_MAX_CHILDREN if NET_L2_OPENTHREAD
	default 16
	help
	  Maximum number of extended addresses tracked in the driver's soft
	  source-match table. See IEEE802154_SILABS_EFR32_SRC_MATCH_SHORT_MAX.

endif
```

## drivers/ieee802154/Kconfig.stm32wba
```kconfig
# STMicroelectronics STM32WBAxx 802.15.4 configuration options

# Copyright (c) 2025 STMicroelectronics

menuconfig IEEE802154_STM32WBA
	bool "STM32WBA series IEEE 802.15.4 Driver"
	default y
	depends on DT_HAS_ST_STM32WBA_IEEE802154_ENABLED

if IEEE802154_STM32WBA

config IEEE802154_STM32WBA_RX_BUFFERS
	int "STM32WBA 802.15.4 receive buffers"
	default 16
	range 16 128
	help
	  Number of buffers in 802.15.4 driver serialization host's receive queue.
	  Increase this number if you are expected to be in a noisy environment, handling many
	  end-devices and you have sufficient RAM to allocate memory to buffers.
	  If this value is increased, IEEE802154_STM32WBA_RX_STACK_SIZE value might require
	  to be updated as well.

config IEEE802154_STM32WBA_RX_STACK_SIZE
	int "Driver RX thread stack size"
	default 800
	help
	  This option sets the driver's stack size for its internal RX thread.
	  The default value should be sufficient, but in case it proves to be
	  too low, adjust as needed.

config IEEE802154_STM32WBA_CSMA_CA_ENABLED
	bool "CSMA-CA configuration"
	default y
	help
	  This option enables the CSMA-CA feature.

config IEEE802154_STM32WBA_INIT_PRIO
	int "STM32WBA IEEE 802.15.4 initialization priority"
	default 80
	help
	  Set the initialization priority number. Do not mess with it unless
	  you know what you are doing.

config IEEE802154_STM32WBA_DELAY_TRX_ACC
	int "Clock accuracy for delayed operations"
	default 20
	range 0 255
	help
	  Accuracy of the clock used for scheduling radio delayed operations (delayed transmission
	  or delayed reception), in ppm.

config IEEE802154_STM32WBA_LOG_RX_FAILURES
	bool "Frame reception failures logging"
	help
	  There are few cases where the frame reception failure can happen because of
	  internal causes. These cases are reported forward by general code error.

	  This option enables logging the reason of frame reception failure.
	  It can be helpful for the network traffic analysis but it generates also
	  a lot of log records in a stressed environment.

config NET_L2_CUSTOM_IEEE802154_STM32WBA
	bool "Use ST MAC as L2"
	default y
	depends on NET_L2_CUSTOM_IEEE802154
	help
	  Custom STM32WBA series IEEE 802.15.4 L2 Implementation.

endif # IEEE802154_STM32WBA
```
