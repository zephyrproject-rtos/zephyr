## drivers/watchdog/Kconfig.max32
```kconfig
# Copyright (c) 2023 Analog Devices, Inc.
# SPDX-License-Identifier: Apache-2.0

config WDT_MAX32
	bool "MAX32 Watchdog (WDT) Driver"
	default y
	depends on DT_HAS_ADI_MAX32_WATCHDOG_ENABLED
	help
	  Enable WDT driver for MAX32.
```

## drivers/watchdog/Kconfig.mcux
```kconfig
# Watchdog configuration options

# Copyright (c) 2018, NXP
# SPDX-License-Identifier: Apache-2.0

config WDT_MCUX_WDOG
	bool "MCUX WDOG driver"
	default y
	depends on DT_HAS_NXP_KINETIS_WDOG_ENABLED
	depends on CLOCK_CONTROL
	help
	  Enable the mcux wdog driver.

config WDT_MCUX_WDOG32
	bool "MCUX WDOG32 driver"
	default y
	depends on DT_HAS_NXP_KINETIS_WDOG32_ENABLED
	depends on CLOCK_CONTROL
	help
	  Enable the mcux wdog32 driver.

config WDT_MCUX_WWDT
	bool "MCUX WWDT driver"
	default y
	depends on DT_HAS_NXP_LPC_WWDT_ENABLED
	help
	  Enable the mcux wwdt driver.

if WDT_MCUX_WWDT

config WDT_MCUX_WWDT_WARNING_INTERRUPT_CFG
	int "WWDT timeout warning interrupt configuration"
	range 0 1023
	default 0
	help
	  WWDT timeout warning interrupt time. The units are
	  the number of watchdog counter ticks before timeout.

endif # WDT_MCUX_WWDT
```

## drivers/watchdog/Kconfig.mcux_imx
```kconfig
# Watchdog configuration options

# Copyright (c) 2020, NXP
# SPDX-License-Identifier: Apache-2.0

config WDT_MCUX_IMX_WDOG
	bool "MCUX IMX WDOG driver"
	default y
	depends on DT_HAS_NXP_IMX_WDOG_ENABLED
	help
	  Enable the mcux imx wdog driver.
```

## drivers/watchdog/Kconfig.mcux_wdog
```kconfig
# Kconfig - Watchdog configuration options
#
# Copyright (c) 2018, NXP
#
# SPDX-License-Identifier: Apache-2.0
#

menuconfig WDT_MCUX_WDOG
	bool "MCUX WDOG driver"
	depends on HAS_MCUX && CLOCK_CONTROL
	select HAS_DTS_WDT
	help
	  Enable the mcux wdog driver.
```

## drivers/watchdog/Kconfig.nct
```kconfig
# NCT WDT driver configuration options

# Copyright (c) 2024 Nuvoton Technology Corporation.
# SPDX-License-Identifier: Apache-2.0

config WDT_NCT
	bool "Nuvoton NCT enhanced Super I/O controller (eSIO) Watchdog Timer driver"
	default y
	depends on DT_HAS_NUVOTON_NCT_WATCHDOG_ENABLED
	help
	  This option enables the Watchdog Timer driver for NCT family of
	  processors.
	  Say y if you wish to use watchdog on NCT MCU.

config WDT_NCT_DELAY_CYCLES
	int "Number of delay cycles before generating watchdog event/signal"
	depends on WDT_NCT
	range 1 255
	default 10
	help
	  This option defines the window in which a watchdog event must be
	  handled, in units of 31ms. After this time window, the watchdog reset
	  triggers immediately.
```

## drivers/watchdog/Kconfig.neorv32
```kconfig
# NEORV32 watchdog configuration

# Copyright (c) 2024, Calian
# SPDX-License-Identifier: Apache-2.0

config WDT_NEORV32
	bool "NEORV32 Watchdog Timer driver"
	default y
	depends on DT_HAS_NEORV32_WDT_ENABLED
	depends on SYSCON
	help
	  Enable the NEORV32 Watchdog Timer driver.
```

## drivers/watchdog/Kconfig.npcx
```kconfig
# NPCX WDT driver configuration options

# Copyright (c) 2021 Nuvoton Technology Corporation.
# SPDX-License-Identifier: Apache-2.0

config WDT_NPCX
	bool "Nuvoton NPCX embedded controller (EC) Watchdog Timer driver"
	default y
	depends on DT_HAS_NUVOTON_NPCX_WATCHDOG_ENABLED
	select HAS_WDT_DISABLE_AT_BOOT
	help
	  This option enables the Watchdog Timer driver for NPCX family of
	  processors.
	  Say y if you wish to use watchdog on NPCX MCU.

config WDT_NPCX_WARNING_LEADING_TIME_MS
	int "Milliseconds before generating watchdog event/signal"
	depends on WDT_NPCX
	default 500
	help
	  This option defines the window in which a watchdog event must be
	  handled. After this time window, the watchdog reset triggers
	  immediately.

config WDT_NPCX_EX
	bool "Extended NPCX watchdog driver support"
	default y
	depends on $(dt_compat_any_has_prop,$(DT_COMPAT_NUVOTON_NPCX_WATCHDOG),support-npckn-v1,True)
	help
	  This option enables the extended Watchdog Timer driver for NPCKn variant
	  of processors.
```

## drivers/watchdog/Kconfig.npm10xx
```kconfig
# Copyright (c) 2026 Nordic Semiconductor ASA
# SPDX-License-Identifier: Apache-2.0

config WDT_NPM10XX
	bool "nPM10xx Watchdog driver"
	default y
	depends on DT_HAS_NORDIC_NPM10XX_WDT_ENABLED
	select MFD
	help
	  Enable nPM13xx Watchdog driver

config WDT_NPM10XX_INIT_PRIORITY
	int "nPM10xx Watchdog driver initialization priority"
	depends on WDT_NPM10XX
	default 85
	help
	  Initialization priority for the nPM10xx Watchdog driver.
	  It must be greater than MFD_NPM10XX_INIT_PRIORITY.
```

## drivers/watchdog/Kconfig.npm1300
```kconfig
# Copyright (c) 2023 Nordic Semiconductor ASA
# SPDX-License-Identifier: Apache-2.0

config WDT_NPM1300
	bool "nPM1300 Watchdog driver"
	default y
	depends on DT_HAS_NORDIC_NPM1300_WDT_ENABLED
	select I2C
	select MFD
	help
	  Enable nPM1300 Watchdog driver

config WDT_NPM1300_INIT_PRIORITY
	int "nPM1300 Watchdog driver initialization priority"
	depends on WDT_NPM1300
	default 85
	help
	  Initialization priority for the nPM1300 Watchdog driver.
	  It must be greater than GPIO_NPM1300_INIT_PRIORITY.
```

## drivers/watchdog/Kconfig.npm13xx
```kconfig
# Copyright (c) 2023 Nordic Semiconductor ASA
# SPDX-License-Identifier: Apache-2.0

config WDT_NPM13XX
	bool "nPM13xx Watchdog driver"
	default y
	depends on DT_HAS_NORDIC_NPM1300_WDT_ENABLED || DT_HAS_NORDIC_NPM1304_WDT_ENABLED
	select I2C
	select MFD
	help
	  Enable nPM13xx Watchdog driver

config WDT_NPM13XX_INIT_PRIORITY
	int "nPM13xx Watchdog driver initialization priority"
	depends on WDT_NPM13XX
	default 85
	help
	  Initialization priority for the nPM13xx Watchdog driver.
	  It must be greater than GPIO_NPM13XX_INIT_PRIORITY.
```

## drivers/watchdog/Kconfig.npm2100
```kconfig
# Copyright (c) 2024 Nordic Semiconductor ASA
# SPDX-License-Identifier: Apache-2.0

config WDT_NPM2100
	bool "nPM2100 Watchdog driver"
	default y
	depends on DT_HAS_NORDIC_NPM2100_WDT_ENABLED
	select I2C
	select MFD
	help
	  Enable nPM2100 Watchdog driver

config WDT_NPM2100_INIT_PRIORITY
	int "nPM2100 Watchdog driver initialization priority"
	depends on WDT_NPM2100
	default 85
	help
	  Initialization priority for the nPM2100 Watchdog driver.
	  It must be greater than GPIO_NPM2100_INIT_PRIORITY.
```

## drivers/watchdog/Kconfig.npm6001
```kconfig
# Copyright (c) 2022 Nordic Semiconductor ASA
# SPDX-License-Identifier: Apache-2.0

config WDT_NPM6001
	bool "nPM6001 Watchdog driver"
	default y
	depends on DT_HAS_NORDIC_NPM6001_WDT_ENABLED
	select I2C
	help
	  Enable nPM6001 Watchdog driver

config WDT_NPM6001_INIT_PRIORITY
	int "nPM6001 Watchdog driver initialization priority"
	depends on WDT_NPM6001
	default 60
	help
	  Initialization priority for the nPM6001 Watchdog driver. It must be
	  greater than the I2C controller init priority.
```

## drivers/watchdog/Kconfig.nrf52
```kconfig
# Kconfig - Nordic nRF52x WDT configuration
#
# Copyright (c) 2018 Intellinium.
# SPDX-License-Identifier: Apache-2.0

menuconfig WDT_NRF52
	bool "nRF52 series Watchdog (WDT) Driver"
	depends on WATCHDOG && SOC_FAMILY_NRF5
	default y
	help
	  Enable WDT driver for nRF52 MCUs.

config WDT_IRQ_PRI
	int "IRQ priority"
	default 2
```

## drivers/watchdog/Kconfig.nrf_gswdt
```kconfig
# Copyright (c) 2026 Nordic Semiconductor ASA
# SPDX-License-Identifier: Apache-2.0

config WDT_NRF_GSWDT
	bool "Nordic Global Software Watchdog Timer (GSWDT) driver"
	depends on DT_HAS_NORDIC_NRF_GSWDT_ENABLED
	default y
	select MBOX
	select HAS_WDT_NO_CALLBACKS
	help
	  This option enables the Nordic Global Software Watchdog Timer
	  (GSWDT) driver.
```

## drivers/watchdog/Kconfig.nrfx
```kconfig
# nrfx WDT support

# Copyright (c) 2018, Nordic Semiconductor ASA
# SPDX-License-Identifier: Apache-2.0

config WDT_NRFX
	bool "nRF WDT nrfx driver"
	default y
	depends on DT_HAS_NORDIC_NRF_WDT_ENABLED
	select NRFX_WDT
	help
	  Enable support for nrfx WDT driver for nRF MCU series.

config WDT_NRFX_NO_IRQ
	bool "nRF WDT nrfx driver without IRQ enabled"
	depends on WDT_NRFX
	help
	  Disable use of WDT interrupt in driver.
```

## drivers/watchdog/Kconfig.numaker
```kconfig
# NUMAKER Watchdog Driver configuration options

# Copyright (c) 2024 Nuvoton Technology Corporation.
# SPDX-License-Identifier: Apache-2.0

config WWDT_NUMAKER
	bool "Nuvoton NUMAKER MCU Window Watchdog driver"
	default y
	depends on DT_HAS_NUVOTON_NUMAKER_WWDT_ENABLED
	help
	  This option enables the window watchdog driver for Nuvoton NuMaker family of
	  processors.

config WDT_NUMAKER
	bool "Nuvoton NUMAKER MCU Watchdog driver"
	default y
	depends on DT_HAS_NUVOTON_NUMAKER_WDT_ENABLED
	help
	  This option enables the watchdog driver for Nuvoton NuMaker family of
	  processors.
```

## drivers/watchdog/Kconfig.nxp_ewm
```kconfig
# Copyright 2025 NXP
# SPDX-License-Identifier: Apache-2.0

config WDT_NXP_EWM
	bool "NXP EWM driver"
	default y
	depends on DT_HAS_NXP_EWM_ENABLED
	help
	  Enable the nxp ewm driver.
```

## drivers/watchdog/Kconfig.nxp_fs26
```kconfig
# Copyright 2023 NXP
# SPDX-License-Identifier: Apache-2.0

menuconfig WDT_NXP_FS26
	bool "NXP FS26 SBC watchdog driver"
	default y
	depends on DT_HAS_NXP_FS26_WDOG_ENABLED
	select SPI
	select GPIO
	help
	  Enable the NXP FS26 SBC watchdog driver.

if WDT_NXP_FS26

config WDT_NXP_FS26_INIT_PRIORITY
	int
	default 80
	help
	  Device driver initialization priority. Device is connected to SPI bus,
	  so it has to be initialized after SPI driver.

config WDT_NXP_FS26_ERROR_COUNTER_LIMIT
	int "Watchdog error counter limit"
	default 6
	help
	  Sets the maximum value of the watchdog error counter. Each time a
	  watchdog failure occurs, the device increments this counter by 2. The
	  watchdog error counter is decremented by 1 each time the watchdog is
	  properly refreshed.

	  Possible values are 2, 4, 6, 8.

config WDT_NXP_FS26_REFRESH_COUNTER_LIMIT
	int "Watchdog refresh counter limit"
	default 6
	help
	  Sets the maximum value of the watchdog refresh counter. Each time the
	  watchdog is properly refreshed, this counter is incremented by 1. Each
	  time this counter reaches its maximum value and if the next refresh is
	  also good, the fault error counter is decremented by 1. Each time
	  there is a bad watchdog refresh, this counter is reset to 0.

	  Possible values are 1, 2, 4, 6.

config WDT_NXP_FS26_SEED
	hex "Watchdog seed"
	default 0x5ab2
	range 0x0 0xffff
	help
	  Seed to pass to the device. This property can be used with both simple
	  and challenger watchdog configurations. In simple watchdog
	  configuration, values 0xffff and 0x0000 are not allowed. In challenger
	  watchdog configuration, value 0x0000 is not allowed.

config WDT_NXP_FS26_EXIT_DEBUG_MODE
	bool "Exit DEBUG mode"
	help
	  If the device is started in DEBUG mode, the driver will exit this mode
	  so that the watchdog is enabled. Otherwise, if the device is in DEBUG
	  mode and this driver is enabled, it will fail to initialize.

config WDT_NXP_FS26_INT_THREAD_STACK_SIZE
	int "Stack size for internal interrupt handler"
	default 1024
	help
	  Size of the stack used for internal thread which is ran for
	  interrupt processing.

config WDT_NXP_FS26_INT_THREAD_PRIO
	int "Priority for internal incoming packet handler"
	default 2
	help
	  Priority level for internal cooperative thread which is ran for
	  interrupt processing.

endif # WDT_NXP_FS26
```

## drivers/watchdog/Kconfig.nxp_s32
```kconfig
# Copyright 2022-2023 NXP
# SPDX-License-Identifier: Apache-2.0

config WDT_NXP_S32
	bool "NXP S32 SWT driver"
	default y
	depends on DT_HAS_NXP_S32_SWT_ENABLED
	select CLOCK_CONTROL
	select NOCACHE_MEMORY if ARCH_HAS_NOCACHE_MEMORY_SUPPORT
	help
	  Enable the Software Watchdog Timer (SWT) driver.
```

## drivers/watchdog/Kconfig.opentitan
```kconfig
# OpenTitan Always-On Timer support

# Copyright (c) 2023, Rivos Inc.
# SPDX-License-Identifier: Apache-2.0

config WDT_OPENTITAN
	bool "OpenTitan Always-On (AON) Timer"
	depends on DT_HAS_LOWRISC_OPENTITAN_AONTIMER_ENABLED
	default y
	select HAS_WDT_MULTISTAGE
	help
	  This option enables support for the watchdog portion of the OpenTitan AON
	  timer.
```

## drivers/watchdog/Kconfig.pic32cxsg
```kconfig
# Microchip PIC32CXSG WDT configuration

# Copyright (c) 2024 Microchip
# SPDX-License-Identifier: Apache-2.0

config WDT_PIC32CXSG
	bool "Microchip PIC32CXSG series Watchdog (WDT) Driver"
	default y
	depends on DT_HAS_PIC32CXSG_WATCHDOG_ENABLED
	help
	  Enable WDT driver for Microchip PIC32CXSG MCUs.
```

## drivers/watchdog/Kconfig.qmsi
```kconfig
# Kconfig - Watchdog configuration options for QMSI WDT
#
#
# Copyright (c) 2015 Intel Corporation
#
# SPDX-License-Identifier: Apache-2.0
#

config WDT_QMSI
	bool "QMSI Watchdog driver"
	select HAS_DTS_WDT
	help
	  This option enables the QMSI watchdog driver.
	  This driver is simply a shim driver based on the watchdog
	  driver provided by the QMSI BSP.

config WDT_QMSI_API_REENTRANCY
	bool "WDT shim driver API reentrancy"
	depends on WDT_QMSI
	help
	  Enable support for WDT shim driver API reentrancy.
```

## drivers/watchdog/Kconfig.rda5981a
```kconfig
#
# Copyright (c) 2017 RDA
# Copyright (c) 2016-2017 Linaro Limited
#
# SPDX-License-Identifier: Apache-2.0
#

if SOC_FAMILY_RDA5981

config WDT_RDA5981A
	bool "RDA5981A Watchdog Driver for RDA5981 family of MCUs"
	default n
	help
	 Enable WDG driver for RDA5981 line of MCUs

config WDT_RDA5981A_DEVICE_NAME
	string "Device name for RDA5981A Watchdog"
	depends on WDT_RDA5981A
	default "WDT"
	help
	 Set the name used by WDT device during registration.

endif # SOC_FAMILY_RDA5981
```

## drivers/watchdog/Kconfig.renesas_rx
```kconfig
# Renesas RX Watchdog configuration

# Copyright (c) 2025 Renesas Electronics Corporation
# SPDX-License-Identifier: Apache-2.0

config WDT_RENESAS_RX_IWDT
	bool "Renesas RX Series Independent Watchdog Driver"
	default y
	depends on DT_HAS_RENESAS_RX_IWDT_ENABLED
	select HAS_WDT_DISABLE_AT_BOOT if WDT_RENESAS_RX_IWDT_REGISTER_START_MODE
	select USE_RX_RDP_IWDT
	help
	  Enable Renesas RX series watchdog driver.

if WDT_RENESAS_RX_IWDT

config WDT_RENESAS_RX_IWDT_USE_NMI
	bool "Non-maskable interrupt for IWDT"
	default y
	help
	  Enable NMI for IWDT.

choice
	prompt "IWDT Start Mode"
	default WDT_RENESAS_RX_IWDT_REGISTER_START_MODE
	help
	  Select the IWDT start mode.
	  - WDT_RENESAS_RX_IWDT_AUTO_START_MODE: Counting automatically starts after a reset
	  (auto-start mode), controlled by option function select register 0 (OFS0).
	  - WDT_RENESAS_RX_IWDT_REGISTER_START_MODE: Counting is started by refreshing the counter.
	  (controlled by the IWDT registers)

config WDT_RENESAS_RX_IWDT_AUTO_START_MODE
	bool "Start IWDT automatically on reset"

config WDT_RENESAS_RX_IWDT_REGISTER_START_MODE
	bool "IWDT Start Mode Select"

endchoice

endif # WDT_RENESAS_RX_IWDT
```

## drivers/watchdog/Kconfig.renesas_rz
```kconfig
# Copyright (c) 2025 Renesas Electronics Corporation
# SPDX-License-Identifier: Apache-2.0

config WDT_RENESAS_RZ
	bool "Watchdog Driver for Renesas RZ"
	default y
	depends on DT_HAS_RENESAS_RZ_WDT_ENABLED
	select HAS_WDT_DISABLE_AT_BOOT
	select USE_RZ_FSP_WDT
	help
	  Enable watchdog driver for Renesas RZ

if WDT_RENESAS_RZ

config WDT_RENESAS_RZ_USE_ICU
	bool "Watchdog generates interrupt requests signal"
	default y
	depends on SOC_SERIES_RZT2M || SOC_SERIES_RZN2L
	help
	  Watchdog generates interrupt requests signal

endif # WDT_RENESAS_RZ
```
