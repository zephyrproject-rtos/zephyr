## drivers/wifi/infineon/Kconfig.airoc
```kconfig
# Copyright (c) 2023 Cypress Semiconductor Corporation (an Infineon company) or
# an affiliate of Cypress Semiconductor Corporation
# SPDX-License-Identifier: Apache-2.0

menuconfig WIFI_AIROC
	bool "Infineon AIROC SoC Wi-Fi support"
	depends on DT_HAS_INFINEON_AIROC_WIFI_ENABLED
	default y
	select THREAD_CUSTOM_DATA
	select WIFI_OFFLOAD
	select NET_L2_ETHERNET
	select NET_L2_WIFI_MGMT
	select GPIO
	select WIFI_USE_NATIVE_NETWORKING
	select USE_INFINEON_ABSTRACTION_RTOS
	help
	  Enable Infineon AIROC SoC Wi-Fi support.

if WIFI_AIROC

config AIROC_WIFI_BUS_SDIO
	bool
	default y
	depends on $(dt_compat_on_bus,$(DT_COMPAT_INFINEON_AIROC_WIFI),sd)
	select SDHC
	select SDIO_STACK
	help
	  Enable SDIO bus support.

config AIROC_WIFI_BUS_SPI
	bool
	default y
	depends on $(dt_compat_on_bus,$(DT_COMPAT_INFINEON_AIROC_WIFI),spi)
	select SPI
	help
	  Enable SPI bus support

config AIROC_WIFI6
	bool

config AIROC_WIFI_EVENT_TASK_STACK_SIZE
	int "Event Task Stack Size"
	default 4096

config AIROC_WIFI_EVENT_TASK_PRIO
	int "Event Task Priority"
	default 4

config AIROC_WLAN_MFG_FIRMWARE
	bool "WLAN Manufacturing Firmware"
	help
	  Enable WLAN Manufacturing Firmware.

config WHD_WIFI_COUNTRY
	string "Wifi couuntry option"
	default "WHD_COUNTRY_UNITED_STATES" if CYW55572 || CYW55500
	default "WHD_COUNTRY_AUSTRALIA"
	help
	  Sets the country, this will operate in for wifi initialization
	  parameters. See the wifi-host-driver's whd_country_code_t for legal options.

config WHD_DISABLE_SDIO_PULLUP_DURING_SPI_SLEEP
	bool "Disable SDIO pullups during SPI sleep"
	help
	  Clears SDIO pullups when the SPI bus is configured for sleep.
	  By default, this option is set to n, so SDIO pullups will be enabled.

config AIROC_WIFI_CUSTOM
	bool "Custom CYW43xx device/module"
	help
	  Select Custom CYW43xx device/module. For this option,
	  user must to provide path to FW, CLM and NVRAM for
	  custom or vendor CYW43xx modules.

choice  AIROC_PART
	prompt "Select AIROC part"
	depends on !AIROC_WIFI_CUSTOM

config CYW4343W
	bool "CYW4343W"
	help
	  Enable Infineon AIROC CYW4343W Wi-Fi connectivity,
	  More information about CYW4343W device you can find on
	  https://www.infineon.com/cms/en/product/wireless-connectivity/airoc-wi-fi-plus-bluetooth-combos/cyw4343w/

config CYW4373
	bool "CYW4373"
	help
	  Enable Infineon AIROC CYW4373 Wi-Fi connectivity,
	  More information about CYW4373 device you can find on
	  https://www.infineon.com/cms/en/product/wireless-connectivity/airoc-wi-fi-plus-bluetooth-combos/cyw4373/

config CYW43012
	bool "CYW43012"
	help
	  Enable Infineon AIROC CYW43012 Wi-Fi connectivity,
	  More information about CYW43012 device you can find on
	  https://www.infineon.com/cms/en/product/wireless-connectivity/airoc-wi-fi-plus-bluetooth-combos/cyw43012/

config CYW43022
	bool "CYW43022"
	help
	  Enable Infineon AIROC CYW43022 Wi-Fi connectivity,
	  More information about CYW43022 device you can find on
	  https://www.infineon.com/cms/en/product/wireless-connectivity/airoc-wi-fi-plus-bluetooth-combos/wi-fi-5-802.11ac/cyw43022/

config CYW43438
	bool "CYW43438"
	help
	  Enable Infineon AIROC CYW43438 Wi-Fi connectivity,
	  More information about CYW43438 device you can find on
	  https://www.infineon.com/cms/en/product/wireless-connectivity/airoc-wi-fi-plus-bluetooth-combos/cyw43438/

config CYW43439
	bool "CYW43439"
	help
	  Enable Infineon AIROC CYW43439 Wi-Fi connectivity,
	  More information about CYW43439 device you can find on
	  https://www.infineon.com/cms/en/product/wireless-connectivity/airoc-wi-fi-plus-bluetooth-combos/cyw43439/

config CYW55500
	bool "CYW55500"
	select AIROC_WIFI6
	help
	  Enable Infineon AIROC CYW55500 Wi-Fi connectivity,
	  More information about CYW55500 device you can find on
	  https://www.infineon.com/cms/en/product/wireless-connectivity/airoc-wi-fi-plus-bluetooth-combos/wi-fi-6-6e-802.11ax/cyw55511/

config CYW55572
	bool "CYW55572"
	select AIROC_WIFI6
	help
	  Enable Infineon AIROC CYW55572 Wi-Fi connectivity,
	  More information about CYW55572 device you can find on
	  https://www.infineon.com/cms/en/product/wireless-connectivity/airoc-wi-fi-plus-bluetooth-combos/wi-fi-6-6e-802.11ax/cyw55572/

endchoice

choice CYW43012_MODULE
	prompt "Select CYW43012 module"
	depends on CYW43012 && !AIROC_WIFI_CUSTOM

config CYW43012_MURATA_1LV
	bool "MURATA-1LV"
	help
	  Murata Type 1LV module based on Infineon CYW43012 combo chipset
	  which supports Wi-Fi® 802.11a/b/g/n + Bluetooth® 5.0 BR/EDR/LE
	  up to 72.2Mbps PHY data rate on Wi-fi® and 3Mbps PHY data rate
	  on Bluetooth®. 2Mbps LE PHY is also supported.

	  Detailed information about Murata Type 1LV module you can find on
	  https://www.murata.com/en-us/products/connectivitymodule/wi-fi-bluetooth/overview/lineup/type1lv
endchoice

choice CYW43022_MODULE
	prompt "Select CYW43022 module"
	depends on CYW43022 && !AIROC_WIFI_CUSTOM

config CYW43022CUB
	bool "CYW43022CUB"
	help
	  Infineon CYW43022CUB M2 module

	  Detailed information about CYW43022CUB module you can find on
	  https://www.infineon.com/cms/en/product/wireless-connectivity/airoc-wi-fi-plus-bluetooth-combos/wi-fi-5-802.11ac/cyw43022/
endchoice

choice CYW4343W_MODULE
	prompt "Select CYW4343W module"
	depends on CYW4343W && !AIROC_WIFI_CUSTOM

config CYW4343W_MURATA_1DX
	bool "MURATA-1DX"
	help
	  Murata Type 1DX modules based on Infineon CYW4343W combo chipset
	  which supports Wi-Fi® 802.11b/g/n + Bluetooth® 5.1 BR/EDR/LE
	  up to 65Mbps PHY data rate on Wi-fi® and 3Mbps PHY data rate
	  on Bluetooth®.

	  Detailed information about Type 1DX module you can find on
	  https://www.murata.com/en-us/products/connectivitymodule/wi-fi-bluetooth/overview/lineup/type1dx
endchoice

choice CYW4373_MODULE
	prompt "Select CYW4373 module"
	depends on CYW4373 && !AIROC_WIFI_CUSTOM


config CYW4373_MURATA_2AE
	bool "CYW4373_MURATA_2AE"
	help
	  Murata Type 2AE modules based on Infineon CYW4373 combo chipset

	  Detailed information about Murata Type 2AE module you can find on
	  https://www.murata.com/en-us/products/connectivitymodule/wi-fi-bluetooth/overview/lineup/type2ae

config CYW4373_MURATA_2BC
	bool "CYW4373_MURATA_2BC"
	help
	  Murata Type 2BC modules based on Infineon CYW4373 combo chipset

	  Detailed information about Murata Type 2BC module you can find on
	  https://www.murata.com/en-us/products/connectivitymodule/wi-fi-bluetooth/overview/lineup/type2bc

config CYW4373_STERLING_LWB5PLUS
	bool "STERLING-LWB5plus"
	help
	  Ezurio Sterling LWB5+ 802.11ac / Bluetooth 5.0 M.2 Carrier Board
	  (E-Type Key w/ SDIO/UART)

	  Detailed information about Sterling LWB5+ module you can find on
	  https://www.ezurio.com/wireless-modules/wifi-modules-bluetooth/sterling-lwb5-plus-wifi-5-bluetooth-5-module
endchoice

choice CYW43439_MODULE
	prompt "Select CYW43439 module"
	depends on CYW43439 && !AIROC_WIFI_CUSTOM

config CYW43439_MURATA_1YN
	bool "MURATA_1YN"
	help
	  Murata Type 1YN module based on Infineon CYW43439 combo chipset
	  which supports Wi-Fi® 802.11b/g/n + Bluetooth® 5.2 BR/EDR/LE
	  up to 65Mbps PHY data rate on Wi-fi® and 3Mbps PHY data rate on
	  Bluetooth®.

	  Detailed information about Murata Type 1YN module you can find on
	  https://www.murata.com/en-us/products/connectivitymodule/wi-fi-bluetooth/overview/lineup/type1yn

config CYW43439_STERLING_LWBPLUS
	bool "STERLING-LWBplus"
	help
	  Ezurio Sterling-LWB+ WiFi 4 with Bluetooth 5.2 module
	  Detailed information about this module you can find on
	  https://www.ezurio.com/wireless-modules/wifi-modules-bluetooth/sterling-lwb-wifi-4-and-bluetooth-52-modules

endchoice

choice CYW55500_MODULE
	prompt "Select CYW55500 module"
	depends on CYW55500 && !AIROC_WIFI_CUSTOM

config CYW955513SDM2WLIPA_SM
	bool "CYW955513SDM2WLIPA_SM"
	help
	  Infineon CYW955513SDM2WLIPA (SM) module
endchoice

choice CYW55572_MODULE
	prompt "Select CYW55572 module"
	depends on CYW55572 && !AIROC_WIFI_CUSTOM

config CYW955573M2IPA1_SM
	bool "CYW955573M2IPA1_SM"
	help
	  Infineon CYW955573M2IPA1 (SM) module
endchoice

endif # AIROC_WIFI
```

## drivers/wifi/infineon/Kconfig.cyw43xxx
```kconfig
# Copyright (c) 2022 Cypress Semiconductor Corporation (an Infineon company) or
# an affiliate of Cypress Semiconductor Corporation
# SPDX-License-Identifier: Apache-2.0

menuconfig WIFI_CYW43XXX
	bool "Infineon CYW43xxx SoC Wi-Fi support"
	select THREAD_CUSTOM_DATA
	select USE_INFINEON_SDIO
	  depends on DT_HAS_INFINEON_CYW43XXX_WIFI_SDIO_ENABLED
	help
	  Enable Infineon CYW43xxx SoC Wi-Fi support.

	  Infineon's AIROC™ Wi-Fi & combos portfolio integrates IEEE 802.11a/b/g/n/ac/ax Wi-Fi and Bluetooth® 5.2
	  in a single-chip solution to enable small-form-factor IoT designs. Combo, standalone Wi-Fi, and Wi-Fi SoCs
	  with embedded MCU and on-chip networking capabilities are also offered in 1x1 SISO and 2x2 MIMO configurations.

if WIFI_CYW43XXX

# Enable Zephyr variant of Abstraction RTOS
config ABSTRACTION_RTOS_COMPONENT_ZEPHYR
	bool
	default y

# For WIFI_CYW43XXX, MINIMAL_LIBC_MALLOC must be disabled
config MINIMAL_LIBC_MALLOC
	bool
	default n

config CYW43XXX_WIFI_SSID
	string "SSID of Wi-Fi network"
	help
	  SSID (network name) for the application to connect to.

config CYW43XXX_WIFI_PASSWORD
	string "Password (WPA or WPA2) of Wi-Fi network"
	help
	  WiFi password (WPA or WPA2) for the example to use.

config CYW43XXX_WIFI_EVENT_TASK_STACK_SIZE
	int "Event Task Stack Size"
	default 4096

config CYW43XXX_WIFI_EVENT_TASK_PRIO
	int "Event Task Priority"
	default 4

choice CYW43XXX_PART
	prompt "Select CYW43XXX part"


config CYW4343W
	bool "CYW4343W"
	help
	  Enable Infineon CYW4343W Wi-Fi connectivity,
	  More information about CYW4343W device you can find on
	  https://www.infineon.com/cms/en/product/wireless-connectivity/airoc-wi-fi-plus-bluetooth-combos/cyw4343w/

config CYW4373
	bool "CYW4373"
	help
	  Enable Infineon CYW4373 Wi-Fi connectivity,
	  More information about CYW4373 device you can find on
	  https://www.infineon.com/cms/en/product/wireless-connectivity/airoc-wi-fi-plus-bluetooth-combos/cyw4373/

config CYW43012
	bool "CYW43012"
	help
	  Enable Infineon CYW43012 Wi-Fi connectivity,
	  More information about CYW43012 device you can find on
	  https://www.infineon.com/cms/en/product/wireless-connectivity/airoc-wi-fi-plus-bluetooth-combos/cyw43012/

config CYW43438
	bool "CYW43438"
	help
	  Enable Infineon CYW43438 Wi-Fi connectivity,
	  More information about CYW43438 device you can find on
	  https://www.infineon.com/cms/en/product/wireless-connectivity/airoc-wi-fi-plus-bluetooth-combos/cyw43438/

config CYW43439
	bool "CYW43439"
	help
	  Enable Infineon CYW43439 Wi-Fi connectivity,
	  More information about CYW43439 device you can find on
	  https://www.infineon.com/cms/en/product/wireless-connectivity/airoc-wi-fi-plus-bluetooth-combos/cyw43439/


choice CYW43012_MODULE
	prompt "Select CYW43012 module"
	depends on CYW43012

config CYW43012_MURATA_1LV
	bool "MURATA-1LV"

config CYW43012_CYSBSYS_RP01
	bool "CYSBSYS-RP01"

config CYW43012_WM_BAC_CYW_50
	bool "WM-BAC-CYW-50"

config CYW43012_CUSTOM
	bool "Custom CYW43012 module"
endchoice


choice CYW4343W_MODULE
	prompt "Select CYW4343W module"
	depends on CYW4343W


config CYW4343W_MURATA_1DX
	bool "MURATA-1DX"

config CYW4343W_CUSTOM
	bool "Custom CYW4343W module"

endchoice


choice CYW4373_MODULE
	prompt "Select CYW4373 module"
	depends on CYW4373

config CYW4373_STERLING_LWB5PLUS
	bool "STERLING-LWB5plus"

config CYW4373_CUSTOM
	bool "Custom CYW4373 module"

endchoice


choice CYW43438_MODULE
	prompt "Select CYW43438 module"
	depends on CYW43438

config CYW43438_AW_CU427_P
	bool "AW-CU427-P"

config CYW43438_CUSTOM
	bool "Custom CYW43438 module"

endchoice


choice CYW43439_MODULE
	prompt "Select CYW43439 module"
	depends on CYW43439

config CYW43439_MURATA_1YN
	bool "MURATA_1YN"

config CYW43439_CYW943439M2IPA
	bool "CYW943439M2IPA1"

config CYW43439_CUSTOM
	bool "Custom CYW43439 module"

endchoice
endchoice

endif # WIFI_CY43XXX
```

## drivers/wifi/infineon/Kconfig.infineon_wifi
```kconfig
# Copyright (c) 2022 Cypress Semiconductor Corporation (an Infineon company) or
# an affiliate of Cypress Semiconductor Corporation
# SPDX-License-Identifier: Apache-2.0

source "drivers/wifi/infineon/Kconfig.cyw43xxx"
```

## drivers/wifi/native_sim/Kconfig.native_sim
```kconfig
# Native-sim wifi driver configuration options

# Copyright (c) 2023 Nordic Semiconductor ASA
# SPDX-License-Identifier: Apache-2.0

menuconfig WIFI_NATIVE_SIM
	bool "Simple WiFi driver for native-sim board"
	default y
	depends on ARCH_POSIX
	# 32-bit native_sim only (not native_sim/native/64), for two reasons:
	#  - the driver links the host 32-bit libnl (i686-linux-gnu), which only
	#    links into a 32-bit image; and
	#  - the hostap sources it pulls in use "%d" for size_t in several printf
	#    calls, which warns (and fails under warnings-as-errors) on 64-bit.
	depends on !64BIT
	depends on WIFI_NM_WPA_SUPPLICANT
	# Opt-in: the driver is only built when a "zephyr,native-sim-wifi" node is
	# present in the devicetree (add one via an overlay to enable it). The MAC
	# address and the host interface name come from that node.
	depends on DT_HAS_ZEPHYR_NATIVE_SIM_WIFI_ENABLED
	select NET_L2_WIFI_MGMT
	select WIFI_USE_NATIVE_NETWORKING
	select NET_INTERFACE_NAME
	help
	  Enable native-sim WiFi support. This is currently only usable
	  for simple verification of the hostap APIs etc.

if WIFI_NATIVE_SIM

config WIFI_NATIVE_SIM_RX_WAIT_TIME
	int "Wifi RX timeout (ms)"
	default 50
	range 1 100
	help
	  Native sim wifi driver repeatedly checks for new data.
	  Specify how long the thread sleeps between these checks if no new data
	  available.

config WIFI_NATIVE_SIM_SUPPLICANT_LOG_FILE
	string "zephyr-host-wpa_supplicant.log"
	help
	  wpa_supplicant log file for host side output.

endif # WIFI_NATIVE_SIM
```
