## drivers/wifi/brcmfmac/Kconfig.brcmfmac
```kconfig
# Copyright (c) 2026 Jonathan Elliot Peace <jep@alphabetiq.com>
# SPDX-License-Identifier: Apache-2.0

menuconfig WIFI_BRCMFMAC
	bool "Broadcom BCM43xxx SDIO Wi-Fi (brcmfmac)"
	depends on DT_HAS_BRCM_BCM43XXX_SDIO_ENABLED
	default y
	select WIFI_USE_NATIVE_NETWORKING
	select NET_L2_ETHERNET
	select NET_L2_WIFI_MGMT
	select SDHC
	select SDIO_STACK
	select GPIO
	help
	  Native-L2 driver for SDIO-attached Broadcom/Cypress combo chips
	  speaking the brcmfmac SDPCM+BCDC protocol. The chip handles
	  802.11; Zephyr's ethernet/IP stack runs on top. Firmware and
	  per-board NVRAM are supplied by the hal_broadcom module via
	  `west blobs fetch hal_broadcom`.

	  When using samples/net/wifi/shell, raise
	  CONFIG_NET_MGMT_EVENT_STACK_SIZE to 4096 -- the 768-byte default
	  overflows on scan-result formatting (each AP raises a net_mgmt
	  event whose handler prints a row).

if WIFI_BRCMFMAC

config WIFI_BRCMFMAC_FIRMWARE_FILE
	string "Firmware file name (under hal_broadcom blobs)"
	default "brcmfmac43436s-sdio.bin"
	help
	  Name of the brcmfmac firmware blob under
	  ${ZEPHYR_HAL_BROADCOM_MODULE_DIR}/zephyr/blobs/img/brcmfmac/.
	  Set by the board defconfig to match the on-board chip.

config WIFI_BRCMFMAC_NVRAM_FILE
	string "NVRAM file name (under hal_broadcom blobs)"
	default "brcmfmac43436s-sdio.txt"
	help
	  Name of the brcmfmac per-board NVRAM blob under
	  ${ZEPHYR_HAL_BROADCOM_MODULE_DIR}/zephyr/blobs/img/brcmfmac/.
	  Encodes board-specific antenna, calibration and PA settings.

config WIFI_BRCMFMAC_CLM_FILE
	string "CLM blob file name (under hal_broadcom blobs)"
	default ""
	help
	  Optional Country Locale Matrix blob under
	  ${ZEPHYR_HAL_BROADCOM_MODULE_DIR}/zephyr/blobs/img/brcmfmac/.
	  Required for trim-on-build (TOB) firmware images that ship with
	  the CLM regulatory database stripped out (e.g. BCM43458F, or the
	  RPi-Distro 43430A1 image): without it the radio stays
	  country-disabled -- country reads back as the null code "#n" and
	  radio ops fail BCME_NOTUP. Firmware with a built-in CLM (e.g. the
	  43436s image) does not need it. Leave empty to skip CLM upload
	  entirely -- the driver links a zero-length blob in that case.

config WIFI_BRCMFMAC_COUNTRY
	string "Regulatory country code (ISO3166 alpha2, empty = CLM default)"
	default ""
	help
	  Country code pushed to the firmware after WLC_UP via the
	  "country" iovar, sent as alpha2 with rev=0 (the fallback Linux
	  uses for this chip family). Leave empty to keep the firmware /
	  CLM default domain. The code must exist in the firmware's CLM
	  or the set is rejected and the default is kept.

config WIFI_BRCMFMAC_RX_THREAD_STACK_SIZE
	int "RX thread stack size"
	default 4096
	help
	  Stack for the dedicated RX polling thread that drains F2 and
	  dispatches frames by SDPCM channel.

config WIFI_BRCMFMAC_RX_THREAD_PRIO
	int "RX thread priority"
	default 4

endif # WIFI_BRCMFMAC
```

## drivers/wifi/emul/Kconfig.emul
```kconfig
# SPDX-FileCopyrightText: 2026 Basalte bv
# SPDX-License-Identifier: Apache-2.0

config WIFI_EMUL
	bool "Emulated Wi-Fi offload driver [EXPERIMENTAL]"
	default y
	depends on DT_HAS_ZEPHYR_WIFI_EMUL_ENABLED
	select NET_L2_ETHERNET
	select NET_ETHERNET_RECV_REDIRECT
	select WIFI_USE_NATIVE_NETWORKING
	select EXPERIMENTAL
	help
	  Enable the emulated Wi-Fi offload driver, a test double that mimics
	  a board that only has Wi-Fi connectivity. Scan results, connection
	  results and Wi-Fi events are controlled at runtime through the API
	  in zephyr/drivers/wifi/wifi_emul.h. The data plane is optional: the
	  driver is self-contained by default and can optionally bridge to an
	  Ethernet device to carry real packets once "connected".

if WIFI_EMUL

config WIFI_EMUL_AP_COUNT_MAX
	int "Maximum number of emulated access points"
	default 8
	help
	  Maximum number of virtual access points that can be registered
	  with the emulated Wi-Fi driver.

config WIFI_EMUL_SCAN_DELAY_MS
	int "Default scan duration in milliseconds"
	default 10
	help
	  Default time between a scan request and the delivery of the scan
	  results. Can be changed at runtime with wifi_emul_set_scan_delay().

config WIFI_EMUL_CONNECT_DELAY_MS
	int "Default connect duration in milliseconds"
	default 10
	help
	  Default time between a connect request and the delivery of the
	  connect result. Can be changed at runtime with
	  wifi_emul_set_connect_delay().

endif # WIFI_EMUL
```

## drivers/wifi/esp/Kconfig.esp
```kconfig
# Copyright (c) 2019 Tobias Svehagen
# SPDX-License-Identifier: Apache-2.0

menuconfig WIFI_ESP
	bool "Espressif ESP8266 and ESP32 support"
	select MODEM
	select MODEM_CONTEXT
	select MODEM_CMD_HANDLER
	select MODEM_IFACE_UART
	select NET_L2_WIFI_MGMT
	select WIFI_OFFLOAD

if WIFI_ESP

config WIFI_ESP_NAME
	string "Driver name"
	default "esp-wifi-modem"

config WIFI_ESP_RX_STACK_SIZE
	int "Stack size for the Espressif esp wifi driver RX thread"
	default 1024
	help
	  This stack is used by the Espressif ESP RX thread.

config WIFI_ESP_RX_THREAD_PRIORITY
	int "Priority of RX thread"
	default 7
	help
	  Priority of thread used for processing RX data.

config WIFI_ESP_WORKQ_STACK_SIZE
	int "Stack size for the esp driver work queue"
	default 2048
	help
	  This stack is used by the work queue to pass off net_pkt data
	  to the rest of the network stack, letting the rx thread continue
	  processing data.

config WIFI_ESP_WORKQ_THREAD_PRIORITY
	int "Priority of work queue thread"
	default 7
	help
	  Priority of thread used for processing driver work queue items.

config WIFI_ESP_MDM_RING_BUF_SIZE
	int "Modem ring buffer size"
	default 1024
	help
	  Ring buffer size used by modem UART interface handler.

config WIFI_ESP_MDM_RX_BUF_COUNT
	int "Modem RX buffer count"
	default 30
	help
	  Number of preallocated RX buffers used by modem command handler.

config WIFI_ESP_MDM_RX_BUF_SIZE
	int "Modem RX buffer size"
	default 128
	help
	  Size of preallocated RX buffers used by modem command handler.

config WIFI_ESP_PASSIVE_MODE
	bool "Use passive mode"
	help
	  This lets the ESP handle the TCP window so that data can flow
	  at a rate that the driver can handle. Without this, data might get
	  lost if the driver cannot empty the device buffer quickly enough.

config WIFI_ESP_RESET_TIMEOUT
	int "Reset timeout"
	default 3000
	help
	  How long to wait for device to become ready after AT+RST has been
	  sent. This can vary with chipset (ESP8266/ESP32) and firmware
	  version. This is ignored if a reset pin is configured.

config WIFI_ESP_RX_NET_PKT_ALLOC_TIMEOUT
	int "Network interface RX packet allocation timeout"
	default 5000
	help
	  Network interface RX net_pkt allocation timeout in milliseconds.

choice
	prompt "ESP IP Address configuration"
	default WIFI_ESP_IP_DHCP
	help
	  Choose whether to use an IP assigned by DHCP Server or
	  configure a static IP Address.

config WIFI_ESP_IP_DHCP
	bool "DHCP"
	help
	  Use DHCP to get an IP Address.

config WIFI_ESP_IP_STATIC
	bool "Static"
	help
	  Setup Static IP Address.

endchoice

if WIFI_ESP_IP_STATIC

config WIFI_ESP_IP_ADDRESS
	string "ESP Station mode IP Address"

config WIFI_ESP_IP_GATEWAY
	string "Gateway Address"

config WIFI_ESP_IP_MASK
	string "Network Mask"

endif

choice WIFI_ESP_AT_VERSION
	prompt "AT version"
	default WIFI_ESP_AT_VERSION_2_0
	help
	  Select which version of AT command set should be used.

config WIFI_ESP_AT_VERSION_1_7
	bool "AT version 1.7"
	help
	  Use AT command set version 1.7.

config WIFI_ESP_AT_VERSION_2_0
	bool "AT version 2.0"
	help
	  Use AT command set version 2.0.

endchoice

endif # WIFI_ESP
```
