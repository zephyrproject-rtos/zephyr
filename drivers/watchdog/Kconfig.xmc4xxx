## drivers/watchdog/Kconfig.xmc4xxx
```kconfig
# Infineon XMC4xxx WDT configuration

# Copyright (C) 2023 SLB
# SPDX-License-Identifier: Apache-2.0

config WDT_XMC4XXX
	bool "Infineon XMC4xxx MCU Family Watchdog (WDT) Driver"
	default y
	depends on DT_HAS_INFINEON_XMC4XXX_WATCHDOG_ENABLED
	help
	  Enable WDT driver for Infineon XMC4xxx MCUs.

if WDT_XMC4XXX && !WDT_DISABLE_AT_BOOT

config WDT_XMC4XXX_DEFAULT_TIMEOUT_MAX_MS
	int "Default watchdog timeout to use at startup"
	default 20000
	help
	  Default watchdog timeout to use if the watchdog is not disabled
	  at startup.

endif
```

## drivers/wifi/Kconfig
```kconfig
# WiFi drivers configuration options

# Copyright (c) 2017 Intel Corporation
# SPDX-License-Identifier: Apache-2.0

menuconfig WIFI
	bool "Wi-Fi drivers"

if WIFI

module = WIFI
module-dep = LOG
module-str = Log level for Wi-Fi driver
module-help = Sets log level for Wi-Fi Device Drivers.
source "subsys/net/Kconfig.template.log_config.net"

config WIFI_INIT_PRIORITY
	int "Wi-Fi driver init priority"
	default 80
	help
	  Wi-Fi device driver initialization priority.
	  Do not mess with it unless you know what you are doing.
	  Note that the priority needs to be lower than the net stack
	  so that it can start before the networking sub-system.

config WIFI_OFFLOAD
	bool "Support offloaded Wi-Fi device drivers"
	select NET_OFFLOAD
	help
	  Enable support for Full-MAC Wi-Fi devices.

config WIFI_USE_NATIVE_NETWORKING
	bool
	help
	  When selected, this hidden configuration enables Wi-Fi driver
	  to use native ethernet stack interface.

source "drivers/wifi/winc1500/Kconfig.winc1500"
source "drivers/wifi/simplelink/Kconfig.simplelink"
source "drivers/wifi/eswifi/Kconfig.eswifi"
source "drivers/wifi/esp_at/Kconfig.esp_at"
source "drivers/wifi/esp32/Kconfig.esp32"
source "drivers/wifi/esp_hosted/Kconfig.esp_hosted"
source "drivers/wifi/nxp/Kconfig.nxp"
source "drivers/wifi/infineon/Kconfig.airoc"
source "drivers/wifi/nrf_wifi/Kconfig.nrfwifi"
source "drivers/wifi/siwx91x/Kconfig.siwx91x"

# Choice is after individual drivers to enable driver specific defaults
choice WIFI_USAGE_MODE
	prompt "Application usage of the Wi-Fi driver"
	default WIFI_USAGE_MODE_STA
	help
	  Inform the Wi-Fi driver of which Wi-Fi features the application
	  will be using. Drivers can use this choice to default appropriate
	  driver-specific options.

config WIFI_USAGE_MODE_STA
	bool "Wi-Fi interface(s) acts as a Station"

config WIFI_USAGE_MODE_AP
	bool "Wi-Fi interface(s) acts as an Access Point"

config WIFI_USAGE_MODE_STA_AP
	bool "Wi-Fi interface(s) acts as an Access Point and Station"

config WIFI_USAGE_MODE_SCAN_ONLY
	bool "Wi-Fi interface(s) used for SSID scanning only"

endchoice

endif # WIFI
```

## drivers/wifi/Kconfig.inventek
```kconfig
# Kconfig - Inventek WiFi driver options

# Copyright (c) 2017 STMicroelectronics
#
# SPDX-License-Identifier: Apache-2.0

menuconfig WIFI_ISM43362_M3G_L44
	bool
	prompt "Use Inventek ism43362_m3G_l44 wifi component"
	default n
	select HAS_INVENTEK_WIFI
	help
	  To be used if Inventek ism43362_m3G_l44 wifi component is on the board

if WIFI_ISM43362_M3G_L44

config HAS_INVENTEK_WIFI
	bool

config WIFI_ISM43362_M3G_L44_SPI_DEV_NAME
	string
	prompt "SPI used for wifi"
	default "SPI_3"
	help
	  The device name of the SPI device to which the Inventek wifi is connected.

config WIFI_ISM43362_M3G_L44_SPI_CLK_FREQ
	int
	prompt "SPI frequency to be used"
	default 2000000
	help
	  SPI frequency to be used.

endif # WIFI_ISM43362_M3G_L44
```

## drivers/wifi/Kconfig.winc1500
```kconfig
# Kconfig - Atmel WINC1500 WiFi driver options

#
# Copyright (c) 2015 Intel Corporation
#
# SPDX-License-Identifier: Apache-2.0
#

menuconfig WIFI_WINC1500
	bool "WINC1500 driver support"
	default n
	select ATMEL_WINC1500

if WIFI_WINC1500

config WIFI_WINC1500_NAME
	string "Driver name"
	default "WINC1500"

config WIFI_WINC1500_SPI_DRV_NAME
	string "SPI device where WINC1500 is connected"
	default "SPI_1"
	help
	 Specify the device name of the SPI device to which WINC1500 is
	 connected.

config WIFI_WINC1500_SPI_SLAVE
	int "SPI Slave Select where WINC1500 is connected"
	default 1
	help
	 Specify the slave select pin of the SPI to which WINC1500 is
	 connected.

config WIFI_WINC1500_SPI_FREQ
	int "SPI frequency to use with WINC1500"
	default 4
	help
	 SPI frequency to use with WINC1500

# TODO GPIO

config WIFI_WINC1500_SSID
	string "SSID the chip shall try to connect to"
	default ""
	help
	 Set the SSID you want the chip to connect to. Note: only WPA PSK
	 based AP is supported. Test purpose only, a full featured interface
	 will be used at some point for more flexible configuration.

config WIFI_WINC1500_SSID_LENGTH
	int "Length of the SSID (do not count the \0)"
	default 0
	help
	 SSID length, without counting the terminal character '\0'

config WIFI_WINC1500_PSK
	string "Pre-Shared Key (human readable)"
	default ""
	help
	 Set the PSK for the given SSID.

endif # WIFI_WINC1500
```

## drivers/wifi/ameba/Kconfig.ameba
```kconfig
# Copyright (c) 2026 Realtek Semiconductor Corp.
# SPDX-License-Identifier: Apache-2.0

config WIFI_AMEBA
	bool "Ameba SoC Wi-Fi support"
	default y
	depends on DT_HAS_REALTEK_AMEBA_WIFI_ENABLED
	depends on ZEPHYR_HAL_REALTEK_MODULE_BLOBS || BUILD_ONLY_NO_BLOBS
	select WIFI_USE_NATIVE_NETWORKING
	select NET_L2_ETHERNET
	select WIFI_NM

if WIFI_AMEBA

config AMEBA_WIFI_EVENT_STACK_SIZE
	int "Ameba Wi-Fi event thread stack size"
	default 4096
	help
	  Stack size for the Ameba Wi-Fi event handling thread.
	  Increase this if you see stack overflow, or decrease to save RAM.

config HEAP_MEM_POOL_ADD_SIZE_AMEBA_WIFI
	int
	default 8192
	help
	  Add heap memory pool for Ameba Wi-Fi scan buffer allocation.

configdefault WIFI_NM_MAX_MANAGED_INTERFACES
	default 2

configdefault NET_IF_MAX_IPV4_COUNT
	default 2

configdefault NET_SOCKETS_SERVICE_THREAD_PRIO
	default -3

configdefault NET_TCP_WORKQ_STACK_SIZE
	default 2048

configdefault NET_RX_STACK_SIZE
	default 2048

configdefault NET_MGMT_EVENT_STACK_SIZE
	default 2048

config RTK_WIFI_STA_AUTO_DHCPV4
	bool "Automatically starts DHCP4 negotiation"
	depends on NET_DHCPV4
	depends on NET_IPV4
	default y
	help
	  WiFi driver will automatically initiate DHCPV4 negotiation when connected.

config BT_COEXIST
	bool "Wi-Fi/Bluetooth coexistence"

config RTK_WIFI_AP_STA_MODE
	bool "Concurrent AP and STA mode"
	default y

config RTK_AP_IPV4_ADDR
	string "RTK SoftAP IPv4 address"
	default "192.168.43.1"
	help
	  IPv4 address assigned to RTK SoftAP interface.

config RTK_AP_IPV4_NETMASK
	string "RTK SoftAP IPv4 netmask"
	default "255.255.255.0"
	help
	  Netmask for the SoftAP IPv4 address.

config RTK_AP_IPV4_GATEWAY
	string "RTK SoftAP IPv4 gateway"
	default "192.168.43.1"
	help
	  Gateway for SoftAP clients (usually the AP itself).

config SINGLE_CORE_WIFI
	bool
	depends on SOC_SERIES_AMEBAD
	default y

config WHC_HOST
	bool

endif
```

## drivers/wifi/bflb/Kconfig.bflb_wifi
```kconfig
# SPDX-FileCopyrightText: Copyright The Zephyr Project Contributors
#
# SPDX-License-Identifier: Apache-2.0

menuconfig WIFI_BFLB
	bool "Bouffalo Lab WiFi driver"
	default y
	depends on DT_HAS_BFLB_BL61X_WIFI_ENABLED
	depends on ZEPHYR_MBEDTLS_MODULE
	select NET_L2_WIFI_MGMT
	select NET_L2_ETHERNET
	select NET_L2_ETHERNET_MGMT
	select WIFI_USE_NATIVE_NETWORKING
	select HWINFO
	select WIFI_NM_WPA_SUPPLICANT
	select WIFI_NM_WPA_SUPPLICANT_WEP
	select WIFI_NM_WPA_SUPPLICANT_AP
	select BFLB_WL80211_SHIM
	select NET_SOCKETS
	help
	  Enable Bouffalo Lab WiFi driver using the MACSW blob.

if WIFI_BFLB

rsource "bl61x/Kconfig"

config HEAP_MEM_POOL_ADD_SIZE_WIFI_BFLB
	int
	default 4096

config NET_MGMT_EVENT_STACK_SIZE
	default 4096

endif # WIFI_BFLB
```

## drivers/wifi/bflb/bl60x/Kconfig
```kconfig
# SPDX-FileCopyrightText: Copyright The Zephyr Project Contributors
#
# SPDX-License-Identifier: Apache-2.0

if DT_HAS_BFLB_BL60X_WIFI_ENABLED

config BFLB_WIFI_BL60X_TASK_STACK_SIZE
	int "WiFi firmware task stack size"
	default 16384
	help
	  Stack size for the wifi4 firmware scheduler thread.  The blob's
	  kernel queues and event handlers all run there.

config BFLB_WIFI_BL60X_TASK_PRIORITY
	int "WiFi firmware task priority"
	default 5
	help
	  Preemptible thread priority of the firmware scheduler loop.

endif # DT_HAS_BFLB_BL60X_WIFI_ENABLED
```

## drivers/wifi/bflb/bl61x/Kconfig
```kconfig
# SPDX-FileCopyrightText: Copyright The Zephyr Project Contributors
#
# SPDX-License-Identifier: Apache-2.0

choice BFLB_WIFI_BL61X_MACSW_VARIANT
	prompt "MACSW firmware variant"
	default BFLB_WIFI_BL61X_MACSW_DEFAULT
	help
	  Selects the MACSW lower-MAC firmware blob variant. All variants
	  share the same host API; they differ only in compile-time tuning
	  (TX/RX queue depth, AMSDU size, coex hooks).

config BFLB_WIFI_BL61X_MACSW_DEFAULT
	bool "default"
	help
	  Balanced configuration suitable for STA and light AP use.
	  Includes the built-in PTA (Packet Traffic Arbiter) coex manager
	  which handles BLE/BT coexistence at the hardware level and works
	  with the default BLE controller blob out of the box.

config BFLB_WIFI_BL61X_MACSW_BRIDGE
	bool "bridge"
	help
	  High-throughput tuning for simultaneous STA+AP bridging:
	  64 TX1 descriptors (vs 32), 8K AMSDU (vs 4K), 12-window block ack
	  and reorder buffer. Adds ~14 KB to RAM usage over default.

config BFLB_WIFI_BL61X_MACSW_ACK
	bool "ack"
	help
	  Enhanced Block Ack and A-MPDU aggregation variant. Increases
	  BA TX/RX agreement counts and reorder buffer depth over default,
	  improving throughput on links with high frame aggregation.
	  Uses more RAM than default but less than bridge.

config BFLB_WIFI_BL61X_MACSW_COEX
	bool "coex"
	help
	  Adds the legacy coex_init/coex_event/coexist_event_* hook API
	  on top of the default firmware, used by the vendor
	  components/wireless/coex/ component for TDMA or PTI mode
	  arbitration with Thread/Zigbee or BR/EDR. Not required for
	  standard BLE coexistence -- the default variant's built-in PTA
	  already handles that.

endchoice

config BFLB_WIFI_BL61X_BA_RX
	int "Number of RX Block Ack agreements"
	default 4 if BFLB_WIFI_BL61X_MACSW_ACK
	default 2
	range 1 8
	help
	  Maximum number of concurrent RX Block Ack sessions negotiated
	  with the AP. Higher values allow parallel aggregated streams
	  at the cost of additional reorder buffer memory.

config BFLB_WIFI_BL61X_BA_REORDER_BUF
	int "Block Ack reorder buffer depth per agreement"
	default 16 if BFLB_WIFI_BL61X_MACSW_ACK
	default 12 if BFLB_WIFI_BL61X_MACSW_BRIDGE
	default 4
	range 4 64
	help
	  Number of MPDU slots in each RX Block Ack reorder window.
	  Deeper buffers tolerate more out-of-order frames before
	  flushing but consume more WRAM (each slot holds one
	  RX descriptor plus the AMSDU subframe).

config BFLB_WIFI_BL61X_TASK_STACK_SIZE
	int "WiFi task stack size"
	default 4096
	help
	  Stack size for the WiFi MACSW task thread.

config BFLB_WIFI_BL61X_TASK_PRIORITY
	int "WiFi task priority"
	default 2
	help
	  Thread priority of the WiFi MACSW event loop.

config BFLB_WIFI_BL61X_TX_MAX_PENDING
	int "Maximum in-flight TX packets"
	default 4
	range 1 64
	help
	  Limits the number of packets queued to the firmware TX path
	  simultaneously. The driver blocks in send() when this limit
	  is reached, providing backpressure to the TCP stack and
	  preventing WRAM heap exhaustion during bulk transfers.

config BFLB_WIFI_BL61X_WRAM_HEAP_SIZE
	int "Size of the WRAM TX heap (bytes)"
	default 4096
	help
	  Heap size for wl80211_platform_malloc_wram(). Allocated in
	  non-cached WRAM for DMA coherency. 4 KB holds two concurrent
	  in-flight TX buffers; minimum ~2 KB for a single full-MTU frame.

config BFLB_WIFI_BL61X_DEFAULT_COUNTRY
	string "Default regulatory country code"
	default "US"
	help
	  ISO/IEC 3166-1 alpha-2 country code used at boot for both RF
	  calibration and MAC channel configuration. Must match an entry
	  in the WL80211_COUNTRY_LIST table. Can be changed at runtime
	  via the wifi reg_domain shell command.

config WIFI_NM_MAX_MANAGED_INTERFACES
	default 2 if WIFI_NM_WPA_SUPPLICANT_AP
```

## drivers/wifi/bflb/wifi6/Kconfig
```kconfig
# SPDX-FileCopyrightText: Copyright The Zephyr Project Contributors
#
# SPDX-License-Identifier: Apache-2.0

choice WIFI_BFLB_WIFI6_MACSW_VARIANT
	prompt "MACSW firmware variant"
	default WIFI_BFLB_WIFI6_MACSW_DEFAULT
	help
	  Selects the MACSW lower-MAC firmware blob variant. All variants
	  share the same host API; they differ only in compile-time tuning
	  (TX/RX queue depth, AMSDU size, coex hooks).

config WIFI_BFLB_WIFI6_MACSW_DEFAULT
	bool "default"
	help
	  Balanced configuration suitable for STA and light AP use.
	  Includes the built-in PTA (Packet Traffic Arbiter) coex manager
	  which handles BLE/BT coexistence at the hardware level and works
	  with the default BLE controller blob out of the box.

config WIFI_BFLB_WIFI6_MACSW_BRIDGE
	bool "bridge"
	help
	  High-throughput tuning for simultaneous STA+AP bridging:
	  64 TX1 descriptors (vs 32), 8K AMSDU (vs 4K), 12-window block ack
	  and reorder buffer. Adds ~14 KB to RAM usage over default.

config WIFI_BFLB_WIFI6_MACSW_ACK
	bool "ack"
	help
	  Enhanced Block Ack and A-MPDU aggregation variant. Increases
	  BA TX/RX agreement counts and reorder buffer depth over default,
	  improving throughput on links with high frame aggregation.
	  Uses more RAM than default but less than bridge.

config WIFI_BFLB_WIFI6_MACSW_COEX
	bool "coex"
	help
	  Adds the legacy coex_init/coex_event/coexist_event_* hook API
	  on top of the default firmware, used by the vendor
	  components/wireless/coex/ component for TDMA or PTI mode
	  arbitration with Thread/Zigbee or BR/EDR. Not required for
	  standard BLE coexistence -- the default variant's built-in PTA
	  already handles that.

endchoice

config WIFI_BFLB_WIFI6_BA_RX
	int "Number of RX Block Ack agreements"
	default 4 if WIFI_BFLB_WIFI6_MACSW_ACK
	default 2
	range 1 8
	help
	  Maximum number of concurrent RX Block Ack sessions negotiated
	  with the AP. Higher values allow parallel aggregated streams
	  at the cost of additional reorder buffer memory.

config WIFI_BFLB_WIFI6_BA_REORDER_BUF
	int "Block Ack reorder buffer depth per agreement"
	default 16 if WIFI_BFLB_WIFI6_MACSW_ACK
	default 12 if WIFI_BFLB_WIFI6_MACSW_BRIDGE
	default 4
	range 4 64
	help
	  Number of MPDU slots in each RX Block Ack reorder window.
	  Deeper buffers tolerate more out-of-order frames before
	  flushing but consume more WRAM (each slot holds one
	  RX descriptor plus the AMSDU subframe).

config WIFI_BFLB_WIFI6_TASK_STACK_SIZE
	int "WiFi task stack size"
	default 4096
	help
	  Stack size for the WiFi MACSW task thread.

config WIFI_BFLB_WIFI6_TASK_PRIORITY
	int "WiFi task priority"
	default 2
	help
	  Thread priority of the WiFi MACSW event loop.

config WIFI_BFLB_WIFI6_TX_MAX_PENDING
	int "Maximum in-flight TX packets"
	default 4
	range 1 64
	help
	  Limits the number of packets queued to the firmware TX path
	  simultaneously. The driver blocks in send() when this limit
	  is reached, providing backpressure to the TCP stack and
	  preventing WRAM heap exhaustion during bulk transfers.

config WIFI_BFLB_WIFI6_WRAM_HEAP_SIZE
	int "Size of the WRAM TX heap (bytes)"
	default 4096
	help
	  Heap size for wl80211_platform_malloc_wram(). Allocated in
	  non-cached WRAM for DMA coherency. 4 KB holds two concurrent
	  in-flight TX buffers; minimum ~2 KB for a single full-MTU frame.

config WIFI_BFLB_WIFI6_DEFAULT_COUNTRY
	string "Default regulatory country code"
	default "US"
	help
	  ISO/IEC 3166-1 alpha-2 country code used at boot for both RF
	  calibration and MAC channel configuration. Must match an entry
	  in the WL80211_COUNTRY_LIST table. Can be changed at runtime
	  via the wifi reg_domain shell command.

config WIFI_NM_MAX_MANAGED_INTERFACES
	default 2 if WIFI_NM_WPA_SUPPLICANT_AP
```
