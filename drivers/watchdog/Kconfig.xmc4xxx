## drivers/wifi/esp32/Kconfig.esp32wifi
```kconfig
#
# Copyright (c) 2019 Manulytica Ltd
# Copyright (c) 2018 Linaro
#
# SPDX-License-Identifier: Apache-2.0
#
# Kconfig - ESP32 AT WiFi driver options

menuconfig WIFI_ESP32
	bool "ESP32 WiFi driver support"
	default n
	depends on WIFI
	select NET_SOCKETS
	select WIFI_OFFLOAD
	select NET_L2_WIFI_MGMT
	select MODEM
	select MODEM_RECEIVER
	select NET_OFFLOAD

if WIFI_ESP32

config WIFI_ESP32_UART_DEVICE
	string "Serial device used for ESP32 connection"
	default "UART_1"
	help
	Specify the device name of the serial device to which ESP32 is
	connected.

config WIFI_ESP32_HAS_ENABLE_PIN
	bool "ESP32 device uses an enable pin"
	default n
	help
	  This option defines whether or not the ESP32 device utilizes a
	  enable pin

if WIFI_ESP32_HAS_ENABLE_PIN

config WIFI_ESP32_GPIO_DEVICE
	string "GPIO driver's name to use to drive ESP32 enable"
	default "GPIO_1"
	help
	  This option is mandatory to set which GPIO controller to use in
	  order to drive the enable pin

config WIFI_ESP32_GPIO_ENABLE_PIN
	int "GPIO PIN to use to drive ESP32 enable"
	help
	  This option is mandatory to set which GPIO pin to use in order
	  to enable the ESP32
endif

endif
```

## drivers/wifi/esp8266/Kconfig.esp8266
```kconfig
#
# Copyright (c) 2018 Linaro
#
# SPDX-License-Identifier: Apache-2.0
#
# Kconfig - esp8266 driver options

menuconfig WIFI_ESP8266
	bool "ESP8266 driver support"
	default n
	depends on WIFI
	select NET_SOCKETS
	select NEWLIB_LIBC
	select WIFI_OFFLOAD
	select NET_L2_WIFI_MGMT
	select MODEM
	select MODEM_RECEIVER

if WIFI_ESP8266

config WIFI_ESP8266_UART_DEVICE
	string "Serial device used for ESP8266 connection"
	default "UART_0"
	help
	Specify the device name of the serial device to which ESP8266 is
	connected.

config WIFI_ESP8266_HAS_ENABLE_PIN
	bool "ESP8266 device uses an enable pin"
	default n
	help
	  This option defines whether or not the ESP8266 device utilizes a
	  enable pin

if WIFI_ESP8266_HAS_ENABLE_PIN

config WIFI_ESP8266_GPIO_DEVICE
	string "GPIO driver's name to use to drive ESP8266 enable"
	default "GPIO_1"
	help
	  This option is mandatory to set which GPIO controller to use in
	  order to drive the enable pin

config WIFI_ESP8266_GPIO_ENABLE_PIN
	int "GPIO PIN to use to drive ESP8266 enable"
	help
	  This option is mandatory to set which GPIO pin to use in order
	  to enable the ESP8266
endif

endif
```

## drivers/wifi/esp_at/Kconfig.esp_at
```kconfig
# Copyright (c) 2019 Tobias Svehagen
# SPDX-License-Identifier: Apache-2.0

menuconfig WIFI_ESP_AT
	bool "Espressif AT Command support"
	default y
	depends on DT_HAS_ESPRESSIF_ESP_AT_ENABLED
	select MODEM
	select MODEM_CONTEXT
	select MODEM_CMD_HANDLER
	select MODEM_IFACE_UART
	select NET_L2_WIFI_MGMT
	select WIFI_OFFLOAD
	imply UART_USE_RUNTIME_CONFIGURE
	help
	  Enable Espressif AT Command offloaded WiFi driver. It is supported on
	  any serial capable platform and communicates with Espressif chips
	  running ESP-AT firmware (https://github.com/espressif/esp-at).

if WIFI_ESP_AT

config WIFI_ESP_AT_SCAN_PASSIVE
	bool "Passive scan"
	help
	  Use passive scanning.

config WIFI_ESP_AT_SCAN_MAC_ADDRESS
	bool "MAC address in scan response"
	help
	  Get mac address in scan response.

config WIFI_ESP_AT_SCAN_RESULT_RSSI_ORDERED
	bool "Scan result ordering based on RSSI"
	help
	  Order based on RSSI.

config WIFI_ESP_AT_RX_STACK_SIZE
	int "Stack size for the Espressif esp wifi driver RX thread"
	default 1024
	help
	  This stack is used by the Espressif ESP RX thread.

config WIFI_ESP_AT_RX_THREAD_PRIORITY
	int "Priority of RX thread"
	default 7
	help
	  Priority of thread used for processing RX data.

config WIFI_ESP_AT_WORKQ_STACK_SIZE
	int "Stack size for the esp driver work queue"
	default 2048
	help
	  This stack is used by the work queue to pass off net_pkt data
	  to the rest of the network stack, letting the rx thread continue
	  processing data.

config WIFI_ESP_AT_WORKQ_THREAD_PRIORITY
	int "Priority of work queue thread"
	default 7
	help
	  Priority of thread used for processing driver work queue items.

config WIFI_ESP_AT_MDM_RING_BUF_SIZE
	int "Modem ring buffer size"
	default 1024
	help
	  Ring buffer size used by modem UART interface handler.

config WIFI_ESP_AT_MDM_RX_BUF_COUNT
	int "Modem RX buffer count"
	default 30
	help
	  Number of preallocated RX buffers used by modem command handler.

config WIFI_ESP_AT_MDM_RX_BUF_SIZE
	int "Modem RX buffer size"
	default 128
	help
	  Size of preallocated RX buffers used by modem command handler.

config WIFI_ESP_AT_PASSIVE_MODE
	bool "Use passive mode"
	help
	  This lets the ESP handle the TCP window so that data can flow
	  at a rate that the driver can handle. Without this, data might get
	  lost if the driver cannot empty the device buffer quickly enough.

config WIFI_ESP_AT_RESET_TIMEOUT
	int "Reset timeout"
	default 3000
	help
	  How long to wait for device to become ready after AT+RST has been
	  sent. This can vary with chipset (ESP8266/ESP32) and firmware
	  version. This is ignored if a reset pin is configured.

config WIFI_ESP_AT_RX_NET_PKT_ALLOC_TIMEOUT
	int "Network interface RX packet allocation timeout"
	default 5000
	help
	  Network interface RX net_pkt allocation timeout in milliseconds.

choice
	prompt "ESP IP Address configuration"
	default WIFI_ESP_AT_IP_DHCP
	help
	  Choose whether to use an IP assigned by DHCP Server or
	  configure a static IP Address.

config WIFI_ESP_AT_IP_DHCP
	bool "DHCP"
	help
	  Use DHCP to get an IP Address.

config WIFI_ESP_AT_IP_STATIC
	bool "Static"
	help
	  Setup Static IP Address.

endchoice

if WIFI_ESP_AT_IP_STATIC

config WIFI_ESP_AT_IP_ADDRESS
	string "ESP Station mode IP Address"

config WIFI_ESP_AT_IP_GATEWAY
	string "Gateway Address"

config WIFI_ESP_AT_IP_MASK
	string "Network Mask"

endif

choice WIFI_ESP_AT_VERSION
	prompt "AT version"
	default WIFI_ESP_AT_VERSION_2_1
	help
	  Select which version of AT command set should be used.

config WIFI_ESP_AT_VERSION_1_7
	bool "AT version 1.7"
	help
	  Use AT command set version 1.7.

config WIFI_ESP_AT_VERSION_2_0
	bool "AT version 2.0"
	help
	  Use AT command set version 2.0.

config WIFI_ESP_AT_VERSION_2_1
	bool "AT version 2.1"
	help
	  Use AT command set version 2.1.

endchoice

config WIFI_ESP_AT_DNS_USE
	bool "Use DNS from ESP"
	depends on DNS_RESOLVER
	help
	  Fetch DNS servers from ESP chip with AT+CIPDNS? command and apply that
	  list to system DNS resolver.

config WIFI_ESP_AT_CIPDINFO_USE
	bool "Use CIPDINFO to get peer ip and port"
	help
	  Enable AT+CIPDINFO to get peer ip-address and port.

config WIFI_ESP_AT_FETCH_VERSION
	bool "Fetch and log ESP-AT firmware version"
	default y
	depends on LOG
	help
	  Fetch information about ESP-AT firmware version. This includes AT
	  command version, SDK (ESP-IDF), board and compile time.

endif # WIFI_ESP_AT
```

## drivers/wifi/esp_hosted/Kconfig.esp_hosted
```kconfig
# ESP Hosted WiFi driver options

# Copyright (c) 2025 Arduino SA
# SPDX-License-Identifier: Apache-2.0

menuconfig WIFI_ESP_HOSTED
	bool "ESP_HOSTED driver support"
	depends on DT_HAS_ESPRESSIF_ESP_HOSTED_ENABLED
	default y
	select GPIO
	select SPI
	select WIFI_OFFLOAD
	select WIFI_NM
	select NANOPB
	select NET_L2_ETHERNET
	select NET_L2_WIFI_MGMT
	select WIFI_USE_NATIVE_NETWORKING

if WIFI_ESP_HOSTED

config WIFI_ESP_HOSTED_DEBUG
	bool "Extra debugging messages"

config WIFI_ESP_HOSTED_EVENT_TASK_PRIORITY
	int "Event task priority"
	default 4

config WIFI_ESP_HOSTED_EVENT_TASK_STACK_SIZE
	int "Event task stack size"
	default 16384

config WIFI_ESP_HOSTED_EVENT_TASK_POLL_MS
	int "Event task poll rate in ms"
	default 20

config WIFI_ESP_HOSTED_AP_CLIENTS_MAX
	int "Max number of AP clients"
	default 5

config WIFI_ESP_HOSTED_AP_CHANNEL_DEF
	int "Default AP channel"
	default 9

endif
```

## drivers/wifi/esp_hosted_mcu/Kconfig.esp_hosted_mcu
```kconfig
# ESP-Hosted-MCU Wi-Fi driver options

# Copyright (c) 2026 Espressif Systems (Shanghai) CO LTD
# SPDX-License-Identifier: Apache-2.0

menuconfig WIFI_ESP_HOSTED_MCU
	bool "ESP-Hosted-MCU driver support"
	depends on DT_HAS_ESPRESSIF_ESP_HOSTED_MCU_ENABLED || \
		DT_HAS_ESPRESSIF_ESP_HOSTED_MCU_SDIO_ENABLED
	default y
	select ESP_HOSTED_MCU
	select WIFI_NM
	select NET_L2_ETHERNET
	select NET_L2_WIFI_MGMT
	select WIFI_USE_NATIVE_NETWORKING
	help
	  Host driver for an Espressif SoC (for example ESP32-C6) running
	  esp-hosted-mcu coprocessor firmware as a Wi-Fi co-processor. Communicates
	  over SPI or SDIO using the esp-hosted-mcu transport core.

if WIFI_ESP_HOSTED_MCU

# The RPC decode and connection-result dispatch run on the net
# management event thread; size it for that path.
config NET_MGMT_EVENT_STACK_SIZE
	default 2048

# Received frames are reassembled on the traffic class receive thread
# before they reach the network stack; size it for sustained traffic.
config NET_RX_STACK_SIZE
	default 2560

config WIFI_ESP_HOSTED_MCU_INIT_PRIORITY
	int "esp-hosted-mcu Wi-Fi init priority"
	default 87
	help
	  POST_KERNEL init priority of the Wi-Fi netif. It must be numerically
	  greater than ESP_HOSTED_MCU_INIT_PRIORITY: this driver issues RPCs
	  from its init function, so the transport core has to have brought the
	  link up and started the receive thread first. Initialising earlier
	  leaves the RPC with no transport and no thread to complete it, which
	  blocks the boot.

config WIFI_ESP_HOSTED_MCU_AP_STA_MODE
	bool "Soft-AP interface support"
	default y if WIFI_USAGE_MODE_STA_AP || WIFI_USAGE_MODE_AP
	help
	  Register the soft-AP (sap_if) network interface and the access
	  point management operations. Without this only the station
	  interface exists. The coprocessor still runs in combined AP-STA
	  mode when the soft-AP is brought up.

if WIFI_ESP_HOSTED_MCU_AP_STA_MODE

config WIFI_ESP_HOSTED_MCU_AP_CHANNEL_DEF
	int "Default AP channel"
	default 9
	help
	  Channel the soft-AP starts on when a connect request does not
	  specify one.

endif # WIFI_ESP_HOSTED_MCU_AP_STA_MODE

endif # WIFI_ESP_HOSTED_MCU
```

## drivers/wifi/eswifi/Kconfig.eswifi
```kconfig
# es-WiFi driver options

# Copyright (c) 2018 Linaro
# SPDX-License-Identifier: Apache-2.0

menuconfig WIFI_ESWIFI
	bool "Inventek eS-WiFi support"
	default y
	depends on DT_HAS_INVENTEK_ESWIFI_ENABLED || DT_HAS_INVENTEK_ESWIFI_UART_ENABLED
	select NET_L2_WIFI_MGMT
	select WIFI_OFFLOAD
	select NET_OFFLOAD
	select NET_SOCKETS
	imply NET_SOCKETS_OFFLOAD
	select GPIO

if WIFI_ESWIFI

choice WIFI_ESWIFI_BUS
	bool "Select BUS interface"
	default WIFI_ESWIFI_BUS_SPI

config WIFI_ESWIFI_BUS_SPI
	bool "SPI Bus interface"
	select SPI

config WIFI_ESWIFI_BUS_UART
	bool "UART Bus interface"
	select SERIAL

endchoice

config WIFI_ESWIFI_MAX_DATA_SIZE
	int "esWiFi message size"
	default 1600
	range 500 4000
	help
	  This option sets the size of the esWiFi message buffer.
	  It can be increased to handle larger messages, like scan results.

config WIFI_ESWIFI_THREAD_PRIO
	int "esWiFi threads priority"
	default 2
	help
	  This option sets the priority of the esWiFi threads.
	  Do not touch it unless you know what you are doing.

config WIFI_ESWIFI_SHELL
	bool "esWiFi shell"
	depends on SHELL
	help
	  Enable esWiFi shell

endif
```

## drivers/wifi/hwsim/Kconfig
```kconfig
# Copyright (c) 2026 Nordic Semiconductor ASA
# SPDX-License-Identifier: Apache-2.0

config WIFI_HWSIM
	bool "Virtual Wi-Fi simulator driver (hwsim)"
	depends on WIFI
	depends on NET_L2_ETHERNET
	select NET_L2_WIFI_MGMT
	select WIFI_USE_NATIVE_NETWORKING
	help
	  Registers N virtual Wi-Fi interfaces backed by an in-process
	  frame relay bus. Intended for testing hostapd and wpa_supplicant
	  on native_sim without real hardware.

if WIFI_HWSIM

module = WIFI_HWSIM
module-str = Log level for WiFi hwsim driver
module-help = Sets log level for the WiFi hwsim driver (wifi_hwsim module).
source "subsys/logging/Kconfig.template.log_config"

config WIFI_HWSIM_NUM_RADIOS
	int "Number of virtual radios"
	default 2
	range 2 8
	help
	  Each radio becomes one net_if. Minimum 2 (one AP, one STA).

config WIFI_HWSIM_DEFAULT_CHANNEL
	int "Default channel (2.4 GHz)"
	default 6
	range 1 14

config WIFI_HWSIM_DEFAULT_SIGNAL_DBM
	int "Default simulated RSSI (dBm)"
	default -50
	range -100 -10

config WIFI_HWSIM_CONNECT_TIMEOUT_SEC
	int "Connect timeout in seconds (for tests)"
	default 15
	range 1 120
	help
	  Max time to wait for connect result in automated tests.

config WIFI_HWSIM_SHELL
	bool "hwsim shell commands"
	depends on SHELL
	default y
	help
	  Exposes 'hwsim channel/signal/loss/dump' shell commands for
	  manual fault injection during interactive testing.

config WIFI_HWSIM_RX_STACK_SIZE
	int "RX thread stack size per radio"
	default 2048

config WIFI_HWSIM_MEM_SLAB_COUNT
	int "Frame pool size (number of frames)"
	default 32
	help
	  Number of struct hwsim_frame entries in the k_mem_slab pool. Each
	  entry holds one in-flight frame (up to HWSIM_FRAME_MTU bytes) plus
	  per-frame metadata.

endif # WIFI_HWSIM
```
