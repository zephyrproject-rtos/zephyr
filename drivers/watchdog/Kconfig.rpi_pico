## drivers/watchdog/Kconfig.rpi_pico
```kconfig
# Copyright (c) 2022, Jamie McCrae
# SPDX-License-Identifier: Apache-2.0

config WDT_RPI_PICO
	bool "Raspberry Pi Pico Watchdog driver"
	default y
	depends on DT_HAS_RASPBERRYPI_PICO_WATCHDOG_ENABLED
	select HAS_WDT_NO_CALLBACKS
```

## drivers/watchdog/Kconfig.rts5817
```kconfig
# Copyright (c) 2024 Realtek Semiconductor, Inc.
# SPDX-License-Identifier: Apache-2.0

config WDT_RTS5817
	bool "Realtek RTS5817 Watchdog driver"
	default y
	depends on DT_HAS_REALTEK_RTS5817_WATCHDOG_ENABLED
	select HAS_WDT_DISABLE_AT_BOOT
	help
	  Realtek RTS5817 watchdog driver.
```

## drivers/watchdog/Kconfig.rts5912
```kconfig
# Copyright (c) 2025, Realtek, SIBG-SD7
# SPDX-License-Identifier: Apache-2.0

config WDT_RTS5912
	bool "Realtek RTS5912 Embedded Controller Watchdog Driver"
	default y
	depends on DT_HAS_REALTEK_RTS5912_WATCHDOG_ENABLED
	select HAS_WDT_DISABLE_AT_BOOT
	help
	  This option enables the WDT driver for Realtek RTS5912 family of
	  processors.
```

## drivers/watchdog/Kconfig.sam
```kconfig
# Atmel SAM WDT configuration

# Copyright (C) 2017 Intel Deutschland GmbH
# SPDX-License-Identifier: Apache-2.0

config WDT_SAM
	bool "Atmel SAM MCU Family Watchdog (WDT) Driver"
	default y
	depends on DT_HAS_ATMEL_SAM_WATCHDOG_ENABLED
	select HAS_WDT_DISABLE_AT_BOOT
	help
	  Enable WDT driver for Atmel SAM MCUs.
```

## drivers/watchdog/Kconfig.sam0
```kconfig
# Atmel SAM0 WDT configuration

# Copyright (c) 2017 Google LLC.
# SPDX-License-Identifier: Apache-2.0

config WDT_SAM0
	bool "Atmel SAM0 series Watchdog (WDT) Driver"
	default y
	depends on DT_HAS_ATMEL_SAM0_WATCHDOG_ENABLED
	help
	  Enable WDT driver for Atmel SAM0 MCUs.
```

## drivers/watchdog/Kconfig.sam4l
```kconfig
# Copyright (C) 2024-2025, Gerson Fernando Budke <nandojve@gmail.com>
# SPDX-License-Identifier: Apache-2.0

config WDT_SAM4L
	bool "Atmel SAM4L MCU Family Watchdog (WDT) Driver"
	default y
	depends on DT_HAS_ATMEL_SAM4L_WATCHDOG_ENABLED
	select HAS_WDT_DISABLE_AT_BOOT
	help
	  Enable WDT driver for Atmel SAM4L MCUs.
```

## drivers/watchdog/Kconfig.sdw_apb
```kconfig
# Synopsys DW AHB WDOG cfg

# Copyright 2022 Broadcom
# SPDX-License-Identifier: Apache-2.0

config WDOG_SDW_APB
	bool "SDW APB Watchdog Driver for RISCV family of MCUs"
	depends on (CONFIG_SOC_FAMILY_RISCV_PRIVILEGE) || \
		    SOC_FAMILY_BCMVK
	help
	  Enable SDW APB Watchdog (WDOG_SDW_APB) Driver for RISCV
	  family of MCUs.

config WDOG_SDW_APB_START_AT_BOOT
	bool "Start Watchdog during boot"
	depends on WDOG_SDW_APB
	help
	  Enable this setting to allow WDOG to be automatically started
	  during device initialization. Note that once WDOG is started
	  it must be reloaded before the counter reaches 0, otherwise
	  the MCU will be reset.
```

## drivers/watchdog/Kconfig.sf32lb
```kconfig
# Copyright (c) 2025 Qingsong Gou <gouqs@hotmail.com>
# SPDX-License-Identifier: Apache-2.0

config WDT_SF32LB
	bool "SF32LB Watchdog (WDT) Driver"
	default y
	depends on DT_HAS_SIFLI_SF32LB_WDT_ENABLED
	select HAS_WDT_DISABLE_AT_BOOT
	select HAS_WDT_NO_CALLBACKS
	help
	  Enable WDT driver for SF32LB series MCUs.
```

## drivers/watchdog/Kconfig.shakti
```kconfig
# SiFive Freedom WDT configuration

# Copyright (C) 2020 Katsuhiro Suzuki
# SPDX-License-Identifier: Apache-2.0

config WDT_SHAKTI
	bool "SiFive Watchdog (WDT) Driver"
	default y
	help
	  This option enables WDT driver for SiFive Freedom.
```

## drivers/watchdog/Kconfig.shell
```kconfig
# Copyright (c) 2023 Centralp
# SPDX-License-Identifier: Apache-2.0

config WDT_SHELL
	bool "Watchdog (WDT) shell"
	depends on SHELL
	help
	  Enable WDT shell.
```

## drivers/watchdog/Kconfig.sifive
```kconfig
# SiFive Freedom WDT configuration

# Copyright (C) 2020 Katsuhiro Suzuki
# SPDX-License-Identifier: Apache-2.0

config WDT_SIFIVE
	bool "SiFive Watchdog (WDT) Driver"
	default y
	depends on DT_HAS_SIFIVE_WDT_ENABLED
	help
	  This option enables WDT driver for SiFive Freedom.
```

## drivers/watchdog/Kconfig.siwx91x
```kconfig
# Copyright (c) 2025 Silicon Laboratories Inc.
# SPDX-License-Identifier: Apache-2.0

config WDT_SILABS_SIWX91X
	bool "Silabs SiWx91x Watchdog driver"
	default y
	depends on DT_HAS_SILABS_SIWX91X_WDT_ENABLED
	help
	  Enable the Watchdog driver for the Silabs SiWx91x SoC series.
```

## drivers/watchdog/Kconfig.smartbond
```kconfig
# Smartbond watchdog driver config

# Copyright (c) 2022 Renesas Electronics Corporation and/or its affiliates
# SPDX-License-Identifier: Apache-2.0

config WDT_SMARTBOND
	bool "Watchdog Driver for Smartbond family of MCUs"
	default y
	depends on DT_HAS_RENESAS_SMARTBOND_WATCHDOG_ENABLED
	select HAS_WDT_DISABLE_AT_BOOT
	help
	  Enable watchdog driver for Smartbond line of MCUs

config WDT_SMARTBOND_NMI
	bool "NMI pre-reset interrupt enable"
	default n
	depends on WDT_SMARTBOND
	select RUNTIME_NMI
	help
	  Watchdog timer generates NMI at value 0, and WDOG (SYS)
	  reset at <= -16. Timer can be frozen/resumed using
	  SET_FREEZE_REG[FRZ_WDOG]/RESET_FREEZE_REG[FRZ_WDOG].
	  When not set:
	  Watchdog timer generates a WDOG (SYS)
	  reset at value 0 and can not be frozen by Software.
	  Note that this bit can only be set to 1 by SW and
	  only be reset with a WDOG (SYS) reset or SW reset.
```

## drivers/watchdog/Kconfig.stm32
```kconfig
# STM32 IWDG configuration

# Copyright (c) 2016 Open-RnD Sp. z o.o.
# Copyright (c) 2017 RnDity Sp. z o.o.
# Copyright (c) 2019 Centaur Analytics, Inc
# SPDX-License-Identifier: Apache-2.0

config IWDG_STM32
	bool "Independent Watchdog (IWDG) Driver for STM32 family of MCUs"
	default y
	depends on DT_HAS_ST_STM32_WATCHDOG_ENABLED
	select HAS_WDT_NO_CALLBACKS
	help
	  Enable IWDG driver for STM32 line of MCUs

if IWDG_STM32

config IWDG_STM32_INITIAL_TIMEOUT
	int "Value for IWDG timeout in ms"
	default 100
	range 1 26214
	help
	  Set initial timeout value for IWDG in ms if enabled at boot.

	  The min timeout supported is 1 ms. The max timeout depends on the
	  MCU's LSI clock frequency and can be calculated with:

	    max. prescaler value (256) * max. reload ticks (4096) / LSI freq.

	  Limiting maximum timeout to a safe value of 26214 ms here, which was
	  calculated for highest LSI frequency among STM32 MCUs of 40 kHz.

config IWDG_STM32_EARLY_WAKEUP
	bool "Early Wakeup Interrupt support for STM32 IWDG"
	depends on $(dt_compat_any_has_prop,$(DT_COMPAT_ST_STM32_WATCHDOG),interrupts)
	help
	  Enable support for Early Wakeup Interrupt.

config IWDG_STM32_EWI_TIME
	int "Value for IWDG early wake-up in ticks"
	depends on IWDG_STM32_EARLY_WAKEUP
	default 100
	range 2 4095
	help
	  Set the early wake-up interrupt value for IWDG in ticks.
	  It represents the time before reset when the early wake-up occurs.
	  This value is ignored if the reload value provided at runtime
	  is smaller. In such cases, the interrupt triggers one tick after
	  the watchdog is reloaded.
endif

config WWDG_STM32
	bool "System Window Watchdog (WWDG) Driver for STM32 family of MCUs"
	default y
	depends on DT_HAS_ST_STM32_WINDOW_WATCHDOG_ENABLED
	help
	  Enable WWDG driver for STM32 line of MCUs
```

## drivers/watchdog/Kconfig.syna
```kconfig
# Synaptics SR100 Watchdog

# Copyright (c) 2025 Synaptics, Inc.
# SPDX-License-Identifier: Apache-2.0

config WDT_SYNA
	bool "Synaptics Watchdog Timer (WDT) driver"
	default y
	depends on DT_HAS_SYNA_WATCHDOG_ENABLED
	select RUNTIME_NMI
	select HAS_WDT_DISABLE_AT_BOOT
	help
	  Enable WDT driver for Synaptics MCU series. The watchdog is based
	  on the ARM SSE system timer.

config WDT_SYNA_DEFAULT_TIMEOUT_MAX
	int "Default timeout value of the WDT in ms"
	depends on WDT_SYNA
	default 1000
	range 1 $(UINT32_MAX)
	help
	  Sets the initial timeout value for WDT in ms if enabled at boot.
```

## drivers/watchdog/Kconfig.tco
```kconfig
# Intel TCO WDT support

# Copyright (c) 2022 Intel Corporation
# SPDX-License-Identifier: Apache-2.0

config WDT_TCO
	bool "Intel TCO Watchdog driver"
	default y
	depends on DT_HAS_INTEL_TCO_WDT_ENABLED
	select HAS_WDT_DISABLE_AT_BOOT
	help
	  Enable support for Intel TCO WDT driver.
```

## drivers/watchdog/Kconfig.ti_rti
```kconfig
# Copyright (c) 2025, Ayush Singh BeagleBoard.org Foundation
# SPDX-License-Identifier: Apache-2.0

config WDT_TI_RTI
	bool "Watchdog Driver for TI K3"
	default y
	depends on DT_HAS_TI_J7_RTI_WDT_ENABLED
	select HAS_WDT_DISABLE_AT_BOOT
	help
	  Enable support for K3 Watchdog timer (RTI module) available in the K3 generation of processors.
```

## drivers/watchdog/Kconfig.ti_tps382x
```kconfig
# Copyright (c) 2023 Prevas A/S
#
# SPDX-License-Identifier: Apache-2.0

config WDT_TI_TPS382X
	bool "External TI TPS382x Watchdog (WDT) Driver"
	default y
	depends on DT_HAS_TI_TPS382X_ENABLED
	depends on GPIO
	select HAS_WDT_NO_CALLBACKS
	help
	  Enable WDT driver for TI TPS382x. This is an external IC and requires
	  a GPIO connection from the processor.
```

## drivers/watchdog/Kconfig.ti_tps3851
```kconfig
# Copyright (c) 2025 Alex Fabre
#
# SPDX-License-Identifier: Apache-2.0

config WDT_TI_TPS3851
	bool "External TI TPS3851 Watchdog (WDT) Driver"
	default y
	depends on DT_HAS_TI_TPS3851_ENABLED
	depends on GPIO
	help
	  Enable WDT driver for TI TPS3851. This is an external IC and requires
	  three GPIO connections from the processor.

if WDT_TI_TPS3851

config WDT_TI_TPS3851_CALLBACK
	bool "Output pin WDO triggers a callback"
	default y
	depends on $(dt_compat_any_has_prop,$(DT_COMPAT_TI_TPS3851),wdo-gpios)
	help
	  When set, WDO GPIO triggers the watchdog callback on falling-edge event.

config WDT_TI_TPS3851_SET1_CONTROL
	bool "TPS3851 SET1 (Enable/disable pin) is controlled by mcu"
	default y
	depends on $(dt_compat_any_has_prop,$(DT_COMPAT_TI_TPS3851),set1-gpios)
	help
	  When set, the SET1 pin will be handled to enable and disable the watchdog timer.
	  When unset, the watchdog timer is considered always enabled.

endif # WDT_TI_TPS3851
```

## drivers/watchdog/Kconfig.tlx
```kconfig
# Copyright (c) 2024 Telink Semiconductor
# SPDX-License-Identifier: Apache-2.0

# Telink TLX WDT configuration options
config WDT_TELINK_TLX
	bool "Telink TLX series Watchdog (WDT) Driver"
	default y
	depends on DT_HAS_TELINK_TLX_WATCHDOG_ENABLED
	help
	  Enable WDT driver for Telink TLX-series MCUs.
```

## drivers/watchdog/Kconfig.uwp
```kconfig
#
# Copyright (c) 2018, UNISOC Incorporated
#
# SPDX-License-Identifier: Apache-2.0
#

menuconfig WDT_UWP
	bool "UNISOC UWP Watchdog Driver"
	depends on SOC_FAMILY_UWP
	default y
	help
	  Enable WDT driver for UNISOC UWP MCU.

config WDT_UWP_DEVICE_NAME
	string "Device name for Watchdog"
	depends on WDT_UWP
	default "UWP_WDT"
	help
	  Set the name used by WDT device during registration.
```

## drivers/watchdog/Kconfig.w91
```kconfig
# Copyright (c) 2024 Telink Semiconductor
# SPDX-License-Identifier: Apache-2.0

# Telink W91 WDT configuration options
config WDT_TELINK_W91
	bool "Telink W91 series Watchdog (WDT) Driver"
	default y
	depends on DT_HAS_TELINK_W91_WATCHDOG_ENABLED
	help
	  Enable WDT driver for Telink W91-series MCUs.

if WDT_TELINK_W91

config WDT_ALLOW_CALLBACK
	bool "Telink W91 Watchdog allow callback"
	default y
	help
	  Enable WDT callback for Telink W91-series MCUs.

endif # WDT_TELINK_W91
```

## drivers/watchdog/Kconfig.wch
```kconfig
# Copyright (c) 2025 Michael Hope <michaelh@juju.nz>
# SPDX-License-Identifier: Apache-2.0

config WDT_IWDG_WCH
	bool "WCH Independent Watchdog (IWDG) driver"
	default y
	depends on DT_HAS_WCH_IWDG_ENABLED
	help
	  Enable the Independent Watchdog (IWDG) driver. Tested on the
	  CH32V003 and CH32V208.
```

## drivers/watchdog/Kconfig.xec
```kconfig
# Microchip XEC Watchdog Timer configuration

# Copyright (c) 2019 Intel Corporation
# SPDX-License-Identifier: Apache-2.0

config WDT_XEC
	bool "Microchip XEC series Watchdog Timer (WDT) driver"
	default y
	depends on DT_HAS_MICROCHIP_XEC_WATCHDOG_ENABLED
	select HAS_WDT_DISABLE_AT_BOOT
	help
	  Enable WDT driver for Microchip XEC MCU series.
```

## drivers/watchdog/Kconfig.xlnx
```kconfig
# Xilinx watchdog configuration

# Copyright (c) 2023, Calian
# SPDX-License-Identifier: Apache-2.0

config WDT_XILINX_AXI
	bool "Xilinx AXI Timebase WDT driver"
	default y
	depends on DT_HAS_XLNX_XPS_TIMEBASE_WDT_1_00_A_ENABLED
	help
	  Enable the Xilinx AXI Timebase WDT driver.

if WDT_XILINX_AXI

config WDT_XILINX_AXI_HWINFO_API
	bool "Expose HWINFO API in Xilinx AXI Timebase WDT driver"
	default y
	select HWINFO
	help
	  Controls whether the Xilinx AXI Timebase WDT driver exposes a HWINFO
	  API which allows determining whether the WDT initiated the last
	  system reset. This may need to be disabled if using a device or SoC
	  which already implements this API.

endif # WDT_XILINX_AXI
```
