## drivers/watchdog/Kconfig.adi_max42500
```kconfig
# MAX42500 WDT configuration

# Copyright (C) 2025 Analog Devices, Inc
# SPDX-License-Identifier: Apache-2.0

config WDT_ADI_MAX42500
	bool "ADI MAX42500 Watchdog (WDT) Driver"
	default y
	depends on DT_HAS_ADI_MAX42500_WATCHDOG_ENABLED
	select I2C
	help
	  Enable WDT driver for ADI MAX42500.
```

## drivers/watchdog/Kconfig.ambiq
```kconfig
# Ambiq SDK WDT
#
# Copyright (c) 2023 Antmicro <www.antmicro.com>
#
# SPDX-License-Identifier: Apache-2.0
#
config WDT_AMBIQ
	bool "AMBIQ WDT driver"
	default y
	depends on DT_HAS_AMBIQ_WATCHDOG_ENABLED
	select AMBIQ_HAL
	select AMBIQ_HAL_USE_WDT
	help
	  Enable driver for Ambiq WDT.
```

## drivers/watchdog/Kconfig.ameba
```kconfig
# AMEBA WDT configuration

# Copyright (c) 2026 Realtek Semiconductor Corp.
# SPDX-License-Identifier: Apache-2.0

config WDT_AMEBA
	bool "AMEBA Watchdog (WDT) Driver"
	default y
	depends on DT_HAS_REALTEK_AMEBA_WATCHDOG_ENABLED
	help
	  Enable WDT driver for AMEBA.
```

## drivers/watchdog/Kconfig.andes_atcwdt200
```kconfig
# Kconfig Andes Watchdog configuration options
#
# Copyright (c) 2023 Andes Technology Corporation.
#
# SPDX-License-Identifier: Apache-2.0
#

config WDT_ANDES_ATCWDT200
	bool "Andes Watchdog driver"
	default y
	depends on DT_HAS_ANDESTECH_ATCWDT200_ENABLED
	select COUNTER
	help
	  Enable driver for the Andes Watchdog driver.
```

## drivers/watchdog/Kconfig.b91
```kconfig
# Copyright (c) 2023 Telink Semiconductor
# SPDX-License-Identifier: Apache-2.0

# Telink B91 WDT configuration options
config WDT_TELINK_B91
	bool "Telink B91 series Watchdog (WDT) Driver"
	default y
	depends on DT_HAS_TELINK_B91_WATCHDOG_ENABLED
	help
	  Enable WDT driver for Telink B91 MCUs.
```

## drivers/watchdog/Kconfig.b9x
```kconfig
# Copyright (c) 2023-2024 Telink Semiconductor
# SPDX-License-Identifier: Apache-2.0

# Telink B9X WDT configuration options
config WDT_TELINK_B9X
	bool "Telink B9X series Watchdog (WDT) Driver"
	default y
	depends on DT_HAS_TELINK_B9X_WATCHDOG_ENABLED
	help
	  Enable WDT driver for Telink B9X-series MCUs.
```

## drivers/watchdog/Kconfig.bee
```kconfig
# Copyright(c) 2026, Realtek Semiconductor Corporation.
# SPDX-License-Identifier: Apache-2.0

config WDT_BEE_CORE
	bool "Realtek Bee CORE Watch Dog Timer driver"
	default y
	depends on DT_HAS_REALTEK_BEE_CORE_WDT_ENABLED
	select HAL_REALTEK_BEE_CORE_WDT
	help
	  Enable the CORE WDT driver for Realtek Bee Family SoCs.
```

## drivers/watchdog/Kconfig.bflb
```kconfig
# SPDX-FileCopyrightText: Copyright The Zephyr Project Contributors
# SPDX-License-Identifier: Apache-2.0

config WDT_BFLB
	bool "Bouffalo Lab watchdog driver"
	default y
	depends on DT_HAS_BFLB_WDT_ENABLED
	help
	  Enable watchdog driver for Bouffalo Lab SoCs.
```

## drivers/watchdog/Kconfig.cc13xx_cc26xx
```kconfig
# Copyright (c) 2021 Florin Stancu <niflostancu@gmail.com>
# SPDX-License-Identifier: Apache-2.0

config WDT_CC13XX_CC26XX
	bool "Watchdog Driver for CC13xx / CC26xx family of MCUs"
	default y
	depends on DT_HAS_TI_CC13XX_CC26XX_WATCHDOG_ENABLED
	help
	  Enable watchdog for CC13xx / CC26xx family of MCUs
```

## drivers/watchdog/Kconfig.cc23x0
```kconfig
# Copyright (c) 2024 BayLibre, SAS
# SPDX-License-Identifier: Apache-2.0

config WDT_CC23X0
	bool "Watchdog Driver for CC23x0 family of MCUs"
	default y
	depends on DT_HAS_TI_CC23X0_WDT_ENABLED
	help
	  Enable watchdog for CC23x0 family of MCUs
```

## drivers/watchdog/Kconfig.cc32xx
```kconfig
# Copyright (c) 2021 Pavlo Hamov <pasha.gamov@gmail.com>
# SPDX-License-Identifier: Apache-2.0

config WDT_CC32XX
	bool "Watchdog Driver for cc32xx family of MCUs"
	default y
	depends on DT_HAS_TI_CC32XX_WATCHDOG_ENABLED
	help
	  Watchdog for cc32xx family of MCUs
```

## drivers/watchdog/Kconfig.cmsdk_apb
```kconfig
# ARM CMSDK (Cortex-M System Design Kit) AHB WDOG cfg

# Copyright (c) 2016 Linaro Limited
# SPDX-License-Identifier: Apache-2.0

config WDOG_CMSDK_APB
	bool "CMSDK APB Watchdog Driver for ARM family of MCUs"
	depends on RUNTIME_NMI
	help
	  Enable CMSDK APB Watchdog (WDOG_CMSDK_APB) Driver for ARM
	  family of MCUs.

config WDOG_CMSDK_APB_START_AT_BOOT
	bool "Start Watchdog during boot"
	depends on WDOG_CMSDK_APB
	help
	  Enable this setting to allow WDOG to be automatically started
	  during device initialization. Note that once WDOG is started
	  it must be reloaded before the counter reaches 0, otherwise
	  the MCU will be reset.
```

## drivers/watchdog/Kconfig.crsas_ma2
```kconfig
# ARM CRSAS (Corstone Reference Systems Architecture Specification Ma2) Watchdog Timer

# Copyright 2026 Google LLC
# SPDX-License-Identifier: Apache-2.0

config WDT_CRSAS_MA2
	bool "CRSAS-MA2 Watchdog Driver"
	default y
	select CLOCK_CONTROL
	depends on DT_HAS_ARM_CRSAS_MA2_WATCHDOG_ENABLED
	help
	  Enable CRSAS-MA2 Watchdog Driver
```

## drivers/watchdog/Kconfig.dw
```kconfig
# Synopsys DesignWare Watchdog configuration options

# Copyright (c) 2022 Intel Corporation
# SPDX-License-Identifier: Apache-2.0

config WDT_DW
	bool "Synopsys DesignWare Watchdog driver"
	default y
	depends on DT_HAS_SNPS_DESIGNWARE_WATCHDOG_ENABLED
	help
	  Synopsys DesignWare Watchdog driver.
```

## drivers/watchdog/Kconfig.ene
```kconfig
# Copyright (c) 2024 ENE Technology Inc.
# SPDX-License-Identifier: Apache-2.0

config WDT_ENE_KB1200
	bool "ENE KB1200 watchdog driver"
	default y
	depends on DT_HAS_ENE_KB1200_WATCHDOG_ENABLED
	help
	  This option enables the KB1200 watchdog driver.
```

## drivers/watchdog/Kconfig.gd32
```kconfig
# Copyright (c) 2021 TOKITA Hiroshi <tokita.hiroshi@gmail.com>
# SPDX-License-Identifier: Apache-2.0

config FWDGT_GD32
	bool "GD32 Free watchdog timer (FWDGT) driver"
	default y
	depends on DT_HAS_GD_GD32_FWDGT_ENABLED
	select USE_GD32_FWDGT
	help
	  Enable the Free watchdog timer (FWDGT) driver for GD32 SoCs.

config WWDGT_GD32
	bool "GD32 Window watchdog timer (WWDGT) Driver"
	default y
	depends on DT_HAS_GD_GD32_WWDGT_ENABLED
	select USE_GD32_WWDGT
	help
	  Enable the Window watchdog timer (WWDGT) driver for GD32 SoCs.
```

## drivers/watchdog/Kconfig.gecko
```kconfig
# Watchdog configuration options
#
# Copyright (c) 2019 Interay Solutions B.V.
# Copyright (c) 2019 Oane Kingma
#
# SPDX-License-Identifier: Apache-2.0

config WDT_GECKO
	bool "Gecko series Watchdog (WDOG) Driver"
	default y
	depends on DT_HAS_SILABS_GECKO_WDOG_ENABLED
	select HAS_WDT_DISABLE_AT_BOOT
	select SOC_GECKO_WDOG if SOC_FAMILY_SILABS_S0 || SOC_FAMILY_SILABS_S1
	select SILABS_SISDK_WDOG if SOC_FAMILY_SILABS_S2
	help
	  Enable WDOG driver for Silicon Labs Gecko MCUs.
```

## drivers/watchdog/Kconfig.gpio
```kconfig
# Kconfig - GPIO based WDT configuration
#
# Copyright (C) 2018 qianfan Zhao
#
# SPDX-License-Identifier: Apache-2.0
#

menuconfig WDT_GPIO
	bool "GPIO based (WDT) Driver"
	depends on GPIO
	default n
	help
	  Enable WDT driver for GPIO based chip, eg: SP706

config WDT_GPIO_MINIMUM_SUPPORT
	bool "Minimum support"
	depends on WDT_GPIO
	default n
	help
	  Select the minimum support mode for gpio watchdog, doesn't support
	  setup/disable/install_timeout.
	  This mode doesn't need k_delay_work, and can save some resource.

config WDT_GPIO_INIT_PRIORITY
	int "Init priority"
	depends on WDT_GPIO
	default 60
	help
	  WDT_GPIO device driver initialization priority.
	  This driver is based on GPIO, please make sure the priority is
	  lower that GPIO driver.
```

## drivers/watchdog/Kconfig.ifx_cat1
```kconfig
# ==================================================================================================
# Copyright (c) 2025 Cypress Semiconductor Corporation (an Infineon company) or
# an affiliate of Cypress Semiconductor Corporation
#
# SPDX-License-Identifier: Apache-2.0
# ==================================================================================================

# Infineon CAT1 Watchdog configuration options

config WDT_INFINEON_CAT1
	bool "Infineon CAT1 Watchdog Driver"
	default y
	depends on DT_HAS_INFINEON_CAT1_WATCHDOG_ENABLED
	select USE_INFINEON_WDT
	help
	  Enable Watchdog driver for Infineon CAT1 devices.
```

## drivers/watchdog/Kconfig.intel_adsp
```kconfig
# Intel ADSP Watchdog configuration options

# Copyright (c) 2023 Intel Corporation
# SPDX-License-Identifier: Apache-2.0

config WDT_INTEL_ADSP
	bool "Intel ADSP Watchdog driver"
	default y
	depends on DT_HAS_INTEL_ADSP_WATCHDOG_ENABLED
	help
	  Intel ADSP Watchdog driver.
```

## drivers/watchdog/Kconfig.it51xxx
```kconfig
# Copyright (c) 2025 ITE Corporation. All Rights Reserved.
# SPDX-License-Identifier: Apache-2.0

config WDT_ITE_IT51XXX
	bool "ITE it51xxx Watchdog Timer (WDT) driver"
	default y
	depends on DT_HAS_ITE_IT51XXX_WATCHDOG_ENABLED
	select HAS_WDT_DISABLE_AT_BOOT
	help
	  This option enables the Watchdog Timer driver for ITE it51xxx.
	  This driver supports only one channel that id is 0 and 16-bits
	  resolution WDT.

config WDT_ITE_WARNING_LEADING_TIME_MS
	int "Number of ms before generating watchdog event/signal"
	depends on WDT_ITE_IT51XXX
	default 500
	help
	  This option defines the window in which a watchdog event must be
	  handled. After this time window, the watchdog reset triggers
	  immediately.

config WDT_ITE_REDUCE_WARNING_LEADING_TIME
	bool "Reduce warning leading time"
	depends on WDT_ITE_IT51XXX
	help
	  Once warning timer triggered, if watchdog timer isn't reloaded,
	  then we will reduce interval of warning timer to 30ms to print
	  more warning messages before watchdog reset.
```

## drivers/watchdog/Kconfig.it8xxx2
```kconfig
# Copyright (c) 2021 ITE Corporation. All Rights Reserved.
# SPDX-License-Identifier: Apache-2.0

config WDT_ITE_IT8XXX2
	bool "ITE it8xxx2 Watchdog Timer (WDT) driver"
	default y
	depends on DT_HAS_ITE_IT8XXX2_WATCHDOG_ENABLED
	select HAS_WDT_DISABLE_AT_BOOT
	help
	  This option enables the Watchdog Timer driver for ITE it8xxx2.
	  This driver supports only one channel that id is 0 and 16-bits
	  resolution WDT.

config WDT_ITE_WARNING_LEADING_TIME_MS
	int "Number of ms before generating watchdog event/signal"
	depends on WDT_ITE_IT8XXX2
	default 500
	help
	  This option defines the window in which a watchdog event must be
	  handled. After this time window, the watchdog reset triggers
	  immediately.

config WDT_ITE_REDUCE_WARNING_LEADING_TIME
	bool "Reduce warning leading time"
	depends on WDT_ITE_IT8XXX2
	help
	  Once warning timer triggered, if watchdog timer isn't reloaded,
	  then we will reduce interval of warning timer to
	  WDT_ITE_PRINT_WARNING_MSG_TIME_MS for printing more warning messages
	  before watchdog reset.

config WDT_ITE_PRINT_WARNING_MSG_TIME_MS
	int "Time interval to print warning message in milliseconds"
	depends on WDT_ITE_IT8XXX2
	default 100
	range 30 WDT_ITE_WARNING_LEADING_TIME_MS
	help
	  Time interval to print warning message in milliseconds.
```

## drivers/watchdog/Kconfig.kb1200
```kconfig
# Watchdog timer configuration

# Copyright (c) 2023 ENE Technology

config WDT_KB1200
	bool "KB1200 watchdog driver"
	help
	  This option enables the KB1200 watchdog driver.
```

## drivers/watchdog/Kconfig.litex
```kconfig
# LiteX WDT configuration

# Copyright (C) 2024 Vogl Electronic GmbH
# SPDX-License-Identifier: Apache-2.0

config WDT_LITEX
	bool "LiteX Watchdog (WDT) Driver"
	default y
	depends on DT_HAS_LITEX_WATCHDOG_ENABLED
	help
	  Enable WDT driver for LiteX.
```

## drivers/watchdog/Kconfig.m5pm1
```kconfig
# Copyright (c) 2026 The Zephyr Project Contributors
# SPDX-License-Identifier: Apache-2.0

config WDT_M5PM1
	bool "M5Stack M5PM1 watchdog driver"
	default y
	depends on DT_HAS_M5STACK_M5PM1_WDT_ENABLED
	select MFD
	help
	  Enable the watchdog driver for the M5Stack M5PM1.

config WDT_M5PM1_INIT_PRIORITY
	int "M5PM1 watchdog driver initialization priority"
	depends on WDT_M5PM1
	default 82
	help
	  Initialization priority for the M5PM1 watchdog driver. It must be
	  greater than the MFD initialization priority.
```
