## drivers/watchdog/Kconfig.max20356
```kconfig
# Copyright (c) 2026 Analog Devices, Inc.
# SPDX-License-Identifier: Apache-2.0

config WDT_MAX20356
	bool "MAX20356/MAX20358 watchdog driver"
	default y
	depends on DT_HAS_ADI_MAX20356_WATCHDOG_ENABLED
	depends on MFD_MAX20356_TRIGGER
	help
	  Enable the Analog Devices MAX20356/MAX20358 watchdog child driver.

if WDT_MAX20356

config WDT_MAX20356_INIT_PRIORITY
	int "MAX20356 watchdog init priority"
	default 90
	help
	  Init priority for the MAX20356/MAX20358 watchdog child. Must be greater
	  than CONFIG_MFD_INIT_PRIORITY so the parent is initialized first.

endif # WDT_MAX20356
```

## drivers/watchdog/Kconfig.mchp
```kconfig
# Copyright (c) 2025-2026 Microchip Technology Inc.
# SPDX-License-Identifier: Apache-2.0

config WDT_MCHP_MSS
	bool "Microchip MSS Watchdog (WDT) Driver"
	default y
	depends on DT_HAS_MICROCHIP_WDT_MSS_ENABLED
	help
	  Enable WDT driver for Microchip MSS.
```

## drivers/watchdog/Kconfig.mspm0
```kconfig
# Copyright (c) 2024 Texas Instruments
# Copyright (c) 2026 Linumiz
#
# SPDX-License-Identifier: Apache-2.0

config WDT_MSPM0
	bool "MSPM0 Windowed Watchdog (WWDT) Driver"
	default y
	depends on DT_HAS_TI_MSPM0_WATCHDOG_ENABLED

config WDT_MSPM0_IWDT
	bool "MSPM0 Independent Watchdog (IWDT) Driver"
	default y
	depends on DT_HAS_TI_MSPM0_IWDT_ENABLED
```

## drivers/watchdog/Kconfig.npcm
```kconfig
# Copyright (c) 2026 Nuvoton Technology Corporation.
# SPDX-License-Identifier: Apache-2.0

config WDT_NPCM
	bool "Nuvoton NPCM Watchdog Timer driver"
	default y
	depends on DT_HAS_NUVOTON_NPCM_WATCHDOG_ENABLED
	select HAS_WDT_DISABLE_AT_BOOT
	select HAS_WDT_NO_CALLBACKS
	help
	  This option enables the Watchdog Timer driver for the Nuvoton NPCM
	  family of processors.
```

## drivers/watchdog/Kconfig.renesas_ra
```kconfig
# Copyright (c) 2025 Renesas Electronics Corporation
# SPDX-License-Identifier: Apache-2.0

config WDT_RENESAS_RA
	bool "Watchdog Driver for Renesas RA family"
	default y
	depends on DT_HAS_RENESAS_RA_WDT_ENABLED
	select HAS_WDT_DISABLE_AT_BOOT
	select SOC_OPTION_SETTING_MEMORY if SOC_SERIES_RA4M1
	select USE_RA_FSP_WDT
	help
	  Enable watchdog driver for Renesas RA MCUs

if WDT_RENESAS_RA

config WDT_RENESAS_RA_NMI
	bool "NMI interrupt enable"
	default y
	select RUNTIME_NMI
	help
	  Watchdog timer generates NMI at value 0

config WDT_RENESAS_RA_START_IN_BOOT
	bool "Start WDT in boot time"
	default y
	depends on !HAS_WDT_DISABLE_AT_BOOT
	help
	  Start watchdog in boot time

endif # WDT_RENESAS_RA

config WDT_RENESAS_RA_IWDT
	bool "Independent Watchdog Driver for Renesas RA family"
	default y
	depends on DT_HAS_RENESAS_RA_IWDT_ENABLED
	select USE_RA_FSP_IWDT
	help
	  Enable independent watchdog driver for Renesas RA MCUs

if WDT_RENESAS_RA_IWDT

config WDT_RENESAS_RA_IWDT_NMI
	bool "NMI interrupt enable for IWDT"
	default y
	select RUNTIME_NMI
	help
	  Independent watchdog timer generates an NMI on underflow or refresh error
	  instead of resetting the SoC, so a callback registered via install_timeout()
	  can run.

choice
	prompt "IWDT Start Mode"
	default WDT_RENESAS_RA_IWDT_AUTO_START_MODE
	help
	  Select the IWDT start mode.
	  - WDT_RENESAS_RA_IWDT_AUTO_START_MODE: Counting starts automatically after a reset,
	    controlled by the Option Function Select Register 0 (OFS0). Window, timeout and
	    clock division settings are fixed in OFS0 at flash time and cannot be changed by
	    this driver at runtime. This is the only mode available on RA MCUs whose IWDT
	    does not implement register start mode.
	  - WDT_RENESAS_RA_IWDT_REGISTER_START_MODE: The IWDT stays stopped after a reset and
	    is started by this driver's setup() call, which programs window, timeout and
	    clock division settings at runtime. Only meaningful on RA MCUs whose IWDT
	    implements register start mode; selecting it on any other MCU is a build error.

config WDT_RENESAS_RA_IWDT_AUTO_START_MODE
	bool "Start IWDT automatically on reset"

config WDT_RENESAS_RA_IWDT_REGISTER_START_MODE
	bool "Start IWDT via register write"

endchoice

endif # WDT_RENESAS_RA_IWDT
```

## drivers/watchdog/Kconfig.silabs
```kconfig
# Copyright (c) 2025 Silicon Laboratories Inc.
# SPDX-License-Identifier: Apache-2.0

config WDT_SILABS_SIWX91X
	bool "Silabs SiWx91x Watchdog driver"
	default y
	depends on DT_HAS_SILABS_SIWX91X_WDT_ENABLED
	depends on CLOCK_CONTROL
	help
	  Enable the Watchdog driver for the Silabs SiWx91x SoC series.

config WDT_SILABS_WDOG
	bool "Silabs Series 3 Watchdog driver"
	default y
	select HAS_WDT_DISABLE_AT_BOOT
	select HAS_WDT_MULTISTAGE
	select SILABS_SISDK_WDOG
	depends on DT_HAS_SILABS_WDOG_ENABLED
	depends on CLOCK_CONTROL
	help
	  Enable the Watchdog driver for Silicon Labs Series 3 devices.
```

## drivers/watchdog/Kconfig.ti_lpf3
```kconfig
# Copyright (c) 2025 Texas Instruments Incorporated
# SPDX-License-Identifier: Apache-2.0


config WDT_LPF3
	bool "TI LPF3 Watchdog driver"
	default y
	depends on DT_HAS_TI_LPF3_WDT_ENABLED
	select HAS_WDT_DISABLE_AT_BOOT
	help
	  This option enables support for the unified watchdog timer driver
	  for TI SimpleLink CC23X0 and CC27XX family of devices.

if WDT_LPF3

config WDT_LPF3_INITIAL_TIMEOUT
	int "Value for initial WDT timeout in ms"
	default 2000
	help
	  Value for initial WDT timeout in ms for TI LPF3 family devices.

endif # WDT_LPF3
```

## drivers/watchdog/Kconfig.tle927x
```kconfig
# SPDX-FileCopyrightText: Copyright (c) 2026 Deere & Company
# SPDX-FileCopyrightText: Copyright (c) 2026 Linumiz
# SPDX-License-Identifier: Apache-2.0

config WDT_TLE927X
	bool "Infineon TLE927x SBC watchdog driver"
	default y
	depends on DT_HAS_INFINEON_TLE927X_WDT_ENABLED
	depends on MFD_TLE927X
	select HAS_WDT_NO_CALLBACKS
	help
	  Enable the watchdog driver for the Infineon TLE927x System Basis
	  Chip. The SBC watchdog runs in SBC Normal and Stop mode and resets
	  the SoC through the RO pin on a missed trigger. It cannot be
	  disabled.

if WDT_TLE927X

config WDT_TLE927X_INIT_PRIORITY
	int "TLE927x watchdog driver init priority"
	default 78
	help
	  Init priority for the TLE927x watchdog driver. It must be greater
	  than MFD_TLE927X_INIT_PRIORITY.

endif # WDT_TLE927X
```

## drivers/watchdog/Kconfig.xen
```kconfig
# SPDX-FileCopyrightText: Copyright (c) 2026 EPAM Systems
# SPDX-License-Identifier: Apache-2.0

config WDT_XEN
	bool "Xen domain watchdog driver"
	default y
	depends on XEN
	depends on DT_HAS_XEN_WATCHDOG_ENABLED
	select HAS_WDT_NO_CALLBACKS
	help
	  Enable a watchdog driver backed by Xen SCHEDOP_watchdog.

	  This driver exposes Xen domain watchdog timers through Zephyr's
	  watchdog API for the current Xen domain. Xen provides two domain
	  watchdog timer slots, exposed as configurable Zephyr watchdog
	  channels.
	  Expiration is handled by Xen according to the domain's on_watchdog
	  policy, so pre-timeout callbacks are not supported.
	  Xen accepts watchdog timeouts in whole seconds. Timeout windows shorter
	  than one second are rejected, and longer millisecond values are rounded
	  up to the next second.
```

## drivers/watchdog/Kconfig.xilinx_wwdt
```kconfig
# Copyright (c) 2025-2026 Advanced Micro Devices, Inc.
# SPDX-License-Identifier: Apache-2.0

config XILINX_VERSAL_WATCHDOG
	bool "Xilinx Versal watchdog driver"
	default y
	depends on DT_HAS_XLNX_VERSAL_WWDT_ENABLED
	help
	  Enable Versal watchdog driver for the versal_wwdt IP core.
	  Window watchdog timer(WWDT) contains closed(first) and
	  open(second) window with 32 bit width. Write to the watchdog
	  timer within predefined window periods of time. This means
	  a period that is not too soon and a period that is not too
	  late. The WWDT has to be restarted within the open window time.
	  If software tries to restart WWDT outside of the open window
	  time period, it generates a SOC reset.
	  The same IP also provides a generic watchdog (GWDT); select the
	  active engine via the mode choice below.

if XILINX_VERSAL_WATCHDOG

choice
	prompt "Watchdog mode"
	default XILINX_VERSAL_WDT_WINDOW_MODE
	help
	  Select which watchdog engine of the IP the driver operates.

config XILINX_VERSAL_WDT_WINDOW_MODE
	bool "Window watchdog mode"
	help
	  Enable the window watchdog.

config XILINX_VERSAL_WDT_GENERIC_MODE
	bool "Generic watchdog (GWDT) mode"
	help
	  Enable the generic watchdog.

endchoice

endif # XILINX_VERSAL_WATCHDOG
```

## drivers/wifi/bflb/wifi4/Kconfig
```kconfig
# SPDX-FileCopyrightText: Copyright The Zephyr Project Contributors
#
# SPDX-License-Identifier: Apache-2.0

if DT_HAS_BFLB_WIFI4_ENABLED

config WIFI_BFLB_WIFI4
	def_bool y
	select BFLB_BL602_OS_SHIM
	# The bl_ops_funcs OS shim maps the blob's event groups onto k_event.
	select EVENTS
	# CRC32 backs the blob's beacon integrity stream.
	select CRC
	# SW CCMP (PSA) for the data-TX encrypt workaround.
	select MBEDTLS_PSA_CRYPTO_C
	select PSA_WANT_KEY_TYPE_AES
	select PSA_WANT_ALG_CCM
	help
	  Common support for the wifi4 MACSW firmware blob driver
	  (BL60x).

config WIFI_BFLB_WIFI4_TASK_STACK_SIZE
	int "WiFi firmware task stack size"
	default 4096
	help
	  Stack size for the wifi4 firmware scheduler thread.  The blob's
	  kernel queues and event handlers all run there.

config WIFI_BFLB_WIFI4_TASK_PRIORITY
	int "WiFi firmware task priority"
	default 5
	help
	  Preemptible thread priority of the firmware scheduler loop.

config WIFI_BFLB_WIFI4_RX_RING_CNT
	int "RX staging ring slots"
	default 8
	help
	  Number of 1600-byte staging slots between the firmware RX
	  callback and the net_pkt allocation work queue.

config WIFI_BFLB_WIFI4_SCAN_AP_MAX
	int "Scan result cache entries"
	default 32
	help
	  Number of access points kept in the scan result cache.

endif # DT_HAS_BFLB_WIFI4_ENABLED
```

## drivers/wifi/emw3080/Kconfig.emw3080
```kconfig
# Copyright (c) 2026 Witekio
# SPDX-License-Identifier: Apache-2.0

menuconfig WIFI_EMW3080
	bool "MXCHIP EMW3080 Wi-Fi support"
	default y
	depends on DT_HAS_MXCHIP_EMW3080_ENABLED
	select NET_L2_WIFI_MGMT
	select WIFI_USE_NATIVE_NETWORKING
	select NET_L2_ETHERNET
	select SPI
	select GPIO
	help
	  Enable the MXCHIP EMW3080 Wi-Fi module driver. The module is used
	  in network bypass mode: Ethernet frames are exchanged over SPI and
	  the IP stack runs on the host. Station mode only, with open, WEP,
	  WPA-Personal and WPA2-Personal security.

if WIFI_EMW3080

config WIFI_EMW3080_SPI_THREAD_STACK_SIZE
	int "SPI transport thread stack size"
	default 2048
	help
	  Stack size of the thread that runs SPI transactions and delivers
	  received frames, including bypass frames to the network stack.

config WIFI_EMW3080_SPI_THREAD_PRIORITY
	int "SPI transport thread priority"
	default 1
	help
	  Preemptive priority of the SPI transport thread. It must be higher
	  (numerically lower) than the driver work queue priority.

config WIFI_EMW3080_WORKQ_STACK_SIZE
	int "Driver work queue stack size"
	default 4096
	help
	  Stack size of the work queue running scan, connect, disconnect and
	  module recovery.

config WIFI_EMW3080_WORKQ_PRIORITY
	int "Driver work queue priority"
	default 5
	help
	  Preemptive priority of the driver work queue.

config WIFI_EMW3080_FLOW_TIMEOUT_MS
	int "FLOW handshake timeout (ms)"
	default 200
	help
	  Maximum time to wait for the module to raise FLOW during an SPI
	  transaction.

config WIFI_EMW3080_RESET_PULSE_MS
	int "Reset pulse duration (ms)"
	default 100

config WIFI_EMW3080_BOOT_DELAY_MS
	int "Boot delay after reset (ms)"
	default 1200
	help
	  Time to wait after releasing reset before the module accepts
	  commands.

config WIFI_EMW3080_CMD_TIMEOUT_MS
	int "Default command timeout (ms)"
	default 3000
	help
	  Timeout for commands without a dedicated timeout, including
	  bypass frame transmission.

config WIFI_EMW3080_SCAN_TIMEOUT_MS
	int "Scan command timeout (ms)"
	default 10000

config WIFI_EMW3080_CONNECT_TIMEOUT_MS
	int "Connection timeout (ms)"
	default 15000
	help
	  Maximum time between a connect request and the station up event.
	  On expiry the attempt is aborted and reported as failed.

config WIFI_EMW3080_MAX_CMD_TIMEOUTS
	int "Command timeouts before module reset"
	default 3
	range 0 255
	help
	  Number of consecutive command timeouts or transport errors after
	  which the module is considered lost: the link is reported down,
	  then the module is reset and reconfigured. 0 disables the
	  recovery.

endif # WIFI_EMW3080
```

## drivers/wifi/rpi_pico_cyw43/Kconfig.rpi_pico_cyw43
```kconfig
# Copyright (c) 2023 Beechwoods Software
# Copyright (c) 2026 Igalia S.L.
# SPDX-License-Identifier: Apache-2.0

menuconfig WIFI_RPI_PICO_CYW43
	bool "Infineon CYW43 SoC Wifi support for Raspberry Pi Pico W boards"
	depends on DT_HAS_RASPBERRYPI_CYW43_WIFI_ENABLED
	default y
	select NET_L2_WIFI_MGMT
	select NET_L2_ETHERNET
	select NET_L2_ETHERNET_MGMT
	select WIFI_USE_NATIVE_NETWORKING
	select SPI
	help
	  Enable Infineon CYW43439 SoC Wi-Fi support for Raspberry Pi Pico W boards.

if WIFI_RPI_PICO_CYW43

config RPI_PICO_CYW43_GPIO_INIT_PRIORITY
	int "Wifi gpio driver init priority"
	default 80

config WIFI_RPI_PICO_CYW43_USE_FIXED_MAC_ADDRESS
	bool "Use a fixed MAC address instead of reading it from OTP"
	default n
	help
	  Use a fixed MAC address instead of reading it from OTP

config WIFI_RPI_PICO_CYW43_FIXED_MAC_ADDRESS
	string "Fixed MAC address with format XX:XX:XX:XX:XX:XX"
	depends on WIFI_RPI_PICO_CYW43_USE_FIXED_MAC_ADDRESS
	default "00:00:5E:00:53:01"
	help
	  For testing only. This defines a fixed MAC address to use instead of reading it from OTP.

config WIFI_RPI_PICO_CYW43_PM_MODE
	int "Power save mode (0=off 1=PM1 aggressive 2=PM2 performance)"
	range 0 2
	default 0
	help
	  Select the CYW43 power save mode.  PM1 saves more power but reduces
	  throughput.  PM2 has little impact on throughput.

config WIFI_RPI_PICO_CYW43_PM2_SLEEP_RET_MS
	int "PM2 sleep return time (0-255 x 10 ms)"
	range 0 255
	default 200
	help
	  Maximum time to wait before going back to sleep in PM2 mode.

config WIFI_RPI_PICO_CYW43_PM_LI_BEACON_PERIOD
	int "Listen interval in beacon periods (0-15)"
	range 0 15
	default 1

config WIFI_RPI_PICO_CYW43_PM_LI_DTIM_PERIOD
	int "Listen interval in DTIMs (0-15, 0 means use beacon period)"
	range 0 15
	default 1

config WIFI_RPI_PICO_CYW43_PM_LI_ASSOC
	int "Wake interval sent to AP (0-15)"
	range 0 15
	default 10

config WIFI_RPI_PICO_CYW43_AP_DHCPV4_ADDRESS
	string "IP address to set when acting as an DHCP server (AP mode)"
	depends on NET_DHCPV4_SERVER
	default "192.168.10.1"
	help
	  IP address to set when acting as an DHCP server (AP mode)

config WIFI_RPI_PICO_CYW43_AP_DHCPV4_BASE_ADDRESS
	string "DHCP base address (AP mode)"
	depends on NET_DHCPV4_SERVER
	default "192.168.10.2"
	help
	  DHCP base address (AP mode)

config WIFI_RPI_PICO_CYW43_AP_DHCPV4_NETMASK
	string "IP netmask (AP mode)"
	depends on NET_DHCPV4_SERVER
	default "255.255.255.0"
	help
	  IP netmask (AP mode)

config WIFI_RPI_PICO_CYW43_JOIN_ATTEMPTS
	int "Number of consecutive attempts to join a network"
	range 1 10
	default 2
	help
	  Number of consecutive attempts to join a network.

config WIFI_RPI_PICO_CYW43_LINK_UP_WAIT_SECS
	int "Time to wait for a link up event after joining a network, in seconds"
	range 1 255
	default 10
	help
	  Time to wait for a link up event after joining a network, in seconds.

comment "Consider setting SYSTEM_WORKQUEUE_STACK_SIZE >= 2048 when NET_DHCPV4_SERVER is enabled"
	depends on NET_DHCPV4_SERVER
	depends on SYSTEM_WORKQUEUE_STACK_SIZE < 2048

endif # WIFI_RPI_PICO_CYW43
```
