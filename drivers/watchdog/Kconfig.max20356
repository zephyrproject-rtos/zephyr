## drivers/wifi/silabs_ncp/Kconfig.silabs_ncp
```kconfig
# Copyright (c) 2026 Silicon Laboratories Inc.
# SPDX-License-Identifier: Apache-2.0

config WIFI_SILABS_NCP
	bool "Silicon Labs network co-processor Wi-Fi driver"
	default y
	depends on DT_HAS_SILABS_NCP_WIFI_ENABLED
	select WIFI_NM_WPA_SUPPLICANT
	select EXPERIMENTAL
	select NET_L2_ETHERNET
	select NET_L2_WIFI_MGMT
	select WIFI_USE_NATIVE_NETWORKING
	help
	  Wi-Fi driver for a station running on a Silicon Labs network
	  co-processor. Ethernet frames and the commands of the network
	  processor are carried by two CPC endpoints of the co-processor. The
	  Zephyr supplicant drives the association and the key exchange.

if WIFI_SILABS_NCP

config WIFI_SILABS_NCP_INIT_PRIORITY
	int "Initialization priority"
	default 87
	help
	  Must be greater than MFD_SILABS_NCP_INIT_PRIORITY and lower than
	  NET_INIT_PRIO.

config WIFI_SILABS_NCP_DATA_RX_COUNT
	int "Number of Ethernet frame buffers handed to CPC"
	default 4

config WIFI_SILABS_NCP_DATA_TX_COUNT
	int "Number of Ethernet frames in flight towards the co-processor"
	default 4

config WIFI_SILABS_NCP_MGMT_RX_COUNT
	int "Number of management frame buffers handed to CPC"
	default 2

endif # WIFI_SILABS_NCP
```

## drivers/wifi/ti_cc35xx/Kconfig.ti_cc35xx
```kconfig
# Texas Instruments CC35XX Wi-Fi driver options

# Copyright (c) 2025 Conclusive Engineering sp. z o. o.
# SPDX-License-Identifier: Apache-2.0

menuconfig WIFI_TI_CC35XX
	bool "Texas Instruments CC35XX Wi-Fi driver support"
	select WIFI_USE_NATIVE_NETWORKING
	select WIFI_OFFLOAD
	select NET_L2_WIFI_MGMT
	select DYNAMIC_THREAD
	select DYNAMIC_THREAD_ALLOC
	select THREAD_STACK_INFO
	select POSIX_API
	select FLASH
	select FLASH_MAP
	select NVS

if WIFI_TI_CC35XX

config WIFI_TI_CC35XX_MTU
	int "Maximum size of a packet, in bytes"
	# MTU (ipv4) per: http://www.ti.com/lit/ug/swru455d/swru455d.pdf:
	default 1472
	help
	  Set the maximum size of a network packet going through the chip.
	  This sets the size of each buffer, in each buffer pool.
	  Do not modify it unless you know what you are doing.

config WIFI_TI_CC35XX_TX_CTRL_BLK_NUM
	int "Number of TX control block entries"
	default 120
	range 32 120
	help
	  Number of TX packet descriptors the WiFi stack can queue
	  simultaneously. Each entry uses ~344 bytes of heap.
	  Increase for high-throughput workloads.

config WIFI_TI_CC35XX_NVS_INIT_PRIORITY
	int "NVS init priority"
	default 60
	help
	  SYS_INIT priority for the WiFi NVS init.
	  Must be lower than the WiFi driver init priority (80).

config WIFI_TI_CC3XXX_NVS_INIT_PRIORITY
	int
	default WIFI_TI_CC35XX_NVS_INIT_PRIORITY

choice WIFI_TI_CC35XX_MBEDTLS_PLATFORM
	prompt "CC35XX Wi-Fi mbedTLS platform"
	default WIFI_TI_CC35XX_USE_ZEPHYR_MBEDTLS
	help
	  Select the mbedTLS implementation used by the CC35XX Wi-Fi host stack.

config WIFI_TI_CC35XX_USE_ZEPHYR_MBEDTLS
	bool "Use Zephyr mbedTLS for CC35XX Wi-Fi crypto"
	select ENTROPY_CC35XX_RNG
	select MBEDTLS
	select MBEDTLS_DECLARE_PRIVATE_IDENTIFIERS
	select MBEDTLS_MD_C
	select MBEDTLS_PSA_CRYPTO_C if !BUILD_WITH_TFM
	select PSA_WANT_ALG_CBC_NO_PADDING
	select PSA_WANT_ALG_CTR
	select PSA_WANT_ALG_ECDH
	select PSA_WANT_ALG_ECB_NO_PADDING
	select PSA_WANT_ALG_FFDH
	select PSA_WANT_ALG_HMAC
	select PSA_WANT_ALG_MD5
	select PSA_WANT_ALG_SHA_1
	select PSA_WANT_ALG_SHA_256
	select PSA_WANT_ALG_SHA_384
	select PSA_WANT_ALG_SHA_512
	select PSA_WANT_ECC_SECP_R1_256
	select PSA_WANT_KEY_TYPE_AES
	select PSA_WANT_KEY_TYPE_DH_KEY_PAIR_GENERATE
	select PSA_WANT_KEY_TYPE_DH_PUBLIC_KEY
	select PSA_WANT_KEY_TYPE_ECC_KEY_PAIR_DERIVE
	select PSA_WANT_KEY_TYPE_ECC_PUBLIC_KEY
	select PSA_WANT_KEY_TYPE_HMAC
	help
	  Build the CC35XX Wi-Fi host crypto glue against Zephyr mbedTLS.

config WIFI_TI_CC35XX_USE_TI_MBEDTLS
	bool "Use TI SDK mbedTLS for CC35XX Wi-Fi crypto"
	select TI_CC35XX_HSM
	select TI_CC35XX_HSM_ITS
	help
	  Build the CC35XX Wi-Fi host crypto glue against the mbedTLS
	  implementation bundled with the TI SimpleLink SDK. This cannot be
	  combined with Zephyr mbedTLS or PSA Crypto in the same image.

endchoice

endif # WIFI_TI_CC35XX
```

## drivers/wuc/Kconfig.rts5817
```kconfig
# Copyright (c) 2026 Realtek Semiconductor, Inc.
# SPDX-License-Identifier: Apache-2.0

config WUC_RTS5817
	bool "RTS5817 WUC (Wake-Up Controller) driver"
	default y
	depends on DT_HAS_REALTEK_RTS5817_WUC_ENABLED
	select SYSCON
	help
	  Enable the RTS5817 wake-up controller driver. This driver handles
	  wakeup source configuration (enable/disable), wakeup detection, and
	  wakeup status clearing for the RTS5817 fingerprint SoC.
```

## drivers/wuc/Kconfig.siwx91x
```kconfig
# Copyright (c) 2026 Silicon Laboratories Inc.
# SPDX-License-Identifier: Apache-2.0

config WUC_SILABS_SIWX91X
	bool "Silicon Labs SiWx91x wake-up controller"
	default y
	depends on DT_HAS_SILABS_SIWX91X_WUC_ENABLED
	help
	  Enable the wake-up controller for Silicon Labs SiWx91x SoCs.
```

## dts/bindings/adc/adi,ad463x.yaml
```yaml
# Copyright (c) 2026 Analog Devices, Inc.
# SPDX-License-Identifier: Apache-2.0

description: |
  Analog Devices AD463x family precision SAR ADCs (offload-mode driver).

  Covers AD4630-24, AD4630-20, AD4630-16, AD4631-24, AD4631-20, AD4631-16,
  AD4632-24, AD4632-20, and AD4632-16. The driver assumes an offload-capable
  data path consisting of an ADI AXI SPI Engine (with offload module),
  an ADI AXI DMAC for DEV-to-MEM capture, an ADI AXI CLKGEN for the SPI
  reference / capture clock, and an ADI AXI PWMGEN to generate the CNV
  trigger. The device is a SPI child of the AXI SPI Engine controller
  (register access uses the standard SPI API; the offload path is driven
  through the engine's vendor extension). The DMAC, CLKGEN and PWMGEN are
  referenced through the standard "dmas", "clocks" and "pwms" specifiers.

  Reset / CNV / PGIA control GPIOs are optional; on the Digilent Zedboard
  AD4630_FMC reference design these are wired to Zynq EMIO bits that the
  Zephyr GPIO controller does not expose, so platform code performs the
  reset pulse. When the GPIOs are present in DT, the driver uses them.

compatible: "adi,ad463x"

include: [adc-controller.yaml, spi-device.yaml]

on-bus: spi

io-channel-cells:
  - input

properties:
  "#io-channel-cells":
    const: 1


  adi,part:
    type: string
    required: true
    enum:
      - "ad4630-24"
      - "ad4630-20"
      - "ad4630-16"
      - "ad4631-24"
      - "ad4631-20"
      - "ad4631-16"
      - "ad4632-24"
      - "ad4632-20"
      - "ad4632-16"
    description: AD463x part variant.

  dmas:
    required: true
    description: |
      DMA specifier for the AXI DMAC capturing offload samples. One entry;
      the channel cell selects the DMAC channel (matches HDL wiring).

  dma-names:
    required: true
    description: Must contain "rx" for the DEV-to-MEM capture channel.

  clocks:
    required: true
    description: Clock specifier for the AXI CLKGEN providing the SPI ref clock.

  pwms:
    type: phandle-array
    required: true
    description: |
      PWM specifier for the AXI PWMGEN generating the CNV trigger. The channel
      cell selects the PWMGEN output used for CNV (matches HDL wiring).

  adi,vref-microvolts:
    type: int
    default: 5000000
    description: External reference voltage in microvolts (default 5.0 V).

  adi,axi-clkgen-rate-hz:
    type: int
    default: 160000000
    description: AXI CLKGEN output rate in Hz used for SPI capture.

  adi,sample-rate-hz:
    type: int
    default: 2000000
    description: |
      Conversion rate driven by the PWMGEN CNV channel. Must be within the
      AD463x maximum throughput for the chosen output / lane mode.

  adi,lane-mode:
    type: string
    enum:
      - "one"
      - "two"
      - "four"
      - "shared"
    default: "one"
    description: |
      Output lane mode (REG_MODES bits[7:6]).
      one = 1 lane / channel; two = 2 lanes / channel; four = 4 lanes / channel;
      shared = shared 2-channel.

  adi,clock-mode:
    type: string
    enum:
      - "spi-compat"
      - "echo"
      - "master"
    default: "spi-compat"
    description: Output clock mode (REG_MODES bits[5:4]).

  adi,output-mode:
    type: string
    enum:
      - "24-diff"
      - "16-diff-8-com"
      - "24-diff-8-com"
      - "30-avg-diff"
      - "32-pattern"
    default: "24-diff"
    description: |
      Output data mode (REG_MODES bits[2:0]). Combined with the chosen part
      this dictates the real ADC precision.

  adi,data-rate:
    type: string
    enum:
      - "sdr"
      - "ddr"
    default: "sdr"
    description: Data-rate mode (REG_MODES bit[3]). DDR is invalid with SPI-compatible clock mode.

  adi,avg-frame-len:
    type: int
    default: 0
    description: |
      Hardware averaging filter length. 0 disables averaging (default).
      1–16 enables the chip's 30-AVERAGED_DIFF output mode and accumulates
      that many consecutive conversions into a single 30-bit result, trading
      effective sample rate for lower noise. When non-zero, adi,output-mode
      must be set to "30-avg-diff".

  adi,skip-reg-config:
    type: boolean
    description: |
      When true, the driver skips writing the lane / clock / output-mode
      registers and trusts the chip's power-up defaults. Useful on HDL
      builds where reg-mode SPI is unreliable. The driver still issues
      EXIT_CFG_MODE before the first capture.

  reset-gpios:
    type: phandle-array
    description: Active-low RESET_N. Optional; pulsed by the driver when present.

  cnv-gpios:
    type: phandle-array
    description: |
      Optional CNV pin GPIO. When present and the platform exposes a CNV
      pin separate from the PWMGEN-driven trigger, the driver will hold it
      LOW during register access. Most FPGA-carrier designs leave this
      unwired — CNV comes solely from PWMGEN.

  pgia-gpios:
    type: phandle-array
    description: |
      Optional 2-entry array (A0, A1) for PGIA gain selection on parts that
      have a PGIA (ADAQ4216, ADAQ4224). Not used for the AD4630/4631/4632
      variants currently supported by this driver.
```

## dts/bindings/adc/adi,ad7794.yaml
```yaml
# Copyright (c) 2026 Testo SE & Co. KGaA
# SPDX-License-Identifier: Apache-2.0

description: |
  Analog Devices AD7794 6-channel, 24-bit sigma-delta ADC.

  Each channel node selects an input pair of the multiplexer with
  zephyr,input-positive (see dt-bindings/adc/ad7794-adc.h). The input pairs
  are fixed, so zephyr,input-negative is not used. zephyr,differential selects
  bipolar coding, in which case samples are returned as signed values.

  Supported channel properties:
  - zephyr,gain: ADC_GAIN_1 to ADC_GAIN_128 in powers of two
  - zephyr,reference: ADC_REF_INTERNAL (1.17 V), ADC_REF_EXTERNAL0 (REFIN1),
    ADC_REF_EXTERNAL1 (REFIN2)
  - zephyr,acquisition-time: ADC_ACQ_TIME_DEFAULT or
    ADC_ACQ_TIME(ADC_ACQ_TIME_TICKS, AD7794_DR_*)
  - zephyr,current-source-pin: [<AD7794_IEXCDIR_*> <AD7794_IEXCEN_*>]
  - zephyr,vbias-pins: AD7794_VBIAS_*
  - zephyr,resolution: 24

  Example:

    #include <zephyr/dt-bindings/adc/adc.h>
    #include <zephyr/dt-bindings/adc/ad7794-adc.h>

    adc@0 {
      compatible = "adi,ad7794";
      reg = <0>;
      spi-max-frequency = <1000000>;
      #io-channel-cells = <1>;
      #address-cells = <1>;
      #size-cells = <0>;

      channel@0 {
        reg = <0>;
        zephyr,gain = "ADC_GAIN_16";
        zephyr,reference = "ADC_REF_EXTERNAL1";
        zephyr,vref-mv = <1225>;
        zephyr,acquisition-time = <ADC_ACQ_TIME(ADC_ACQ_TIME_TICKS, AD7794_DR_16_7_HZ)>;
        zephyr,differential;
        zephyr,resolution = <24>;
        zephyr,input-positive = <AD7794_ADC_AIN1>;
        zephyr,current-source-pin = [AD7794_IEXCDIR_IOUT1_IOUT2 AD7794_IEXCEN_1_MA];
      };
    };

compatible: "adi,ad7794"

include: [adc-controller.yaml, spi-device.yaml]

properties:
  "#io-channel-cells":
    const: 1

io-channel-cells:
  - input
```

## dts/bindings/adc/adi,ade7913.yaml
```yaml
# SPDX-FileCopyrightText: Copyright The Zephyr Project Contributors
# SPDX-License-Identifier: Apache-2.0

description: Analog Devices ADE7913 3-channel SPI ADC

compatible: "adi,ade7913"

include: [adc-controller.yaml, spi-device.yaml]

on-bus: spi

properties:
  "#io-channel-cells":
    const: 1
  spi-max-frequency:
    type: int
    min: 250000
    max: 5600000
  clk-out-enable:
    type: boolean
    description: |
      Enable Clk-Out Signal to enable driving other ADE7913 ADCs.
      - true: Enable Clk-Out Signal
      - false: By default Data_Ready_N goes low for 64 Clk cycles when Data is Ready
  clock-frequency:
    type: int
    enum:
      - 8000
      - 4000
      - 2000
      - 1000
    description: "ADC Frequency Configuration"

io-channel-cells:
  - input
```

## dts/bindings/adc/infineon,hppass-sar-adc-v3.yaml
```yaml
# SPDX-FileCopyrightText: Copyright (c) 2026 Infineon Technologies AG,
# SPDX-FileCopyrightText: or an affiliate of Infineon Technologies AG. All rights reserved.
#
# SPDX-License-Identifier: Apache-2.0

title: PSOC C3 HPPASS SAR ADC, MCPASS v3

description: |
  Infineon PSOC C3 HPPASS SAR ADC with the MCPASS v3 register layout
  (PSOC Control C3M6/P6).

  v3 carries 36 channels: 12 direct samplers, plus four muxed samplers of
  six inputs each.  The Zephyr ADC API addresses channels 0-31 only, so the
  top four are not reachable.  The programming model is otherwise the one
  described by infineon,hppass-sar-adc, which must be listed as the fallback
  compatible so the ADC driver still binds:

    compatible = "infineon,hppass-sar-adc-v3", "infineon,hppass-sar-adc";

compatible: "infineon,hppass-sar-adc-v3"

include: infineon,hppass-sar-adc.yaml
```
