## dts/bindings/adc/infineon,hppass-sar-adc.yaml
```yaml
# SPDX-FileCopyrightText: Copyright (c) 2026 Infineon Technologies AG,
# SPDX-FileCopyrightText: or an affiliate of Infineon Technologies AG. All rights reserved.
#
# SPDX-License-Identifier: Apache-2.0

title: PSOC C3 HPPASS SAR ADC

description: |
  Infineon PSOC C3 HPPASS SAR ADC

  The HPPASS (High Performance Programmable Analog Sub-System) SAR ADC
  provides high-resolution analog-to-digital conversion capabilities
  for the PSOC C3 family of microcontrollers.

  Each ADC channel corresponds to a dedicated analog input pin, except for
  the last four sampler inputs which are muxed.  See the device datasheet for
  pin assignments and mux options.

  Dependency: This ADC node must be a child of the HPPASS analog subsystem
  node ("infineon,hppass-analog"), which provides clock, power, and reference
  resources.

compatible: "infineon,hppass-sar-adc"

include: adc-controller.yaml

properties:
  reg:
    required: true
    description: |
      SAR controller register region (HPPASS_SAR: sequencer, channel
      config, sample gain, result masks, interrupts).

  interrupts:
    required: true
    description: Interrupt configuration for the HPPASS SAR ADC

  "#io-channel-cells":
    const: 1
    description: Number of cells in an io-channel specifier

  clock-frequency:
    type: int
    description: |
      ADC clock frequency in Hz. If not specified, the driver will use
      the default clock configuration.

  vref-mv:
    type: int
    default: 3300
    description: |
      Internal reference voltage in millivolts.

  offset-cal:
    type: boolean
    description:
      Enables Self-Calibration for offset correction within the ADC.  If left disabled,
      the factory calibration for offset correction will be used.

  gain-cal:
    type: boolean
    description: |
      Enables Self-Calibration for gain within the ADC. If left disabled,
      the factory calibration for gain will be used.

  linear-cal:
    type: boolean
    description: |
      Enables Self-Calibration for linearity correction within the ADC. If left disabled,
      the factory calibration for linearity will be used.

  ref-internal-source:
    type: boolean
    description: |
      Selects whether the ADC uses internal (true) or external (false) reference.
      External reference recommended for best performance.

  fifo-chan-id:
    type: boolean
    description: |
      Tag each FIFO word with the channel number that produced it, so a FIFO
      buffer shared by multiple channels can be demultiplexed.

io-channel-cells:
  - input

child-binding:
  description: |
    A single SAR ADC input channel, named channel@N where N is the channel
    number 0 to 27. Channels 0 to 11 are the direct samplers; 12 to 27 reach
    the four muxed samplers, four channels each.

  properties:
    fifo-sel:
      type: int
      default: 0
      enum: [0, 1, 2, 3, 4]
      description: |
        Route this channel's conversion result to a FIFO buffer.
        Use the IFX_HPPASS_SAR_FIFO_* macros:
        DISABLED (0, default), FIFO_0 (1), FIFO_1 (2), FIFO_2 (3), FIFO_3 (4).
```

## dts/bindings/adc/infineon,hppass-sar-fifo.yaml
```yaml
# SPDX-FileCopyrightText: Copyright (c) 2026 Infineon Technologies AG,
# SPDX-FileCopyrightText: or an affiliate of Infineon Technologies AG. All rights reserved.
#
# SPDX-License-Identifier: Apache-2.0

title: HPPASS SAR ADC FIFO Configuration

description: |
  FIFO configuration for the Infineon HPPASS SAR ADC.

  32 words of FIFO storage, split into up to 4 buffers. A channel routes its
  result to a buffer via fifo-sel on the channel node. This node is named
  "fifo" under the SAR ADC node, and its interrupt is named "fifo" on the
  parent ADC node.

compatible: "infineon,hppass-sar-fifo"

properties:
  fifo-levels:
    type: array
    required: true
    description: |
      Watermark threshold for each FIFO buffer. The length of this array
      selects the split:
        1 entry  -> one 32-word buffer
        2 entries -> two 16-word buffers
        4 entries -> four 8-word buffers

      A watermark interrupt fires for a buffer once its occupancy reaches
      the configured entry. An entry of 0 disables the watermark interrupt
      for that buffer.
```

## dts/bindings/adc/infineon,hppass-sar-sequencer.yaml
```yaml
# SPDX-FileCopyrightText: Copyright (c) 2026 Infineon Technologies AG,
# SPDX-FileCopyrightText: or an affiliate of Infineon Technologies AG. All rights reserved.
#
# SPDX-License-Identifier: Apache-2.0

title: HPPASS SAR ADC Sequencer

description: |
  Holds the SAR sequencer groups. Each child node is one group, owning a set of
  channels and its own trigger.

  Must be a child of an "infineon,hppass-sar-adc" node. Groups live here rather
  than directly under the ADC so the channel numbering stays free for the
  channel nodes.

    &adc0 {
        channel@1 {
            reg = <1>;
            ...
        };

        sequencer {
            compatible = "infineon,hppass-sar-sequencer";
            #address-cells = <1>;
            #size-cells = <0>;

            group@0 {
                reg = <0>;
                infineon,channel-mask = <0x2>;
                infineon,trigger-source = <IFX_HPPASS_SAR_TRIG_0>;
            };
        };
    };

compatible: "infineon,hppass-sar-sequencer"

include: base.yaml

properties:
  "#address-cells":
    const: 1

  "#size-cells":
    const: 0

child-binding:
  description: |
    One SAR sequencer group.

  properties:
    reg:
      type: array
      required: true
      description: Group number, 0 to 7.

    infineon,channel-mask:
      type: int
      required: true
      description: |
        Channels this group converts, one bit per channel. Bit 0 is channel 0.

        Each channel needs its own channel node, and two groups cannot share a
        channel.

        If two groups use the same muxed sampler, meaning channels from the same
        block of 12-15, 16-19, 20-23 or 24-27, both must set
        infineon,sample-time-cycles. The mux switches when the conversion
        starts, so without it the new input has no time to settle.

    infineon,sample-time-cycles:
      type: int
      description: |
        How long to sample before converting, in SAR clock cycles, 1 to 1024.
        Leave it out for 32 cycles, enough for a low impedance source on a
        channel no other group uses.

        There are three sample timers for the eight groups. Groups asking for
        the same value share a timer, so use no more than three different
        values.

    infineon,trigger-source:
      type: int
      required: true
      enum: [0, 1, 2, 3, 4, 5, 6, 7, 8, 9]
      description: |
        Trigger that fires this group. Use one of the IFX_HPPASS_SAR_TRIG_*
        constants. Group 0 must use IFX_HPPASS_SAR_TRIG_0, the trigger
        adc_read() fires.
```
