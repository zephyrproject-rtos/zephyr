## drivers/regulator/Kconfig.gd32
```kconfig
# Copyright (c) 2026 Aleksandr Senin <al@meshium.net>
#
# SPDX-License-Identifier: Apache-2.0

config REGULATOR_GD32_BLDO
	bool "GD32 BLDO regulator"
	default y
	depends on DT_HAS_GD_GD32_BLDO_ENABLED
	depends on SOC_SERIES_GD32F4XX
	help
	  Enable the driver for GD32 Backup SRAM LDO (BLDO) regulator.

if REGULATOR_GD32_BLDO

config REGULATOR_GD32_BLDO_INIT_PRIORITY
	int "Init priority"
	default 75
	help
	  Device driver initialization priority.

endif # REGULATOR_GD32_BLDO
```

## drivers/regulator/Kconfig.gpio
```kconfig
# Copyright 2023 EPAM Systems
# SPDX-License-Identifier: Apache-2.0

config REGULATOR_GPIO
	bool "GPIO-controlled regulators"
	default y
	depends on DT_HAS_REGULATOR_GPIO_ENABLED
	select GPIO
	help
	  Enable the driver for GPIO-controlled regulators

if REGULATOR_GPIO

config REGULATOR_GPIO_INIT_PRIORITY
	int "Init priority"
	default 75
	help
	  Device driver initialization priority

endif # REGULATOR_GPIO
```

## drivers/regulator/Kconfig.infineon_autanalog_prb
```kconfig
# Copyright (c) 2026 Infineon Technologies AG,
# or an affiliate of Infineon Technologies AG.
#
# SPDX-License-Identifier: Apache-2.0

config REGULATOR_INFINEON_AUTANALOG_PRB
	bool "Infineon AutAnalog PRB voltage reference regulator"
	default y
	depends on DT_HAS_INFINEON_AUTANALOG_PRB_VREF_ENABLED
	select MFD
	help
	  Enable the Infineon AutAnalog PRB voltage reference regulator driver.
	  Each instance provides a programmable voltage reference output (Vref0
	  or Vref1) with 16 discrete voltage levels derived from either VBGR
	  (0.9V) or VDDA (1.8V).

config REGULATOR_INFINEON_AUTANALOG_PRB_INIT_PRIORITY
	int "Infineon AutAnalog PRB regulator init priority"
	default 43
	depends on REGULATOR_INFINEON_AUTANALOG_PRB
	help
	  Init priority for the PRB regulator driver.  Must be higher (later)
	  than the PRB MFD init priority (default 42).
```

## drivers/regulator/Kconfig.m5pm1
```kconfig
# Copyright (c) 2026 The Zephyr Project Contributors
# SPDX-License-Identifier: Apache-2.0

config REGULATOR_M5PM1
	bool "M5Stack M5PM1 regulator driver"
	default y
	depends on DT_HAS_M5STACK_M5PM1_REGULATOR_ENABLED
	select MFD
	help
	  Enable fixed-voltage regulator support for the M5Stack M5PM1.

config REGULATOR_M5PM1_INIT_PRIORITY
	int "M5PM1 regulator driver initialization priority"
	depends on REGULATOR_M5PM1
	default 81
	help
	  Initialization priority for the M5PM1 regulator driver. It must be
	  greater than the MFD initialization priority.
```

## drivers/regulator/Kconfig.max20335
```kconfig
# Copyright (c) 2023 Grinn
# SPDX-License-Identifier: Apache-2.0

config REGULATOR_MAX20335
	bool "MAX20335 PMIC regulator driver"
	default y
	depends on DT_HAS_MAXIM_MAX20335_REGULATOR_ENABLED
	select I2C
	select MFD
	help
	  Enable the Maxim MAX20335 PMIC regulator driver

if REGULATOR_MAX20335

config REGULATOR_MAXIM_MAX20335_COMMON_INIT_PRIORITY
	int "MAX20335 regulator driver init priority (common part)"
	default 86
	help
	  Init priority for the Maxim MAX20335 regulator driver
	  (common part). It must be greater than I2C and MFD init priority.

config REGULATOR_MAXIM_MAX20335_INIT_PRIORITY
	int "MAX20335 regulator driver init priority"
	default 87
	help
	  Init priority for the Maxim MAX20335 regulator driver. It must be
	  greater than REGULATOR_MAXIM_MAX20335_COMMON_INIT_PRIORITY

endif
```

## drivers/regulator/Kconfig.modulino_latch_relay
```kconfig
# Copyright 2026 Silicon Labs
# SPDX-License-Identifier: Apache-2.0

config REGULATOR_MODULINO_LATCH_RELAY
	bool "Arduino Modulino Latch Relay"
	default y
	depends on DT_HAS_ARDUINO_MODULINO_LATCH_RELAY_ENABLED
	select I2C
	help
	  Enable the Arduino Modulino Latch Relay driver.

config REGULATOR_MODULINO_LATCH_RELAY_INIT_PRIORITY
	int "Arduino Modulino Latch Relay driver init priority"
	default 85
	depends on REGULATOR_MODULINO_LATCH_RELAY
	help
	  Init priority for the Arduino Modulino Latch Relay driver.
	  It must be greater than I2C init priority.
```

## drivers/regulator/Kconfig.mpm54304
```kconfig
# Copyright 2024 Vogl Electronic GmbH
# SPDX-License-Identifier: Apache-2.0

config REGULATOR_MPM54304
	bool "MPM54304 DC/DC step-down power module"
	default y
	depends on DT_HAS_MPS_MPM54304_ENABLED
	select I2C
	help
	  Enable MPM54304 DC/DC step-down power module support.

if REGULATOR_MPM54304

config REGULATOR_MPM54304_INIT_PRIORITY
	int "MPM54304 regulator driver init priority"
	default 85
	help
	  Init priority for the MPS MPM54304 regulator driver.
	  It must be greater than I2C init priority.

endif
```
