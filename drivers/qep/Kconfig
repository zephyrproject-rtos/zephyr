## drivers/qep/Kconfig
```kconfig
# Kconfig - QEP configuration options

#
# Copyright (c) 2021 Intel Corporation
#
# SPDX-License-Identifier: Apache-2.0
#

#
# QEP options
#
menuconfig QEP
	bool "QEP"
	help
	  Enable QPE Driver Configuration

if QEP

# Include these first so that any properties (e.g. defaults) below can be
# overridden (by defining symbols in multiple locations)

config QEP_INIT_PRIORITY
	int "Init priority"
	default 60
	help
	  QEP device driver initialization priority.

endif # QEP
```

## drivers/qmsi/Kconfig
```kconfig
# Kconfig - QMSI drivers configuration options

#
# Copyright (c) 2015 Intel Corporation
#
# Licensed under the Apache License, Version 2.0 (the "License");
# you may not use this file except in compliance with the License.
# You may obtain a copy of the License at
#
#     http://www.apache.org/licenses/LICENSE-2.0
#
# Unless required by applicable law or agreed to in writing, software
# distributed under the License is distributed on an "AS IS" BASIS,
# WITHOUT WARRANTIES OR CONDITIONS OF ANY KIND, either express or implied.
# See the License for the specific language governing permissions and
# limitations under the License.
#
config QMSI_BUILTIN
	bool "Enable QMSI drivers through integrated sources"
	default n
	select QMSI
	help
	Link with local QMSI sources instead of external library.

config QMSI_LIBRARY
	bool "Enable QMSI drivers using external library"
	default n
	select QMSI
	help
	This option enables QMSI device drivers. These drivers are actually shim
	drivers based on drivers provided by QMSI BSP. The BSP provides a static
	library (libqmsi) which implements several drivers for peripherals from
	Intel MCUs (e.g. Quark SE and Quark D2000).

config QMSI
	bool
	default n
	help
	automatically set when either of QMSI_LIBRARY or QMSI_BUILTIN
	is selected.

config QMSI_INSTALL_PATH
	depends on QMSI_LIBRARY
	string "QMSI install path"
	help
	This option holds the path where the QMSI library and headers are
	installed. Make sure this option is properly set when QMSI_LIBRARY
	is enabled otherwise the build will fail.
```

## drivers/qspi/Kconfig
```kconfig
# Kconfig - QSPI driver configuration options

#
# Copyright (c) 2019, Nordic Semiconductor ASA
#
# SPDX-License-Identifier: Apache-2.0
#

#
# QSPI Drivers
#
menuconfig QSPI
	bool "QSPI hardware bus support"
	select HAS_DTS_QSPI
	help
	  Enable support for the QSPI hardware bus.

if QSPI

config QSPI_ASYNC
	bool "Enable Asynchronous call support"
	select POLL
	help
	  This option enables the asynchronous API calls.


config QSPI_INIT_PRIORITY
	int "Init priority"
	default 70
	help
	  Device driver initialization priority.

module = QSPI
module-str = qspi
source "subsys/logging/Kconfig.template.log_config"


config	QSPI_0
	bool "QSPI port 0"
	help
	  Enable QSPI controller port 0.


endif # QSPI
```

## drivers/random/Kconfig
```kconfig
# Kconfig - random generator driver configuration options

#
# Copyright (c) 2014-2015 Wind River Systems, Inc.
#
# SPDX-License-Identifier: Apache-2.0
#

menuconfig RANDOM_GENERATOR
	bool
	prompt "Random Drivers"
	default n
	help
	  Include RANDOM drivers in system config.

if RANDOM_GENERATOR

source "drivers/random/Kconfig.mcux"
source "drivers/random/Kconfig.stm32"

config RANDOM_HAS_DRIVER
	bool
	default n
	help
	This is an option to be enabled by individual random driver
	to signal that there is a true random driver.

config RANDOM_POOL
	bool "Enables the random pool"
	select TINYCRYPT
	select TINYCRYPT_AES
	default n
	help
	This adds a device inspired by /dev/random as common on Unices. Various
	sources of entropy can be enabled, including hardware-based random
	number generators usually available as microcontroller peripherals.

	If enabled, this will take over the RANDOM_0 device, and the
	hardware-based random number generators will be named HWRNG_0 instead.
	Either the random_get_entropy() function or sys_rand32_get() can then
	be used to obtain some data.

	An idle priority thread will kick in every now and then to stir a pot
	of integers with the various sources of entropy.  When asked to
	generate random data, this pot and an atomically-increasing integer
	will be used as inputs to an AES encryption routine.  The cyphertext is
	then stirred in the pot, folded into a single integer, and used as
	entropy for random_get_entropy().  (sys_rand32_get() is just a special
	case of random_get_entropy().)

config RANDOM_POOL_SOURCE_DEVICES
	bool "Initialize random pool with device information"
	depends on RANDOM_POOL
	default y
	help
	Use pointers to all `struct device` that were initialized before main()
	gets executed.  While not random, this is unique for every configuration.

config RANDOM_POOL_SOURCE_HARDWARE
	bool "Use hardware-based number generator as entropy source in pool"
	depends on RANDOM_POOL
	depends on RANDOM_HAS_DRIVER
	default y
	help
	Mix values obtained from the hardware random number generator in the pool.

config RANDOM_HARDWARE_NAME
	string "Hardware-based random generator name"
	depends on RANDOM_POOL
	depends on RANDOM_POOL_SOURCE_HARDWARE
	default "HWRNG_0"

config RANDOM_POOL_SOURCE_TIMESTAMP
	bool "Use time stamp as entropy source in random pool"
	depends on RANDOM_POOL
	default y
	help
	Mix the CPU timestamp in the pool.

config RANDOM_POOL_SOURCE_CYCLE_COUNTER
	bool "Use cycle counter as entropy source in random pool"
	depends on RANDOM_POOL
	default y
	help
	Mix the CPU cycle count in the pool.

config RANDOM_NAME
	string "Random device name"
	depends on RANDOM_GENERATOR
	default "RANDOM_0"
	help
	Specify the device name to be used for the RANDOM driver.

config SYS_LOG_RANDOM_LEVEL
	int "Random Log level"
	depends on SYS_LOG && RANDOM_GENERATOR
	default 0
	range 0 4
	help
	  Sets log level for random driver.
	  Levels are:
	  - 0 OFF: do not write
	  - 1 ERROR: only write SYS_LOG_ERR
	  - 2 WARNING: write SYS_LOG_WRN in addition to previous level
	  - 3 INFO: write SYS_LOG_INF in addition to previous levels
	  - 4 DEBUG: write SYS_LOG_DBG in addition to previous levels

config TEST_RANDOM_GENERATOR
	bool
	prompt "Non-random number generator"
	depends on RANDOM_GENERATOR && !RANDOM_HAS_DRIVER && !RANDOM_POOL
	default n
	help
	  This option signifies that the kernel's random number APIs are
	  permitted to return values that are not truly random.
	  This capability is provided for testing purposes, when a truly random
	  number generator is not available. The non-random number generator
	  should not be used in a production environment.

config X86_TSC_RANDOM_GENERATOR
	bool
	prompt "x86 timestamp counter based number generator"
	depends on TEST_RANDOM_GENERATOR && X86
	default y
	help
	  This options enables number generator based on timestamp counter
	  of x86 boards, obtained with rdtsc instruction.

config TIMER_RANDOM_GENERATOR
	bool
	prompt "System timer clock based number generator"
	depends on TEST_RANDOM_GENERATOR && !X86_TSC_RANDOM_GENERATOR
	default y
	help
	  This options enables number generator based on system timer
	  clock. This number generator is not random and used for
	  testing only.

endif
```

## drivers/random/Kconfig.esp32
```kconfig
# Kconfig.esp32 - esp32 random generator driver configuration
#
# Copyright (c) 2017 Intel Corporation
#
# SPDX-License-Identifier: Apache-2.0

config RANDOM_ESP32_RNG
	bool "ESP32 random number generator driver"
	depends on RANDOM_GENERATOR && SOC_ESP32
	default n
	select RANDOM_HAS_DRIVER
	help
	  This option enables the random number generator for ESP32 SoCs.

	  With Wi-Fi and Bluetooth disabled, this will produce pseudo-random
	  numbers: noise from these radios are used to feed entropy in this
	  generator.
```

## drivers/random/Kconfig.mcux
```kconfig
# Kconfig.mcux - mcux random generator driver configuration
#
# Copyright (c) 2016 ARM Ltd.
#
# SPDX-License-Identifier: Apache-2.0

menuconfig RANDOM_MCUX
	bool "MCUX Random driver"
	depends on RANDOM_GENERATOR && HAS_RNGA
	default n
	select RANDOM_HAS_DRIVER
	help
	  This option enables the random number generator accelerator (RNGA)
	  driver based on the MCUX RNGA driver.
```

## drivers/random/Kconfig.stm32
```kconfig
# Kconfig.stm32 - STM32 random generator driver configuration
#
# Copyright (c) 2017 Erwin Rol <erwin@erwinrol.com>
#
# SPDX-License-Identifier: Apache-2.0

menuconfig RANDOM_STM32_RNG
	bool "STM32 RNG driver"
	depends on RANDOM_GENERATOR
	depends on SOC_FAMILY_STM32
	default n
	select RANDOM_HAS_DRIVER
	help
	  This option enables the RNG processor, which is a random number
	  generator, based on a continuous analog noise, that provides
	  a random 32-bit value to the host when read.
```

## drivers/random_generator/Kconfig.mcux
```kconfig
# Kconfig.mcux - mcux random generator driver configuration
#
# Copyright (c) 2016 ARM Ltd.
#
# SPDX-License-Identifier: Apache-2.0

menuconfig RANDOM_MCUX_RNGA
	bool "MCUX RNGA driver"
	depends on RANDOM_GENERATOR && HAS_RNGA
	default n
	select RANDOM_HAS_DRIVER
	help
	  This option enables the random number generator accelerator (RNGA)
	  driver based on the MCUX RNGA driver.

menuconfig RANDOM_MCUX_TRNG
	bool "MCUX TRNG driver"
	depends on RANDOM_GENERATOR && HAS_TRNG
	default n
	select RANDOM_HAS_DRIVER
	help
	  This option enables the true random number generator (TRNG)
	  driver based on the MCUX TRNG driver.
```

## drivers/regulator/Kconfig
```kconfig
# Copyright 2020 Peter Bigot Consulting, LLC
# SPDX-License-Identifier: Apache-2.0

menuconfig REGULATOR
	bool "Regulator drivers"
	help
	  Include drivers for current/voltage regulators in system config

if REGULATOR

config REGULATOR_THREAD_SAFE_REFCNT
	bool "Thread-safe reference counting"
	depends on MULTITHREADING
	default y
	help
	  When enabled, regulator reference counting is thread-safe.

config REGULATOR_SHELL
	bool "Regulator shell"
	depends on SHELL
	help
	  Enable regulator shell framework, for interacting with regulators via
	  the shell interface

module = REGULATOR
module-str = regulator
source "subsys/logging/Kconfig.template.log_config"

source "drivers/regulator/Kconfig.*"

endif # REGULATOR
```

## drivers/regulator/Kconfig.adp5360
```kconfig
# Copyright (c) 2023 Nordic Semiconductor ASA
# SPDX-License-Identifier: Apache-2.0

config REGULATOR_ADP5360
	bool "ADP5360 PMIC regulator driver"
	default y
	depends on DT_HAS_ADI_ADP5360_REGULATOR_ENABLED
	select I2C
	help
	  Enable the Analog Devices ADP5360 PMIC regulator driver

config REGULATOR_ADP5360_INIT_PRIORITY
	int "ADP5360 regulator driver init priority"
	default 76
	depends on REGULATOR_ADP5360
	help
	  Init priority for the Analog Devices ADP5360 regulator driver.
```

## drivers/regulator/Kconfig.axp192
```kconfig
# Copyright (c) 2023 Martin Kiepfer
# SPDX-License-Identifier: Apache-2.0

config REGULATOR_AXP192_AXP2101
	bool "X-Powers AXP192/AXP2101 PMIC regulator driver"
	default y
	depends on DT_HAS_X_POWERS_AXP192_REGULATOR_ENABLED || DT_HAS_X_POWERS_AXP2101_REGULATOR_ENABLED
	depends on DT_HAS_X_POWERS_AXP192_ENABLED || DT_HAS_X_POWERS_AXP2101_ENABLED
	select I2C
	select MFD
	help
	  Enable the AXP PMIC regulator driver

if REGULATOR_AXP192_AXP2101

config REGULATOR_AXP192_AXP2101_INIT_PRIORITY
	int "AXP192/AXP2101 regulator driver init priority"
	default 86
	help
	  Init priority for the axp192/axp2101 regulator driver. It must be
	  greater than MFD_INIT_PRIORITY.

endif
```

## drivers/regulator/Kconfig.axp2101
```kconfig
# Copyright (c) 2024 Lothar Felten <lothar.felten@gmail.com>
# SPDX -License-Identifier: Apache-2.0

config REGULATOR_AXP2101
	bool "X-Powers AXP2101 PMIC regulator driver"
	default y
	depends on DT_HAS_X_POWERS_AXP2101_REGULATOR_ENABLED
	select I2C
	help
	  Enable the X-Powers AXP 2101 PMIC regulator driver

if REGULATOR_AXP2101

config REGULATOR_AXP2101_INIT_PRIORITY
	int "AXP2101 regulator driver init priority"
	default 75
	help
	  Init priority for the axp2101 regulator driver.

endif
```

## drivers/regulator/Kconfig.bflb
```kconfig
# Copyright (c) 2026 MASSDRIVER EI (massdriver.space)
# SPDX-License-Identifier: Apache-2.0

config REGULATOR_BFLB
	bool "Bouffalolab power regulation drivers"
	default y
	depends on DT_HAS_BFLB_AON_REGULATOR_ENABLED || DT_HAS_BFLB_RT_REGULATOR_ENABLED \
		|| DT_HAS_BFLB_SOC_REGULATOR_ENABLED
	help
	  Enable support for Bouffalolab power regulation

if REGULATOR_BFLB

config REGULATOR_BFLB_INIT_PRIORITY
	int "Bouffalolab power regulation drivers init priority"
	default 25
	help
	  Init priority for Bouffalolab power regulation drivers.
	  Must be earlier than clock_control.

endif
```

## drivers/regulator/Kconfig.cp9314
```kconfig
# Copyright (c) 2023 Cirrus Logic, Inc.
# SPDX-License-Identifier: Apache-2.0

config REGULATOR_CP9314
	bool "CP9314 Switched Cap Converter regulator driver"
	default y
	depends on DT_HAS_CIRRUS_CP9314_ENABLED
	help
	  Enable the Cirrus Logic CP9314 Switched Cap Converter
	  regulator driver

config REGULATOR_CP9314_INIT_PRIORITY
	int "CP9314 regulator driver init priority"
	default KERNEL_INIT_PRIORITY_DEVICE
	depends on REGULATOR_CP9314
	help
	  Init priority for the Cirrus Logic CP9314 Switched Cap
	  Converter regulator driver. It must be greater than I2C
	  init priority.
```

## drivers/regulator/Kconfig.da1469x
```kconfig
# Copyright 2023 Renesas Electronics Corporation
# SPDX-License-Identifier: Apache-2.0

config REGULATOR_DA1469X
	bool "DA1469X regulators driver"
	default y
	depends on DT_HAS_RENESAS_SMARTBOND_REGULATOR_ENABLED
	help
	  Enable support for the Smartbond DA1469x regulators.

config REGULATOR_DA1469X_INIT_PRIORITY
	int "Renesas DA1469x regulators driver init priority"
	default KERNEL_INIT_PRIORITY_DEVICE
	depends on REGULATOR_DA1469X
	help
	  Init priority for the Renesas DA1469x regulators driver.
```

## drivers/regulator/Kconfig.esp32
```kconfig
# Copyright (c) 2026 Espressif Systems (Shanghai) Co., Ltd.
# SPDX-License-Identifier: Apache-2.0

config REGULATOR_ESP32
	bool "Espressif on-chip regulator driver"
	default y
	depends on DT_HAS_ESPRESSIF_ESP32_REGULATOR_ENABLED
	help
	  Enable support for the Espressif on-chip voltage
	  regulators.

config REGULATOR_ESP32_INIT_PRIORITY
	int "Espressif regulator driver init priority"
	default 20
	depends on REGULATOR_ESP32
	help
	  Init priority for the Espressif regulator driver.
	  Must be lower than consumers such as PSRAM/MEMC drivers.
```

## drivers/regulator/Kconfig.fake
```kconfig
# Copyright (c) 2022 Nordic Semiconductor ASA
# SPDX-License-Identifier: Apache-2.0

config REGULATOR_FAKE
	bool "Fake regulator driver"
	default y
	depends on DT_HAS_ZEPHYR_FAKE_REGULATOR_ENABLED
	help
	  Enable support for the FFF-based fake regulator driver.

if REGULATOR_FAKE

config REGULATOR_FAKE_COMMON_INIT_PRIORITY
	int "Fake regulator driver init priority (common part)"
	default 75
	help
	  Init priority for the fake regulator driver (common part).

config REGULATOR_FAKE_INIT_PRIORITY
	int "Fake regulator driver init priority"
	default 76
	help
	  Init priority for the fake regulator driver. It must be
	  greater than REGULATOR_FAKE_COMMON_INIT_PRIORITY.

endif
```

## drivers/regulator/Kconfig.fixed
```kconfig
# Copyright 2020 Peter Bigot Consulting, LLC
# SPDX-License-Identifier: Apache-2.0

config REGULATOR_FIXED
	bool "GPIO-controlled regulators"
	default y
	depends on DT_HAS_REGULATOR_FIXED_ENABLED
	depends on GPIO
	help
	  Enable the driver for GPIO-controlled regulators

if REGULATOR_FIXED

config REGULATOR_FIXED_INIT_PRIORITY
	int "Init priority"
	default 75
	help
	  Device driver initialization priority

endif # REGULATOR_FIXED
```
