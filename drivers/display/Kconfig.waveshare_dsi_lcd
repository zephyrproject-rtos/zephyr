## drivers/display/Kconfig.waveshare_dsi_lcd
```kconfig
# Copyright 2025 NXP
#
# SPDX-License-Identifier: Apache-2.0

config WAVESHARE_7INCH_DSI_LCD_C
	bool "waveshare 7inch DSI LCD(C) driver"
	default y
	select MIPI_DSI
	select I2C
	depends on DT_HAS_WAVESHARE_7INCH_DSI_LCD_C_ENABLED
	help
	  Enable driver for waveshare 7inch DSI LCD(C).
```

## drivers/display/Kconfig.zc143ac72mipi
```kconfig
# Copyright 2025 NXP
# SPDX-License-Identifier: Apache-2.0


menuconfig DISPLAY_ZC143AC72MIPI
	bool "MCUX ---"
	default y
	help
	  ---


if DISPLAY_ZC143AC72MIPI
endif # DISPLAY_ZC143AC72MIPI
```

## drivers/dma/Kconfig
```kconfig
# DMA configuration options

# Copyright (c) 2016 Intel Corporation
# SPDX-License-Identifier: Apache-2.0

#
# DMA options
#
menuconfig DMA
	bool "Direct Memory Access (DMA) drivers"

if DMA
config DMA_64BIT
	bool "DMA 64 bit address support"
	help
	  When this option is true, 64 bit source and dest
	  DMA addresses are supported.

config DMA_INIT_PRIORITY
	int "DMA init priority"
	default KERNEL_INIT_PRIORITY_DEFAULT
	help
	  DMA driver device initialization priority.

module = DMA
module-str = dma
source "subsys/logging/Kconfig.template.log_config"

source "drivers/dma/Kconfig.*"

endif # DMA
```

## drivers/dma/Kconfig.ace_gpdma
```kconfig
# DMA configuration options

# Copyright (c) 2022 Intel Corporation
# SPDX-License-Identifier: Apache-2.0

config DMA_ACE_GPDMA
	bool "ACE General Purpose Direct Memory Access driver"
	default $(dt_compat_enabled,$(DT_COMPAT_DMA_ACE_GPDMA))
	help
	  Intel ACE DMA driver.
```

## drivers/dma/Kconfig.acp_sdw
```kconfig
# SPDX-FileCopyrightText: Copyright The Zephyr Project Contributors
# Copyright (c) 2026 AMD
# SPDX-License-Identifier: Apache-2.0

menuconfig DMA_AMD_ACP_SDW
	bool "AMD ACP SoundWire DMA driver"
	default y
	depends on DMA && DT_HAS_AMD_ACP_SDW_DMA_ENABLED
	help
	  Enable support for AMD Audio Co-Processor (ACP) SoundWire DMA driver.
	  This driver provides DMA functionality for SoundWire interface transfers
	  in AMD ACP 7.0 audio subsystem, enabling audio streaming over SoundWire
	  bus for connected audio peripherals and codecs.

if DMA_AMD_ACP_SDW

config DMA_AMD_ACP_SDW_TRANS_SIZE
	int "DMA transfer size"
	default 128
	help
	  ACP SoundWire DMA transfer size.

config DMA_AMD_ACP_SDW_CHANNEL_COUNT
	int "Maximum channel count"
	default 12
	help
	  Maximum number of ACP SoundWire DMA channels.

endif # DMA_AMD_ACP_SDW
```

## drivers/dma/Kconfig.acp_tdm
```kconfig
# SPDX-FileCopyrightText: Copyright (c) 2026 AMD
# SPDX-License-Identifier: Apache-2.0

menuconfig DMA_AMD_ACP_TDM
	bool "AMD ACP TDM DMA driver"
	default y
	depends on DT_HAS_AMD_ACP_TDM_DMA_ENABLED
	help
	  Enable the AMD ACP unified TDM DMA driver.
	  Covers TDM0 (Headset), TDM1 (SP speaker), and TDM2 (Bluetooth)
	  P1 DMA instances using per-instance register tables.

if DMA_AMD_ACP_TDM

config DMA_AMD_ACP_TDM_CHANNEL_COUNT
	int "Channel count"
	default 8
	help
	  Number of DMA channels (2 per instance x 3 instances).

config DMA_AMD_ACP_TDM_BUFFER_ALIGN
	int "Buffer alignment"
	default 64
	help
	  Required alignment for ACP TDM audio buffers.

config DMA_AMD_ACP_TDM_BUFFER_ADDRESS_ALIGN
	int "Buffer address alignment"
	default 128
	help
	  Required address alignment for ACP TDM audio buffers.

endif # DMA_AMD_ACP_TDM
```

## drivers/dma/Kconfig.ameba
```kconfig
# Copyright (c) 2026 Realtek Semiconductor Corp.
# SPDX-License-Identifier: Apache-2.0

config DMA_AMEBA
	bool "AMEBA General Purpose DMA driver"
	depends on DT_HAS_REALTEK_AMEBA_GDMA_ENABLED
	default y
	help
	  General Purpose DMA for AMEBA series.

if DMA_AMEBA

config DMA_AMEBA_SCATTER_GATHER
	bool "Ameba DMA scatter/gather support"
	depends on SOC_SERIES_AMEBAG2
	default y
	help
	  Enable DMA scatter/gather support on Ameba SoC

config DMA_AMEBA_LLI
	bool "AMEBA Linked List Mode"
	help
	  This option supports data block in the form of linked lists.

config DMA_AMEBA_LLI_MAX_DESC
	int "Maximal number of available DMA descriptors"
	default 16
	help
	  Reserves memory for a maximal number of descriptors

endif # DMA_AMEBA
```

## drivers/dma/Kconfig.andes_atcdmac100
```kconfig
# Andestech ATCDMAC100 configuration options
# Copyright (c) 2024 Rapid Silicon

# SPDX-License-Identifier: Apache-2.0


config DMA_ANDES_ATCDMAC100
	bool "Using Andes ATCDMAC100 DMA driver"
	default y
	depends on DT_HAS_ANDESTECH_ATCDMAC100_ENABLED
	help
	  Andes ATCDMAC100 DMA driver.
```

## drivers/dma/Kconfig.andes_atcdmac300
```kconfig
# Andestech ATCDMAC300 configuration options
# Copyright (c) 2023 Andes Technology Corporation.

# SPDX-License-Identifier: Apache-2.0


config DMA_ANDES_ATCDMAC300
	bool "Using Andes ATCDMAC300 DMA driver"
	default y
	depends on DT_HAS_ANDESTECH_ATCDMAC300_ENABLED
	help
	  Andes ATCDMAC300 DMA driver.
```

## drivers/dma/Kconfig.andes_atcdmacx00
```kconfig
# Andestech ATCDMACx00 serial configuration options
# Copyright (c) 2025 Andes Technology Corporation.

# SPDX-License-Identifier: Apache-2.0


config DMA_ANDES_ATCDMACX00
	bool "Andes ATCDMACX00 DMA driver"
	default y
	depends on DT_HAS_ANDESTECH_ATCDMACX00_ENABLED
	depends on !DCACHE || SOC_ANDES_V5_IOCP || NOCACHE_MEMORY
	help
	  Andes ATCDMACX00 DMA driver.

if DMA_ANDES_ATCDMACX00
config DMA_64BIT
	default y
	depends on 64BIT
endif
```

## drivers/dma/Kconfig.axi_dmac
```kconfig
# Kconfig - DMA configuration options
#
#
# Copyright (c) 2016 Intel Corporation
#
# SPDX-License-Identifier: Apache-2.0
#

menuconfig DMA_AXI_DMAC
	bool "Enable AXI-DMAC DMA driver"
	default n
	help
	  AXI-DMAC DMA driver.
```

## drivers/dma/Kconfig.bee
```kconfig
# Copyright (c) 2026, Realtek Semiconductor Corporation
# SPDX-License-Identifier: Apache-2.0

config DMA_BEE
	bool "Realtek Bee series DMA driver"
	default y
	depends on DT_HAS_REALTEK_BEE_DMA_ENABLED
	select HAL_REALTEK_BEE_DMA
	select SYS_MEM_BLOCKS
	help
	  This option enables the DMA driver for Realtek Bee SoCs.

if DMA_BEE

config DMA_BEE_LLI_POOL_COUNT
	int "Number of LLI in the pool"
	default 128
	help
	  Specifies the total number of Linked List Item (LLI) descriptors
	  available in the driver's internal memory pool.

	  These descriptors are used for multi-block DMA transfers.
	  Each block in a DMA configuration requires one LLI.

	  Increase this value if you have many concurrent DMA channels using
	  multi-block transfers or if you have single transfers with a large
	  number of blocks.

config DMA_BEE_MAX_BLOCKS_PER_CHANNEL
	int "Max number of blocks per channel"
	default 16
	range 1 64
	help
	  Specifies the maximum number of blocks that can be configured for a
	  single DMA channel transaction.

endif
```

## drivers/dma/Kconfig.bflb
```kconfig
# Copyright (c) 2025 MASSDRIVER EI <massdriver.space>
# SPDX-License-Identifier: Apache-2.0

config DMA_BFLB
	bool "Bouffalo Lab DMA driver"
	default y
	depends on DT_HAS_BFLB_DMA_ENABLED
	help
	  DMA driver for Bouffalo Lab SoCs
```

## drivers/dma/Kconfig.cavs
```kconfig
# Kconfig.cavs - CAVS DMA configuration options
#
#
# Copyright (c) 2018 Intel Corporation
#
# SPDX-License-Identifier: Apache-2.0
#

config DMA_CAVS
	bool "Enable CAVS DMA driver"
	help
	  CAVS DMA driver.
```

## drivers/dma/Kconfig.cavs_gpdma
```kconfig
# cAVS GPDMA configuration options

# Copyright (c) 2022 Intel Corporation
# SPDX-License-Identifier: Apache-2.0

config DMA_CAVS_GPDMA
	bool "CAVS GPDMA DMA driver"
	help
	  Intel cAVS GPDMA DMA driver.

if DMA_CAVS_GPDMA

config DMA_CAVS_GPDMA_HAS_LLP
	bool "cAVS GPDMA Linear Link Position Feature"
	help
	  cAVS GPDMA may optionally have a linear link position
	  feature.

source "drivers/dma/Kconfig.dw_common"

endif # DMA_CAVS_GPDMA
```

## drivers/dma/Kconfig.cavs_hda
```kconfig
# cAVS HDA configuration options

# Copyright (c) 2022 Intel Corporation
# SPDX-License-Identifier: Apache-2.0

DT_COMPAT_INTEL_CAVS_HDA_HOST_IN := intel,cavs-hda-host-in
DT_COMPAT_INTEL_CAVS_HDA_HOST_OUT := intel,cavs-hda-host-out
DT_COMPAT_INTEL_CAVS_HDA_LINK_IN := intel,cavs-hda-link-in
DT_COMPAT_INTEL_CAVS_HDA_LINK_OUT := intel,cavs-hda-link-out

config DMA_CAVS_HDA_HOST_IN
	bool "Intel cAVS HDA Host In DMA drivers"
	default $(dt_compat_enabled,$(DT_COMPAT_INTEL_CAVS_HDA_HOST_IN))
	depends on DMA
	select DMA_CAVS_HDA
	help
	  Intel cAVS Host HDA DMA driver.

config DMA_CAVS_HDA_HOST_OUT
	bool "Intel cAVS HDA Host Out DMA drivers"
	default $(dt_compat_enabled,$(DT_COMPAT_INTEL_CAVS_HDA_HOST_OUT))
	depends on DMA
	select DMA_CAVS_HDA
	help
	  Intel cAVS Host HDA DMA driver.

config DMA_CAVS_HDA_LINK_IN
	bool "Intel cAVS HDA Link In DMA drivers"
	default $(dt_compat_enabled,$(DT_COMPAT_INTEL_CAVS_HDA_LINK_IN))
	depends on DMA
	select DMA_CAVS_HDA
	help
	  Intel cAVS Link In HDA DMA driver.

config DMA_CAVS_HDA_LINK_OUT
	bool "Intel cAVS HDA Link Out DMA drivers"
	default $(dt_compat_enabled,$(DT_COMPAT_INTEL_CAVS_HDA_LINK_OUT))
	depends on DMA
	select DMA_CAVS_HDA
	help
	  Intel cAVS Link Out HDA DMA driver.

config DMA_CAVS_HDA
	bool
	depends on DMA_CAVS_HDA_LINK_OUT || DMA_CAVS_HDA_LINK_IN || DMA_CAVS_HDA_HOST_OUT || DMA_CAVS_HDA_HOST_IN
	help
	  Intel cAVS HDA DMA driver.
```

## drivers/dma/Kconfig.dma_pl330
```kconfig
# Copyright 2020 Broadcom
# SPDX-License-Identifier: Apache-2.0

config DMA_PL330
	bool
	prompt "PL330 DMA driver"
	default y
	depends on DT_HAS_ARM_DMA_PL330_ENABLED
	help
	  This option enables support of pl330 DMA Controller.
```

## drivers/dma/Kconfig.dw
```kconfig
# DesignWare DMA configuration options

# Copyright (c) 2018 Intel Corporation
# SPDX-License-Identifier: Apache-2.0

config DMA_DW
	bool "DesignWare DMA driver"
	default y
	depends on DT_HAS_SNPS_DESIGNWARE_DMA_ENABLED
	help
	  DesignWare DMA driver.

if DMA_DW

source "drivers/dma/Kconfig.dw_common"

endif # DMA_DW
```

## drivers/dma/Kconfig.dw_axi_dmac
```kconfig
# DesignWare DMA configuration options

# Copyright (c) 2023 Intel Corporation
# SPDX-License-Identifier: Apache-2.0

config DMA_DW_AXI
	bool "DesignWare AXI DMA driver"
	default y
	depends on DT_HAS_SNPS_DESIGNWARE_DMA_AXI_ENABLED
	imply DMA_64BIT
	help
	  DesignWare AXI DMA driver.

if DMA_DW_AXI

config DMA_DW_AXI_MAX_DESC
	int "allocate number of lli descriptor"
	default 10
	help
	  creates number of descriptor per channel in a statically allocated pool.
	  Each channel has its own dedicated pool.

config DMA_DW_AXI_LLI_SUPPORT
	bool "hardware supports linked list multi block transfer"
	default y
	help
	  This flag can be enabled if hardware support Linked List multi-block transfer

config DMA_CHANNEL_STATUS_TIMEOUT
	int "Channel status timeout"
	default 1000
	help
	  Max timeout to abort or disable the channel

config DMA_DW_AXI_MAX_BURST_TXN_LEN
	int "max burst transaction length"
	default 8
	help
	  set max number of source and destination data units supported

config DMA_DW_AXI_DATA_WIDTH
	int "data bus width"
	default 64
	help
	  update this flag to change the axi master interface data width

config DMA_DW_AXI_MAX_BLOCK_TS
	int "max block size"
	default 32767
	help
	  update this config to set maximum value of block size

endif # DMA_DW_AXI
```

## drivers/dma/Kconfig.dw_common
```kconfig
# DesignWare DMA common configuration options

# Copyright (c) 2022 Intel Corporation
# SPDX-License-Identifier: Apache-2.0

config DMA_DW_FIFO_PARTITION
	bool "FIFO Partitioning"
	help
	  FIFO partition feature

config DMA_DW_LLI_POOL_SIZE
	int "number of LLI structs in an allocation pool"
	default 2
	help
	  The number of LLI structs in a statically allocated pool. Each channel has its own
	  LLI struct pool. If during dma_config() a log notes there are not enough LLI structs
	  then this should be increased to match the need.

config DMA_DW_HW_LLI
	bool "hardware supports scatter gather"
	default y
	help
	  The hardware is by default expected to support hardware LLI (scatter gather).
	  When not enabled the driver will still perform scatter gather but using software
	  to run through the scatter gather list.

config DMA_DW_SUSPEND_DRAIN
	bool "channels should be suspended and drained on stop"
	depends on DMA_INTEL_ADSP_GPDMA
	help
	  Rather than immediately stopping a DMA channel the channel is suspended
	  with the DRAIN bit flag set to allow for the hardware FIFO to be drained
	  before stopping the channel.

config DMA_DW_HOST_MASK
	int "memory space mask"
	default 0
	help
	  Some instances of the DesignWare DMAC require a mask applied to source/destination
	  addresses to signifiy the memory space the address is in.
```

## drivers/dma/Kconfig.esp32
```kconfig
# Copyright (c) 2022 Espressif Systems (Shanghai) Co., Ltd.
# SPDX-License-Identifier: Apache-2.0

config DMA_ESP32
	bool "ESP32 General Purpose DMA driver"
	depends on DT_HAS_ESPRESSIF_ESP32_GDMA_ENABLED
	default y
	help
	  General Purpose DMA for ESP32 series.

config DMA_ESP32_MAX_DESCRIPTOR_NUM
	int "Maximal number of available DMA descriptors"
	default 16
	help
	  Reserves memory for a maximal number of descriptors
```

## drivers/dma/Kconfig.gd32
```kconfig
# Copyright (c) 2022 Tokita, Hiroshi <tokita.hiroshi@gmail.com>
# SPDX-License-Identifier: Apache-2.0

config DMA_GD32
	bool "Gigadevice GD32 DMA driver"
	default y
	depends on DT_HAS_GD_GD32_DMA_ENABLED
	select USE_GD32_DMA
	help
	  DMA driver for GigaDevice GD32 series MCUs.
```

## drivers/dma/Kconfig.ifx_cat1
```kconfig
# Infineon CAT1 DMA configuration options

# Copyright (c) 2023 Cypress Semiconductor Corporation (an Infineon company) or
# an affiliate of Cypress Semiconductor Corporation
#
# SPDX-License-Identifier: Apache-2.0

config DMA_INFINEON_CAT1
	bool "Infineon CAT1 DMA driver"
	default y
	depends on DT_HAS_INFINEON_CAT1_DMA_ENABLED
	select USE_INFINEON_DMA
	help
	  This option enables the DMA driver for Infineon CAT1 family.

config DMA_PDL_INFINEON_CAT1
	bool "Infineon CAT1 DMA driver"
	default y
	depends on DT_HAS_INFINEON_CAT1_DMA_PDL_ENABLED
	select USE_INFINEON_DMA
	help
	  This option enables the DMA driver for Infineon CAT1 family.

config INFINEON_DESCRIPTOR_POOL_SIZE
	int
	default 10
	depends on DMA_PDL_INFINEON_CAT1
	help
	  This option provides the descritor pool size used for the DMA PDL driver
```

## drivers/dma/Kconfig.infineon
```kconfig
# Infineon CAT1 DMA configuration options

# Copyright (c) 2023 Cypress Semiconductor Corporation (an Infineon company) or
# an affiliate of Cypress Semiconductor Corporation
#
# SPDX-License-Identifier: Apache-2.0

config DMA_INFINEON_CAT1_HAL
	bool "Infineon CAT1 DMA Legacy HAL-based driver"
	default y
	depends on DT_HAS_INFINEON_DMA_ENABLED
	depends on USE_INFINEON_LEGACY_HAL
	select USE_INFINEON_DMA
	help
	  This option enables the legacy HAL-based DMA driver for Infineon CAT1 family.

config DMA_INFINEON_CAT1_PDL
	bool "Infineon CAT1 DMA PDL-based driver"
	default y
	depends on DT_HAS_INFINEON_DMA_ENABLED
	depends on !USE_INFINEON_LEGACY_HAL
	select USE_INFINEON_DMA
	help
	  This option enables the PDL-based DMA driver for Infineon CAT1 family.

config DMA_INFINEON_DESCRIPTOR_COUNT
	int "Number of available descriptors per channel"
	default 2
	depends on DMA_INFINEON_CAT1_PDL
	help
	  This option determines the number of descriptors that are allocated for each DMA
	  channel. This must be set to a value of 1 or greater.

config DMA_INFINEON
	bool "Infineon DMAC PDL-based driver"
	default y
	depends on DT_HAS_INFINEON_DMAC_ENABLED
	depends on !USE_INFINEON_LEGACY_HAL
	select USE_INFINEON_DMA
	help
	  This option enables the PDL-based DMAC driver for Infineon family.

config INFINEON_DESCRIPTOR_POOL_SIZE
	int
	default 10
	depends on DMA_INFINEON_CAT1_PDL
	help
	  This option provides the descritor pool size used for the DMA PDL driver

config INFINEON_DMA_MAX_XFERS
	int "Maximum blocks to transfer"
	default 4
	depends on DT_HAS_INFINEON_DMAC_ENABLED
	help
	  This option provides the maximum blocks allocated for the DMAC
```
