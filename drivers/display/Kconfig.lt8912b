## drivers/dma/Kconfig.infineon_dw
```kconfig
# SPDX-FileCopyrightText: Copyright (c) 2026 Infineon Technologies AG,
# SPDX-FileCopyrightText: or an affiliate of Infineon Technologies AG. All rights reserved.
# SPDX-FileCopyrightText: Copyright (c) 2026 Linumiz
#
# SPDX-License-Identifier: Apache-2.0

config DMA_INFINEON_DW
	bool "Infineon DataWire (P-DMA) driver"
	default y
	depends on DT_HAS_INFINEON_DW_DMA_ENABLED
	help
	  Register-level driver for the Infineon DataWire (P-DMA) controller.

config DMA_INFINEON_DW_DESCRIPTOR_COUNT
	int "Number of descriptors per DMA channel"
	default 2
	depends on DMA_INFINEON_DW
	help
	  Number of descriptors allocated for each DMA channel. Must be 1 or
	  greater. This is also the maximum block_count accepted by
	  dma_config().
```

## drivers/dma/Kconfig.lpf3
```kconfig
# TI LPF3 DMA configuration options

# Copyright (c) 2026 Texas Instruments Incorporated
# Copyright (c) 2024 BayLibre, SAS
# SPDX-License-Identifier: Apache-2.0

config DMA_LPF3
	bool "TI SimpleLink LPF3 DMA driver"
	default y
	depends on DT_HAS_TI_LPF3_DMA_ENABLED
	help
	  Enable the TI SimpleLink LPF3 DMA driver (CC23x0 and CC27xx).
```

## drivers/dma/Kconfig.ti_cc23x0
```kconfig
# TI CC23X0 DMA configuration options

# Copyright (c) 2024 BayLibre, SAS
# SPDX-License-Identifier: Apache-2.0

config DMA_TI_CC23X0
	bool "TI CC23X0 DMA driver"
	default y
	depends on DT_HAS_TI_CC23X0_DMA_ENABLED
	help
	  DMA driver for TI CC23X0 MCUs.
config DMA_TI_CONTROL_TABLE_PREALLOCATED_LOCATION
	hex "Location of the preallocated control table"
	default 0x20000400
config DMA_TI_CONTROL_TABLE_PREALLOCATED
	bool "The control table is preallocated"
	default n
	help
		If the DMA control table is preallocated, use that table instead of
		allocating one at a random location. The location of the preallocated
		control table can be specified in using
		DMA_TI_CONTROL_TABLE_PREALLOCATED_LOCATION
```

## drivers/dma/Kconfig.ti_cc23x0_cc27xx
```kconfig
# TI CC23X0_CC27XX DMA configuration options

# Copyright (c) 2024 BayLibre, SAS
# SPDX-License-Identifier: Apache-2.0

config DMA_TI_CC23X0_CC27XX
	bool "TI CC23X0_CC27XX DMA driver"
	default y
	depends on DT_HAS_TI_CC23X0_CC27XX_DMA_ENABLED
	help
	  DMA driver for TI CC23X0_CC27XX MCUs.
```

## drivers/dma/Kconfig.ti_cc35xx
```kconfig
# Copyright (c) 2025 Conclusive Engineering Sp. z o.o.
# SPDX-License-Identifier: Apache-2.0

config DMA_TI_CC35XX
	bool "CC35XX MCU DMA driver"
	default y
	depends on DT_HAS_TI_CC35XX_DMA_ENABLED
	help
	  Enable DMA support on the CC35XX family of processors.
```
