## drivers/display/Kconfig.lt8912b
```kconfig
# SPDX-FileCopyrightText: Copyright The Zephyr Project Contributors
# SPDX-License-Identifier: Apache-2.0

config LT8912B
	bool "Lontium LT8912B MIPI DSI to HDMI bridge"
	default y
	depends on DT_HAS_LONTIUM_LT8912B_ENABLED
	select MIPI_DSI
	select I2C
	help
	  Enable driver for the Lontium LT8912B MIPI DSI to HDMI bridge.
```

## drivers/display/Kconfig.mcux_dcnano_lcdif
```kconfig
# Copyright 2023,2025 NXP
# SPDX-License-Identifier: Apache-2.0


menuconfig DISPLAY_MCUX_DCNANO_LCDIF
	bool "MCUX DCNano LCDIF driver"
	default y
	depends on DT_HAS_NXP_DCNANO_LCDIF_ENABLED
	help
	  Enable support for mcux DCNano LCDIF driver.


if DISPLAY_MCUX_DCNANO_LCDIF

config MCUX_DCNANO_LCDIF_FB_NUM
	int "Framebuffers to allocate in driver"
	default 1
	range 0 2
	help
	  Number of framebuffers to allocate in DCNANO driver. Driver allocated
	  framebuffers are required to support partial display updates.
	  The driver has been validated to support 0 through 2 framebuffers.
	  A write covering the whole panel is scanned out of the caller's
	  buffer whatever the count, and that buffer stays in use until the
	  next full-frame write returns (SCREEN_INFO_WRITE_HOLDS_BUFFER).
	  The driver framebuffers serve partial updates and the frame shown
	  before the first write.


config MCUX_DCNANO_LCDIF_MAINTAIN_CACHE
	bool "Maintain cache coherency"
	default y
	help
	  Maintain cache coherency for LCDIF framebuffer. This is generally
	  required, unless an external framebuffer is utilized with custom
	  caching settings, or caching is disabled.

endif # DISPLAY_MCUX_DCNANO_LCDIF
```

## drivers/display/Kconfig.mcux_lcdifv2
```kconfig
# Copyright 2026 NXP
# SPDX-License-Identifier: Apache-2.0

menuconfig DISPLAY_MCUX_LCDIFV2
	bool "MCUX LCDIFV2 driver"
	default y
	depends on DT_HAS_NXP_IMX_LCDIFV2_ENABLED
	select PINCTRL
	help
	  Enable support for mcux LCDIFV2 driver.

if DISPLAY_MCUX_LCDIFV2

config MCUX_LCDIFV2_FB_NUM
	int "Framebuffers to allocate in driver"
	default 1
	range 0 2
	help
	  Number of framebuffers to allocate in LCDIFV2 driver. Driver allocated
	  framebuffers are required to support partial display updates.
	  The driver has been validated to support 0 through 2 framebuffers.
	  A write covering the whole panel is scanned out of the caller's
	  buffer whatever the count, and that buffer stays in use until the
	  next full-frame write returns (SCREEN_INFO_WRITE_HOLDS_BUFFER).
	  The driver framebuffers serve partial updates and the frame shown
	  before the first write.

config MCUX_LCDIFV2_FB_SIZE
	int "Framebuffer size required by the LCDIFV2 driver"
	default 3686400
	help
	  LCDIFV2 driver allocates framebuffers to support partial display updates.
	  The framebuffer size is computed as : panel_width * panel_height * bpp.
	  The default value is set to afford for a default resolution of 1280x720 and
	  4-bytes pixel format, e.g. ARGB8888. Applications should change this value
	  according to the actual used resolution and format to optimize the heap size.

endif # DISPLAY_MCUX_LCDIFV2
```

## drivers/display/Kconfig.mcux_lcdifv3
```kconfig
# Copyright 2025-2026 NXP
# SPDX-License-Identifier: Apache-2.0


menuconfig DISPLAY_MCUX_LCDIFV3
	bool "MCUX LCDIFV3 driver"
	default y
	depends on DT_HAS_NXP_IMX_LCDIFV3_ENABLED
	depends on CLOCK_CONTROL
	help
	  Enable support for mcux LCDIFV3 driver.

if DISPLAY_MCUX_LCDIFV3

config MCUX_LCDIFV3_FB_NUM
	int "Framebuffers to be allocated in driver"
	default 2
	range 0 2
	help
	  Number of framebuffers to be allocated in LCDIFV3 driver. Driver allocates
	  framebuffers in order to support partial display update. A write
	  covering the whole panel is scanned out of the caller's buffer
	  whatever the count, and that buffer stays in use until the next
	  full-frame write returns (SCREEN_INFO_WRITE_HOLDS_BUFFER).

endif # DISPLAY_MCUX_LCDIFV3
```

## drivers/display/Kconfig.nv3031b
```kconfig
# SPDX-FileCopyrightText: Copyright The Zephyr Project Contributors
# SPDX-License-Identifier: Apache-2.0

config DISPLAY_NV3031B
	bool "NV3031B display driver"
	default y
	depends on DT_HAS_NEWVISION_NV3031B_ENABLED
	select SPI
	select GPIO
	select LED if $(dt_compat_any_has_prop,$(DT_COMPAT_NEWVISION_NV3031B),backlight-leds)
	help
	  Enable the NV3031B LCD controller using single-data-line transfers
	  over its QSPI interface. Supports RGB565 with swapped bytes,
	  rotation, display blanking, and optional LED backlight control.

	  When using backlight LEDs, set DISPLAY_INIT_PRIORITY so the display
	  initializes after the backlight LED controllers.
```

## drivers/display/Kconfig.nxp_dcif
```kconfig
# Copyright 2026 NXP
# SPDX-License-Identifier: Apache-2.0

menuconfig DISPLAY_NXP_DCIF
	bool "NXP DCIF driver"
	default y
	depends on DT_HAS_NXP_DCIF_ENABLED
	select PINCTRL
	help
	  Enable support for NXP DCIF driver.


if DISPLAY_NXP_DCIF

config NXP_DCIF_FB_NUM
	int "Framebuffers to allocate in driver"
	default 1
	range 0 2
	help
	  Number of framebuffers to allocate in DCIF driver. Driver allocated
	  framebuffers are required to support partial display updates.
	  The driver has been validated to support 0 through 2 framebuffers.
	  Note that hardware will likely perform best if zero driver
	  framebuffers are allocated by the driver, and the application
	  implements double framebuffering by always calling display_write with
	  a buffer equal in size to the connected panel.


config NXP_DCIF_MAINTAIN_CACHE
	bool "Maintain cache coherency"
	default y
	help
	  Maintain cache coherency for DCIF framebuffer. This is generally
	  required, unless an external framebuffer is utilized with custom
	  caching settings, or caching is disabled.

endif # DISPLAY_NXP_DCIF
```

## drivers/display/Kconfig.otm8009a
```kconfig
# Copyright (c) 2023 bytes at work AG
# SPDX-License-Identifier: Apache-2.0

config OTM8009A
	bool "OTM8009A display driver"
	default y
	depends on DT_HAS_ORISETECH_OTM8009A_ENABLED
	select MIPI_DSI
	select GPIO if $(dt_compat_any_has_prop,$(DT_COMPAT_ORISETECH_OTM8009A),reset-gpios) || \
		$(dt_compat_any_has_prop,$(DT_COMPAT_ORISETECH_OTM8009A),bl-gpios)
	help
	  Enable driver for OTM8009A display driver.

if OTM8009A

config DISPLAY_OTM8009A_INIT_PRIORITY
	int "Initialization priority"
	default DISPLAY_INIT_PRIORITY
	help
	  OTM8009A display driver initialization priority.

endif
```

## drivers/display/Kconfig.renesas_rz
```kconfig
# Renesas RZ Family

# SPDX-FileCopyrightText: 2026 Renesas Electronics Corporation
# SPDX-License-Identifier: Apache-2.0

config RENESAS_RZ_LCDC
	bool "Renesas display controller driver"
	default y
	depends on DT_HAS_RENESAS_RZ_LCDC_ENABLED
	select USE_RZ_FSP_DISPLAY
	select NOCACHE_MEMORY if DCACHE
	select GPIO if $(dt_compat_any_has_prop,$(DT_COMPAT_RENESAS_RZ_LCDC),backlight-gpios)
	help
	  Enable Renesas display controller.

if RENESAS_RZ_LCDC

config RENESAS_RZ_LCDC_FB_NUM
	int "Frame buffer number"
	default 2
	range 0 2
	help
	  RENESAS RZ LCDC frame buffer number config:
	    - 0 frame buffer maintained by application, must write with full screen pixels.
	    - 1 single frame buffer in RENESAS RZ LCDC driver.
	    - 2 double frame buffer in RENESAS RZ LCDC driver.

endif # RENESAS_RZ_LCDC
```

## drivers/display/Kconfig.rm67162
```kconfig
# Copyright 2023, NXP
# SPDX-License-Identifier: Apache-2.0

config RM67162
	bool "RM67162 display driver"
	default y
	depends on DT_HAS_RAYDIUM_RM67162_ENABLED
	select MIPI_DSI if $(dt_compat_on_bus,$(DT_COMPAT_RAYDIUM_RM67162),mipi-dsi)
	select MIPI_DBI if $(dt_compat_on_bus,$(DT_COMPAT_RAYDIUM_RM67162),mipi-dbi)
	help
	  Enable driver for RM67162 display driver.
```

## drivers/display/Kconfig.sf32lb_jdi_parallel
```kconfig
# Copyright (c) 2026 Qingsong Gou <gouqs@hotmail.com>
# SPDX-License-Identifier: Apache-2.0

config SF32LB_JDI_PARALLEL
	bool "JDI parallel interface display driver"
	default y
	depends on DT_HAS_SIFLI_SF32LB_JDI_PARALLEL_ENABLED
	help
	  Enable driver for JDI parallel interface display.
```

## drivers/display/Kconfig.ssd16xx
```kconfig
# SSD16XX display controller configuration options

# Copyright (c) 2018 Phytec Messtechnik GmbH
# SPDX-License-Identifier: Apache-2.0

config SSD16XX
	bool "SSD16XX compatible display controller driver"
	default y
	depends on \
		DT_HAS_SOLOMON_SSD1608_ENABLED || \
		DT_HAS_SOLOMON_SSD1673_ENABLED || \
		DT_HAS_SOLOMON_SSD1675A_ENABLED || \
		DT_HAS_SOLOMON_SSD1680_ENABLED || \
		DT_HAS_SOLOMON_SSD1681_ENABLED || \
		DT_HAS_SOLOMON_SSD1683_ENABLED
	select MIPI_DBI
	help
	  Enable driver for SSD16XX compatible controller.

if SSD16XX

config SSD16XX_PM_TIME_BEFORE_SUSPEND
	int "Idle time before the panel is suspended (ms)"
	depends on PM_DEVICE_RUNTIME
	default 10000
	help
	  Delay between the last display access and the asynchronous runtime
	  suspend that puts the panel into deep sleep. Leaving and re-entering
	  deep sleep costs a full controller re-initialisation, so applications
	  that refresh in bursts benefit from a delay that spans the burst.

endif # SSD16XX
```

## drivers/display/Kconfig.st7262
```kconfig
# Copyright (c) 2026 Espressif Systems (Shanghai) Co., Ltd.
# SPDX-License-Identifier: Apache-2.0

config ST7262
	bool "Sitronix ST7262 RGB panel on ESP32 LCD-CAM"
	default y
	depends on DT_HAS_SITRONIX_ST7262_ENABLED
	select DMA
	select PINCTRL
	help
	  Enable driver for Sitronix ST7262 RGB panels connected to the
	  ESP32-S3 LCD-CAM parallel RGB interface.

if ST7262

config ST7262_BOUNCE_BUFFER_LINES
	int "RGB bounce buffer height in lines"
	default 20
	range 0 64
	help
	  When non-zero, scanout copies the PSRAM framebuffer into internal
	  SRAM bounce buffers for GDMA (required for reliable ESP32-S3 RGB
	  panels with octal PSRAM). Set to 0 to DMA directly from PSRAM.

endif
```

## drivers/display/Kconfig.st7701_rgb
```kconfig
# Copyright (c) 2026 Kim Bøndergaard
# SPDX-License-Identifier: Apache-2.0

config ST7701_RGB
	bool "Sitronix ST7701 RGB panel"
	default y
	depends on DISPLAY
	depends on DT_HAS_SITRONIX_ST7701_RGB_ENABLED
	select MIPI_DBI
	help
	  Enable driver for ST7701 in RGB panel use-cases where
	  initialization commands are sent over a MIPI-DBI command channel.

config ST7701_RGB_INIT_PRIORITY
	int "ST7701 RGB init priority"
	default DISPLAY_INIT_PRIORITY
	depends on ST7701_RGB
	help
	  Initialization priority for the ST7701 RGB panel driver. Its value must
	  not be higher than the init priority value of the RGB host controller.
```

## drivers/display/Kconfig.ti_dss
```kconfig
# TI K3 Family DSS driver
#
# Copyright (c) 2026 Texas Instruments Incorporated
# SPDX-License-Identifier: Apache-2.0

config TI_DSS
	bool "TI display controller driver"
	default y
	depends on DT_HAS_TI_TIDSS_ENABLED
	help
	  Enable the TI K3 Display Sub-System (TIDSS) driver.

if TI_DSS

config TIDSS_INIT_PRIORITY
	int "TI DSS initialisation priority"
	default 91
	help
	  Device initialisation priority for the TI DSS Controller.

endif # TIDSS
```

## drivers/display/Kconfig.tr230s
```kconfig
# SPDX-FileCopyrightText: Copyright 2026 A Blue Thing In The Cloud SLU
# SPDX-License-Identifier: Apache-2.0

config TR230S
	bool "Shanghai TDO TR230S display controller"
	default y
	depends on DT_HAS_TDO_TR230S_ENABLED
	select MIPI_DBI
	help
	  Enable the display driver for the Shanghai Top Display
	  Optoelectronics TR230S display bridge/controller using Zephyr's
	  MIPI DBI interface.
```

## drivers/dma/Kconfig.acp_dmic_dma
```kconfig
# SPDX-FileCopyrightText: Copyright (c) 2026 AMD
# SPDX-License-Identifier: Apache-2.0

menuconfig DMA_AMD_ACP_DMIC
	bool "AMD ACP DMIC DMA driver"
	default y
	depends on DT_HAS_AMD_ACP_DMIC_DMA_ENABLED
	help
	  Enable the AMD ACP DMIC (PDM) DMA driver.
	  Covers DMIC0 (PDM) and DMIC1 (PDM1) capture instances.

if DMA_AMD_ACP_DMIC

config DMA_ACP_CHANNEL_COUNT
	int "DMIC DMA channel count"
	default 8
	help
	  Maximum number of ACP DMIC DMA channels.

config ACP_DMA_BUFFER_ALIGN
	int "DMIC DMA buffer size alignment"
	default DCACHE_LINE_SIZE
	help
	  Required size alignment for ACP DMIC DMA buffers. This must cover
	  a complete data-cache line so invalidation cannot discard data
	  belonging to an adjacent allocation.

config ACP_DMA_BUFFER_ADDRESS_ALIGN
	int "DMIC DMA buffer address alignment"
	default DCACHE_LINE_SIZE
	help
	  Required address alignment for ACP DMIC DMA buffers. Aligning both
	  the address and size to the architecture data-cache line keeps
	  cache invalidation within the DMIC DMA allocation.

endif # DMA_AMD_ACP_DMIC
```

## drivers/dma/Kconfig.acp_host
```kconfig
# SPDX-FileCopyrightText: Copyright The Zephyr Project Contributors
# Copyright (c) 2026 AMD
# SPDX-License-Identifier: Apache-2.0

menuconfig DMA_AMD_ACP_HOST
	bool "AMD ACP host DMA driver"
	default y
	depends on DMA && DT_HAS_AMD_ACP_HOST_DMA_ENABLED
	help
	  Enable support for AMD Audio Co-Processor (ACP) host DMA driver.
	  This driver provides DMA functionality for host memory transfers
	  in AMD ACP 7.0 audio subsystem, supporting audio data movement
	  between system memory and ACP audio processing units.

if DMA_AMD_ACP_HOST

config DMA_AMD_ACP_HOST_CHANNEL_COUNT
	int "Maximum channel count"
	default 10
	help
	  Maximum number of host DMA channels.

config DMA_AMD_ACP_BUFFER_ALIGN
	int "Buffer alignment in bytes"
	default 128
	help
	  Alignment in bytes for memory regions passed to this driver,
	  used to adjust a memory region's size and base address.

config DMA_AMD_ACP_BUFFER_ADDRESS_ALIGN
	int "Buffer address alignment in bytes"
	default 128
	help
	  Alignment in bytes for buffer addresses passed to this driver,
	  used to adjust a memory region's buffer address.

config DMA_AMD_ACP_ATTR_MAX_BLOCK_COUNT
	int "Maximum block count"
	default 2
	help
	  Maximum number of blocks per DMA transfer.

config AMD_ACP_HOST_DMA_PROBE
	bool "ACP host DMA probe extraction"
	depends on SOC_ACP_7_X
	help
	  Enable the SOF probe extraction path on ACP host DMA. The driver
	  records the probe channel, copies the requested extractor data,
	  and writes ACP_FUTURE_REG_ACLK_2 so the host compressor can update
	  the stream position.

endif # DMA_AMD_ACP_HOST
```

## drivers/dma/Kconfig.adi_axi_dmac
```kconfig
# Copyright (c) 2026 Analog Devices, Inc.
# SPDX-License-Identifier: Apache-2.0

config DMA_ADI_AXI_DMAC
	bool "Analog Devices AXI DMAC driver"
	default y
	depends on DT_HAS_ADI_AXI_DMAC_ENABLED
	help
	  Driver for the Analog Devices AXI DMAC core. Provides DMA
	  transfers for AXI-Stream peripherals via the standard Zephyr
	  DMA driver API.
```

## drivers/dma/Kconfig.bcm2835
```kconfig
# Broadcom BCM2835 DMA controller
#
# Copyright (c) 2026 Jonathan Elliot Peace <jep@alphabetiq.com>
# SPDX-License-Identifier: Apache-2.0

config DMA_BCM2835
	bool "Broadcom BCM2835 DMA controller driver"
	default y
	depends on DT_HAS_BRCM_BCM2835_DMA_ENABLED
	select CACHE_MANAGEMENT
	help
	  Driver for the DMA controller of the BCM2835, BCM2710 and BCM2711
	  SoCs. The engine is not cache coherent: the driver cleans its
	  control blocks, callers maintain their data buffers.

if DMA_BCM2835

config DMA_BCM2835_MAX_CBS_PER_CHANNEL
	int "Maximum DMA control blocks per channel"
	default 4
	range 1 32
	help
	  Depth of the control block chain of a channel. Single-block
	  transfers need 1, cyclic rings need more.

endif # DMA_BCM2835
```
