## drivers/display/Kconfig.ssd135x
```kconfig
# SSD1351 and SSD1357 display controller configuration options
# Copyright (c) 2025 MASSDRIVER EI (massdriver.space)
# SPDX-License-Identifier: Apache-2.0

config SSD135X
	bool "SSD135x display controllers driver"
	select MIPI_DBI
	help
	  Enable driver for SSD135x display controllers.

config SSD1351
	bool "SSD1351 display controllers driver"
	default y
	depends on DT_HAS_SOLOMON_SSD1351_ENABLED
	select SSD135X
	help
	  Enable driver for SSD1351 display controller.


config SSD1357
	bool "SSD1357 display controllers driver"
	default y
	depends on DT_HAS_SOLOMON_SSD1357_ENABLED
	select SSD135X
	help
	  Enable driver for SSD1357 display controller.

if SSD135X

config SSD135X_DEFAULT_CONTRAST
	int "SSD135x default contrast"
	default 100
	range 0 255
	help
	  Default contrast.

config SSD135X_CONTRASTA
	int "SSD135x contrast multiplier for seg A"
	default 145
	range 0 255
	help
	  Contrast multiplier for seg A

config SSD135X_CONTRASTB
	int "SSD135x contrast multiplier for seg B"
	default 80
	range 0 255
	help
	  Contrast multiplier for seg B

config SSD135X_CONTRASTC
	int "SSD135x contrast multiplier for seg C"
	default 125
	range 0 255
	help
	  Contrast multiplier for seg C

endif # SSD135X
```

## drivers/display/Kconfig.ssd1363
```kconfig
# SSD1363 display controller configuration options
# Copyright (c) 2025 MASSDRIVER EI (massdriver.space)
# SPDX-License-Identifier: Apache-2.0

menuconfig SSD1363
	bool "SSD1363 display controller driver"
	default y
	depends on DT_HAS_SOLOMON_SSD1363_ENABLED
	select MIPI_DBI if $(dt_compat_on_bus,$(DT_COMPAT_SOLOMON_SSD1363),mipi-dbi)
	select I2C if $(dt_compat_on_bus,$(DT_COMPAT_SOLOMON_SSD1363),i2c)
	help
	  Enable driver for SSD1363 display controller.

if SSD1363

config SSD1363_DEFAULT_CONTRAST
	int "SSD1363 default contrast"
	default 192
	range 0 255
	help
	  SSD1363 default contrast.

config SSD1363_CONV_BUFFER_LINES
	int "How many lines can the conversion buffer hold"
	default 16
	range 1 160

endif # SSD1363
```

## drivers/display/Kconfig.ssd1673
```kconfig
# Kconfig - SSD1673 display controller configuration options

#
# Copyright (c) 2018 Phytec Messtechnik GmbH
#
# SPDX-License-Identifier: Apache-2.0
#

menuconfig SSD1673
	bool "SSD1673 display driver"
	depends on SPI
	help
	  Enable driver for SSD1673 display driver.

if SSD1673

choice
	prompt "EPD display"
	default SSD1673_EPD_GDE0213B1
	help
	  Specify the type of EPD connected to the SSD1673 controller.

config SSD1673_EPD_GDE0213B1
	bool "GDE0213B1 2.13\""

endchoice

endif #SSD1673
```

## drivers/display/Kconfig.st730x
```kconfig
# Copyright (c) 2025 MASSDRIVER EI (massdriver.space)
# SPDX-License-Identifier: Apache-2.0

config ST730X
	bool "ST730x display controllers driver"
	default y
	depends on DT_HAS_SITRONIX_ST7305_ENABLED || DT_HAS_SITRONIX_ST7306_ENABLED
	select MIPI_DBI
	imply DISPLAY_COLOR_PALETTE \
		if $(dt_compat_any_has_prop,$(DT_COMPAT_SITRONIX_ST7306),color-mode,RBW)
	help
	  Enable driver for ST730X series display controllers.

if ST730X

config ST730X_CONV_BUFFER_LINE_CNT
	int "Size of the conversion buffer in lines"
	default 8
	range 1 1024
	help
	  Size of the conversion buffer in lines.

config ST730X_DEFAULT_PALETTED
	bool "ST730X default mode is paletted i4"
	default y if $(dt_compat_any_has_prop,$(DT_COMPAT_SITRONIX_ST7306),color-mode,RBW)
	depends on DT_HAS_SITRONIX_ST7306_ENABLED
	select DISPLAY_COLOR_PALETTE
	help
	  Sets paletted i4 mode as the default color mode

endif # ST730X
```

## drivers/display/Kconfig.st75256
```kconfig
# Copyright (c) 2025 MASSDRIVER EI (massdriver.space)
# SPDX-License-Identifier: Apache-2.0

menuconfig ST75256
	bool "ST75256 display controller"
	default y
	depends on DT_HAS_SITRONIX_ST75256_ENABLED
	select MIPI_DBI
	help
	  Enable driver for ST75256 display controller.

if ST75256

config ST75256_DEFAULT_CONTRAST
	int "ST75256 default contrast"
	default 155
	range 0 255
	help
	  ST75256 default contrast.

config ST75256_DEFAULT_GREYSCALE
	bool "ST75256 default mode is greyscale"
	help
	  Sets greyscale mode as default mode

config ST75256_CONV_BUFFER_LINES
	int "How many lines can the conversion buffer hold"
	default 16
	range 1 162

endif # ST75256
```

## drivers/display/Kconfig.st7528i
```kconfig
# ST7528I display driver configuration options

# Copyright (c) 2023 SILA Embedded Solutions GmbH
# SPDX-License-Identifier: Apache-2.0

config ST7528I
	bool "ST7528I display driver"
	default y
	depends on DT_HAS_SITRONIX_ST7528I_ENABLED
	select I2C
	help
	  Enable driver for ST7528I display driver.
```

## drivers/display/Kconfig.st7565r
```kconfig
# Copyright (c) Giyora Haroon
# SPDX-License-Identifier: Apache-2.0

config ST7565R
	bool "ST7565R display controller driver"
	default y
	depends on DT_HAS_SITRONIX_ST7565R_ENABLED
	select SPI
	select GPIO
	help
	  Enable driver for the ST7565R display controller.
```

## drivers/display/Kconfig.st7567
```kconfig
# Copyright (c) 2025 MASSDRIVER EI (massdriver.space)
# SPDX-License-Identifier: Apache-2.0

menuconfig ST7567
	bool "ST7567 display controller"
	default y
	depends on DT_HAS_SITRONIX_ST7567_ENABLED
	select I2C if $(dt_compat_on_bus,$(DT_COMPAT_SITRONIX_ST7567),i2c)
	select SPI if $(dt_compat_on_bus,$(DT_COMPAT_SITRONIX_ST7567),spi)
	help
	  Enable driver for ST7567 display controller.

if ST7567

config ST7567_DEFAULT_CONTRAST
	int "ST7567 default contrast"
	default 8
	range 0 15
	help
	  ST7567 default contrast.

endif # ST7567
```

## drivers/display/Kconfig.st7586s
```kconfig
# Copyright (c) 2026 MASSDRIVER EI (massdriver.space)
# SPDX-License-Identifier: Apache-2.0

menuconfig ST7586S
	bool "ST7586S display controller"
	default y
	depends on DT_HAS_SITRONIX_ST7586S_ENABLED
	select MIPI_DBI
	help
	  Enable driver for ST7586S display controller.

if ST7586S

config ST7586S_DEFAULT_CONTRAST
	int "ST7586S default contrast"
	default 152
	range 0 255
	help
	  ST7586S default contrast.

config ST7586S_DEFAULT_GRAYSCALE
	bool "ST7586S default mode is grayscale"
	default y
	help
	  Sets greyscale mode as default mode

config ST7586S_CONV_BUFFER_LINES
	int "How many lines can the conversion buffer hold"
	default 16
	range 1 162

endif # ST7586S
```

## drivers/display/Kconfig.st7701
```kconfig
# Copyright (c) 2025 Arduino SA
# SPDX-License-Identifier: Apache-2.0

config ST7701
	bool "ST7701 display controller driver"
	default y
	depends on DT_HAS_SITRONIX_ST7701_ENABLED
	select MIPI_DSI
	help
	  Enable driver for ST7701 display driver.
```

## drivers/display/Kconfig.st7735
```kconfig
# ST7735 display driver configuration options

# Copyright (c) 2019 Marc Reilly <marc@cpdesign.com.au>
# SPDX-License-Identifier: Apache-2.0

menuconfig ST7735
	bool "ST7735 display driver"
	depends on SPI
	help
	  Enable driver for ST7735 display driver.

choice ST7735_PIXEL_FORMAT
	prompt "Color pixel format"
	default ST7735_RGB565
	depends on ST7735
	help
	  Specify the color pixel format for the ST7735 display controller.

config ST7735_RGB888
	bool "RGB888"

config ST7735_RGB565
	bool "RGB565"

endchoice
```

## drivers/display/Kconfig.st7735r
```kconfig
# ST7735R display driver configuration options

# Copyright (c) 2020 Kim Bøndergaard <kim@fam-boendergaard.dk>
# SPDX-License-Identifier: Apache-2.0

config ST7735R
	bool "ST7735R display driver"
	default y
	depends on DT_HAS_SITRONIX_ST7735R_ENABLED
	select SPI
	help
	  Enable driver for ST7735R display driver.
```

## drivers/display/Kconfig.st7789h2_gpio
```kconfig
# ST7789H2 display driver configuration options

# Copyright (c) 2021, Jeremy LOCHE
# SPDX-License-Identifier: Apache-2.0

DT_COMPAT_ST7789H2_GPIO := sitronix,st7789h2-gpio

config ST7789H2_GPIO
	bool "ST7789H2 display driver"
	depends on GPIO
	default $(dt_compat_enabled,$(DT_COMPAT_ST7789H2_GPIO))
	help
	  Enable driver for ST7789H2 display driver.

config ST7789H2_GPIO_PORT_WRITING
	bool "Group data bus writing by GPIO ports"
	default y
	help
	  Allow the driver to group GPIOs that can be set in one shot
	  Requirement: needs to be on the same port and in correct order
	  Example:
	    D0=GPIOD 14
	    D1=GPIOD 15
	    D2=GPIOD 0
	    D3=GPIOD 1
	    D4=GPIOE 8
	    D5=GPIOE 9
	    D6=GPIOE 10
	    D7=GPIOE 11
	    ...
	  The driver will then write the ports in this order:
	    DO,D1 -> GPIOD 14,15
	    D2,D3 -> GPIOD 0,1
	    D4,D5,D6,D7 -> GPIOE 8,9,10,11
	  This will considerably reduce the number of GPIO writing and speed up the parallel bus.
```

## drivers/display/Kconfig.st7789h2_st_fmc
```kconfig
# ST7789H2 display driver configuration options

# Copyright (c) 2022, Jeremy LOCHE
# SPDX-License-Identifier: Apache-2.0

DT_COMPAT_ST7789H2_ST_FMC := sitronix,st7789h2-st-fmc

config ST7789H2_ST_FMC
	bool "ST7789H2 display driver"
	depends on MEMC_STM32_NOR_PSRAM
	default $(dt_compat_enabled,$(DT_COMPAT_ST7789H2_ST_FMC))
	help
	  Enable driver for ST7789H2 display driver using ST FMC peripheral.
```

## drivers/display/Kconfig.st7789v
```kconfig
# ST7789V display driver configuration options

# Copyright (c) 2019 Marc Reilly <marc@cpdesign.com.au>
# SPDX-License-Identifier: Apache-2.0

config ST7789V
	bool "ST7789V display driver"
	default y
	depends on DT_HAS_SITRONIX_ST7789V_ENABLED
	select MIPI_DBI
	help
	  Enable driver for ST7789V display driver.
```

## drivers/display/Kconfig.st7796s
```kconfig
# Copyright 2023 NXP
# SPDX-License-Identifier: Apache-2.0

config ST7796S
	bool "ST7796S display driver"
	default y
	depends on DT_HAS_SITRONIX_ST7796S_ENABLED
	select MIPI_DBI
	help
	  Enable driver for ST7796S display driver.
```

## drivers/display/Kconfig.stm32_ltdc
```kconfig
# STM32 LTDC display driver configuration options

# Copyright (c) 2022 Byte-Lab d.o.o. <dev@byte-lab.com>
# SPDX-License-Identifier: Apache-2.0

menuconfig STM32_LTDC
	bool "STM32 LCD-TFT display controller driver"
	default y
	depends on DT_HAS_ST_STM32_LTDC_ENABLED
	select USE_STM32_HAL_LTDC
	select USE_STM32_HAL_RIF if SOC_SERIES_STM32N6X
	select CACHE_MANAGEMENT if CPU_HAS_DCACHE
	select PINCTRL
	help
	  Enable driver for STM32 LCT-TFT display controller periheral.

if STM32_LTDC

choice STM32_LTDC_PIXEL_FORMAT
	prompt "Color pixel format"
	default STM32_LTDC_RGB565
	depends on STM32_LTDC
	help
	  Specify the color pixel format for the STM32 LCD-TFT display controller.

config STM32_LTDC_ARGB8888
	bool "ARGB8888"
	help
	  One pixel consists of 8-bit alpha, 8-bit red, 8-bit green and 8-bit blue value
	  (4 bytes per pixel)

config STM32_LTDC_RGB888
	bool "RGB888"
	help
	  One pixel consists of 8-bit red, 8-bit green and 8-bit blue value
	  (3 bytes per pixel)

config STM32_LTDC_RGB565
	bool "RGB565"
	help
	  One pixel consists of 5-bit red, 6-bit green and 5-bit blue value
	  (2 bytes per pixel)

endchoice

config STM32_LTDC_FB_NUM
	int "Frame buffer number"
	default 1
	range 0 2
	help
	  STM32 LTDC frame buffer number config:
	    - 0 frame buffer maintained by application, must write with full screen pixels.
	    - 1 single frame buffer in stm32 ltdc driver.
	    - 2 double frame buffer in stm32 ltdc driver.

config STM32_LTDC_FB_USE_SHARED_MULTI_HEAP
	bool "Use shared multi heap for the display buffer"

config STM32_LTDC_DISABLE_FMC_BANK1
	bool "Disable FMC bank1 for STM32F7/H7 series"
	depends on SOC_SERIES_STM32H7X || SOC_SERIES_STM32F7X
	default y
	help
	  Disable FMC bank1 if not used to prevent speculative read accesses.
	  Refer to AN4861 "4.6 Special recommendations for Cortex-M7 (STM32F7/H7)".

endif # STM32_LTDC
```

## drivers/display/Kconfig.stm32ltdc
```kconfig
# Configuration options for STM32 LTDC display

# Copyright (c) 2020 Mark Olsson <mark@markolsson.se>
# SPDX-License-Identifier: Apache-2.0

config LTDC_STM32
	bool "STM32 LTDC driver"
	select USE_STM32_HAL_LTDC
	select USE_STM32_HAL_DMA2D
	select USE_STM32_HAL_DMA
	select USE_STM32_HAL_SDRAM
	select USE_STM32_HAL_CORTEX
	select USE_STM32_LL_FMC
	help
	  Enable STM32 LTDC display driver compliant with display driver API.

config FMC_STM32
	bool "STM32 FMC driver"
	help
	  Enable STM32 FMC driver.
```

## drivers/display/Kconfig.tft
```kconfig
# ILI9XXX display driver configuration options

# Copyright (c) 2017 Jan Van Winkel <jan.van_winkel@dxplore.eu>
# Copyright (c) 2020 Teslabs Engineering S.L.
# Copyright (c) 2021 Krivorot Oleg <krivorot.oleg@gmail.com>
# SPDX-License-Identifier: Apache-2.0

config ILI9XXX
	bool
	help
	  Hidden configuration entry for all ILI9XXX drivers.

config ILI9340
	bool "ILI9340 display driver"
	default y
	depends on DT_HAS_ILITEK_ILI9340_ENABLED
	select MIPI_DBI
	select ILI9XXX
	help
	  Enable driver for ILI9340 display driver.

config ILI9341
	bool "ILI9341 display driver"
	default y
	depends on DT_HAS_ILITEK_ILI9341_ENABLED
	select MIPI_DBI
	select ILI9XXX
	help
	  Enable driver for ILI9341 display driver.

config TFT
	bool "TFT display driver"
	default y

config ILI9342C
	bool "ILI9342C display driver"
	default y
	depends on DT_HAS_ILITEK_ILI9342C_ENABLED
	select MIPI_DBI
	select ILI9XXX
	help
	  Enable driver for ILI9342C display driver.

config ILI9488
	bool "ILI9488 display driver"
	default y
	depends on DT_HAS_ILITEK_ILI9488_ENABLED
	select MIPI_DBI
	select ILI9XXX
	help
	  Enable driver for ILI9488 display driver.
```

## drivers/display/Kconfig.tn0xxx
```kconfig
# Copyright (c) 2023 Alen Daniel
# SPDX-License-Identifier: Apache-2.0

config TN0XXX
	bool "Kyocera TN0XXX memory display controller driver"
	default y
	depends on DT_HAS_KYO_TN0XXX_ENABLED
	select SPI
	help
	  Enable driver for kyocera memory in pixel tft display series TN0XXX
```

## drivers/display/Kconfig.uc81xx
```kconfig
# UC81xx display controller configuration options

# Copyright (c) 2020 Phytec Messtechnik GmbH
# SPDX-License-Identifier: Apache-2.0

config UC81XX
	bool "UltraChip UC81xx compatible display controller driver"
	default y
	depends on DT_HAS_ULTRACHIP_UC8175_ENABLED || DT_HAS_ULTRACHIP_UC8176_ENABLED || DT_HAS_ULTRACHIP_UC8179_ENABLED
	select MIPI_DBI
	help
	  Enable driver for UC81xx compatible controller.
```

## drivers/display/Kconfig.video
```kconfig
# Configuration options for display to video layer

# Copyright (c) 2018 Jan Van Winkel <jan.van_winkel@dxplore.eu>
# SPDX-License-Identifier: Apache-2.0

config VIDEO_DISPLAY
	bool "Add display to video API support"
	depends on VIDEO
	help
	  Enable display to video API support.
```

## drivers/display/Kconfig.waveshare_4p3
```kconfig
# Copyright (c) 2026 Infineon Technologies AG,
# or an affiliate of Infineon Technologies AG.
#
# SPDX-License-Identifier: Apache-2.0

config WAVESHARE_4P3
	bool "Waveshare 4.3in display driver"
	default y
	select I2C
	depends on DT_HAS_WAVESHARE_4P3_ENABLED
	help
	  Enable driver for Waveshare 4.3in display
```

## drivers/display/Kconfig.waveshare_7
```kconfig
# Copyright (c) 2026 Infineon Technologies AG,
# or an affiliate of Infineon Technologies AG.
#
# SPDX-License-Identifier: Apache-2.0

config WAVESHARE_7
	bool "Waveshare 7in display driver"
	default y
	select I2C
	depends on DT_HAS_WAVESHARE_7_ENABLED
	help
	  Enable driver for Waveshare 7in display

if WAVESHARE_7

config WAVESHARE_7_POWER_ON_DELAY_MS
	int "Display module power on delay"
	default 1000
	help
	  This option sets the power on delay time in milliseconds. This will
	  allow time for the display module to power up and initialize itself
	  before any I2C communications are attempted. The default value of
	  1000ms was determined through experimentation with the PSE84 Eval
	  board.

endif # WAVESHARE_7
```

## drivers/display/Kconfig.waveshare_dsi2dpi
```kconfig
# Copyright 2025 NXP
#
# SPDX-License-Identifier: Apache-2.0

config WAVESHARE_DSI2DPI
	bool "Waveshare DSI-to-DPI bridge driver"
	default y
	select MIPI_DSI
	select I2C
	depends on DT_HAS_WAVESHARE_DSI2DPI_ENABLED
	help
	  Enable driver for Waveshare DSI-to-DPI display bridge.
```
