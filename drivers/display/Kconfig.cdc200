## drivers/display/Kconfig.cdc200
```kconfig
# Alif CDC200 display driver configuration options

# Copyright (C) 2024 Alif Semiconductor
# SPDX-License-Identifier: Apache-2.0

config CDC200
	bool "CDC200 driver"
	default y
	depends on DT_HAS_TES_CDC_2_1_ENABLED
	help
	  Enable support for CDC200 driver controller.

if CDC200

config CDC200_INIT_PRIORITY
	int "CDC200 initialization priority"
	default 95
	help
	  Set the initialization priority for the CDC200 driver. Should be
	  later than the display init priority, since the panel needs to
	  initialize first.

config CDC200_DRIVER_FRAMEBUFFER
	bool "CDC200 driver framebuffer"
	default y
	help
	  Allocate dual framebuffers within the driver. Required to support
	  partial writes, but can be disabled in the case of application
	  managed framebuffers

endif # CDC200
```

## drivers/display/Kconfig.esp32_lcd_cam_rgb
```kconfig
# Copyright (c) 2026 Gustavo Reis
# SPDX-License-Identifier: Apache-2.0

menuconfig DISPLAY_ESP32_LCD_CAM_RGB
	bool "ESP32 LCD-CAM parallel RGB display controller"
	default y
	depends on DT_HAS_ESPRESSIF_ESP32_LCD_CAM_RGB_ENABLED
	depends on SOC_SERIES_ESP32S3
	depends on SOC_FAMILY_ESPRESSIF_LCD_CAM
	select SOC_FAMILY_ESPRESSIF_SPIRAM
	select SHARED_MULTI_HEAP
	help
	  Enable driver for the ESP32-S3 LCD_CAM peripheral in parallel RGB
	  (DPI / dot-clock) mode. The controller continuously streams the
	  framebuffer from external PSRAM via GDMA to an RGB TTL panel.

if DISPLAY_ESP32_LCD_CAM_RGB

config DISPLAY_ESP32_LCD_CAM_RGB_FB_NUM
	int "Framebuffers to allocate in the driver"
	default 1
	range 1 2
	help
	  Number of full-screen framebuffers allocated in external PSRAM.
	  When internal SRAM bounce buffers are enabled, a single PSRAM
	  framebuffer is sufficient for tear-free partial updates. Two
	  framebuffers enable page flipping synchronized to VSYNC.

config DISPLAY_ESP32_LCD_CAM_RGB_BOUNCE_BUFFER_LINES
	int "Internal SRAM bounce buffer height in lines (0 to disable)"
	default 16
	range 0 64
	help
	  When greater than 0, allocates two ping-pong bounce buffers of the
	  specified number of horizontal lines in internal DMA-capable SRAM.
	  GDMA streams exclusively from internal SRAM while the bounce-buffer
	  EOF ISR prefetches lines from the PSRAM framebuffer, eliminating
	  LCD FIFO underflow and horizontal drift during PSRAM cache flushes.
	  When set to 0, GDMA streams directly from the PSRAM framebuffer.

config DISPLAY_ESP32_LCD_CAM_RGB_RESTART_IN_VSYNC
	bool "Restart GDMA and reset LCD FIFO on VSYNC"
	default n
	help
	  Reset the LCD async FIFO and restart the GDMA descriptor chain at
	  the beginning of each VSYNC blanking interval when streaming
	  directly from PSRAM without bounce buffers.

endif # DISPLAY_ESP32_LCD_CAM_RGB
```

## drivers/display/Kconfig.ili98xx_dsi
```kconfig
# SPDX-FileCopyrightText: 2026 Renesas Electronics Corporation
# SPDX-License-Identifier: Apache-2.0

config ILI98XX_DSI
	bool "ILI98xx DSI display driver"
	default y
	depends on DT_HAS_ILITEK_ILI9806E_ENABLED || DT_HAS_ILITEK_ILI9881C_ENABLED
	select MIPI_DSI
	select GPIO if $(dt_compat_any_has_prop,$(DT_COMPAT_ILITEK_ILI9806E),reset-gpios) || \
		$(dt_compat_any_has_prop,$(DT_COMPAT_ILITEK_ILI9806E),bl-gpios) || \
		$(dt_compat_any_has_prop,$(DT_COMPAT_ILITEK_ILI9881C),reset-gpios) || \
		$(dt_compat_any_has_prop,$(DT_COMPAT_ILITEK_ILI9881C),bl-gpios)
	help
	  Enable driver for ILI9806E_DSI display driver.
```

## drivers/display/Kconfig.mcux_lcdc
```kconfig
# SPDX-FileCopyrightText: Copyright The Zephyr Project Contributors
# SPDX-License-Identifier: Apache-2.0

config DISPLAY_MCUX_LCDC
	bool "MCUX LPC LCDC driver"
	default y
	depends on DT_HAS_NXP_LPC_LCDC_ENABLED
	select PINCTRL
	select GPIO if $(dt_compat_any_has_prop,$(DT_COMPAT_NXP_LPC_LCDC),backlight-gpios)
	select PWM if $(dt_compat_any_has_prop,$(DT_COMPAT_NXP_LPC_LCDC),pwms)
	help
	  Enable support for the NXP LPC LCD controller (LCDC). The driver keeps
	  two full-screen framebuffers in the devicetree memory-region, copies
	  each write into the one that is not on screen and swaps them at the
	  next vertical blank.
```

## drivers/dma/Kconfig.ti_am62l_bcdma
```kconfig
# SPDX-FileCopyrightText: Copyright The Zephyr Project Contributors
# SPDX-License-Identifier: Apache-2.0

config DMA_TI_AM62L_BCDMA
	bool "TI AM62L BCDMA driver"
	default y
	depends on DT_HAS_TI_AM62L_BCDMA_ENABLED
	depends on DCACHE
	select DMA_64BIT
	select CACHE_MANAGEMENT
	help
	  Driver for the Block Copy DMA (BCDMA) of the TI AM62L main DMSS.
	  Supports memory to memory transfers on the block-copy channels.
	  The driver keeps its own descriptors and rings coherent; callers
	  maintain the cache for their data buffers unless the channel uses
	  ASEL 14 or 15 (ACP).

if DMA_TI_AM62L_BCDMA

config DMA_TI_AM62L_BCDMA_MEMCPY_CHANNELS
	int "Block-copy channels with descriptor memory"
	default 2
	range 1 16
	help
	  Number of block-copy channels, starting at channel 128, that get
	  ring and descriptor memory. Each costs RING_SIZE descriptors of
	  about 64 bytes per TR plus 64.

config DMA_TI_AM62L_BCDMA_RING_SIZE
	int "Descriptors per channel"
	default 8
	range 8 64
	help
	  Ring entries and descriptors of one channel: how many transfers,
	  from dma_config() and dma_reload(), a channel can hold queued.
	  Must be a power of two.

config DMA_TI_AM62L_BCDMA_MAX_TR
	int "Transfer requests per descriptor"
	default 8
	range 1 64
	help
	  Largest number of TRs in one descriptor. A block takes one TR, or
	  two when it is larger than 64 KiB and not a multiple of 32 KiB, so
	  this bounds the block count of one dma_config().

endif # DMA_TI_AM62L_BCDMA
```

## drivers/edac/Kconfig.ti_k3_ecc_aggr
```kconfig
# Copyright (c) 2026 BeagleBoard.org Foundation
# SPDX-License-Identifier: Apache-2.0

config EDAC_TI_K3_ECC_AGGR
	bool "TI K3 ECC Aggregator EDAC driver"
	default y
	depends on DT_HAS_TI_K3_ECC_AGGR_ENABLED
	help
	  EDAC back-end for the TI K3 ECC Aggregator (SEC/DED status, counts,
	  and optional interrupt notification).
```

## drivers/eeprom/Kconfig.mcux_lpc546xx
```kconfig
# SPDX-FileCopyrightText: Copyright The Zephyr Project Contributors
# SPDX-License-Identifier: Apache-2.0

config EEPROM_MCUX_LPC546XX
	bool "NXP LPC546xx on-chip EEPROM driver"
	default y
	depends on DT_HAS_NXP_LPC546XX_EEPROM_ENABLED
	select RESET
	help
	  Enable the driver for the on-chip EEPROM controller of the NXP
	  LPC546xx.
```

## drivers/entropy/Kconfig.aspeed
```kconfig
# Copyright (c) 2026 ASPEED Technology Inc.
# SPDX-License-Identifier: Apache-2.0

config ENTROPY_ASPEED_HWRNG
	bool "ASPEED HWRNG entropy driver"
	default y
	depends on DT_HAS_ASPEED_HWRNG_ENABLED
	select ENTROPY_HAS_DRIVER
	help
	  Enable the driver for the hardware random number generator in the
	  ASPEED SCU, a control and a data register.
```

## drivers/entropy/Kconfig.psa_crypto
```kconfig
# Copyright (c) 2022 Nordic Semiconductor ASA
# SPDX-License-Identifier: Apache-2.0

# PSA Crypto Random source configuration options

DT_CHOSEN_Z_ENTROPY := zephyr,entropy

config ENTROPY_PSA_CRYPTO_RNG
	bool "PSA Crypto Random source Entropy driver"
	depends on DT_HAS_ZEPHYR_PSA_CRYPTO_RNG_ENABLED
	depends on PSA_CRYPTO
	depends on !(PSA_CRYPTO_PROVIDER_MBEDTLS && TF_PSA_CRYPTO_BUILTIN && MBEDTLS_BUILTIN && \
		$(dt_chosen_has_compat,$(DT_CHOSEN_Z_ENTROPY),$(DT_COMPAT_ZEPHYR_PSA_CRYPTO_RNG)))
	select ENTROPY_HAS_DRIVER
	default y
	help
	  Enable the PSA Crypto source Entropy driver.
```

## drivers/entropy/Kconfig.rts5817
```kconfig
# Copyright (c) 2026 Realtek Semiconductor, Inc.
# SPDX-License-Identifier: Apache-2.0

config ENTROPY_RTS5817
	bool "RTS5817 Entropy Controller Driver"
	depends on DT_HAS_REALTEK_RTS5817_TRNG_ENABLED
	depends on OTP
	select ENTROPY_HAS_DRIVER
	default y
	help
	  Enable the RTS5817 true random number generator driver.
```

## drivers/entropy/Kconfig.safexcel_eip76
```kconfig
# SPDX-FileCopyrightText: Copyright The Zephyr Project Contributors
# SPDX-License-Identifier: Apache-2.0

config ENTROPY_SAFEXCEL_EIP76
	bool "Inside Secure SafeXcel EIP-76 TRNG driver"
	default y
	depends on DT_HAS_INSIDE_SECURE_SAFEXCEL_EIP76_ENABLED
	select ENTROPY_HAS_DRIVER
	help
	  Enable the polled driver for the Inside Secure SafeXcel EIP-76(d)
	  true random number generator, used as the TRNG on TI AM62L.
	  If boot firmware or the secure world has already started the core,
	  its configuration is kept and the driver only reads output blocks.
```

## drivers/ethernet/Kconfig
```kconfig
# Ethernet drivers configuration options

# Copyright (c) 2015 Intel Corporation
# SPDX-License-Identifier: Apache-2.0

menuconfig ETH_DRIVER
	bool "Ethernet drivers"
	depends on NETWORKING
	depends on !NET_TEST

if ETH_DRIVER

config ETH_DRIVER_RAW_MODE
	bool "Ethernet driver without the MAC stack"
	select NET_RAW_MODE
	depends on !NET_L2_ETHERNET
	help
	  This option enables using the drivers in a so-called "raw" mode,
	  i.e. without a MAC stack (the net L2 layer for ethernet will not
	  be built).

module = ETHERNET
module-dep = LOG
module-str = Log level for Ethernet driver
module-help = Sets log level for Ethernet Device Drivers.
source "subsys/net/Kconfig.template.log_config.net"

config ETH_QEMU_IFACE_NAME
	string "Network interface name for QEMU"
	default "zeth"
	depends on NET_QEMU_ETHERNET
	help
	  The network interface name for QEMU. This value is given as
	  a parameter to -netdev qemu command line option. The network
	  interface must be created before starting QEMU. The net-setup.sh
	  script from net-tools project can be used to create the network
	  interface.

config ETH_QEMU_EXTRA_ARGS
	string "Extra arguments to QEMU -netdev option"
	depends on NET_QEMU_ETHERNET
	default ""
	help
	  Extra arguments passed to QEMU -netdev option when Ethernet Networking
	  is enabled. This option can contain multiple QEMU option
	  arguments. Each QEMU argument must be separated by comma "," and no
	  spaces between arguments. Example: "script=no" or
	  "script=no,downscript=no".
	  See https://www.qemu.org/docs/master/system/invocation.html#hxtool-5
	  for the available options.

config ETH_NIC_MODEL_ONBOARD
	bool
	help
	  Selected by drivers whose QEMU NIC model (ETH_NIC_MODEL) is built
	  into the emulated machine. Such a NIC cannot be created with the
	  QEMU -device option, so it is configured with -nic instead.

# zephyr-keep-sorted-start
rsource "Kconfig.adin1140"
rsource "Kconfig.adin2111"
rsource "Kconfig.bcmgenet"
rsource "Kconfig.cyclonev"
rsource "Kconfig.dm9051"
rsource "Kconfig.e1000"
rsource "Kconfig.enc28j60"
rsource "Kconfig.enc424j600"
rsource "Kconfig.esp32"
rsource "Kconfig.gecko"
rsource "Kconfig.ivshmem"
rsource "Kconfig.lan865x"
rsource "Kconfig.lan9250"
rsource "Kconfig.litex"
rsource "Kconfig.mchp"
rsource "Kconfig.native_tap"
rsource "Kconfig.nxp_enet"
rsource "Kconfig.nxp_s32_gmac"
rsource "Kconfig.nxp_s32_netc"
rsource "Kconfig.renesas_ra"
rsource "Kconfig.renesas_ra_rmac"
rsource "Kconfig.sam_gmac"
rsource "Kconfig.smsc911x"
rsource "Kconfig.smsc91x"
rsource "Kconfig.stellaris"
rsource "Kconfig.stm32_hal"
rsource "Kconfig.sy1xx_mac"
rsource "Kconfig.test"
rsource "Kconfig.virtio_net"
rsource "Kconfig.wch"
rsource "Kconfig.xilinx_axi_ethernet_lite"
rsource "Kconfig.xilinx_axienet"
rsource "Kconfig.xlnx_gem"
rsource "Kconfig.xmc4xxx"
rsource "dsa/Kconfig"
rsource "dwc_mac/Kconfig"
rsource "dwc_xgmac/Kconfig"
rsource "eth_nxp_enet_qos/Kconfig"
rsource "intel/Kconfig"
rsource "nxp_imx_netc/Kconfig"
rsource "offload/Kconfig"
rsource "phy/Kconfig"
rsource "wiznet/Kconfig"
# zephyr-keep-sorted-stop

endif # "Ethernet Drivers"

config ETH_INIT_PRIORITY
	int "Ethernet driver init priority"
	default 60
	depends on NET_L2_ETHERNET || ETH_DRIVER || MDIO
	help
	  Ethernet device driver initialization priority.
	  Do not mess with it unless you know what you are doing.
	  Note that the priority needs to be lower than the net stack
	  so that it can start before the networking sub-system.

config ETH_NET_IF_NO_AUTO_START
	bool "Disable Ethernet interface auto-start"
	depends on NET_L2_ETHERNET || ETH_DRIVER
	help
	  This option allows user to set any configuration before the interface
	  becomes operational. For instance, the MAC address can be configured using
	  net_if_set_link_addr(iface, mac, 6, NET_LINK_ETHERNET).
	  When all configurations are done net_if_up() has to be invoked to
	  bring the interface up.

rsource "mdio/Kconfig"
```

## drivers/ethernet/dsa/Kconfig.renesas_ra
```kconfig
# Copyright The Zephyr Project Contributors
# SPDX-License-Identifier: Apache-2.0

config DSA_RENESAS_RA_ESWM
	bool "Renesas RA ESWM DSA driver"
	default y
	depends on DT_HAS_RENESAS_RA_ESWM_DSA_ENABLED
	depends on DT_HAS_RENESAS_RA_ESWM_SWITCH_ENABLED
	depends on NET_DSA
	select ETH_PHY_DRIVER
	select USE_RA_FSP_RMAC
	select USE_RA_FSP_LAYER3_SWITCH
	select NOCACHE_MEMORY if ARCH_HAS_NOCACHE_MEMORY_SUPPORT
	help
	  DSA driver for the Renesas RA Ethernet Switch Module (ESWM). Each
	  Ethernet port is a DSA user port, and the ESWM node is the conduit.

if DSA_RENESAS_RA_ESWM

config DSA_RENESAS_RA_ESWM_RX_THREAD_STACK_SIZE
	int "RX thread stack size"
	default 1500
	help
	  Stack size of the RX thread of each user port.

config DSA_RENESAS_RA_ESWM_RX_THREAD_PRIORITY
	int "RX thread priority"
	default 2
	help
	  Cooperative priority of the RX thread of each user port.

config DSA_RENESAS_RA_ESWM_USE_HW_WRITEBACK
	bool "Wait for the TX descriptor write back"
	default y
	help
	  Wait until the hardware writes back the TX descriptor, so a send
	  returns only when the frame was transmitted. Sending takes slightly
	  longer.

config DSA_RENESAS_RA_ESWM_TX_QUEUE_NUM
	int "TX queues per port"
	default 2
	range 1 8

config DSA_RENESAS_RA_ESWM_RX_QUEUE_NUM
	int "RX queues per port"
	default 2
	range 1 8

config DSA_RENESAS_RA_ESWM_TX_QUEUE_LEN
	int "Descriptors per TX queue"
	default 4
	range 2 64
	help
	  Number of descriptors in each TX queue, including the LINKFIX
	  descriptor.

config DSA_RENESAS_RA_ESWM_RX_QUEUE_LEN
	int "Descriptors per RX queue"
	default 4
	range 2 64
	help
	  Number of descriptors in each RX queue, including the LINKFIX
	  descriptor.

config DSA_RENESAS_RA_ESWM_TX_BUF_NUM
	int "TX buffers per port"
	default 12
	range 1 64

config DSA_RENESAS_RA_ESWM_RX_BUF_NUM
	int "RX buffers per port"
	default 12
	range 1 64

endif # DSA_RENESAS_RA_ESWM
```

## drivers/flash/Kconfig.alif
```kconfig
# Copyright (c) 2025 Alif Semiconductor
# SPDX-License-Identifier: Apache-2.0

config FLASH_ALIF_MRAM
	bool "Alif MRAM flash driver"
	default y
	depends on DT_HAS_ALIF_MRAM_FLASH_CONTROLLER_ENABLED
	depends on CPU_CORTEX_M
	select FLASH_HAS_DRIVER_ENABLED
	select FLASH_HAS_PAGE_LAYOUT
	select FLASH_HAS_NO_EXPLICIT_ERASE
	help
	  Enable the flash driver for the on-chip MRAM of Alif SoCs.

	  MRAM is programmed in 128-bit words and needs no erase before a
	  write. The writable part of MRAM must be mapped as Device memory
	  in the MPU.
```

## drivers/flash/Kconfig.it51xxx_m1k
```kconfig
# Copyright (c) 2025 ITE Corporation. All Rights Reserved.
# SPDX-License-Identifier: Apache-2.0

config SOC_FLASH_ITE_IT51XXX_M1K
	bool "ITE IT51XXX manual flash 1k driver"
	default y
	depends on DT_HAS_ITE_IT51XXX_MANUAL_FLASH_1K_ENABLED
	select FLASH_HAS_PAGE_LAYOUT
	select FLASH_HAS_DRIVER_ENABLED
	select PINCTRL
	select FLASH_HAS_EX_OP
	help
	  The flash M1K driver supports read (up to 1K), write (1K), and erase (4K)
	  operations. Accessible flash regions include internal e-Flash or external
	  SPI flash via FSCE# or FSCE1#

if SOC_FLASH_ITE_IT51XXX_M1K

config FLASH_IT51XXX_M1K_SHARED_REGS
	bool
	default y if SOC_IT51526AW || SOC_IT51526BW
	help
	  The M1K engine shares lower bound address registers between program and
	  erase operations. These variants also use a two-bit read command field.

endif # SOC_FLASH_ITE_IT51XXX_M1K
```
