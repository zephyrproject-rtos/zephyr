## drivers/gpio/Kconfig.cyw43_rpi_pico
```kconfig
# Copyright (c) 2026 Igalia
# SPDX-License-Identifier: Apache-2.0

config GPIO_CYW43_RPI_PICO
	bool "Infineon CYW43 GPIO driver based on hal_rpi_pico cyw43 wifi driver"
	default y
	depends on DT_HAS_INFINEON_CYW43_GPIO_ENABLED
	depends on !WIFI_AIROC
	help
	  Enable GPIO driver for the Infineon CYW43 WiFi chip, based on
	  the hal_rpi_pico cyw43 driver.

if GPIO_CYW43_RPI_PICO

config GPIO_CYW43_RPI_PICO_INIT_PRIORITY
	int "CYW43 GPIO initialization priority"
	default 82
	help
	  CYW43 GPIO initialization priority. Must be higher than
	  the WiFi driver initialization priority.

endif
```

## drivers/gpio/Kconfig.mchp
```kconfig
# SPDX-FileCopyrightText: Copyright (c) 2025-2026 Microchip Technology Inc.
# SPDX-License-Identifier: Apache-2.0

config GPIO_MCHP_PORT_G1
	bool "Microchip PORT G1 GPIO driver"
	default y
	depends on DT_HAS_MICROCHIP_PORT_G1_GPIO_ENABLED
	help
	  This option enables GPIO driver for group (g1) of PORT peripherals.

config GPIO_MCHP_GPIO_G1
	bool "Microchip GPIO G1 GPIO driver"
	default y
	depends on DT_HAS_MICROCHIP_GPIO_G1_GPIO_ENABLED
	help
	  This option enables GPIO driver for group (g1) of GPIO peripherals.
```
