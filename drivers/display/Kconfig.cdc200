## drivers/flash/Kconfig.nand
```kconfig
# Copyright (c) 2025 Embeint Pty Ltd
#
# SPDX-License-Identifier: Apache-2.0

DT_SPI_NAND_HAS_WP := $(dt_compat_any_has_prop,$(DT_COMPAT_JEDEC_SPI_NAND),wp-gpios)
DT_SPI_NAND_HAS_HOLD := $(dt_compat_any_has_prop,$(DT_COMPAT_JEDEC_SPI_NAND),hold-gpios)

menuconfig SPI_NAND
	bool "SPI NAND Flash"
	default y
	depends on DT_HAS_JEDEC_SPI_NAND_ENABLED
	select FLASH_HAS_DRIVER_ENABLED
	select FLASH_HAS_EXPLICIT_ERASE
	select FLASH_HAS_PAGE_LAYOUT
	select FLASH_HAS_EX_OP
	select SPI
	select CRC
	select GPIO if $(DT_SPI_NAND_HAS_WP) || $(DT_SPI_NAND_HAS_HOLD)

if SPI_NAND

config SPI_NAND_INIT_PRIORITY
	int "Init priority"
	default 80
	help
	  Device driver initialization priority. Device is connected to
	  SPI bus, it has to be initialized after SPI driver.

config SPI_NAND_BAD_BLOCK_CACHE
	bool "Bad block cache"
	depends on FLASH_EX_OP_ENABLED
	default y
	help
	  Enable bad block cache by keeping a bad block table in memory.
	  This will speed up bad block checking at the cost of slightly
	  increased memory usage.

endif # SPI_NAND
```

## drivers/flash/Kconfig.nrf
```kconfig
# SPDX-License-Identifier: Apache-2.0

config FLASH_NRF_FORCE_ALT
	bool
	depends on SOC_COMPATIBLE_NRF
	help
	  This option can be enabled to force an alternative implementation
	  of the flash driver.

menuconfig SOC_FLASH_NRF
	bool "Nordic Semiconductor nRF flash driver"
	default y
	depends on DT_HAS_NORDIC_NRF51_FLASH_CONTROLLER_ENABLED || \
		   DT_HAS_NORDIC_NRF52_FLASH_CONTROLLER_ENABLED || \
		   DT_HAS_NORDIC_NRF53_FLASH_CONTROLLER_ENABLED || \
		   DT_HAS_NORDIC_NRF91_FLASH_CONTROLLER_ENABLED
	depends on !FLASH_NRF_FORCE_ALT
	select FLASH_HAS_PAGE_LAYOUT
	select FLASH_HAS_DRIVER_ENABLED
	select FLASH_HAS_EXPLICIT_ERASE
	select NRFX_NVMC
	select MPU_ALLOW_FLASH_WRITE if ARM_MPU
	help
	  Enables Nordic Semiconductor nRF flash driver.

if SOC_FLASH_NRF

rsource "Kconfig.nrf_radio_sync"

config SOC_FLASH_NRF_CUSTOM_CONTEXT
	bool "Nordic nRFx flash driver operation custom context"
	depends on SOC_COMPATIBLE_NRF
	help
	  Enable pointer to custom context, for drivers that need to store additional data,
	  not covered by the structure.

config SOC_FLASH_NRF_PARTIAL_ERASE
	bool "Nordic nRFx flash driver partial erase"
	depends on HAS_HW_NRF_NVMC_PE
	help
	  Enable partial erase feature. Partial erase is performed in time
	  slices instead of blocking MCU, for the time it is needed to
	  complete operation over given area.
	  This allows interrupting flash erase between operations
	  to perform other task by MCU.
	  This feature may also be used for better syncing flash erase
	  operations, when compiled with SOC_FLASH_NRF_RADIO_SYNC_TICKER,
	  with Bluetooth.

config SOC_FLASH_NRF_PARTIAL_ERASE_MS
	int "Partial erase timeout in MS"
	depends on SOC_FLASH_NRF_PARTIAL_ERASE
	default 3
	help
	  This is maximum time, in ms, that NVMC will use to erase part
	  of Flash, before stopping to let CPU resume operation.
	  Minimal timeout is 2ms maximum should not exceed half of
	  FLASH_PAGE_ERASE_MAX_TIME_US im ms.

config SOC_FLASH_NRF_UICR
	bool "Access to UICR"
	depends on !TRUSTED_EXECUTION_NONSECURE
	help
	  Enable operations on UICR. Once enabled UICR are written or read as
	  ordinary flash memory. Erase is possible for whole UICR at once.

config SOC_FLASH_NRF_EMULATE_ONE_BYTE_WRITE_ACCESS
	bool "8-bit write block size emulation"
	help
	  When this option is enabled writing chunks less than minimal write
	  block size parameter (imposed by manufacturer) is possible but operation
	  is more complex and requires basic user knowledge about NVMC controller.

endif # SOC_FLASH_NRF
```

## drivers/flash/Kconfig.nrf_mram
```kconfig
#
# Copyright (c) 2024 Nordic Semiconductor ASA
#
# SPDX-License-Identifier: Apache-2.0
#

config SOC_FLASH_NRF_MRAM
	bool "Nordic Semiconductor flash driver for MRAM"
	default y
	depends on DT_HAS_NORDIC_MRAM_ENABLED
	depends on HAS_NRFX
	depends on !RISCV_CORE_NORDIC_VPR
	select FLASH_HAS_DRIVER_ENABLED
	select FLASH_HAS_PAGE_LAYOUT
	select FLASH_HAS_NO_EXPLICIT_ERASE
	imply NRFS
	imply MRAM_LATENCY
	imply MPU_ALLOW_FLASH_WRITE if ARM_MPU
	help
	  Enables Nordic Semiconductor flash driver for MRAM in direct write mode.

	  Note that MRAM words are auto-erased when written to, but writing to a
	  pre-erased area is faster. Hence, the erase API is not required, but
	  it can be used to amortize write performance for some use cases.

config NRF_MRAM_MAX_RETRIES
	int "Maximum number of retries for MRAM write/erase operations"
	default 20
	range 1 255
	depends on SOC_FLASH_NRF_MRAM
	help
	  This option sets the maximum number of retry attempts for MRAM
	  write and erase operations when verification fails. Each retry
	  attempts to rewrite or re-erase the data to ensure reliability.
	  Higher values increase reliability but may impact performance
	  in case of persistent failures.

if SOC_FLASH_NRF_MRAM

DT_PROP_NORDIC_MUTEXES := nordic,mutexes

config NRF_MRAM_USE_MUTEX_HW
	bool "Use hardware mutexes to serialize MRAM access across CPU domains"
	default y
	depends on $(dt_compat_any_has_prop,$(DT_COMPAT_NORDIC_MRAM_BANK),$(DT_PROP_NORDIC_MUTEXES))
	help
	  When enabled, the driver claims a per-bank hardware mutex around each
	  MRAM write and erase transaction, using the controller's
	  "nordic,mutexes" property of each "nordic,mram-bank" node.

config NRF_MRAM_MUTEX_HW_TIMEOUT_US
	int "Hardware mutex acquisition timeout in microseconds"
	default 10000
	range 1 2147483647
	depends on NRF_MRAM_USE_MUTEX_HW
	help
	  Time to wait for the hardware mutex of an MRAM bank before a write
	  or erase gives up and fails with -ETIMEDOUT.

endif # SOC_FLASH_NRF_MRAM
```

## drivers/flash/Kconfig.nrf_radio_sync
```kconfig
#
# Copyright (c) 2026 Nordic Semiconductor ASA
#
# SPDX-License-Identifier: Apache-2.0
#

# Shared by the Nordic flash drivers that can run their writes
# in the execution windows of a sync backend, see soc_flash_nrf.h.

choice SOC_FLASH_NRF_RADIO_SYNC_CHOICE
	prompt "Nordic nRFx flash driver synchronization"
	default SOC_FLASH_NRF_RADIO_SYNC_TICKER if BT_LL_SW_SPLIT
	default SOC_FLASH_NRF_RADIO_SYNC_NONE
	help
	  synchronization between flash memory driver and radio.

config SOC_FLASH_NRF_RADIO_SYNC_TICKER
	bool "Nordic nRFx flash driver synchronized with radio"
	depends on BT_LL_SW_SPLIT
	help
	  Enable synchronization between flash memory driver and radio using
	  Bluetooth LE LL controller ticker API.

config SOC_FLASH_NRF_RADIO_SYNC_NONE
	bool "none"
	help
	  disable synchronization between flash memory driver and radio.

endchoice # SOC_FLASH_NRF_RADIO_SYNC_CHOICE

if !SOC_FLASH_NRF_RADIO_SYNC_NONE

config SOC_FLASH_NRF_TIMEOUT_MULTIPLIER
	int "Multiplier for flash operation timeouts [x0.1]"
	default 15 if SOC_FLASH_NRF_RRAM || \
		(SOC_FLASH_NRF && SOC_FLASH_NRF_PARTIAL_ERASE && SOC_FLASH_NRF_RADIO_SYNC_TICKER)
	default 10 if SOC_FLASH_NRF
	help
	  This is a multiplier that will be divided by 10 that is applied
	  to the flash erase and write operations timeout. The base for
	  the multiplication would allow erasing all nRF flash pages in
	  blocking mode.

endif # !SOC_FLASH_NRF_RADIO_SYNC_NONE
```

## drivers/flash/Kconfig.nrf_rram
```kconfig
#
# Copyright (c) 2024 Nordic Semiconductor ASA
#
# SPDX-License-Identifier: Apache-2.0
#

menuconfig SOC_FLASH_NRF_RRAM
	bool "Nordic Semiconductor flash driver for nRF RRAM"
	default y
	depends on DT_HAS_NORDIC_RRAM_CONTROLLER_ENABLED
	select NRFX_RRAMC if !TRUSTED_EXECUTION_NONSECURE
	select FLASH_HAS_DRIVER_ENABLED
	select FLASH_HAS_DRIVER_FILL
	select FLASH_HAS_PAGE_LAYOUT
	select FLASH_HAS_NO_EXPLICIT_ERASE
	select FLASH_NRF_FORCE_ALT
	select MPU_ALLOW_FLASH_WRITE if ARM_MPU
	help
	  Enables Nordic Semiconductor flash driver for nRF RRAM controllers.
	  The entire contiguous block of RRAM gets logically divided into pages,
	  but partial erase is always supported.

if SOC_FLASH_NRF_RRAM

rsource "Kconfig.nrf_radio_sync"

config NRF_RRAM_WRITE_BUFFER_SIZE
	int "Internal write-buffer size"
	default 32 if SOC_FLASH_NRF_RADIO_SYNC_NONE
	default 1
	range 0 32
	help
	  Number of 128-bit words.
	  Maximum buffer size can be configured to the value of 32 (128-bit words).
	  Set 0 to disable write-buffer.

config NRF_RRAM_READYNEXT_TIMEOUT_VALUE
	int "Preload timeout value for waiting for a next write in RRAMC clock cycles"
	default 128
	range 0 4095
	help
	  Set 0 to disable ready next timeout counter.

config SOC_FLASH_NRF_THROTTLING
	bool "Nordic nRFx throttling for flash write operations"
	help
	  Enable throttling for flash write operations to avoid overloading the
	  flash memory controller.

config NRF_RRAM_REGION_ADDRESS_RESOLUTION
	hex
	default 0x400
	help
	  RRAMC's region protection address resolution.
	  Applies to region with configurable start address.

config NRF_RRAM_REGION_SIZE_UNIT
	hex
	default 0x400
	help
	  Base unit for the size of RRAMC's region protection.

config NRF_RRAM_THROTTLING_DELAY
	int "Delay between flash write operations"
	depends on SOC_FLASH_NRF_THROTTLING
	default 2000
	help
	  This is the delay (in microseconds) between consecutive flash write
	  operations when throttling is enabled.

config NRF_RRAM_THROTTLING_DATA_BLOCK
	int "Number of Data blocks for each flash write operations"
	depends on SOC_FLASH_NRF_THROTTLING
	default 16
	help
	  This is the number of data blocks (in number of 128-bit words) for flash write
	  operations when throttling is enabled.

config NRF_RRAM_FILL_SKIP_IF_FILLED
	bool "Skip writing fill value to lines that already hold it"
	help
	  When enabled, the api->fill callback (used by flash_fill() and,
	  transitively, flash_flatten() on no-erase devices) scans the target
	  region in 16-byte write-line granularity and only writes lines that
	  currently hold something different from the requested fill value.
	  Consecutive dirty lines are batched into a single underlying write.
	  The optimisation applies for any fill value, including but not
	  limited to the device ERASE_VALUE.

	  Useful for upper layers that reflexively re-fill already-uniform
	  regions (e.g. NVS / ZMS sector rotation, MCUboot re-flattening
	  previously scrambled slots, FCB GC, settings housekeeping).
	  Significantly improves write endurance in those workloads at the
	  cost of a few microseconds of memory-mapped read scan per page.

	  Disabled by default because it changes the worst-case latency profile
	  of fill operations.

	  NOTE: Feature does not protect against simultaneous writes to the
	  scanned area.

endif # SOC_FLASH_NRF_RRAM
```

## drivers/flash/Kconfig.rpi_pico
```kconfig
# Copyright (c) 2022 Yonatan Schachter
#
# SPDX-License-Identifier: Apache-2.0

config FLASH_RPI_PICO
	bool "Raspberry Pi Pico flash driver"
	default y if !SMP || MP_MAX_NUM_CPUS = 1 || RPI_PICO_SMP_FLASH_PARK
	depends on DT_HAS_RASPBERRYPI_PICO_FLASH_CONTROLLER_ENABLED
	select FLASH_HAS_DRIVER_ENABLED
	select FLASH_HAS_PAGE_LAYOUT
	select FLASH_HAS_EXPLICIT_ERASE
	select PICOSDK_USE_FLASH
	help
	  Enable Raspberry Pi Pico flash driver.

	  With SMP on more than one CPU the other core keeps executing from flash
	  while the flash is being written or erased, so the driver needs the SoC
	  to park it in RAM (RPI_PICO_SMP_FLASH_PARK) and the build fails without
	  it. The other core is parked for each page written and each erase unit.
	  Writing and erasing are then only possible from threads, not from
	  interrupt handlers (they return -EWOULDBLOCK), and when the other core
	  cannot be parked in time (-EBUSY) a write or erase may have been done in
	  part. With SMP on one CPU the driver works as without SMP.

config FLASH_RPI_PICO_READ_UNTRANSLATED
	bool "Use untranslated window for flash reads"
	depends on FLASH_RPI_PICO
	depends on SOC_SERIES_RP2350
	help
	  Bypass XIP cache and address translation hardware when reading from flash.

config FLASH_RPI_PICO_LOCK_IRQS
	bool "Lock IRQs during write and erase"
	depends on FLASH_RPI_PICO
	default y if XIP
	help
	  Disable interrupts while the pico-sdk write and erase routines run. The
	  vector table and any handler in flash are unreachable during that window,
	  so this is required whenever the application executes from flash. A
	  RAM-linked application only needs it if an interrupt handler reads a
	  memory-mapped flash partition.

	  With SMP this option has no effect: the calling core always has its
	  interrupts locked while the other core is parked
	  (RPI_PICO_SMP_FLASH_PARK).

choice RPI_PICO_SMP_FLASH_PARK_ERASE_UNIT
	prompt "Erase unit between which the other core is released"
	default RPI_PICO_SMP_FLASH_PARK_ERASE_SECTOR
	depends on FLASH_RPI_PICO && SMP
	help
	  The other core is parked while one unit is erased. A smaller unit
	  stops both cores for a shorter time, a larger one erases a big area
	  in less total time.

config RPI_PICO_SMP_FLASH_PARK_ERASE_SECTOR
	bool "Sector (4 KiB)"
	help
	  Park for one sector erase at a time, typically about 45 ms.

config RPI_PICO_SMP_FLASH_PARK_ERASE_BLOCK
	bool "Block (64 KiB) where aligned"
	help
	  Park for one 64 KiB block erase at a time where the range allows it,
	  typically about 150 ms and up to 2 s. The ends of an unaligned range
	  are still erased sector by sector.

endchoice

config RPI_PICO_SMP_FLASH_PARK_GAP_US
	int "Pause between two parked units of one write or erase (microseconds)"
	default 300
	range 0 10000
	depends on FLASH_RPI_PICO && SMP
	help
	  Between two pages of a write, and between two erase units of an erase,
	  the calling thread sleeps for this time with the other core running.
	  Core 0 takes the interrupts that came in while it was stopped (the
	  system timer among them, and only core 0 receives them), and a thread
	  of the other core that was woken by them gets to run before the other
	  core is parked again. Without it a thread there that sleeps and polls
	  (a data acquisition thread, for example) may get no time during a long
	  erase made of many units, even though the core runs between the units.

	  The value is rounded up to the system tick. Every unit of a call but
	  the last adds this time to the duration of the call. 0 does not pause.
```

## drivers/flash/Kconfig.rts5817
```kconfig
# Copyright (c) 2026 Realtek Semiconductor, Inc.
# SPDX-License-Identifier: Apache-2.0

config FLASH_RTS5817_QSPI
	bool "RTS5817 flash driver"
	depends on DT_HAS_REALTEK_RTS5817_FLASH_CONTROLLER_ENABLED
	depends on DCACHE
	depends on ICACHE
	default y
	select FLASH_HAS_DRIVER_ENABLED
	select FLASH_HAS_PAGE_LAYOUT
	select FLASH_HAS_EXPLICIT_ERASE
	select FLASH_HAS_EX_OP
	select SYSCON if PM_DEVICE
	help
	  Enable RTS5817 Flash driver.

if FLASH_RTS5817_QSPI

config FLASH_RTS5817_WRITE_PROTECTION_AUTO
	bool "Flash write protection auto control"
	default y
	help
	  Disable the flash software write protection before writing or erasing,
	  and enable it again afterwards. If n is selected, write protection
	  must be controlled manually via flash_ex_op, which requires
	  FLASH_EX_OP_ENABLED.

endif
```

## drivers/gpio/Kconfig.clt01_38sq7
```kconfig
# Copyright (c) 2026 Sebastian Balling
# SPDX-License-Identifier: Apache-2.0

config GPIO_CLT01_38SQ7
	bool "ST CLT01-38SQ7 octal digital input current limiter"
	default y
	depends on DT_HAS_ST_CLT01_38SQ7_ENABLED
	depends on SPI
	help
	  GPIO driver for the ST CLT01-38SQ7 octal digital input termination
	  (8 digital inputs, read via 16-bit SPI frames with check bits).

config GPIO_CLT01_38SQ7_INIT_PRIORITY
	int "CLT01-38SQ7 init priority"
	default 75
	depends on GPIO_CLT01_38SQ7
	help
	  Device driver initialization priority. Must be higher than
	  SPI_INIT_PRIORITY.
```
