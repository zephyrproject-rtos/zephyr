/*
 * SPDX-FileCopyrightText: Copyright (c) 2026 Tom Waldron <tom@baremetal.dev>
 *
 * SPDX-License-Identifier: Apache-2.0
 */

#define DT_DRV_COMPAT shenghe_sh8501a

#include <zephyr/drivers/gpio.h>
#include <zephyr/drivers/mipi_dbi.h>
#include <zephyr/drivers/mspi.h>
#include <zephyr/logging/log.h>
#include <zephyr/pm/device.h>
#include <zephyr/pm/device_runtime.h>
#include <zephyr/sys/byteorder.h>

LOG_MODULE_REGISTER(display_sh8501a, CONFIG_DISPLAY_LOG_LEVEL);

#define TE_GPIOS_PRESENT(n) DT_INST_NODE_HAS_PROP(n, te_gpios) |

#define TE_REQUIRED                                                                                \
	IS_ENABLED(CONFIG_SH8501A_USE_TE) && (DT_INST_FOREACH_STATUS_OKAY(TE_GPIOS_PRESENT) 0)

#define PWR_READY_DELAY  K_MSEC(50)
#define POST_RESET_DELAY K_MSEC(150)
#define POST_WAKE_DELAY  K_MSEC(120)

#define MSPI_CMD 0x02
#define MSPI_RD  0x03
#define MSPI_W1  0x2C

#define MSPI_ADDRESS_MASK 0x0000ff00
#define MSPI_ADDRESS(cmd) ((((uint32_t)cmd) << 8) & MSPI_ADDRESS_MASK)

struct sh8501a_config {
	/* MSPI controller */
	const struct device *bus;
	/* MSPI compatible ID for multi-device scheme */
	struct mspi_dev_id mspi_id;
	/* MSPI communications mode */
	enum mspi_io_mode mspi_mode;
	/* Clock polarity and phase */
	enum mspi_cpp_mode cpp;
	/* MSPI frequency */
	uint32_t freq;
	/* Tearing-effect */
	uint8_t te_mode;
	/* Tearing-effect GPIO */
	const struct gpio_dt_spec tearing_effect;
	/* Tear-scan-line */
	uint32_t te_scanline;
	/* Reset GPIO */
	const struct gpio_dt_spec reset;
	/* Display */
	uint16_t height;
	uint16_t width;
};

struct sh8501a_data {
	struct k_mutex lock;
	uint8_t bytes_per_pixel;
	enum display_pixel_format pixel_format;
	enum display_orientation orientation;
#if TE_REQUIRED
	struct k_sem te_signal;
	k_timeout_t te_delay;
	atomic_t in_active_area;
	struct gpio_callback te_cb_data;
#endif
};

struct init_cmd {
	uint8_t cmd;
	uint8_t len;
	const uint8_t *data;
};

/**
 * @brief Takes the init sequence (adapted from manufacturers docs) and takes the
 * first item as the command byte, then the rest as the data, calculating size.
 */
#define SH8501A_INIT_CMD(command, ...)                                                             \
	{                                                                                          \
		.cmd = command, .len = sizeof((uint8_t[]){__VA_ARGS__}), .data = (const uint8_t[]) \
		{                                                                                  \
			__VA_ARGS__                                                                \
		}                                                                                  \
	}

static const struct init_cmd init_sequence[] = {
	/* MCS */
	SH8501A_INIT_CMD(0xC0, 0x5A, 0x5A),
	SH8501A_INIT_CMD(0xC1, 0x5A, 0x5A),
	SH8501A_INIT_CMD(0xD0, 0x10),
	/* 90h:CRP On/Off Control :90h 0x33: CRP On; 90h 0x00: CRP Off; */
	SH8501A_INIT_CMD(0x90, 0x33, 0x01, 0xC2, 0x00, 0x70, 0x01),
	SH8501A_INIT_CMD(0x91, 0x25, 0x00, 0x00, 0x19, 0x00, 0x00, 0x00, 0x19, 0x00, 0x19, 0x00,
			 0x19, 0x00, 0x1A, 0x00, 0x00, 0x00, 0x00, 0x00, 0x00),
	SH8501A_INIT_CMD(0x92, 0x29, 0x00, 0x00, 0x19, 0x00, 0x56, 0x01, 0x6F, 0x01, 0x19, 0x00,
			 0x56, 0x01, 0x1A, 0x00, 0x00, 0x00, 0x00, 0x00, 0x00),
	SH8501A_INIT_CMD(0x93, 0x2D, 0xA8, 0x00, 0xC1, 0x00, 0x56, 0x01, 0x6F, 0x01, 0xA8, 0x00,
			 0x56, 0x01, 0x1A, 0x00, 0x00, 0x00, 0x00, 0x00, 0x00),
	SH8501A_INIT_CMD(0x94, 0x21, 0xA8, 0x00, 0xC1, 0x00, 0x00, 0x00, 0x19, 0x00, 0xA8, 0x00,
			 0x19, 0x00, 0x1A, 0x00, 0x00, 0x00, 0x00, 0x00, 0x00),
	SH8501A_INIT_CMD(
		0x9B, 0x07, 0x00, 0x00, 0x00, 0x00, 0x00, 0x00, 0x6F, 0x01, 0x00, 0x00, 0x01, 0x00,
		0x00, 0x00, 0x6F, 0x01, 0x01, 0xE0, 0xFF, 0xE0, 0xFF, 0xFF, 0xFF, 0x01, 0x00, 0x00,
		0xC1, 0x00, 0x6F, 0x01, 0x6F, 0x01, 0x00, 0x00, 0xC1, 0x00, 0x6E, 0x01, 0x6F, 0x01,
		0x01, 0xFF, 0xFF, 0xCE, 0xFF, 0xF3, 0xFF, 0x05, 0xC1, 0x00, 0xC1, 0x00, 0x00, 0x00,
		0x6F, 0x01, 0xC0, 0x00, 0xC1, 0x00, 0x00, 0x00, 0x6F, 0x01, 0x01, 0xFF, 0xFF, 0xFF,
		0xFF, 0xE0, 0xFF, 0x0B, 0x00, 0x00, 0xC1, 0x00, 0x00, 0x00, 0x00, 0x00, 0x00, 0x00,
		0xC1, 0x00, 0x00, 0x00, 0x01, 0x00, 0x01, 0xC4, 0xFF, 0xFF, 0xFF, 0xCC, 0xFF),
	SH8501A_INIT_CMD(0x9D, 0x01, 0x16, 0x00, 0x00, 0x00, 0xA0, 0xBE, 0xAF, 0x01, 0x17, 0x00,
			 0x00, 0x00, 0xB4, 0xD2, 0xC3, 0x01, 0x18, 0x00, 0x00, 0x00, 0xC8, 0xE6,
			 0xD7, 0x01, 0x19, 0x00, 0x00, 0x00, 0xBE, 0xFA, 0xEB, 0x01, 0xA8, 0x00,
			 0x00, 0x00, 0xDC, 0xFA, 0xEB, 0x01, 0xA9, 0x00, 0x00, 0x00, 0xC8, 0xE6,
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			 0xC3, 0x01, 0xAB, 0x00, 0x6F, 0x01, 0xBE, 0xA0, 0xAF),
	SH8501A_INIT_CMD(
		0x9E, 0x03, 0x07, 0x0B, 0x0E, 0x12, 0x16, 0x19, 0x1D, 0x21, 0x25, 0x28, 0x2C, 0x30,
		0x33, 0x37, 0x3B, 0x03, 0x06, 0x09, 0x0C, 0x0F, 0x12, 0x15, 0x18, 0x1B, 0x1F, 0x22,
		0x25, 0x28, 0x2B, 0x2E, 0x31, 0x00, 0x01, 0x01, 0x01, 0x02, 0x02, 0x03, 0x04, 0x04,
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		0x30),
	SH8501A_INIT_CMD(0x8E, 0x00, 0x00, 0x00, 0x00, 0x00, 0x00, 0x00, 0x00, 0x00, 0x00, 0x00,
			 0x00, 0x00, 0x00, 0x00, 0x00, 0x00, 0x00, 0x00, 0x00),
	/* B1h 16bit Pixel Format Switch: Last Para: 0x00->GBRG-3553, 0x10->RGB-565; */
	SH8501A_INIT_CMD(0xB1, 0xE5, 0x70, 0x01, 0xC2, 0x00, 0x08, 0x00, 0x08, 0x00, 0x30, 0x00,
			 0x30, 0x00, 0x08, 0x00, 0x08, 0x00, 0x30, 0x00, 0x30, 0x00, 0x00, 0x08,
			 0x00, 0x8D, 0x00, 0x30, 0x00, 0x30, 0x00, 0x08, 0x00, 0x8D, 0x00, 0x30,
			 0x00, 0x30, 0x00, 0x02, 0xA0, 0x00, 0x00, 0xC1, 0x00, 0x00, 0x00, 0x6F,
			 0x01, 0x00, 0x00, 0x10),
	SH8501A_INIT_CMD(0xB2, 0x13, 0x13, 0x04, 0x04, 0x13, 0x04, 0x04, 0x13, 0x13, 0x04, 0x04,
			 0x04, 0x04, 0x0F, 0x1C, 0x01, 0xB6, 0x00, 0x1C, 0x01, 0xB6, 0x00, 0x15,
			 0x01, 0xB6, 0x00, 0x00, 0x00, 0xB6, 0x00, 0x1C, 0x01, 0xB6, 0x00, 0x1C,
			 0x01, 0xB6, 0x00, 0x15, 0x01, 0xB6, 0x00, 0x00, 0x00, 0xB6, 0x00, 0x0B,
			 0x3B, 0x3C, 0x6B, 0x00, 0x03, 0x00, 0x00, 0x31, 0x55, 0x15, 0xD5, 0x31,
			 0x60, 0x00, 0x00, 0x00, 0x00, 0x00, 0x00, 0x00, 0x00, 0x00, 0x00, 0x00,
			 0x00, 0x00, 0x00, 0x00, 0x00, 0x00, 0x00, 0x00, 0x00, 0x00, 0x00, 0x00,
			 0x13, 0x77),
	SH8501A_INIT_CMD(0xB3, 0x00, 0x01, 0x02, 0x03, 0x00, 0x13, 0x13, 0x14, 0x14, 0x12, 0x12,
			 0x00, 0x00, 0x00, 0x00, 0x00, 0x00, 0x04, 0x05, 0x06, 0x00, 0x0E, 0x0E,
			 0x0F, 0x0F, 0x0D, 0x0D, 0x00, 0x00, 0x00, 0x00, 0x00),
	SH8501A_INIT_CMD(0xB4, 0x20, 0x03, 0x00, 0x00, 0x0E, 0x07, 0x07, 0x07, 0x07, 0x07, 0x00,
			 0x14, 0x14, 0x14, 0x14, 0x14, 0x14, 0x36, 0x63, 0x25, 0x52, 0x14, 0x41,
			 0x63, 0x36, 0x52, 0x25, 0x41, 0x14, 0x14, 0x41, 0x25, 0x52, 0x36, 0x63,
			 0x41, 0x14, 0x52, 0x25, 0x63, 0x36, 0x00, 0x00, 0x2A, 0x15, 0x2A, 0x15,
			 0x15, 0x2A, 0x15, 0x2A, 0x00, 0x00, 0x00, 0x00, 0x00, 0x00, 0x00),
	SH8501A_INIT_CMD(0xB5, 0x00, 0x00, 0x09, 0x09, 0x01, 0x29, 0x00, 0x00, 0x01, 0x00, 0x00,
			 0x00, 0x00, 0xB6, 0x00, 0x0E, 0x01, 0xB6, 0x00, 0x0E, 0x01, 0x00, 0x00,
			 0x00, 0x00, 0x00, 0x00, 0x00, 0x00, 0x00, 0x00, 0x00, 0x00, 0x00, 0x00,
			 0x00, 0x00, 0x03, 0x02, 0x03, 0x02, 0x03, 0x02, 0x22, 0x00, 0x22, 0x00,
			 0x22, 0x00, 0x01, 0x01, 0x22, 0x00, 0x01, 0x01, 0x00, 0x00, 0x00, 0x00,
			 0x00, 0x00, 0x00, 0x00, 0x00, 0x00, 0x00, 0x00, 0x00, 0x00, 0x01, 0x00,
			 0x01, 0x00, 0x00, 0x00, 0x00, 0x00, 0x00, 0x00, 0x00, 0x00),
	SH8501A_INIT_CMD(0xB8, 0x00, 0xE7, 0x30, 0x00, 0x22, 0x22, 0x22, 0x22, 0x22, 0x22, 0x44,
			 0x44, 0x44, 0x00, 0x00, 0x44, 0x44, 0x44, 0x00, 0x00, 0x00, 0x00, 0x00,
			 0x00, 0x00, 0x00, 0x00),
	SH8501A_INIT_CMD(0xBB, 0x01, 0xC8, 0xC8, 0xC8, 0x80, 0x80, 0x80, 0x4C, 0x59, 0x66),
	/*(2025/12/05)
	 * - ELVSS_SWIRE_NOR = 29(1Dh)->27(1Bh)
	 * - AVDD_SWIRE_NOR = 0(0h)->56(38h)
	 * - AVDD_PGM_EN = 0(0h)->1(1h)
	 */
	SH8501A_INIT_CMD(0xBD, 0x01, 0x07, 0x64, 0x00, 0xBC, 0x02, 0x04, 0x01, 0x1B, 0x00, 0x38,
			 0x00, 0x7C, 0x00, 0x5F, 0x00, 0x00, 0x7F, 0x00, 0x00, 0x00, 0x00, 0x00,
			 0x0B, 0x0B, 0x00),
	SH8501A_INIT_CMD(
		0xBE, 0x00, 0x00, 0x0E, 0x01, 0x0E, 0x01, 0x0E, 0x01, 0x0E, 0x01, 0x0E, 0x01, 0x0E,
		0x01, 0x0E, 0x01, 0x0E, 0x01, 0x0E, 0x01, 0x00, 0x00, 0x0E, 0x01, 0x0E, 0x01, 0x0E,
		0x01, 0x0E, 0x01, 0x0E, 0x01, 0x0E, 0x01, 0x0E, 0x01, 0x0E, 0x01, 0x0E, 0x01, 0x00,
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		0x00, 0x00, 0x00, 0x00, 0x00),
	/* Gamma 2.2&DBV 2.2 */
	SH8501A_INIT_CMD(0xC2, 0xFC),
	SH8501A_INIT_CMD(0xC3, 0x00, 0x00, 0xFF, 0x07, 0x00, 0x00, 0xFF, 0x07, 0x00, 0x00, 0xFF,
			 0x04),
	/* C5h (NRM_GAM_SET) */
	SH8501A_INIT_CMD(
		0xC5, 0x51, 0x05, 0x1A, 0x05, 0x2C, 0x06, 0x22, 0x05, 0xF3, 0x04, 0xF8, 0x05, 0xF6,
		0x04, 0xCB, 0x04, 0xC2, 0x05, 0xCC, 0x04, 0xA2, 0x04, 0x8C, 0x05, 0xA0, 0x04, 0x7C,
		0x04, 0x58, 0x05, 0x76, 0x04, 0x53, 0x04, 0x21, 0x05, 0x49, 0x04, 0x2B, 0x04, 0xEC,
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		0x01, 0x11, 0x02, 0x00, 0x00, 0x00, 0x00, 0x00, 0x00),
	/* C6h (HBM_GAM_SET) */
	SH8501A_INIT_CMD(
		0xC6, 0x00, 0x05, 0xC4, 0x04, 0xA6, 0x05, 0xD3, 0x04, 0x9D, 0x04, 0x72, 0x05, 0xA6,
		0x04, 0x76, 0x04, 0x3E, 0x05, 0x78, 0x04, 0x4C, 0x04, 0x08, 0x05, 0x4F, 0x04, 0x26,
		0x04, 0xD6, 0x04, 0x25, 0x04, 0x00, 0x04, 0xA3, 0x04, 0xFC, 0x03, 0xD9, 0x03, 0x72,
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		0x01, 0xF3, 0x01, 0x00, 0x00, 0x00, 0x00, 0x00, 0x00),
	/* D4h: SPR On/Off Control: D4h 0x11 :SPR On; D4h 0x00 :SPR Off; */
	SH8501A_INIT_CMD(0xD4, 0x13, 0xC2, 0x00, 0x70, 0x01, 0x08, 0x08, 0x14, 0x14, 0x00, 0x00),
	SH8501A_INIT_CMD(0xD5, 0x0C, 0x00, 0x2D, 0x00, 0x01, 0x00, 0x28, 0x00, 0x98, 0x00, 0x03,
			 0x00, 0x01, 0x00, 0x02, 0x00, 0x00, 0x00, 0x01, 0x00, 0x02, 0x00, 0x00,
			 0x00, 0x28, 0x00, 0x98, 0x00, 0x03, 0x00, 0x0C, 0x00, 0x2D, 0x00, 0x01,
			 0x00, 0x01, 0x00, 0x2D, 0x00, 0x0C, 0x00, 0x03, 0x00, 0x98, 0x00, 0x28,
			 0x00, 0x00, 0x00, 0x02, 0x00, 0x01, 0x00),
	SH8501A_INIT_CMD(0xD6, 0x0C, 0x00, 0x2D, 0x00, 0x01, 0x00, 0x28, 0x00, 0x98, 0x00, 0x03,
			 0x00, 0x01, 0x00, 0x02, 0x00, 0x00, 0x00, 0x01, 0x00, 0x02, 0x00, 0x00,
			 0x00, 0x28, 0x00, 0x98, 0x00, 0x03, 0x00, 0x0C, 0x00, 0x2D, 0x00, 0x01,
			 0x00, 0x01, 0x00, 0x2D, 0x00, 0x0C, 0x00, 0x03, 0x00, 0x98, 0x00, 0x28,
			 0x00, 0x00, 0x00, 0x02, 0x00, 0x01, 0x00),
	SH8501A_INIT_CMD(0xD7, 0x13, 0x00, 0x2C, 0x00, 0xFB, 0x01, 0x47, 0x00, 0xA6, 0x00, 0xEE,
			 0x01, 0xF9, 0x01, 0xF0, 0x01, 0x02, 0x00, 0xFB, 0x01, 0x2C, 0x00, 0x13,
			 0x00, 0xEE, 0x01, 0xA6, 0x00, 0x47, 0x00, 0x02, 0x00, 0xF0, 0x01, 0xF9,
			 0x01, 0x00, 0x00, 0xEB, 0x01, 0x00, 0x00, 0x00, 0x00, 0xDA, 0x00, 0x00,
			 0x00, 0x00, 0x00, 0x3B, 0x00, 0x00, 0x00),
	SH8501A_INIT_CMD(0xD8, 0xF9, 0x01, 0xF0, 0x01, 0x02, 0x00, 0x47, 0x00, 0xA6, 0x00, 0xEE,
			 0x01, 0x13, 0x00, 0x2C, 0x00, 0xFB, 0x01, 0x02, 0x00, 0xF0, 0x01, 0xF9,
			 0x01, 0xEE, 0x01, 0xA6, 0x00, 0x47, 0x00, 0xFB, 0x01, 0x2C, 0x00, 0x13,
			 0x00, 0x00, 0x00, 0x3B, 0x00, 0x00, 0x00, 0x00, 0x00, 0xDA, 0x00, 0x00,
			 0x00, 0x00, 0x00, 0xEB, 0x01, 0x00, 0x00),
	/* DEh:ID Write: ID1/ID2/ID3 */
	SH8501A_INIT_CMD(0xDE, 0x00, 0x00, 0x00),
	SH8501A_INIT_CMD(0xDF, 0xFF, 0xFF, 0xFF, 0xFF, 0xFF, 0xFF, 0x08, 0x08, 0x08, 0x08, 0x08,
			 0x08, 0x08, 0x08, 0x08, 0x08, 0x00, 0x06, 0x55, 0x50, 0xFF, 0xFF, 0x08,
			 0x08, 0x08),
	SH8501A_INIT_CMD(0xE7, 0x02, 0x04, 0x00, 0x44, 0x00, 0x00, 0x00, 0x00, 0x00, 0x00, 0x11),
	SH8501A_INIT_CMD(0xEE, 0x40, 0x00, 0x00, 0x00, 0x00, 0x00, 0x00, 0x00, 0x01, 0x03, 0x00,
			 0x00, 0x00, 0x00, 0x00, 0x00, 0x00, 0x00, 0x00, 0x00, 0x00, 0x00, 0x00,
			 0x00, 0x00, 0x00, 0x00, 0x00, 0x00, 0x00, 0x00, 0x00, 0x00, 0x00, 0x00,
			 0x00, 0x00, 0x00, 0x00, 0x00, 0x00, 0x00, 0x00, 0x00),
	/* NOR_PWR_Setting */
	SH8501A_INIT_CMD(0xF0, 0x75, 0x2A, 0x78, 0x71, 0x70, 0x58, 0x2F, 0x1C, 0x1C, 0x8A, 0x8A,
			 0x10, 0x0D, 0x75, 0x2A, 0x78, 0x71, 0x70, 0x58, 0x2F, 0x1C, 0x1C, 0x0A,
			 0x0A, 0x10, 0x0D),
	SH8501A_INIT_CMD(0xF1, 0x00, 0x6E, 0x49, 0xD0, 0x95, 0x15, 0xA5, 0x55, 0x0E, 0x50, 0xC6),
	/* AOD_PWR_Setting */
	SH8501A_INIT_CMD(0xF2, 0x75, 0x2A, 0x78, 0x71, 0x70, 0x58, 0x2F, 0x03, 0x1C, 0x8A, 0x8A,
			 0x10, 0x0D),
	SH8501A_INIT_CMD(0xF3, 0x00, 0x60, 0x41, 0xD0, 0x95, 0x15, 0xA5, 0x55, 0x0E, 0x50),
	SH8501A_INIT_CMD(0xF4, 0x0B, 0x00, 0x00, 0x75, 0x2A, 0x78, 0x71, 0x70, 0x41, 0x00, 0x10,
			 0x95, 0x15, 0xA5, 0x55, 0x10, 0x0E, 0x0E),
	SH8501A_INIT_CMD(0xF5, 0x3F, 0x53, 0x01, 0x11, 0x19, 0x0A, 0x29, 0x01, 0x03, 0x05, 0x07,
			 0x09, 0x0B, 0x0D, 0x0F, 0x11, 0x00, 0x01, 0x01, 0x3F, 0x53, 0x31, 0x11,
			 0x19, 0x0A, 0x29, 0x01, 0x03, 0x05, 0x07, 0x09, 0x0B, 0x0D, 0x0F, 0x11,
			 0x01, 0x01, 0x01),
	/* PWR_ON/OFF_SEQ */
	SH8501A_INIT_CMD(0xF6, 0x00, 0x00, 0x00, 0x00, 0x01, 0x01, 0x02, 0x02, 0x02, 0x03, 0x04,
			 0x04, 0x07, 0x07, 0x08, 0x08, 0x08, 0x02, 0x02, 0x04, 0x04, 0x0B, 0x0B,
			 0x0B, 0x0B, 0x4B, 0x4B, 0x0B, 0x0C, 0x0C, 0x0D, 0x0E, 0x0E, 0x03, 0x04,
			 0x42, 0x02, 0x11, 0x00),
	SH8501A_INIT_CMD(0xF7, 0x55, 0x55, 0x55, 0x55, 0x44, 0x34, 0x23, 0x22, 0x41, 0x34, 0x13,
			 0x11, 0x11, 0x11, 0x00, 0x00, 0x05, 0x00, 0x00, 0x02, 0x00, 0x04, 0x01,
			 0x02),
	SH8501A_INIT_CMD(0xF8, 0x55, 0x55, 0x55, 0x55, 0x44, 0x34, 0x23, 0x22, 0x41, 0x34, 0x13,
			 0x11, 0x11, 0x11, 0x00, 0x00, 0x05, 0x00, 0x00, 0x00, 0x00, 0x00, 0x00,
			 0x00),
	SH8501A_INIT_CMD(0xFE, 0x80, 0x01, 0x02, 0x03),
	SH8501A_INIT_CMD(0x8F, 0x00, 0x00, 0x00, 0x00, 0x00, 0x00, 0x00, 0x00, 0x00, 0x00, 0x00,
			 0x00, 0x00, 0x00, 0x00, 0x00, 0x00, 0x00, 0x00, 0x00, 0x00, 0x00, 0x00,
			 0x00, 0x00, 0x00, 0x00, 0x00, 0x00, 0x00, 0x00, 0x00, 0x00),
	SH8501A_INIT_CMD(0x95, 0x00, 0x00, 0x00, 0x00, 0x00, 0x00, 0x00, 0x00, 0x00, 0x00, 0x00,
			 0x00, 0x00, 0x00, 0x00, 0x00, 0x00),
	SH8501A_INIT_CMD(0x96, 0x00, 0x00, 0x00, 0x00, 0x00, 0x00, 0x00, 0x00, 0x00, 0x00, 0x00,
			 0x00, 0x00, 0x00, 0x00, 0x00, 0x00),
	SH8501A_INIT_CMD(0x97, 0x00, 0x00, 0x00, 0x00, 0x00, 0x00, 0x00, 0x00, 0x00, 0x00, 0x00,
			 0x00, 0x00, 0x00, 0x00, 0x00, 0x00),
	SH8501A_INIT_CMD(0x98, 0x00, 0x00, 0x00, 0x00, 0x00, 0x00, 0x00, 0x00, 0x00, 0x00, 0x00,
			 0x00, 0x00, 0x00, 0x00, 0x00, 0x00),
	SH8501A_INIT_CMD(0x99, 0x00, 0x00, 0x00, 0x00, 0x00, 0x00, 0x00, 0x00, 0x00, 0x00, 0x00,
			 0x00, 0x00, 0x00, 0x00, 0x00, 0x00),
	SH8501A_INIT_CMD(0x9A, 0x00, 0x00, 0x00, 0x00, 0x00, 0x00, 0x00, 0x00, 0x00, 0x00, 0x00,
			 0x00, 0x00, 0x00, 0x00, 0x00, 0x00),
	SH8501A_INIT_CMD(
		0x9C, 0x00, 0x00, 0x00, 0x00, 0x00, 0x00, 0x00, 0x00, 0x00, 0x00, 0x00, 0x00, 0x00,
		0x00, 0x00, 0x00, 0x00, 0x00, 0x00, 0x00, 0x00, 0x00, 0x00, 0x00, 0x00, 0x00, 0x00,
		0x00, 0x00, 0x00, 0x00, 0x00, 0x00, 0x00, 0x00, 0x00, 0x00, 0x00, 0x00, 0x00, 0x00,
		0x00, 0x00, 0x00, 0x00, 0x00, 0x00, 0x00, 0x00, 0x00, 0x00, 0x00, 0x00, 0x00, 0x00,
		0x00, 0x00, 0x00, 0x00, 0x00, 0x00, 0x00, 0x00, 0x00, 0x00, 0x00, 0x00, 0x00, 0x00,
		0x00, 0x00, 0x00, 0x00, 0x00, 0x00, 0x00, 0x00, 0x00, 0x00, 0x00, 0x00, 0x00, 0x00,
		0x00, 0x00, 0x00, 0x00, 0x00, 0x00, 0x00, 0x00, 0x00, 0x00, 0x00, 0x00, 0x00),
	SH8501A_INIT_CMD(0xB6, 0x00, 0x02, 0x02, 0x02, 0x02, 0x02, 0x02, 0x00, 0x0F, 0x0F, 0x0F,
			 0x0F, 0x0F, 0x0F),
	SH8501A_INIT_CMD(
		0xB9, 0x00, 0x00, 0x00, 0x00, 0x00, 0x00, 0x00, 0x00, 0x00, 0x00, 0x00, 0x00, 0x00,
		0x00, 0x00, 0x00, 0x00, 0x00, 0x00, 0x00, 0x00, 0x00, 0x00, 0x00, 0x00, 0x00, 0x00,
		0x00, 0x00, 0x00, 0x00, 0x00, 0x00, 0x00, 0x00, 0x00, 0x00, 0x00, 0x00, 0x00, 0x00,
		0x00, 0x00, 0x00, 0x00, 0x00, 0x00, 0x00, 0x00, 0x00, 0x00, 0x00, 0x00, 0x00, 0x00,
		0x00, 0x00, 0x00, 0x00, 0x00, 0x00, 0x00, 0x00, 0x00, 0x00, 0x00, 0x00, 0x00, 0x00,
		0x00, 0x00, 0x00, 0x00, 0x00, 0x00, 0x00, 0x00, 0x00, 0x00, 0x00, 0x00, 0x00, 0x00,
		0x00, 0x00, 0x00, 0x00, 0x00, 0x00, 0x00, 0x00, 0x00, 0x00, 0x00, 0x00, 0x00, 0x00),
	SH8501A_INIT_CMD(0xBC, 0x00, 0x01, 0x23, 0x45, 0x67, 0x01, 0x23, 0x45, 0x67, 0x00, 0x00,
			 0x00, 0x00, 0x00, 0x00, 0x00),
	SH8501A_INIT_CMD(0xBF, 0x00, 0x00, 0x00, 0x00, 0x00, 0x00, 0x00, 0x00, 0x00, 0x00, 0x00,
			 0x00, 0x00, 0x00, 0x00, 0x00, 0x00, 0x00, 0x00, 0x00, 0x00, 0x00, 0x00,
			 0x00, 0x00, 0x00, 0x00, 0x00, 0x00, 0x00),
	SH8501A_INIT_CMD(
		0xC7, 0x0F, 0x07, 0x0F, 0x07, 0x0F, 0x07, 0xE5, 0x06, 0xE5, 0x06, 0xE5, 0x06, 0xBC,
		0x06, 0xBC, 0x06, 0xBC, 0x06, 0x93, 0x06, 0x93, 0x06, 0x93, 0x06, 0x6A, 0x06, 0x6A,
		0x06, 0x6A, 0x06, 0x44, 0x06, 0x44, 0x06, 0x44, 0x06, 0x1D, 0x06, 0x1D, 0x06, 0x1D,
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		0x03, 0x2D, 0x03, 0x00, 0x00, 0x00, 0x00, 0x00, 0x00),
	SH8501A_INIT_CMD(0xC8, 0x00, 0x00, 0x00),
	SH8501A_INIT_CMD(0xCF, 0x01),
	SH8501A_INIT_CMD(0xDD, 0x00, 0x00, 0x00, 0x00, 0x00, 0x00, 0x00, 0x00),
	SH8501A_INIT_CMD(0xE5, 0x00, 0x00, 0x00, 0x00, 0x00, 0x00),
	SH8501A_INIT_CMD(0xE6, 0x8C, 0x00, 0x00),
	SH8501A_INIT_CMD(0xE8, 0x00),
	SH8501A_INIT_CMD(0xEF, 0x00, 0x11, 0x32, 0xFF, 0x01, 0x32, 0xFF, 0x01),
	SH8501A_INIT_CMD(0xFB, 0x10, 0x05, 0x01, 0x00, 0x05, 0x00),
	SH8501A_INIT_CMD(0xFC, 0x00, 0x00, 0x00),
};

#if TE_REQUIRED

static void te_cb(const struct device *dev, struct gpio_callback *cb, uint32_t pins)
{
	ARG_UNUSED(dev);
	ARG_UNUSED(pins);

	struct sh8501a_data *data = CONTAINER_OF(cb, struct sh8501a_data, te_cb_data);

	/* Open frame window */
	if (!atomic_cas(&data->in_active_area, 0, 1)) {
		return;
	}

	k_sem_give(&data->te_signal);
}

#endif /* TE_REQUIRED */

/* Returns the display command which is mode-dependent */
static uint32_t mspi_command(enum mspi_io_mode mspi_mode)
{
	switch (mspi_mode) {
	case MSPI_IO_MODE_DUAL:
		[[fallthrough]];
	case MSPI_IO_MODE_DUAL_1_1_2:
		return 0x72;
	case MSPI_IO_MODE_DUAL_1_2_2:
		return 0x52;
	case MSPI_IO_MODE_QUAD:
		[[fallthrough]];
	case MSPI_IO_MODE_QUAD_1_1_4:
		return 0x32;
	case MSPI_IO_MODE_QUAD_1_4_4:
		return 0x12;
	default:
		return MSPI_CMD;
	};
}

static int mspi_configure(const struct device *controller, const struct mspi_dev_id *dev_id,
			  enum mspi_io_mode io_mode, uint32_t freq, enum mspi_cpp_mode cpp)
{
	const struct mspi_dev_cfg spi_transfer_cfg = {
		.io_mode = io_mode,
	};

	return mspi_dev_config(controller, dev_id, MSPI_DEVICE_CONFIG_IO_MODE, &spi_transfer_cfg);
}

static int mspi_transmit_cmd(const struct device *dev, uint8_t cmd, const uint8_t *data_buf,
			     size_t len)
{
	const struct sh8501a_config *config = dev->config;
	const struct device *controller = config->bus;
	const struct mspi_dev_id *dev_id = &config->mspi_id;

	const struct mspi_xfer_packet command[] = {
		{
			.dir = MSPI_TX,
			.cmd = MSPI_CMD,
			.address = MSPI_ADDRESS(cmd),
			.data_buf = (uint8_t *)data_buf,
			.num_bytes = len,
		},
	};

	const struct mspi_xfer transfer = {
		.xfer_mode = MSPI_DMA,
		.rx_dummy = 0,
		.tx_dummy = 0,
		.cmd_length = 1,
		.addr_length = 3,
		.packets = command,
		.num_packet = sizeof(command) / sizeof(struct mspi_xfer_packet),
		.priority = 1,
		.timeout = 30,
	};

	int ret =
		mspi_configure(controller, dev_id, MSPI_IO_MODE_SINGLE, config->freq, config->cpp);
	if (ret) {
		LOG_ERR("Failed to set mspi mode");
		return ret;
	}

	return mspi_transceive(controller, dev_id, &transfer);
}

static int mspi_transmit_display(const struct device *dev, const uint8_t *data_buf, size_t len)
{
	const struct sh8501a_config *config = dev->config;
	const struct device *controller = config->bus;
	const struct mspi_dev_id *dev_id = &config->mspi_id;

	const struct mspi_xfer_packet packet[] = {
		{
			.dir = MSPI_TX,
			.cmd = mspi_command(config->mspi_mode),
			.address = MSPI_ADDRESS(MSPI_W1),
			.data_buf = (uint8_t *)data_buf,
			.num_bytes = len,
		},
	};

	const struct mspi_xfer transfer = {
		.xfer_mode = MSPI_DMA,
		.rx_dummy = 0,
		.tx_dummy = 0,
		.cmd_length = 1,
		.addr_length = 3,
		.packets = packet,
		.num_packet = sizeof(packet) / sizeof(struct mspi_xfer_packet),
		.priority = 1,
		.timeout = 30,
	};

	int ret = mspi_configure(controller, dev_id, config->mspi_mode, config->freq, config->cpp);

	if (ret) {
		LOG_ERR("Failed to set mspi mode");
		return ret;
	}

	return mspi_transceive(controller, dev_id, &transfer);
}

static int write_display(const struct device *dev, const uint8_t *framebuf,
			 struct display_buffer_descriptor *desc)
{
	struct sh8501a_data *data = dev->data;
	int ret;

#if TE_REQUIRED
	/* Wait for TE signal, otherwise transferring can begin */
	if (!atomic_get(&data->in_active_area)) {
		ret = k_sem_take(&data->te_signal, K_FOREVER);
		if (ret < 0) {
			return ret;
		}
		k_sleep(data->te_delay);
	}
#endif

	ret = k_mutex_lock(&data->lock, K_FOREVER);
	if (ret < 0) {
		return ret;
	}

	ret = mspi_transmit_display(dev, framebuf, desc->buf_size);
	if (ret) {
		LOG_ERR("Failed to transmit pixels");
	}

	k_mutex_unlock(&data->lock);

#if TE_REQUIRED
	/* End of frame reset */
	if (!desc->frame_incomplete) {
		atomic_set(&data->in_active_area, 0);
	}
#endif

	return ret;
}

static int command_write(const struct device *dev, uint8_t cmd, const uint8_t *tx_data,
			 size_t tx_count)
{
	struct sh8501a_data *data = dev->data;

	int ret = k_mutex_lock(&data->lock, K_FOREVER);

	if (ret < 0) {
		return ret;
	}

	ret = mspi_transmit_cmd(dev, cmd, tx_data, tx_count);

	if (ret) {
		LOG_ERR("Failed to send transceive");
	}

	k_mutex_unlock(&data->lock);
	return ret;
}

static int sh8501a_blanking_on(const struct device *dev)
{
	return command_write(dev, MIPI_DCS_SET_DISPLAY_OFF, NULL, 0);
}

static int sh8501a_blanking_off(const struct device *dev)
{
	return command_write(dev, MIPI_DCS_SET_DISPLAY_ON, NULL, 0);
}

static int sh8501a_set_mem_area(const struct device *dev, const uint16_t x, const uint16_t y,
				const uint16_t w, const uint16_t h)
{
	uint16_t spi_data[2];
	int ret;

	spi_data[0] = sys_cpu_to_be16(x);
	spi_data[1] = sys_cpu_to_be16(x + w - 1);
	ret = command_write(dev, MIPI_DCS_SET_COLUMN_ADDRESS, (uint8_t *)spi_data, 4);
	if (ret < 0) {
		return ret;
	}

	spi_data[0] = sys_cpu_to_be16(y);
	spi_data[1] = sys_cpu_to_be16(y + h - 1);
	return command_write(dev, MIPI_DCS_SET_PAGE_ADDRESS, (uint8_t *)spi_data, 4);
}

static int sh8501a_write(const struct device *dev, const uint16_t x, const uint16_t y,
			 const struct display_buffer_descriptor *desc, const void *buf)
{
	struct sh8501a_data *data = dev->data;
	struct display_buffer_descriptor mipi_desc;

	int ret;
	const uint8_t *write_data_start = (const uint8_t *)buf;
	uint16_t write_cnt;
	uint16_t nbr_of_writes;
	uint16_t write_h;

	__ASSERT(desc->width <= desc->pitch, "Pitch is smaller than width");
	__ASSERT((desc->pitch * data->bytes_per_pixel * desc->height) <= desc->buf_size,
		 "Input buffer too small");

	LOG_DBG("Writing %dx%d (w,h) @ %dx%d (x,y)", desc->width, desc->height, x, y);
	ret = sh8501a_set_mem_area(dev, x, y, desc->width, desc->height);
	if (ret < 0) {
		return ret;
	}

	if (desc->pitch > desc->width) {
		write_h = 1U;
		nbr_of_writes = desc->height;
		mipi_desc.height = 1;
		mipi_desc.buf_size = desc->pitch * data->bytes_per_pixel;
	} else {
		write_h = desc->height;
		mipi_desc.height = desc->height;
		mipi_desc.buf_size = desc->width * data->bytes_per_pixel * write_h;
		nbr_of_writes = 1U;
	}

	mipi_desc.width = desc->width;
	/* Per MIPI API, pitch must always match width */
	mipi_desc.pitch = desc->width;
	mipi_desc.frame_incomplete = desc->frame_incomplete;

	ret = command_write(dev, MIPI_DCS_WRITE_MEMORY_START, NULL, 0);
	if (ret < 0) {
		return ret;
	}

	for (write_cnt = 0U; write_cnt < nbr_of_writes; ++write_cnt) {
		write_display(dev, write_data_start, &mipi_desc);
		if (ret < 0) {
			return ret;
		}

		write_data_start += desc->pitch * data->bytes_per_pixel;
	}

	return 0;
}

static void sh8501a_get_capabilities(const struct device *dev,
				     struct display_capabilities *capabilities)
{
	struct sh8501a_data *data = dev->data;
	const struct sh8501a_config *config = dev->config;

	memset(capabilities, 0, sizeof(struct display_capabilities));

	if (data->orientation == DISPLAY_ORIENTATION_NORMAL ||
	    data->orientation == DISPLAY_ORIENTATION_ROTATED_180) {
		capabilities->x_resolution = config->width;
		capabilities->y_resolution = config->height;
	} else {
		capabilities->x_resolution = config->height;
		capabilities->y_resolution = config->width;
	}

	capabilities->supported_pixel_formats = PIXEL_FORMAT_RGB_888 | PIXEL_FORMAT_RGB_565;

	capabilities->current_pixel_format = data->pixel_format;
	capabilities->current_orientation = data->orientation;
}

static int sh8501a_set_brightness(const struct device *dev, const uint8_t brightness)
{
	return command_write(dev, MIPI_DCS_SET_DISPLAY_BRIGHTNESS, &brightness, 1);
}

static int sh8501a_set_pixel_format(const struct device *dev,
				    const enum display_pixel_format pixel_format)
{
	struct sh8501a_data *data = dev->data;
	uint8_t buf[1];
	uint8_t bytes_per_pixel;

	if (pixel_format == PIXEL_FORMAT_RGB_565) {
		bytes_per_pixel = 2;
		buf[0] = MIPI_DCS_PIXEL_FORMAT_16BIT;
	} else if (pixel_format == PIXEL_FORMAT_RGB_888) {
		bytes_per_pixel = 3;
		buf[0] = MIPI_DCS_PIXEL_FORMAT_24BIT;
	} else {
		LOG_ERR("Unsupported pixel format");
		return -ENOTSUP;
	}

	int ret = command_write(dev, MIPI_DCS_SET_PIXEL_FORMAT, buf, 1);

	if (ret < 0) {
		return ret;
	}

	data->pixel_format = pixel_format;
	data->bytes_per_pixel = bytes_per_pixel;
	return 0;
}

static int sh8501a_set_orientation(const struct device *dev,
				   const enum display_orientation orientation)
{
	struct sh8501a_data *data = dev->data;
	uint8_t buf[1];

	if (orientation == DISPLAY_ORIENTATION_NORMAL) {
		buf[0] = 0x00;
	} else if (orientation == DISPLAY_ORIENTATION_ROTATED_90) {
		buf[0] = MIPI_DCS_ADDRESS_MODE_MIRROR_X | MIPI_DCS_ADDRESS_MODE_SWAP_XY;
	} else if (orientation == DISPLAY_ORIENTATION_ROTATED_180) {
		buf[0] = MIPI_DCS_ADDRESS_MODE_MIRROR_X | MIPI_DCS_ADDRESS_MODE_MIRROR_Y;
	} else if (orientation == DISPLAY_ORIENTATION_ROTATED_270) {
		buf[0] = MIPI_DCS_ADDRESS_MODE_MIRROR_Y | MIPI_DCS_ADDRESS_MODE_SWAP_XY;
	}

	int ret = command_write(dev, MIPI_DCS_SET_ADDRESS_MODE, buf, 1);

	if (ret < 0) {
		return ret;
	}

	data->orientation = orientation;
	return 0;
}

static int sh8501a_exit_sleep(const struct device *dev)
{
	int ret;

	ret = command_write(dev, MIPI_DCS_EXIT_SLEEP_MODE, NULL, 0);
	if (ret < 0) {
		return ret;
	}

	k_sleep(POST_WAKE_DELAY);
	return ret;
}

static inline bool sh8501a_has_pin(const struct gpio_dt_spec *spec)
{
	return spec->port != NULL;
}

static int sh8501a_reset_display(const struct device *dev)
{
	const struct sh8501a_config *config = dev->config;
	int ret;

	LOG_DBG("Resetting display");

	if (sh8501a_has_pin(&config->reset)) {
		ret = gpio_pin_set_dt(&config->reset, 1);
		if (ret < 0) {
			return ret;
		}

		k_msleep(6);

		ret = gpio_pin_set_dt(&config->reset, 0);
		if (ret < 0) {
			return ret;
		}
	} else {
		ret = command_write(dev, MIPI_DCS_SOFT_RESET, NULL, 0);
		if (ret < 0) {
			return ret;
		}
	}

	k_sleep(POST_RESET_DELAY);
	return ret;
}

#if TE_REQUIRED

static int configure_te(const struct device *dev, uint8_t edge, k_timeout_t delay_us)
{
	const struct sh8501a_config *config = dev->config;
	struct sh8501a_data *data = dev->data;
	int ret = 0;

	if (edge == MIPI_DBI_TE_NO_EDGE) {
		/* No configuration */
		return 0;
	}

	if (!sh8501a_has_pin(&config->tearing_effect)) {
		return -ENOTSUP;
	}

	if (!gpio_is_ready_dt(&config->tearing_effect)) {
		return -ENODEV;
	}

	ret = gpio_pin_configure_dt(&config->tearing_effect, GPIO_INPUT);
	if (ret < 0) {
		LOG_ERR("Could not configure Tearing Effect GPIO (%d)", ret);
		return ret;
	}

	if (edge == MIPI_DBI_TE_RISING_EDGE) {
		ret = gpio_pin_interrupt_configure_dt(&config->tearing_effect,
						      GPIO_INT_EDGE_RISING);
	} else if (edge == MIPI_DBI_TE_FALLING_EDGE) {
		ret = gpio_pin_interrupt_configure_dt(&config->tearing_effect,
						      GPIO_INT_EDGE_FALLING);
	}
	if (ret < 0) {
		LOG_ERR("Could not configure Tearing Effect GPIO EXT interrupt (%d)", ret);
		return ret;
	}

	gpio_init_callback(&data->te_cb_data, (gpio_callback_handler_t)te_cb,
			   BIT(config->tearing_effect.pin));

	ret = gpio_add_callback(config->tearing_effect.port, &data->te_cb_data);
	if (ret < 0) {
		LOG_ERR("Could not add Tearing Effect GPIO callback (%d)", ret);
		return ret;
	}

	data->te_delay = delay_us;
	atomic_set(&data->in_active_area, 0);
	k_sem_init(&data->te_signal, 0, 1);

	return ret;
}

#endif /* TE_REQUIRED */

static int sh8501a_lcd_init(const struct device *dev)
{
	const struct sh8501a_config *config = dev->config;
	uint8_t tmp[4];
	int ret;

	ARRAY_FOR_EACH_PTR(init_sequence, cmd) {
		ret = command_write(dev, cmd->cmd, cmd->data, cmd->len);
		if (ret < 0) {
			return ret;
		}
	}

	ret = sh8501a_exit_sleep(dev);
	if (ret < 0) {
		LOG_ERR("Failed to exit the sleep mode (%d)", ret);
		return ret;
	}

	ret = sh8501a_set_pixel_format(dev, PIXEL_FORMAT_RGB_565);
	if (ret < 0) {
		LOG_ERR("Failed to set pixel format (%d)", ret);
		return ret;
	}

	sys_put_be16(config->te_scanline, tmp);
	ret = command_write(dev, MIPI_DCS_SET_TEAR_SCANLINE, tmp, 2);
	if (ret < 0) {
		return ret;
	}

	tmp[0] = 0x00;
	ret = command_write(dev, MIPI_DCS_SET_TEAR_ON, tmp, 1);
	if (ret < 0) {
		return ret;
	}

	ret = sh8501a_set_orientation(dev, DISPLAY_ORIENTATION_NORMAL);
	if (ret < 0) {
		return ret;
	}

	tmp[0] = MIPI_DCS_PIXEL_FORMAT_16BIT;
	ret = command_write(dev, MIPI_DCS_SET_PIXEL_FORMAT, tmp, 1);
	if (ret < 0) {
		return ret;
	}

	tmp[0] = 0x20;
	ret = command_write(dev, MIPI_DCS_WRITE_CONTROL_DISPLAY, tmp, 1);
	if (ret < 0) {
		return ret;
	}

	return 0;
}

static int sh8501a_init(const struct device *dev)
{
	LOG_DBG("Initialising SH8501A MSPI Display");

	const struct sh8501a_config *config = dev->config;
	const struct device *controller = config->bus;
	struct sh8501a_data *data = dev->data;
	int ret;

	if (!device_is_ready(controller)) {
		LOG_ERR("MSPI controller is not ready");
		return -ENODEV;
	}

	pm_device_runtime_get(controller);

	if (sh8501a_has_pin(&config->reset)) {
		if (!gpio_is_ready_dt(&config->reset)) {
			return -ENODEV;
		}
		ret = gpio_pin_configure_dt(&config->reset, GPIO_OUTPUT_INACTIVE);
		if (ret < 0) {
			LOG_ERR("Could not configure reset GPIO (%d)", ret);
			return ret;
		}
	}

#if TE_REQUIRED
	ret = configure_te(dev, config->te_mode, K_TIMEOUT_ABS_MS(0));
	if (ret < 0) {
		LOG_ERR("Could not configure tearing-effect GPIO (%d)", ret);
		return ret;
	}
#endif

	k_mutex_init(&data->lock);

	ret = k_mutex_lock(&data->lock, K_FOREVER);
	if (ret < 0) {
		return ret;
	}

	const struct mspi_dev_cfg spi_transfer_cfg = {
		.freq = config->freq,
		.cpp = config->cpp,
	};

	ret = mspi_dev_config(controller, &config->mspi_id,
			      MSPI_DEVICE_CONFIG_FREQUENCY | MSPI_DEVICE_CONFIG_CPP,
			      &spi_transfer_cfg);
	if (ret < 0) {
		LOG_ERR("Failed to configure mspi");
		return ret;
	}

	k_mutex_unlock(&data->lock);

	k_sleep(PWR_READY_DELAY);

	ret = sh8501a_reset_display(dev);
	if (ret < 0) {
		LOG_ERR("Failed to reset display (%d)", ret);
		return ret;
	}

	ret = sh8501a_lcd_init(dev);
	if (ret < 0) {
		LOG_ERR("Failed to init display (%d)", ret);
		return ret;
	}

	ret = sh8501a_exit_sleep(dev);
	if (ret < 0) {
		LOG_ERR("Failed to exit the sleep mode (%d)", ret);
		return ret;
	}

	return ret;
}

#ifdef CONFIG_PM_DEVICE
static int sh8501a_pm_action(const struct device *dev, enum pm_device_action action)
{
	int ret;

	switch (action) {
	case PM_DEVICE_ACTION_RESUME:
		ret = sh8501a_exit_sleep(dev);
		break;
	case PM_DEVICE_ACTION_SUSPEND:
		ret = command_write(dev, MIPI_DCS_ENTER_SLEEP_MODE, NULL, 0);
		break;
	default:
		ret = -ENOTSUP;
		break;
	}

	return ret;
}
#endif /* CONFIG_PM_DEVICE */

static DEVICE_API(display, sh8501a_api) = {
	.blanking_off = sh8501a_blanking_off,
	.blanking_on = sh8501a_blanking_on,
	.get_capabilities = sh8501a_get_capabilities,
	.set_brightness = sh8501a_set_brightness,
	.set_orientation = sh8501a_set_orientation,
	.set_pixel_format = sh8501a_set_pixel_format,
	.write = sh8501a_write,
};

#define SH8501A_INIT(inst)                                                                         \
	static const struct sh8501a_config sh8501a_config_##inst = {                               \
		.bus = DEVICE_DT_GET(DT_INST_BUS(inst)),                                           \
		.mspi_id = MSPI_DEVICE_ID_DT_INST(inst),                                           \
		.mspi_mode = DT_INST_ENUM_IDX(inst, mspi_io_mode),                                 \
		.cpp = DT_INST_ENUM_IDX(inst, mspi_cpp_mode),                                      \
		.freq = DT_INST_PROP(inst, mspi_max_frequency),                                    \
		.te_mode = MIPI_DBI_TE_MODE_DT_INST(inst, te_mode),                                \
		.tearing_effect = GPIO_DT_SPEC_INST_GET_OR(inst, te_gpios, {}),                    \
		.te_scanline = DT_INST_PROP(inst, te_scanline),                                    \
		.reset = GPIO_DT_SPEC_INST_GET_OR(inst, reset_gpios, {}),                          \
		.width = DT_INST_PROP(inst, width),                                                \
		.height = DT_INST_PROP(inst, height),                                              \
	};                                                                                         \
                                                                                                   \
	static struct sh8501a_data sh8501a_data_##inst;                                            \
                                                                                                   \
	PM_DEVICE_DT_INST_DEFINE(inst, sh8501a_pm_action);                                         \
                                                                                                   \
	DEVICE_DT_INST_DEFINE(inst, sh8501a_init, PM_DEVICE_DT_INST_GET(inst),                     \
			      &sh8501a_data_##inst, &sh8501a_config_##inst, POST_KERNEL,           \
			      CONFIG_DISPLAY_INIT_PRIORITY, &sh8501a_api);

DT_INST_FOREACH_STATUS_OKAY(SH8501A_INIT)
