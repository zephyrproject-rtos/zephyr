/*
 * Copyright (c) 2020
 *
 * SPDX-License-Identifier: Apache-2.0
 */

#define DT_DRV_COMPAT rydium_rm68xx
#include <zephyr.h>
#include <device.h>

#include <sys/byteorder.h>

#include <drivers/display.h>
#include <drivers/i2c.h>
#include <drivers/gpio.h>

#define LOG_LEVEL CONFIG_LOG_DEFAULT_LEVEL
#include <logging/log.h>
LOG_MODULE_REGISTER(rm68200);

struct rm68200_data {
	const struct device *mipi_dsi;
	const struct device *reset_gpio;
	const struct device *pwr_gpio;
	const struct device *bl_gpio;
	uint8_t reset_pin;
	uint8_t pwr_pin;
	uint8_t bl_pin;
	gpio_dt_flags_t reset_flags;
	gpio_dt_flags_t pwr_flags;
	gpio_dt_flags_t bl_flags;
};

static const uint8_t rm68200InitParam[][2] = {
	{0xFE, 0x01},
	{0x24, 0xC0},
	{0x25, 0x53},
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	{0x55, 0x00},
	/* 2 data lanes */
	{0x5F, 0x11},

	{0xFE, 0x03},
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	{0x01, 0x75},

	/* Gamma Settings */
	{0xFE, 0x04},
	{0x60, 0x00},
	{0x61, 0x0C},
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	{0x7F, 0x00},

	/* Page 0. */
	{0xFE, 0x00},
	{0x11, 0x00},
};

extern int mipi_dsi_dcs_write(const struct device *dev, const uint8_t *buf, uint8_t len);
static int rm68200_generic_write(const struct device *dev, uint8_t *buf,
			    uint8_t len)
{
	struct rm68200_data *drv_data = dev->data;

	return mipi_dsi_dcs_write(drv_data->mipi_dsi, buf, len);
}

static int rm68200_write_all(const struct device *dev,
			    const uint8_t buf[][2],
			    uint16_t reg_num)
{
	uint16_t i = 0;

	for (i = 0; i < reg_num; i++) {
		int err;

		err = rm68200_generic_write(dev, (uint8_t *)buf[i], 2);
		if (err) {
			return err;
		}
	}

	return 0;
}

static int rm68200_init(const struct device *dev)
{
	struct rm68200_data *drv_data = dev->data;
	uint8_t param[2];
	int ret;

	if (drv_data->reset_gpio && drv_data->pwr_gpio) {
		ret = gpio_pin_configure(drv_data->reset_gpio,
					 drv_data->reset_pin,
					 GPIO_OUTPUT_INACTIVE |
					 drv_data->reset_flags);
		if (ret) {
			return ret;
		}
		ret = gpio_pin_configure(drv_data->pwr_gpio,
					 drv_data->pwr_pin,
					 GPIO_OUTPUT_INACTIVE |
					 drv_data->pwr_flags);
		if (ret) {
			return ret;
		}
		ret = gpio_pin_configure(drv_data->bl_gpio,
					 drv_data->bl_pin,
					 GPIO_OUTPUT_INACTIVE |
					 drv_data->bl_flags);
		if (ret) {
			return ret;
		}

		/* pwr:1 -> reset:0 -> reset:1 */
		gpio_pin_set(drv_data->pwr_gpio,
			     drv_data->pwr_pin,
			     1);
		k_sleep(K_MSEC(1));
		gpio_pin_set(drv_data->reset_gpio,
			     drv_data->reset_pin,
			     0);
		k_sleep(K_MSEC(1));
		gpio_pin_set(drv_data->reset_gpio,
			     drv_data->reset_pin,
			     1);
		k_sleep(K_MSEC(5));
	}

	ret = rm68200_write_all(dev, rm68200InitParam, ARRAY_SIZE(rm68200InitParam));
	if (ret) {
		LOG_ERR("Failed to init the reg of the rm68200");
		return -EIO;
	}

	k_sleep(K_MSEC(200));

	param[0] = 0x29;
	param[1] = 0x00;
	rm68200_generic_write(dev, param, 2);

	k_sleep(K_MSEC(100));

	param[0] = 0x2c;
	rm68200_generic_write(dev, param, 1);

	param[0] = 0x35;
	param[1] = 0x00;
	rm68200_generic_write(dev, param, 2);

	k_sleep(K_MSEC(200));

	/* turn the backlight on */
	if (drv_data->bl_gpio) {
		ret = gpio_pin_set(drv_data->bl_gpio,
					 drv_data->bl_pin,
					 1);
		if (ret) {
			return ret;
		}
	}

	return 0;
}

/* Unique Instance */
static struct rm68200_data rm68200_data_0;

#define PANEL_PIN_BINDING(drv_data, pin_type) \
	{ \
		char *pin_name = DT_INST_GPIO_LABEL(0, pin_type ##_gpios); \
		drv_data->pin_type ##_pin = DT_INST_GPIO_PIN(0, pin_type ##_gpios); \
		drv_data->pin_type ##_flags = DT_INST_GPIO_FLAGS(0, pin_type ##_gpios); \
		if (pin_name) { \
			drv_data->pin_type ##_gpio = device_get_binding(pin_name); \
			if (drv_data->pin_type ##_gpio == NULL) { \
				LOG_ERR("Failed to get pointer to %s device!", \
					pin_name); \
			} \
		} \
	}

static int rm68200_init_0(const struct device *dev)
{
	struct rm68200_data *drv_data = dev->data;

	PANEL_PIN_BINDING(drv_data, reset);
	PANEL_PIN_BINDING(drv_data, pwr);
	PANEL_PIN_BINDING(drv_data, bl);

	drv_data->mipi_dsi = device_get_binding(DT_INST_BUS_LABEL(0));
	if (drv_data->mipi_dsi == NULL) {
		LOG_ERR("Failed to get pointer to %s device!",
			DT_INST_LABEL(0));
		return -EINVAL;
	}

	return rm68200_init(dev);
}

DEVICE_DT_INST_DEFINE(0, &rm68200_init_0, device_pm_control_nop,
		    &rm68200_data_0, NULL,
		    POST_KERNEL, CONFIG_APPLICATION_INIT_PRIORITY,
		    NULL);
