## drivers/display/Kconfig.hx8379c
```kconfig
# Copyright 2025 Charles Dias
# SPDX-License-Identifier: Apache-2.0

config HX8379C
	bool "HX8379C display controller driver"
	default y
	depends on DT_HAS_HIMAX_HX8379C_ENABLED
	select MIPI_DSI
	help
	  Enable driver for HX8379C display controller.

if HX8379C

config DISPLAY_HX8379C_INIT_PRIORITY
	int "Initialization priority"
	default APPLICATION_INIT_PRIORITY

	help
	  HX8379C display driver initialization priority.

endif
```

## drivers/display/Kconfig.hx8394
```kconfig
# Copyright 2023 NXP
# SPDX-License-Identifier: Apache-2.0

config HX8394
	bool "HX8394 display driver"
	default y
	depends on MIPI_DSI
	depends on DT_HAS_HIMAX_HX8394_ENABLED
	help
	  Enable driver for HX8394 display driver.
```

## drivers/display/Kconfig.ili9163
```kconfig
# ILI9163 display driver configuration options

#
# Copyright (c) 2020 Jabil Inc.
# SPDX-License-Identifier: Apache-2.0
#

menuconfig ILI9163
	bool "ILI9163 display driver"
	depends on SPI
	help
	Enable driver for ILI9163 display driver.

if ILI9163

choice
	prompt "Color pixel format"
	help
	Specify the color pixel format of the ILI9163 display controller.

config ILI9163_RGB565
	bool "RGB565"

config ILI9163_RGB888
	bool "RGB888"

endchoice

endif #ILI9163
```

## drivers/display/Kconfig.ili9340
```kconfig
# ILI9340 display driver configuration options

# Copyright (c) 2017 Jan Van Winkel <jan.van_winkel@dxplore.eu>
# SPDX-License-Identifier: Apache-2.0

config ILI9340
	bool "ILI9340 display driver"
	depends on SPI
	help
	  Enable driver for ILI9340 display driver.
```

## drivers/display/Kconfig.ili9341
```kconfig
# ILI9XXX display driver configuration options

# Copyright (c) 2017 Jan Van Winkel <jan.van_winkel@dxplore.eu>
# Copyright (c) 2020 Teslabs Engineering S.L.
# Copyright (c) 2021 Krivorot Oleg <krivorot.oleg@gmail.com>
# SPDX-License-Identifier: Apache-2.0

config ILI9341
	bool "ILI9341 display driver"
	default y
```

## drivers/display/Kconfig.ili9342c_esp32s3
```kconfig
# Copyright (c) 2026 NotioNext LTD.
# SPDX-License-Identifier: Apache-2.0

config ILI9342C_ESP32S3
	bool "ESP32 LCD display driver"
	default y
	depends on DT_HAS_ESPRESSIF_ESP32_LCD_ENABLED
	depends on SOC_SERIES_ESP32S3
	select GPIO
	help
	  Enable driver for ESP32-S3 LCD displays using ESP-IDF's esp_lcd component.
	  This driver supports SPI-based LCD panels like ILI9341, ILI9342C, etc.
```

## drivers/display/Kconfig.ili9806e_dsi
```kconfig
# Copyright (c) 2024 Renesas Electronics Corporation
# SPDX-License-Identifier: Apache-2.0

config ILI9806E_DSI
	bool "ILI9806E_DSI display driver"
	default y
	depends on DT_HAS_ILITEK_ILI9806E_DSI_ENABLED
	select MIPI_DSI
	help
	  Enable driver for ILI9806E_DSI display driver.

if ILI9806E_DSI

config DISPLAY_ILI9806E_DSI_INIT_PRIORITY
	int "Initialization priority"
	default 90
	help
	  ILI9806E_DSI display driver initialization priority.

endif
```

## drivers/display/Kconfig.ili9881c_dsi
```kconfig
# Copyright (c) 2025 Renesas Electronics Corporation
# SPDX-License-Identifier: Apache-2.0

config ILI9881C_DSI
	bool "ILI9881C_DSI display driver"
	default y
	depends on DT_HAS_ILITEK_ILI9881C_DSI_ENABLED
	select MIPI_DSI
	help
	  Enable driver for ILI9881C_DSI display driver.

if ILI9881C_DSI

config DISPLAY_ILI9881C_DSI_INIT_PRIORITY
	int "Initialization priority"
	default 90
	help
	  ILI9881C_DSI display driver initialization priority.

endif
```

## drivers/display/Kconfig.ili9xxx
```kconfig
# ILI9XXX display driver configuration options

# Copyright (c) 2017 Jan Van Winkel <jan.van_winkel@dxplore.eu>
# Copyright (c) 2020 Teslabs Engineering S.L.
# Copyright (c) 2021 Krivorot Oleg <krivorot.oleg@gmail.com>
# SPDX-License-Identifier: Apache-2.0

config ILI9XXX
	bool
	help
	  Hidden configuration entry for all ILI9XXX drivers.

config ILI9XXX_READ
	bool "Allow display_read API with ILI9XXX"
	depends on ILI9XXX
	help
	  Support display_read API with ILI9XXX controllers. This API is opt-in,
	  because it adds code overhead and is not very performant due to
	  the requirement to bitshift data read from the ILI9XXX. Note the
	  API only supports RGB565 mode.

config ILI9340
	bool "ILI9340 display driver"
	default y
	depends on DT_HAS_ILITEK_ILI9340_ENABLED
	select MIPI_DBI
	select ILI9XXX
	help
	  Enable driver for ILI9340 display driver.

config ILI9341
	bool "ILI9341 display driver"
	default y
	depends on DT_HAS_ILITEK_ILI9341_ENABLED
	select MIPI_DBI
	select ILI9XXX
	help
	  Enable driver for ILI9341 display driver.

config ILI9342C
	bool "ILI9342C display driver"
	default y
	depends on DT_HAS_ILITEK_ILI9342C_ENABLED
	select MIPI_DBI
	select ILI9XXX
	help
	  Enable driver for ILI9342C display driver.

config ILI9488
	bool "ILI9488 display driver"
	default y
	depends on DT_HAS_ILITEK_ILI9488_ENABLED
	select MIPI_DBI
	select ILI9XXX
	help
	  Enable driver for ILI9488 display driver.
```

## drivers/display/Kconfig.infineon_dc
```kconfig
# Copyright (c) 2026 Infineon Technologies AG,
# or an affiliate of Infineon Technologies AG.
#
# SPDX-License-Identifier: Apache-2.0

config INFINEON_DISPLAY_CONTROLLER
	bool "Infineon display controller driver"
	default y
	depends on DT_HAS_INFINEON_DISPLAY_CONTROLLER_ENABLED
	help
	  Infineon display controller driver
```

## drivers/display/Kconfig.intel_multibootfb
```kconfig
# Copyright (c) 2017 Intel Corporation
# SPDX-License-Identifier: Apache-2.0

config INTEL_MULTIBOOTFB_DISPLAY
	bool "Intel Multiboot Framebuffer"
	default y
	depends on MULTIBOOT && MULTIBOOT_INFO
	help
	  Enable Intel Multiboot framebuffer-based display driver.

if INTEL_MULTIBOOTFB_DISPLAY

config INTEL_MULTIBOOTFB_X
	int "Multiboot framebuffer X pixels"
	default 640

config INTEL_MULTIBOOTFB_Y
	int "Multiboot framebuffer Y pixels"
	default 480

endif # INTEL_MULTIBOOTFB_DISPLAY
```

## drivers/display/Kconfig.ist3931
```kconfig
# Copyright 2024 XuYang Shen <shenxuyang@shlinyuantech.com>
# SPDX-License-Identifier: Apache-2.0

config IST3931
	bool "IST3931 display driver"
	default y
	depends on DT_HAS_ISTECH_IST3931_ENABLED
	select I2C
	help
	  Enable driver for IST3931 display driver.
```

## drivers/display/Kconfig.it8951
```kconfig
# Copyright 2026 The Zephyr Project Contributors
# SPDX-License-Identifier: Apache-2.0

config IT8951
	bool "ITE IT8951 e-paper display controller"
	default y
	depends on DT_HAS_ITE_IT8951_ENABLED
	select SPI
	help
	  Enable driver for ITE IT8951 timing controllers used by SPI/I80
	  e-paper display modules, including ED103TC2-based panels.
```

## drivers/display/Kconfig.jdi
```kconfig
# Copyright (c) 2019, NXP
# SPDX-License-Identifier: Apache-2.0

menuconfig DISPLAY_JDI
	bool "JDI driver"
	help
	  Enable support for mcux eLCDIF driver.

if DISPLAY_JDI

choice JDI_CLOCK_GEN_MODE
	prompt "Clock generation method"
	default JDI_CLOCK_GEN_SPI_DMA_REQUEST
	help
	  Specify the type of the clock generation method.

config JDI_CLOCK_GEN_SPI_DMA_REQUEST
	bool "Use DMA Request of SPI to generate clock"
	select SPI_MCUX_FLEXCOMM_DMA
	help
	  It may happen that the SHIFTBUF data is overwritten by the
	  new data before the current SHIFTBUF data has been sent.

config JDI_CLOCK_GEN_CTIMER_TRIGGER
	bool "Use CTimer trigger to generate clock"
	help
	  Using the CTIMER trigger method can control the timing more finely,
	  and avoid the SHIFTBUF being overwritten by new data before it has
	  finished shifting the data. 
	  Notice: the first clock pattern can't send via DMA and the CS pin
	  of the SPI cannot be configured in the device tree.

endchoice

endif # DISPLAY_JDI
```

## drivers/display/Kconfig.ks0108
```kconfig
# Copyright (c) 2021 Zisis Adamos <zisarono@gmail.com>
# SPDX-License-Identifier: Apache-2.0

config KS0108
	bool "KS0108 compatible display controller driver"
	depends on GPIO
	help
	  Enable driver for KS0108 compatible controller.
```

## drivers/display/Kconfig.led_strip_matrix
```kconfig
# Copyright (c) 2024 TOKITA Hiroshi
# SPDX-License-Identifier: Apache-2.0

config LED_STRIP_MATRIX
	bool "LED strip matrix display driver"
	default y
	depends on DT_HAS_LED_STRIP_MATRIX_ENABLED
	depends on LED_STRIP
	help
	  Enable LED strip matrix display (LED strip arranged in
	  a grid pattern) driver.
```

## drivers/display/Kconfig.lpm013m126
```kconfig
# Copyright (c) 2025 Silicon Signals Pvt. Ltd.
# SPDX-License-Identifier: Apache-2.0

config LPM013M126
	bool "LPM013M126 memory display controller driver"
	default y
	depends on DT_HAS_JDI_LPM013M126_ENABLED
	select SPI
	help
		Enable driver for JDI memory display series LPM013M126
```

## drivers/display/Kconfig.lpm013m126a
```kconfig
# Copyright (c) 2025 Silicon Signals Pvt. Ltd.
# SPDX-License-Identifier: Apache-2.0

config LPM013M126A
	bool "LPM013M126A memory display controller driver"
	default y
	depends on DT_HAS_JDI_LPM013M126A_ENABLED
	select SPI
	help
		Enable driver for JDI memory display series LPM013M126A
```

## drivers/display/Kconfig.lpm0xx
```kconfig
# Copyright (c) 2020 Rohit Gujarathi
# SPDX-License-Identifier: Apache-2.0

config LPM0XX
	bool "LPM0XX memory display controller driver"
    default y
    depends on DT_HAS_SHARP_LPM0XX_ENABLED
	depends on SPI
	help
	  Enable driver for sharp memory display series LPM0XXMXXXX
```

## drivers/display/Kconfig.ls013b7dh03
```kconfig
# Copyright (c) 2024 PineTime Project
# SPDX-License-Identifier: Apache-2.0

config DISPLAY_LS013B7DH03
	bool "JDI LS013B7DH03 memory LCD display driver"
	default y
	depends on DT_HAS_JDI_LS013B7DH03_ENABLED
	select JDI
	help
	  Enable driver for JDI LS013B7DH03 memory LCD display.
```

## drivers/display/Kconfig.ls013b7dh05
```kconfig
# Kconfig - LS013B7DH05 display driver configuration options

#
# Copyright (c) 2018 Miras Absar
#
# SPDX-License-Identifier: Apache-2.0
#

menuconfig LS013B7DH05
	bool "LS013B7DH05 display driver"
	depends on SPI
	help
	Enable the LS013B7DH05 display driver.

if LS013B7DH05

config LS013B7DH05_DEV_NAME
	string "LS013B7DH05 device name"
	default "LS013B7DH05"

config LS013B7DH05_SPI_DEV_NAME
	string "SPI master device name where an LS013B7DH05 is connected"
	default "SPI_0"

config LS013B7DH05_SPI_DEV_NUM
	int "SPI slave device number where an LS013B7DH05 is connected"
	default 0

config LS013B7DH05_SPI_DEV_FREQ
	int "SPI device frequency where an LS013B7DH05 is connected"
	default 1000000

config LS013B7DH05_SCS_GPIO_PORT_NAME
	string "GPIO port name where an LS013B7DH05's chip select is connected"
	default "GPIO_0"

config LS013B7DH05_SCS_GPIO_PIN_NUM
	int "GPIO pin number where an LS013B7DH05's chip select is connected"
	default 1

endif #LS013B7DH05
```

## drivers/display/Kconfig.ls014b7dd01
```kconfig
# Copyright (c) 2025 Ambiq Micro Inc.
# SPDX-License-Identifier: Apache-2.0

config LS014B7DD01
	bool "Sharp LS014B7DD01 display driver"
	default y
	depends on DT_HAS_SHARP_LS014B7DD01_ENABLED
	select JDI
	help
	  Enable driver for Sharp LS014B7DD01 display.
```

## drivers/display/Kconfig.ls0xx
```kconfig
# Copyright (c) 2020 Rohit Gujarathi
# SPDX-License-Identifier: Apache-2.0

config LS0XX
	bool "LS0XX memory display controller driver"
	default y
	depends on DT_HAS_SHARP_LS0XX_ENABLED
	select SPI
	help
	  Enable driver for sharp memory display series LS0XXX7DXXX

config LS0XX_VCOM_THREAD_PRIO
	int "Priority for the VCOM inversion thread"
	default 3
	depends on LS0XX
	help
	  Set the VCOM inversion thread priority
```

## drivers/display/Kconfig.lt7680
```kconfig
# Copyright (c) 2025 JUMO GmbH & Co. KG
# SPDX-License-Identifier: Apache-2.0

config LT7680
	bool "LT7680 display driver"
	default y
	depends on DT_HAS_LEVETOP_LT7680_ENABLED
	select SPI
	help
	  Levetop Ltd. LT7680 display driver.

if LT7680

config LT7680_TRANSMIT_DATA_AS_BURST
	bool "Transmit data as burst without FIFO check"
	default y
	help
	  Enable this option to transmit data as a burst without checking the FIFO.

config LT7680_READ_DATA_AS_BURST
	bool "Read data as burst"
	default y
	help
	  Enable this option to read data as a burst.

endif
```

## drivers/display/Kconfig.max7219
```kconfig
# Copyright (c) 2022 Jimmy Ou <yanagiis@gmail.com>
# SPDX-License-Identifier: Apache-2.0

config MAX7219
	bool "MAX7219 LED display driver"
	default y
	depends on DT_HAS_MAXIM_MAX7219_ENABLED
	select SPI
	help
	  Enable driver for the Maxim MAX7219 SPI LED display driver.
	  It is supporting up to 64 individual LEDs per MAX7219.
```
