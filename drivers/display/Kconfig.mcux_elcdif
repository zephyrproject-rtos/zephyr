## drivers/display/Kconfig.ssd1306
```kconfig
# SSD1306 display controller configuration options

# Copyright (c) 2018 Phytec Messtechnik GmbH
# SPDX-License-Identifier: Apache-2.0

menuconfig SSD1306
	bool "SSD1306 display driver"
	default y
	depends on DT_HAS_SOLOMON_SSD1306_ENABLED \
		|| DT_HAS_SOLOMON_SSD1306B_ENABLED || DT_HAS_SOLOMON_SSD1315_ENABLED \
		|| DT_HAS_SOLOMON_SSD1309_ENABLED || DT_HAS_SOLOMON_SSD1305_ENABLED \
		|| DT_HAS_SINOWEALTH_SH1106_ENABLED || DT_HAS_SINOWEALTH_SH1107_ENABLED \
		|| DT_HAS_CHIPWEALTH_CH1115_ENABLED || DT_HAS_CHIPWEALTH_CH1116_ENABLED
	select I2C if $(dt_compat_on_bus,$(DT_COMPAT_SOLOMON_SSD1306),i2c)
	select SPI if $(dt_compat_on_bus,$(DT_COMPAT_SOLOMON_SSD1306),spi)
	select I2C if $(dt_compat_on_bus,$(DT_COMPAT_SOLOMON_SSD1306B),i2c)
	select SPI if $(dt_compat_on_bus,$(DT_COMPAT_SOLOMON_SSD1306B),spi)
	select I2C if $(dt_compat_on_bus,$(DT_COMPAT_SOLOMON_SSD1315),i2c)
	select SPI if $(dt_compat_on_bus,$(DT_COMPAT_SOLOMON_SSD1315),spi)
	select I2C if $(dt_compat_on_bus,$(DT_COMPAT_SOLOMON_SSD1309),i2c)
	select SPI if $(dt_compat_on_bus,$(DT_COMPAT_SOLOMON_SSD1309),spi)
	select I2C if $(dt_compat_on_bus,$(DT_COMPAT_SOLOMON_SSD1305),i2c)
	select SPI if $(dt_compat_on_bus,$(DT_COMPAT_SOLOMON_SSD1305),spi)
	select I2C if $(dt_compat_on_bus,$(DT_COMPAT_SINOWEALTH_SH1106),i2c)
	select SPI if $(dt_compat_on_bus,$(DT_COMPAT_SINOWEALTH_SH1106),spi)
	select I2C if $(dt_compat_on_bus,$(DT_COMPAT_SINOWEALTH_SH1107),i2c)
	select SPI if $(dt_compat_on_bus,$(DT_COMPAT_SINOWEALTH_SH1107),spi)
	select I2C if $(dt_compat_on_bus,$(DT_COMPAT_CHIPWEALTH_CH1115),i2c)
	select SPI if $(dt_compat_on_bus,$(DT_COMPAT_CHIPWEALTH_CH1115),spi)
	select I2C if $(dt_compat_on_bus,$(DT_COMPAT_CHIPWEALTH_CH1116),i2c)
	select SPI if $(dt_compat_on_bus,$(DT_COMPAT_CHIPWEALTH_CH1116),spi)
	help
	  Enable driver for SSD1306 display driver.

if SSD1306

config SSD1306_DEFAULT_CONTRAST
	int "SSD1306 default contrast"
	default 128
	range 0 $(UINT8_MAX)
	help
	  SSD1306 default contrast.

endif # SSD1306
```

## drivers/display/Kconfig.ssd1320
```kconfig
# SSD1320 display controller configuration options
# Copyright (c) 2025 MASSDRIVER EI (massdriver.space)
# SPDX-License-Identifier: Apache-2.0

menuconfig SSD1320
	bool "SSD1320 display controller driver"
	default y
	depends on DT_HAS_SOLOMON_SSD1320_ENABLED
	select MIPI_DBI if $(dt_compat_on_bus,$(DT_COMPAT_SOLOMON_SSD1320),mipi-dbi)
	select I2C if $(dt_compat_on_bus,$(DT_COMPAT_SOLOMON_SSD1320),i2c)
	help
	  Enable driver for SSD1320 display controller.

if SSD1320

config SSD1320_DEFAULT_CONTRAST
	int "SSD1320 default contrast"
	default 128
	range 0 255
	help
	  SSD1320 default contrast.

config SSD1320_CONV_BUFFER_LINES
	int "How many lines can the conversion buffer hold"
	default 16
	range 1 160

endif # SSD1327
```

## drivers/display/Kconfig.ssd1322
```kconfig
# Copyright (c) 2024 Lukasz Hawrylko
# SPDX-License-Identifier: Apache-2.0

config SSD1322
	bool "SSD1322 display driver"
	default y
	depends on DT_HAS_SOLOMON_SSD1322_ENABLED
	select MIPI_DBI
	help
	  Enable driver for SSD1322 display driver.

if SSD1322

config SSD1322_DEFAULT_GRAYSCALE
	bool "SSD1322 default mode is grayscale"
	help
	  Sets grayscale mode as default mode

config SSD1322_CONV_BUFFER_LINES
	int "Number of lines the conversion buffer can hold"
	default 16
	range 1 128

endif # SSD1322
```

## drivers/display/Kconfig.ssd1327
```kconfig
# SSD1327 display controller configuration options

# Copyright (c) 2024 Savoir-faire Linux
# SPDX-License-Identifier: Apache-2.0

menuconfig SSD1327
	bool "SSD1327 display controller driver"
	default y
	depends on DT_HAS_SOLOMON_SSD1327FB_ENABLED
	select I2C if $(dt_compat_on_bus,$(DT_COMPAT_SOLOMON_SSD1327FB),i2c)
	select MIPI_DBI if $(dt_compat_on_bus,$(DT_COMPAT_SOLOMON_SSD1327FB),mipi-dbi)
	help
	  Enable driver for SSD1327 display.

if SSD1327

config SSD1327_DEFAULT_CONTRAST
	int "SSD1327 default contrast"
	default 128
	range 0 255
	help
	  SSD1327 default contrast.

config SSD1327_CONV_BUFFER_LINES
	int "How many lines can the conversion buffer hold"
	default 1
	range 1 128

endif # SSD1327
```

## drivers/display/Kconfig.ssd1327_5
```kconfig
# SSD1327 and SSD1325 display controller configuration options

# Copyright (c) 2024 Savoir-faire Linux
# Copyright (c) 2025-2026 MASSDRIVER EI (massdriver.space)
# SPDX-License-Identifier: Apache-2.0

menuconfig SSD1327_5
	bool "SSD1327/5 display controller driver"
	default y
	depends on DT_HAS_SOLOMON_SSD1327_ENABLED || DT_HAS_SOLOMON_SSD1325_ENABLED
	select I2C if $(dt_compat_on_bus,$(DT_COMPAT_SOLOMON_SSD1327),i2c) \
		||  $(dt_compat_on_bus,$(DT_COMPAT_SOLOMON_SSD1325),i2c)
	select MIPI_DBI if $(dt_compat_on_bus,$(DT_COMPAT_SOLOMON_SSD1327),mipi-dbi) \
		|| $(dt_compat_on_bus,$(DT_COMPAT_SOLOMON_SSD1325),mipi-dbi)
	help
	  Enable driver for SSD1327 and SSD1325 display controllers.

if SSD1327_5

config SSD1327_DEFAULT_CONTRAST
	int "SSD1327 default contrast"
	default 128
	range 0 255
	help
	  SSD1327 default contrast.

config SSD1327_CONV_BUFFER_LINES
	int "How many lines can the conversion buffer hold"
	default 1
	range 1 128

config SSD1325_DEFAULT_CONTRAST
	int "SSD1325 default contrast"
	default 128
	range 0 255
	help
	  SSD1325 default contrast.

config SSD1325_CONV_BUFFER_LINES
	int "How many lines can the conversion buffer hold"
	default 1
	range 1 128

endif # SSD1327_5
```

## drivers/display/Kconfig.ssd1331
```kconfig
# SSD1331 display controller configuration options
# Copyright (c) 2025 MASSDRIVER EI (massdriver.space)
# SPDX-License-Identifier: Apache-2.0

menuconfig SSD1331
	bool "SSD1331 display controller driver"
	default y
	depends on DT_HAS_SOLOMON_SSD1331_ENABLED
	select MIPI_DBI
	help
	  Enable driver for SSD1331 display controller.

if SSD1331

config SSD1331_DEFAULT_CONTRAST
	int "SSD1331 default contrast"
	default 100
	range 0 255
	help
	  SSD1331 default contrast.

config SSD1331_CONTRASTA
	int "SSD1331 contrast multiplier for seg A"
	default 145
	range 0 255
	help
	  Contrast multiplier for seg A

config SSD1331_CONTRASTB
	int "SSD1331 contrast multiplier for seg B"
	default 80
	range 0 255
	help
	  Contrast multiplier for seg B

config SSD1331_CONTRASTC
	int "SSD1331 contrast multiplier for seg C"
	default 125
	range 0 255
	help
	  Contrast multiplier for seg C

endif # SSD1331
```

## drivers/display/Kconfig.ssd1351
```kconfig
# SSD1351 display controller configuration options
# Copyright (c) 2025 MASSDRIVER EI (massdriver.space)
# SPDX-License-Identifier: Apache-2.0

menuconfig SSD1351
	bool "SSD1351 display controller driver"
	default y
	depends on DT_HAS_SOLOMON_SSD1351_ENABLED
	select MIPI_DBI
	help
	  Enable driver for SSD1351 display controller.

if SSD1351

config SSD1351_DEFAULT_CONTRAST
	int "SSD1351 default contrast"
	default 100
	range 0 255
	help
	  SSD1351 default contrast.

config SSD1351_CONTRASTA
	int "SSD1351 contrast multiplier for seg A"
	default 145
	range 0 255
	help
	  Contrast multiplier for seg A

config SSD1351_CONTRASTB
	int "SSD1351 contrast multiplier for seg B"
	default 80
	range 0 255
	help
	  Contrast multiplier for seg B

config SSD1351_CONTRASTC
	int "SSD1351 contrast multiplier for seg C"
	default 125
	range 0 255
	help
	  Contrast multiplier for seg C

endif # SSD1351
```
