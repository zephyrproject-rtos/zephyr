## drivers/display/Kconfig.mcux_elcdif
```kconfig
# Copyright 2019,2023-2024 NXP
# Copyright (c) 2022, Basalte bv
# SPDX-License-Identifier: Apache-2.0


menuconfig DISPLAY_MCUX_ELCDIF
	bool "MCUX eLCDIF driver"
	default y
	depends on DT_HAS_NXP_IMX_ELCDIF_ENABLED
	select PINCTRL
	help
	  Enable support for mcux eLCDIF driver.

if DISPLAY_MCUX_ELCDIF

config MCUX_ELCDIF_FB_NUM
	int "Framebuffers to allocate in driver"
	default 2
	range 0 2
	help
	  Number of framebuffers to allocate in ELCDIF driver. Driver allocated
	  framebuffers are required to support partial display updates.
	  The driver has been validated to support 0 through 2 framebuffers.
	  Note that hardware will likely perform best if zero driver
	  framebuffers are allocated by the driver, and the application
	  implements double framebuffering by always calling display_write with
	  a buffer equal in size to the connected panel.

config MCUX_ELCDIF_FB_SIZE
	int "Framebuffer size required by the eLCDIF driver"
	default 3686400
	help
	  eLCDIF driver allocates framebuffers to support partial display updates.
	  The framebuffer size is computed as : panel_width * panel_height * bpp.
	  The default value is set to afford for a default resolution of 1280x720 and
	  4-bytes pixel format, e.g. ARGB8888. Applications should change this value
	  according to the actual used resolution and format to optimize the heap size.

config MCUX_ELCDIF_START_ON_INIT
	bool "Start the ELCDIF display driver during initialization"
	default y if MCUX_ELCDIF_FB_NUM != 0
	help
	  Optionally start the ELCDIF display driver from the initialization step,
	  which can be required for some connected display controllers to function properly.

endif # DISPLAY_MCUX_ELCDIF
```

## drivers/display/Kconfig.mcux_mipi_dsi
```kconfig
# NXP MCUX MIPI DSI driver configuration options

# Copyright (c) 2019, Linaro Limited
# SPDX-License-Identifier: Apache-2.0

config DISPLAY_MCUX_MIPI_DSI
	bool "NXP MCUX MIPI DSI driver"
	depends on HAS_MCUX_MIPI_DSI
```

## drivers/display/Kconfig.microbit
```kconfig
# Microbit display driver configuration options

# Copyright (c) 2017 Jan Van Winkel <jan.van_winkel@dxplore.eu>
# Copyright (c) 2021 Peter Niebert <peter.niebert@univ-amu.fr>
# SPDX-License-Identifier: Apache-2.0

config MICROBIT_DISPLAY
	bool "BBC micro:bit 5x5 LED Display support"
	depends on BOARD_BBC_MICROBIT || BOARD_BBC_MICROBIT_V2
	depends on PRINTK
	help
	  Enable this to be able to display images and text on the 5x5
	  LED matrix display on the BBC micro:bit.

config MICROBIT_DISPLAY_STR_MAX
	int "Maximum length of strings that can be shown on the display"
	range 3 255
	default 40
	depends on MICROBIT_DISPLAY
	help
	  This value specifies the maximum length of strings that can
	  be displayed using the mb_display_string() and mb_display_print()
	  APIs.

config MICROBIT_DISPLAY_TIMER
	int "NRFX Timer Instance for use with mb_display.cpp"
	default 2
	depends on MICROBIT_DISPLAY
	help
	  Dedicated NRFX Timer for Microbit Screen


config MICROBIT_DISPLAY_TIMER_PRIORITY
	int "NRFX Timer Interrupt priority"
	default 1
	depends on MICROBIT_DISPLAY
	help
	  Dedicated NRFX Timer for Microbit Screen
```

## drivers/display/Kconfig.nrf_led_matrix
```kconfig
# Copyright (c) 2021, Nordic Semiconductor ASA
# SPDX-License-Identifier: Apache-2.0

config DISPLAY_NRF_LED_MATRIX
	bool "LED matrix driven by GPIOs"
	default y
	depends on DT_HAS_NORDIC_NRF_LED_MATRIX_ENABLED
	select NRFX_GPIOTE
	select NRFX_PPI if HAS_HW_NRF_PPI
	help
	  Enable driver for a LED matrix with rows and columns driven by
	  GPIOs. The driver allows setting one of 256 levels of brightness
	  (where 0 means off completely) for each of the LEDs independently.
	  Assignment of GPIOs to rows and columns and the mapping of those
	  to pixels are specified in properties of a "nordic,nrf-led-matrix"
	  compatible node in devicetree.
	  The driver uses one TIMER instance and, depending on what is set in
	  devicetree, one PWM instance or one or more GPIOTE and PPI channels
	  (the latter value depends on the chosen pixel group size - the number
	  of LEDs in one row that can be lit simultaneously).
```

## drivers/display/Kconfig.nt35510
```kconfig
# Copyright (c) 2024 Erik Andersson <erian747@gmail.com>
# Copyright (c) 2025 Ambiq Micro Inc.
# SPDX-License-Identifier: Apache-2.0

config NT35510
	bool "NT35510 display driver"
	default y
	depends on DT_HAS_FRIDA_NT35510_ENABLED || DT_HAS_NOVATEK_NT35510_ENABLED
	select MIPI_DSI if $(dt_compat_on_bus,$(DT_COMPAT_FRIDA_NT35510),mipi-dsi)
	select MIPI_DBI if $(dt_compat_on_bus,$(DT_COMPAT_NOVATEK_NT35510),mipi-dbi)
	help
	  Enable driver for NT35510 display driver.

if NT35510

config DISPLAY_NT35510_INIT_PRIORITY
	int "Initialization priority"
	default DISPLAY_INIT_PRIORITY
	help
	  NT35510 display driver initialization priority.

endif
```

## drivers/display/Kconfig.pcd8544
```kconfig
# PCD8544 display controller configuration options

# Copyright (c) 2025 LACOMBE Quentin <quentlace2g@gmail.com>
# SPDX-License-Identifier: Apache-2.0

config PCD8544
	bool "PCD8544 LCD display controller driver"
	default y
	depends on DT_HAS_PHILIPS_PCD8544_ENABLED
	select MIPI_DBI
	help
	  Enable PCD8544 display controller driver
```

## drivers/display/Kconfig.qemu_ramfb
```kconfig
# Copyright (c) 2026 Maximilian Zimmermann
# SPDX-License-Identifier: Apache-2.0

config QEMU_RAMFB_DISPLAY
	bool "QEMU ramfb"
	default y
	depends on DT_HAS_QEMU_RAMFB_ENABLED
	depends on DT_HAS_QEMU_FW_CFG_MMIO_ENABLED || DT_HAS_QEMU_FW_CFG_IOPORT_ENABLED
	select QEMU_FWCFG
	help
	  Enable QEMU ramfb framebuffer-based display driver.
```

## drivers/display/Kconfig.renesas_lcdc
```kconfig
# Smartbond display controller configuration options

# Copyright (c) 2023 Renesas Electronics Corporation
# SPDX-License-Identifier: Apache-2.0

config DISPLAY_RENESAS_LCDC
	bool "Smartbond display controller driver"
	depends on DT_HAS_RENESAS_SMARTBOND_DISPLAY_ENABLED
	select DMA
	default y
	help
	  Enable Smartbond display controller.

config DISPLAY_RENESAS_LCDC_BUFFER_PSRAM
	bool "Allocate the display buffer into PSRAM"
	depends on DISPLAY_RENESAS_LCDC
	select MEMC
	help
	  Allocate the display buffer into PSRAM
```

## drivers/display/Kconfig.renesas_ra
```kconfig
# Renesas RA Family

# Copyright (c) 2024-2025 Renesas Electronics Corporation
# SPDX-License-Identifier: Apache-2.0

config RENESAS_RA_GLCDC
	bool "Renesas display controller driver"
	default y
	depends on DT_HAS_RENESAS_RA_GLCDC_ENABLED
	select USE_RA_FSP_DISPLAY
	help
	  Enable Renesas display controller.

if RENESAS_RA_GLCDC

config RENESAS_RA_GLCDC_FB_NUM
	int "Frame buffer number"
	default 2
	range 0 2
	help
	  RENESAS RA GLCDC frame buffer number config:
	    - 0 frame buffer maintained by application, must write with full screen pixels.
	    - 1 single frame buffer in RENESAS RA GLCDC driver.
	    - 2 double frame buffer in RENESAS RA GLCDC driver.

config RENESAS_RA_GLCDC_FRAME_BUFFER_SECTION
	string "RAM memory section to place frame buffer"
	depends on RENESAS_RA_GLCDC_FB_NUM > 0
	help
	  RAM memory section name to place frame buffer.
	  Example: to place display frame buffer in external SDRAM (.sdram section)
	    CONFIG_RENESAS_RA_GLCDC_FRAME_BUFFER_SECTION=".sdram"

config RENESAS_RA_DISPLAY_EVENT_CB_MAX
        int "Maximum number of registered display event callbacks"
        default 2
        range 1 16
        help
          Maximum number of event callbacks that can be simultaneously
          registered with a Renesas RA display driver instance.
          Each entry consumes a small amount of static memory per
          display device instance.

endif # RENESAS_RA_GLCDC
```

## drivers/display/Kconfig.rm67199
```kconfig
# Copyright 2025 NXP
# SPDX-License-Identifier: Apache-2.0

config RM67199
	bool "RM67199 display controller driver"
	default y
	select MIPI_DSI
	depends on DT_HAS_RAYDIUM_RM67199_ENABLED
	help
	  Enable driver for RM67199 display controller.
```

## drivers/display/Kconfig.rm68200
```kconfig
# Copyright 2022, NXP
# SPDX-License-Identifier: Apache-2.0

DT_COMPAT_RM68200 := raydium,rm68200

config RM68200
	bool "RM68200 display driver"
	depends on MIPI_DSI
	default $(dt_compat_enabled,$(DT_COMPAT_RM68200))
	help
	  Enable driver for RM68200 display driver.
```

## drivers/display/Kconfig.rm692c9
```kconfig
# Copyright 2025 NXP
# SPDX-License-Identifier: Apache-2.0

config RM692C9
	bool "RM692C9 display controller driver"
	default y
	select MIPI_DSI
	depends on DT_HAS_RAYDIUM_RM692C9_ENABLED
	help
	  Enable driver for RM692C9 display controller.
```

## drivers/display/Kconfig.rpi_bcm2711_fb
```kconfig
# Copyright (c) 2026 Muhammad Waleed Badar
# SPDX-License-Identifier: Apache-2.0

config RASPBERRYPI_BCM2711_FRAMEBUFFER
	bool "Raspberry Pi BCM2711 framebuffer"
	default y
	depends on DT_HAS_RASPBERRYPI_BCM2711_FRAMEBUFFER_ENABLED
	select RASPBERRYPI_FIRMWARE
	help
	  Enable Raspberry Pi BCM2711 framebuffer display driver.
```

## drivers/display/Kconfig.sdl
```kconfig
# SDL based emulated display configuration options

# Copyright (c) 2018 Jan Van Winkel <jan.van_winkel@dxplore.eu>
# SPDX-License-Identifier: Apache-2.0

menuconfig SDL_DISPLAY
	bool "SDL based emulated display"
	default y
	depends on DT_HAS_ZEPHYR_SDL_DC_ENABLED
	select HAS_SDL
	help
	  Enable SDL based emulated display compliant with display driver API.

if SDL_DISPLAY

choice SDL_DISPLAY_DEFAULT_PIXEL_FORMAT
	prompt "Default pixel format"
	default SDL_DISPLAY_DEFAULT_PIXEL_FORMAT_ARGB_8888
	help
	  Default pixel format to be used by the display

	config SDL_DISPLAY_DEFAULT_PIXEL_FORMAT_ARGB_8888
		bool "ARGB 8888"

	config SDL_DISPLAY_DEFAULT_PIXEL_FORMAT_RGB_888
		bool "RGB 888"

	config SDL_DISPLAY_DEFAULT_PIXEL_FORMAT_MONO01
		bool "Mono Black=0"

	config SDL_DISPLAY_DEFAULT_PIXEL_FORMAT_MONO10
		bool "Mono Black=1"

	config SDL_DISPLAY_DEFAULT_PIXEL_FORMAT_RGB_565
		bool "RGB 565"

	config SDL_DISPLAY_DEFAULT_PIXEL_FORMAT_BGR_565
		bool "BGR 565"

endchoice

config SDL_DISPLAY_ZOOM_PCT
	int "Default zoom percentage"
	default 100
	range 10 10000
	help
	  SDL window zoom percentage to adjust readability on small screens

config SDL_DISPLAY_USE_HARDWARE_ACCELERATOR
	bool "Use hardware accelerator"
	default y
	help
	  Enable hardware acceleration for graphics rendering

config SDL_DISPLAY_MONO_MSB_FIRST
	bool "Configure bit order in monochrome formats to MSB first"
	default y
	help
	  If selected, set the MSB to represent the first pixel.
	  This applies when the pixel format is MONO01/MONO10.

config SDL_DISPLAY_TRANSPARENCY_GRID_CELL_SIZE
	int "Transparency grid cell size"
	default 8
	help
	  The size of the checkerboard pattern squares, in pixels.

config SDL_DISPLAY_TRANSPARENCY_GRID_CELL_COLOR_1
	hex "Transparency grid cell color 1"
	default 0xcccccc
	help
	  The color of the odd cells in the transparency grid.

config SDL_DISPLAY_TRANSPARENCY_GRID_CELL_COLOR_2
	hex "Transparency grid cell color 2"
	default 0xbbbbbb
	help
	  The color of the even cells in the transparency grid.

endif # SDL_DISPLAY
```

## drivers/display/Kconfig.sh1122
```kconfig
# SH1122 display controller configuration options
# Copyright (c) 2025 MASSDRIVER EI (massdriver.space)
# SPDX-License-Identifier: Apache-2.0

menuconfig SH1122
	bool "SH1122 display controller driver"
	default y
	depends on DT_HAS_SINOWEALTH_SH1122_ENABLED
	select MIPI_DBI if $(dt_compat_on_bus,$(DT_COMPAT_SINOWEALTH_SH1122),mipi-dbi)
	select I2C if $(dt_compat_on_bus,$(DT_COMPAT_SINOWEALTH_SH1122),i2c)
	help
	  Enable driver for SH1122 display controller.

if SH1122

config SH1122_DEFAULT_CONTRAST
	int "SH1122 default contrast"
	default 16
	range 0 255
	help
	  SH1122 default contrast.

endif # SH1122
```

## drivers/display/Kconfig.sh8501a
```kconfig
# SPDX-FileCopyrightText: Copyright The Zephyr Project Contributors
# SPDX-License-Identifier: Apache-2.0

config SH8501A
	bool "SH8501A display driver"
	default y
	depends on DT_HAS_SHENGHE_SH8501A_ENABLED
	select MSPI
	help
	  Enable the MSPI display SH8501A driver.

if SH8501A

	config SH8501A_USE_TE
	bool "Tearing-effect interrupt"
	default n
	help
	  Enables the tearing-effect GPIO interrupt

endif
```

## drivers/display/Kconfig.sii9022a
```kconfig
# SII9022A HDMI/DVI bridge driver

# Copyright (c) 2026 Texas Instruments Incorporated
# SPDX-License-Identifier: Apache-2.0

config SII9022A
	bool "Silicon Image SII9022A HDMI/DVI bridge driver"
	default y
	depends on DT_HAS_SIL_SII9022A_ENABLED
	select I2C
	help
	  Enable driver for the Silicon Image SII9022A HDMI/DVI transmitter
	  bridge.  The chip accepts a parallel DPI/RGB input (with
	  separate DE, HSYNC and VSYNC signals) and outputs HDMI or DVI.
	  Configured via I2C.

if SII9022A

config SII9022A_INIT_PRIORITY
	int "SII9022A initialisation priority"
	default 86
	help
	  Device initialisation priority for the SII9022A bridge.  Must be
	  greater (numerically) than CONFIG_DISPLAY_INIT_PRIORITY (default 85)
	  because the display-controller phandle on the SII9022A DT node creates
	  a Zephyr device dependency — the display controller must be initialised
	  first.

endif # SII9022A
```

## drivers/display/Kconfig.socionext_dpu
```kconfig
# Copyright 2025 NXP
# SPDX-License-Identifier: Apache-2.0

menuconfig DISPLAY_SOCIONEXT_DPU
	bool "Socionext DPU driver"
	default y
	depends on DT_HAS_SOCIONEXT_DPU_ENABLED
	help
	  Enable support for dpu driver.

if DISPLAY_SOCIONEXT_DPU

config DPU_FB_NUM
	int "Framebuffers to allocate in driver"
	default 2
	range 0 2
	help
	  Number of framebuffers to allocate in DPU driver. Driver allocated
	  framebuffers are required to support partial display updates.
	  The driver has been validated to support 0 through 2 framebuffers.
	  Note that hardware will likely perform best if zero driver
	  framebuffers are allocated by the driver, and the application
	  implements double framebuffering by always calling display_write with
	  a buffer equal in size to the connected panel.

	  NOTE: when no framebuffers are allocated, the DPU will be
	  set to display an empty buffer during initialization. This means
	  the display will show what is effectively a dump of
	  system RAM until a new framebuffer is written. If the security
	  implications of this concern you, leave at least one driver
	  framebuffer enabled.

config DPU_FB_SIZE
	int "Framebuffer size required by the dpu driver"
	default 10108800
	help
	  DPU driver allocates framebuffers to support partial display updates.
	  The framebuffer size is computed as : panel_width * panel_height * bpp.
	  The default value is set to afford for a default resolution of 1080x2340 and
	  4-bytes pixel format, e.g. ARGB8888. Applications should change this value
	  according to the actual used resolution and format to optimize the heap size.

config DPU_EXTERNAL_FB_MEM
	bool "Use external memory for framebuffer"
	imply MEMC
	help
	  Use external memory for framebuffer. Configures the DPU to write
	  framebuffer data to a memory mapped external device.

	  Note that no specific linker section is used for this framebuffer, so
	  if the application uses the external memory for other purposes, care
	  should be taken to ensure that the memory allocated for the DPU
	  does not overlap with other data. Each allocated DPU buffer will
	  utilize (panel_width * panel_height * bytes_per_pixel) bytes of data,
	  and buffers will be allocated contiguously.

if DPU_EXTERNAL_FB_MEM

config DPU_EXTERNAL_FB_ADDR
	hex "DPU framebuffer address"
	help
	  Address of memory mapped external framebuffer.
	  Must be 32 byte aligned

endif # DPU_EXTERNAL_FB_MEM

endif # DISPLAY_SOCIONEXT_DPU
```
