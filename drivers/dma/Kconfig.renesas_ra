## drivers/dma/Kconfig.renesas_ra
```kconfig
# Copyright (c) 2025 Renesas Electronics Corporation
# SPDX-License-Identifier: Apache-2.0

config DMA_RENESAS_RA
	bool "Renesas RA DMAC"
	default y
	depends on DT_HAS_RENESAS_RA_DMA_ENABLED
	select USE_RA_FSP_DMA
	help
	  Enable Renesas RA DMA Driver.
```

## drivers/dma/Kconfig.renesas_rz
```kconfig
# Copyright (c) 2024-2025 Renesas Electronics Corporation
# SPDX-License-Identifier: Apache-2.0

config DMA_RENESAS_RZ_DMAC
	bool "Renesas RZ DMAC"
	default y
	depends on DT_HAS_RENESAS_RZ_DMAC_ENABLED
	select USE_RZ_FSP_DMAC
	help
	  Enable Renesas RZ DMAC Driver.

config DMA_RENESAS_RZ_DMAC_B
	bool "Renesas RZ DMAC_B"
	default y
	depends on DT_HAS_RENESAS_RZ_DMAC_B_ENABLED
	select USE_RZ_FSP_DMAC_B
	help
	  Enable Renesas RZ DMAC_B Driver.
```

## drivers/dma/Kconfig.rpi_pico
```kconfig
# Copyright (c) 2023 Tokita, Hiroshi <tokita.hiroshi@gfujitsu.com>
# SPDX-License-Identifier: Apache-2.0

config DMA_RPI_PICO
	bool "Raspberry Pi Pico DMA driver"
	default y
	depends on DT_HAS_RASPBERRYPI_PICO_DMA_ENABLED
	select PICOSDK_USE_DMA
	select PICOSDK_USE_CLAIM
	depends on RESET
	help
	  DMA driver for Raspberry Pi Pico.
```

## drivers/dma/Kconfig.sam0
```kconfig
# Atmel SAM DMAC configuration options

# Copyright (c) 2018 Google LLC.
# SPDX-License-Identifier: Apache-2.0

config DMA_SAM0
	bool "Atmel SAM0 series DMAC driver"
	default y
	depends on DT_HAS_ATMEL_SAM0_DMAC_ENABLED
	help
	  DMA driver for Atmel SAM0 series MCUs.
```

## drivers/dma/Kconfig.sam_xdmac
```kconfig
# Atmel XDMAC SAM driver configuration options

# Copyright (c) 2017 Piotr Mienkowski
# SPDX-License-Identifier: Apache-2.0

config DMA_SAM_XDMAC
	bool "Atmel SAM DMA (XDMAC) driver"
	default y
	depends on DT_HAS_ATMEL_SAM_XDMAC_ENABLED
	help
	  Enable Atmel SAM MCU Family Direct Memory Access (XDMAC) driver.
```

## drivers/dma/Kconfig.sedi
```kconfig
# Intel sedi DMA configuration options

# Copyright (c) 2023 Intel Corporation
# SPDX-License-Identifier: Apache-2.0

config DMA_SEDI
	bool "SEDI DMA driver"
	select DMA_64BIT
	default y
	depends on DT_HAS_INTEL_SEDI_DMA_ENABLED
	help
	  This option enables the Intel SEDI DMA driver.
	  This driver is simply a shim driver built upon the SEDI
	  bare metal DMA driver in the hal-intel module
```

## drivers/dma/Kconfig.sf32lb
```kconfig
# Copyright 2025 Core Devices LLC
# SPDX-License-Identifier: Apache-2.0

config DMA_SF32LB
	bool "SiFli SF32LB DMA driver"
	default y
	depends on DT_HAS_SIFLI_SF32LB_DMAC_ENABLED
	help
	  Enable DMA driver for SiFli SF32LB
```

## drivers/dma/Kconfig.si32
```kconfig
# Copyright (c) 2024 GARDENA GmbH
#
# SPDX-License-Identifier: Apache-2.0

config DMA_SI32
	bool "Si32 DMA controller driver"
	default y
	depends on DT_HAS_SILABS_SI32_DMA_ENABLED
	help
	  Enable DMA controller driver for Si32 line of MCUs
```

## drivers/dma/Kconfig.silabs
```kconfig
# Copyright (c) 2024 Silicon-labs
# SPDX-License-Identifier: Apache-2.0

config DMA_SILABS_LDMA
	bool "Silabs DMA driver"
	default y
	select SYS_MEM_BLOCKS
	select SOC_GECKO_LDMA
	depends on DT_HAS_SILABS_LDMA_ENABLED
	help
	  Driver for Silabs DMA.

if DMA_SILABS_LDMA

config DMA_MAX_DESCRIPTOR
	int "Max Number of block_config (LDMA_Descriptor)"
	default 16
	help
	  Max Number of block_config (LDMA_Descriptor)

endif
```

## drivers/dma/Kconfig.siwx91x
```kconfig
# Copyright (c) 2024 Silicon Laboratories Inc.
# SPDX-License-Identifier: Apache-2.0

config DMA_SILABS_SIWX91X_UDMA
	bool "Silabs SiWx91x UDMA driver"
	default y
	select SYS_MEM_BLOCKS
	depends on DT_HAS_SILABS_UDMA_ENABLED
	depends on CLOCK_CONTROL
	help
	  Enable the High Power(HP) / Ultra Low Power(ULP) UDMA driver for the
	  Silabs SiWx91x SoC series.

if DMA_SILABS_SIWX91X_UDMA

config DMA_SILABS_SIWX91X_UDMA_DESCR_COUNT
	int "The maximum UDMA descriptor count"
	default 30

endif

config DMA_SILABS_SIWX91X_GPDMA
	bool "Silabs SiWx91x GPDMA driver"
	default y
	select SYS_MEM_BLOCKS
	depends on DT_HAS_SILABS_GPDMA_ENABLED
	depends on CLOCK_CONTROL
	help
	  Enable the GDMA driver for the Silabs SiWx91x SoC series.

if DMA_SILABS_SIWX91X_GPDMA

config DMA_SILABS_SIWX91X_GPDMA_DESCR_COUNT
	int "The maximum GPDMA descriptor count"
	default 32

endif
```

## drivers/dma/Kconfig.smartbond
```kconfig
# Smartbond DMA Accelerator Configuration Options

# Copyright (c) 2023 Renesas Electronics Corporation
# SPDX-License-Identifier: Apache-2.0

config DMA_SMARTBOND
	bool "Smartbond DMA Accelerator Driver"
	depends on DT_HAS_RENESAS_SMARTBOND_DMA_ENABLED
	default y
	help
	  Enable Smartbond DMA Accelerator Driver
```

## drivers/dma/Kconfig.stm32
```kconfig
# DMA configuration options

# Copyright (c) 2016 Intel Corporation
# Copyright (c) 2019 Song Qiang <songqiang1304521@gmail.com>
# Copyright (c) 2023 Jeroen van Dooren, Nobleo Technology
# SPDX-License-Identifier: Apache-2.0

config DMA_STM32
	bool "STM32 DMA driver"
	select USE_STM32_LL_DMA
	default y
	depends on DT_HAS_ST_STM32_DMA_V1_ENABLED \
		|| DT_HAS_ST_STM32_DMA_V2_ENABLED \
		|| DT_HAS_ST_STM32_DMA_V2BIS_ENABLED \
		|| DT_HAS_ST_STM32_BDMA_ENABLED
	help
	  Driver for STM32 DMA V1, V2, V2bis and BDMA types.

config DMA_STM32U5
	bool "STM32U5 serie DMA driver"
	select USE_STM32_LL_DMA
	default y
	depends on DT_HAS_ST_STM32U5_DMA_ENABLED
	help
	  Enable DMA support mainly for stm32U5 family.
	  It differs from the DMA driver due to the GPDMA peripheral.

if DMA_STM32

config DMA_STM32_V1
	bool
	default y
	depends on DT_HAS_ST_STM32_DMA_V1_ENABLED
	help
	  Enable DMA V1 support.

config DMA_STM32_V2
	bool
	default y
	depends on DT_HAS_ST_STM32_DMA_V2_ENABLED || DT_HAS_ST_STM32_DMA_V2BIS_ENABLED
	help
	  Enable DMA V2 or DMA V2bis support. With the versions V2 of DMA, the
	  peripheral request must be specified in the dma slot of the dma cell
	  With the versions V2 bis of DMA, the peripheral request (slot) is not
	  a parameter of the dma-cell.

config DMAMUX_STM32
	bool
	default y
	depends on DT_HAS_ST_STM32_DMAMUX_ENABLED
	help
	  Enable DMAMUX support.

config DMA_STM32_SHARED_IRQS
	bool
	default y
	depends on SOC_SERIES_STM32C0X || SOC_SERIES_STM32F0X || \
		   SOC_SERIES_STM32G0X || SOC_SERIES_STM32L0X
	help
	  Enable shared IRQ support on devices where channels share 1 IRQ.

config DMA_STM32_BDMA
	bool "STM32 BDMA driver"
	default y
	select USE_STM32_LL_BDMA
	depends on DT_HAS_ST_STM32_BDMA_ENABLED
	help
	  BDMA driver for STM32H7 series SoCs.

config DMAMUX_STM32_INIT_PRIORITY
	int "STM32 DMAMUX init priority"
	depends on DT_HAS_ST_STM32_DMAMUX_ENABLED
	default 41
	help
	  DMAMUX driver device must be init'd after the DMA (CONFIG_DMA_INIT_PRIORITY)
	  DMAMUX driver device initialization priority is greater than DMA one's

endif # DMA_STM32
```

## drivers/dma/Kconfig.stm32f4x
```kconfig
# Kconfig - DMA configuration options
#
#
# Copyright (c) 2016 Intel Corporation
#
# SPDX-License-Identifier: Apache-2.0
#

config DMA_STM32F4X
	bool "Enable STM32F4x DMA driver"
	depends on SOC_SERIES_STM32F4X
	help
	  DMA driver for STM32F4x series SoCs.
```

## drivers/dma/Kconfig.ti_am62l_pktdma
```kconfig
# TI AM62L PKTDMA driver configuration

# Copyright (c) 2026 Texas Instruments Incorporated
# SPDX-License-Identifier: Apache-2.0

config DMA_TI_AM62L_PKTDMA
	bool "TI AM62L PKTDMA (Packet DMA) driver"
	default y
	depends on DT_HAS_TI_AM62L_PKTDMA_ENABLED
	select DMA_64BIT
	help
	  Enable the TI AM62L Packet DMA functionality for PSI-L
	  peripherals in the AM62L SoC.
```

## drivers/dma/Kconfig.ti_mspm0
```kconfig
# Copyright (c) 2026 Linumiz
#
# SPDX-License-Identifier: Apache-2.0

config DMA_TI_MSPM0
	bool "Texas Instruments MSPM0 DMA Controller Driver"
	default y
	depends on DT_HAS_TI_MSPM0_DMA_ENABLED
	select USE_MSPM0_DL_DMA
	help
	  Enable Texas Instruments MSPM0 Family DMA driver.
```

## drivers/dma/Kconfig.tsn_nic
```kconfig
# Copyright (c) 2024 Junho Lee <junho@tsnlab.com>
# SPDX-License-Identifier: Apache-2.0

config DMA_TSN_NIC
	bool "TSN NIC DMA Driver"
	default y
	depends on DT_HAS_TSNLAB_TSN_NIC_DMA_ENABLED
	help
	  Enable DMA driver for TSN NIC.
```

## drivers/dma/Kconfig.wch
```kconfig
# Copyright (c) 2024 Paul Wedeck <paulwedeck@gmail.com>
# SPDX-License-Identifier: Apache-2.0

config DMA_WCH
	bool "CH32V DMA driver"
	default y
	depends on DT_HAS_WCH_WCH_DMA_ENABLED
	help
	  DMA driver for the WCH CH32V SoC family.
```

## drivers/dma/Kconfig.xilinx
```kconfig
config DMA_XILINX
	bool "TODO"
	default y
	depends on DT_HAS_XILINX_ALINX_DMA_ENABLED
	help
	  TODO
```

## drivers/dma/Kconfig.xilinx_adma
```kconfig
# ADMA Driver configuration options
# Copyright (c) 2026 Advanced Micro Devices.

# SPDX-License-Identifier: Apache-2.0


config DMA_XILINX_ADMA
	bool "Using Xilinx ADMA driver"
	default y
	depends on DT_HAS_XLNX_ZYNQMP_DMA_1_0_ENABLED || DT_HAS_AMD_VERSAL2_DMA_1_0_ENABLED
	select CACHE_MANAGEMENT
	select SYS_MEM_BLOCKS
	help
	  DMA driver for Xilinx ADMA.

config DMA_XILINX_ADMA_SG_BUFFER_COUNT
	int "Maximum number of scatter-gather descriptors per channel"
	default 32
	range 1 32
	help
	  Number of scatter-gather descriptor slots allocated per DMA channel
	  in the descriptor memory pool. Each entry holds a paired source and
	  destination hardware descriptor used by a single SG block.

config DMA_XILINX_ADMA_DESC_POOL_ALIGNMENT
	int "DMA descriptor pool alignment in bytes"
	default 64
	help
	  Memory alignment requirement for DMA descriptor pool allocation.
```

## drivers/dma/Kconfig.xilinx_axi_dma
```kconfig
# Xilinx AXI DMA configuration options

# Copyright (c) 2023 CISPA Helmholtz Center for Information Security gGmbH
# SPDX-License-Identifier: Apache-2.0

config DMA_XILINX_AXI_DMA
	bool "Xilinx AXI DMA LogiCORE IP driver"
	default y
	depends on DT_HAS_XLNX_AXI_DMA_1_00_A_ENABLED || DT_HAS_XLNX_ETH_DMA_ENABLED
	help
	  DMA driver for Xilinx AXI DMAs, usually found on FPGAs.


config DMA_XILINX_AXI_DMA_DISABLE_CACHE_WHEN_ACCESSING_SG_DESCRIPTORS
	bool "Disable data cache while accessing Scatter-Gather Descriptors."
	depends on DMA_XILINX_AXI_DMA
	default n
	help
		Disable dcache while operating on Scatter-Gather descriptors.
		This allows the DMA to be used on architectures that do not provide
		coherency for DMA accesses. If you are unsure whether you need this feature,
		you should select n here.

config DMA_XILINX_AXI_DMA_SG_DESCRIPTOR_NUM_TX
	int "Number of transfer descriptors allocated for transmission (TX)."
	depends on DMA_XILINX_AXI_DMA
	default 16
	help
		The Xilinx AXI DMA uses a ring of in-memory DMA descriptors which reference
		the buffers containing the network packets and control and status information.
		Increasing the number of descriptors increases the amount of packets in flight,
		which benefits performance, while increasing memory usage.

config DMA_XILINX_AXI_DMA_SG_DESCRIPTOR_NUM_RX
	int "Number of transfer descriptors allocated for reception (RX)."
	depends on DMA_XILINX_AXI_DMA
	default 16
	help
		The AXI DMA driver currently allocates a single DMA descriptor for each RX transfer,
		because transfers need to be started by the upstream driver.

choice
	prompt "IRQs to lock when manipulating per-channel data structures during dma_start."
	depends on DMA_XILINX_AXI_DMA
	default DMA_XILINX_AXI_DMA_LOCK_ALL_IRQS

config DMA_XILINX_AXI_DMA_LOCK_ALL_IRQS
	bool "Lock all IRQs"
	help
		Lock all interrupts (including, e.g., timers and scheduler) when modifying channel data
		during dma_start.
		This is required when calling dma_start outside of the TX/RX callbacks.
		This is the safest option and the default, select this if you are unsure.

config DMA_XILINX_AXI_DMA_LOCK_DMA_IRQS
	bool "Lock TX and RX IRQs"
	help
		Lock all interrupts of this DMA device when modifying channel data during dma_start.
		This is only safe when dma_start is only called from the TX/RX callbacks (and possibly
		once directly after initialization of the DMA).

config DMA_XILINX_AXI_DMA_LOCK_CHANNEL_IRQ
	bool "Lock IRQs of the DMA channel"
	help
		Only lock the interrupt of the DMA channel whose data are to be modified during dma_start.
		Only select this when you can guarantee that dma_start is only called from the callback
		registered for the same channel.

endchoice

config DMA_XILINX_AXI_DMA_POLL_INTERVAL
	int "Period of the timer used for polling the DMA in milliseconds"
	depends on DMA_XILINX_AXI_DMA
	default 100
	help
		On certain platforms (e.g., RISC-V), the DMA driver can sometimes miss interrupts.
		This can cause the DMA driver to stop processing completed transactions.
		In order to prevent this, the DMA driver periodically polls the DMA's registers and
		determines whether it needs to handle outstanding transactions.
		This configuration controls how often this happens.
		Choose a larger value to minimize overhead and a smaller value to minimize
		worst-case latency.

config DMA_XILINX_AXI_DMA_INTERRUPT_THRESHOLD
	int "Number of completed transactions after which to trigger an interrupt"
	depends on DMA_XILINX_AXI_DMA
	range 1 255
	default 8
	help
		Number of completed transactions after which to trigger an interrupt.
		Decrease to minimize latency, increase to minimize overhead introduced by interrupts.

config DMA_XILINX_AXI_DMA_INTERRUPT_TIMEOUT
	int "Timeout for triggering an interrupt"
	depends on DMA_XILINX_AXI_DMA
	range 0 255
	default 16
	help
		Trigger an interrupt at the latest after
		CONFIG_DMA_XILINX_AXI_DMA_INTERRUPT_TIMEOUT * 125 * DMA_CLOCK_PERIOD cycles.
		This is useful in conjunction with DMA_XILINX_AXI_DMA_INTERRUPT_THRESHOLD - the DMA
		can raise an interrupt before the threshold is reached, minimizing latency in scenarios
		where only few transactions per second are completed.
		Set to 0 to disable this feature, i.e., interrupts will only be raised when the threshold
		has been reached.
```

## drivers/dma/Kconfig.xmc4xxx
```kconfig
# Infineon XMC4xxx DMA configuration options

# Copyright (c) 2022 Andriy Gelman
# SPDX-License-Identifier: Apache-2.0

config DMA_XMC4XXX
	bool "Infineon xmc4xxx series DMA driver"
	default y
	depends on DT_HAS_INFINEON_XMC4XXX_DMA_ENABLED
	help
	  DMA driver for Infineon xmc4xxx series MCUs.

config DMA_XMC4XXX_NUM_DESCRIPTORS
	int "Max DMA descriptors in a linked list"
	default 4
	depends on DMA_XMC4XXX
	help
	  Maximum number of blocks in a DMA block transfer configuration.
	  Only supported by dma0 channels 0 and 1.
```

## drivers/dp/Kconfig
```kconfig
# Copyright (c) 2019 Phytec Messtechnik GmbH
#
# SPDX-License-Identifier: Apache-2.0

menuconfig DP_DRIVER
	bool "Debug Port (DP) drivers [EXPERIMENTAL]"
	select EXPERIMENTAL
	help
	  Enable Debug Port interface driver

if DP_DRIVER

module = DP_DRIVER
module-str = dp drv
source "subsys/logging/Kconfig.template.log_config"

config DP_DRIVER_INIT_PRIO
	int "Debug Port driver initialization priority"
	default 80
	help
	  Set the initialization priority number.

config SWDP_BITBANG_DRIVER
	bool "Serial Wire Debug Port bit-bang driver"
	default y
	depends on DT_HAS_ZEPHYR_SWDP_GPIO_ENABLED
	depends on GPIO
	help
	  Serial Wire Debug Port bit-bang driver.

config SWDP_BITBANG_NO_DISCONNECT
	bool "Use GPIO_INPUT instead of GPIO_DISCONNECTED"
	depends on SWDP_BITBANG_DRIVER
	help
	  When deactivating the debug port, use GPIO_INPUT instead of
	  GPIO_DISCONNECTED. Use if the underlying gpio driver does not support
	  the GPIO_DISCONNECTED state.

endif # DP_DRIVER
```
