## drivers/dma/Kconfig.xec
```kconfig
# Microchip XEC DMAC configuration options

# Copyright (c) 2023 Microchip Technology Inc.
# SPDX-License-Identifier: Apache-2.0

config DMA_MCHP_XEC
	bool "Microchip XEC series DMAC driver"
	default y
	depends on DT_HAS_MICROCHIP_XEC_DMAC_ENABLED
	help
	  DMA driver for Microchip XEC series MCUs.

if DMA_MCHP_XEC

XEC_DMA_NODE_PATH := $(dt_nodelabel_path,dmac)
XEC_DMA_MAX_CHANS := $(dt_node_int_prop_int,$(XEC_DMA_NODE_PATH),dma-channels)

config DMA_MCHP_XEC_DMAC_MAX_CHANNELS
	int "Microchip XEC central DMA maximum channels"
	default $(XEC_DMA_MAX_CHANS)
	help
	  The number of channels this instance of the DMAC
	  controller supports.

config DMA_MCHP_XEC_MAX_BLOCKS_PER_CHAN
	int "Maximum DMA blocks per channel"
	default 1
	range 1 16
	help
	  Maximum number of dma_block_config entries the driver will
	  cache from a multi-block dma_config call. The XEC central DMA
	  hardware programs one block at a time; the driver chains the
	  remaining blocks in its ISR by ABORTing the channel, rewriting
	  MSA/MEA/DEVA from the cached block, and re-issuing RUN. Each
	  cached block costs roughly 16 bytes per channel.

	  Set this to 1 (the default) to preserve historical single-block
	  behavior bit-for-bit and the lowest RAM footprint. Increase it
	  when a peripheral driver needs ping-pong or scatter-style
	  transfers on the same START-to-STOP transaction (for example,
	  streaming target-mode RX in the I2Cv3-NL driver when the host
	  may write a payload larger than the per-instance receive
	  buffer).

endif # DMA_MCHP_XEC
```

## drivers/eeprom/Kconfig.mb85rsxx
```kconfig
# Copyright (c) 2024 Antmicro <www.antmicro.com>
# SPDX-License-Identifier: Apache-2.0

config EEPROM_MB85RSXX
	bool "MB85RSXX EEPROM driver"
	default y
	depends on DT_HAS_FUJITSU_MB85RSXX_ENABLED
	select SPI
	help
	  Enable FUJITSU mb85rsxx SPI FRAM
```

## drivers/eeprom/Kconfig.rv3028
```kconfig
# Copyright (c) 2026 Janez Ugovsek <janez@ugovsek.info>
# SPDX-License-Identifier: Apache-2.0

config EEPROM_RV3028
	bool "Micro Crystal RV3028 EEPROM driver"
	default y
	depends on DT_HAS_MICROCRYSTAL_RV3028_EEPROM_ENABLED
	depends on DT_HAS_MICROCRYSTAL_RV3028_ENABLED
	select MFD
	help
	  Enable the EEPROM child driver for the Micro Crystal RV3028.
	  The EEPROM is accessed through the EEPROM API.
```

## drivers/energy_meter/Kconfig
```kconfig
# Copyright (c) 2025 Pedro Ramos
# SPDX-License-Identifier: Apache-2.0

menuconfig ENERGY_METER
	bool "Energy meter drivers"
	help
	  Enable drivers for electrical energy metering ICs.

if ENERGY_METER

module = ENERGY_METER
module-str = energy_meter
source "subsys/logging/Kconfig.template.log_config"

config ENERGY_METER_INIT_PRIORITY
	int "Energy meter init priority"
	default 90
	help
	  Energy meter device driver initialization priority.

config ENERGY_METER_SHELL
	bool "Energy meter shell"
	depends on SHELL
	help
	  Enable the energy_meter shell command, which lists the values an
	  energy meter measures and reads them once or periodically.

endif # ENERGY_METER
```

## drivers/energy_meter/atm90e26/Kconfig
```kconfig
# Copyright (c) 2025 Pedro Ramos
# SPDX-License-Identifier: Apache-2.0

menuconfig ATM90E26
	bool "Microchip ATM90E26 energy metering IC"
	default y
	depends on DT_HAS_MICROCHIP_ATM90E26_ENABLED
	depends on SERIAL || !$(dt_compat_on_bus,$(DT_COMPAT_MICROCHIP_ATM90E26),uart)
	select SPI if $(dt_compat_on_bus,$(DT_COMPAT_MICROCHIP_ATM90E26),spi)
	select UART_INTERRUPT_DRIVEN if $(dt_compat_on_bus,$(DT_COMPAT_MICROCHIP_ATM90E26),uart)
	help
	  Enable the driver for the Microchip ATM90E26 single-phase energy
	  metering IC on SPI or UART. An instance on a UART requires the
	  serial driver to be enabled.

if ATM90E26

config ATM90E26_BUS_SPI
	def_bool $(dt_compat_on_bus,$(DT_COMPAT_MICROCHIP_ATM90E26),spi)

config ATM90E26_BUS_UART
	def_bool $(dt_compat_on_bus,$(DT_COMPAT_MICROCHIP_ATM90E26),uart)

config ATM90E26_EVENTS
	bool "Event support"
	depends on GPIO
	help
	  Report the IRQ, WarnOut, CF1 and CF2 pins through the energy meter
	  event callback. The callback runs in the system work queue.

config ATM90E26_VERIFY_READ
	bool "Verify register reads"
	help
	  Read the LastData register after every register read and compare it
	  with the value received, to detect corrupted transfers. This doubles
	  the number of bus transactions per read. Register writes are always
	  verified, and UART frames are always checked against their checksum.

config ATM90E26_SHELL
	bool "Register access shell commands"
	depends on SHELL
	help
	  Enable the atm90e26 shell command, which reads and writes chip
	  registers for calibration and debugging. Writing a calibration
	  register rewrites its block with a new checksum. Registers written
	  from the shell keep their value until the chip is reset.

config EMUL_ATM90E26
	bool "Emulator for the ATM90E26"
	default y
	depends on EMUL
	help
	  Enable the SPI and UART emulator for the ATM90E26, used by the driver
	  tests.

endif # ATM90E26
```

## drivers/energy_meter/atm90e32as/Kconfig
```kconfig
# Copyright (c) 2025 Pedro Ramos
# SPDX-License-Identifier: Apache-2.0

menuconfig ATM90E32AS
	bool "Microchip ATM90E32AS energy metering IC"
	default y
	depends on DT_HAS_MICROCHIP_ATM90E32AS_ENABLED
	select SPI
	help
	  Enable the driver for the Microchip ATM90E32AS poly-phase energy
	  metering IC.

if ATM90E32AS

config ATM90E32AS_EVENTS
	bool "Event support"
	depends on GPIO
	help
	  Report the IRQ0, IRQ1, WarnOut and CF1-CF4 pins through the energy
	  meter event callback. The callback runs in the system work queue.

config ATM90E32AS_VERIFY_READ
	bool "Verify register reads"
	help
	  Read the LastSPIData register after every register read and compare
	  it with the value received, to detect transfers corrupted by noise on
	  the SPI lines. This doubles the number of SPI transfers per read.
	  Register writes are always verified.

config ATM90E32AS_SHELL
	bool "Register access shell commands"
	depends on SHELL
	help
	  Enable the atm90e32as shell command, which reads and writes chip
	  registers for calibration and debugging. Registers written from the
	  shell keep their value until the chip is reset or resumed.

config EMUL_ATM90E32AS
	bool "Emulator for the ATM90E32AS"
	default y
	depends on EMUL
	help
	  Enable the SPI emulator for the ATM90E32AS, used by the driver tests.

endif # ATM90E32AS
```

## drivers/entropy/Kconfig.aesc
```kconfig
# SPDX-FileCopyrightText: 2026 Aesc Silicon
# SPDX-License-Identifier: Apache-2.0

config ENTROPY_AESC_PRNG
	bool "Aesc Silicon PRNG driver"
	default y
	depends on DT_HAS_AESC_PRNG_ENABLED
	select ENTROPY_HAS_DRIVER
	help
	  Enable the driver for the Aesc Silicon PRNG IP core. The IP core is a
	  32-bit Galois LFSR and not a source of true entropy; its output is not
	  suitable for cryptographic use.
```

## drivers/entropy/Kconfig.atecc608a
```kconfig
# Copyright (c) 2026 RAKwireless Technology Limited
# SPDX-License-Identifier: Apache-2.0

config ENTROPY_ATECC608A
	bool "Microchip ATECC608A TRNG entropy driver"
	default y
	depends on DT_HAS_MICROCHIP_ATECC608A_TRNG_ENABLED
	select MFD
	select ENTROPY_HAS_DRIVER
	help
	  Enable the ATECC608A on-chip Random command as a Zephyr entropy
	  source. The parent microchip,atecc608a node must be present. The
	  configuration zone must be locked; until then Random returns a
	  fixed test pattern (0xFF 0xFF 0x00 0x00 repeating).

if ENTROPY_ATECC608A

config ENTROPY_ATECC608A_INIT_PRIORITY
	int "ATECC608A entropy driver init priority"
	default 90
	help
	  Initialization priority. Must be after CONFIG_MFD_INIT_PRIORITY so
	  the parent I2C MFD device is ready.

endif # ENTROPY_ATECC608A
```

## drivers/entropy/Kconfig.cc27xx
```kconfig
# TI CC27xx entropy driver configuration

# Copyright (c) 2025 Texas Instruments
# SPDX-License-Identifier: Apache-2.0

config ENTROPY_CC27XX_RNG
	bool "TI SimpleLink CC27xx Random Number Generator (RNG)"
	default y
	depends on DT_HAS_TI_CC27XX_RNG_ENABLED
	select ENTROPY_HAS_DRIVER
	help
	  This option enables the driver for the Random Number Generator (RNG)
	  for TI SimpleLink CC27xx SoCs. This uses noise from Radio during startup
	  to generate entropy. Subsequent calls to this API will fail and it
	  returns with an error code.

if ENTROPY_CC27XX_RNG

config HEAP_MEM_POOL_ADD_SIZE_ENTROPY
	int
	default 3072
	help
	  Add heap memory if entropy driver is enabled.
	  Entropy driver depends on large amount of radio noise for
	  generating entropy, which is dynamically allocated and freed
	  during entropy driver initialization.

config ENTROPY_CC27XX_NOISE_INPUT_WORD_LENGTH
	int "Number of words from the Radio noise to use to generate 32-byte entropy"
	default 512
	range 256 1024
	help
	  The size in words of the buffer used to get the noise from Radio.
	  This is the amount of noise that will be used to generate 32 bytes of entropy.
	  The default value is 512 words, which is the minimum required to generate
	  32 bytes of entropy. Increasing this value will increase the time it takes
	  to generate the entropy, but may improve the quality of the entropy.
	  The maximum value is 1024 words. The value must be a multiple of 32.
	  Increasing this value will also increase heap usage, and the config value
	  HEAP_MEM_POOL_ADD_SIZE_ENTROPY must be increased accordingly.

config ENTROPY_CC27XX_ENTROPY_BYTE_LENGTH
	int "Number of bytes of entropy to generate"
	default 128
	help
	  The size in bytes of the entropy to generate. The minimum value is 64 bytes.
	  But, it is recommended to use 128 bytes to provide entropy for other generators
	  in the system. The value must be a multiple of 32. Increasing this value will
	  increase the time it takes to generate the entropy. Increasing this value will
	  also increase the data segment usage in the system. While the device is running,
	  entropy cannot be generated again since Radio noise is only available during
	  startup.

config ENTROPY_CC27XX_RCT_ENABLED
	bool "RCT (Repetitive Count Test) for the noise buffer from Radio"
	default y
	help
	  This option enables the Repetitive Count Test (RCT) on the noise data from
	  the Radio. RCT is a feature that checks the quality of the noise generated
	  by the Radio. It is recommended to enable this feature to ensure the quality of
	  the entropy generated. Disabling this feature can improve start up time.

config ENTROPY_CC27XX_RCT_THRESHOLD
	int "Threshold for RCT (Repetitive Count Test) on the noise buffer from Radio"
	default 24
	help
	  This option sets the threshold for the Repetitive Count Test (RCT) on the noise
	  data from the Radio. The RCT checks the number of repeated values in the noise
	  data. If the number of repeated values exceeds this threshold, the RCT fails.
	  The default value is 24 and it must be a multiple of 3.

config ENTROPY_CC27XX_APT_ENABLED
	bool "APT (Adaptive Proportion Test) for the noise buffer from Radio"
	default y
	help
	  This option enables the Adaptive Proportion Test (APT) on the noise data from
	  the Radio. APT is a feature that checks the quality of the noise generated
	  by the Radio. It is recommended to enable this feature to ensure the quality of
	  the entropy generated. Disabling this feature can improve start up time.

config ENTROPY_CC27XX_APT_THRESHOLD
	int "Threshold for APT (Adaptive Proportion Test) on the noise buffer from Radio"
	default 461
	help
	  This option sets the threshold for the Adaptive Proportion Test (APT) on the noise
	  data from the Radio. See NIST SP 800-90B section 4.4.2 for information about
	  adjusting this value. This option is only effective if APT is enabled.

config ENTROPY_CC27XX_APT_BIMODAL_THRESHOLD
	int "Threshold for expected entropy between two code values"
	default 369
	help
	  This option enables the bimodal test for the Adaptive Proportion Test (APT) on
	  the noise data from the Radio. This is an additional test which is not specified
	  by NSIT SP 800-90B. TI recommends setting this value to 80% of the Adaptive
	  Proportion Test Threshold above.

endif # ENTROPY_CC27XX_RNG
```

## drivers/entropy/Kconfig.cc35xx
```kconfig
# TI CC35xxE entropy driver configuration

# Copyright (c) 2025 Conclusive Engineering Sp. z o.o.
# SPDX-License-Identifier: Apache-2.0

config ENTROPY_CC35XX_RNG
	bool "TI SimpleLink CC35xxE Hardware Security Module (HSM) Entropy submodule"
	default n
	depends on DT_HAS_TI_CC35XX_HSM_TRNG_ENABLED
	select TI_CC35XX_HSM
	select ENTROPY_HAS_DRIVER
	help
	  This option enables the driver for the HSM Entropy submodule
	  for TI SimpleLink CC35xx SoCs.
```

## drivers/entropy/Kconfig.psa_crypto
```kconfig
# Copyright (c) 2022 Nordic Semiconductor ASA
# SPDX-License-Identifier: Apache-2.0

# PSA Crypto Random source configuration options

config ENTROPY_PSA_CRYPTO_RNG
	bool "PSA Crypto Random source Entropy driver"
	depends on DT_HAS_ZEPHYR_PSA_CRYPTO_RNG_ENABLED
	select ENTROPY_HAS_DRIVER
	default y
	help
	  Enable the PSA Crypto source Entropy driver.

if ENTROPY_PSA_CRYPTO_RNG

config ENTROPY_PSA_CRYPTO_RNG_ISR
	bool "Get random bytes from an interrupt context"
	depends on MULTITHREADING
	help
	  Implement .get_entropy_isr handler to allow interrupt context
	  to get random bytes from a pool filled with regular PSA Crypto
	  calls from a thread context.

if ENTROPY_PSA_CRYPTO_RNG_ISR

config ENTROPY_PSA_CRYPTO_RNG_ISR_BUFFER_SIZE
	int "Size of the ISR random pool in bytes"
	range 1 32767
	default 32

config ENTROPY_PSA_CRYPTO_RNG_ISR_REFILL_THRESHOLD
	int "Byte size threshold for refilling the ISR random bytes pool"
	range 0 ENTROPY_PSA_CRYPTO_RNG_ISR_BUFFER_SIZE
	default ENTROPY_PSA_CRYPTO_RNG_ISR_BUFFER_SIZE
	help
	  A thread context is requested for filling the ISR random bytes
	  pool when the number of available bytes is equal to or lower
	  than this threshold.

config ENTROPY_PSA_CRYPTO_RNG_ISR_REFILL_SIZE
	int "Chunk byte size for refilling ISR random bytes pool"
	range 0 ENTROPY_PSA_CRYPTO_RNG_ISR_BUFFER_SIZE
	default 0
	help
	  Bytes size of the buffer chunks used to refill the ISR
	  random bytes pool. Bigger values may add latency to other
	  PSA Crypto services.

	  Special value 0 (default value) means the pool is refilled
	  using the biggest possible chunks.

config ENTROPY_PSA_CRYPTO_RNG_ISR_PRIVATE_WQ
	bool "Use a private worqueue to refill the pool"
	default y if BUILD_WITH_TFM
	help
	  When enabled, a private workqueue is use to run the work
	  that refills the ISR random bytes pool. It can be used
	  to specify the workqueue priority with
	  ENTROPY_PSA_CRYPTO_RNG_ISR_PRIVATE_WQ_PRIO.

	  When disabled, Zephyr system workqueue is used.

config ENTROPY_PSA_CRYPTO_RNG_ISR_WQ_STACK_SIZE
	int "Private workqueue stack byte size"
	depends on ENTROPY_PSA_CRYPTO_RNG_ISR_PRIVATE_WQ
	default 384

config ENTROPY_PSA_CRYPTO_RNG_ISR_WQ_PRIO
	int "Private workqueue priority"
	depends on ENTROPY_PSA_CRYPTO_RNG_ISR_PRIVATE_WQ
	default 1

endif # ENTROPY_PSA_CRYPTO_RNG_ISR

endif # ENTROPY_PSA_CRYPTO_RNG
```
