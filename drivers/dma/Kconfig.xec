## drivers/ethernet/Kconfig.lan9250
```kconfig
# LAN9250 Stand-alone Ethernet Controller configuration options

# Copyright (c) 2024 Mario Paja
# SPDX-License-Identifier: Apache-2.0


menuconfig ETH_LAN9250
	bool "LAN9250 Ethernet Controller"
	default y
	depends on DT_HAS_MICROCHIP_LAN9250_ENABLED
	select GPIO
	select SPI
	help
	  LAN9250 Stand-Alone Ethernet Controller
	  with SPI Interface

if ETH_LAN9250

config ETH_LAN9250_RX_THREAD_STACK_SIZE
	int "Stack size for internal incoming packet handler"
	default 800
	help
	  Size of the stack used for internal thread which is ran for
	  incoming packet processing.

config ETH_LAN9250_RX_THREAD_PRIO
	int "Priority for internal incoming packet handler"
	default 2
	help
	  Priority level for internal thread which is ran for incoming
	  packet processing.

config ETH_LAN9250_SPI_FAST_READ
	bool "Use the SPI Fast Read instruction"
	default y
	help
	  Read registers and the RX data FIFO with the SPI Fast Read
	  instruction (0x0B), which supports SPI clock rates up to 80 MHz.
	  The Read instruction (0x03) is limited to 30 MHz. Fast Read adds
	  one dummy byte to each read transfer.

config ETH_LAN9250_BUF_ALLOC_TIMEOUT
	int "Network buffer allocation timeout"
	default 100
	help
	  Given timeout in milliseconds. Maximum amount of time
	  that the driver will wait from the IP stack to get
	  a memory buffer before the Ethernet frame is dropped.

endif
```

## drivers/ethernet/Kconfig.mchp
```kconfig
# Copyright (c) 2026 Microchip Technology Inc.
# SPDX-License-Identifier: Apache-2.0

# Define menu symbol for configuring ethernet features
menuconfig ETH_MCHP_GMAC_G1
	bool "Microchip G1 Ethernet driver"
	default y
	depends on NET_BUF_FIXED_DATA_SIZE
	depends on DT_HAS_MICROCHIP_GMAC_G1_ETH_ENABLED
	select NOCACHE_MEMORY if ARCH_HAS_NOCACHE_MEMORY_SUPPORT && DCACHE
	select PINCTRL
	select NET_CHECKSUM_OFFLOAD_SUPPORTED if NET_L2_ETHERNET
	imply NVMEM if $(dt_compat_any_has_prop,$(DT_COMPAT_MICROCHIP_GMAC_G1_ETH),nvmem-cells)
	help
	  Enable Microchip MCU Family Ethernet driver.

if ETH_MCHP_GMAC_G1

config ETH_MCHP_BUF_RX_COUNT
	int "Network RX buffers preallocated by the SAM ETH driver"
	default 12
	help
	  Number of network buffers that will be permanently allocated by the
	  Ethernet driver. These buffers are used in receive path. They are
	  preallocated by the driver and made available to the GMAC module to be
	  filled in with incoming data. Their number has to be large enough to fit
	  at least one complete Ethernet frame. SAM ETH driver will always allocate
	  that amount of buffers for itself thus reducing the NET_BUF_RX_COUNT
	  which is a total amount of RX data buffers used by the whole networking
	  stack. One has to ensure that NET_PKT_RX_COUNT is large enough to
	  fit at least two Ethernet frames: one being received by the GMAC module
	  and the other being processed by the higher layer networking stack.

config ETH_MCHP_RX_THREAD_STACK_SIZE
	int "MCHP RX Work thread stack size"
	default 1600
	help
	  RX thread stack size in bytes.

config ETH_MCHP_RX_THREAD_PRIORITY
	int "MCHP RX work thread priority"
	default 2
	help
	  Ethernet Driver handles RX in thread.
	  This options sets the priority of that thread.

endif # ETH_MCHP_GMAC_G1

menuconfig ETH_MCHP_GMAC_G2
	bool "Microchip G2 GMAC Ethernet driver"
	default y
	depends on ETH_DRIVER
	depends on DT_HAS_MICROCHIP_GMAC_G2_ETH_ENABLED
	select EXPERIMENTAL
	select PINCTRL
	select NOCACHE_MEMORY if ARCH_HAS_NOCACHE_MEMORY_SUPPORT && DCACHE
	select CACHE_MANAGEMENT if DCACHE
	select NET_CHECKSUM_OFFLOAD_SUPPORTED if NET_L2_ETHERNET
	imply NVMEM if $(dt_compat_any_has_prop,$(DT_COMPAT_MICROCHIP_GMAC_G2_ETH),nvmem-cells)
	help
	  Enable the Ethernet driver for the Microchip G2 GMAC, the gigabit
	  "ETH" peripheral of PIC32CZ CA (a Cadence GEM core behind a
	  Microchip wrapper). GMII at 10/100/1000 Mbit/s; MII and RMII at
	  10/100 Mbit/s.

	  Not the GMAC microchip,gmac-g1-eth drives: that is the 10/100 core
	  of SAM E5x and PIC32CX SG, with a different register map.

if ETH_MCHP_GMAC_G2

config ETH_MCHP_GMAC_G2_RX_BUF_COUNT
	int "Receive descriptors"
	default 32
	range 2 1024
	help
	  Receive descriptors, each with a 1536-byte frame buffer owned by
	  the driver. This is how many frames the MAC can absorb in a burst
	  before the receive thread gets to run.

config ETH_MCHP_GMAC_G2_TX_BUF_COUNT
	int "Transmit descriptors"
	default 16
	range 2 1024
	help
	  Transmit descriptors, each with a 1536-byte frame buffer owned by
	  the driver. One of them always stays empty. With
	  CONFIG_ETH_MCHP_GMAC_G2_TX_ZEROCOPY there are no driver buffers and a
	  frame takes one descriptor per fragment of its packet.

config ETH_MCHP_GMAC_G2_TX_ZEROCOPY
	bool "Zero-copy transmit"
	depends on NET_L2_ETHERNET
	help
	  Let the MAC read each frame straight out of the packet it was sent
	  in, one descriptor per fragment, instead of copying the frame into a
	  driver-owned buffer first. The driver keeps a reference to the
	  packet until the frame is on the wire, so the packet has to stay
	  unchanged until then: the network stack never writes to a packet it
	  has sent, but an application handing its own packets to the driver
	  must not reuse one while the driver still holds it.

	  It saves the copy and the CONFIG_ETH_MCHP_GMAC_G2_TX_BUF_COUNT
	  frame buffers. A frame with more fragments than
	  CONFIG_ETH_MCHP_GMAC_G2_TX_BUF_COUNT - 1 cannot be sent and is
	  refused with -EMSGSIZE, so with small network buffers the ring has
	  to be sized for the fragment count rather than the frame count.
	  Packet data has to be in memory the MAC can reach.

config ETH_MCHP_GMAC_G2_TX_INT_MODERATION
	int "Transmit interrupt moderation, in 800 ns units"
	default 0
	range 0 255
	help
	  How long the MAC holds back the transmit-complete interrupt after a
	  frame has gone, so that one interrupt reclaims several frames. 0
	  interrupts once per frame.

	  Worth setting only where the transmitter runs near line rate and the
	  processor is short: 50, 40 us, reclaims about four full-size frames
	  per interrupt at gigabit. The transmit ring has to hold more frames
	  than go out in that time, or the sender waits for the interrupt.

config ETH_MCHP_GMAC_G2_RX_THREAD_STACK_SIZE
	int "Receive thread stack size"
	default 1536
	help
	  Stack of the thread that hands received frames to the network
	  stack.

config ETH_MCHP_GMAC_G2_RX_THREAD_PRIORITY
	int "Receive thread priority"
	default 2
	help
	  Priority of the receive thread, cooperative or preemptive as
	  CONFIG_NET_TC_THREAD_PREEMPTIVE selects.

endif # ETH_MCHP_GMAC_G2
```

## drivers/ethernet/Kconfig.native_tap
```kconfig
# Native TAP ethernet driver configuration options

# Copyright (c) 2018 Intel Corporation
# SPDX-License-Identifier: Apache-2.0

menuconfig ETH_NATIVE_TAP
	bool "Native TAP Ethernet driver"
	default y
	depends on DT_HAS_ZEPHYR_NATIVE_TAP_ENABLED
	depends on ARCH_POSIX
	depends on NET_L2_ETHERNET
	help
	  Enable native_sim TAP ethernet driver. Note, this driver is run inside
	  a process in your host system.

if ETH_NATIVE_TAP

config ETH_NATIVE_TAP_DEV_NAME
	string "Host ethernet TUN/TAP device name"
	default "/dev/net/tun"
	help
	  This option sets the TUN/TAP device name in your host system.

config ETH_NATIVE_TAP_VLAN_TAG_STRIP
	bool "Strip VLAN tag from Rx frames"
	depends on NET_VLAN
	help
	  Native TAP ethernet driver will strip of VLAN tag from
	  Rx Ethernet frames and sets tag information in net packet
	  metadata.

config ETH_NATIVE_TAP_RX_TIMEOUT
	int "Ethernet RX timeout"
	default 1 if NET_GPTP
	default 50
	range 1 100
	help
	  Native TAP ethernet driver repeatedly checks for new data.
	  Specify how long the thread sleeps between these checks if no new data
	  available.

endif # ETH_NATIVE_TAP
```
