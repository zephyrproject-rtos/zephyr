## drivers/entropy/Kconfig.riscv_zkr
```kconfig
# SPDX-FileCopyrightText: Copyright The Zephyr Project Contributors
# SPDX-License-Identifier: Apache-2.0

config ENTROPY_RISCV_ZKR
	bool "RISC-V Zkr entropy driver"
	default y
	depends on RISCV_ISA_EXT_ZKR
	select ARCH_HAS_ENTROPY
	help
	  Enables the architectural entropy driver based on the seed CSR of the
	  RISC-V Zkr extension.

	  The driver returns the entropy bits as delivered by the seed CSR, without
	  conditioning. The extension guarantees at least 8 bits of min-entropy per
	  16 bits delivered.

	  When the kernel runs in S-mode, the M-mode firmware has to grant access to
	  the seed CSR by setting mseccfg.SSEED.

if ENTROPY_RISCV_ZKR

config ENTROPY_RISCV_ZKR_MAX_RETRIES
	int "Maximum number of retries for RISC-V Zkr entropy driver"
	default 10
	help
	  Maximum number of consecutive seed CSR accesses delivering no entropy
	  after which the driver gives up.

config ENTROPY_RISCV_ZKR_RETRY_WAIT_USEC
	int "Retry wait time for RISC-V Zkr entropy driver"
	default 500
	help
	  Number of microseconds the driver waits before accessing the seed CSR
	  again after an access that delivered no entropy.

endif # ENTROPY_RISCV_ZKR
```

## drivers/entropy/Kconfig.rp2040_rosc
```kconfig
# SPDX-FileCopyrightText: Copyright The Zephyr Project Contributors
# SPDX-License-Identifier: Apache-2.0

config ENTROPY_RP2040_ROSC
	bool "RP2040 ring-oscillator entropy driver"
	default y
	depends on SOC_SERIES_RP2040
	depends on SYS_CLOCK_EXISTS
	depends on DT_HAS_RASPBERRYPI_RP2040_ROSC_RNG_ENABLED
	select ENTROPY_HAS_DRIVER
	select ENTROPY_NEEDS_PRNG
	help
	  Read the RP2040 ring oscillator's random-bit register directly, without
	  the Pico SDK random generator. RP2040 has no hardware TRNG, so this is
	  the platform entropy source, as in the Pico SDK's pico_rand and
	  pico_mbedtls. The RP2040 datasheet does not recommend the ring
	  oscillator for security applications; use an external TRNG or secure
	  element where stronger guarantees are required.
	  The oscillator must be enabled and stable, and the system clock must
	  use XOSC or a PLL. Clock configuration must remain unchanged during
	  a request. This driver does not reconfigure or enable the oscillator.
```

## drivers/entropy/Kconfig.rts5817
```kconfig
# Copyright (c) 2026 Realtek Semiconductor, Inc.
# SPDX-License-Identifier: Apache-2.0

config ENTROPY_RTS5817
	bool "RTS5817 Entropy Controller Driver"
	depends on DT_HAS_REALTEK_RTS5817_TRNG_ENABLED
	depends on OTP_RTS5817
	select ENTROPY_HAS_DRIVER
	default y
	help
	  This option enables the entropy number generator for RTS5817 SoCs.
```

## drivers/espi/Kconfig.nxp
```kconfig
# Copyright 2025-2026 NXP
# SPDX-License-Identifier: Apache-2.0

config ESPI_NXP
	bool "NXP eSPI target driver"
	default y
	depends on DT_HAS_NXP_ESPI_ENABLED
	select ESPI_TARGET
	select PINCTRL
	help
	  Enable the eSPI target driver for NXP SoCs.

config ESPI_NXP_TIMEOUT_MS
	int "eSPI operation timeout in milliseconds"
	default 200
	depends on ESPI_NXP
	help
	  Timeout for synchronous eSPI operations such as OOB receive.

config ESPI_TAF_NXP
	bool "NXP eSPI Target Attached Flash (TAF) driver"
	default y
	depends on ESPI_NXP
	depends on DT_HAS_NXP_ESPI_TAF_ENABLED
	select FLASH
	help
	  Enable the NXP eSPI Target Attached Flash (TAF) driver. This is a
	  separate device bound to the espi_saf_driver_api. It shares the parent
	  nxp,espi controller register block and interrupt, the parent driver
	  forwards host flash requests to this driver, which services them
	  against the local flash device and posts the completion back to the
	  host.
```

## drivers/ethernet/Kconfig.adin1140
```kconfig
# Copyright (c) 2024-2026 Analog Devices, Inc.
# SPDX-License-Identifier: Apache-2.0

menuconfig ETH_ADIN1140
	bool "ADIN1140 10BASE-T1S MAC-PHY"
	default y
	depends on DT_HAS_ADI_ADIN1140_ENABLED
	select SPI
	help
	  The ADIN1140 is a 10BASE-T1S IEEE 802.3™-2022 compliant MAC-PHY
	  for 10Mbps Single-Pair Ethernet (SPE).

if ETH_ADIN1140

config ETH_ADIN1140_RX_THREAD_STACK_SIZE
	int "Stack size for a thread that processes ADIN1140 IRQ"
	default 1024
	help
	  Size of the stack used for internal thread which is ran to
	  process raised ADIN1140 IRQ.

config ETH_ADIN1140_RX_THREAD_PRIO
	int "Priority for internal incoming packet handler"
	default 2
	help
	  Priority level for internal thread which is ran for ADIN1140
	  IRQ processing.

config ETH_ADIN1140_TIMEOUT
	int "IP buffer timeout"
	default 100
	help
	  Timeout in milliseconds. Maximum amount of time
	  that the driver will wait from the IP stack to get
	  a memory buffer before the Ethernet frame is dropped.

config ETH_ADIN1140_TIMESTAMP
	bool "RX/TX frame hardware timestamping (FTSE / TSC)"
	select NET_PKT_TIMESTAMP
	select NET_PKT_TIMESTAMP_THREAD
	help
	  Enable the MAC-PHY's Frame Timestamp Sync Enable/Select
	  (FTSE/FTSS) feature for RX, and per-frame Timestamp Capture
	  (TSC) for TX.

	  RX: an 8-byte hardware timestamp (32-bit seconds + 32-bit
	  nanoseconds) is prepended to every received frame ahead of
	  the destination MAC address. The driver strips this prefix
	  before handing the frame to the network stack and exposes it
	  via net_pkt_set_timestamp() instead of leaving it in the
	  frame payload.

	  TX: when a packet requests it (net_pkt_is_tx_timestamping(),
	  e.g. via a socket's SO_TIMESTAMPING SOF_TIMESTAMPING_TX_HARDWARE
	  option), the driver requests a hardware capture of the frame's
	  actual departure onto the wire and reports it via the standard
	  net_if_add_tx_timestamp() mechanism once available.

config ETH_ADIN1140_PTP
	bool "ADIN1140 hardware gPTP (IEEE 802.1AS) engine support"
	select ETH_ADIN1140_TIMESTAMP
	help
	  Enable use of the MAC-PHY's autonomous hardware gPTP engine
	  (endpoint mode) -- GPTP_LOCKED, GPTP_TIME_ERROR, GPTP_SYNC_COUNT,
	  etc. in the IO_LV register map. Selecting this option enables
	  MAC_CONFIG0.FTSE/FTSS (via ETH_ADIN1140_TIMESTAMP) and has the
	  driver strip the resulting 8-byte RX timestamp prefix before
	  handing frames to the network stack.

	  MAC_CONFIG0.FTSE must be enabled for the internal gPTP
	  time-error computation to run at all, but this dependency is
	  not documented anywhere in the ADIN1140 TRM. Selecting this
	  option enables FTSE automatically so this undocumented
	  requirement can't be missed.

endif # ETH_ADIN1140
```

## drivers/ethernet/Kconfig.adin2111
```kconfig
# Copyright (c) 2023 PHOENIX CONTACT Electronics GmbH
# SPDX-License-Identifier: Apache-2.0

menuconfig ETH_ADIN2111
	bool "ADIN2111 2-port 10BASE-T1L Controller"
	default y
	depends on DT_HAS_ADI_ADIN2111_ENABLED || DT_HAS_ADI_ADIN1110_ENABLED
	select ETH_OA_TC6
	select SPI
	imply CRC
	help
	  The ADIN2111 is a low power, 2-port 10BASE-T1L transceiver
	  designed for industrial Ethernet applications, and is compliant with
	  the IEEE® 802.3cg-2019™ Ethernet standard for long reach, 10
	  Mbps single pair Ethernet (SPE).

	  Featuring an integrated media access control (MAC) and a switch,
	  the ADIN2111 enables direct connectivity with a variety of controllers
	  via a serial peripheral inter-face (SPI).

if ETH_ADIN2111

config ETH_ADIN2111_IRQ_THREAD_STACK_SIZE
	int "Stack size for a thread that processes ADIN IRQ"
	default 2048
	help
	  Size of the stack used for internal thread which is ran to
	  process raised INT IRQ.

config ETH_ADIN2111_IRQ_THREAD_PRIO
	int "Priority for internal incoming packet handler"
	default 2
	help
	  Priority level for internal thread which is ran for ADIN
	  INT IRQ processing.

config ETH_ADIN2111_TIMEOUT
	int "IP buffer timeout"
	default 100
	help
	  Given timeout in milliseconds. Maximum amount of time
	  that the driver will wait from the IP stack to get
	  a memory buffer before the Ethernet frame is dropped.

config ETH_ADIN2111_SPI_CFG0
	bool "SPI_CFG0"
	default y
	help
	  Must be set when ADIN uses 8-bit CRC (Generic SPI)
	  or Protection Mode (OPEN Alliance) on the SPI Host Interface.

config ETH_ADIN2111_BUFFER_SIZE
	int "Buffer size in bytes use for frame transmission"
	default 1524
	help
	  Transmission and reception buffer size.

config ETH_ADIN2111_OA_MAX_RCA_COUNT
	int "Maximum OA chunks handled per transfer"
	range 1 255
	default 255
	help
	   Maximum number of OPEN Alliance chunks transmitted or received in one SPI
	   transfer. Lower values reduce OA buffer memory but may require more SPI
	   transfers for large TX frames.

config ETH_ADIN2111_OA_TX_MAX_SPI_BUFS
	int "Maximum OA TX SPI buffer descriptors"
	range 3 4096
	default 511
	help
	  Maximum number of struct spi_buf descriptors allocated for one OA TX SPI
	  transfer batch. The default supports 255 chunks with one descriptor for each
	  chunk header and one for its contiguous payload, plus one descriptor for
	  final-chunk padding. Highly fragmented packets may require more
	  descriptors; the driver batches frames as needed and rejects a frame before
	  the first SPI write if one chunk exceeds the configured capacity. Each
	  descriptor uses sizeof(struct spi_buf) bytes of static RAM.

endif # ETH_ADIN2111
```

## drivers/ethernet/Kconfig.dm9000
```kconfig
# Davicom DM9000 Ethernet driver configuration options

# Copyright (c) 2026 Fuyu Fei
# SPDX-License-Identifier: Apache-2.0

menuconfig ETH_DM9000
	bool "Davicom DM9000 Ethernet Controller"
	default y
	depends on DT_HAS_DAVICOM_DM9000_ENABLED
	select GPIO
	select MEMC
	select MDIO
	help
	  Davicom DM9000 Ethernet Controller with parallel host interface.
	  The integrated MII PHY is described as an "ethernet-phy" node on a
	  "davicom,dm9000-mdio" child bus and managed by the generic phy_mii
	  driver.

if ETH_DM9000

config ETH_DM9000_RX_THREAD_STACK_SIZE
	int "Stack size for internal incoming packet handler"
	default 1024
	help
	  Size of the stack used for internal incoming packet processing.

config ETH_DM9000_RX_THREAD_PRIORITY
	int "Priority for internal incoming packet handler"
	default 2
	help
	  Priority level for internal incoming packet processing.

config ETH_DM9000_TIMEOUT
	int "IP buffer timeout"
	default 100
	help
	  Maximum time in milliseconds that the driver waits for an RX packet
	  buffer before dropping an Ethernet frame.

config ETH_DM9000_HW_CHECKSUM
	bool "Use TX and RX hardware checksum offload"
	default y
	select NET_CHECKSUM_OFFLOAD_SUPPORTED if NET_L2_ETHERNET
	help
	  Offload the IPv4 header, TCP and UDP checksums to the controller's
	  TCSCR/RCSCSR checksum engine: generate on transmit, and verify-and-
	  discard on receive (so the network stack can skip the software
	  checksum). ICMP and IPv6 are left to software. Disable this if the
	  DM9000A checksum engine mishandles your traffic (for example IP
	  fragments or packets with IP options).

endif # ETH_DM9000
```

## drivers/ethernet/Kconfig.enc28j60
```kconfig
# ETH_ENC28J60 Ethernet driver configuration options

# Copyright (c) 2015 Intel Corporation
# SPDX-License-Identifier: Apache-2.0

menuconfig ETH_ENC28J60
	bool "ENC28J60C Ethernet Controller"
	default y
	depends on DT_HAS_MICROCHIP_ENC28J60_ENABLED
	select SPI
	help
	  ENC28J60C Stand-Alone Ethernet Controller
	  with SPI Interface

if ETH_ENC28J60

config ETH_ENC28J60_RX_THREAD_STACK_SIZE
	int "Stack size for internal incoming packet handler"
	depends on ETH_ENC28J60
	default 800
	help
	  Size of the stack used for internal thread which is ran for
	  incoming packet processing.

config ETH_ENC28J60_RX_THREAD_PRIO
	int "Priority for internal incoming packet handler"
	depends on ETH_ENC28J60
	default 2
	help
	  Priority level for internal thread which is ran for incoming
	  packet processing.

config ETH_ENC28J60_CLKRDY_INIT_WAIT_MS
	int "Time to wait for the CLKRDY bit on driver init"
	depends on ETH_ENC28J60
	default 2
	help
	  Timeout in milliseconds. Maximum time the initialisation
	  of the driver will wait for the OST to expire, indicated
	  by the CLKRDY bit set. If timeout driver init will fail
	  with -ETIMEDOUT.

config ETH_ENC28J60_TX_RETRIES
	int "TX retries on late collision"
	depends on ETH_ENC28J60
	default 4
	range 0 15
	help
	  Max software retransmissions after a late collision in
	  half-duplex mode (errata DS80349C, issue 13). Example 1 of
	  the errata counts up to 15. Each attempt busy waits up to
	  one frame time (about 1.2 ms for 1518 bytes at 10 Mbit/s)
	  on the calling thread. With the default 4 the worst case is
	  about 6 ms.

config ETH_ENC28J60_TIMEOUT
	int "IP buffer timeout"
	depends on ETH_ENC28J60
	default 100
	help
	  Given timeout in milliseconds. Maximum amount of time
	  that the driver will wait from the IP stack to get
	  a memory buffer before the Ethernet frame is dropped.

endif # ETH_ENC28J60
```

## drivers/ethernet/Kconfig.esp32
```kconfig
# ESP32 Ethernet driver configuration options

# Copyright (c) 2022 Grant Ramsay <grant.ramsay@hotmail.com>
# SPDX-License-Identifier: Apache-2.0

menuconfig ETH_ESP32
	bool "ESP32 Ethernet driver"
	default y
	depends on SOC_SERIES_ESP32 || SOC_SERIES_ESP32P4 || SOC_SERIES_ESP32S31
	depends on DT_HAS_ESPRESSIF_ESP32_ETH_ENABLED
	select ETH_PHY_DRIVER
	select NET_CHECKSUM_OFFLOAD_SUPPORTED if NET_L2_ETHERNET
	help
	  Enable ESP32 Ethernet driver.

if ETH_ESP32

config ETH_ESP32_RX_THREAD_STACK_SIZE
	int "ESP32 Ethernet receive thread stack size"
	default 768

config ETH_ESP32_RX_THREAD_PRIORITY
	int "ESP32 Ethernet receive thread priority"
	default -2 if SOC_SERIES_ESP32S31
	default 2
	help
	  Priority of the thread that hands received frames to the network
	  stack and returns the DMA descriptors. A cooperative priority keeps
	  it ahead of the network stack threads, so the DMA receive ring is
	  drained under load.

config ETH_ESP32_DMA_BUFFER_SIZE
	int "Ethernet DMA buffer size (Byte)"
	range 256 1600
	default 1600 if SOC_SERIES_ESP32S31
	default 512
	help
	  Set the size of each buffer used by Ethernet MAC DMA.

config ETH_ESP32_DMA_RX_BUFFER_NUM
	int "Amount of Ethernet DMA Rx buffers"
	range 3 30
	default 20 if SOC_SERIES_ESP32S31
	default 10
	help
	  Number of DMA receive buffers. Each buffer's size is
	  ETH_ESP32_DMA_BUFFER_SIZE. Larger number of buffers could
	  increase throughput somehow.

config ETH_ESP32_DMA_TX_BUFFER_NUM
	int "Amount of Ethernet DMA Tx buffers"
	range 3 30
	default 10
	help
	  Number of DMA transmit buffers. Each buffer's size is
	  ETH_ESP32_DMA_BUFFER_SIZE. Larger number of buffers could
	  increase throughput somehow.

config PTP_CLOCK_ESP32
	bool "ESP32 Ethernet PTP clock driver"
	default y
	depends on PTP_CLOCK
	depends on DT_HAS_SNPS_DWMAC_PTP_CLOCK_ENABLED
	help
	  Enable the IEEE 1588 PTP clock provided by the Ethernet MAC.
	  The MAC timestamps transmitted and received frames in
	  hardware and exposes a free running clock that can be set,
	  offset and rate adjusted.

endif # ETH_ESP32
```

## drivers/ethernet/Kconfig.ksz8851snl
```kconfig
# KSZ8851SNL Ethernet driver configuration options

# SPDX-FileCopyrightText: Copyright The Zephyr Project Contributors
# SPDX-License-Identifier: Apache-2.0

menuconfig ETH_KSZ8851SNL
	bool "KSZ8851SNL Ethernet Controller"
	default y
	depends on DT_HAS_MICROCHIP_KSZ8851SNL_ENABLED
	select CRC
	select SPI
	help
	  KSZ8851SNL Single-Port Ethernet Controller with SPI interface.

config ETH_KSZ8851SNL_RX_THREAD_STACK_SIZE
	int "Stack size for internal incoming packet handler"
	depends on ETH_KSZ8851SNL
	default 1024
	help
	  Size of the stack used for internal thread which is ran for
	  incoming packet processing.

config ETH_KSZ8851SNL_RX_THREAD_PRIO
	int "Priority for internal incoming packet handler"
	depends on ETH_KSZ8851SNL
	default 2
	help
	  Priority level for internal thread which is ran for incoming
	  packet processing.

config ETH_KSZ8851SNL_TIMEOUT
	int "IP buffer timeout"
	depends on ETH_KSZ8851SNL
	default 100
	help
	  Given timeout in milliseconds. Maximum amount of time
	  that the driver will wait from the IP stack to get
	  a memory buffer before the Ethernet frame is dropped.
```
