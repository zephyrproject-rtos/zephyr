## drivers/dma/Kconfig.intel_adsp_gpdma
```kconfig
# DMA configuration options

# Copyright (c) 2022 Intel Corporation
# SPDX-License-Identifier: Apache-2.0

config DMA_INTEL_ADSP_GPDMA
	bool "Intel ADSP General Purpose Direct Memory Access driver"
	default y
	depends on DT_HAS_INTEL_ADSP_GPDMA_ENABLED
	help
	  Intel ADSP DMA driver.

if DMA_INTEL_ADSP_GPDMA

config DMA_INTEL_ADSP_GPDMA_NEED_CONTROLLER_OWNERSHIP
	bool
	default y if !SOC_INTEL_CAVS_V15
	help
	  Hidden option to indicate that the driver needs to request
	  dma controller ownership from the host.

config DMA_INTEL_ADSP_GPDMA_HAS_LLP
	bool "Intel ADSP GPDMA Linear Link Position Feature"
	default y if SOC_SERIES_INTEL_ACE
	help
	  Intel ADSP GPDMA may optionally have a linear link position
	  feature.

source "drivers/dma/Kconfig.dw_common"

endif # DMA_INTEL_ADSP_GPDMA
```

## drivers/dma/Kconfig.intel_adsp_hda
```kconfig
# Intel ADSP HDA configuration options

# Copyright (c) 2022 Intel Corporation
# SPDX-License-Identifier: Apache-2.0

config DMA_INTEL_ADSP_HDA_HOST_IN
	bool "Intel ADSP HDA Host In DMA drivers"
	default y
	depends on DT_HAS_INTEL_ADSP_HDA_HOST_IN_ENABLED
	depends on DMA
	select DMA_INTEL_ADSP_HDA
	help
	  Intel ADSP Host HDA DMA driver.

config DMA_INTEL_ADSP_HDA_HOST_OUT
	bool "Intel ADSP HDA Host Out DMA drivers"
	default y
	depends on DT_HAS_INTEL_ADSP_HDA_HOST_OUT_ENABLED
	select DMA_INTEL_ADSP_HDA
	help
	  Intel ADSP Host HDA DMA driver.

config DMA_INTEL_ADSP_HDA_LINK_IN
	bool "Intel ADSP HDA Link In DMA drivers"
	default y
	depends on DT_HAS_INTEL_ADSP_HDA_LINK_IN_ENABLED
	select DMA_INTEL_ADSP_HDA
	help
	  Intel ADSP Link In HDA DMA driver.

config DMA_INTEL_ADSP_HDA_LINK_OUT
	bool "Intel ADSP HDA Link Out DMA drivers"
	default y
	depends on DT_HAS_INTEL_ADSP_HDA_LINK_OUT_ENABLED
	select DMA_INTEL_ADSP_HDA
	help
	  Intel ADSP Link Out HDA DMA driver.

config DMA_INTEL_ADSP_HDA
	bool
	depends on DMA_INTEL_ADSP_HDA_LINK_OUT || DMA_INTEL_ADSP_HDA_LINK_IN || DMA_INTEL_ADSP_HDA_HOST_OUT || DMA_INTEL_ADSP_HDA_HOST_IN
	help
	  Intel ADSP HDA DMA driver.

config DMA_INTEL_ADSP_HDA_TIMING_L1_EXIT
	bool "Intel ADSP HDA Host L1 Exit Interrupt"
	default y if SOC_INTEL_ACE15_MTPM
	default y if SOC_INTEL_ACE20_LNL
	depends on DMA_INTEL_ADSP_HDA_HOST_IN || DMA_INTEL_ADSP_HDA_HOST_OUT
	help
	  Intel ADSP HDA Host Interrupt for L1 exit.
```

## drivers/dma/Kconfig.intel_lpss
```kconfig
# LPSS DMA configuration options

# Copyright (c) 2023 Intel Corporation
# SPDX-License-Identifier: Apache-2.0

config DMA_INTEL_LPSS
	bool "INTEL LPSS DMA driver"
	default y
	depends on DT_HAS_INTEL_LPSS_ENABLED
	select DEVICE_DEPS
	help
	  INTEL LPSS DMA driver.

if DMA_INTEL_LPSS

source "drivers/dma/Kconfig.dw_common"

endif # DMA_INTEL_LPSS
```

## drivers/dma/Kconfig.iproc_pax
```kconfig
# Copyright 2020 Broadcom
# SPDX-License-Identifier: Apache-2.0

config DMA_IPROC_PAX
	bool
	prompt "Broadcom PAX(PCIE<->AXI) DMA driver"
	depends on PCIE_EP_IPROC

config DMA_IPROC_PAX_V2
	bool
	prompt "Broadcom PAX(PCIE<->AXI) DMA driver version 2"
	depends on PCIE_EP_IPROC_V2

if DMA_IPROC_PAX || DMA_IPROC_PAX_V2

config DMA_IPROC_PAX_DEBUG
	bool "PAX DMA paranoid debug checks"
	help
	  Add paranoid checks for buffer address/size
	  alignments for each dma packet.

choice
	prompt "PAX DMA API modes"
	default DMA_IPROC_PAX_IRQ_SYNC

config DMA_IPROC_PAX_POLL_MODE
	bool "PAX DMA API in polling mode"
	help
	  PAX DMA API polls for dma completions

config DMA_IPROC_PAX_IRQ_SYNC
	bool "PAX DMA synchronous API with interrupt support"
	help
	  PAX DMA API blocks until dma completion alert is
	  signalled from ring interrupt handler.

endchoice

choice
	prompt "PAX DMA Ring operation mode"
	default DMA_IPROC_PAX_TOGGLE_MODE

config DMA_IPROC_PAX_TOGGLE_MODE
	bool "PAX DMA Ring toggle mode"
	help
	  PAX DMA hardware ring operation in toggle mode

config DMA_IPROC_PAX_DOORBELL_MODE
	bool "PAX DMA Ring door bell mode"
	help
	  PAX DMA hardware ring operation in doorbell mode

endchoice

endif
```

## drivers/dma/Kconfig.max32
```kconfig
# Copyright (c) 2023 Analog Devices, Inc.
# SPDX-License-Identifier: Apache-2.0

config DMA_MAX32
	bool "MAX32 MCU DMA driver"
	default y
	depends on DT_HAS_ADI_MAX32_DMA_ENABLED
	help
	  Enable DMA support on the MAX32 family of processors.
```

## drivers/dma/Kconfig.mchp
```kconfig
# Copyright (c) 2025-2026 Microchip Technology Inc.
# SPDX-License-Identifier: Apache-2.0

config DMA_MCHP_DMAC_G1
	bool "Microchip G1 DMA driver"
	default y
	depends on DT_HAS_MICROCHIP_DMAC_G1_DMA_ENABLED && !DMA_64BIT
	help
	  Enables the G1 DMA driver support for Microchip MCUs.

config DMA_MCHP_DMAC_G2
	bool "Microchip G2 DMA driver"
	default y
	depends on DT_HAS_MICROCHIP_DMAC_G2_DMA_ENABLED && !DMA_64BIT
	help
	  Enables the G2 DMA driver support for Microchip MCUs.

config DMA_MCHP_DMAC_G3
	bool "Microchip G3 DMA driver"
	default y
	depends on DT_HAS_MICROCHIP_DMAC_G3_DMA_ENABLED && !DMA_64BIT
	help
	  Enables the G3 DMA driver support for Microchip MCUs.

if DMA_MCHP_DMAC_G3

config	DMAC_DESC_COUNT
	int "DMAC descriptor count"
	default 10
	help
	  Number of descriptors to preallocate.

endif # DMA_MCHP_DMAC_G3
```

## drivers/dma/Kconfig.mcux
```kconfig
# Kconfig - MCUXpresso SDK DMA
#
#
#
# Copyright (c) 2017, Phytec Messtechnik GmbH
#
# SPDX-License-Identifier: Apache-2.0
#

menuconfig DMA_MCUX
	bool "Enable MCUX DMA driver"
	default n
	depends on HAS_MCUX
	help
	  MCUX eDMA driver.

if DMA_MCUX

config DMA_MCUX_ENABLE_DEBUG_MODE
	bool "Enable debug mode"
	default y
	help
	  When the system is in debug mode and this option is enabled,
	  the DMA controller stalls the start of a new channel.
	  Channel execution resumes when the system exits debug mode.

choice
prompt "Channel Arbitration Mode"
default DMA_MCUX_ROUND_ROBIN_ARBITRATION_MODE

config DMA_MCUX_FIXED_PRIORITY_ARBITRATION_MODE
	bool "Fixed priority arbitration mode"
	help
	  Fixed priority arbitration is used for channel selection.

config DMA_MCUX_ROUND_ROBIN_ARBITRATION_MODE
	bool "Round robin arbitration mode"
	help
	  Round robin arbitration is used for channel selection.

endchoice

config DMA_MCUX_NUMOF_DMA_CHANNELS
	int "Number of enabled DMA channels"
	default 2
	range 1 8
	help
	  This option configures the number of enabled DMA channels.

config DMA_MCUX_TCD0_QUEUE_SIZE
	int "TCD0 pool length"
	default 0
	range 0 8
	help
	  This option configures the size of the Transfer
	  Control Descriptor (TCD) queue for the DMA channel 0.

config DMA_MCUX_TCD1_QUEUE_SIZE
	int "TCD1 pool length"
	default 0
	range 0 8
	help
	  This option configures the size of the Transfer
	  Control Descriptor (TCD) queue for the DMA channel 1.

config DMA_MCUX_TCD2_QUEUE_SIZE
	int "TCD2 pool length"
	default 0
	range 0 8
	help
	  This option configures the size of the Transfer
	  Control Descriptor (TCD) queue for the DMA channel 2.

config DMA_MCUX_TCD3_QUEUE_SIZE
	int "TCD3 pool length"
	default 0
	range 0 8
	help
	  This option configures the size of the Transfer
	  Control Descriptor (TCD) queue for the DMA channel 3.

config DMA_MCUX_TCD4_QUEUE_SIZE
	int "TCD4 pool length"
	default 0
	range 0 8
	help
	  This option configures the size of the Transfer
	  Control Descriptor (TCD) queue for the DMA channel 4.

config DMA_MCUX_TCD5_QUEUE_SIZE
	int "TCD5 pool length"
	default 0
	range 0 8
	help
	  This option configures the size of the Transfer
	  Control Descriptor (TCD) queue for the DMA channel 5.

config DMA_MCUX_TCD6_QUEUE_SIZE
	int "TCD6 pool length"
	default 0
	range 0 8
	help
	  This option configures the size of the Transfer
	  Control Descriptor (TCD) queue for the DMA channel 6.

config DMA_MCUX_TCD7_QUEUE_SIZE
	int "TCD7 pool length"
	default 0
	range 0 8
	help
	  This option configures the size of the Transfer
	  Control Descriptor (TCD) queue for the DMA channel 7.

endif # DMA_MCUX
```

## drivers/dma/Kconfig.mcux_edma
```kconfig
# DMA configuration options

# Copyright (c) 2020, NXP
# SPDX-License-Identifier: Apache-2.0

EDMA_COMPAT := $(DT_COMPAT_NXP_MCUX_EDMA)
REV_PROP := nxp,version
DMAMUX_PROP:= has-dmamux

config DMA_MCUX_EDMA
	bool "MCUX DMA driver"
	default y
	depends on $(dt_compat_any_has_prop,$(EDMA_COMPAT),$(REV_PROP),2)
	imply NOCACHE_MEMORY if CPU_HAS_DCACHE
	help
	  DMA version 2 driver for MCUX series SoCs with EDMA IP.

config DMA_MCUX_EDMA_V3
	bool "MCUX DMA v3 driver"
	default y
	depends on $(dt_compat_any_has_prop,$(EDMA_COMPAT),$(REV_PROP),3)
	help
	  DMA version 3 driver for MCUX series SoCs with DMA3 IP.

config DMA_MCUX_EDMA_V4
	bool "MCUX DMA UNIFIED driver"
	default y
	depends on $(dt_compat_any_has_prop,$(EDMA_COMPAT),$(REV_PROP),4) || \
	           $(dt_compat_any_has_prop,$(EDMA_COMPAT),$(REV_PROP),5)
	help
	  DMA version 4  driver for MCUX Series SoCs Equipped
	  with Multiple EDMA IPs(EDMA, DMA3, EDMA4, EDMA5).
	  For the EDMA4 driver, it is compatible with different EDMA IPs
	  and allows different EDMA IPs to be used within a single project.
	  However, it required provide additional support in the SDK
	  device header. Therefore, only new SoCs could use it.

config DMA_MCUX_EDMA_DMAMUX
	bool
	default (DMA_MCUX_EDMA || $(dt_compat_any_has_prop,$(EDMA_COMPAT),$(DMAMUX_PROP),True))
	help
	  Automatically enabled when EDMA device tree node has has-dmamux property.

config DMA_MCUX_MAX_DATA_SIZE
	int
	default 64 if DMA_MCUX_EDMA_V4 || DMA_MCUX_EDMA_V3
	default 32

if DMA_MCUX_EDMA || DMA_MCUX_EDMA_V3 || DMA_MCUX_EDMA_V4

config DMA_TCD_QUEUE_SIZE
	int "number of TCD in a queue for SG mode"
	default 2
	help
	  number of TCD in a queue for SG mode

config DMA_MCUX_TEST_SLOT_START
	int "test slot start num"
	depends on (SOC_SERIES_K6X || SOC_SERIES_KE1XF \
		    || SOC_SERIES_S32K3 || SOC_SERIES_S32ZE || SOC_SERIES_KE1XZ || SOC_SERIES_MCXE24X \
		    || SOC_SERIES_MCXE31X)
	default 58 if SOC_SERIES_K6X
	default 60 if SOC_SERIES_KE1XF
	default 60 if SOC_SERIES_KE1XZ
	default 62 if SOC_SERIES_S32K3 || SOC_SERIES_S32ZE || SOC_SERIES_MCXE24X || SOC_SERIES_MCXE31X
	help
	  test slot start num

ZEPHYR_DTCM := zephyr,dtcm

config DMA_MCUX_USE_DTCM_FOR_DMA_DESCRIPTORS
	bool "Use DTCM for DMA descriptors"
	default y
	depends on $(dt_chosen_enabled,$(ZEPHYR_DTCM))
	help
	  When this option is activated, the descriptors for DMA transfer are
	  located in the DTCM (Data Tightly Coupled Memory).

endif # DMA_MCUX_EDMA || DMA_MCUX_EDMA_V3 || DMA_MCUX_EDMA_V4
```

## drivers/dma/Kconfig.mcux_lpc
```kconfig
# Copyright (c) 2020-2023, NXP
# SPDX-License-Identifier: Apache-2.0

config DMA_MCUX_LPC
	bool "MCUX LPC DMAC driver"
	default y
	depends on DT_HAS_NXP_LPC_DMA_ENABLED
	help
	  DMA driver for MCUX LPC MCUs.

if DMA_MCUX_LPC

config DMA_MCUX_LPC_NUMBER_OF_DESCRIPTORS
	int "Number of DMA descriptors to use"
	default 16
	help
	  Each DMA descriptor can be used to transfer (1024*width) bytes of data.
	  Increase or decrease this value depending on the max number of data
	  transferred by the application.

config DMA_MCUX_LPC_NUMBER_OF_CHANNELS_ALLOCATED
	int "Number of DMA channels to allocate memory for in driver"
	default 0
	help
	  The MCUX LPC DMA driver can save memory by not allocating static data
	  depending on this value. So, the application can save some data memory
	  space by setting this value to suit its needs. The meaning of the value
	  is "total number of unique DMA channels ever expected to be used, maximum
	  out of all DMA controllers". A value of 0 (default) means to allocate
	  as many channel data structures as the maximum number of DMA channels
	  in any DMA controller hardware. About 1 KB per 3-4 channels unused can
	  be saved by fine tuning this Kconfig.

endif # DMA_MCUX_LPC
```

## drivers/dma/Kconfig.mcux_pxp
```kconfig
# Copyright 2023 NXP
# SPDX-License-Identifier: Apache-2.0

config MCUX_PXP
	bool "MCUX PXP DMA driver"
	default y
	depends on DT_HAS_NXP_PXP_ENABLED
	depends on DISPLAY
	help
	  PXP DMA driver for NXP SOCs
```

## drivers/dma/Kconfig.mcux_smartdma
```kconfig
# Copyright 2023 NXP
# SPDX-License-Identifier: Apache-2.0

config DMA_MCUX_SMARTDMA
	bool "MCUX SmartDMA Driver"
	default y
	depends on DT_HAS_NXP_SMARTDMA_ENABLED
	select NXP_INPUTMUX
	help
	  MCUX SmartDMA driver.
```

## drivers/dma/Kconfig.mec5
```kconfig
# Microchip MEC5 DMAC configuration options
# Copyright (c) 2024 Microchip Technology Inc.
# SPDX-License-Identifier: Apache-2.0

config DMA_MCHP_MEC5
	bool "Microchip MEC5 series DMAC driver"
	default y
	depends on DT_HAS_MICROCHIP_MEC5_DMAC_ENABLED
	help
	  DMA driver for Microchip MEC5 series MCUs.
```

## drivers/dma/Kconfig.mspm0
```kconfig
# Copyright (c) 2025 Linumiz
#
# SPDX-License-Identifier: Apache-2.0

config DMA_MSPM0
	bool "MSPM0 DMA controller driver"
	default y
	depends on DT_HAS_TI_MSPM0_DMA_ENABLED
	help
	  Enable DMA controller driver for TI's MSPM0.
```

## drivers/dma/Kconfig.nios2_msgdma
```kconfig
# Nios-II mSGDMA driver configuration options

# Copyright (c) 2018 Intel Corporation
# SPDX-License-Identifier: Apache-2.0

config DMA_NIOS2_MSGDMA
	bool "Nios-II  Modular Scatter-Gather DMA(MSGDMA) driver"
	default y
	depends on DT_HAS_ALTR_MSGDMA_ENABLED
	help
	  Enable Nios-II Modular Scatter-Gather DMA(MSGDMA) driver.
```

## drivers/dma/Kconfig.npcx
```kconfig
# Copyright (c) 2025 Nuvoton Technology Corporation.
# SPDX-License-Identifier: Apache-2.0

# NPCX GDMA driver configuration options

config DMA_NPCX_GDMA
	bool "NPCX GDMA driver"
	default y
	depends on DT_HAS_NUVOTON_NPCX_GDMA_ENABLED
	help
	  GDMA driver for NPCX series

config DMA_NPCX_GDMA_EX
	bool "Extended NPCX GDMA driver support"
	default y
	depends on $(dt_compat_any_has_prop,$(DT_COMPAT_NUVOTON_NPCX_GDMA),support-npckn-v1,True)
	help
	  This option enables extended GDMA support for NPCKn variant of processors.
```

## drivers/dma/Kconfig.nrf
```kconfig
# Copyright (c) 2025 Nordic Semiconductor ASA
# SPDX-License-Identifier: Apache-2.0

config DMA_NRF_MVDMA
	depends on DT_HAS_NORDIC_NRF_MVDMA_ENABLED
	bool "nRF MVDMA driver"
```

## drivers/dma/Kconfig.nxp
```kconfig
# Copyright 2025
# SPDX-License-Identifier: Apache-2.0

config DMA_NXP
	bool "NXP DMA driver"
	default y
	depends on DT_HAS_NXP_DMA_ENABLED
```

## drivers/dma/Kconfig.nxp_4ch_dma
```kconfig
# Copyright 2025 NXP
# SPDX-License-Identifier: Apache-2.0

config DMA_NXP_4CH_DMA
	bool "NXP 4 channel DMA driver"
	default y
	depends on DT_HAS_NXP_4CH_DMA_ENABLED
```

## drivers/dma/Kconfig.nxp_edma
```kconfig
# Copyright 2024 NXP
# SPDX-License-Identifier: Apache-2.0

config DMA_NXP_EDMA
	bool "NXP enhanced Direct Memory Access (eDMA) driver"
	default y
	depends on DT_HAS_NXP_EDMA_ENABLED
	help
		Enable driver for NXP's eDMA IP.

if DMA_NXP_EDMA

config DMA_NXP_EDMA_ALIGN
	int "Alignment (in bytes) required for the transfers"
	default 8
	help
		Use this to set the alignment (in bytes)
		used by entities employing this driver to
		adjust the addresses and sizes of the memory
		regions involved in the transfer process.
		This value needs to match one of the possible
		values for SSIZE and DSIZE, otherwise the
		driver will return an error upon configuration.

config DMA_NXP_EDMA_ENABLE_HALFMAJOR_IRQ
	bool "Set if CPU should be interrupted when CITER = BITER / 2"
	default n
	help
		Enable this configuration if the CPU should be
		interrupted when CITER = BITER / 2. Using this,
		the CPU will be interrupted when CITER = BITER and
		when CITER = BITER / 2.

endif # DMA_NXP_EDMA
```

## drivers/dma/Kconfig.nxp_gdma
```kconfig
# Copyright (c) 2026 NXP
# SPDX-License-Identifier: Apache-2.0

config DMA_NXP_GDMA
	bool "NXP GDMA driver"
	default y
	depends on DT_HAS_NXP_GDMA_ENABLED
	help
	  DMA driver for NXP GDMA (General DMA) controller.
	  This driver supports memory-to-memory, memory-to-peripheral,
	  and peripheral-to-memory transfers.
```

## drivers/dma/Kconfig.nxp_sdma
```kconfig
# Copyright 2024 NXP
# SPDX-License-Identifier: Apache-2.0

config DMA_NXP_SDMA
	bool "NXP SDMA driver"
	default y
	depends on DT_HAS_NXP_SDMA_ENABLED
	help
		Enable driver for NXP's SDMA IP.
```
