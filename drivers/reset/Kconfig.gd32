## drivers/reset/Kconfig.gd32
```kconfig
# Copyright (c) 2022 Teslabs Engineering S.L.
# SPDX-License-Identifier: Apache-2.0

config RESET_GD32
	bool "GD32 Reset Controller Driver"
	default y
	depends on DT_HAS_GD_GD32_RCTL_ENABLED
```

## drivers/reset/Kconfig.intel_socfpga
```kconfig
# Copyright (c) 2022, Intel Corporation
# SPDX-License-Identifier: Apache-2.0

config RESET_INTEL_SOCFPGA
	bool "Intel SoC FPGA Reset Controller driver"
	default y
	depends on DT_HAS_INTEL_SOCFPGA_RESET_ENABLED
	help
	  Enable the Reset driver for Intel SoC FPGA device
```

## drivers/reset/Kconfig.lpc_syscon
```kconfig
# Copyright 2024 NXP
# SPDX-License-Identifier: Apache-2.0

config RESET_NXP_SYSCON
	bool "NXP Syscon Reset controller driver"
	default y
	depends on DT_HAS_NXP_LPC_SYSCON_RESET_ENABLED
	help
	  Enable the NXP syscon reset controller driver.
	  Syscon is found on LPC parts and LPC heritage parts.
```

## drivers/reset/Kconfig.mchp
```kconfig
# Copyright (c) 2025 Microchip Technology Inc.
# SPDX-License-Identifier: Apache-2.0

config RESET_MCHP_RSTC_G1
	bool "Microchip Reset Controller g1 peripheral driver"
	default y
	depends on DT_HAS_MICROCHIP_RSTC_G1_RESET_ENABLED
	help
	  Enable RESET driver for Microchip G1.
```

## drivers/reset/Kconfig.mchp_mss
```kconfig
# Copyright (c) 2025 Microchip Technology Inc
# SPDX-License-Identifier: Apache-2.0

config RESET_MCHP_MSS
	bool "Microchip PolarFire SoC and PIC64GX reset driver"
	depends on DT_HAS_MICROCHIP_MPFS_RESET_ENABLED
	help
	  This option enables the reset driver for Microchip's PolarFire SoC
	  and PIC64GX platform.
```

## drivers/reset/Kconfig.mmio
```kconfig
# MMIO reset driver configuration options

# Copyright (c) 2025 Google LLC
# SPDX-License-Identifier: Apache-2.0

config RESET_MMIO
	bool "Generic MMIO reset driver"
	default y
	depends on DT_HAS_RESET_MMIO_ENABLED
	help
	  This option enables the generic MMIO reset driver. This is meant for IPs with a single memory mapped reset bit required to take them out of reset.
```

## drivers/reset/Kconfig.npcx
```kconfig
# NPCX reset controller driver configuration options

# Copyright (c) 2024 Nuvoton Technology Corporation.
# SPDX-License-Identifier: Apache-2.0

config RESET_NPCX
	bool "Nuvoton NPCX embedded controller (EC) reset controller driver"
	default y
	depends on DT_HAS_NUVOTON_NPCX_RST_ENABLED
	help
	  This option enables the reset controller driver for Nuvoton NPCX MCUs.
```

## drivers/reset/Kconfig.numaker
```kconfig
# Nuvoton NuMaker Reset Controller configuration options

# Copyright (c) 2023 Nuvoton Technology Corporation.
# SPDX-License-Identifier: Apache-2.0

config RESET_NUMAKER
	bool "Nuvoton NuMaker reset controller driver"
	default y
	depends on DT_HAS_NUVOTON_NUMAKER_RST_ENABLED
	help
	  This option enables the reset controller driver for Nuvoton NuMaker MCUs.
```

## drivers/reset/Kconfig.nxp_mrcc
```kconfig
# Copyright 2025 NXP
# SPDX-License-Identifier: Apache-2.0

config RESET_NXP_MRCC
	bool "NXP MRCC Reset controller driver"
	default y
	depends on DT_HAS_NXP_MRCC_RESET_ENABLED
	help
	  Enable the NXP MRCC reset controller driver.
```

## drivers/reset/Kconfig.nxp_rstctl
```kconfig
# Copyright 2024 NXP
# SPDX-License-Identifier: Apache-2.0

config RESET_NXP_RSTCTL
	bool "NXP RSTCTL driver"
	default y
	depends on DT_HAS_NXP_RSTCTL_ENABLED
	help
	  Enable the driver for the NXP RSTCTL,
	  a peripheral reset controller.
```

## drivers/reset/Kconfig.rpi_pico
```kconfig
# Copyright (c) 2022 Andrei-Edward Popa
# SPDX-License-Identifier: Apache-2.0

config RESET_RPI_PICO
	bool "Raspberry Pi Reset Controller driver"
	default y
	depends on DT_HAS_RASPBERRYPI_PICO_RESET_ENABLED
```

## drivers/reset/Kconfig.rts5817
```kconfig
# Copyright (c) 2024 Realtek Semiconductor, Inc.
# SPDX-License-Identifier: Apache-2.0

config RESET_RTS5817
	bool "RTS5817 Reset Controller Driver"
	default y
	depends on DT_HAS_REALTEK_RTS5817_RESET_ENABLED
	help
	  This option enables the reset controller driver for RTS5817.
```

## drivers/reset/Kconfig.sf32lb
```kconfig
# Copyright (c) 2025 Qingsong Gou <gouqs@hotmail.com>
# SPDX-License-Identifier: Apache-2.0

config RESET_SF32LB
	bool "SF32LB Reset Controller"
	default y
	depends on DT_HAS_SIFLI_SF32LB_RCC_RCTL_ENABLED
	help
	  Enable support for SF32LB Reset Controller.
```

## drivers/reset/Kconfig.stm32
```kconfig
# Copyright (c) 2022 Google Inc
# SPDX-License-Identifier: Apache-2.0

config RESET_STM32
	bool "STM32 Reset Controller Driver"
	default y
	depends on DT_HAS_ST_STM32_RCC_RCTL_ENABLED
```

## drivers/reset/Kconfig.syna_sr100
```kconfig
# Copyright (c) 2025 Synaptics, Inc.
# SPDX-License-Identifier: Apache-2.0

config RESET_SYNA_SR100
	bool "Synaptics SR100 reset driver"
	default y
	depends on DT_HAS_SYNA_SR100_RESET_ENABLED
	help
	  This option enables the reset driver for Synaptics SR100 series SOC.
```

## drivers/reset/Kconfig.xec
```kconfig
# Copyright (c) 2023 Silicom Connectivity Solutions, Ltd
# SPDX-License-Identifier: Apache-2.0

config RESET_XEC
	bool "XEC Reset Controller Driver"
	default y
	depends on DT_HAS_MICROCHIP_XEC_PCR_RCTL_ENABLED
```

## drivers/retained_mem/Kconfig
```kconfig
# Copyright (c) Nordic Semiconductor ASA
# SPDX-License-Identifier: Apache-2.0

menuconfig RETAINED_MEM
	bool "Retained memory drivers"
	help
	  Enables support for drivers that can retain their data whilst the
	  device is powered (may be lost in low power states).

if RETAINED_MEM

config RETAINED_MEM_INIT_PRIORITY
	int "Retained memory devices init priority"
	default 40
	help
	  Retained memory devices initialization priority,

config RETAINED_MEM_MUTEXES
	bool
	default y
	depends on MULTITHREADING
	depends on !RETAINED_MEM_MUTEX_FORCE_DISABLE

config RETAINED_MEM_MUTEX_FORCE_DISABLE
	bool "Disable retained memory mutex support"
	depends on MULTITHREADING
	help
	  Disable use of mutexes which prevent issues with concurrent retained
	  memory access. This option should only be enabled when retained
	  memory access is required in an ISR or for special use cases.

module = RETAINED_MEM
module-str = retained_mem
source "subsys/logging/Kconfig.template.log_config"

source "drivers/retained_mem/Kconfig.nrf"

source "drivers/retained_mem/Kconfig.zephyr"

endif # RETAINED_MEM
```

## drivers/retained_mem/Kconfig.esp32
```kconfig
# Copyright (c) 2025 Espressif Systems (Shanghai) CO LTD
#
# SPDX-License-Identifier: Apache-2.0

config RETAINED_MEM_ESP32_RTCRAM
	bool "ESP32 RTCRAM retention driver"
	default y
	depends on DT_HAS_ZEPHYR_RETAINED_RAM_ENABLED && RETAINED_MEM_ZEPHYR_RAM && POWEROFF
	depends on HAS_ESPRESSIF_RAM_CTRL
	help
	  Enable driver for ESP32 RTCRAM retention
```

## drivers/retained_mem/Kconfig.gd32
```kconfig
# Copyright (c) 2026 Aleksandr Senin <al@meshium.net>
# SPDX-License-Identifier: Apache-2.0

config RETAINED_MEM_GD32_BKPSRAM
	bool "GD32 Backup SRAM retained memory"
	default y
	depends on DT_HAS_GD_GD32_BACKUP_SRAM_ENABLED
	help
	  Enable retained memory driver for GD32 Backup SRAM. The driver enables
	  the BKPSRAM clock gate. To enable BLDO (Backup SRAM LDO) for retention,
	  use a regulator referenced via the devicetree vin-supply property.
```

## drivers/retained_mem/Kconfig.nrf
```kconfig
# Copyright (c) 2023 Nordic Semiconductor ASA
# SPDX-License-Identifier: Apache-2.0

config RETAINED_MEM_NRF_GPREGRET
	bool "nRF GPREGRET driver"
	default y
	depends on DT_HAS_NORDIC_NRF_GPREGRET_ENABLED
	help
	  Enable driver for Nordic nRF GPREGRET-based retained memory
	  register support.
```

## drivers/retained_mem/Kconfig.nxp
```kconfig
# SPDX-FileCopyrightText: 2026 Basalte bv
# SPDX-License-Identifier: Apache-2.0

config RETAINED_MEM_NXP_SNVS_GPR
	bool "NXP i.MX SNVS General Purpose Registers retained memory driver"
	default y
	depends on DT_HAS_NXP_IMX_SNVS_GPR_ENABLED
	help
	  Enable the retained memory driver for the NXP i.MX SNVS Low-Power
	  General Purpose Registers. The bank's base address and size are
	  obtained from the MCUX HAL SNVS_Type definition for the active SoC.
```

## drivers/retained_mem/Kconfig.sf32lb
```kconfig
# Copyright (c) 2025 Qingsong Gou <gouqs@hotmail.com>
# SPDX-License-Identifier: Apache-2.0

config RETAINED_MEM_SF32LB_RTC_BKP
	bool "Sifli sf32lb rtc backup driver"
	default y
	depends on DT_HAS_SIFLI_SF32LB_RTC_BACKUP_ENABLED
	help
	  Enable driver for Sifli sf32lb rtc backup retained memory support.
```

## drivers/retained_mem/Kconfig.silabs
```kconfig
# Copyright (c) 2025 Silicon Laboratories Inc.
# SPDX-License-Identifier: Apache-2.0

config RETAINED_MEM_SILABS_BURAM
	bool "Silicon Labs BURAM driver"
	default y
	depends on DT_HAS_SILABS_BURAM_ENABLED
	help
	  Enable driver for Silicon Labs BURAM-based retained memory register support.
```

## drivers/retained_mem/Kconfig.zephyr
```kconfig
# Copyright (c) 2023 Nordic Semiconductor ASA
# SPDX-License-Identifier: Apache-2.0

menuconfig RETAINED_MEM_ZEPHYR_BBRAM
	bool "Generic BBRAM retained memory driver"
	default y
	depends on BBRAM
	depends on DT_HAS_ZEPHYR_RETAINED_BBRAM_ENABLED
	help
	  Enable driver for retained memory in BBRAM.

config RETAINED_MEM_ZEPHYR_BBRAM_CLEAR_CHUNK_SIZE
	int "Number of BBRAM bytes to clear at a time"
	default 128
	depends on RETAINED_MEM_ZEPHYR_BBRAM
	help
	  Dictates the size of stack allocation and number of writes performed by
	  each retained memory clear operation.

	  BBRAMs do not have a clear operation; to clear one, we must repeatedly
	  write chunks of zeroes. Each clear operation will stack-allocate this
	  many bytes, and then make ceil(BBRAM size / clear chunk size) writes.

config RETAINED_MEM_ZEPHYR_RAM
	bool "Generic Zephyr RAM retained memory driver"
	default y
	depends on DT_HAS_ZEPHYR_RETAINED_RAM_ENABLED
	help
	  Enable driver for retained memory in RAM.

config RETAINED_MEM_ZEPHYR_REG
	bool "Generic Zephyr register retained memory driver"
	default y
	depends on DT_HAS_ZEPHYR_RETAINED_REG_ENABLED
	help
	  Enable driver for retained memory in retained registers.
```

## drivers/retained_mem/retained_mem_rv3028/Kconfig
```kconfig
# Copyright (c) 2024 ANITRA system s.r.o.
# SPDX-License-Identifier: Apache-2.0

config RETAINED_MEM_RV3028
	bool "Micro Crystal RV3028 User RAM support"
	default y
	depends on RTC_RV3028
	depends on DT_HAS_MICROCRYSTAL_RV3028_RETMEM_ENABLED

config RETAINED_MEM_RV3028_INIT_PRIORITY
	int "RV3028 User RAM init priority"
	default 60
	depends on RETAINED_MEM_RV3028
	help
	  RV3028 User RAM driver device initialization priority. The memory is
	  part of the RV3028 RTC device and has to be initialized after the
	  RV3028 RTC driver.
```
