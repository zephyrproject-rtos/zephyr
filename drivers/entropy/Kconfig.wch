## drivers/espi/Kconfig.mec5
```kconfig
# Microchip MEC5 ESPI driver configuration

# Copyright (c) 2024 Microchip Technologies Inc.
# SPDX-License-Identifier: Apache-2.0

config ESPI_MEC5
	bool "Microchip MEC5 family ESPI driver"
	depends on DT_HAS_MICROCHIP_MEC5_ESPI_ENABLED
	help
	  Enable the Microchip MEC5 family ESPI driver.

if ESPI_MEC5

config ESPI_OOB_CHANNEL
	default y

config ESPI_FLASH_CHANNEL
	default y

config ESPI_PERIPHERAL_HOST_IO
	default y

config ESPI_PERIPHERAL_HOST_IO_PVT
	default  y

config ESPI_PERIPHERAL_HOST_MAILBOX
	default  y

config ESPI_PERIPHERAL_DEBUG_PORT_80
	default y

config ESPI_PERIPHERAL_UART
	default y

config ESPI_PERIPHERAL_UART_SOC_MAPPING
	int "SoC port exposed as logical eSPI UART"
	default 2 if SOC_SERIES_MEC174X || SOC_SERIES_MEC175X
	default 1 if SOC_SERIES_MECH172X
	depends on ESPI_PERIPHERAL_UART
	help
	  This tells the driver to which SoC UART to direct the UART traffic
	  send over eSPI from host.

config ESPI_OOB_BUFFER_SIZE
	int "eSPI OOB channel buffer size in bytes"
	default 128
	depends on ESPI_OOB_CHANNEL
	help
	  Use minimum RAM buffer size by default but allow applications to
	  override the value.
	  Maximum OOB payload is 73 bytes.

config ESPI_FLASH_BUFFER_SIZE
	int "eSPI Flash channel buffer size in bytes"
	default 256
	depends on ESPI_FLASH_CHANNEL
	help
	  Use maximum RAM buffer size defined by spec but allow applications
	  to override if eSPI host doesn't support it.

config ESPI_MEC5_PERIPHERAL_ACPI_SHD_MEM_SIZE
	int "Host I/O peripheral port size for shared memory in MEC5 series"
	depends on ESPI_MEC5 || ESPI_PERIPHERAL_ACPI_SHM_REGION
	default 256
	help
	  This is the port size used by the Host and EC to communicate over
	  the shared memory region to return the ACPI response data.

config ESPI_MEC5_PERIPHERAL_HOST_CMD_PARAM_SIZE
	int "Host I/O peripheral port size for ec host command in MEC5 series"
	depends on ESPI_MEC5 || ESPI_PERIPHERAL_EC_HOST_CMD
	default 256
	help
	  This is the port size used by the Host and EC to communicate over
	  the shared memory region to return the host command parameter data.

config ESPI_PERIPHERAL_ACPI_EC_IBF_EVT_DATA
	bool "Read ACPI EC Event Data in IBF ISR"
	depends on ESPI_PERIPHERAL_CHANNEL
	help
	  Enable reading event data in ACPI EC IBF ISR. This is used in OS
	  environment where application expects IBF ISR to read data and pass
	  to callback.

config ESPI_SAF_MEC5
	bool "Microchip MEC5 ESPI SAF driver"
	default y
	depends on SOC_SERIES_MEC5
	depends on DT_HAS_MICROCHIP_MEC5_ESPI_SAF_ENABLED
	help
	  Enable the Microchip MEC5 family SAF ESPI driver.

config ESPI_SAF
	bool "Microchip MEC5 ESPI SAF driver"
	depends on ESPI_FLASH_CHANNEL
	help
	  Enable Slave Attached Flash eSPI driver. SAF depends upon ESPI MEC5 driver
	  and flash channel.

config ESPI_SAF_INIT_PRIORITY
	int "ESPI SAF driver initialization priority"
	depends on ESPI_SAF
	default 4
	help
	  Driver initialization priority for eSPI SAF driver.

if ESPI_PERIPHERAL_8042_KBC

config ESPI_PERIPHERAL_KBC_IBF_EVT_DATA
	bool "KBC event data format in IBF"
	help
	  Enable espi_evt_data_kbc format for encoding event in KBC IBF ISR

config ESPI_PERIPHERAL_KBC_OBE_CBK
	bool "KBC OBE Callback"
	help
	  Enable KBC OBE callback from OBE ISR

endif #ESPI_PERIPHERAL_8042_KBC

if ESPI_PERIPHERAL_ACPI_EC_IBF_EVT_DATA

config ESPI_PERIPHERAL_ACPI_EC_IBF_EVT_DATA_UD0
	bool "Select UD0 as the handshake bit between OS and ACPI EC"
	help
	  For ACPI_EC IBF event data use hardware status UD0 bit as a
	  handshake bit between OS and ACPI EC.

config ESPI_PERIPHERAL_ACPI_EC_IBF_EVT_DATA_UD1
	bool "Select UD1 as the handshake bit between OS and ACPI EC"
	help
	  For ACPI_EC IBF event data use hardware status UD1 bit as a
	  handshake bit between OS and ACPI EC.

endif #ESPI_PERIPHERAL_ACPI_EC_IBF_EVT_DATA

endif #ESPI_MEC5
```

## drivers/espi/Kconfig.nct
```kconfig
# NCT eSPI driver configuration options

# Copyright (c) 2025 Nuvoton Technology Corporation.
# SPDX-License-Identifier: Apache-2.0

config ESPI_NCT
	bool "Nuvoton NCT ESPI driver"
	depends on SOC_FAMILY_NCT
	help
	  This option enables the Intel Enhanced Serial Peripheral Interface
	  (eSPI) for NCT family of processors.

config ESPI_NCT_PERIPHERAL_ACPI_SHD_MEM_SIZE
	int "Host I/O peripheral port size for shared memory in nct series"
	depends on ESPI_NCT || ESPI_PERIPHERAL_ACPI_SHM_REGION
	default 256
	help
	  This is the port size used by the Host and NCT to communicate over
	  the shared memory region to return the ACPI response data. Please
	  notice the valid value in nct for this option is 8/16/32/
	  64/128/256/512/1024/2048/4096 bytes.

config ESPI_NCT_PERIPHERAL_HOST_CMD_PARAM_SIZE
	int "Host I/O peripheral port size for host command in nct series"
	depends on ESPI_NCT || ESPI_PERIPHERAL_EC_HOST_CMD
	default 256
	help
	  This is the port size used by the Host and nct to communicate over
	  the shared memory region to return the host command parameter data.
	  Please notice the valid value in nct for this option is
	  8/16/32/64/128/256/512/1024/2048/4096 bytes.

config ESPI_TAF_NCT
	bool "Nuvoton NCT ESPI TAF driver"
	depends on SOC_SERIES_NCT66
	depends on FLASH
	help
	  This option enables the Intel Enhanced Serial Peripheral Interface
	  Target Attached Flash (eSPI TAF) for NCT66 family of processors.

choice ESPI_NCT_TAF_ACCESS_MODE_CHOICE
	prompt "eSPI TAF Read Access Mode"
	default ESPI_NCT_TAF_AUTO_MODE

config ESPI_NCT_TAF_AUTO_MODE
	bool "eSPI TAF Automatic Mode"
	help
	  This is the setting to use auto mode for eSPI TAF read.

config ESPI_NCT_TAF_MANUAL_MODE
	bool "eSPI TAF Manual Mode"
	help
	  This is the setting to use manual mode for eSPI TAF read.

endchoice

config ESPI_TAF_PR_NUM
	int "Sets of protection region settings"
	default 16
	help
	  This size is display how many group of slave attached flash protection
	  region.

# The default value 'y' for the existing options if ESPI_NCT is selected.
if ESPI_NCT

config ESPI_FLASH_CHANNEL
	default  y

config ESPI_OOB_CHANNEL
	default  y

config ESPI_PERIPHERAL_8042_KBC
	default n

config ESPI_PERIPHERAL_HOST_IO
	default n

config ESPI_PERIPHERAL_DEBUG_PORT_80
	default n

config ESPI_PERIPHERAL_EC_HOST_CMD
	default n

config ESPI_PERIPHERAL_ACPI_SHM_REGION
	default y

config ESPI_PERIPHERAL_CUSTOM_OPCODE
	default n

config ESPI_PERIPHERAL_PMCH3
	bool "NCT PMCH3 Support"
	default n
	help
	  Enables PM channel 3 for eSPI peripheral channel.

config ESPI_PERIPHERAL_PMCH4
	bool "NCT PMCH4 Support"
	default n
	help
	  Enables PM channel 4 for eSPI peripheral channel.

config ESPI_NCT_SUPP_VW_GPIO
	bool "Indicates that the eSPI hardware supports virtual wire GPIOs"
	default n
	help
	  Supports virtual wire GPIOs in eSPI module.

endif #ESPI_NCT
```

## drivers/espi/Kconfig.npcm4xx
```kconfig
# NPCM4XX eSPI driver configuration options

# Copyright (c) 2020 Nuvoton Technology Corporation.
# SPDX-License-Identifier: Apache-2.0

config ESPI_NPCM
	bool "Nuvoton NPCM ESPI driver"
	depends on SOC_FAMILY_NPCM
	help
	  This option enables the Intel Enhanced Serial Peripheral Interface
	  (eSPI) for NPCM4XX family of processors.

config ESPI_NPCM4XX_PERIPHERAL_ACPI_SHD_MEM_SIZE
	int "Host I/O peripheral port size for shared memory in npcm4xx series"
	depends on ESPI_NPCM4XX || ESPI_PERIPHERAL_ACPI_SHM_REGION
	default 256
	help
	  This is the port size used by the Host and NPCM4XX to communicate over
	  the shared memory region to return the ACPI response data. Please
	  notice the valid value in npcm4xx for this option is 8/16/32/
	  64/128/256/512/1024/2048/4096 bytes.

config ESPI_NPCM4XX_PERIPHERAL_HOST_CMD_PARAM_SIZE
	int "Host I/O peripheral port size for host command in npcm4xx series"
	depends on ESPI_NPCM4XX || ESPI_PERIPHERAL_EC_HOST_CMD
	default 256
	help
	  This is the port size used by the Host and npcm4xx to communicate over
	  the shared memory region to return the host command parameter data.
	  Please notice the valid value in npcm4xx for this option is
	  8/16/32/64/128/256/512/1024/2048/4096 bytes.

# The default value 'y' for the existing options if ESPI_NPCM4XX is selected.
if ESPI_NPCM4XX

config ESPI_OOB_CHANNEL
	default  y

config ESPI_PERIPHERAL_8042_KBC
	default n

config ESPI_PERIPHERAL_HOST_IO
	default y

config ESPI_PERIPHERAL_DEBUG_PORT_80
	default n

config ESPI_PERIPHERAL_EC_HOST_CMD
	default y

config ESPI_PERIPHERAL_ACPI_SHM_REGION
	default y

config ESPI_PERIPHERAL_CUSTOM_OPCODE
	default y

config ESPI_PERIPHERAL_PMCH3
	bool "NPCM4XX PMCH3 Support"
	default y
	help
	  Enables PM channel 3 for eSPI peripheral channel.

config ESPI_PERIPHERAL_PMCH4
	bool "NPCM4XX PMCH4 Support"
	default y
	help
	  Enables PM channel 4 for eSPI peripheral channel.

endif #ESPI_NPCM4XX
```

## drivers/espi/Kconfig.npcx
```kconfig
# NPCX eSPI driver configuration options

# Copyright (c) 2020 Nuvoton Technology Corporation.
# SPDX-License-Identifier: Apache-2.0

config ESPI_NPCX
	bool "Nuvoton NPCX embedded controller (EC) ESPI driver"
	default y
	depends on SOC_FAMILY_NPCX
	depends on DT_HAS_NUVOTON_NPCX_ESPI_ENABLED
	help
	  This option enables the Intel Enhanced Serial Peripheral Interface
	  (eSPI) for NPCX family of processors.

config ESPI_NPCX_PERIPHERAL_ACPI_SHD_MEM_SIZE
	int "Host I/O peripheral port size for shared memory in npcx series"
	depends on ESPI_NPCX || ESPI_PERIPHERAL_ACPI_SHM_REGION
	default 256
	help
	  This is the port size used by the Host and EC to communicate over
	  the shared memory region to return the ACPI response data. Please
	  notice the valid value in npcx ec series for this option is 8/16/32/
	  64/128/256/512/1024/2048/4096 bytes.

config ESPI_NPCX_PERIPHERAL_HOST_CMD_PARAM_SIZE
	int "Host I/O peripheral port size for ec host command in npcx series"
	depends on ESPI_NPCX || ESPI_PERIPHERAL_EC_HOST_CMD
	default 256
	help
	  This is the port size used by the Host and EC to communicate over
	  the shared memory region to return the host command parameter data.
	  Please notice the valid value in npcx ec series for this option is
	  8/16/32/64/128/256/512/1024/2048/4096 bytes.

config ESPI_NPCX_BYPASS_CH_ENABLE_FATAL_ERROR
	bool
	depends on SOC_SERIES_NPCX7 || SOC_SERIES_NPCX9
	default y
	help
	  Workaround the issue documented in NPCX99nF errata rev1_2, No.3.10.
	  Enabling an eSPI channel during an eSPI transaction might
	  (with low probability) cause the eSPI_SIF module to transition to
	  a wrong state and therefore response with FATAL_ERROR on an incoming
	  transaction.

config ESPI_NPCX_PERIPHERAL_DEBUG_PORT_80_MULTI_BYTE
	bool "Host can write 1/2/4 bytes of Port80 data in a eSPI transaction"
	depends on (SOC_SERIES_NPCX9 || SOC_SERIES_NPCX4) && ESPI_PERIPHERAL_DEBUG_PORT_80
	select RING_BUFFER
	help
	  EC can accept 1/2/4 bytes of Port 80 data written from the Host in an
	  eSPI transaction.

config ESPI_NPCX_PERIPHERAL_DEBUG_PORT_80_RING_BUF_SIZE
	int "Debug Port80 ring buffer size"
	depends on ESPI_NPCX_PERIPHERAL_DEBUG_PORT_80_MULTI_BYTE
	default 256
	help
	  The size of the ring buffer in byte used by the Port80 ISR to store
	  Postcodes from Host.

config ESPI_TAF_NPCX
	bool "Nuvoton NPCX embedded controller (EC) ESPI TAF driver"
	depends on SOC_SERIES_NPCX4
	depends on FLASH
	help
	  This option enables the Intel Enhanced Serial Peripheral Interface
	  Target Attached Flash (eSPI TAF) for NPCX4 family of processors.

choice ESPI_TAF_ACCESS_MODE_CHOICE
	prompt "eSPI TAF Read Access Mode"
	default ESPI_TAF_AUTO_MODE

config ESPI_TAF_AUTO_MODE
	bool "eSPI TAF Automatic Mode"
	help
	  This is the setting to use auto mode for eSPI TAF read.

config ESPI_TAF_MANUAL_MODE
	bool "eSPI TAF Manual Mode"
	help
	  This is the setting to use manual mode for eSPI TAF read.

endchoice

config ESPI_TAF_PR_NUM
	int "Sets of protection region settings"
	default 16
	help
	  This size is display how many group of slave attached flash protection
	  region.

# The default value 'y' for the existing options if ESPI_NPCX is selected.
if ESPI_NPCX

config ESPI_OOB_CHANNEL
	default  y

config ESPI_PERIPHERAL_8042_KBC
	default y

config ESPI_PERIPHERAL_HOST_IO
	default y

config ESPI_PERIPHERAL_DEBUG_PORT_80
	default y

config ESPI_PERIPHERAL_EC_HOST_CMD
	default y

config ESPI_PERIPHERAL_ACPI_SHM_REGION
	default y

config ESPI_PERIPHERAL_CUSTOM_OPCODE
	default y

config ESPI_NPCX_SUPP_VW_GPIO
	bool "Indicates that the eSPI hardware supports virtual wire GPIOs"
	default y if SOC_SERIES_NPCX9 || SOC_SERIES_NPCX4
	help
	  Selected if NPCX series supports virtual wire GPIOs in eSPI module.

config ESPI_NPCX_CAF_GLOBAL_RESET_WORKAROUND
	bool
	default y if SOC_SERIES_NPCX4 && ESPI_FLASH_CHANNEL
	help
	  Workaround the issue "Global Reset" in the npcx4 SoC errata.

endif #ESPI_NPCX
```

## drivers/espi/Kconfig.rts5912
```kconfig
# Copyright (c) 2025, Realtek, SIBG-SD7
# SPDX-License-Identifier: Apache-2.0

config ESPI_RTS5912
	bool "Realtek RTS5912 eSPI Driver"
	default y
	depends on DT_HAS_REALTEK_RTS5912_ESPI_ENABLED
	help
	  Enable the Realtek RTS5912 eSPI driver.

if ESPI_RTS5912

config ESPI_RTS5912_PRESERVED_DATA_HOOKS
	bool "Functions for saving and restoring internal state"
	help
	  Some of the RTS5912 ESPI driver's state is cached by software and
	  cannot be deduced from hardware registers. When this driver is
	  used in multi-image (e.g. A/B, RO/RW) firmware products that jump
	  between images without a full hardware reset, the cache is cleared
	  and no longer reflects the hardware state.

	  This option enables a pair of driver-specific functions that can be
	  called to export state data to be preserved ahead of soft-reboots
	  and then restore it. It is the caller's responsibility to retain the
	  state data somewhere safe in the meantime (e.g. BBRAM, NVRAM, etc)

config ESPI_PERIPHERAL_8042_KBC
	default y

config ESPI_PERIPHERAL_ACPI_SHM_REGION
	default y

config ESPI_PERIPHERAL_HOST_IO
	default y

config ESPI_PERIPHERAL_EC_HOST_CMD
	default y

config ESPI_PERIPHERAL_DEBUG_PORT_80
	default y

config ESPI_OOB_CHANNEL
	default y

config ESPI_FLASH_CHANNEL
	default y

endif
```
