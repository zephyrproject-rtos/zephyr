## drivers/entropy/Kconfig.wch
```kconfig
# WCH entropy generator driver configuration

# Copyright (c) 2025 James Bennion-Pedley
# SPDX-License-Identifier: Apache-2.0

config ENTROPY_WCH_RNG
	bool "WCH CH32 entropy number generator driver"
	default y
	depends on DT_HAS_WCH_RNG_ENABLED
	select ENTROPY_HAS_DRIVER
	help
	  This option enables the entropy number generator for CH32 SoCs
```

## drivers/entropy/Kconfig.wdt
```kconfig
# Kconfig.wdt - race watchdog timer against system timer to generate entropy
#
# Copyright (c) 2018 Intel Corporation
#
# SPDX-License-Identifier: Apache-2.0

config ENTROPY_WDT_RNG
	bool "Use watchdog timer jitter to generate entropy"
	depends on WATCHDOG
	select ENTROPY_HAS_DRIVER
	help
	  This option enables a "driver" that generates entropy by racing
	  the watchdog timer against a system timer.  The jitter between
	  these two drivers is used to generate entropy.  Please refer to
	  entropy_wdt.c for a more detailed explanation.

	  Enabling this feature will conflict with the use of the watchdog
	  timer.
```

## drivers/espi/Kconfig
```kconfig
# eSPI configuration options

# Copyright (c) 2019 Intel Corporation
# SPDX-License-Identifier: Apache-2.0

menuconfig ESPI
	bool "Enhanced Serial Peripheral Interface (eSPI) bus drivers"
	help
	  Enable ESPI Driver.

if ESPI

source "drivers/espi/Kconfig.xec"

source "drivers/espi/Kconfig.npcx"

source "drivers/espi/Kconfig.espi_emul"

source "drivers/espi/Kconfig.it8xxx2"

module = ESPI
module-str = espi
source "subsys/logging/Kconfig.template.log_config"

config ESPI_TARGET
	bool "ESPI target driver"
	default y
	help
	  Enables eSPI driver in target mode.

config ESPI_INIT_PRIORITY
	int "ESPI Controller driver initialization priority"
	default 3
	help
	  Driver initialization priority for eSPI driver.

config ESPI_PERIPHERAL_CHANNEL
	bool "eSPI peripheral channel"
	default y
	help
	  eSPI Controller supports peripheral channel.

config ESPI_VWIRE_CHANNEL
	bool "eSPI virtual wire channel"
	default y
	help
	  eSPI Controller supports virtual wires channel.

config ESPI_VWIRE_VALID_BIT_CHECK
	bool "eSPI virtual wire valid bit check"
	default y
	depends on ESPI_VWIRE_CHANNEL
	help
	  Enable the checking of the eSPI virtual wire valid bit. If this
	  configuration is not set, treat the new values as the previously
	  retained valid values and return the received virtual wire level.

config ESPI_AUTOMATIC_WARNING_ACKNOWLEDGE
	bool "Automatic acknowledge for eSPI HOST warnings"
	default y
	depends on ESPI_VWIRE_CHANNEL
	depends on ESPI_TARGET
	help
	  Enable automatic acknowledgment from eSPI target towards eSPI controller
	  whenever it receives suspend or reset warning.
	  If this is disabled, it means the app wants to be give the opportunity
	  to prepare for either HOST suspend or reset.

config ESPI_AUTOMATIC_BOOT_DONE_ACKNOWLEDGE
	bool "Automatic acknowledge target boot status"
	default y
	depends on ESPI_VWIRE_CHANNEL
	depends on ESPI_TARGET
	help
	  Enable automatic acknowledgment from target basic configuration been
	  completed by sending a virtual wire message to the eSPI master.
	  This depends on SPI boot configuration. It could be either very
	  early in the flow after the VW channel is configured. Or it could be
	  until flash channel is configured.

config ESPI_OOB_CHANNEL
	bool "eSPI Out-of-band channel"
	help
	  eSPI Controller supports OOB channel.

config ESPI_FLASH_CHANNEL
	bool "ESPI flash channel"
	help
	  eSPI Controller supports flash channel.

if ESPI_PERIPHERAL_CHANNEL

config ESPI_PERIPHERAL_UART
	bool "UART peripheral"
	help
	  Enables UART over eSPI peripheral channel.

config ESPI_PERIPHERAL_8042_KBC
	bool "8042 kbc peripheral"
	help
	  Enables 8042 keyboard controller over eSPI peripheral channel.

config ESPI_PERIPHERAL_HOST_IO
	bool "Host I/O peripheral"
	help
	  Enables ACPI Host I/O over eSPI peripheral channel.

config ESPI_PERIPHERAL_HOST_IO_PVT
	bool "Host I/O peripheral Private Channel"
	help
	  Enables ACPI Host I/O over eSPI peripheral channel for private channel.

config ESPI_PERIPHERAL_HOST_IO_PVT_PORT_NUM
	hex "Host I/O peripheral Private Channel"
	depends on ESPI_PERIPHERAL_HOST_IO_PVT
	default 0x06A00000
	help
	  This is the port number used by the Host and EC to communicate over
	  the private channel. Please ensure the Host code is configured to use
	  the same port. Also, ensure the port number selected doesn't clash
	  with the existing ports (like 80, 92, 62 etc).

config ESPI_PERIPHERAL_DEBUG_PORT_80
	bool "Debug Port 80 peripheral"
	help
	  Enables debug Port 80 over eSPI peripheral channel.

config ESPI_PERIPHERAL_EC_HOST_CMD
	bool "Host peripheral device support EC host command subsystem"
	help
	  Enables Embedded Controller (EC) host command subsystem via eSPI
	  peripheral channel.

config ESPI_PERIPHERAL_ACPI_SHM_REGION
	bool "Host peripheral device support shared memory region"
	help
	  Enables shared memory region over eSPI peripheral channel to access
	  the ACPI response data.

config ESPI_PERIPHERAL_ACPI_SHM_REGION_PORT_NUM
	hex "Host I/O peripheral port number for shared memory region"
	depends on ESPI_PERIPHERAL_ACPI_SHM_REGION
	default 0x0900
	help
	  This is the port number used by the Host and EC to communicate over
	  the shared memory region to access the ACPI response data. Please
	  ensure the Host code is configured to use for accessing ACPI response
	  data. Also, ensure the port number selected doesn't clash with the
	  existing ports.

config ESPI_PERIPHERAL_CUSTOM_OPCODE
	bool "Host peripheral device support customized opcode"
	help
	  Enables opcode is customized for certain platforms such as Chromebook
	  and so on over eSPI peripheral channel.

config ESPI_PERIPHERAL_HOST_CMD_DATA_PORT_NUM
	hex "Host I/O peripheral port number for ec host command data"
	depends on ESPI_PERIPHERAL_EC_HOST_CMD
	default 0x0200
	help
	  This is the port number used by the Host and EC to communicate over
	  the eSPI peripheral channel to send EC host command data and its
	  result. Please ensure the Host code is configured to use for accessing
	  host command data and result. Also, ensure the port number selected
	  doesn't clash with the existing ports.

config ESPI_PERIPHERAL_HOST_CMD_PARAM_PORT_NUM
	hex "Host I/O peripheral port number for ec host command parameters"
	depends on ESPI_PERIPHERAL_EC_HOST_CMD
	default 0x0800
	help
	  This is the port number used by the Host and EC to communicate over
	  the eSPI peripheral channel to access the host command request and
	  response data. Please ensure the Host code is configured to use for
	  accessing these package data. Also, ensure the port number selected
	  doesn't clash with the existing ports.

endif # ESPI_PERIPHERAL_CHANNEL

config ESPI_OOB_CHANNEL_RX_ASYNC
	bool "OOB host-initiated traffic handling"
	depends on ESPI_OOB_CHANNEL
	help
	  Enables asynchronous handling for host-initiated OOB traffic.
	  Otherwise OOB traffic is assumed to be always client-initiated.

config ESPI_TAF
	bool "ESPI TAF driver"
	depends on ESPI_FLASH_CHANNEL
	help
	  Enable Target Attached Flash eSPI driver. TAF depends upon ESPI driver
	  and flash channel.

config ESPI_TAF_INIT_PRIORITY
	int "ESPI TAF driver initialization priority"
	depends on ESPI_TAF
	default 4
	help
	  Driver initialization priority for eSPI TAF driver. TAF driver must
	  initialize after the ESPI driver.

endif # ESPI
```

## drivers/espi/Kconfig.ene
```kconfig
# Copyright (c) 2026 ENE Technology Inc.
# SPDX-License-Identifier: Apache-2.0

config ESPI_ENE_KB106X
	bool "ENE KB106X ESPI Driver"
	default y
	depends on DT_HAS_ENE_KB106X_ESPI_ENABLED
	select PINCTRL
	help
	  Enable support for the KB106X ESPI controllers.

if ESPI_ENE_KB106X

config ESPI_VWIRE_CHANNEL
	default y

config ESPI_OOB_CHANNEL
	default y

config ESPI_PERIPHERAL_8042_KBC
	default y

config ESPI_PERIPHERAL_HOST_IO
	default y

config ESPI_PERIPHERAL_DEBUG_PORT_80
	default y

config ESPI_PERIPHERAL_KB106X_HOST_TO_RAM
	bool "Host I/O peripheral ENE Private Channel (host to ram)"
	select ESPI_PERIPHERAL_HOST_IO_PVT

config ESPI_PERIPHERAL_KB106X_LEGACY_IO
	bool "Host I/O peripheral ENE Private Channel (legacy io)"
	select ESPI_PERIPHERAL_CUSTOM_OPCODE
	select ESPI_PERIPHERAL_HOST_IO_PVT

config ESPI_PERIPHERAL_KB106X_MAILBOX
	bool "Host I/O peripheral ENE Private Channel (mailbox)"
	select ESPI_PERIPHERAL_HOST_IO_PVT

config ESPI_KB106X_LEGI_CLR_IBF_AFTER_OUTPUT_DATA_READY
	default y
	bool "Clear IBF after output data ready"

config ESPI_KB106X_VWIRE_ENABLE_SEND_CHECK
	bool "Check the value was read by host after wire bits changed"
	default y
	help
	  This option enables checking whether the host has read the value after the
	  virtual wire data changes

config ESPI_KB106X_WIRE_SEND_TIMEOUT_US
	int "eSPI virtual wire send timeout period"
	default 1000
	help
	  The times to check status after sending the eSPI virtual wire signal. The unit
	  is microseconds (µs).

endif # ESPI_ENE_KB106X
```

## drivers/espi/Kconfig.espi_emul
```kconfig
# Copyright 2020 Google LLC
# SPDX-License-Identifier: Apache-2.0

config ESPI_EMUL
	bool "eSPI emulator"
	default y
	depends on DT_HAS_ZEPHYR_ESPI_EMUL_CONTROLLER_ENABLED
	help
	  Enable the eSPI emulator driver. This is a fake peripheral driver,
	  it does not talk to real hardware. Instead, it can talk to the host emulator
	  driver that pretends to be the controller of the emulated eSPI bus. It is
	  used for testing drivers for eSPI signals and for communication between MCU eSPI
	  peripheral and host eSPI controller.

	  eSPI is an interface using SPI wires, whose main goal is to reduce the
	  number of required pins. It includes the functionality of LPC, SMB, SPI
	  itself (flash access) and GPIO (virtual wires). Please refer to the
	  specification for more details (it is good for the introduction as well)
	  https://www.intel.com/content/dam/support/us/en/documents/software/chipset-software/327432-004_espi_base_specification_rev1.0_cb.pdf
```

## drivers/espi/Kconfig.it8xxx2
```kconfig
# Copyright (c) 2021 ITE Corporation. All Rights Reserved.
# SPDX-License-Identifier: Apache-2.0

config ESPI_IT8XXX2
	bool "ITE IT8XXX2 embedded controller ESPI driver"
	depends on SOC_IT8XXX2
	help
	  Enable ITE IT8XXX2 ESPI driver.

if ESPI_IT8XXX2

config ESPI_OOB_CHANNEL
	default y

config ESPI_PERIPHERAL_8042_KBC
	default y

config ESPI_PERIPHERAL_HOST_IO
	default y

config ESPI_PERIPHERAL_DEBUG_PORT_80
	default y

config ESPI_PERIPHERAL_EC_HOST_CMD
	default y

choice IT8XXX2_H2RAM_HC_SIZE_CHOICE
	prompt "H2RAM space for ec host command"
	default IT8XXX2_H2RAM_HC_SIZE_256
	depends on ESPI_PERIPHERAL_EC_HOST_CMD

config IT8XXX2_H2RAM_HC_SIZE_16
	bool "16"

config IT8XXX2_H2RAM_HC_SIZE_32
	bool "32"

config IT8XXX2_H2RAM_HC_SIZE_64
	bool "64"

config IT8XXX2_H2RAM_HC_SIZE_128
	bool "128"

config IT8XXX2_H2RAM_HC_SIZE_256
	bool "256"

config IT8XXX2_H2RAM_HC_SIZE_512
	bool "512"

config IT8XXX2_H2RAM_HC_SIZE_1024
	bool "1024"

config IT8XXX2_H2RAM_HC_SIZE_2048
	bool "2048"

endchoice

config ESPI_IT8XXX2_HC_H2RAM_SIZE
	int
	depends on ESPI_PERIPHERAL_EC_HOST_CMD
	default 16 if IT8XXX2_H2RAM_HC_SIZE_16
	default 32 if IT8XXX2_H2RAM_HC_SIZE_32
	default 64 if IT8XXX2_H2RAM_HC_SIZE_64
	default 128 if IT8XXX2_H2RAM_HC_SIZE_128
	default 256 if IT8XXX2_H2RAM_HC_SIZE_256
	default 512 if IT8XXX2_H2RAM_HC_SIZE_512
	default 1024 if IT8XXX2_H2RAM_HC_SIZE_1024
	default 2048 if IT8XXX2_H2RAM_HC_SIZE_2048

config ESPI_PERIPHERAL_ACPI_SHM_REGION
	default y

choice IT8XXX2_H2RAM_ACPI_SHM_SIZE_CHOICE
	prompt "H2RAM space for ACPI shared memory region"
	default IT8XXX2_H2RAM_ACPI_SHM_SIZE_256
	depends on ESPI_PERIPHERAL_ACPI_SHM_REGION

config IT8XXX2_H2RAM_ACPI_SHM_SIZE_16
	bool "16"

config IT8XXX2_H2RAM_ACPI_SHM_SIZE_32
	bool "32"

config IT8XXX2_H2RAM_ACPI_SHM_SIZE_64
	bool "64"

config IT8XXX2_H2RAM_ACPI_SHM_SIZE_128
	bool "128"

config IT8XXX2_H2RAM_ACPI_SHM_SIZE_256
	bool "256"

config IT8XXX2_H2RAM_ACPI_SHM_SIZE_512
	bool "512"

config IT8XXX2_H2RAM_ACPI_SHM_SIZE_1024
	bool "1024"

config IT8XXX2_H2RAM_ACPI_SHM_SIZE_2048
	bool "2048"

endchoice

config ESPI_IT8XXX2_ACPI_SHM_H2RAM_SIZE
	int
	depends on ESPI_PERIPHERAL_ACPI_SHM_REGION
	default 16 if IT8XXX2_H2RAM_ACPI_SHM_SIZE_16
	default 32 if IT8XXX2_H2RAM_ACPI_SHM_SIZE_32
	default 64 if IT8XXX2_H2RAM_ACPI_SHM_SIZE_64
	default 128 if IT8XXX2_H2RAM_ACPI_SHM_SIZE_128
	default 256 if IT8XXX2_H2RAM_ACPI_SHM_SIZE_256
	default 512 if IT8XXX2_H2RAM_ACPI_SHM_SIZE_512
	default 1024 if IT8XXX2_H2RAM_ACPI_SHM_SIZE_1024
	default 2048 if IT8XXX2_H2RAM_ACPI_SHM_SIZE_2048

config ESPI_PERIPHERAL_CUSTOM_OPCODE
	default y

config ESPI_FLASH_CHANNEL
	default y

config ESPI_IT8XXX2_PNPCFG_DEVICE_KBC_MOUSE
	bool "ITE IT8XXX2 KBC mouse device"
	help
	  With this option enabled, EC will send IRQ12 signal to host when the
	  KBC mouse output buffer is full.

endif #ESPI_IT8XXX2
```

## drivers/espi/Kconfig.kb1200
```kconfig
# eSPI configuration options

# Copyright (c) 2023 ENE Technology


config ESPI_KB1200
	bool "ENE KB106X eSPI Driver"
	depends on SOC_ENE_KB1200
	help
	  Enable support for the kb1200 eSPI controllers.
```
