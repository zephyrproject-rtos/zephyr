## drivers/ethernet/Kconfig
```kconfig
# Ethernet drivers configuration options

# Copyright (c) 2015 Intel Corporation
# SPDX-License-Identifier: Apache-2.0

menuconfig ETH_DRIVER
	bool "Ethernet drivers"
	depends on NETWORKING
	depends on !NET_TEST
	default y if NET_L2_ETHERNET

if ETH_DRIVER

config ETH_DRIVER_RAW_MODE
	bool "Ethernet driver without the MAC stack"
	select NET_RAW_MODE
	depends on !NET_L2_ETHERNET
	help
	  This option enables using the drivers in a so-called "raw" mode,
	  i.e. without a MAC stack (the net L2 layer for ethernet will not
	  be built).

module = ETHERNET
module-dep = LOG
module-str = Log level for Ethernet driver
module-help = Sets log level for Ethernet Device Drivers.
source "subsys/net/Kconfig.template.log_config.net"

config ETH_QEMU_IFACE_NAME
	string "Network interface name for QEMU"
	default "zeth"
	depends on NET_QEMU_ETHERNET
	help
	  The network interface name for QEMU. This value is given as
	  a parameter to -nic qemu command line option. The network
	  interface must be created before starting QEMU. The net-setup.sh
	  script from net-tools project can be used to create the network
	  interface.

config ETH_QEMU_EXTRA_ARGS
	string "Extra arguments to QEMU -nic option"
	depends on NET_QEMU_ETHERNET
	default ""
	help
	  Extra arguments passed to QEMU -nic option when Ethernet Networking
	  is enabled. Typically this is used to set the network MAC address of
	  Zephyr instance. This option can contain multiple QEMU option
	  arguments. Each QEMU argument must be separated by comma "," and no
	  spaces between arguments. Example: "mac=02:03:04:f0:0d:01" or
	  "mac=02:03:04:f0:0d:01,downscript=no"

source "drivers/ethernet/Kconfig.enc28j60"
source "drivers/ethernet/Kconfig.enc424j600"
source "drivers/ethernet/Kconfig.esp32"
source "drivers/ethernet/Kconfig.e1000"
source "drivers/ethernet/Kconfig.sam_gmac"
source "drivers/ethernet/Kconfig.stm32_hal"
source "drivers/ethernet/Kconfig.dwmac"
source "drivers/ethernet/Kconfig.smsc911x"
source "drivers/ethernet/Kconfig.native_tap"
source "drivers/ethernet/Kconfig.stellaris"
source "drivers/ethernet/Kconfig.litex"
source "drivers/ethernet/Kconfig.gecko"
source "drivers/ethernet/Kconfig.w5500"
source "drivers/ethernet/Kconfig.xlnx_gem"
source "drivers/ethernet/Kconfig.cyclonev"
source "drivers/ethernet/Kconfig.nxp_enet"
source "drivers/ethernet/Kconfig.nxp_s32_netc"
source "drivers/ethernet/Kconfig.nxp_s32_gmac"
source "drivers/ethernet/Kconfig.smsc91x"
source "drivers/ethernet/Kconfig.ivshmem"
source "drivers/ethernet/Kconfig.adin2111"
source "drivers/ethernet/Kconfig.numaker"
source "drivers/ethernet/Kconfig.lan865x"
source "drivers/ethernet/Kconfig.xmc4xxx"
source "drivers/ethernet/Kconfig.test"
source "drivers/ethernet/Kconfig.lan9250"
source "drivers/ethernet/Kconfig.sy1xx_mac"
source "drivers/ethernet/Kconfig.xilinx_axienet"
source "drivers/ethernet/Kconfig.virtio_net"

source "drivers/ethernet/eth_nxp_enet_qos/Kconfig"

source "drivers/ethernet/dsa/Kconfig"
source "drivers/ethernet/dwc_xgmac/Kconfig"
source "drivers/ethernet/phy/Kconfig"

source "drivers/ethernet/nxp_imx_netc/Kconfig"
source "drivers/ethernet/Kconfig.renesas_ra"
source "drivers/ethernet/intel/Kconfig"

endif # "Ethernet Drivers"

config ETH_INIT_PRIORITY
	int "Ethernet driver init priority"
	default 80
	depends on NET_L2_ETHERNET || ETH_DRIVER
	help
	  Ethernet device driver initialization priority.
	  Do not mess with it unless you know what you are doing.
	  Note that the priority needs to be lower than the net stack
	  so that it can start before the networking sub-system.
```

## drivers/ethernet/Kconfig.bcm_genet
```kconfig
# Copyright (c) 2026 Khaled Abdalla <khaled.3bdulaziz@gmail.com>
# SPDX-License-Identifier: Apache-2.0

menuconfig ETH_BCM_GENET
	bool "Broadcom GENET v5 Ethernet driver (BCM2711 / Raspberry Pi 4)"
	default y
	depends on DT_HAS_BRCM_BCM2711_GENET_ENABLED
	help
	  Enable the Broadcom GENET v5 Gigabit Ethernet driver for the
	  BCM2711 SoC (Raspberry Pi 4 Model B).

	  The driver supports:
	    - 10/100/1000 Mbps via RGMII / RGMII-RXID
	    - Interrupt-driven RX (ring 0) and TX (ring 16)
	    - MDIO-based PHY management (BCM54213PE default)
	    - Static MAC address or random locally-administered address

if ETH_BCM_GENET

config ETH_BCM_GENET_LOG_LEVEL
	int "GENET driver log level"
	default 3
	range 0 4
	help
	  Log verbosity: 0=off 1=error 2=warning 3=info 4=debug.

endif # ETH_BCM_GENET
```

## drivers/ethernet/Kconfig.bcmgenet
```kconfig
# Copyright (c) 2026 Muhammad Waleed Badar
# SPDX-License-Identifier: Apache-2.0

config ETH_BCMGENET
	bool "Broadcom GENET (Gigabit Ethernet) driver"
	default y
	depends on DT_HAS_BRCM_GENET_ENABLED
	help
	  Enable Broadcom GENET (Gigabit Ethernet) driver.

if ETH_BCMGENET

configdefault NET_BUF_ALIGNMENT
	default DCACHE_LINE_SIZE if DCACHE

config ETH_BCMGENET_RX_POLLING_INTERVAL_US
	int "Receive Polling interval in us"
	default 500
	range 100 1000
	help
	  Receive polling interval in us

config ETH_BCMGENET_RX_THREAD_STACK_SIZE
	int "Stack size for internal incoming packet handler"
	default 1024
	help
	  Size of the stack used for internal thread which is ran for
	  incoming packet processing.

config ETH_BCMGENET_RX_THREAD_PRIORITY
	int "Priority for internal incoming packet handler"
	default 0
	help
	  Priority level for internal thread which is ran for incoming
	  packet processing.

endif # ETH_BCMGENET
```

## drivers/ethernet/Kconfig.ch390
```kconfig
# WCH CH390 Ethernet driver configuration options

# Copyright (c) 2026
# SPDX-License-Identifier: Apache-2.0

menuconfig ETH_CH390
	bool "WCH CH390 Ethernet Controller"
	default y
	depends on DT_HAS_WCH_CH390_ENABLED
	select SPI
	help
	  WCH CH390 10/100BASE-T Ethernet controller with SPI interface.

config ETH_CH390_RX_THREAD_STACK_SIZE
	int "Stack size for internal incoming packet handler"
	depends on ETH_CH390
	default 800
	help
	  Size of the stack used for the internal incoming packet thread.

config ETH_CH390_RX_THREAD_PRIORITY
	int "Priority for internal incoming packet handler"
	depends on ETH_CH390
	default 2
	help
	  Priority level for the internal incoming packet thread.

config ETH_CH390_TIMEOUT
	int "IP buffer timeout"
	depends on ETH_CH390
	default 100
	help
	  Timeout in milliseconds. Maximum amount of time that the driver waits
	  for a network buffer before an Ethernet frame is dropped.
```

## drivers/ethernet/Kconfig.cyclonev
```kconfig
# SPDX-License-Identifier: Apache-2.0
# Copyright (C) 2022, Intel Corporation
# Description:
# Cyclone V ethernet configuration options

menuconfig ETH_CYCLONEV
	bool "Cyclone V ethernet MAC driver"
	default y
	depends on DT_HAS_SNPS_ETHERNET_CYCLONEV_ENABLED

if ETH_CYCLONEV

config ETH_CVSX_NB_TX_DESCS
	int "Number of entries in the transmit descriptor ring"
	default 32
	range 4 128
	help
	  A higher number allows for more packets to be queued which may
	  improve throughput, but that requires more transient memory.
	  However there must be enough descriptors to hold all fragments
	  of a full-size packet to be transmitted or the packet will be
	  dropped.

	  Fragment size is influenced by CONFIG_NET_BUF_DATA_SIZE.

config ETH_CVSX_NB_RX_DESCS
	int "Number of entries in the receive descriptor ring"
	default 32
	range 4 128
	help
	  Received packets are spread across the required number of fragment
	  buffers. Each RX fragment has a size of CONFIG_NET_BUF_DATA_SIZE.
	  There is one descriptor entry per fragment.

endif # ETH_CYCLONEV
```

## drivers/ethernet/Kconfig.dm9051
```kconfig
# Davicom DM9051 Ethernet driver configuration options

# Copyright (c) 2026 Andrei-Edward Popa
# SPDX-License-Identifier: Apache-2.0

menuconfig ETH_DM9051
	bool "Davicom DM9051 Ethernet Controller"
	default y
	depends on DT_HAS_DAVICOM_DM9051_ENABLED
	select SPI
	help
	  Davicom DM9051 Ethernet Controller with SPI Interface

config ETH_DM9051_RX_THREAD_STACK_SIZE
	int "Stack size for internal incoming packet handler"
	depends on ETH_DM9051
	default 800
	help
	  Size of the stack used for internal thread which is ran for
	  incoming packet processing.

config ETH_DM9051_RX_THREAD_PRIORITY
	int "Priority for internal incoming packet handler"
	depends on ETH_DM9051
	default 2
	help
	  Priority level for internal thread which is ran for incoming
	  packet processing.

config ETH_DM9051_TIMEOUT
	int "IP buffer timeout"
	depends on ETH_DM9051
	default 100
	help
	  Given timeout in milliseconds. Maximum amount of time
	  that the driver will wait from the IP stack to get
	  a memory buffer before the Ethernet frame is dropped.
```

## drivers/ethernet/Kconfig.dsa
```kconfig
# Distributed Switch Architecture [DSA] configuration options

# Copyright (c) 2020 DENX Software Engineering GmbH
#               Lukasz Majewski <lukma@denx.de>
# SPDX-License-Identifier: Apache-2.0

menuconfig NET_DSA
	bool "Distributed Switch Architecture support"
	depends on ETH_MCUX || ETH_SAM_GMAC || ETH_STM32_HAL
	help
	  Enable Distributed Switch Architecture support. For now it
	  only supports Kinetics and STM32 ENET drivers.

if NET_DSA

config DSA_KSZ8XXX
	bool

config DSA_KSZ8794
	bool "Support for KSZ8794"
	default y
	depends on DT_HAS_MICROCHIP_KSZ8794_ENABLED
	select DSA_KSZ8XXX
	select SPI if $(dt_compat_on_bus,$(DT_COMPAT_MICROCHIP_KSZ8794),spi)
	help
	  Add support for KSZ8794 DSA device driver.

config DSA_KSZ8863
	bool "Support for KSZ8863"
	default y
	depends on DT_HAS_MICROCHIP_KSZ8863_ENABLED
	select DSA_KSZ8XXX
	select SPI if $(dt_compat_on_bus,$(DT_COMPAT_MICROCHIP_KSZ8863),spi)
	help
	  Add support for KSZ8863 DSA device driver.

config DSA_KSZ_TAIL_TAGGING
	bool "Support for tail tagging"
	depends on DSA_KSZ8794 || DSA_KSZ8863
	help
	  Add support for tail tagging on DSA device.

config DSA_SPI
	bool "Support for PHY SPI interface"
	depends on SPI && (DSA_KSZ8794 || DSA_KSZ8863)
	help
	  Use SPI bus to communicate with PHY

module = NET_DSA
module-dep = NET_LOG
module-str = Log level for DSA
module-help = Enables core DSA code to output debug messages.
source "subsys/net/Kconfig.template.log_config.net"

endif # NET_DSA
```

## drivers/ethernet/Kconfig.dw
```kconfig
# Kconfig - Synopsys DesignWare Ethernet driver configuration options

#
# Copyright (c) 2016 Intel Corporation
#
# SPDX-License-Identifier: Apache-2.0
#

menuconfig ETH_DW
	bool "Synopsys DesignWare Ethernet driver"
	help
	  Enable Synopsys DesignWare Ethernet driver.

if ETH_DW
config ETH_DW_SHARED_IRQ
	bool

config ETH_DW_0
	bool "Synopsys DesignWare Ethernet port 0"
	help
	 Include port 0 driver

config ETH_DW_0_NAME
	string "Driver name"
	depends on ETH_DW_0
	default "ETH_0"

choice
	prompt "Port 0 Interrupts via"
	default ETH_DW_0_IRQ_SHARED
	depends on ETH_DW_0

config ETH_DW_0_IRQ_DIRECT
	bool "Direct Hardware Interrupt"
	help
	  When interrupts fire, the driver's ISR function is being called directly.

config ETH_DW_0_IRQ_SHARED
	bool "Shared IRQ"
	depends on SHARED_IRQ
	select ETH_DW_SHARED_IRQ
	help
	  When interrupts fire, the shared IRQ driver is notified. Then the shared IRQ
	  driver dispatches the interrupt to other drivers.

endchoice

config ETH_DW_0_IRQ_PRI
	int "Controller interrupt priority"
	depends on ETH_DW_0 && ETH_DW_0_IRQ_DIRECT
	default 0
	help
	  IRQ priority

endif # ETH_DW
```

## drivers/ethernet/Kconfig.dwmac
```kconfig
# Synopsys DesignWare MAC configuration options

# Copyright (c) 2021 BayLibre SAS
# SPDX-License-Identifier: Apache-2.0

menu "Synopsys DesignWare MAC driver"

config ETH_DWMAC
	bool
	depends on NET_BUF_FIXED_DATA_SIZE
	help
	  This is a driver for the Synopsys DesignWare MAC, also referred to
	  as "DesignWare Cores Ethernet Quality-of-Service". Hardware versions
	  4.x and 5.x are supported.

	  Platform specific glue support is also required. This driver is
	  currently available on targets using the STM32H7X series as an
	  alternative to the eth_stm32_hal driver. Support for a generic DT
	  and MMU based platform is also provided.

	  Not yet implemented:
	  - MDIO (currently relying on default PHY config)
	  - PTP support
	  - VLAN support
	  - various hardware offloads (when available)

config ETH_DWMAC_STM32H7X
	bool "Synopsys DesignWare MAC driver for STM32H7 series"
	depends on !ETH_STM32_HAL
	depends on SOC_SERIES_STM32H7X
	depends on DT_HAS_ST_STM32_ETHERNET_ENABLED
	select ETH_DWMAC
	select NOCACHE_MEMORY if ARCH_HAS_NOCACHE_MEMORY_SUPPORT
	select PINCTRL
	default y
	help
	  This enables the Synopsys DesignWare MAC driver on STM32H7 series
	  SoCs.

config ETH_DWMAC_MMU
	bool "Synopsys DesignWare MAC driver for MMU based platforms"
	depends on MMU
	depends on DT_HAS_SNPS_DESIGNWARE_ETHERNET_ENABLED
	select ETH_DWMAC
	default y
	help
	  This enables the Synopsys DesignWare MAC driver on MMU based
	  platforms.

if ETH_DWMAC

config DWMAC_NB_TX_DESCS
	int "Number of entries in the transmit descriptor ring"
	default 16
	range 4 128
	help
	  A higher number allows for more packets to be queued which may
	  improve throughput, but that requires more transient memory.
	  However there must be enough descriptors to hold all fragments
	  of a full-size packet to be transmitted or the packet will be
	  dropped.

	  Fragment size is influenced by CONFIG_NET_BUF_DATA_SIZE.

config DWMAC_NB_RX_DESCS
	int "Number of entries in the receive descriptor ring"
	default 16
	range 4 128
	help
	  Received packets are spread across the required number of fragment
	  buffers. Each RX fragment has a size of CONFIG_NET_BUF_DATA_SIZE.
	  There is one descriptor entry per fragment.

	  A higher number allows for more packets to be received without
	  immediate intervention from the CPU but requires more transient
	  memory. A smaller number increases the risk of an overflow and
	  dropped packets.

endif # ETH_DWMAC

endmenu
```

## drivers/ethernet/Kconfig.e1000
```kconfig
# Intel(R) PRO/1000 Gigabit Ethernet driver configuration options

# Copyright (c) 2018-2019 Intel Corporation
# SPDX-License-Identifier: Apache-2.0

menuconfig ETH_E1000
	bool "Intel(R) PRO/1000 Gigabit Ethernet driver"
	default y
	depends on DT_HAS_INTEL_E1000_ENABLED
	depends on PCIE
	help
	  Enable Intel(R) PRO/1000 Gigabit Ethernet driver.

if ETH_E1000

config ETH_NIC_MODEL
	string
	default "e1000"
	help
	  Tells what Qemu network model to use. This value is given as
	  a parameter to -nic qemu command line option.

config ETH_E1000_VERBOSE_DEBUG
	bool "Hexdump of the received and sent frames"
	help
	  Enabling this will turn on the hexdump of the received and sent
	  frames. Do not leave on for production.

config ETH_E1000_PTP_CLOCK
	bool "PTP clock driver support [EXPERIMENTAL]"
	depends on PTP_CLOCK
	select EXPERIMENTAL
	default y
	help
	  Enable PTP clock support. This is still a dummy that is only used
	  for debugging and currently does not do any real PTP activities.

config ETH_E1000_PTP_CLOCK_SRC_HZ
	int "Frequency of the clock source for the PTP timer"
	default 50000000
	depends on ETH_E1000_PTP_CLOCK
	help
	  Set the frequency in Hz sourced to the PTP timer.
	  If the value is set properly, the timer will be accurate.

config ETH_E1000_RX_QUEUE_SIZE
	int "Size of receive queue"
	default 8
	help
	  Sets size of receive descriptor queue. It has to be a multiple of 8.

config ETH_E1000_TX_QUEUE_SIZE
	int "Size of transmit queue"
	default 8
	help
	  Sets size of transmit descriptor queue. It has to be a multiple of 8.

endif # ETH_E1000
```
