## drivers/entropy/Kconfig.mspm0_trng
```kconfig
# Copyright (c) 2025, Linumiz GmbH
# SPDX-License-Identifier: Apache-2.0

config ENTROPY_MSPM0_TRNG
	bool "TI MSPM0 True Random Number Generator (TRNG)"
	default y
	depends on DT_HAS_TI_MSPM0_TRNG_ENABLED
	depends on SOC_FAMILY_TI_MSPM0
	select ENTROPY_HAS_DRIVER
	select RING_BUFFER
	help
	  This option enables the driver for the True Random Number Generator (TRNG)
	  for TI MSPM0 SoCs.

if ENTROPY_MSPM0_TRNG

config ENTROPY_MSPM0_TRNG_POOL_SIZE
	int "Entropy pool buffer size in bytes"
	default 256
	help
	  The size in bytes of the ring buffer used to store entropy generated by the
	  TRNG hardware.

config ENTROPY_MSPM0_TRNG_DECIMATION_RATE
	int "TRNG decimation rate (0-7)"
	default 4
	range 0 7
	help
	  The decimation rate controls the sampling rate of the TRNG. Higher values
	  provide better entropy quality. A decimation rate of 4 or greater is recommended per TRM.
	  Valid values are 0-7.
endif # ENTROPY_MSPM0_TRNG
```

## drivers/entropy/Kconfig.native_posix
```kconfig
# SPDX-License-Identifier: Apache-2.0

config FAKE_ENTROPY_NATIVE_POSIX
	bool "Native posix entropy driver"
	default y
	depends on DT_HAS_ZEPHYR_NATIVE_POSIX_RNG_ENABLED
	select ENTROPY_HAS_DRIVER
	help
	  This option enables the test random number generator for the
	  native_posix board (ARCH_POSIX). This is based on the host random() API.
	  Note that this entropy generator is only meant for test purposes and does
	  not generate real entropy.
	  It actually generates always the same sequence of random numbers if
	  initialized with the same seed.
```

## drivers/entropy/Kconfig.native_sim
```kconfig
# SPDX-License-Identifier: Apache-2.0

config FAKE_ENTROPY_NATIVE_SIM
	bool "Native simulator entropy driver"
	default y
	depends on DT_HAS_ZEPHYR_NATIVE_POSIX_RNG_ENABLED || DT_HAS_ZEPHYR_NATIVE_SIM_RNG_ENABLED
	select ENTROPY_HAS_DRIVER
	help
	  This option enables the test random number generator for the
	  native_sim board (ARCH_POSIX). This is based on the host random() API.
	  Note that this entropy generator is only meant for test purposes and does
	  not generate real entropy.
	  It actually generates always the same sequence of random numbers if
	  initialized with the same seed.

config FAKE_ENTROPY_NATIVE_SIM_SEED_BY_DEFAULT
	bool "Seed the generator by default"
	default y
	depends on FAKE_ENTROPY_NATIVE_SIM
	help
	  Apply a seed by default, even if the user does not request it through the command line.
	  Disabling this feature allows some other component to seed the host standard library random
	  generator without this component's default initialization interfering.

config FAKE_ENTROPY_NATIVE_POSIX
	bool "Native posix entropy driver (deprecated)"
	select FAKE_ENTROPY_NATIVE_SIM
	select DEPRECATED
	help
	  Deprecated option in favour of FAKE_ENTROPY_NATIVE_SIM

config FAKE_ENTROPY_NATIVE_POSIX_SEED_BY_DEFAULT
	bool "Seed the generator by default (deprecated)"
	depends on FAKE_ENTROPY_NATIVE_POSIX
	select DEPRECATED
	help
	  Deprecated option. Replaced by FAKE_ENTROPY_NATIVE_SIM_SEED_BY_DEFAULT
```

## drivers/entropy/Kconfig.neorv32
```kconfig
# NEORV32 TRNG configuration

# Copyright (c) 2021 Henrik Brix Andersen <henrik@brixandersen.dk>
# SPDX-License-Identifier: Apache-2.0

config ENTROPY_NEORV32_TRNG
	bool "NEORV32 TRNG"
	default y
	depends on DT_HAS_NEORV32_TRNG_ENABLED
	depends on SYSCON
	select ENTROPY_HAS_DRIVER
	help
	  This option enables the True Random Number Generator (TRNG) driver for
	  the NEORV32.
```

## drivers/entropy/Kconfig.npcx
```kconfig
# NPCX DRBG driver configuration options

# Copyright (c) 2024 Nuvoton Technology Corporation.
# SPDX-License-Identifier: Apache-2.0

menuconfig ENTROPY_NPCX_DRBG
	bool "NPCX DRBG driver"
	default y
	depends on DT_HAS_NUVOTON_NPCX_DRBG_ENABLED && SOC_NPCX9MFP
	select ENTROPY_HAS_DRIVER
	help
	  This option enables the deterministic random bit generator (DRBG)
	  driver for NPCX family of processors.

if ENTROPY_NPCX_DRBG

choice
	prompt "DRBG Security Strength Selection"
	default ENTROPY_NPCX_DRBG_SECURITY_STRENGTH_128B
	help
	  The chosen security strength defines the amount of entropy bits
	  generated internally and passed to the conditioning component.

config ENTROPY_NPCX_DRBG_SECURITY_STRENGTH_112B
	bool "DRBG security strength 112 bits"

config ENTROPY_NPCX_DRBG_SECURITY_STRENGTH_128B
	bool "DRBG security strength 128 bits"

config ENTROPY_NPCX_DRBG_SECURITY_STRENGTH_192B
	bool "DRBG security strength 192 bits"

config ENTROPY_NPCX_DRBG_SECURITY_STRENGTH_256B
	bool "DRBG security strength 256 bits"

config ENTROPY_NPCX_DRBG_SECURITY_STRENGTH_128B_TEST
	bool "DRBG security strength 12b bits test"

config ENTROPY_NPCX_DRBG_SECURITY_STRENGTH_256B_TEST
	bool "DRBG security strength 256 bits test"

endchoice

config ENTROPY_NPCX_DRBG_SECURITY_STRENGTH
	int
	default 0 if ENTROPY_NPCX_DRBG_SECURITY_STRENGTH_112B
	default 1 if ENTROPY_NPCX_DRBG_SECURITY_STRENGTH_128B
	default 2 if ENTROPY_NPCX_DRBG_SECURITY_STRENGTH_192B
	default 3 if ENTROPY_NPCX_DRBG_SECURITY_STRENGTH_256B
	default 4 if ENTROPY_NPCX_DRBG_SECURITY_STRENGTH_128B_TEST
	default 5 if ENTROPY_NPCX_DRBG_SECURITY_STRENGTH_256B_TEST

config ENTROPY_NPCX_DRBG_RESEED_INTERVAL
	int "DRBG Reseed Interval"
	default 100
	help
	   Number of gererations allowed until next reseeding.

endif
```

## drivers/entropy/Kconfig.nrf5
```kconfig
# nRF5 entropy generator driver configuration

# Copyright (c) 2018 Nordic Semiconductor ASA
# Copyright (c) 2017 Exati Tecnologia Ltda.
# SPDX-License-Identifier: Apache-2.0

config ENTROPY_NRF_FORCE_ALT
	bool
	depends on SOC_COMPATIBLE_NRF
	help
	  This option can be enabled to force an alternative implementation
	  of the entropy driver.

menuconfig ENTROPY_NRF5_RNG
	bool "nRF5 RNG driver"
	default y
	depends on !ENTROPY_NRF_FORCE_ALT
	depends on DT_HAS_NORDIC_NRF_RNG_ENABLED
	select ENTROPY_HAS_DRIVER
	help
	  This option enables the RNG peripheral, which is a random number
	  generator, based on internal thermal noise, that provides a
	  random 8-bit value to the host when read.

if ENTROPY_NRF5_RNG

config ENTROPY_NRF5_BIAS_CORRECTION
	bool "Bias correction (uniform distribution)"
	help
	  This option enables the RNG bias correction, which guarantees a
	  uniform distribution of 0 and 1. When this option is enabled, the time
	  to generate a byte cannot be guaranteed.

config ENTROPY_NRF5_THR_POOL_SIZE
	int "Thread-mode random number pool size"
	range ENTROPY_NRF5_THR_THRESHOLD 256
	default 8
	help
	  Buffer length in bytes used to store entropy bytes generated by the
	  hardware to make them ready for thread mode consumers.
	  Please note, that size of the pool must be a power of 2.

config ENTROPY_NRF5_THR_THRESHOLD
	int "Thread-mode random number pool low-water threshold"
	range 4 255
	help
	  Low water-mark threshold in bytes to trigger entropy generation for
	  thread mode consumers. As soon as the number of available bytes in the
	  buffer goes below this number hardware entropy generation will be
	  started.

config ENTROPY_NRF5_ISR_POOL_SIZE
	int "ISR-mode random number pool size"
	range ENTROPY_NRF5_ISR_THRESHOLD 256
	default 16
	help
	  Buffer length in bytes used to store entropy bytes generated by the
	  hardware to make them ready for ISR consumers.
	  Please note, that size of the pool must be a power of 2.

config ENTROPY_NRF5_ISR_THRESHOLD
	int "ISR-mode random number pool low-water threshold"
	range 12 255
	help
	  Low water-mark threshold in bytes to trigger entropy generation for
	  ISR consumers. As soon as the number of available bytes in the
	  buffer goes below this number hardware entropy generation will be
	  started.

endif # ENTROPY_NRF5_RNG
```

## drivers/entropy/Kconfig.nrf_cracen
```kconfig
# Copyright (c) 2025 Nordic Semiconductor ASA
# SPDX-License-Identifier: Apache-2.0

config ENTROPY_NRF_CRACEN_CTR_DRBG
	bool "nRF entropy driver based on the CRACEN CTR_DRBG driver"
	default y
	depends on DT_HAS_NORDIC_NRF_CRACEN_CTRDRBG_ENABLED
	select ENTROPY_HAS_DRIVER
	select NRFX_CRACEN
	help
	  This option enables the CRACEN based entropy driver, based on the nrfx CRACEN CTR_DRBG
	  random driver.
	  Notes: This driver is not compatible with 54H devices, and may only be used from one processor
	  core. This driver cannot be used in conjunction with the nRF security PSA solution, as both
	  would attempt to use the CRACEN HW exclusively; When that is enabled, the PSA crypto entropy
	  driver should be selected instead.
```

## drivers/entropy/Kconfig.nrf_prng
```kconfig
# nRF fake entropy prng generator driver configuration

# Copyright (c) 2024 Nordic Semiconductor ASA
# SPDX-License-Identifier: Apache-2.0

if ENTROPY_GENERATOR

config FAKE_ENTROPY_NRF_PRNG
	bool "A fake nRF entropy driver"
	default y
	depends on DT_HAS_NORDIC_ENTROPY_PRNG_ENABLED
	depends on (SOC_SERIES_NRF54HX || SOC_SERIES_NRF92X || SOC_SERIES_NRF54LX)
	select ENTROPY_HAS_DRIVER
	help
	  This is a super simple PRNG driver that can be used on nRF platforms that
	  do not have an entropy source.
	  This is NOT SAFE to use for cryptographic operations!

endif
```

## drivers/entropy/Kconfig.nxp
```kconfig
# NXP ELE entropy configuration options

# Copyright 2025 NXP
# SPDX-License-Identifier: Apache-2.0

config ENTROPY_NXP_ELE_TRNG
	bool "NXP ELE TRNG driver"
	default y
	depends on DT_HAS_NXP_ELE_TRNG_ENABLED
	select ENTROPY_HAS_DRIVER
	help
	  This option enables the ELE true random number generator (TRNG)
```

## drivers/entropy/Kconfig.pseudo_stm32
```kconfig
# Kconfig.stm32 - STM32 entropy generator driver configuration
#
# Copyright (c) 2018 Alexander Wachter
#
# SPDX-License-Identifier: Apache-2.0

menuconfig ENTROPY_PSEUDO_STM32
	bool "STM32 pseudo entropy driver"
	depends on SOC_FAMILY_STM32 && (SOC_SERIES_STM32F0X || SOC_SERIES_STM32F3X || SOC_SERIES_STM32L4X || SOC_SERIES_STM32F7X)
	select DEVICE_ID_SEED_HAS_DRIVER
	help
	  This driver enables a pseudo entropy to seed the xoroshiro128 random
	  generator. It is not a real source of entropy and must not be used for
	  crypto.
```

## drivers/entropy/Kconfig.renesas_ra
```kconfig
# Copyright (c) 2024 Renesas Electronics Corporation
# SPDX-License-Identifier: Apache-2.0

# Renesas RA entropy generator driver configuration

config ENTROPY_RENESAS_RA
	bool "Renesas RA TRNG driver"
	default y
	depends on DT_HAS_RENESAS_RA_RSIP_E51A_TRNG_ENABLED || DT_HAS_RENESAS_RA_SCE9_RNG_ENABLED \
		|| DT_HAS_RENESAS_RA_SCE7_RNG_ENABLED || DT_HAS_RENESAS_RA_SCE5_RNG_ENABLED       \
		|| DT_HAS_RENESAS_RA_TRNG_ENABLED
	select ENTROPY_HAS_DRIVER
	select USE_RA_FSP_SCE
	help
	  This option enables entropy driver for Renesas RA
```

## drivers/entropy/Kconfig.renesas_ra8
```kconfig
# Renesas RA entropy generator driver configuration

# Copyright (c) 2024 Renesas Electronics Corporation
# SPDX-License-Identifier: Apache-2.0

config ENTROPY_RA8_RSIP7_TRNG
	bool "Renesas RA RSIP7 TRNG driver"
	default y
	depends on DT_HAS_RENESAS_RA8_RSIP7_TRNG_ENABLED
	select ENTROPY_HAS_DRIVER
	select USE_RA_FSP_SCE
	help
	  This option enables the Renesas RA RSIP7 RNG.
```

## drivers/entropy/Kconfig.rp2040
```kconfig
# RP2040 entropy generator driver configuration

# Copyright (c) 2023 Xudong Zheng
# SPDX-License-Identifier: Apache-2.0

config ENTROPY_RP2040_RNG
	bool "RP2040 entropy number generator driver"
	default y
	depends on DT_HAS_RASPBERRYPI_RP2040_RNG_ENABLED
	select ENTROPY_HAS_DRIVER
	select PICOSDK_USE_CLAIM
	select PICOSDK_USE_FLASH
	select PICOSDK_USE_RAND
	select PICOSDK_USE_TIMER
	help
	  This option enables the entropy number generator for the RP2040 SOC.
```

## drivers/entropy/Kconfig.rpi_pico
```kconfig
# Raspberry Pi Pico entropy generator driver configuration

# Copyright (c) 2024 Xudong Zheng
# SPDX-License-Identifier: Apache-2.0

config ENTROPY_RPI_PICO_RNG
	bool "Raspberry Pi Pico entropy number generator driver"
	default y
	depends on DT_HAS_RASPBERRYPI_PICO_RNG_ENABLED
	depends on SOC_SERIES_RP2350
	select ENTROPY_HAS_DRIVER
	select PICOSDK_USE_CLAIM
	select PICOSDK_USE_RAND
	select PICOSDK_USE_TIMER
```

## drivers/entropy/Kconfig.rv32m1
```kconfig
# RV32M1 entropy generator driver configuration

# Copyright 2019 NXP
# SPDX-License-Identifier: Apache-2.0

config ENTROPY_RV32M1_TRNG
	bool "RV32M1 TRNG driver"
	default y
	depends on DT_HAS_OPENISA_RV32M1_TRNG_ENABLED
	select ENTROPY_HAS_DRIVER
	help
	  This option enables the true random number generator (TRNG)
	  driver based on the RV32M1 TRNG driver.

# Don't use use the RV32M1 TRNG as a random source since it can be quite slow.
# Instead, use the software implemented xoshiro RNG.
choice RNG_GENERATOR_CHOICE
	default XOSHIRO_RANDOM_GENERATOR if ENTROPY_RV32M1_TRNG
endchoice
```

## drivers/entropy/Kconfig.sam
```kconfig
# Atmel SAM TRNG configuration

# Copyright (c) 2018 Aurelien Jarno
# SPDX-License-Identifier: Apache-2.0

config ENTROPY_SAM_RNG
	bool "Atmel SAM MCU Family True Random Number Generator (TRNG) Driver"
	default y
	depends on DT_HAS_ATMEL_SAM_TRNG_ENABLED
	select ENTROPY_HAS_DRIVER
	help
	  Enable True Random Number Generator (TRNG) driver for Atmel SAM MCUs.
```

## drivers/entropy/Kconfig.sam0
```kconfig
# Kconfig.sam - Atmel SAM0 TRNG configuration
#
# Copyright (c) 2019 Benjamin Valentin
#
# SPDX-License-Identifier: Apache-2.0

menuconfig ENTROPY_SAM0_RNG
	bool "Atmel SAM0 MCU Family True Random Number Generator (TRNG) Driver"
	depends on SOC_FAMILY_SAM0
	default y
	select ENTROPY_HAS_DRIVER
	select HAS_DTS_ENTROPY
	help
	  Enable True Random Number Generator (TRNG) driver for Atmel SAM0 MCUs.
```

## drivers/entropy/Kconfig.sf32lb
```kconfig
# Copyright (c) 2025, Qingsong Gou <gouqs@hotmail.com>
# SPDX-License-Identifier: Apache-2.0

config ENTROPY_SF32LB
	bool "SF32LB Entropy driver"
	default y
	depends on DT_HAS_SIFLI_SF32LB_TRNG_ENABLED
	select ENTROPY_HAS_DRIVER
	help
	  Enable driver for SF32LB True Random Number Generator (TRNG).
```

## drivers/entropy/Kconfig.siwx91x
```kconfig
# Copyright (c) 2024 Silicon Laboratories Inc.
# SPDX-License-Identifier: Apache-2.0

config ENTROPY_SILABS_SIWX91X
	bool "SiWx91x RNG driver"
	default y
	depends on DT_HAS_SILABS_SIWX91X_RNG_ENABLED
	select ENTROPY_HAS_DRIVER
	help
	 Enable hardware Random Number Generator embedded on Silicon Labs
	 SiWx91x chips.
```
