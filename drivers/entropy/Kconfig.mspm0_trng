## drivers/entropy/Kconfig.smartbond
```kconfig
# Smartbond TRNG configuration

# Copyright (c) 2023 Renesas Electronics Corporation
# SPDX-License-Identifier: Apache-2.0


config ENTROPY_SMARTBOND_TRNG
	bool "Renesas Smartbond MCU Family True Random Number Generator (TRNG) Driver"
	default y
	depends on DT_HAS_RENESAS_SMARTBOND_TRNG_ENABLED
	select ENTROPY_HAS_DRIVER
	help
	  Enable True Random Number Generator (TRNG) driver for Renesas Smartbond MCUs.

if ENTROPY_SMARTBOND_TRNG

config ENTROPY_SMARTBOND_THR_POOL_SIZE
	int "Thread-mode random number pool size"
	range ENTROPY_SMARTBOND_THR_THRESHOLD 256
	default 8
	help
	  Buffer length in bytes used to store entropy bytes generated by the
	  hardware to make them ready for thread mode consumers.
	  Please note, that size of the pool must be a power of 2.

config ENTROPY_SMARTBOND_THR_THRESHOLD
	int "Thread-mode random number pool low-water threshold"
	range 4 255
	help
	  Low water-mark threshold in bytes to trigger entropy generation for
	  thread mode consumers. As soon as the number of available bytes in the
	  buffer goes below this number hardware entropy generation will be
	  started.

config ENTROPY_SMARTBOND_ISR_POOL_SIZE
	int "ISR-mode random number pool size"
	range ENTROPY_SMARTBOND_ISR_THRESHOLD 256
	default 16
	help
	  Buffer length in bytes used to store entropy bytes generated by the
	  hardware to make them ready for ISR consumers.
	  Please note, that size of the pool must be a power of 2.

config ENTROPY_SMARTBOND_ISR_THRESHOLD
	int "ISR-mode random number pool low-water threshold"
	range 12 255
	help
	  Low water-mark threshold in bytes to trigger entropy generation for
	  ISR consumers. As soon as the number of available bytes in the
	  buffer goes below this number hardware entropy generation will be
	  started.

endif # ENTROPY_SMARTBOND_TRNG
```

## drivers/entropy/Kconfig.stm32
```kconfig
# STM32 entropy generator driver configuration

# Copyright (c) 2017 Erwin Rol <erwin@erwinrol.com>
# SPDX-License-Identifier: Apache-2.0

menuconfig ENTROPY_STM32_RNG
	bool "STM32 RNG driver"
	default y
	depends on DT_HAS_ST_STM32_RNG_ENABLED || DT_HAS_ST_STM32_RNG_NOIRQ_ENABLED
	select ENTROPY_HAS_DRIVER
	help
	  This option enables the RNG processor, which is a entropy number
	  generator, based on a continuous analog noise, that provides
	  a entropy 32-bit value to the host when read. It is available for
	  F4 (except STM32F401 & STM32F411), L4, F7, H7 and G4 series.

if ENTROPY_STM32_RNG

config ENTROPY_STM32_THR_POOL_SIZE
	int "Thread-mode random number pool size"
	range ENTROPY_STM32_THR_THRESHOLD 256
	default 8
	help
	  Buffer length in bytes used to store entropy bytes generated by the
	  hardware to make them ready for thread mode consumers.
	  Please note, that size of the pool must be a power of 2.

config ENTROPY_STM32_THR_THRESHOLD
	int "Thread-mode random number pool low-water threshold"
	range 4 $(UINT8_MAX)
	help
	  Low water-mark threshold in bytes to trigger entropy generation for
	  thread mode consumers. As soon as the number of available bytes in the
	  buffer goes below this number hardware entropy generation will be
	  started.

config ENTROPY_STM32_ISR_POOL_SIZE
	int "ISR-mode random number pool size"
	range ENTROPY_STM32_ISR_THRESHOLD 256
	default 16
	help
	  Buffer length in bytes used to store entropy bytes generated by the
	  hardware to make them ready for ISR consumers.
	  Please note, that size of the pool must be a power of 2.

config ENTROPY_STM32_ISR_THRESHOLD
	int "ISR-mode random number pool low-water threshold"
	range 12 $(UINT8_MAX)
	help
	  Low water-mark threshold in bytes to trigger entropy generation for
	  ISR consumers. As soon as the number of available bytes in the
	  buffer goes below this number hardware entropy generation will be
	  started.

config ENTROPY_STM32_CLK_CHECK
	bool "Runtime clock configuration check"
	depends on !SOC_SERIES_STM32WB0X
	default y
	help
	  Enables a check on RNG clock configuration. Correct clock
	  configuration depends on STM32 series. Check reference manual if an
	  error is reported.
	  This check assumes CED (Clock Error Detected) bit is enabled (when
	  available, CED is enabled by default). Disable this check if CED is
	  disabled.

config ENTROPY_STM32_RNG_CLOCKON_API_REQUIRED
	bool
	depends on SOC_SERIES_STM32U5X
	default y if DT_HAS_ST_STM32_SAES_ENABLED
	select ENTROPY_STM32_RNG_CLOCKON_API

config ENTROPY_STM32_RNG_CLOCKON_API
	bool "Clock-on API for other drivers"
	help
	  Enable the STM32 RNG clock-on API.
	  This clock-on API provides a way for other drivers to request the
	  RNG peripheral to be powered and clocked when needed.
	  This is particularly useful for drivers that rely on the RNG
	  peripheral for their own operations, such as PKA (Public Key
	  Accelerator) or SAES (Secure AES), ensuring that the RNG peripheral
	  is active and ready to provide random numbers when required.

	  When this option is enabled, other drivers can utilize a dedicated
	  API to request the RNG driver to activate the peripheral as needed.
	  This allows for efficient power management, as the RNG peripheral
	  can be powered down when not in use and only activated when required
	  for itself or by other drivers.

endif # ENTROPY_STM32_RNG
```

## drivers/entropy/Kconfig.sy1xx
```kconfig
# Copyright (c) 2025 sensry.io
# SPDX-License-Identifier: Apache-2.0

config ENTROPY_SY1XX_TRNG
	bool "Sensry sy1xx soc family true random number generator (TRNG) driver"
	default y
	depends on DT_HAS_SENSRY_SY1XX_TRNG_ENABLED
	select ENTROPY_HAS_DRIVER
```

## drivers/entropy/Kconfig.tlx
```kconfig
# Copyright (c) 2021-2023 Telink Semiconductor
# SPDX-License-Identifier: Apache-2.0

# Telink TLx-series GPIO configuration options

config ENTROPY_TELINK_TLX_TRNG
	bool "Telink TLx-series Entropy driver"
	default y
	depends on DT_HAS_TELINK_TLX_TRNG_ENABLED
	select ENTROPY_HAS_DRIVER
	help
	  Enable the TLx-series Entropy driver.
```

## drivers/entropy/Kconfig.virtio
```kconfig
# Copyright (c) 2025 TOKITA Hiroshi
# SPDX-License-Identifier: Apache-2.0

config ENTROPY_VIRTIO
	bool "Driver for VIRTIO Entropy device"
	depends on DT_HAS_VIRTIO_DEVICE4_ENABLED
	depends on VIRTIO
	select ENTROPY_HAS_DRIVER
	default y
	help
	  Enable driver for the VIRTIO Entropy device.
```

## drivers/entropy/Kconfig.w91
```kconfig
# Copyright (c) 2024 Telink Semiconductor
# SPDX-License-Identifier: Apache-2.0

# Telink W91-series entropy TRNG configuration

config ENTROPY_TELINK_W91_TRNG
	bool "Telink W91-series Entropy driver"
	default y
	depends on DT_HAS_TELINK_W91_TRNG_ENABLED && TELINK_W91_IPC_DISPATCHER
	select ENTROPY_HAS_DRIVER
	help
	  Enable the W91-series Entropy driver.
```
