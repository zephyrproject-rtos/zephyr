## drivers/usb_c/tcpc/Kconfig.tcpc_numaker
```kconfig
# Nuvoton NuMaker USB-C TCPC device configuration options

# Copyright (c) 2024 Nuvoton Technology Corporation
# SPDX-License-Identifier: Apache-2.0

config USBC_TCPC_NUMAKER
	bool "Nuvoton NuMaker USB-C TCPC device controller driver"
	default y
	select HAS_NUMAKER_ADC
	select HAS_NUMAKER_TMR
	depends on DT_HAS_NUVOTON_NUMAKER_TCPC_ENABLED
	help
	  Enable USB-C TCPC support for Nuvoton NuMaker chip with UTCPD.
```

## drivers/usb_c/tcpc/Kconfig.tcpc_ps8xxx
```kconfig
# USB-C PS8xxx TCPC configuration options

# Copyright 2024 Google LLC
# SPDX-License-Identifier: Apache-2.0

config USBC_TCPC_PS8XXX
	bool "USB-C TCPC device controller driver"
	select USBC_TCPC_TCPCI
	default y
	depends on DT_HAS_PARADE_PS8XXX_ENABLED
	help
	  Enable USB-C TCPC support for the Parade PS8xxx chip family

if USBC_TCPC_PS8XXX

config USBC_TCPC_PS8XXX_INIT_DELAY
	int "PS8xxx init delay"
	default 25
	help
	  Delay between each try of the TCPC initialization

config USBC_TCPC_PS8XXX_INIT_RETRIES
	int "PS8xxx init retries"
	default 10
	help
	  Number of initialization tries that will be performed

endif
```

## drivers/usb_c/tcpc/Kconfig.tcpc_rt1715
```kconfig
# USB-C RT1715 TCPC configuration options

# Copyright (c) 2024 Jianxiong Gu <jianxiong.gu@outlook.com>
# SPDX-License-Identifier: Apache-2.0

config USBC_TCPC_RT1715
	bool "USB-C TCPC device controller driver"
	select USBC_TCPC_TCPCI
	default y
	depends on DT_HAS_RICHTEK_RT1715_ENABLED
	help
	  Enable USB-C TCPC support for the Richtek RT1715

if USBC_TCPC_RT1715

config USBC_TCPC_RT1715_INIT_DELAY
	int "RT1715 init delay"
	default 5
	help
	  Delay between each try of the TCPC initialization

config USBC_TCPC_RT1715_INIT_RETRIES
	int "RT1715 init retries"
	default 10
	help
	  Number of initialization tries that will be performed

endif
```

## drivers/usb_c/tcpc/Kconfig.tcpc_stm32
```kconfig
# USB-C STM32 TCPC device configuration options

# Copyright 2022 The Chromium OS Authors
# SPDX-License-Identifier: Apache-2.0

config USBC_TCPC_STM32
	bool "USB-C TCPC device controller driver"
	default y
	depends on DT_HAS_ST_STM32_UCPD_ENABLED
	select PINCTRL
	select USE_STM32_LL_UCPD
	help
	  Enable USB-C TCPC support on the STM32 G0, G4, L5, and U5 family of
	  processors.
```

## drivers/usb_c/tcpc/Kconfig.tcpc_tcpci
```kconfig
# USB-C TCPCI-compliant devices configuration options

# Copyright 2024 Google LLC
# SPDX-License-Identifier: Apache-2.0

config USBC_TCPC_TCPCI
	bool
	select I2C
	help
	  Enable support for Type-C Port Controller Interface.
	  This symbol should be selected by TCPCI-compliant drivers to allow the use of generic
	  TCPCI functions for registers operations.

if USBC_TCPC_TCPCI

config USBC_TCPC_TCPCI_I2C_RETRIES
	int "I2C communication retries"
	default 2
	help
	  Number of I2C transaction tries that will be performed for each request.
	  Some TCPCs are going into deep sleep mode when no charger is connected and won't respond
	  to the i2c address immediately. If device won't respond after retries, it means that
	  it is not responsible or is not connected.

endif
```

## drivers/usb_c/tcpc/Kconfig.tcpc_tps25750
```kconfig
# Copyright (c) 2023, ithinx GmbH
# Copyright (c) 2023, Tonies GmbH
#
# SPDX-License-Identifier: Apache-2.0

config USBC_TCPC_TPS25750
	bool "USB-C TCPC device controller driver"
	default y
	depends on DT_HAS_TI_TPS25750_ENABLED
```

## drivers/usb_c/vbus/Kconfig
```kconfig
# USB-C VBUS Measurement configuration options

# Copyright 2022 The Chromium OS Authors
# SPDX-License-Identifier: Apache-2.0

menuconfig USBC_VBUS_DRIVER
	bool "USB-C VBUS drivers"
	help
	  Enable USB-C drivers

if USBC_VBUS_DRIVER

config USBC_VBUS_INIT_PRIORITY
	int "USB-C VBUS driver init priority"
	default 85
	help
	  Initialization priority of the USB-C VBUS measurement drivers in POST_KERNEL.

source "drivers/usb_c/vbus/Kconfig.usbc_vbus_adc"
source "drivers/usb_c/vbus/Kconfig.numaker"
source "drivers/usb_c/vbus/Kconfig.usbc_vbus_tcpci"

endif # USBC_VBUS_DRIVER

module = USBC
module-str = usbc
source "subsys/logging/Kconfig.template.log_config"
```

## drivers/usb_c/vbus/Kconfig.numaker
```kconfig
# Nuvoton NuMaker USB-C VBUS device configuration options

# Copyright (c) 2024 Nuvoton Technology Corporation
# SPDX-License-Identifier: Apache-2.0

config USBC_VBUS_NUMAKER
	bool "Nuvoton NuMaker USB-C VBUS"
	default y
	depends on DT_HAS_NUVOTON_NUMAKER_VBUS_ENABLED && USBC_TCPC_NUMAKER
	select PINCTRL
	help
	  Enable USB-C VBUS support for Nuvoton NuMaker chip with UTCPD.
```

## drivers/usb_c/vbus/Kconfig.usbc_vbus_fusb302b
```kconfig
config USBC_VBUS_FUSB302B
	bool "FUSB203B vbus"
	default y
	depends on DT_HAS_FCS_FUSB302B_VBUS_ENABLED
	help
	  Measure VBUS with FUSB302B

if USBC_VBUS_FUSB302B

config EMUL_VBUS_FUSB302B
	bool "Emulate a FUSB302B (VBUS)"
	default y
	depends on EMUL
	depends on USBC_VBUS_FUSB302B
	help
	  This is an emulator for the FUSB302B VBUS component.

endif
```

## drivers/usb_c/vbus/Kconfig.usbc_vbus_i2c
```kconfig
# USB-C VBUS device configuration options

# Copyright 2022 The Chromium OS Authors
# SPDX-License-Identifier: Apache-2.0

config USBC_VBUS_I2C
	bool "USB-C VBUS I2C"
	default y
	depends on DT_HAS_ZEPHYR_USB_C_VBUS_I2C_ENABLED
	help
	  Measure VBUS with an I2C through a voltage divider
```

## drivers/usb_c/vbus/Kconfig.usbc_vbus_tcpci
```kconfig
# USB-C TCPCI VBUS device configuration options

# Copyright 2024 Google LLC
# SPDX-License-Identifier: Apache-2.0

config USBC_VBUS_TCPCI
	bool "USB-C VBUS TCPCI"
	select USBC_TCPC_TCPCI
	default y
	depends on DT_HAS_ZEPHYR_USB_C_VBUS_TCPCI_ENABLED
	help
	  Measure VBUS using the TCPC chip compliant to TCPCI
```

## drivers/usbc/Kconfig
```kconfig
# USBC configuration options

# Copyright 2022 The Chromium OS Authors
# SPDX-License-Identifier: Apache-2.0

source "drivers/usbc/tcpc/Kconfig"
```

## drivers/usbc/tcpc/Kconfig
```kconfig
# USBC TCPC configuration options

# Copyright 2022 The Chromium OS Authors
# SPDX-License-Identifier: Apache-2.0

menuconfig USBC_TCPC_DRIVER
	bool "USBC TCPC drivers"
	help
	  Enable USBC TypeC Port Controller (TCPC) drivers

if USBC_TCPC_DRIVER

config USBC_INIT_PRIORITY
	int "USBC driver init priority"
	default 80
	help
	  USBC device driver initialization priority.
	  Do not mess with it unless you know what you are doing.
	  Note that the priority needs to be lower than the USBC stack
	  so that it can start before the USBC sub-system.

source "drivers/usbc/tcpc/Kconfig.tcpc_stm32"

endif # USBC_TCPC_DRIVER

module = USBC
module-str = usbc
source "subsys/logging/Kconfig.template.log_config"
```

## drivers/usbc/tcpc/Kconfig.tcpc_stm32
```kconfig
# USBC STM32 TCPC device configuration options

# Copyright 2022 The Chromium OS Authors
# SPDX-License-Identifier: Apache-2.0

DT_COMPAT_ST_STM32_UCPD := st,stm32-ucpd

config USBC_TCPC_STM32
	bool "USBC TCPC device controller driver"
	depends on SOC_FAMILY_STM32
	default $(dt_compat_enabled,$(DT_COMPAT_ST_STM32_UCPD))
	select USE_STM32_LL_UCPD
	help
	  Enable USBC TCPC support on the STM32 G0, G4, L5, and U5 family of
	  processors.
```

## drivers/usbh/Kconfig
```kconfig
# Copyright (c) 2020 PHYTEC Messtechnik GmbH
# SPDX-License-Identifier: Apache-2.0

if USBH

config USBH_SAM0
	bool "SAM0 series USB Host Controller driver"
	default y
	depends on SOC_FAMILY_SAM0
	help
	  SAM0 family USB host controller Driver.

config USBH_EHCI
	bool "EHCI USB Host Controller driver"
	default y
	depends on HAS_MCUX_USB_EHCI
	select NOCACHE_MEMORY if HAS_MCUX_CACHE
	help
	  RT EHCI USB Host Controller Driver.

endif
```

## drivers/uwb/native_sim/Kconfig
```kconfig
# Copyright 2026 NXP
# SPDX-License-Identifier: Apache-2.0

if UWB

module = UWB
module-str = uwb
source "subsys/logging/Kconfig.template.log_config"

config UWB_TRANSPORT_NATIVE_SIM
	bool "Native simulator UWB transport backend"
	default y if BOARD_NATIVE_SIM
	help
	  Selects the pipe-based native_sim UWB transport backend.
	  A POSIX thread simulates the UWB device and responds to
	  standard UCI commands.

endif # UWB
```

## drivers/vhost/Kconfig
```kconfig
# Copyright (c) 2025 TOKITA Hiroshi
# SPDX-License-Identifier: Apache-2.0

config VHOST
	bool "support for VIRTIO"
	help
	  Enable options for VIRTIO

if VHOST

endif # VIRTIO

module = VHOST
module-str = VHOST
source "subsys/logging/Kconfig.template.log_config"
```

## drivers/video/Kconfig
```kconfig
# VIDEO driver configuration options

# Copyright (c) 2019 Linaro Limited
# SPDX-License-Identifier: Apache-2.0

#
# VIDEO Drivers
#
menuconfig VIDEO
	bool "Video drivers"
	help
	  Enable support for the VIDEO.

if VIDEO

module = VIDEO
module-str = video
source "subsys/logging/Kconfig.template.log_config"

config VIDEO_INIT_PRIORITY
	int "Video initialization priority"
	default 60
	help
	  System initialization priority for video drivers.

config VIDEO_BUFFER_POOL_HEAP_SIZE
	int "Size in byte of the video buffer pool"
	default 2097152

config VIDEO_BUFFER_POOL_NUM_MAX
	int "Number of maximum sized buffer in the video pool"
	default 2

config VIDEO_BUFFER_POOL_ALIGN
	int "Alignment of the video pool’s buffer"
	default 64

config VIDEO_BUFFER_POOL_ZEPHYR_REGION
	bool "Place video buffer pool in a Zephyr memory-region"
	help
	  Place video buffer pool in a region, automatically
	  created from a 'zephyr,memory-region' compatible node,
	  whose name is specified in CONFIG_VIDEO_BUFFER_ZEPHYR_REGION_NAME.

config VIDEO_BUFFER_POOL_ZEPHYR_REGION_NAME
	string "Name of the zephyr memory-region for video buffer pool"
	help
	  Name of the Zephyr memory-region where video buffer pool is placed.

config VIDEO_BUFFER_USE_SHARED_MULTI_HEAP
	bool "Use shared multi heap for video buffer"

config VIDEO_BUFFER_SMH_ATTRIBUTE
	int "Shared multi heap attribute for video buffer"
	depends on VIDEO_BUFFER_USE_SHARED_MULTI_HEAP
	default 0
	range 0 2
	help
	  Shared multi heap attribute for video buffer:
	  0: SMH_REG_ATTR_CACHEABLE
	  1: SMH_REG_ATTR_NON_CACHEABLE
	  2: SMH_REG_ATTR_EXTERNAL

config VIDEO_I2C_RETRY_NUM
	int "Number of retries after a failed I2C communication"
	default 0
	help
	  If set to 0, only a single write attempt will be done with no retry.
	  The default is to not retry. Board configuration files or user project can then
	  use the number of retries that matches their situation.

config VIDEO_ENCODER_H264
	bool "H264 video encoder support"

config VIDEO_ENCODER_JPEG
	bool "JPEG video encoder support"

# zephyr-keep-sorted-start
source "drivers/video/Kconfig.emul_imager"
source "drivers/video/Kconfig.emul_rx"
source "drivers/video/Kconfig.esp32_dvp"
source "drivers/video/Kconfig.gc2145"
source "drivers/video/Kconfig.hm01b0"
source "drivers/video/Kconfig.hm0360"
source "drivers/video/Kconfig.imx335"
source "drivers/video/Kconfig.mcux_csi"
source "drivers/video/Kconfig.mcux_mipi_csi2rx"
source "drivers/video/Kconfig.mcux_sdma"
source "drivers/video/Kconfig.mt9m114"
source "drivers/video/Kconfig.ov2640"
source "drivers/video/Kconfig.ov5640"
source "drivers/video/Kconfig.ov7725"
source "drivers/video/Kconfig.ov9655"
source "drivers/video/Kconfig.renesas_ra_ceu"
source "drivers/video/Kconfig.shell"
source "drivers/video/Kconfig.st_mipid02"
source "drivers/video/Kconfig.stm32_dcmi"
source "drivers/video/Kconfig.stm32_dcmipp"
source "drivers/video/Kconfig.stm32_jpeg"
source "drivers/video/Kconfig.stm32_venc"
source "drivers/video/Kconfig.sw_generator"
# zephyr-keep-sorted-stop

source "drivers/video/Kconfig.ov5642"
source "drivers/video/Kconfig.ov767x"

endif # VIDEO
```

## drivers/video/Kconfig.ap1302
```kconfig
# Copyright 2026 NXP
# SPDX-License-Identifier: Apache-2.0

config VIDEO_AP1302
	bool "ONNN AP1302 Camera ISP driver"
	select I2C
	select GPIO
	select REGULATOR
	depends on DT_HAS_ONNN_AP1302_ENABLED
	default y
	help
	  Enable driver for AP1302 Camera ISP.

	  Firmware loading:
	  The AP1302 requires a firmware binary blob provided by ON Semiconductor.
	  The blob is publicly downloadable from:
	    https://github.com/ONSemiconductor/ap1302_binaries

	  The firmware is distributed under the "AP1302 Software License Agreement"
	  (see the PDF in that repository). Due to its licensing terms, the firmware
	  is NOT shipped as part of Zephyr.

	  Users must download the firmware separately and place it in a location
	  accessible to the driver (see the devicetree binding property
	  firmware-partition) and ensure they comply with the license terms.

if VIDEO_AP1302

config VIDEO_AP1302_INIT_PRIORITY
	int "AP1302 driver initialization priority"
	default 76
	help
	  Initialization priority for AP1302 driver.

config VIDEO_AP1302_FIRMWARE_FILE
	string "AP1302 firmware blob file"
	default ""
	help
	  Optional path to an AP1302 firmware blob file.
	  Leave empty to build without embedding a firmware.

config VIDEO_AP1302_UPLOAD_FIRMWARE
	bool "Embed and upload AP1302 firmware"
	default n
	depends on VIDEO_AP1302_FIRMWARE_FILE != ""
	help
	  When enabled, the firmware blob specified by
	  CONFIG_VIDEO_AP1302_FIRMWARE_FILE is built into the application image and
	  uploaded to the AP1302 at runtime.

	  When disabled, the driver expects the firmware to be available via the
	  devicetree firmware-partition property.

endif # VIDEO_AP1302
```

## drivers/video/Kconfig.arducam_mega
```kconfig
# ARDUCAM_MEGA

# Copyright (c) 2023 Arducam Technology Co., Ltd. <www.arducam.com>
# SPDX-License-Identifier: Apache-2.0

config VIDEO_ARDUCAM_MEGA
	bool "Arducam Mega CMOS digital image sensor"
	select SPI
	depends on DT_HAS_ARDUCAM_MEGA_ENABLED
	default y
	help
	  Enable driver for Arducam Mega CMOS digital image sensor device.
```

## drivers/video/Kconfig.emul_imager
```kconfig
# Copyright (c) 2024 tinyVision.ai Inc.
# SPDX-License-Identifier: Apache-2.0

config VIDEO_EMUL_IMAGER
	bool "Software implementation of an imager"
	depends on DT_HAS_ZEPHYR_VIDEO_EMUL_IMAGER_ENABLED
	default y
	help
	  Enable driver for the emulated Imager. A line buffer contains
	  the color pattern within the imager data struct, at the first
	  field, and the "zephyr,video-emul-rx" driver will memcpy() this
	  line over a full frame, simulating a MIPI link transmetting
	  the lines of data from the imager to the memory.  The default
	  value fits 2 bit-per-pixel, 640 pixel-wide frames.
```

## drivers/video/Kconfig.emul_rx
```kconfig
# Copyright (c) 2024 tinyVision.ai Inc.
# SPDX-License-Identifier: Apache-2.0

config VIDEO_EMUL_RX
	bool "Software implementation of video frame RX core"
	depends on DT_HAS_ZEPHYR_VIDEO_EMUL_RX_ENABLED
	depends on VIDEO_EMUL_IMAGER
	default y
	help
	  Enable driver for the MIPI RX emulated DMA engine.
```

## drivers/video/Kconfig.esp32_dvp
```kconfig
# Copyright (c) 2024 Espressif Systems (Shanghai) Co., Ltd.
# SPDX-License-Identifier: Apache-2.0

config VIDEO_ESP32
	bool "Video interface driver"
	select DMA
	depends on DT_HAS_ESPRESSIF_ESP32_LCD_CAM_ENABLED
	default y
	help
	  This option enables the video interface for the esp32s3.
```

## drivers/video/Kconfig.gc2145
```kconfig
# Copyright (c) 2024 Felipe Neves
# SPDX-License-Identifier: Apache-2.0

config VIDEO_GC2145
	bool "GC2145 CMOS digital image sensor"
	select I2C
	select GPIO if $(dt_compat_any_has_prop,$(DT_COMPAT_GALAXYCORE_GC2145),pwdn-gpios) || \
			$(dt_compat_any_has_prop,$(DT_COMPAT_GALAXYCORE_GC2145),reset-gpios)
	depends on DT_HAS_GALAXYCORE_GC2145_ENABLED
	default y
	help
	  Enable driver for GC2145 CMOS digital image sensor device.
```

## drivers/video/Kconfig.hm01b0
```kconfig
# Copyright The Zephyr Project Contributors
# SPDX-License-Identifier: Apache-2.0
config VIDEO_HIMAX_HM01B0
	bool "Real-time monochrome camera Himax HM01B0 sensor"
	depends on DT_HAS_HIMAX_HM01B0_ENABLED
	select I2C
	default y
	help
	  Enable driver for monochrome camera Himax HM01B0 sensor.
```
