## drivers/cache/Kconfig.andes
```kconfig
# SPDX-License-Identifier: Apache-2.0
#
# Copyright (c) 2024 ANDES Technology Inc.

DT_COMPAT_ANDESTECH_L2C := andestech,l2c

config CACHE_ANDES
bool "ANDES external cache driver"
	default y
	depends on SOC_FAMILY_ANDES_V5
	select CACHE_HAS_DRIVER
	imply DCACHE_LINE_SIZE_DETECT
	imply ICACHE_LINE_SIZE_DETECT
	help
	  This option enables the CACHE driver for ANDES V5 series SOC.

if CACHE_ANDES

config L2C_INCLUSIVE_POLICY
	bool
	depends on $(dt_compat_enabled,$(DT_COMPAT_ANDESTECH_L2C))
	help
	  When L2 cache is inclusive of L1, CPU only needs to perform operations
	  on L2 cache, instead of on both L1 and L2 caches.

config CACHE_ANDES_INIT_PRIORITY
	int "Andes cache driver init priority"
	default 60
	help
	  This option controls the priority of the cache initialization.
	  Lower values indicate earlier initialization.

endif # CACHE_ANDES
```

## drivers/cache/Kconfig.arm_ahb
```kconfig
# SPDX-FileCopyrightText: Copyright (c) 2026 Synaptics Incorporated
# SPDX-License-Identifier: Apache-2.0

config CACHE_ARM_AHB
	bool "ARM CoreLink AHB cache driver"
	select CACHE_HAS_DRIVER
	depends on CACHE_MANAGEMENT
	depends on DT_HAS_ARM_AHB_CACHE_ENABLED
	help
	  Enable support for the ARM CoreLink AHB cache as instruction cache
	  for Cortex-M0/0+/3/4/23/33 and similar CPUs.
```

## drivers/cache/Kconfig.bflb
```kconfig
# Copyright (c) 2025 MASSDRIVER EI <massdriver.space>
# SPDX-License-Identifier: Apache-2.0

config CACHE_BFLB_L1C
	bool "Bouffalolab L1C cache system driver"
	default y
	select CACHE_HAS_DRIVER
	depends on DT_HAS_BFLB_L1C_ENABLED
	help
	  This option enables the cache driver for the Bouffalolab L1C cache system
```

## drivers/cache/Kconfig.esp32
```kconfig
# Copyright (c) 2026 Espressif Systems (Shanghai) Co., Ltd.
# SPDX-License-Identifier: Apache-2.0

config CACHE_ESP32
	bool "Espressif ESP32 cache driver"
	default y
	depends on SOC_FAMILY_ESPRESSIF_ESP32 && CACHE_MANAGEMENT
	select CACHE_HAS_DRIVER
	help
	  Enable the data cache driver for Espressif SoCs with a
	  writeback data cache (ESP32-S2, S3, C5), used to keep PSRAM
	  and DMA buffers coherent.
```

## drivers/cache/Kconfig.kinetis
```kconfig
# SPDX-License-Identifier: Apache-2.0
#
# Copyright 2022 NXP

config CACHE_KINETIS
bool "Kinetis cache driver"
	select CACHE
	select CACHE_HAS_DRIVER
	select CACHE_MANAGEMENT
	help
	  This option enables the CACHE driver for NXP kinetis caches.

choice CACHE_TYPE
	default HAS_EXTERNAL_CACHE if CACHE_KINETIS
endchoice
```

## drivers/cache/Kconfig.max32
```kconfig
# Copyright (c) 2026 Analog Devices, Inc.
# SPDX-License-Identifier: Apache-2.0

config CACHE_MAX32
	bool "ADI MAX32 cache controller driver"
	default y
	select CACHE_HAS_DRIVER
	depends on SOC_FAMILY_MAX32
	help
	  Enable the ADI MAX32 cache controller driver.
```

## drivers/cache/Kconfig.mcux
```kconfig
# Copyright 2025 NXP
# SPDX-License-Identifier: Apache-2.0

config CACHE_NXP_CACHE64_INIT
	bool "NXP CACHE64 POLSEL init for FlexSPI/XSPI"
	default y
	depends on HAS_MCUX_CACHE64 && CACHE_INIT_ONLY
	help
	  Initialize CACHE64 policy selector (POLSEL) from Devicetree and optionally
	  enable write buffer and cache. No system cache maintenance API is provided.

config CACHE_NXP_CACHE64_INIT_PRIORITY
	int "NXP CACHE64 init priority (POST_KERNEL)"
	default 10
	help
	  Initialization priority for the CACHE64 POLSEL setup. This driver must
	  run after the FlexSPI NOR flash driver, which typically uses
	  CONFIG_FLASH_INIT_PRIORITY (often 80). Choose a value greater than the
	  flash init priority to ensure FlexSPI reset does not wipe cache settings.

config CACHE_NXP_SYSCON_LPCAC
	bool "NXP external cache driver for NXP syscon lpcac controller"
	default y
	select CACHE_HAS_DRIVER
	depends on HAS_MCUX_SYSCON_LPCAC
	help
	  This option enables the syscon lpcac driver for NXP SoCs.

config CACHE_NXP_XCACHE
	bool "NXP external cache driver for xcache controller"
	default y
	select CACHE_HAS_DRIVER
	depends on HAS_MCUX_XCACHE
	help
	  This option enables the XCACHE driver for NXP SOC's.

config CACHE_NXP_LMEM_CACHE
	bool "NXP LMEM cache driver"
	default y
	select CACHE_HAS_DRIVER
	depends on HAS_MCUX_LMEM_CACHE
	help
	  This option enables the LMEM cache driver for NXP SOCs.
```
