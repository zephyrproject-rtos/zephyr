## drivers/bluetooth/hci/Kconfig.infineon
```kconfig
# Copyright (c) 2023 Cypress Semiconductor Corporation (an Infineon company) or
# an affiliate of Cypress Semiconductor Corporation
# SPDX-License-Identifier: Apache-2.0

if BT_AIROC

config BT_CYW43XX
	bool
	default y if BT_AIROC && BT_H4

choice  AIROC_PART
	prompt "Select AIROC part"

config CYW4343W
	bool "CYW4343W"
	depends on BT_H4
	help
	  Enable Infineon CYW4343W BLE connectivity,
	  More information about CYW4343W device you can find on
	  https://www.infineon.com/cms/en/product/wireless-connectivity/airoc-wi-fi-plus-bluetooth-combos/cyw4343w/

config CYW4373
	bool "CYW4373"
	depends on BT_H4
	help
	  Enable Infineon CYW4373 BLE connectivity,
	  More information about CYW4373 device you can find on
	  https://www.infineon.com/cms/en/product/wireless-connectivity/airoc-wi-fi-plus-bluetooth-combos/cyw4373/

config CYW43012
	bool "CYW43012"
	depends on BT_H4
	help
	  Enable Infineon CYW43012 BLE connectivity,
	  More information about CYW43012 device you can find on
	  https://www.infineon.com/cms/en/product/wireless-connectivity/airoc-wi-fi-plus-bluetooth-combos/cyw43012/

config CYW43438
	bool "CYW43438"
	depends on BT_H4
	help
	  Enable Infineon CYW43438 BLE connectivity,
	  More information about CYW43438 device you can find on
	  https://www.infineon.com/cms/en/product/wireless-connectivity/airoc-wi-fi-plus-bluetooth-combos/cyw43438/

config CYW43439
	bool "CYW43439"
	depends on BT_H4
	help
	  Enable Infineon CYW43439 BLE connectivity,
	  More information about CYW43439 device you can find on
	  https://www.infineon.com/cms/en/product/wireless-connectivity/airoc-wi-fi-plus-bluetooth-combos/cyw43439/

config CYW20829
	bool "CYW20829"
	depends on BT_CYW208XX
	help
	  Enable Infineon CYW20829 BLE connectivity,
	  More information about CYW20829 device you can find on
	  https://www.infineon.com/cms/en/product/wireless-connectivity/airoc-bluetooth-le-bluetooth-multiprotocol/airoc-bluetooth-le/cyw20829/

config BT_AIROC_CUSTOM
	bool "Custom AIROC device/module"
	help
	  Select Custom AIROC device/module. For this option,
	  user must to provide path to BT firmware HCD file for
	  custom or vendor AIROC modules in AIROC_CUSTOM_FIRMWARE_HCD_BLOB.

endchoice

choice CYW43012_MODULE
	prompt "Select CYW43012 module"
	depends on CYW43012

config CYW43012_MURATA_1LV
	bool "MURATA-1LV"
	help
	  Murata Type 1LV module based on Infineon CYW43012 combo chipset
	  which supports Wi-Fi® 802.11a/b/g/n + Bluetooth® 5.0 BR/EDR/LE
	  up to 72.2Mbps PHY data rate on Wi-fi® and 3Mbps PHY data rate
	  on Bluetooth®. 2Mbps LE PHY is also supported.

	  Detailed information about Murata Type 1LV module you can find on
	  https://www.murata.com/en-us/products/connectivitymodule/wi-fi-bluetooth/overview/lineup/type1lv

endchoice

choice CYW4343W_MODULE
	prompt "Select CYW4343W module"
	depends on CYW4343W

config CYW4343W_MURATA_1DX
	bool "MURATA-1DX"
	help
	  Murata Type 1DX modules based on Infineon CYW4343W combo chipset
	  which supports Wi-Fi® 802.11b/g/n + Bluetooth® 5.1 BR/EDR/LE
	  up to 65Mbps PHY data rate on Wi-fi® and 3Mbps PHY data rate
	  on Bluetooth®.

	  Detailed information about Type 1DX module you can find on
	  https://www.murata.com/en-us/products/connectivitymodule/wi-fi-bluetooth/overview/lineup/type1dx

endchoice

choice CYW4373_MODULE
	prompt "Select CYW4373 module"
	depends on CYW4373

config CYW4373_STERLING_LWB5PLUS
	bool "STERLING-LWB5plus"
	help
	  Ezurio Sterling LWB5+ 802.11ac / Bluetooth 5.0 M.2 Carrier Board
	  (E-Type Key w/ SDIO/UART)

	  Detailed information about Type Sterling LWB5+ module you can find on
	  https://www.ezurio.com/wireless-modules/wifi-modules-bluetooth/sterling-lwb5-plus-wifi-5-bluetooth-5-module

endchoice

choice CYW43439_MODULE
	prompt "Select CYW43439 module"
	depends on CYW43439

config CYW43439_MURATA_1YN
	bool "MURATA_1YN"
	help
	  Murata Type 1YN module based on Infineon CYW43439 combo chipset
	  which supports Wi-Fi® 802.11b/g/n + Bluetooth® 5.2 BR/EDR/LE
	  up to 65Mbps PHY data rate on Wi-fi® and 3Mbps PHY data rate on
	  Bluetooth®.

	  Detailed information about Murata Type 1YN module you can find on
	  https://www.murata.com/en-us/products/connectivitymodule/wi-fi-bluetooth/overview/lineup/type1yn

endchoice

if CYW20829

config CYW20829_BT_FW_TX10DBM_POWER
	bool "CYW20829_BT_FW_TX10DBM_POWER"
	default y
	help
	  Enable 10dBm TX Power variant of CYW20829 FW patch.

choice CYW20829_BT_FW
	prompt "Select variant of default CYW20829 BT FW"
	default CYW20829_BT_FW_ISOC_TX10 if BT_ISO &&  CYW20829_BT_FW_TX10DBM_POWER
	default CYW20829_BT_FW_ISOC_TX0  if BT_ISO && !CYW20829_BT_FW_TX10DBM_POWER
	default CYW20829_BT_FW_PAWR_TX10 if (BT_PER_ADV_RSP || BT_PER_ADV_SYNC_RSP) &&  CYW20829_BT_FW_TX10DBM_POWER
	default CYW20829_BT_FW_PAWR_TX0  if (BT_PER_ADV_RSP || BT_PER_ADV_SYNC_RSP) && !CYW20829_BT_FW_TX10DBM_POWER
	default CYW20829_BT_FW_TX10      if CYW20829_BT_FW_TX10DBM_POWER
	default CYW20829_BT_FW_TX0

config CYW20829_BT_FW_TX0
	bool "CYW20829_BT_FW_TX0"
	help
	  Enable CYW20829 FW patch for 0dBm TX Power.
	  This configuration should be used with non-PAWR and non-ISOC applications.

config CYW20829_BT_FW_TX10
	bool "CYW20829_BT_FW_TX10"
	help
	  Enable CYW20829 FW patch for 10dBm TX Power.
	  This configuration should be used with non-PAwR and non-ISOC applications.

config CYW20829_BT_FW_PAWR_TX0
	bool "CYW20829_BT_FW_PAWR_TX0"
	help
	  Enable CYW20829 FW patch with PAwR support for 0dBm TX Power.
	  This configuration should be used with PAwR applications.

config CYW20829_BT_FW_PAWR_TX10
	bool "CYW20829_BT_FW_PAWR_TX10"
	help
	  Enable CYW20829 FW patch for 10dBm TX Power.
	  This configuration should be used with PAwR applications.

config CYW20829_BT_FW_ISOC_TX0
	bool "CYW20829_BT_FW_ISOC_TX0"
	help
	  Enable CYW20829 FW patch for 0dBm TX Power.
	  This configuration should be used with ISOC applications.

config CYW20829_BT_FW_ISOC_TX10
	bool "CYW20829_BT_FW_ISOC_TX10"
	help
	  Enable CYW20829 FW patch for 10dBm TX Power.
	  This configuration should be used with ISOC applications.

endchoice
endif # CYW20829

config AIROC_CUSTOM_FIRMWARE_HCD_BLOB
	string  "Path to user BT firmware HCD file"
	help
	  Path to BT firmware HCD file for custom or vendor CYW43xx modules.
	  It can be absolute path, or relative from project folder.

# Change size of command lengths. It for vendor commands related to
# firmware downloading.
config BT_BUF_CMD_TX_SIZE
	default $(UINT8_MAX)

endif # BT_AIROC

if BT_PSOC6_BLESS

config BT_PSOC6_BLESS_MAX_TX_PAYLOAD
	int "Max Tx payload size"
	range 27 251
	default 27

config BT_PSOC6_BLESS_MAX_RX_PAYLOAD
	int "Max Rx payload size"
	range 27 251
	default 27

endif # BT_PSOC6_BLESS
```

## drivers/bluetooth/hci/Kconfig.nxp
```kconfig
#
# Copyright 2023-2025 NXP
#
# SPDX-License-Identifier: Apache-2.0
#

config HCI_NXP_ENABLE_AUTO_SLEEP
	bool "BLE Controller auto sleep mode"
	help
	  If enabled, the Controller auto sleep mode will be configured and enabled during HCI init.
	  Auto sleep mode means the Controller will handle its low power state automatically.
	  Enabling this feature will allow to save power at the cost of some latency when sending a HCI
	  message to the Controller as the Host will need to wake it up.

config HCI_NXP_SET_CAL_DATA
	bool "Bluetooth Controller calibration data"
	help
	  If enabled, the Host will send calibration data to the Bluetooth Controller during HCI init.

config HCI_NXP_SET_CAL_DATA_ANNEX100
	bool "Bluetooth Controller calibration data annex 100"
	help
	  If enabled, the Host will send calibration data annex 100 to the Bluetooth Controller during HCI
	  init.

config HCI_NXP_RX_THREAD
	bool "Process RX buffers in a dedicated thread"
	help
	  Some platforms receive the HCI RX buffers in ISR context.
	  If enabled, the HCI RX message is queued by the ISR, and the message is processed
	  in a dedicated thread.

if HCI_NXP_RX_THREAD

config HCI_NXP_RX_STACK_SIZE
	int "HCI RX stack size"
	default 512

config HCI_NXP_RX_MSG_QUEUE_SIZE
	int "HCI RX message queue size"
	default 4

config HEAP_MEM_POOL_ADD_SIZE_BT_NXP_RX_THREAD
	int
	default 768

endif

if BT_NXP

config BT_DIS_MANUF_NAME
	default y

config BT_DIS_MANUF_NAME_STR
	default "NXP"

config BT_HCI_ACL_FLOW_CONTROL
	default n

config BT_BUF_EVT_DISCARDABLE_SIZE
	default 84

config HEAP_MEM_POOL_ADD_SIZE_BT_NXP
	int
	default 256

config FLASH
	default y

endif # BT_NXP

if BT_H4_NXP_CTLR

choice BT_NXP_MODULE
	# All NXP Bluetooth modules controlled by BT_H4_NXP_CTLR should be added to this section
	# similar with BT_NXP_NW612.
	prompt "NXP Bluetooth Module"
	default BT_NXP_NW612

config BT_NXP_NW612
	bool "NW612 firmware for NXP IW612 Chipset"
	help
	  NXP IW612 Chipset supports Wi-Fi? 802.11a/b/g/n/ac/ax + Bluetooth? 5.4
	  BR/EDR/LE + IEEE802.1.5.4 up to 601 Mbps data rate on Wi-Fi? and 2Mbps
	  data rate on Bluetooth?. 4-wire UART@3M baud is supported. PCM for
	  audio is also supported.
	  Details of the module could be found on https://www.nxp.com/products/
	  wireless-connectivity/wi-fi-plus-bluetooth-plus-802-15-4/2-4-5-ghz-
	  dual-band-1x1-wi-fi-6-802-11ax-plus-bluetooth-5-4-plus-802-15-4-tri-
	  radio-solution:IW612.

config BT_NXP_IW416
	bool "NXP IW416 Chipset"
	help
	  NXP IW416 Chipset supports Wi-Fi4 + Bluetooth5.2
	  Details of the module could be found on https://www.nxp.com/products/
	  wireless-connectivity/wi-fi-plus-bluetooth-plus-802-15-4/2-4-5-ghz-
	  dual-band-1x1-wi-fi-4-802-11n-plus-bluetooth-5-2-solution:IW416.

config BT_NXP_IW610
	bool "IW610 firmware for NXP IW610 Chipset"
	help
	  NXP IW610 Chipset supports Wi-Fi™ 802.11a/b/g/n/ac/ax HE20 + Bluetooth®. 5.4
	  Low Energy + 802.15.4
	  Details of the module could be found on https://www.nxp.com/products/
	  wireless-connectivity/wi-fi-plus-bluetooth-plus-802-15-4/2-4-5ghz-
	  dual-band-1x1-wi-fi-6-plus-bluetooth-low-energy-5-4-plus-802-15-4-tri-
	  radio-solution:IW610

endchoice # BT_NXP_MODULE

endif # BT_H4_NXP_CTLR
```
