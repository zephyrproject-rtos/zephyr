## drivers/bluetooth/hci/Kconfig.silabs
```kconfig
# Copyright (c) 2025 Silicon Laboratories Inc.
#
# SPDX-License-Identifier: Apache-2.0

config BT_SILABS_SIWX91X
	bool "Silabs SiWx91x Bluetooth interface"
	default y
	depends on DT_HAS_SILABS_SIWX91X_BT_HCI_ENABLED
	select SILABS_SIWX91X_NWP
	select ENTROPY_GENERATOR
	select BT_HCI_SETUP
	help
	  Use Silicon Labs Wiseconnect 3.x Bluetooth library to connect to the controller.

# SiWx917 BLE controller currently does not support HCI Command: Host Number of Completed Packets
configdefault BT_HCI_ACL_FLOW_CONTROL
	default n if BT_SILABS_SIWX91X

config BT_SILABS_EFR32
	bool "Silabs EFR32 HCI driver"
	default y
	depends on DT_HAS_SILABS_BT_HCI_EFR32_ENABLED
	depends on ZEPHYR_HAL_SILABS_MODULE_BLOBS || BUILD_ONLY_NO_BLOBS
	depends on SOC_GECKO_HAS_RADIO
	select SOC_GECKO_USE_RAIL
	select PSA_CRYPTO
	select SILABS_SISDK_PROTOCOL_CRYPTO
	select HAS_BT_CTLR
	# Features supported by all EFR32 devices
	select BT_CTLR_PHY_UPDATE_SUPPORT
	select BT_CTLR_PER_INIT_FEAT_XCHG_SUPPORT
	select BT_CTLR_DATA_LEN_UPDATE_SUPPORT
	select BT_CTLR_EXT_REJ_IND_SUPPORT
	select BT_CTLR_CHAN_SEL_2_SUPPORT
	select BT_CTLR_CONN_RSSI_SUPPORT
	select BT_CTLR_ADV_EXT_SUPPORT
	select BT_CTLR_PRIVACY_SUPPORT
	select BT_CTLR_SYNC_PERIODIC_SUPPORT
	select BT_CTLR_SYNC_TRANSFER_RECEIVER_SUPPORT
	select BT_CTLR_SYNC_TRANSFER_SENDER_SUPPORT
	# Features supported by some EFR32 devices
	select BT_CTLR_PHY_2M_SUPPORT if HAS_HW_EFR32_RADIO_BLE_2M
	select BT_CTLR_PHY_CODED_SUPPORT if HAS_HW_EFR32_RADIO_BLE_CODED
	select BT_CTLR_CHANNEL_SOUNDING_SUPPORT if HAS_HW_EFR32_RADIO_CS
	select BT_CTLR_DF_SUPPORT if HAS_HW_EFR32_RADIO_CTE_TX
	select BT_CTLR_DF_CTE_TX_SUPPORT if HAS_HW_EFR32_RADIO_CTE_TX
	select BT_CTLR_DF_CTE_RX_SUPPORT if HAS_HW_EFR32_RADIO_CTE_RX
	select BT_CTLR_DF_CTE_RX_SAMPLE_1US_SUPPORT if HAS_HW_EFR32_RADIO_CTE_RX
	select BT_CTLR_DF_ANT_SWITCH_1US_SUPPORT if HAS_HW_EFR32_RADIO_CTE_TX
	select BT_CTLR_DF_ANT_SWITCH_2US_SUPPORT if HAS_HW_EFR32_RADIO_CTE_TX
	select BT_SILABS_EFR32_HIGH_POWER if HAS_HW_EFR32_RADIO_TX_HIGH_POWER
	help
	  Use Silicon Labs binary Bluetooth library to connect to the
	  controller.

menu "EFR32 Bluetooth Controller Configuration"
	depends on BT_SILABS_EFR32

config BT_SILABS_EFR32_HCI_VS
	bool "Silicon Labs vendor specific HCI extensions"
	help
	  Enable Silicon Labs vendor specific HCI extensions.

config BT_SILABS_EFR32_BUFFER_MEMORY
	int "Memory buffer size"
	default 6144
	help
	  Select the size of allocated memory buffer for the Silicon Labs
	  Bluetooth Library. If set too low the capacity of the link layer may
	  suffer.

config BT_SILABS_EFR32_USER_ADVERTISERS
	int "User advertisement sets"
	default 1
	help
	  Number of advertisement sets reserved for the application.

config BT_SILABS_EFR32_ACCEPT_LIST_SIZE
	int "Accept list size"
	default 1
	help
	  Accept list size.

config BT_SILABS_EFR32_COMPLETED_PACKETS_THRESHOLD
	int "Completed packet reporting threshold"
	default 1
	help
	  The number of transmitted air interface ACL packets to trigger the
	  Number Of Completed Packets HCI event. In most cases, this should be
	  set to 1, because the host stack uses this to determine whether a
	  packet has been sent over the air.

config BT_SILABS_EFR32_COMPLETED_PACKETS_TIMEOUT
	int "Completed packet report event timeout"
	default 3
	help
	  The maximum number of connection events since the previous Number Of
	  Completed Packets HCI event to trigger reporting of any unreported
	  completed ACL packets.

config BT_SILABS_EFR32_LINK_LAYER_STACK_SIZE
	int "Link layer thread stack size"
	default 1024
	help
	  Link layer thread stack size.

config BT_SILABS_EFR32_MAX_QUEUED_ADV_REPORTS
	int "Maximum queued advertising reports"
	default 10
	help
	  Maximum queued advertising reports.
	  Additional advertising reports are dropped.

config BT_SILABS_EFR32_HIGH_POWER
	bool
	help
	  Normally the transmit power is limited to 10 dBm. This option
	  is automatically enabled on devices with high power PA support
	  and allows the controller to transmit at higher power levels.

config BT_SILABS_EFR32_HIGH_POWER_AFH
	bool "Adaptive frequency hopping for high power transmitters"
	depends on BT_SILABS_EFR32_HIGH_POWER
	help
	  When high power is used, the controller may be required to perform
	  adaptive frequency hopping to comply with regulatory requirements.

config BT_SILABS_EFR32_MAX_CS_CONFIGS_PER_CONNECTION
	int "Maximum number of CS configurations per connection"
	default 4
	help
	  Defines the number of Channel Sounding configurations the application
	  needs per Bluetooth connection.

config BT_SILABS_EFR32_MAX_CS_PROCEDURES
	int "Maximum number of CS procedures per CS configuration"
	default 2
	help
	  Defines the number of Channel Sounding procedures the application
	  needs per Channel Sounding configuration.

config BT_SILABS_EFR32_MAX_PAWR_SYNCHRONIZERS
	int "Maximum number of PAWR synchronizers"
	default 1
	depends on BT_PER_ADV_SYNC
	range 1 BT_PER_ADV_SYNC_MAX
	help
	  Define the number of periodic synchronizing instances that the
	  application needs to use concurrently for Periodic Advertising
	  with Responses. This number must not exceed the number of periodic
	  advertising synchronization instances.

config BT_SILABS_EFR32_MAX_PERIODIC_ADVERTISERS
	int "Maximum number of periodic advertisers"
	default 1
	depends on BT_PER_ADV
	range 1 BT_EXT_ADV_MAX_ADV_SET
	help
	  Define the number of periodic advertising instances that the
	  application needs to use concurrently. This number must not exceed
	  the number of total advertisement sets.

if BT_PER_ADV_RSP

config BT_SILABS_EFR32_MAX_PAWR_ADVERTISERS
	int "Maximum numbers of Periodic Advertising With Response advertisers"
	default 0
	range 0 BT_SILABS_EFR32_MAX_PERIODIC_ADVERTISERS

config BT_SILABS_EFR32_MAX_PAWR_ADVERTISED_DATA_LENGTH_HINT
	int "Give a hint to the controller about the maximum PAwR data length"
	default 61
	range 0 251
	help
	  The maximum data length that the application expects to send in a
	  Periodic Advertising with Response packet. The controller will use
	  this hint to optimize the scheduling of concurrent connections.
	  This value does not preclude using longer data lengths.

config BT_SILABS_EFR32_PAWR_PACKET_REQUEST_COUNT
	int "Number of PAwR packets from host per request"
	default 4
	range 1 12
	help
	  The number of packets the controller requests from the host in one LE
	  Periodic Advertising Subevent Data Request event. This is a tradeoff
	  between the controller's memory usage and the number of separate HCI
	  events the controller must send. This value is applied to each PAwR
	  advertiser separately. Note that the request count is limited by the
	  number of subevents in the PAwR train, and the request advance
	  configuration.

config BT_SILABS_EFR32_PAWR_PACKET_REQUEST_ADVANCE
	int "Number of subevents in advance to request PAwR data"
	default 1
	range 1 6
	help
	  The controller asks the host to provide data for upcoming subevents
	  before the subevents are sent over the air. This parameter is used to
	  configure how many subevents in advance the requests are sent to the
	  host. The bigger the advance is, the more time the host has to
	  process the request, but the controller has to reserve more memory
	  for buffering the subevent data. Note that the maximum advance is
	  limited by the number of subevents configured for a PAwR train.
	  Therefore, the actual advance may be less than the number configured
	  in this parameter.

endif # BT_PER_ADV_RSP

if BT_TRANSMIT_POWER_CONTROL

config BT_SILABS_EFR32_ACTIVATE_POWER_CONTROL
	bool "EFR32 LE Power Control"
	default y
	help
	  Enable power control to adjust the transmit power based on the
	  received signal strength. The controller will ask the transmitter
	  to adjust its transmit power to keep the RSSI of the received
	  packets within the golden ranges, specified separately for each PHY.

config BT_SILABS_EFR32_GOLDEN_RSSI_MIN_1M
	int "Lower bound of the golden RSSI range for 1M PHY"
	default -60
	help
	  The lower bound of the golden RSSI range for 1M PHY.

config BT_SILABS_EFR32_GOLDEN_RSSI_MAX_1M
	int "Upper bound of the golden RSSI range for 1M PHY"
	default -40
	help
	  The upper bound of the golden RSSI range for 1M PHY.

config BT_SILABS_EFR32_GOLDEN_RSSI_MIN_2M
	int "Lower bound of the golden RSSI range for 2M PHY"
	default -60
	help
	  The lower bound of the golden RSSI range for 2M PHY.

config BT_SILABS_EFR32_GOLDEN_RSSI_MAX_2M
	int "Upper bound of the golden RSSI range for 2M PHY"
	default -40
	help
	  The upper bound of the golden RSSI range for 2M PHY.

config BT_SILABS_EFR32_GOLDEN_RSSI_MIN_CODED_S8
	int "Lower bound of the golden RSSI range for Coded S=8 PHY"
	default -60
	help
	  The lower bound of the golden RSSI range for Coded S=8 PHY.

config BT_SILABS_EFR32_GOLDEN_RSSI_MAX_CODED_S8
	int "Upper bound of the golden RSSI range for Coded S=8 PHY"
	default -40
	help
	  The upper bound of the golden RSSI range for Coded S=8 PHY.

config BT_SILABS_EFR32_GOLDEN_RSSI_MIN_CODED_S2
	int "Lower bound of the golden RSSI range for Coded S=2 PHY"
	default -60
	help
	  The lower bound of the golden RSSI range for Coded S=2 PHY.

config BT_SILABS_EFR32_GOLDEN_RSSI_MAX_CODED_S2
	int "Upper bound of the golden RSSI range for Coded S=2 PHY"
	default -40
	help
	  The upper bound of the golden RSSI range for Coded S=2 PHY.

endif # BT_TRANSMIT_POWER_CONTROL

config BT_SILABS_EFR32_LL_THREAD_PRIO
	# Hidden option for Co-Operative Link Layer thread priority
	def_int 0

endmenu
```

## drivers/bluetooth/hci/Kconfig.w91
```kconfig
# Copyright (c) 2024 Telink Semiconductor
# SPDX-License-Identifier: Apache-2.0

if BT_W91

config BT_HCI_TX_STACK_SIZE
	int
	default 2048

config BT_RX_STACK_SIZE
	int
	default 2048

if BT_LONG_WQ

config BT_LONG_WQ_STACK_SIZE
	int
	default 2048

endif # BT_LONG_WQ

endif # BT_W91
```

## drivers/bluetooth/nble/Kconfig
```kconfig
# Kconfig - NBLE configuration options

#
# Copyright (c) 2016 Intel Corporation
#
# SPDX-License-Identifier: Apache-2.0
#

config NBLE
	bool "Support for custom non-HCI nRF51 firmware [DEPRECATED]"
	select UART_INTERRUPT_DRIVEN
	select NANO_TIMEOUTS
	select NET_BUF
	depends on SERIAL
	help
	  Note: This feature is deprecated and will be removed in a
	  future Zephyr version.

	  Enables support for using Nordic Semiconductor nRF51 Bluetooth
	  LE chips with a custom firmware. The API for this is a subset of
	  the normal Bluetooth API (include/bluetooth/). This driver can
	  only be enabled if CONFIG_BLUETOOTH has not been enabled.

	  A fundamental assumption that the driver makes is that it is
	  run on an architecture with the same ABI (e.g. struct packing
	  & endianess) as the nRF51 chip. The driver cannot be used on
	  any architecture that doesn't fulfill this requirement.

if NBLE
config BLUETOOTH_PERIPHERAL
	bool
	default y

config BLUETOOTH_CENTRAL
	bool
	default y

config BLUETOOTH_ATT_PREPARE_COUNT
	int "Number of ATT prepare write buffers"
	default 2
	range 0 64
	help
	  Number of buffers available for ATT prepare write, setting
	  this to 0 disables GATT long/reliable writes.

config BLUETOOTH_GATT_CLIENT
	bool
	default y

config BLUETOOTH_SMP
	bool
	default y

config	BLUETOOTH_MAX_CONN
	int
	default 6

config	BLUETOOTH_MAX_PAIRED
	int
	default 7

config BLUETOOTH_RX_STACK_SIZE
	int "Size of the receiving thread stack"
	default 1024
	range 1024 65536
	help
	  Size of the receiving thread stack. This is the context from
	  which all event callbacks to the application occur. The
	  default value is sufficient for basic operation, but if the
	  application needs to do advanced things in its callbacks that
	  require extra stack space, this value can be increased to
	  accomodate for that.

config BLUETOOTH_DEVICE_NAME
	string "Bluetooth device name"
	default "Zephyr"
	help
	  Bluetooth device name. Name can be up to 248 bytes long (excluding
	  NULL termination). Can be empty string.

if BLUETOOTH_DEBUG

config	BLUETOOTH_DEBUG_HCI_DRIVER
	bool "Bluetooth driver debug"
	help
	  This option enables debug support for the chosen
	  Bluetooth UART driver to Nordic chip.

config BLUETOOTH_DEBUG_GATT
	bool "Bluetooth Generic Attribute Profile (GATT) debug"
	help
	  This option enables debug support for the Bluetooth
	  Generic Attribute Profile (GATT).

config NBLE_DEBUG_GAP
	bool "NBLE Generic Access Profile (GAP) debug"
	help
	  This option enables debug support for the Bluetooth
	  Generic Access Profile (GAP) in the interfaces to the
	  Nordic chip.

config NBLE_DEBUG_CONN
	bool "NBLE connection debug"
	help
	  This option enables debug support for Bluetooth
	  connections in the nble driver.

config NBLE_DEBUG_RPC
	bool "NBLE RPC debug"
	help
	  This option enables debug for RPC interface to the Nordic
	  Bluetooth LE chip.

endif # BLUETOOTH_DEBUG

config NBLE_UART_ON_DEV_NAME
	string "Device Name of UART Device for Nordic BLE"
	default "UART_0"
	depends on NBLE
	help
	  This option specifies the name of UART device to be used
	  for Nordic BLE.

endif
```

## drivers/buzzer/Kconfig
```kconfig
# Copyright (c) 2026 Carlo Caione <ccaione@baylibre.com>
# SPDX-License-Identifier: Apache-2.0

menuconfig BUZZER
	bool "Buzzer drivers [EXPERIMENTAL]"
	select EXPERIMENTAL
	help
	  Include buzzer drivers in the system configuration.

if BUZZER

module = BUZZER
module-str = buzzer
source "subsys/logging/Kconfig.template.log_config"

config BUZZER_INIT_PRIORITY
	int "Buzzer initialization priority"
	default 90
	help
	  System initialization priority for buzzer drivers.

rsource "Kconfig.gpio"
rsource "Kconfig.pwm"

endif # BUZZER
```

## drivers/buzzer/Kconfig.gpio
```kconfig
# Copyright (c) 2026 Carlo Caione <ccaione@baylibre.com>
# SPDX-License-Identifier: Apache-2.0

config BUZZER_GPIO
	bool "GPIO-driven active buzzer"
	default y
	depends on DT_HAS_GPIO_BUZZER_ENABLED
	select GPIO
	help
	  Enable the GPIO backend for active buzzers (those with a
	  built-in oscillator). The driver only controls on/off; the
	  buzzer's resonance frequency is fixed by hardware.
```

## drivers/buzzer/Kconfig.pwm
```kconfig
# Copyright (c) 2026 Carlo Caione <ccaione@baylibre.com>
# SPDX-License-Identifier: Apache-2.0

config BUZZER_PWM
	bool "PWM-driven passive piezo buzzer"
	default y
	depends on DT_HAS_PWM_BUZZER_ENABLED
	select PWM
	help
	  Enable the PWM backend for passive piezo buzzers. The PWM
	  channel's period sets the audio frequency and the duty cycle
	  sets the volume.
```

## drivers/cache/Kconfig
```kconfig
# Copyright (c) 2021 Carlo Caione <ccaione@baylibre.com>
# SPDX-License-Identifier: Apache-2.0

menuconfig CACHE
		bool "External cache controller drivers"
		default y if CACHE_MANAGEMENT || CACHE_INIT_ONLY
		help
		  Enable support for external cache controller drivers

if CACHE

config CACHE_HAS_DRIVER
	bool

module = CACHE
module-str = cache
source "subsys/logging/Kconfig.template.log_config"

comment "Device Drivers"

# zephyr-keep-sorted-start
source "drivers/cache/Kconfig.andes"
source "drivers/cache/Kconfig.aspeed"
source "drivers/cache/Kconfig.bflb"
source "drivers/cache/Kconfig.mcux"
source "drivers/cache/Kconfig.nrf"
source "drivers/cache/Kconfig.stm32"
# zephyr-keep-sorted-stop

endif # CACHE

# Init-only cache drivers without enabling generic cache management API
config CACHE_INIT_ONLY
		bool "Initialize SoC cache controller (no management API)"
		help
		  Enable init-only cache drivers without enabling the generic
		  cache management API. This compiles drivers/cache to allow
		  board/SoC specific cache initialization at boot.
```
