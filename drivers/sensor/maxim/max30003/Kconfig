## drivers/spi/Kconfig.ti_unicomm
```kconfig
# Copyright (c) 2026 Texas Instruments Incorporated
# SPDX-License-Identifier: Apache-2.0

config SPI_TI_UNICOMM
	bool "TI Unicomm SPI Driver"
	default y
	depends on DT_HAS_TI_UNICOMM_SPI_ENABLED
	help
	  Enable SPI on TI devices with the Unicomm peripheral.

config SPI_TI_UNICOMM_DMA
	bool "TI Unicomm SPI DMA support"
	depends on SPI_TI_UNICOMM && SPI_ASYNC
	depends on $(dt_compat_any_has_prop,$(DT_COMPAT_TI_UNICOMM_SPI),dmas)
	select DMA
	help
	  Use DMA for asynchronous controller-mode transfers instead of the CPU interrupt
	  handler. This only guards the DMA code, actual DMA depends on whether the instance
	  has the dmas property in its devicetree node. Synchronous and peripheral-mode
	  transfers always use interrupts.
```

## drivers/stepper/adi_tmc/tmc5241/Kconfig.tmc5241
```kconfig
# SPDX-FileCopyrightText: Copyright (c) 2026 Analog Devices, Inc.
# SPDX-License-Identifier: Apache-2.0

config STEPPER_ADI_TMC5241
	bool "TMC5241/TMC2241 stepper driver"
	default y
	depends on DT_HAS_ADI_TMC5241_ENABLED || DT_HAS_ADI_TMC2241_ENABLED
	select GPIO
	select STEPPER_ADI_TMC_SPI if $(dt_compat_on_bus,$(DT_COMPAT_ADI_TMC5241),spi) || \
					$(dt_compat_on_bus,$(DT_COMPAT_ADI_TMC2241),spi)
	select STEPPER_ADI_TMC_UART if $(dt_compat_on_bus,$(DT_COMPAT_ADI_TMC5241),uart) || \
					$(dt_compat_on_bus,$(DT_COMPAT_ADI_TMC2241),uart)
	help
	  Enable support for the ADI/Trinamic TMC5241 (controller and driver)
	  and TMC2241 (driver only) stepper ICs.

if STEPPER_ADI_TMC5241

config STEPPER_ADI_TMC5241_STEPPER_DRIVER
	bool "Activate trinamic tmc5241/tmc2241 stepper driver"
	default y
	depends on DT_HAS_ADI_TMC5241_STEPPER_DRIVER_ENABLED
	help
	  Enable the stepper.h child device (TMC5241 and TMC2241).

config STEPPER_ADI_TMC5241_STEPPER_CTRL
	bool "Activate trinamic tmc5241 motion controller"
	default y
	depends on DT_HAS_ADI_TMC5241_STEPPER_CTRL_ENABLED
	depends on DT_HAS_ADI_TMC5241_STEPPER_DRIVER_ENABLED
	help
	  Enable the stepper_ctrl.h child device (TMC5241 only). Requires the
	  stepper driver child.

module = TMC5241
module-str = tmc5241
source "drivers/stepper/adi_tmc/Kconfig.tmc_rampgen_template"

endif # STEPPER_ADI_TMC5241
```

## drivers/tee/optee/Kconfig
```kconfig
# Copyright (c) 2023 EPAM Systems
# SPDX-License-Identifier: Apache-2.0

config OPTEE
	bool "OP-TEE driver"
	depends on (ARM64 && ARMV8_A_NS && HAS_ARM_SMCCC) || ZTEST
	help
	  This implements support of the OP-TEE firmware which is loaded
	  as BL32 image. OP-TEE is a Trust Zone OS which implements mechanisms
	  of the hardware isolation and rely to ARM TrustZone technology.
	  Driver requests functions from the OP-TEE and implements RPC mechanism
	  needed by OP-TEE to run services. See https://www.op-tee.org for more
	  information.

config OPTEE_MAX_NOTIF
	int "Max number of OP-TEE notifications"
	depends on OPTEE
	default $(UINT8_MAX)
	help
	 Sets the maximum notifications from OP-TEE to the Normal World. OP-TEE using
	 this mechanism for the synchronization.

config OPTEE_SUPPLICANT
	bool "OP-TEE supplicant support"
	depends on OPTEE
	default y
	help
	  Pass requests that OP-TEE makes of the normal world's supplicant, such
	  as loading a TA or accessing the REE file system, to a thread that serves
	  them with tee_suppl_recv() and tee_suppl_send(). A request waits until
	  that thread answers it, so disable this option when no thread does.
	  Without it, such requests fail at once instead of waiting, and
	  tee_suppl_recv() and tee_suppl_send() return -ENOSYS.
```

## drivers/timer/Kconfig.riscv_supervisor
```kconfig
# Copyright (c) 2024 MASSDRIVER EI (massdriver.space)
# Copyright (c) 2018-2023 Intel Corp.
# SPDX-License-Identifier: Apache-2.0

config RISCV_SUPERVISOR_TIMER
	bool "RISCV Supervisor Timer"
	default y
	depends on RISCV_S_MODE
	depends on DT_HAS_RISCV_MACHINE_TIMER_ENABLED || \
		DT_HAS_NUCLEI_SYSTIMER_ENABLED || \
		RISCV_ISA_EXT_SSTC
	select TICKLESS_CAPABLE
	select TIMER_HAS_64BIT_CYCLE_COUNTER
	help
	  This module implements a kernel device driver for the RISC-V supervisor
	  mode timer. It reads time via the "time" CSR and sets timer deadlines
	  in the "stimecmp" CSR if the harts have the Sstc extension, or with
	  the SBI timer extension otherwise. It provides the standard "system
	  clock driver" interfaces.
```

## drivers/timer/Kconfig.wch_systick_ch32v10x
```kconfig
# Copyright (c) 2024 Michael Hope
# SPDX-License-Identifier: Apache-2.0

config WCH_SYSTICK_CH32V10X
	bool "WCH CH32V10x SysTick timer"
	default y
	depends on DT_HAS_WCH_SYSTICK_CH32V10X_ENABLED
	help
	  This module implements the system timer for the CH32V10x QingKe V3A
	  SysTick, a ticking-only driver.
```

## drivers/usb/udc/Kconfig.dwc3
```kconfig
# SPDX-FileCopyrightText: Copyright The Zephyr Project Contributors
# SPDX-License-Identifier: Apache-2.0

config UDC_DWC3
	bool "DWC3 USB device controller driver"
	default y
	depends on DT_HAS_SNPS_DWC3_ENABLED
	select UDC_DRIVER_HAS_HIGH_SPEED_SUPPORT
	select EVENTS
	select CACHE_MANAGEMENT if DCACHE
	select NOCACHE_MEMORY if ARCH_HAS_NOCACHE_MEMORY_SUPPORT
	select CLOCK_CONTROL if $(dt_compat_any_has_prop,$(DT_COMPAT_SNPS_DWC3),clocks)
	select RESET if $(dt_compat_any_has_prop,$(DT_COMPAT_SNPS_DWC3),resets)
	help
	  Synopsys DesignWare Cores SuperSpeed USB 3.x (DWC3) device controller
	  driver.

if UDC_DWC3

config UDC_DWC3_STACK_SIZE
	int "UDC DWC3 driver internal thread stack size"
	default 2048
	help
	  DWC3 driver internal thread stack size.

config UDC_DWC3_THREAD_PRIORITY
	int "UDC DWC3 driver thread priority"
	default 8
	help
	  DWC3 driver thread priority.

config UDC_DWC3_EVENT_BUFFER_SIZE
	int "Size of the event buffer in bytes"
	default 4096
	range 256 65532
	help
	  Size of the buffer the controller writes its 4-byte events to. The
	  driver processes the events from a thread, the buffer has to hold
	  those that arrive in the meantime.

config UDC_DWC3_TRB_NUM
	int "Number of TRBs per non-control endpoint"
	default 32
	range 4 256
	help
	  Size of the TRB ring of each non-control endpoint, including the link
	  TRB. A buffer takes one TRB, or two when it is padded to the packet
	  size or ends with a zero-length packet.

endif # UDC_DWC3
```
