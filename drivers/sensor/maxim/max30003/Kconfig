## drivers/sensor/maxim/max30003/Kconfig
```kconfig
# Copyright (c) 2026 Nainaiu Rakhaine
# SPDX-License-Identifier: Apache-2.0

menuconfig MAX30003
	bool "MAX30003 ECG analog front end"
	default y
	depends on DT_HAS_MAXIM_MAX30003_ENABLED
	select SPI
	select PWM if $(dt_compat_any_has_prop,$(DT_COMPAT_MAXIM_MAX30003),pwms)
	help
	  Driver for the Maxim (ADI) MAX30003.

if MAX30003

choice MAX30003_TRIGGER_MODE
	prompt "Trigger mode"
	default MAX30003_TRIGGER_NONE
	help
	  How the interrupt pin is handled.

config MAX30003_TRIGGER_NONE
	bool "No trigger"

config MAX30003_TRIGGER_GLOBAL_THREAD
	bool "Use global (system work queue) thread"
	depends on GPIO
	select MAX30003_TRIGGER

config MAX30003_TRIGGER_OWN_THREAD
	bool "Use own thread"
	depends on GPIO
	select MAX30003_TRIGGER

endchoice

config MAX30003_TRIGGER
	bool

config MAX30003_THREAD_PRIORITY
	int "Thread priority"
	depends on MAX30003_TRIGGER_OWN_THREAD
	default 10

config MAX30003_THREAD_STACK_SIZE
	int "Thread stack size"
	depends on MAX30003_TRIGGER_OWN_THREAD
	default 1024

endif # MAX30003
```

## drivers/sensor/maxim/max31865/Kconfig
```kconfig
# MAX31865 temperature sensor configuration options

# Copyright (c) 2022 HAW Hamburg FTZ-DIWIP
# SPDX-License-Identifier: Apache-2.0

config MAX31865
	bool "MAX31865 Temperature Sensor"
	default y
	depends on DT_HAS_MAXIM_MAX31865_ENABLED
	select SPI
	help
	  Enable the driver for Maxim MAX31865 SPI Temperature Sensors.

config MAX31865_DRDY
	bool "Wait on the DRDY output"
	default y
	depends on MAX31865
	depends on GPIO
	depends on $(dt_compat_any_has_prop,$(DT_COMPAT_MAXIM_MAX31865),drdy-gpios)
	help
	  Wait for the converter to pull DRDY low once a conversion result is
	  ready, instead of waiting out the conversion time the datasheet gives.
	  Needs drdy-gpios on the node.
```

## drivers/sensor/melexis/mlx90632/Kconfig
```kconfig
# SPDX-FileCopyrightText: Copyright (c) Michele Tavecchio <tavecchiomichele03@gmail.com>
# SPDX-FileCopyrightText: Copyright (c) Alessandro Sola <alessandrosola03@gmail.com>
# SPDX-License-Identifier: Apache-2.0

config MLX90632
	bool "MLX90632 Infrared Temperature Sensor"
	default y
	depends on DT_HAS_MELEXIS_MLX90632_ENABLED
	select I2C
	help
	  Enable driver for MLX90632 infrared temperature sensor.
```

## drivers/sensor/nxp/qdec_nxp_emios/Kconfig
```kconfig
# SPDX-FileCopyrightText: Copyright 2026 NXP
# SPDX-License-Identifier: Apache-2.0

config QDEC_NXP_EMIOS
	bool "NXP eMIOS and LCU quadrature decoder"
	default y
	depends on DT_HAS_NXP_EMIOS_QDEC_ENABLED
	depends on SOC_SERIES_MCXE31X
	depends on CLOCK_CONTROL
	select NXP_LCU
	select MUX
	select PINCTRL
	help
	  Decode quadrature signals with an LCU cell and two eMIOS counters.
	  Each decoder exclusively owns one eMIOS instance. Period interrupts
	  extend the hardware counters. Fetches provide position and revolution counts.
```

## drivers/sensor/sensirion/sgp41/Kconfig
```kconfig
# Copyright (c) 2026 Dotcom IoT LLP
# SPDX-License-Identifier: Apache-2.0

config SGP41
	bool "Sensirion SGP41 VOC / NOx gas sensor"
	depends on DT_HAS_SENSIRION_SGP41_ENABLED
	default y
	select I2C
	select CRC
	select RTIO
	select SENSOR_ASYNC_API
	help
	  Enable driver for the Sensirion SGP41 multi-pixel gas sensor
	  (raw VOC and NOx signals) on I2C.
```

## drivers/sensor/st/lps22hb/Kconfig
```kconfig
# Copyright (c) 2017 Linaro Limited
# SPDX-License-Identifier: Apache-2.0

menuconfig LPS22HB
	bool "LPS22HB and LPS33HW pressure and temperature"
	default y
	depends on DT_HAS_ST_LPS22HB_PRESS_ENABLED || DT_HAS_ST_LPS33HW_ENABLED
	select I2C
	help
	  Enable the driver for the LPS22HB and LPS33HW I2C pressure and
	  temperature sensors. Both parts share the register map and
	  WHO_AM_I value.

config LPS22HB_SAMPLING_RATE
	int "Output data rate"
	default 25
	depends on LPS22HB
	help
	  Sensor output data rate expressed in samples per second.
	  Data rates supported by the chip are 1, 10, 25, 50, 75.
```

## drivers/sensor/st/sths34pf80/Kconfig
```kconfig
# Copyright (c) 2026 Dotcom IoT LLP
# SPDX-License-Identifier: Apache-2.0

config STHS34PF80
	bool "STHS34PF80 infrared presence and motion sensor"
	default y
	depends on DT_HAS_ST_STHS34PF80_ENABLED
	depends on ZEPHYR_HAL_ST_MODULE
	select I2C if $(dt_compat_on_bus,$(DT_COMPAT_ST_STHS34PF80),i2c)
	select I2C_RTIO if $(dt_compat_on_bus,$(DT_COMPAT_ST_STHS34PF80),i2c)
	select SPI if $(dt_compat_on_bus,$(DT_COMPAT_ST_STHS34PF80),spi)
	select SPI_RTIO if $(dt_compat_on_bus,$(DT_COMPAT_ST_STHS34PF80),spi)
	select RTIO
	select HAS_STMEMSC
	select USE_STDC_STHS34PF80
	select SENSOR_ASYNC_API
	select GPIO if $(dt_compat_any_has_prop,$(DT_COMPAT_ST_STHS34PF80),int-gpios)
	help
	  Enable the ST STHS34PF80 infrared presence and motion
	  detection sensor driver (uses the Sensor Read & Decode API).

if STHS34PF80

config STHS34PF80_TRIGGER
	bool "Data-ready trigger"
	default y
	depends on GPIO
	depends on $(dt_compat_any_has_prop,$(DT_COMPAT_ST_STHS34PF80),int-gpios)
	help
	  Enable the SENSOR_TRIG_DATA_READY trigger. The INT/DRDY pin
	  interrupt is handled in the system work queue.

endif # STHS34PF80
```

## drivers/sensor/st/vl53l4cd/Kconfig
```kconfig
# Copyright (c) 2026 Dotcom IoT LLP
# SPDX-License-Identifier: Apache-2.0

config VL53L4CD
	bool "VL53L4CD time-of-flight distance sensor"
	default y
	depends on DT_HAS_ST_VL53L4CD_ENABLED
	depends on SENSOR_ASYNC_API
	select I2C
	select I2C_RTIO if SENSOR_ASYNC_API
	select RTIO_WORKQ
	select GPIO if $(dt_compat_any_has_prop,$(DT_COMPAT_ST_VL53L4CD),xshut-gpios)
	help
	  Enable the driver for the ST VL53L4CD time-of-flight distance sensor.
	  The driver implements the Read and Decode API (sensor_read() and
	  sensor_get_decoder()) along with timing configuration attributes.
```

## drivers/sensor/tdk/itg3200/Kconfig
```kconfig
# Copyright (c) 2026 NBuiLe
# SPDX-License-Identifier: Apache-2.0

config ITG3200
	bool "InvenSense ITG3200 gyro and temperature sensor"
	default y
	depends on DT_HAS_INVENSENSE_ITG3200_ENABLED
	depends on SENSOR
	select I2C
	help
	  Enable driver for the InvenSense ITG3200 gyro and temperature sensor.
```

## drivers/sensor/ti/drv505x/Kconfig
```kconfig
# SPDX-FileCopyrightText: Copyright RAKwireless Technology Limited
# SPDX-License-Identifier: Apache-2.0

config DRV505X
	bool "TI DRV505x Hall-effect sensors"
	default y
	depends on DT_HAS_TI_DRV505X_ENABLED
	select ADC
	help
	  Enable the driver for the Texas Instruments DRV5053, DRV5055 and
	  DRV5056 Hall-effect sensors read through an ADC.
```

## drivers/sensor/ti/mspm0_temp/Kconfig
```kconfig
# SPDX-FileCopyrightText: Copyright The Zephyr Project Contributors
# SPDX-License-Identifier: Apache-2.0

config MSPM0_TEMP
	bool "TI MSPM0 die temperature sensor"
	default y
	depends on DT_HAS_TI_MSPM0_TEMP_ENABLED
	select ADC
	help
	  Enable the driver for the internal die temperature sensor of TI MSPM0
	  devices, read through the ADC and converted with the factory trim.
```

## drivers/sensor/winsen/Kconfig
```kconfig
# SPDX-FileCopyrightText: Copyright RAKwireless Technology Limited
# SPDX-License-Identifier: Apache-2.0

# zephyr-keep-sorted-start
source "drivers/sensor/winsen/mq/Kconfig"
# zephyr-keep-sorted-stop
```

## drivers/sensor/winsen/mq/Kconfig
```kconfig
# SPDX-FileCopyrightText: Copyright RAKwireless Technology Limited
# SPDX-License-Identifier: Apache-2.0

config MQ
	bool "Winsen MQ series gas sensors"
	default y
	depends on DT_HAS_WINSEN_MQ_ENABLED
	select ADC
	select REQUIRES_FULL_LIBC
	help
	  Enable the driver for the Winsen MQ series of heated resistive gas
	  sensors read through an ADC, such as the MQ-2 and the MQ-3B.
```

## drivers/serial/Kconfig.rpi_pico
```kconfig
# Copyright (c) 2021 Yonatan Schachter
# SPDX-License-Identifier: Apache-2.0

config UART_RPI_PICO_PIO
	bool "Raspberry Pi PIO UART driver"
	default y
	depends on DT_HAS_RASPBERRYPI_PICO_UART_PIO_ENABLED
	depends on PIO_RPI_PICO
	select SERIAL_HAS_DRIVER
	select SERIAL_SUPPORT_INTERRUPT
	select PICOSDK_USE_PIO
	select PICOSDK_USE_CLAIM
	select PINCTRL
	select SERIAL_HAS_POST_KERNEL_INIT
	select DMA if UART_INTERRUPT_DRIVEN
	select DMA_RPI_PICO if UART_INTERRUPT_DRIVEN
	depends on RESET

if UART_RPI_PICO_PIO && UART_INTERRUPT_DRIVEN

config UART_RPI_PICO_PIO_POLL_PERIOD_US
	int "Poll period, in microseconds, of the PIO UART interrupt emulation"
	default 500
	help
	  RX is captured by a self-reloading DMA ring buffer. While RX or TX
	  interrupts are enabled, a periodic k_timer per instance invokes the
	  registered uart_irq_callback in ISR context at this period.
	  TX is refilled only from the callback, so throughput is limited to
	  the 8-byte TX FIFO per period: 16 KB/s at the default, enough for
	  115200 baud. Shorten the period for higher baudrates, at the cost of
	  more timer interrupts while the UART is active.

config UART_RPI_PICO_PIO_RX_RING_BUF_SIZE
	int "Size, in bytes, of the RX DMA ring buffer"
	default 256
	range 2 32768
	help
	  Must be a power of two, as required by the DMA address wrapping.
	  Bounds how far the callback can fall behind before RX bytes
	  are lost. Size it for the longest expected stall at the configured
	  baudrate.

endif # UART_RPI_PICO_PIO && UART_INTERRUPT_DRIVEN
```

## drivers/serial/Kconfig.rpmsg
```kconfig
# Copyright (c) 2025 Ayush Singh, BeagleBoard.org
# SPDX-License-Identifier: Apache-2.0

config UART_RPMSG
	bool "Use RPMSG uart"
	depends on RPMSG_SERVICE
	depends on DT_HAS_RPMSG_UART_ENABLED
	select SERIAL_HAS_POST_KERNEL_INIT
	select SERIAL_SUPPORT_INTERRUPT
	help
	  Enable a UART that carries characters over RPMsg instead of a
	  hardware serial port.

	  Typical use is a Zephyr image running on a remote processor that
	  Linux started with remoteproc. Polling always works. Turn on
	  UART_INTERRUPT_DRIVEN as well if you need clients such as the
	  serial shell, which expect the usual interrupt-driven UART API.

if UART_RPMSG

config UART_RPMSG_RX_BUF_SIZE
	int "Size of internal rx buffer"
	default 64
	help
	  How many received bytes the driver can hold before it has to drop
	  data. Raise this if bursts from the host overflow the default.

config UART_RPMSG_TX_BUF_SIZE
	int "Size of internal tx buffer"
	default 64
	depends on UART_INTERRUPT_DRIVEN
	help
	  How many bytes uart_fifo_fill() can queue for later send. Larger
	  values absorb short bursts from the shell or other UART clients.
	  Soft IRQ handling and TX drain both run on the system workqueue.

config UART_RPMSG_TX_CHUNK_SIZE
	int "Max bytes per RPMsg TX send"
	default 32
	range 1 496
	depends on UART_INTERRUPT_DRIVEN
	help
	  Largest block taken from the TX queue and sent in one RPMsg
	  message. Bigger chunks mean fewer messages across the link. Keep
	  the value within the payload the other side accepts (commonly the
	  RPMsg buffer size minus the 16-byte header).

endif # UART_RPMSG
```

## drivers/spi/Kconfig.mchp
```kconfig
# Copyright (c) 2026 Microchip Technology Inc.
# SPDX-License-Identifier: Apache-2.0

config SPI_MCHP_FLEXCOM_G1
	bool "Microchip FLEXCOM SPI driver"
	default y
	depends on DT_HAS_MICROCHIP_FLEXCOM_G1_SPI_ENABLED
	select PINCTRL
	select GPIO
	help
	  Enable support for the Microchip FLEXCOM SPI driver.

config SPI_MCHP_FLEXCOM_DMA_DRIVEN
	bool "Microchip FLEXCOM SPI DMA Mode"
	default y
	depends on SPI_MCHP_FLEXCOM_G1
	depends on $(dt_compat_all_has_prop,$(DT_COMPAT_MICROCHIP_FLEXCOM_G1_SPI),dmas)
	select DMA
	help
	  This enables DMA driven transfers for the SPI peripheral.
	  Requires DMA controller and dmas property in device tree.

config SPI_MCHP_QSPI_G1
	bool "Microchip G1 QSPI controller in SPI mode"
	default y
	depends on DT_HAS_MICROCHIP_QSPI_G1_SPI_ENABLED
	select PINCTRL
	help
	  Use the G1 QSPI controller (PIC32CX SG, SAM D5x/E5x) as a single-line
	  SPI controller, for example for a serial NOR flash through the
	  jedec,spi-nor driver.

config SPI_MCHP_QSPI_G1_DMA
	bool "DMA transfers for the Microchip G1 QSPI controller"
	default y
	depends on SPI_MCHP_QSPI_G1
	depends on $(dt_compat_any_has_prop,$(DT_COMPAT_MICROCHIP_QSPI_G1_SPI),dmas)
	select DMA
	help
	  Use two DMAC channels, given by the dmas property, for transfers of
	  at least SPI_MCHP_QSPI_G1_DMA_THRESHOLD bytes. Instances without
	  dmas, and shorter transfers, stay polled.

config SPI_MCHP_QSPI_G1_DMA_THRESHOLD
	int "Minimum chunk length for a DMA transfer"
	default 32
	range 1 65535
	depends on SPI_MCHP_QSPI_G1_DMA
	help
	  Chunks shorter than this, such as flash commands and addresses, are
	  shifted by the CPU: setting up two DMA channels costs more than it
	  saves on a few bytes.

config SPI_MCHP_SERCOM
	bool
	help
	  Common options for Microchip SPI SERCOM drivers.

config SPI_MCHP_SERCOM_G1
	bool
	default y
	depends on DT_HAS_MICROCHIP_SERCOM_G1_SPI_ENABLED
	select PINCTRL
	select GPIO
	select SPI_MCHP_SERCOM
	help
	  Enable support for the Microchip SERCOM SPI driver.

if SPI_MCHP_SERCOM

config SPI_MCHP_INTER_CHARACTER_SPACE
	int "Microchip SERCOM SPI Inter-Character Spacing (in clock cycles)"
	default 63 if SPI_PERIPHERAL
	default 0
	range 0 63
	depends on SOC_FAMILY_MICROCHIP_SAM_D5X_E5X || SOC_FAMILY_MICROCHIP_PIC32CZ_CA
	help
	  Number of clock cycles to delay between characters on SPI bus.

config SPI_MCHP_DMA_DRIVEN
	bool "Microchip SPI DMA Mode"
	default y
	depends on DMA
	depends on $(dt_compat_all_has_prop,$(DT_COMPAT_MICROCHIP_SERCOM_G1_SPI),dmas)
	help
	  This enables DMA driven transfers for the SPI peripheral.
	  Requires DMA controller and dmas property in device tree.

endif # SPI_MCHP_SERCOM
```

## drivers/spi/Kconfig.sam_qspi
```kconfig
# SPDX-FileCopyrightText: Copyright The Zephyr Project Contributors
# SPDX-License-Identifier: Apache-2.0

config SPI_SAM_QSPI
	bool "Atmel SAM QSPI controller in SPI mode"
	default y
	depends on DT_HAS_ATMEL_SAM_QSPI_ENABLED
	select PINCTRL
	help
	  Use the QSPI controller of the SAM E70/S70/V70/V71 and PIC32CZ CA70/MC70
	  as a single-line SPI controller, for example for a serial NOR flash
	  through the jedec,spi-nor driver.

config SPI_SAM_QSPI_DMA
	bool "DMA transfers for the Atmel SAM QSPI controller"
	default y
	depends on SPI_SAM_QSPI
	depends on $(dt_compat_any_has_prop,$(DT_COMPAT_ATMEL_SAM_QSPI),dmas)
	select DMA
	help
	  Use two XDMAC channels, given by the dmas property, for transfers of
	  at least SPI_SAM_QSPI_DMA_THRESHOLD bytes. Instances without dmas,
	  and shorter transfers, stay polled. With the data cache enabled, only
	  the whole cache lines of a receive buffer go through DMA.

config SPI_SAM_QSPI_DMA_THRESHOLD
	int "Minimum chunk length for a DMA transfer"
	default 32
	range 1 $(UINT16_MAX)
	depends on SPI_SAM_QSPI_DMA
	help
	  Chunks shorter than this, such as flash commands and addresses, are
	  shifted by the CPU: setting up two DMA channels costs more than it
	  saves on a few bytes.
```

## drivers/spi/Kconfig.sc18is60x
```kconfig
# Copyright (c) 2026 Alif Semiconductor
# SPDX-License-Identifier: Apache-2.0

config SPI_SC18IS60X
	bool "NXP SC18IS602/SC18IS606 SPI controller driver"
	default y
	select MFD
	depends on DT_HAS_NXP_SC18IS60X_SPI_ENABLED
	help
	  Enable the SPI controller child of an NXP SC18IS60x I2C-to-SPI
	  bridge (SC18IS602/SC18IS602B or SC18IS606).

if SPI_SC18IS60X

config SPI_SC18IS60X_INIT_PRIORITY
	int "SC18IS60x SPI init priority"
	default MFD_INIT_PRIORITY
	help
	  SC18IS60x SPI controller init priority.

	  The controller and the MFD parent both use POST_KERNEL. The same
	  priority as MFD_INIT_PRIORITY is enough, because the parent is
	  initialized first. A higher value delays devices on this controller.

endif
```
