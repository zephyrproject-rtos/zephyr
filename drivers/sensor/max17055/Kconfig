## drivers/sensor/max17055/Kconfig
```kconfig
# Copyright 2020 Google LLC
#
# SPDX-License-Identifier: Apache-2.0

config MAX17055
	bool "MAX17055 Fuel Gauge"
	default y
	depends on DT_HAS_MAXIM_MAX17055_ENABLED
	select I2C
	help
	  Enable I2C-based driver for MAX17055 Fuel Gauge. This driver supports
	  reading various sensor settings including charge level percentage,
	  time to full/empty, design voltage, temperature and remaining
	  capacity in mA.
```

## drivers/sensor/max1726x/Kconfig
```kconfig
# Copyright 2020 Matija Tudan
#
# SPDX-License-Identifier: Apache-2.0

config MAX1726X
	bool "MAX1726X Fuel Gauge"
	depends on I2C
	help
	  Enable I2C-based driver for MAX1726X Fuel Gauge. This driver supports
	  reading various sensor settings including voltage, current, temperature,
	  time to full/empty and remaining capacity in mAh.
```

## drivers/sensor/max22190/Kconfig
```kconfig
# Copyright (c) 2010-2024 Analog Devices Inc.
# Copyright (c) 2024 BayLibre SAS
# SPDX-License-Identifier: Apache-2.0

config MAX22190
	bool "MAX22190 Octal industrial digital input"
	default y
	depends on DT_HAS_ADI_MAX22190_ENABLED
	select SPI
	help
	  Enabe MAX22190 Octal industrial digital
	  input with diagnostics
```

## drivers/sensor/max30101/Kconfig
```kconfig
# MAX30101 heart rate sensor

# Copyright (c) 2017, NXP
# SPDX-License-Identifier: Apache-2.0

menuconfig MAX30101
	bool "MAX30101 Pulse Oximeter and Heart Rate Sensor"
	default y
	depends on DT_HAS_MAXIM_MAX30101_ENABLED
	depends on I2C

if MAX30101

config MAX30101_SMP_AVE
	int "Sample averaging"
	range 0 7
	default 0
	help
	  To reduce the amount of data throughput, adjacent samples (in each
	  individual channel) can be averaged and decimated on the chip by
	  setting this register. Set to 0 for no averaging.
	  0 = 1 sample (no averaging)
	  1 = 2 samples
	  2 = 4 samples
	  3 = 8 samples
	  4 = 16 samples
	  5 = 32 samples
	  6 = 32 samples
	  7 = 32 samples

config MAX30101_FIFO_ROLLOVER_EN
	bool "FIFO rolls on full"
	help
	  Controls the behavior of the FIFO when the FIFO becomes completely
	  filled with data. If set, the FIFO address rolls over to zero and the
	  FIFO continues to fill with new data. If not set, then the FIFO is
	  not updated until FIFO_DATA is read or the WRITE/READ pointer
	  positions are changed.

config MAX30101_FIFO_A_FULL
	int "FIFO almost full value"
	range 0 15
	default 0
	help
	  Set the trigger for the FIFO_A_FULL interrupt

choice MAX30101_MODE
	prompt "Mode control"
	default MAX30101_MULTI_LED_MODE

config MAX30101_HEART_RATE_MODE
	bool "Heart rate mode"
	help
	  Set to operate in heart rate only mode. The red LED channel is
	  active.

config MAX30101_SPO2_MODE
	bool "SpO2 mode"
	help
	  Set to operate in SpO2 mode. The red and IR LED channels are active.

config MAX30101_MULTI_LED_MODE
	bool "Multi-LED mode"
	help
	  Set to operate in multi-LED mode. The green, red, and/or IR LED
	  channels are active.

endchoice

config MAX30101_ADC_RGE
	int "ADC range control"
	range 0 3
	default 2
	help
	  Set the ADC's full-scale range.
	  0 = 7.81 pA/LSB
	  1 = 15.63 pA/LSB
	  2 = 31.25 pA/LSB
	  3 = 62.5 pA/LSB

config MAX30101_SR
	int "ADC sample rate control"
	range 0 7
	default 0
	help
	  Set the effective sampling rate with one sample consisting of one
	  pulse/conversion per active LED channel. In SpO2 mode, these means
	  one IR pulse/conversion and one red pulse/conversion per sample
	  period.
	  0 = 50 Hz
	  1 = 100 Hz
	  2 = 200 Hz
	  3 = 400 Hz
	  4 = 800 Hz
	  5 = 1000 Hz
	  6 = 1600 Hz
	  7 = 3200 Hz

config MAX30101_LED1_PA
	hex "LED1 (red) pulse amplitude"
	range 0 0xff
	default 0xff
	help
	  Set the pulse amplitude to control the LED1 (red) current. The actual
	  measured LED current for each part can vary significantly due to the
	  trimming methodology.
	  0x00 = 0.0 mA
	  0x01 = 0.2 mA
	  0x02 = 0.4 mA
	  0x0f = 3.1 mA
	  0xff = 50.0 mA

config MAX30101_LED2_PA
	hex "LED2 (IR) pulse amplitude"
	range 0 0xff
	default 0x33
	help
	  Set the pulse amplitude to control the LED2 (IR) current. The actual
	  measured LED current for each part can vary significantly due to the
	  trimming methodology.
	  0x00 = 0.0 mA
	  0x01 = 0.2 mA
	  0x02 = 0.4 mA
	  0x0f = 3.1 mA
	  0xff = 50.0 mA

config MAX30101_LED3_PA
	hex "LED2 (green) pulse amplitude"
	range 0 0xff
	default 0xff
	help
	  Set the pulse amplitude to control the LED3 (green) current. The
	  actual measured LED current for each part can vary significantly due
	  to the trimming methodology.
	  0x00 = 0.0 mA
	  0x01 = 0.2 mA
	  0x02 = 0.4 mA
	  0x0f = 3.1 mA
	  0xff = 50.0 mA

if MAX30101_MULTI_LED_MODE

config MAX30101_SLOT1
	int "Slot 1"
	range 0 7
	default 3
	help
	  Set which LED and pulse amplitude are active in time slot 1.
	  0: None (disabled)
	  1: LED1 (red), LED1_PA
	  2: LED2 (IR), LED2_PA
	  3: LED3 (green), LED3_PA
	  4: None (disabled)
	  5: LED1 (red), PILOT_PA
	  6: LED2 (IR), PILOT_PA
	  7: LED3 (green), PILOT_PA

config MAX30101_SLOT2
	int "Slot 2"
	range 0 7
	default 0
	help
	  Set which LED and pulse amplitude are active in time slot 2.
	  0: None (disabled)
	  1: LED1 (red), LED1_PA
	  2: LED2 (IR), LED2_PA
	  3: LED3 (green), LED3_PA
	  4: None (disabled)
	  5: LED1 (red), PILOT_PA
	  6: LED2 (IR), PILOT_PA
	  7: LED3 (green), PILOT_PA

config MAX30101_SLOT3
	int "Slot 3"
	range 0 7
	default 0
	help
	  Set which LED and pulse amplitude are active in time slot 3.
	  0: None (disabled)
	  1: LED1 (red), LED1_PA
	  2: LED2 (IR), LED2_PA
	  3: LED3 (green), LED3_PA
	  4: None (disabled)
	  5: LED1 (red), PILOT_PA
	  6: LED2 (IR), PILOT_PA
	  7: LED3 (green), PILOT_PA

config MAX30101_SLOT4
	int "Slot 4"
	range 0 7
	default 0
	help
	  Set which LED and pulse amplitude are active in time slot 4.
	  0: None (disabled)
	  1: LED1 (red), LED1_PA
	  2: LED2 (IR), LED2_PA
	  3: LED3 (green), LED3_PA
	  4: None (disabled)
	  5: LED1 (red), PILOT_PA
	  6: LED2 (IR), PILOT_PA
	  7: LED3 (green), PILOT_PA

endif # MAX30101_MULTI_LED_MODE

endif # MAX30101
```

## drivers/sensor/max30208/Kconfig
```kconfig
# MAX30208 digital temperature sensor

# Copyright (c) 2021, Silvano Cortesi
# Copyright (c) 2021, ETH Zürich
# SPDX-License-Identifier: Apache-2.0

menuconfig MAX30208
	bool "MAX30208 Digital Temperature Sensor"
	depends on I2C
	select RING_BUFFER

if MAX30208

config MAX30208_RINGBUFFER_SIZE
	int "Ring Buffer size"
	default 1
	help
	  Ring Buffer size for storage of elements from the FIFO in number of values.
	  Each value will occupy 16-bit.

config MAX30208_TRIGGER
	bool

choice MAX30208_TRIGGER_MODE
	prompt "Trigger mode"
	default MAX30208_TRIGGER_NONE
	help
	  Specify the type of triggering used by the driver.

config MAX30208_TRIGGER_NONE
	bool "No trigger"

config MAX30208_TRIGGER_GLOBAL_THREAD
	bool "Use global thread"
	depends on GPIO
	select MAX30208_TRIGGER

config MAX30208_TRIGGER_OWN_THREAD
	bool "Use own thread"
	depends on GPIO
	select MAX30208_TRIGGER

endchoice # MAX30208_TRIGGER_MODE

config MAX30208_THREAD_PRIORITY
	int "Thread priority"
	depends on MAX30208_TRIGGER_OWN_THREAD && MAX30208_TRIGGER
	default 10
	help
	  Priority of thread used by the driver to handle interrupts.

config MAX30208_THREAD_STACK_SIZE
	int "Thread stack size"
	depends on MAX30208_TRIGGER_OWN_THREAD && MAX30208_TRIGGER
	default 1024
	help
	  Stack size of thread used by the driver to handle interrupts.

endif # MAX30208
```

## drivers/sensor/max31855/Kconfig
```kconfig
# MAX31855 cold-junction compensated thermocpuple-to-digital converter configuration options

# Copyright (c) 2020 Christian Hirsch
# SPDX-License-Identifier: Apache-2.0

config MAX31855
	bool "MAX31855 sensor"
	depends on SPI
	help
	  Enable driver for MAX31855 SPI-based Cold-Junction Compensated Thermocouple-to-Digital Converter.
```

## drivers/sensor/max31865/Kconfig
```kconfig
# MAX31865 temperature sensor configuration options

# Copyright (c) 2022 HAW Hamburg FTZ-DIWIP
# SPDX-License-Identifier: Apache-2.0

config MAX31865
	bool "MAX31865 Temperature Sensor"
	default y
	depends on DT_HAS_MAXIM_MAX31865_ENABLED
	select SPI
	help
	  Enable the driver for Maxim MAX31865 SPI Temperature Sensors.
```

## drivers/sensor/max44009/Kconfig
```kconfig
# MAX44009 light sensor configuration options

# Copyright (c) 2016 Intel Corporation
# SPDX-License-Identifier: Apache-2.0

config MAX44009
	bool "MAX44009 Light Sensor"
	default y
	depends on DT_HAS_MAXIM_MAX44009_ENABLED
	depends on I2C
	help
	  Enable driver for MAX44009 light sensors.
```

## drivers/sensor/max6675/Kconfig
```kconfig
# Copyright (c) 2021 Teslabs Engineering S.L.
# SPDX-License-Identifier: Apache-2.0

config MAX6675
	bool "MAX6675 K-thermocouple to digital converter"
	depends on SPI
	help
	  Enable MAX6675 cold-junction-compensated K-thermocouple to digital
	  converter.
```

## drivers/sensor/maxim/Kconfig
```kconfig
# Copyright (c) 2024 Analog Devices, Inc.
# SPDX-License-Identifier: Apache-2.0

# zephyr-keep-sorted-start
source "drivers/sensor/maxim/ds18b20/Kconfig"
source "drivers/sensor/maxim/ds3231/Kconfig"
source "drivers/sensor/maxim/max17055/Kconfig"
source "drivers/sensor/maxim/max17262/Kconfig"
source "drivers/sensor/maxim/max30101/Kconfig"
source "drivers/sensor/maxim/max31790/Kconfig"
source "drivers/sensor/maxim/max31855/Kconfig"
source "drivers/sensor/maxim/max31865/Kconfig"
source "drivers/sensor/maxim/max31875/Kconfig"
source "drivers/sensor/maxim/max44009/Kconfig"
source "drivers/sensor/maxim/max6675/Kconfig"
# zephyr-keep-sorted-stop
```

## drivers/sensor/maxim/ds3231/Kconfig
```kconfig
# DS3231 temperature sensor configuration options

# Copyright (c) 2024 Gergo Vari <work@gergovari.com>
# SPDX-License-Identifier: Apache-2.0

config SENSOR_DS3231
	bool "DS3231 sensor"
	default y
	depends on DT_HAS_MAXIM_DS3231_MFD_ENABLED
	depends on DT_HAS_MAXIM_DS3231_SENSOR_ENABLED
	select I2C
	select MFD
	select RTIO_WORKQ if SENSOR_ASYNC_API
	help
	  Enable driver for DS3231 I2C-based temperature sensor.

config SENSOR_DS3231_INIT_PRIORITY
	int "DS3231 sensor driver init priority"
	default 86
	help
	Init priority for the DS3231 sensor driver. It must be
	greater than MFD_INIT_PRIORITY.
```

## drivers/sensor/maxim/max17262/Kconfig
```kconfig
# Copyright 2020 Matija Tudan
#
# SPDX-License-Identifier: Apache-2.0

config MAX17262
	bool "MAX17262 Fuel Gauge"
	default y
	depends on DT_HAS_MAXIM_MAX17262_ENABLED
	select I2C
	help
	  Enable I2C-based driver for MAX17262 Fuel Gauge. This driver supports
	  reading various sensor settings including voltage, current, temperature,
	  time to full/empty and remaining capacity in mAh.
```

## drivers/sensor/maxim/max30101/Kconfig
```kconfig
# MAX30101 heart rate sensor
#
# Copyright (c) 2017, NXP
# Copyright (c) 2025, CATIE
#
# SPDX-License-Identifier: Apache-2.0

menuconfig MAX30101
	bool "MAX30101 Pulse Oximeter and Heart Rate Sensor"
	default y
	depends on DT_HAS_MAXIM_MAX30101_ENABLED
	select I2C if $(dt_compat_on_bus,$(DT_COMPAT_MAXIM_MAX30101),i2c)

if MAX30101

config MAX30101_DIE_TEMPERATURE
	bool "Die temperature acquisition"

choice MAX30101_TRIGGER_MODE
	prompt "Trigger mode"
	default MAX30101_TRIGGER_NONE
	help
	  Specify the type of triggering to be used by the driver.

config MAX30101_TRIGGER_NONE
	bool "No trigger"

config MAX30101_TRIGGER_GLOBAL_THREAD
	bool "Use global thread"
	depends on GPIO
	depends on $(dt_compat_any_has_prop,$(DT_COMPAT_MAXIM_MAX30101),irq-gpios)
	select MAX30101_TRIGGER

config MAX30101_TRIGGER_OWN_THREAD
	bool "Use own thread"
	depends on GPIO
	depends on $(dt_compat_any_has_prop,$(DT_COMPAT_MAXIM_MAX30101),irq-gpios)
	select MAX30101_TRIGGER

endchoice

config MAX30101_TRIGGER
	bool

if MAX30101_TRIGGER

config MAX30101_THREAD_PRIORITY
	int "Thread priority"
	depends on MAX30101_TRIGGER_OWN_THREAD
	default 10
	help
	  Priority of thread used by the driver to handle interrupts.

config MAX30101_THREAD_SIZE
	int "Thread stack size"
	depends on MAX30101_TRIGGER_OWN_THREAD
	default 2048
	help
	  Stack size of thread used by the driver to handle interrupts.

endif # MAX30101_TRIGGER

endif # MAX30101
```

## drivers/sensor/maxim/max31790/Kconfig
```kconfig
# Copyright (c) 2024 SILA Embedded Solutions GmbH
# SPDX-License-Identifier: Apache-2.0

config MAX31790_SENSOR
	bool "MAX31790 sensors"
	default y
	depends on MAX31790_FAN_SPEED || MAX31790_FAN_FAULT
	help
	  Enable sensors for the MAX31790 PWM controller.

config MAX31790_FAN_SPEED
	bool "MAX31790 fan speed sensor"
	default y
	depends on DT_HAS_MAXIM_MAX31790_FAN_SPEED_ENABLED
	select MFD
	help
	  Enable driver for the MAX31790 fan speed sensor.

config MAX31790_FAN_FAULT
	bool "MAX31790 fan fault sensor"
	default y
	depends on DT_HAS_MAXIM_MAX31790_FAN_FAULT_ENABLED
	select MFD
	help
	  Enable driver for the MAX31790 fan fault sensor.
```

## drivers/sensor/maxim/max31826/Kconfig
```kconfig
# MAX31826 1-Wire temperature sensor configuration options

# Copyright (c) 2022 Thomas Stranger
# Copyright (c) 2026 Foss Analytical A/S
# SPDX-License-Identifier: Apache-2.0

config MAX31826
	bool "MAX31826 1-Wire Temperature Sensor"
	default y
	depends on DT_HAS_MAXIM_MAX31826_ENABLED
	depends on W1_NET
	help
	  Enable driver for the MAX31826 1-Wire temperature sensor.
```

## drivers/sensor/maxim/max31855/Kconfig
```kconfig
# MAX31855 cold-junction compensated thermocouple-to-digital converter configuration options

# Copyright (c) 2020 Christian Hirsch
# SPDX-License-Identifier: Apache-2.0

config MAX31855
	bool "MAX31855 sensor"
	default y
	depends on DT_HAS_MAXIM_MAX31855_ENABLED
	select SPI
	help
	  Enable driver for MAX31855 SPI-based Cold-Junction Compensated thermocouple-to-Digital Converter.
```

## drivers/sensor/maxim/max31875/Kconfig
```kconfig
# MAX31875 temperature sensor configuration options

# Copyright (c) 2021 Pete Dietl
# SPDX-License-Identifier: Apache-2.0

config MAX31875
	bool "MAX31875 Temperature Sensor"
	default y
	depends on DT_HAS_MAXIM_MAX31875_ENABLED
	select I2C
	help
	  Enable the driver for Maxim MAX31875 Low-Power I2C Temperature Sensors.
```

## drivers/sensor/maxim/max6675/Kconfig
```kconfig
# Copyright (c) 2021 Teslabs Engineering S.L.
# SPDX-License-Identifier: Apache-2.0

config MAX6675
	bool "MAX6675 K-thermocouple to digital converter"
	default y
	depends on DT_HAS_MAXIM_MAX6675_ENABLED
	select SPI
	help
	  Enable MAX6675 cold-junction-compensated K-thermocouple to digital
	  converter.
```

## drivers/sensor/mb7040/Kconfig
```kconfig
#MB7040 ultrasonic sensor config

#Copyright 2025 Sabrina Simkhovich <sabrinasimkhovich @gmail.com>
#SPDX-License-Identifier: Apache-2.0

config MB7040
	bool "MB7040 ultrasonic distance sensor"
	default y
	depends on DT_HAS_MAXBOTIX_MB7040_ENABLED
	select I2C
	help
	  Enable driver for MB7040 distance sensor.

config MB7040_DELAY_MS
	int "Delay in milliseconds to wait for distance measurements"
	default 100
	depends on MB7040
	help
	  Timeout for sample fetch.
```
