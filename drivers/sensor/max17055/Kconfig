## drivers/sensor/mc3419/Kconfig
```kconfig
# SPDX-License-Identifier: Apache-2.0
#
# Copyright (c) 2023 Linumiz

menuconfig MC3419
	bool "MC3419 acclerometer driver"
	default y
	depends on DT_HAS_MEMSIC_MC3419_ENABLED
	select I2C if $(dt_compat_on_bus,$(DT_COMPAT_MEMSIC_MC3419),i2c)
	help
	 Enable driver for MC3419 acclerometer.

if MC3419

config MC3419_TRIGGER
	bool "Trigger mode"

if MC3419_TRIGGER

config MC3419_TRIGGER_OWN_THREAD
	bool "Use own thread"
	help
	 Enable trigger to run in own thread. By
	 default it is global thread mode.

config MC3419_THREAD_PRIORITY
	int "Own thread priority"
	depends on MC3419_TRIGGER_OWN_THREAD
	default 10

config MC3419_THREAD_STACK_SIZE
	int "Own thread stask size"
	depends on MC3419_TRIGGER_OWN_THREAD
	default 1024

endif # MC3419_TRIGGER

config MC3419_DECIMATION_RATE
	int "Enable decimation rate"
	range 0 15
	default 15
	help
	 This helps in producing slower interrupt. Internal Data
	 Rate is divide by this decimation rate. If decimation rate
	 is 0 then internal data rate is equal to output data rate,
	 then it produce interrupt floods.

endif # MC3419
```

## drivers/sensor/mchp_tach_xec/Kconfig
```kconfig
# Microchip mec15xx tachometer sensor configuration options

# Copyright (c) 2020 Intel Corporation
# SPDX-License-Identifier: Apache-2.0

config TACH_XEC
	bool "XEC Tachometer sensor"
	default y
	depends on DT_HAS_MICROCHIP_XEC_TACH_ENABLED
	depends on SOC_FAMILY_MEC
	help
	  Enable the Microchip XEC tachometer sensor.

if TACH_XEC

choice
	prompt "Number of tach edges"
	default TACH_XEC_5_TACH_EDGES
	help
	 This value represents the number of Tach edges that
	 will be used to determine the interval for which the number of
	 100KHz pulses will be counted.

config TACH_XEC_9_TACH_EDGES
	bool "Configure 9 tach edges or 4 tach periods"

config TACH_XEC_5_TACH_EDGES
	bool "Configure 5 tach edges or 2 tach periods"

config TACH_XEC_3_TACH_EDGES
	bool "Configure 3 tach edges or 1 tach period"

config TACH_XEC_2_TACH_EDGES
	bool "Configure 2 tach edges or 1/2 tach period"

endchoice

config TACH_XEC_EDGES
	int
	range 0 3
	default 0 if TACH_XEC_2_TACH_EDGES
	default 1 if TACH_XEC_3_TACH_EDGES
	default 2 if TACH_XEC_5_TACH_EDGES
	default 3 if TACH_XEC_9_TACH_EDGES

endif #TACH_XEC
```

## drivers/sensor/mcp3221/Kconfig
```kconfig
# Low-Power 12-Bit A/D Converter with I2C Interface
#
# Copyright (c) 2023, Atmosic
#
# SPDX-License-Identifier: Apache-2.0

config MCP3221
	bool "MCP3221 i2c 12-bit ADC"
	default y
	depends on DT_HAS_MICROCHIP_MCP3221_ENABLED
	select I2C
	help
	  Enable driver for MCP3221 i2c ADC.
```

## drivers/sensor/mcp9600/Kconfig
```kconfig
# MCP9600 temperature sensor configuration options

# Copyright (c) 2020 SER Consulting LLC / Steven Riedl

# SPDX-License-Identifier: Apache-2.0

menuconfig MCP9600
	bool "MCP9600 i2c thermocouple temperature sensor"
	depends on I2C
	help
	  Enable driver for MCP9600 i2c thermocouple temperature sensor.
```

## drivers/sensor/mcp970x/Kconfig
```kconfig
# Microchip MCP970X ADC driver
#
# Copyright (c) 2023 FTP Technologies
#
# SPDX-License-Identifier: Apache-2.0

config MCP970X
	bool "MCP9700/9700A and MCP9701/9701A sensor"
	default y
	depends on DT_HAS_MICROCHIP_MCP970X_ENABLED
	select ADC
	help
	  Enables Low-Power Linear Active Thermistor IC driver.
```

## drivers/sensor/mcp9800/Kconfig
```kconfig
# MCP9808 temperature sensor configuration options

# Copyright (c) 2024 Robert Kowalewski
# Copyright (c) 2016 Intel Corporation
# SPDX-License-Identifier: Apache-2.0

menuconfig MCP9800
	bool "MCP9800 temperature sensor"
	default y
	depends on DT_HAS_MICROCHIP_MCP9800_ENABLED
	select I2C
	help
	  Enable driver for MCP9800 temperature sensor.

if MCP9800

choice
	prompt "MCP9800 trigger mode"
	default MCP9800_TRIGGER_NONE

config MCP9800_TRIGGER_NONE
	bool "No trigger"

config MCP9800_TRIGGER_GLOBAL_THREAD
	depends on GPIO
	select MCP9800_TRIGGER
	bool "Use global thread"

config MCP9800_TRIGGER_OWN_THREAD
	depends on GPIO
	select MCP9800_TRIGGER
	bool "Use own thread"

endchoice

config MCP9800_TRIGGER
	bool

config MCP9800_THREAD_STACK_SIZE
	int "Sensor delayed work thread stack size"
	depends on MCP9800_TRIGGER_OWN_THREAD
	default 1024

config MCP9800_THREAD_PRIORITY
	int "MCP9800 thread priority"
	depends on MCP9800_TRIGGER_OWN_THREAD
	default 10

endif # MCP9800
```
