## drivers/sensor/excelitas/Kconfig
```kconfig
# Copyright (c) 2026 BayLibre, SAS
# SPDX-License-Identifier: Apache-2.0

source "drivers/sensor/excelitas/tpi1s1385/Kconfig"
```

## drivers/sensor/excelitas/tpi1s1385/Kconfig
```kconfig
# Copyright (c) 2026 BayLibre, SAS
# SPDX-License-Identifier: Apache-2.0

menuconfig TPI1S1385
	bool "Excelitas TPiS 1S 1385 infrared thermopile sensor"
	default y
	depends on DT_HAS_EXCELITAS_TPI1S1385_ENABLED
	select I2C
	help
	  Enable driver for the Excelitas CaliPile TPiS 1S 1385 infrared
	  thermopile sensor.

if TPI1S1385

module = TPI1S1385
thread_priority = 10
thread_stack_size = 1024
source "drivers/sensor/Kconfig.trigger_template"

endif # TPI1S1385
```

## drivers/sensor/fan/Kconfig.pwm
```kconfig
config FAN_PWM
	bool "Generic PWM fan driver"
	default y
	depends on DT_HAS_ZEPHYR_PWM_FAN_ENABLED
	depends on PWM
	help
	  Enable the generic PWM fan driver. The fan is driven by a PWM
	  channel and may optionally reference an arbitrary tachometer
	  sensor (any device reporting SENSOR_CHAN_RPM) for RPM feedback.

config FAN_PWM_START_PERCENT
    int "Start percentage for fan pwm"
	default 50
	range 0 100
	depends on FAN_PWM
	help
	  Set the starting percentage of a fan pwm. Default is 50 percent
```

## drivers/sensor/generic_emul/Kconfig
```kconfig
# Generic emulated sensor driver configuration
# Copyright (c) 2026 Embeint Inc
# SPDX-License-Identifier: Apache-2.0

config SENSOR_GENERIC_EMUL
	bool "Generic emulated sensor"
	depends on DT_HAS_ZEPHYR_GENERIC_EMUL_SENSOR_ENABLED
	select EMUL
	default y
	help
	  Generic sensor device controlled by the sensor emulator backend API.
```

## drivers/sensor/generic_sim/Kconfig
```kconfig
# Flow meter sensor driver configuration
# Copyright (c) 2026 Embeint Inc
# SPDX-License-Identifier: Apache-2.0

config SENSOR_GENERIC_SIM
	bool "Generic simulated sensor"
	depends on DT_HAS_ZEPHYR_GENERIC_SIM_SENSOR_ENABLED
	default y
	help
	  Simulated sensor that can expose any configured channel.
```

## drivers/sensor/infineon/tle493d/Kconfig
```kconfig
# SPDX-FileCopyrightText: Copyright The Zephyr Project Contributors
# SPDX-License-Identifier: Apache-2.0

config TLE493D
	bool "TLE493D sensor"
	default y
	depends on DT_HAS_INFINEON_TLE493D_ENABLED
	select I2C
	help
	  Enable the driver for Infineon TLE493D 3D hall sensor.

if TLE493D

config TLE493D_RESET_DELAY
	int "Driver reset delay (ms)"
	range 0 100
	default 30

endif # TLE493D
```

## drivers/sensor/isentek/Kconfig
```kconfig
# SPDX-FileCopyrightText: Copyright The Zephyr Project Contributors
# SPDX-License-Identifier: Apache-2.0

# zephyr-keep-sorted-start
source "drivers/sensor/isentek/ist8308/Kconfig"
# zephyr-keep-sorted-stop
```

## drivers/sensor/isentek/ist8308/Kconfig
```kconfig
# SPDX-FileCopyrightText: Copyright The Zephyr Project Contributors
# SPDX-License-Identifier: Apache-2.0

config IST8308
	bool "IST8308 geomagnetic sensor"
	default y
	depends on DT_HAS_ISENTEK_IST8308_ENABLED
	select I2C
	help
	  Enable the driver for the iSentek IST8308 I2C geomagnetic sensor.
```

## drivers/sensor/linux_temp/Kconfig
```kconfig
# Copyright 2026 Bayrem Gharsellaoui
# SPDX-License-Identifier: Apache-2.0

config NATIVE_LINUX_TEMP
	bool "Native Linux host temperature sensor"
	default y
	depends on DT_HAS_ZEPHYR_NATIVE_LINUX_TEMP_ENABLED
	depends on ARCH_POSIX
	help
	  Enable a native_sim temperature sensor backed by a Linux sysfs
	  temperature file. The devicetree node provides the file location
	  through the `path` property, such as
	  /sys/class/thermal/thermal_zone0/temp.
```

## drivers/sensor/melexis/Kconfig
```kconfig
# Copyright (c) 2024 Florian Weber <Florian.Weber@live.de>
# SPDX-License-Identifier: Apache-2.0

# zephyr-keep-sorted-start
source "drivers/sensor/melexis/mlx90394/Kconfig"
source "drivers/sensor/melexis/mlx90640/Kconfig"
# zephyr-keep-sorted-stop
```

## drivers/sensor/melexis/mlx90640/Kconfig
```kconfig
# Copyright (c) 2026 RAKwireless Technology Limited
# SPDX-License-Identifier: Apache-2.0

config MLX90640
	bool "MLX90640 32x24 IR array sensor driver"
	default y
	depends on DT_HAS_MELEXIS_MLX90640_ENABLED
	select I2C
	select REGULATOR if $(dt_compat_any_has_prop,$(DT_COMPAT_MELEXIS_MLX90640),vin-supply)
	help
	  Enable the I2C driver for the Melexis MLX90640 far infrared
	  array. The driver dumps EEPROM calibration data at init, reads
	  both RAM subpages on fetch, and reports 768 object temperatures
	  on SENSOR_CHAN_AMBIENT_TEMP plus die/ambient Ta on
	  SENSOR_CHAN_DIE_TEMP.

	  Uses single-precision floating point and about 9 kB of RAM for
	  extracted parameters, one raw frame, and the compensated pixel
	  buffer.
```

## drivers/sensor/microchip/emc1702/Kconfig
```kconfig
# Copyright (c) 2026 Microchip Technology Inc. and its subsidiaries
# SPDX-License-Identifier: Apache-2.0

config EMC1702
	bool "Microchip EMC1702 high-side current sense & temperature monitor"
	default y
	depends on DT_HAS_MICROCHIP_EMC1702_ENABLED
	select I2C
	help
	  Enable driver for Microchip EMC1702. Reports internal die
	  temperature, ambient temperature, bus voltage, current
	  through an external sense resistor and computed power
	  via the Zephyr sensor API.

if EMC1702

choice
	prompt "EMC1702 trigger mode"
	default EMC1702_TRIGGER_NONE

config EMC1702_TRIGGER_NONE
	bool "No trigger"

config EMC1702_TRIGGER_GLOBAL_THREAD
	bool "Use system workqueue"
	select EMC1702_TRIGGER
	depends on GPIO

endchoice

config EMC1702_TRIGGER
	bool

endif # EMC1702
```

## drivers/sensor/microchip/mchp_tach_xec/Kconfig
```kconfig
# Microchip mec15xx tachometer sensor configuration options

# Copyright (c) 2020 Intel Corporation
# SPDX-License-Identifier: Apache-2.0

config TACH_XEC
	bool "XEC Tachometer sensor"
	default y
	depends on DT_HAS_MICROCHIP_XEC_TACH_ENABLED
	depends on SOC_FAMILY_MICROCHIP_MEC
	select PINCTRL
	help
	  Enable the Microchip XEC tachometer sensor.

	  The number of TACH edges to measure over and the number of TACH
	  periods the fan produces per revolution are set per instance with the
	  tach-edges and pulses-per-round devicetree properties.

if TACH_XEC

choice
	prompt "Trigger mode"
	default TACH_XEC_TRIGGER_NONE
	help
	  Specify the type of triggering used by the driver.

config TACH_XEC_TRIGGER_NONE
	bool "No trigger"

config TACH_XEC_TRIGGER_GLOBAL_THREAD
	bool "Use global thread"
	select TACH_XEC_TRIGGER

config TACH_XEC_TRIGGER_OWN_THREAD
	bool "Use own thread"
	select TACH_XEC_TRIGGER

endchoice

config TACH_XEC_TRIGGER
	bool

config TACH_XEC_THREAD_PRIORITY
	int "Thread priority"
	depends on TACH_XEC_TRIGGER_OWN_THREAD && TACH_XEC_TRIGGER
	default 10
	help
	  Priority of thread used by the driver to handle interrupts.

config TACH_XEC_THREAD_STACK_SIZE
	int "Thread stack size"
	depends on TACH_XEC_TRIGGER_OWN_THREAD && TACH_XEC_TRIGGER
	default 1024
	help
	  Stack size of thread used by the driver to handle interrupts. One
	  thread is created per enabled tachometer instance.

endif # TACH_XEC
```

## drivers/sensor/microchip/tc74/Kconfig
```kconfig
# Copyright 2026 Ahmed Ashraf NourEldeen <a.programmer55559@gmail.com>
# SPDX-License-Identifier: Apache-2.0

config TC74
	bool "TC74 Ambient Temperature Sensor"
	default y
	depends on DT_HAS_MICROCHIP_TC74_ENABLED
	select I2C
	help
	  Enable TC74 ambient temperature to digital converter
```

## drivers/sensor/omron/d7s/Kconfig
```kconfig
# Copyright (c) 2026 RAKwireless Technology Limited
# SPDX-License-Identifier: Apache-2.0

config D7S
	bool "D7S seismic sensor"
	default y
	depends on DT_HAS_OMRON_D7S_ENABLED
	select I2C
	help
	  Enable the Omron D7S seismic sensor driver. The sensor reports the
	  spectral intensity and the peak ground acceleration of an earthquake
	  over I2C.

if D7S

choice
	prompt "Trigger mode"
	default D7S_TRIGGER_NONE
	help
	  Specify the type of triggering used by the driver. Triggers require
	  the int1-gpios or int2-gpios property to be present.

config D7S_TRIGGER_NONE
	bool "No trigger"

config D7S_TRIGGER_GLOBAL_THREAD
	bool "Use global thread"
	depends on GPIO
	select D7S_TRIGGER

config D7S_TRIGGER_OWN_THREAD
	bool "Use own thread"
	depends on GPIO
	select D7S_TRIGGER

endchoice

config D7S_TRIGGER
	bool

config D7S_THREAD_PRIORITY
	int "Thread priority"
	depends on D7S_TRIGGER_OWN_THREAD
	default 10

config D7S_THREAD_STACK_SIZE
	int "Thread stack size"
	depends on D7S_TRIGGER_OWN_THREAD
	default 1024

endif # D7S
```

## drivers/sensor/pmbus/Kconfig
```kconfig
# SPDX-FileCopyrightText: Copyright (c) 2026 Linumiz
#
# SPDX-License-Identifier: Apache-2.0

config SENSOR_PMBUS
	bool "Generic PMBus sensor"
	default y
	depends on DT_HAS_ZEPHYR_PMBUS_ENABLED
	depends on SMBUS
	select PMBUS
	help
	  Enable the generic driver reading the standard telemetry commands of
	  a PMBus device.
```

## drivers/sensor/qst/qmi8658a/Kconfig
```kconfig
# QST QMI8658A 6-axis IMU driver configuration options
#
# SPDX-FileCopyrightText: Copyright The Zephyr Project Contributors
# SPDX-License-Identifier: Apache-2.0

menuconfig QMI8658A
	bool "QST QMI8658A 6-axis IMU"
	default y
	depends on DT_HAS_QST_QMI8658A_ENABLED
	select I2C
	select GPIO if $(dt_compat_any_has_prop,$(DT_COMPAT_QST_QMI8658A),int-gpios)
	help
	  Enable driver for the QST QMI8658A six-axis IMU.

if QMI8658A

module = QMI8658A
thread_priority = 10
thread_stack_size = 1024
source "drivers/sensor/Kconfig.trigger_template"

config QMI8658A_TRIGGER_GLOBAL_THREAD
	depends on $(dt_compat_any_has_prop,$(DT_COMPAT_QST_QMI8658A),int-gpios)

config QMI8658A_TRIGGER_OWN_THREAD
	depends on $(dt_compat_any_has_prop,$(DT_COMPAT_QST_QMI8658A),int-gpios)

endif # QMI8658A
```

## drivers/sensor/rakwireless/Kconfig
```kconfig
# Copyright (c) 2026 RAKwireless Technology Limited
# SPDX-License-Identifier: Apache-2.0

# zephyr-keep-sorted-start
source "drivers/sensor/rakwireless/rak12035/Kconfig"
# zephyr-keep-sorted-stop
```

## drivers/sensor/rakwireless/rak12035/Kconfig
```kconfig
# Copyright (c) 2026 RAKwireless Technology Limited
# SPDX-License-Identifier: Apache-2.0

menuconfig RAK12035
	bool "RAK12035 soil moisture sensor driver"
	default y
	depends on DT_HAS_RAKWIRELESS_RAK12035_ENABLED
	select I2C
	select GPIO if $(dt_compat_any_has_prop,$(DT_COMPAT_RAKWIRELESS_RAK12035),reset-gpios)
	select REGULATOR if $(dt_compat_any_has_prop,$(DT_COMPAT_RAKWIRELESS_RAK12035),vin-supply)
	help
	  Enable the I2C driver for the RAKwireless RAK12035 capacitive
	  soil moisture probe. Reports probe temperature on
	  SENSOR_CHAN_AMBIENT_TEMP, a two-point calibrated soil moisture
	  percentage on SENSOR_CHAN_HUMIDITY, and the raw capacitance
	  count on SENSOR_CHAN_RAK12035_CAPACITANCE_RAW.

if RAK12035

config RAK12035_COMMAND_DELAY_MS
	int "Delay after I2C command before read (ms)"
	default 20
	range 20 200
	help
	  Delay after the command STOP before the host may read. Matches the
	  Arduino RAK12035 library (20 ms). Capacitance conversion finishes
	  between sample_fetch calls; do not shorten the application sampling
	  period below ~200 ms.

endif # RAK12035
```

## drivers/sensor/realtek/ameba_temp/Kconfig
```kconfig
# Copyright (c) 2026 Realtek Semiconductor Corp.
# SPDX-License-Identifier: Apache-2.0

config TEMP_AMEBA
	bool "AMEBA Temperature Sensor"
	default y
	depends on DT_HAS_REALTEK_AMEBA_TEMP_ENABLED
	depends on SOC_FAMILY_REALTEK_AMEBA
	help
	  Enable driver for temperature sensor on certain ameba targets.
```

## drivers/sensor/sen0193/Kconfig
```kconfig
# Copyright (c) 2026 J. Nishanth Raj
# SPDX-License-Identifier: Apache-2.0

config SEN0193
	bool "DFRobot SEN0193 Capacitive Soil Moisture Sensor"
	default y
	depends on DT_HAS_DFROBOT_SEN0193_ENABLED
	depends on ADC
	help
	  Enable driver for the SEN0193 Capacitive Soil Moisture Sensor (v1.0.2).
	  This driver abstracts raw ADC reads into a calibrated 0-100% moisture value.
```

## drivers/sensor/sensirion/scd30/Kconfig
```kconfig
# Copyright (c) 2026 MASSDRIVER EI (massdriver.space)
# SPDX-License-Identifier: Apache-2.0

config SCD30
	bool "SCD30 Sensor module driver"
	default y
	depends on DT_HAS_SENSIRION_SCD30_ENABLED
	select I2C
	select CRC
	select GPIO if $(dt_compat_any_has_prop,$(DT_COMPAT_SENSIRION_SCD30),ready-gpios)
	help
	  Enable driver for the Sensirion SCD30 sensor module.

if SCD30

config SCD30_TRIGGER
	bool "SCD30 Sensor module data ready trigger"
	default y
	depends on $(dt_compat_any_has_prop,$(DT_COMPAT_SENSIRION_SCD30),ready-gpios)
	select GPIO
	help
	  Enable interrupt based data ready trigger support for SCD30.

endif
```

## drivers/sensor/sensirion/sts35/Kconfig
```kconfig
# Copyright (c) 2026 Dotcom IoT LLP
# SPDX-License-Identifier: Apache-2.0

config STS35
	bool "STS35 high-accuracy temperature sensor"
	default y
	depends on DT_HAS_SENSIRION_STS35_ENABLED
	select I2C
	select CRC
	help
	  Enable the driver for the Sensirion STS35-DIS digital temperature sensor.
```

## drivers/sensor/silabs/emu_temp/Kconfig
```kconfig
# Copyright (c) 2026 Martin Moya
# SPDX-License-Identifier: Apache-2.0

config TEMP_SILABS_EMU
	bool "Silicon Labs Series 2 EMU temperature sensor"
	default y
	depends on DT_HAS_SILABS_EMU_TEMP_ENABLED
	select SILABS_SISDK_EMU
	help
	  Enable the internal die temperature sensor of the EMU on Silicon Labs
	  Series 2 (EFR32/EFM32) devices, read via sl_hal_emu_get_temperature().
```

## drivers/sensor/st/lsm9ds1/Kconfig
```kconfig
# Copyright (c) 2024 Bootlin
# SPDX-License-Identifier: Apache-2.0

menuconfig LSM9DS1
	bool "LSM9DS1 I2C/SPI accelerometer and gyroscope chip"
	default y
	depends on DT_HAS_ST_LSM9DS1_ENABLED
	depends on ZEPHYR_HAL_ST_MODULE
	select I2C if $(dt_compat_on_bus,$(DT_COMPAT_ST_LSM9DS1),i2c)
	select SPI if $(dt_compat_on_bus,$(DT_COMPAT_ST_LSM9DS1),spi)
	select HAS_STMEMSC
	select USE_STDC_LSM9DS1

if LSM9DS1

config LSM9DS1_ENABLE_TEMP
	bool "LSM9DS1 Temperature sensor"
	help
	  Enable/disable temperature

endif #LSM9DS1
```
