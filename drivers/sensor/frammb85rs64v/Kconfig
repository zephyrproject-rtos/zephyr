## drivers/sensor/honeywell/sm351lt/Kconfig
```kconfig
# SM351LT Magnetoresistive Sensor configuration options

# Copyright (c) 2020, Laird Connectivity
# SPDX-License-Identifier: Apache-2.0

menuconfig SM351LT
	bool "SM351LT Magnetoresistive Sensor"
	default y
	depends on DT_HAS_HONEYWELL_SM351LT_ENABLED
	depends on (GPIO)
	help
	  Enable GPIO-based driver for SM351LT magnetoresistive
	  sensor.

if SM351LT

choice SM351LT_TRIGGER_MODE
	prompt "Trigger mode"
	help
	  Specify the type of triggering to be used by the driver.

config SM351LT_TRIGGER_NONE
	bool "No trigger"

config SM351LT_TRIGGER_GLOBAL_THREAD
	bool "Use global thread"
	select SM351LT_TRIGGER

config SM351LT_TRIGGER_OWN_THREAD
	bool "Use own thread"
	select SM351LT_TRIGGER

endchoice

config SM351LT_TRIGGER
	bool

config SM351LT_THREAD_PRIORITY
	int "Thread priority"
	depends on SM351LT_TRIGGER_OWN_THREAD
	default 10
	help
	  Priority of thread used by the driver to handle interrupts.

config SM351LT_THREAD_STACK_SIZE
	int "Thread stack size"
	depends on SM351LT_TRIGGER_OWN_THREAD
	default 512
	help
	  Stack size of thread used by the driver to handle interrupts.

endif # SM351LT
```

## drivers/sensor/hp206c/Kconfig
```kconfig
# HopeRF Electronic HP206C precision barometer and altimeter configuration
# options

# Copyright (c) 2016 Intel Corporation
# SPDX-License-Identifier: Apache-2.0

menuconfig HP206C
	bool "HopeRF HP206C precision barometer and altimeter sensor"
	default y
	depends on DT_HAS_HOPERF_HP206C_ENABLED
	select I2C
	help
	  Enable HopeRF HP206C barometer and altimeter support.

if HP206C

config HP206C_OSR_RUNTIME
	bool "Oversampling rate set at runtime"
	default y

config HP206C_OSR
	int "Oversampling rate"
	depends on !HP206C_OSR_RUNTIME
	default 4096
	help
	  Allowed values: 4096, 2048, 1024, 512, 256, 128

config HP206C_ALT_OFFSET_RUNTIME
	bool "Altitude offset set at runtime"
	default y

config HP206C_ALT_OFFSET
	int "Altitude offset (in cm)"
	depends on !HP206C_ALT_OFFSET_RUNTIME
	default 0
	help
	  Value, in cm, that will be used to compensate altitude calculation.
	  For more info on how to choose this value, consult section 6.1.1 in
	  the datasheet.

endif # HP206C
```

## drivers/sensor/hts221/Kconfig
```kconfig
# Copyright (c) 2016 Intel Corporation
# SPDX-License-Identifier: Apache-2.0

menuconfig HTS221
	bool "HTS221 temperature and humidity sensor"
	default y
	depends on DT_HAS_ST_HTS221_ENABLED
	depends on ZEPHYR_HAL_ST_MODULE
	select I2C if $(dt_compat_on_bus,$(DT_COMPAT_ST_HTS221),i2c)
	select SPI if $(dt_compat_on_bus,$(DT_COMPAT_ST_HTS221),spi)
	select HAS_STMEMSC
	select USE_STDC_HTS221
	help
	  Enable driver for HTS221 I2C/SPI-based temperature and humidity sensor.

if HTS221

choice HTS221_TRIGGER_MODE
	prompt "Trigger mode"
	default HTS221_TRIGGER_GLOBAL_THREAD
	help
	  Specify the type of triggering to be used by the driver.

config HTS221_TRIGGER_NONE
	bool "No trigger"

config HTS221_TRIGGER_GLOBAL_THREAD
	bool "Use global thread"
	depends on GPIO
	select HTS221_TRIGGER

config HTS221_TRIGGER_OWN_THREAD
	bool "Use own thread"
	depends on GPIO
	select HTS221_TRIGGER

endchoice # HTS221_TRIGGER_MODE

config HTS221_TRIGGER
	bool

config HTS221_THREAD_PRIORITY
	int "Thread priority"
	depends on HTS221_TRIGGER_OWN_THREAD
	default 10
	help
	  Priority of thread used by the driver to handle interrupts.

config HTS221_THREAD_STACK_SIZE
	int "Thread stack size"
	depends on HTS221_TRIGGER_OWN_THREAD
	default 1024
	help
	  Stack size of thread used by the driver to handle interrupts.

config HTS221_ODR
	string "Output data rate"
	default "1"
	help
	  Sensor output data rate expressed in samples per second.
	  Data rates supported by the chip are 1, 7 and 12.5.

endif # HTS221
```

## drivers/sensor/htu21d/Kconfig
```kconfig
# HTU21D humidity and temperature sensor configuration options

# Copyright (c) 2022 Gaël PORTAY
# SPDX-License-Identifier: Apache-2.0

config HTU21D
	bool "HTU21D sensor"
	default y
	depends on DT_HAS_MEAS_HTU21D_ENABLED
	select I2C
	help
	  Enable driver for HTU21D I2C-based humidity and temperature sensor.
```

## drivers/sensor/hx711/Kconfig
```kconfig
# HX711 Weight Scale interface Sensor configuration options

# Copyright (c) 2020, George Gkinis
# SPDX-License-Identifier: Apache-2.0

config HX711
	bool "HX711 Weight Scale Sensor"
	default y
	depends on DT_HAS_AVIA_HX711_ENABLED
	depends on GPIO
	help
	  Enable driver for the HX711 Weight Scale Sensor.
```

## drivers/sensor/hx711_spi/Kconfig
```kconfig
# Copyright (c) 2026 Zephyr Project Developers
# SPDX-License-Identifier: Apache-2.0

menuconfig HX711_SPI
	bool "Avia Semiconductor HX711 24-bit ADC Specialized for Load Cells / Strain Gauges on SPI bus"
	default y
	depends on DT_HAS_AVIA_HX711_SPI_ENABLED
	select SPI
	help
	  Enable driver for Avia Semiconductor HX711 24-bit ADC Specialized for
	  Load Cells / Strain Gauges on SPI bus.

if HX711_SPI

config HX711_SPI_TRIGGER
	bool "Use data ready trigger"
	depends on GPIO
	help
	  Trigger data transfer when data is ready by interrupting on the falling
	  edge of the DOUT line.

config HX711_SPI_TRIGGER_OWN_THREAD
	bool "Use own workqueue thread"
	select HX711_SPI_TRIGGER
	help
	  When interrupted, the interrupt handler submits a work to execute user
	  callback. By default, the work is submitted to the system workqueue.
	  Enable this option to submit work to the driver's own workquere.

config HX711_SPI_THREAD_PRIORITY
	int "Thread priority"
	depends on HX711_SPI_TRIGGER_OWN_THREAD && HX711_SPI_TRIGGER
	default 10
	help
	  Priority of thread used by the driver to handle interrupts.

config HX711_SPI_THREAD_STACK_SIZE
	int "Thread stack size"
	depends on HX711_SPI_TRIGGER_OWN_THREAD && HX711_SPI_TRIGGER
	default 1024
	help
	  Stack size of thread used by the driver to handle interrupts.

endif # HX711_SPI
```

## drivers/sensor/hx7xx/Kconfig
```kconfig
# HX711 Weight Scale interface Sensor configuration options

# Copyright (c) 2020, George Gkinis
# SPDX-License-Identifier: Apache-2.0

config HX7XX
	bool "Common HX7xx driver for multiple Avia ADCs"

config HX710
	bool "HX710/HX712/HX720 Weight Scale Sensor"
	default y
	depends on DT_HAS_AVIA_HX710_ENABLED
	depends on GPIO
	select HX7XX
	help
	  Enable driver for the HX710/HX712/HX720 Weight Scale Sensor.

config HX711
	bool "HX711 Weight Scale Sensor"
	default y
	depends on DT_HAS_AVIA_HX711_ENABLED
	depends on GPIO
	select HX7XX
	help
	  Enable driver for the HX711 Weight Scale Sensor.

config HX717
	bool "HX717 Weight Scale Sensor"
	default y
	depends on DT_HAS_AVIA_HX717_ENABLED
	depends on GPIO
	select HX7XX
	help
	  Enable driver for the HX717 Weight Scale Sensor.

config HX71708
	bool "HX71708 Weight Scale Sensor"
	default y
	depends on DT_HAS_AVIA_HX71708_ENABLED
	depends on GPIO
	select HX7XX
	help
	  Enable driver for the HX71708 Weight Scale Sensor.

config HX7XX_DISABLE_INTERRUPTS_WHILE_POLLING
	bool "Disable interrupts while generating clock signal"
	help
	  Disables all interrupts while generating one clock cycle when polling data.
	  Enable this option if there is a thread with higher priority executed frequently
	  to avoid clock generating issues when switching to other thread.
```

## drivers/sensor/i3g4250d/Kconfig
```kconfig
# I3G4250D three-axis digital output gyroscope

# Copyright (c) 2021 Jonathan Hahn
# SPDX-License-Identifier: Apache-2.0

config I3G4250D
	bool "I3G4250D three-axis digital output gyroscope"
	default y
	depends on DT_HAS_ST_I3G4250D_ENABLED
	select SPI
	select HAS_STMEMSC
	select USE_STDC_I3G4250D
	help
	  Enable driver for I3G4250D SPI-based three-axis motion tracking device.
```
