## drivers/sensor/frammb85rs64v/Kconfig
```kconfig
# BMP280 temperature and pressure sensor configuration options

# Copyright (c) 2016 Intel Corporation
# Copyright (c) 2017 IpTronix S.r.l.
# SPDX-License-Identifier: Apache-2.0

menuconfig FRAMMB85RS64V
	bool "FRAMMB85RS64V/BMP280 sensor"
	depends on I2C || SPI
	help
	  Enable driver for FRAMMB85RS64V I2C-based or SPI-based temperature and pressure sensor.

if FRAMMB85RS64V

choice
	prompt "FRAMMB85RS64V sampling mode"
	default FRAMMB85RS64V_MODE_NORMAL
	help
	  Select sampling mode. In normal mode continuous measurements are
	  performed, whereas in forced mode only single measurement is performed.
config FRAMMB85RS64V_MODE_NORMAL
	bool "normal"
config FRAMMB85RS64V_MODE_FORCED
	bool "forced"
endchoice

endif # FRAMMB85RS64V
```

## drivers/sensor/freq_meter_stm32_icap/Kconfig
```kconfig
# STM32 Input Capture Frequency Meter sensor configuration options

# Copyright (c) 2024 Freedom Veiculos Eletricos
# SPDX-License-Identifier: Apache-2.0

config FREQ_METER_STM32_ICAP
	bool "STM32 Input Capture Frequency Meter Sensor"
	default y
	depends on DT_HAS_ST_STM32_ICAP_FREQ_METER_ENABLED
	depends on SOC_FAMILY_STM32
	help
	  Enable driver for STM32 Input Capture Frequency Meter sensor.

if FREQ_METER_STM32_ICAP

config FREQ_METER_STM32_ICAP_GEN
	bool "STM32 Frequency Generator"
	default y

config FREQ_METER_STM32_ICAP_GEN_FREQ
	int "Frequency in Hz"
	range 10 150
	default 100
	depends on FREQ_METER_STM32_ICAP_GEN
endif
```

## drivers/sensor/fxas21002/Kconfig
```kconfig
# FXAS21002 3-axis gyroscope

# Copyright (c) 2017, NXP
# SPDX-License-Identifier: Apache-2.0

menuconfig FXAS21002
	bool "FXAS21002 gyroscope driver"
	depends on I2C && HAS_DTS_GPIO
	help
	  Enable driver for the FXAS21002 gyroscope

if FXAS21002

config FXAS21002_WHOAMI
	hex "WHOAMI value"
	range 0x00 0xff
	default 0xd7
	help
	  The datasheet defines the value of the WHOAMI register, but some
	  pre-production devices can have a different value. It is unlikely you
	  should need to change this configuration option from the default.

config FXAS21002_RANGE
	int "Full scale range"
	range 0 3
	default 0
	help
	  Selects the full scale range
	  0: +/-2000 dps (62.5 mdps/LSB)
	  1: +/-1000 dps (31.25 mdps/LSB)
	  2: +/-500 dps (15.625 mdps/LSB)
	  3: +/-250 dps (7.8125 mdps/LSB)

config FXAS21002_DR
	int "Output data rate"
	range 0 7
	default 3
	help
	  Selects the output data rate
	  0: 800 Hz
	  1: 400 Hz
	  2: 200 Hz
	  3: 100 Hz
	  4: 50 Hz
	  5: 25 Hz
	  6: 12.5 Hz
	  7: 12.5 Hz

choice
	prompt "Trigger mode"
	default FXAS21002_TRIGGER_NONE

config FXAS21002_TRIGGER_NONE
	bool "No trigger"

config FXAS21002_TRIGGER_GLOBAL_THREAD
	bool "Use global thread"
	select FXAS21002_TRIGGER

config FXAS21002_TRIGGER_OWN_THREAD
	bool "Use own thread"
	select FXAS21002_TRIGGER

endchoice

config FXAS21002_TRIGGER
	bool

if FXAS21002_TRIGGER

config FXAS21002_DRDY_INT1
	bool "Data ready interrupt to INT1 pin"
	help
	  Say Y to route data ready interrupt to INT1 pin. Say N to route to
	  INT2 pin.

config FXAS21002_THREAD_PRIORITY
	int "Own thread priority"
	depends on FXAS21002_TRIGGER_OWN_THREAD
	default 10

config FXAS21002_THREAD_STACK_SIZE
	int "Own thread stack size"
	depends on FXAS21002_TRIGGER_OWN_THREAD
	default 1024

endif # FXAS21002_TRIGGER

endif # FXAS21002
```

## drivers/sensor/fxos8700/Kconfig
```kconfig
# FXOS8700 6-axis accelerometer/magnetometer

# Copyright (c) 2016 Freescale Semiconductor, Inc.
# SPDX-License-Identifier: Apache-2.0

DT_COMPAT_FXOS8700 := nxp,fxos8700

menuconfig FXOS8700
	bool "FXOS8700 accelerometer/magnetometer driver"
	default $(dt_compat_enabled,$(DT_COMPAT_FXOS8700))
	depends on I2C
	help
	  Enable driver for the FXOS8700 accelerometer/magnetometer.
	  The driver also supports MMA8451Q, MMA8652FC and MMA8653FC
	  accelerometers. If the driver is used with one of these
	  accelerometers then the Accelerometer-only mode should be selected."

if FXOS8700

choice FXOS8700_MODE
	prompt "Mode"
	default FXOS8700_MODE_HYBRID

config FXOS8700_MODE_ACCEL
	bool "Accelerometer-only mode"

config FXOS8700_MODE_MAGN
	bool "Magnetometer-only mode"

config FXOS8700_MODE_HYBRID
	bool "Hybrid (accel+mag) mode"

endchoice

config FXOS8700_TEMP
	bool "Temperature"
	depends on FXOS8700_MODE_MAGN || FXOS8700_MODE_HYBRID
	help
	  Enable the temperature sensor. Note that the temperature sensor is
	  uncalibrated and its output for a given temperature may vary from one
	  device to the next.

choice
	prompt "Trigger mode"
	default FXOS8700_TRIGGER_NONE

config FXOS8700_TRIGGER_NONE
	bool "No trigger"

config FXOS8700_TRIGGER_GLOBAL_THREAD
	bool "Use global thread"
	select FXOS8700_TRIGGER

config FXOS8700_TRIGGER_OWN_THREAD
	bool "Use own thread"
	select FXOS8700_TRIGGER

endchoice

config FXOS8700_TRIGGER
	bool

config FXOS8700_DRDY_INT1
	bool "Data ready interrupt to INT1 pin"
	depends on FXOS8700_TRIGGER
	help
	  Say Y to route data ready interrupt to INT1 pin. Say N to route to
	  INT2 pin.

if FXOS8700_TRIGGER

config FXOS8700_THREAD_PRIORITY
	int "Own thread priority"
	depends on FXOS8700_TRIGGER_OWN_THREAD
	default 10

config FXOS8700_THREAD_STACK_SIZE
	int "Own thread stack size"
	depends on FXOS8700_TRIGGER_OWN_THREAD
	default 1024

menuconfig FXOS8700_PULSE
	bool "Pulse detection"
	help
	  Enable pulse detection

if FXOS8700_PULSE

config FXOS8700_PULSE_INT1
	bool "Pulse interrupt to INT1 pin"
	help
	  Say Y to route pulse interrupt to INT1 pin. Say N to route to INT2 pin.

endif # FXOS8700_PULSE

menuconfig FXOS8700_MOTION
	bool "Motion detection"
	help
	  Enable motion detection

config FXOS8700_MOTION_INT1
	bool "Motion interrupt to INT1 pin"
	depends on FXOS8700_MOTION
	help
	  Say Y to route motion interrupt to INT1 pin. Say N to route to INT2 pin.

menuconfig FXOS8700_MAG_VECM
	bool "Magnetic vector-magnitude detection"
	help
	  Enable magnetic vector-magnitude detection

if FXOS8700_MAG_VECM

config FXOS8700_MAG_VECM_INT1
	bool "Magnetic vector-magnitude interrupt to INT1 pin"
	help
	  Say Y to route magnetic vector-magnitude interrupt to INT1 pin.
	  Say N to route to INT2 pin.

endif # FXOS8700_MAG_VECM

endif # FXOS8700_TRIGGER

endif # FXOS8700
```

## drivers/sensor/grmn/Kconfig
```kconfig
# Copyright (c) 2025 Alex Aylward
# SPDX-License-Identifier: Apache-2.0

# zephyr-keep-sorted-start
source "drivers/sensor/grmn/lidar_lite_v4/Kconfig"
# zephyr-keep-sorted-stop
```

## drivers/sensor/grmn/lidar_lite_v4/Kconfig
```kconfig
# Copyright (c) 2025 Alex Aylward
# SPDX-License-Identifier: Apache-2.0

config LIDAR_LITE_V4
	bool "Lidar Lite V4 support"
	depends on DT_HAS_GRMN_LIDAR_LITE_V4_ENABLED
	default y
	select I2C
	help
	  Driver for Lidar Lite V4 I2C Operation.
```

## drivers/sensor/grove/Kconfig
```kconfig
# Drivers configuration options for SeeedStudio Grove Devices

# Copyright (c) 2015 Intel Corporation
# SPDX-License-Identifier: Apache-2.0

config GROVE_SENSORS
	bool "Seeed Grove sensors support"
	help
	  Enable Seeed Grove sensors support.

if GROVE_SENSORS

config GROVE_LIGHT_SENSOR
	bool "The Seeed Grove Light Sensor"
	depends on ADC && !MINIMAL_LIBC
	help
	  Setting this value will enable driver support for the Grove Light
	  Sensor.

config GROVE_TEMPERATURE_SENSOR
	bool "The Seeed Grove Temperature Sensor"
	depends on ADC && !MINIMAL_LIBC
	help
	  Setting this value will enable driver support for the Grove
	  Temperature Sensor.

endif # GROVE_SENSORS
```

## drivers/sensor/grow_r502a/Kconfig
```kconfig
# GROW_R502A hzgrow Fingerprint sensor Configuration options

# Copyright (c) 2021 Linumiz
# SPDX-License-Identifier: Apache-2.0

menuconfig GROW_R502A
	bool "GROW_R502A Fingerprint Sensor"
	default y
	depends on DT_HAS_HZGROW_R502A_ENABLED
	depends on UART_INTERRUPT_DRIVEN && SERIAL
	help
	  Enable driver for GROW_R502A Fingerprint Sensor.

if GROW_R502A

config R502A_DATA_PKT_SIZE
	int "Template data packet size"
	default 128
	help
	  Template data packet size for upload and download
	  to the sensor device.
	  valid values are:
	  32, 64, 128, 256.

choice
	prompt "Trigger mode"
	default GROW_R502A_TRIGGER_NONE
	help
	  Specify the type of triggering used by the driver.

config GROW_R502A_TRIGGER_NONE
	bool "No trigger"

config GROW_R502A_TRIGGER_GLOBAL_THREAD
	bool "Use global thread"
	depends on GPIO
	select GROW_R502A_TRIGGER

config GROW_R502A_TRIGGER_OWN_THREAD
	bool "Use own thread"
	depends on GPIO
	depends on $(dt_compat_any_has_prop,$(DT_COMPAT_HZGROW_R502A),int-gpios)
	select GROW_R502A_TRIGGER

endchoice


config GROW_R502A_TRIGGER
	bool

config GROW_R502A_THREAD_PRIORITY
	int "Thread priority"
	depends on GROW_R502A_TRIGGER_OWN_THREAD && GROW_R502A_TRIGGER
	default 10
	help
	  Priority of thread used by the driver to handle interrupts.

config GROW_R502A_THREAD_STACK_SIZE
	int "Thread stack size"
	depends on GROW_R502A_TRIGGER_OWN_THREAD && GROW_R502A_TRIGGER
	default 1024
	help
	  Stack size of thread used by the driver to handle interrupts.

config GROW_R502A_GPIO_POWER
	bool "GROW_R502A sensor VCC and VT GPIO"
	help
	  Enable control of vin-gpios and act-gpios.

endif # GROW_R502A
```

## drivers/sensor/gxcas/Kconfig
```kconfig
# Copyright (c) 2024 LCKFB
# SPDX-License-Identifier: Apache-2.0

# zephyr-keep-sorted-start
source "drivers/sensor/gxcas/gxhtc3/Kconfig"
# zephyr-keep-sorted-stop
```

## drivers/sensor/gxcas/gxhtc3/Kconfig
```kconfig
# Copyright (c) 2024 LCKFB
# SPDX-License-Identifier: Apache-2.0

config GXHTC3
	bool "GXHTC3 temperature and humidity sensor"
	default y
	depends on DT_HAS_GXCAS_GXHTC3_ENABLED
	select I2C
	help
	  Enable driver for GXCAS GXHTC3 I2C-based temperature and humidity sensor.
```

## drivers/sensor/hc_sr04/Kconfig
```kconfig
# HC-SR04 Ultrasound sensor configuration options

# Copyright (c) 2024 Adrien Leravat
# SPDX-License-Identifier: Apache-2.0

config HC_SR04
	bool "HC-SR04 Ultrasound distance sensor"
	default y
	depends on DT_HAS_HC_SR04_ENABLED
	depends on GPIO
	help
	  Enable driver for HC-SR04 distance sensor.
```

## drivers/sensor/hdc1008/Kconfig
```kconfig
# Kconfig - HDC1008 temperature and humidity sensor configuration options

#
# Copyright (c) 2016 Intel Corporation
#
# SPDX-License-Identifier: Apache-2.0
#

menuconfig HDC1008
	bool "HDC1008 Temperature and Humidity Sensor"
	depends on I2C && HAS_DTS_I2C && GPIO && HAS_DTS_GPIO
	help
	  Enable driver for HDC1008 temperature and humidity sensors.
```

## drivers/sensor/hdc2080/Kconfig
```kconfig
# HDC2080 temperature and humidity sensor configuration options

# Copyright (c) 2020 ZedBlox Logitech Pvt Ltd
# SPDX-License-Identifier: Apache-2.0

menuconfig HDC2080
	bool "HDC2080 sensor"
	depends on I2C
	help
	  Enable driver for HDC2080 I2C-based temperature and humidity sensor.

if HDC2080

choice
	prompt "HDC2080 measurement rate"
	default HDC2080_1HZ
	help
        HDC2080 measurement rate

config HDC2080_1HZ
    bool "1hz"

endchoice

endif # HDC2080
```

## drivers/sensor/hdc20x0/Kconfig
```kconfig
# HDC20x0 ±2% ultra-low-power, digital humidity sensor with
# temperature sensor in WCSP

# Copyright (c) 2020 seeed.cc
# SPDX-License-Identifier: Apache-2.0

config HDC20X0
	bool "HDC20X0 sensor"
	depends on I2C
	help
	  Enable driver for HDC2010/HDC2080 I2C-based digital humidity sensor
	  with temperature sensor.
```

## drivers/sensor/hmc5883l/Kconfig
```kconfig
# Copyright (c) 2016 Intel Corporation
# SPDX-License-Identifier: Apache-2.0

DT_COMPAT_HMC5883L := honeywell,hmc5883l

menuconfig HMC5883L
	bool "HMC5883L magnetometer"
	default $(dt_compat_enabled,$(DT_COMPAT_HMC5883L))
	depends on I2C
	help
	  Enable driver for HMC5883L I2C-based magnetometer.

if HMC5883L

choice
	prompt "Trigger mode"
	default HMC5883L_TRIGGER_GLOBAL_THREAD
	help
	  Specify the type of triggering to be used by the driver.

config HMC5883L_TRIGGER_NONE
	bool "No trigger"

config HMC5883L_TRIGGER_GLOBAL_THREAD
	bool "Use global thread"
	depends on GPIO
	select HMC5883L_TRIGGER

config HMC5883L_TRIGGER_OWN_THREAD
	bool "Use own thread"
	depends on GPIO
	select HMC5883L_TRIGGER

endchoice

config HMC5883L_TRIGGER
	bool

config HMC5883L_THREAD_PRIORITY
	int "Thread priority"
	depends on HMC5883L_TRIGGER_OWN_THREAD
	default 10
	help
	  Priority of thread used by the driver to handle interrupts.

config HMC5883L_THREAD_STACK_SIZE
	int "Thread stack size"
	depends on HMC5883L_TRIGGER_OWN_THREAD
	default 1024
	help
	  Stack size of thread used by the driver to handle interrupts.

config HMC5883L_ODR
	string "Output data rate"
	default "15"
	help
	  Magnetometer output data rate expressed in samples per second.
	  Data rates supported by the chip are 0.75, 1.5, 3, 7.5, 15, 30
	  and 75.

config HMC5883L_FS
	string "Full-scale range"
	default "1.3"
	help
	  Magnetometer full-scale range.
	  An X value for the config represents a range of +/- X gauss. Valid
	  values are 0.88, 1.3, 1.9, 2.5, 4, 4.7, 5.6 and 8.1.

endif # HMC5883L
```

## drivers/sensor/honeywell/Kconfig
```kconfig
# Copyright (c) 2024 Analog Devices, Inc.
# SPDX-License-Identifier: Apache-2.0

# zephyr-keep-sorted-start
source "drivers/sensor/honeywell/hmc5883l/Kconfig"
source "drivers/sensor/honeywell/mpr/Kconfig"
source "drivers/sensor/honeywell/sm351lt/Kconfig"
# zephyr-keep-sorted-stop
```

## drivers/sensor/honeywell/hmc5883l/Kconfig
```kconfig
# Copyright (c) 2016 Intel Corporation
# SPDX-License-Identifier: Apache-2.0

menuconfig HMC5883L
	bool "HMC5883L magnetometer"
	default y
	depends on DT_HAS_HONEYWELL_HMC5883L_ENABLED
	select I2C
	help
	  Enable driver for HMC5883L I2C-based magnetometer.

if HMC5883L

choice
	prompt "Trigger mode"
	default HMC5883L_TRIGGER_GLOBAL_THREAD
	help
	  Specify the type of triggering to be used by the driver.

config HMC5883L_TRIGGER_NONE
	bool "No trigger"

config HMC5883L_TRIGGER_GLOBAL_THREAD
	bool "Use global thread"
	depends on GPIO
	depends on $(dt_compat_any_has_prop,$(DT_COMPAT_HONEYWELL_HMC5883L),int-gpios)
	select HMC5883L_TRIGGER

config HMC5883L_TRIGGER_OWN_THREAD
	bool "Use own thread"
	depends on GPIO
	depends on $(dt_compat_any_has_prop,$(DT_COMPAT_HONEYWELL_HMC5883L),int-gpios)
	select HMC5883L_TRIGGER

endchoice

config HMC5883L_TRIGGER
	bool

config HMC5883L_THREAD_PRIORITY
	int "Thread priority"
	depends on HMC5883L_TRIGGER_OWN_THREAD
	default 10
	help
	  Priority of thread used by the driver to handle interrupts.

config HMC5883L_THREAD_STACK_SIZE
	int "Thread stack size"
	depends on HMC5883L_TRIGGER_OWN_THREAD
	default 1024
	help
	  Stack size of thread used by the driver to handle interrupts.

config HMC5883L_ODR
	string "Output data rate"
	default "15"
	help
	  Magnetometer output data rate expressed in samples per second.
	  Data rates supported by the chip are 0.75, 1.5, 3, 7.5, 15, 30
	  and 75.

config HMC5883L_FS
	string "Full-scale range"
	default "1.3"
	help
	  Magnetometer full-scale range.
	  An X value for the config represents a range of +/- X gauss. Valid
	  values are 0.88, 1.3, 1.9, 2.5, 4, 4.7, 5.6 and 8.1.

endif # HMC5883L
```
