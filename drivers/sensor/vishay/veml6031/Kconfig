## drivers/sensor/vishay/veml6031/Kconfig
```kconfig
# Copyright (c) 2025 Andreas Klinger
# SPDX-License-Identifier: Apache-2.0

# Vishay VEML6031 ambient light sensor driver options.

config VEML6031
	bool "Vishay VEML6031 ambient light sensor"
	default y
	depends on DT_HAS_VISHAY_VEML6031_ENABLED
	select I2C
	help
	  Enable Vishay VEML6031 ambient light sensor driver.
```

## drivers/sensor/vishay/veml6046/Kconfig
```kconfig
# Copyright (c) 2025 Andreas Klinger
# SPDX-License-Identifier: Apache-2.0

# Vishay VEML6046 RGBIR color sensor driver options.

config VEML6046
	bool "Vishay VEML6046 RGBIR color sensor"
	default y
	depends on DT_HAS_VISHAY_VEML6046_ENABLED
	select I2C
	help
	  Enable Vishay VEML6046 RGBIR color sensor driver.
```

## drivers/sensor/vishay/veml7700/Kconfig
```kconfig
# Copyright (c) 2023 Andreas Kilian
# SPDX-License-Identifier: Apache-2.0

# Vishay VEML7700 ambient light sensor driver options.

config VEML7700
	bool "Vishay VEML7700 ambient light sensor"
	default y
	depends on DT_HAS_VISHAY_VEML7700_ENABLED
	select I2C
	help
	  Enable Vishay VEML7700 ambient light sensor driver.
```

## drivers/sensor/vl53l0x/Kconfig
```kconfig
# VL53L0X time of flight sensor configuration options

# Copyright (c) 2017 STMicroelectronics
# SPDX-License-Identifier: Apache-2.0

menuconfig VL53L0X
	bool "VL53L0X time of flight sensor"
	default y
	depends on DT_HAS_ST_VL53L0X_ENABLED
	depends on ZEPHYR_HAL_ST_MODULE
	select I2C
	select HAS_STLIB
	help
	  Enable driver for VL53L0X I2C-based time of flight sensor.

config VL53L0X_PROXIMITY_THRESHOLD
	int "Proximity threshold in millimeters"
	default 100
	depends on VL53L0X
	help
	  Threshold used for proximity detection when sensor is used with SENSOR_CHAN_PROX.

config VL53L0X_RECONFIGURE_ADDRESS
	bool "Support reconfigurable sensor address"
	depends on VL53L0X
	help
	  Enable support for reconfiguring the sensor address at runtime.
	  When this option is enabled, all sensors declared in the device tree
	  must have an xshut-gpio property.

	  All sensors are disabled during initialization. When reading the first
	  value from a sensor, it is powered up and its I2C address is reconfigured
	  from the manufacturer default (0x29) to the address specified in the
	  device tree.

config VL53L0X_SETUP_MAX_TIME_FOR_RANGING
	int "config max time for ranging"
	default 33000
	depends on VL53L0X
	help
	  Set max time for ranging in μs
	
config VL53L0X_SETUP_SIGNAL_LIMIT_RATIO
	int "config signal limit ratio"
	default 100
	depends on VL53L0X
	help
	  Specify a floating point value multiplied by 1000.
	  For example, a value of 1 represents 0.001 in real value.
	  default value 100 is set VL53L0X_SETUP_SIGNAL_LIMIT (0.1 * 65536)

config VL53L0X_SETUP_SIGMA_LIMIT_RATIO
	int "config sigma limit ratio"
	default 60000
	depends on VL53L0X
	help
	  Specify a floating point value multiplied by 1000.
	  For example, a value of 1 represents 0.001 in real value.
	  default value 60000 is set VL53L0X_SETUP_SIGMA_LIMIT (60 * 65536)
	
```

## drivers/sensor/vl53l1x/Kconfig
```kconfig
# VL53L0X time of flight sensor configuration options

# Copyright (c) 2023 Prosaris Solutions Inc.
# SPDX-License-Identifier: Apache-2.0

menuconfig VL53L1X
	bool "VL53L1X time of flight sensor"
	default y
	depends on DT_HAS_ST_VL53L1X_ENABLED
	select I2C
	select HAS_STLIB
	help
	  Enable driver for VL53L1X I2C-based time of flight sensor.

if VL53L1X

config VL53L1X_INTERRUPT_MODE
	bool "Use interrupt mode for VL53L1X time of flight sensor"
	default y
	depends on GPIO
	help
	  Enable interrupt mode for VL53L1X time of flight sensor. Otherwise,
	  the driver will use the polling method.

config VL53L1X_XSHUT
	bool "Use xshut pin on VL53L1X time of flight sensor"
	depends on GPIO
	help
	  Enable to use the xshut pin on the VL53L1X. If not, the pin should be
	  connected to VDD.

endif # VL53L1X
```

## drivers/sensor/vl6180x/Kconfig
```kconfig
# VL6180X time of flight sensor configuration options

# Copyright (c) 2017 STMicroelectronics
# SPDX-License-Identifier: Apache-2.0

menuconfig VL6180X
	bool "VL6180X time of flight sensor"
	default y
	depends on DT_HAS_ST_VL6180X_ENABLED
	select I2C
	select HAS_STLIB
	help
	  Enable driver for VL6180X I2C-based time of flight sensor.

config VL6180X_PROXIMITY_THRESHOLD
	int "Proximity threshold in millimeters"
	default 100
	depends on VL6180X
	help
	  Threshold used for proximity detection when sensor is used with SENSOR_CHAN_PROX.

config VL6180X_RECONFIGURE_ADDRESS
	bool "Support reconfigurable sensor address"
	depends on VL6180X
	help
	  Enable support for reconfiguring the sensor address at runtime.
	  When this option is enabled, all sensors declared in the device tree
	  must have an xshut-gpio property.

	  All sensors are disabled during initialization. When reading the first
	  value from a sensor, it is powered up and its I2C address is reconfigured
	  from the manufacturer default (0x29) to the address specified in the
	  device tree.
```

## drivers/sensor/voltage_divider/Kconfig
```kconfig
# Voltage sensor driver
#
# Copyright (c) 2023 FTP Technologies
#
# SPDX-License-Identifier: Apache-2.0

config VOLTAGE_DIVIDER
	bool "Voltage sensor driver"
	default y
	depends on DT_HAS_VOLTAGE_DIVIDER_ENABLED
	select ADC
	help
	  Enable voltage sensor driver.
```

## drivers/sensor/wsen/Kconfig
```kconfig
# Copyright (c) 2024 Analog Devices, Inc.
# Copyright (c) 2024 Würth Elektronik eiSos GmbH & Co. KG
# SPDX-License-Identifier: Apache-2.0

source "drivers/sensor/wsen/*/Kconfig"
```

## drivers/sensor/wsen/wsen_hids/Kconfig
```kconfig
# Copyright (c) 2022 Würth Elektronik eiSos GmbH & Co. KG
# SPDX-License-Identifier: Apache-2.0

menuconfig WSEN_HIDS
	bool "WSEN-HIDS humidity and temperature sensor"
	default y
	depends on DT_HAS_WE_WSEN_HIDS_ENABLED
	select I2C if $(dt_compat_on_bus,$(DT_COMPAT_WE_WSEN_HIDS),i2c)
	select SPI if $(dt_compat_on_bus,$(DT_COMPAT_WE_WSEN_HIDS),spi)
	select HAS_WESENSORS
	help
	  Enable driver for the WSEN-HIDS I2C/SPI-based humidity sensor with integrated
	  temperature sensor.

if WSEN_HIDS

choice WSEN_HIDS_TRIGGER_MODE
	prompt "Trigger mode"
	default WSEN_HIDS_TRIGGER_NONE
	help
	  Specify the type of triggering to be used by the driver.

config WSEN_HIDS_TRIGGER_NONE
	bool "No trigger"

config WSEN_HIDS_TRIGGER_GLOBAL_THREAD
	bool "Use global thread"
	depends on GPIO
	select WSEN_HIDS_TRIGGER

config WSEN_HIDS_TRIGGER_OWN_THREAD
	bool "Use own thread"
	depends on GPIO
	select WSEN_HIDS_TRIGGER

endchoice # WSEN_HIDS_TRIGGER_MODE

config WSEN_HIDS_TRIGGER
	bool

config WSEN_HIDS_THREAD_PRIORITY
	int "Thread priority"
	depends on WSEN_HIDS_TRIGGER_OWN_THREAD
	default 10
	help
	  Priority of thread used by the driver to handle interrupts.

config WSEN_HIDS_THREAD_STACK_SIZE
	int "Thread stack size"
	depends on WSEN_HIDS_TRIGGER_OWN_THREAD
	default 1024
	help
	  Stack size of thread used by the driver to handle interrupts.

endif # WSEN_HIDS
```

## drivers/sensor/wsen/wsen_hids_2525020210001/Kconfig
```kconfig
# Copyright (c) 2023 Würth Elektronik eiSos GmbH & Co. KG
# SPDX-License-Identifier: Apache-2.0

menuconfig WSEN_HIDS_2525020210001
	bool "WSEN-HIDS-2525020210001 humidity and temperature sensor"
	default y
	depends on DT_HAS_WE_WSEN_HIDS_2525020210001_ENABLED
	select I2C if $(dt_compat_on_bus,$(DT_COMPAT_WE_WSEN_HIDS_2525020210001),i2c)
	select SPI if $(dt_compat_on_bus,$(DT_COMPAT_WE_WSEN_HIDS_2525020210001),spi)
	select HAS_WESENSORS
	help
	  Enable driver for the WSEN-HIDS I2C/SPI-based humidity sensor with integrated
	  temperature sensor.

if WSEN_HIDS_2525020210001

choice WSEN_HIDS_2525020210001_TRIGGER_MODE
	prompt "Trigger mode"
	default WSEN_HIDS_2525020210001_TRIGGER_NONE
	help
	  Specify the type of triggering to be used by the driver.

config WSEN_HIDS_2525020210001_TRIGGER_NONE
	bool "No trigger"

config WSEN_HIDS_2525020210001_TRIGGER_GLOBAL_THREAD
	bool "Use global thread"
	depends on GPIO
	select WSEN_HIDS_2525020210001_TRIGGER

config WSEN_HIDS_2525020210001_TRIGGER_OWN_THREAD
	bool "Use own thread"
	depends on GPIO
	select WSEN_HIDS_2525020210001_TRIGGER

endchoice # WSEN_HIDS_2525020210001_TRIGGER_MODE

config WSEN_HIDS_2525020210001_TRIGGER
	bool

config WSEN_HIDS_2525020210001_THREAD_PRIORITY
	int "Thread priority"
	depends on WSEN_HIDS_2525020210001_TRIGGER_OWN_THREAD
	default 10
	help
	  Priority of thread used by the driver to handle interrupts.

config WSEN_HIDS_2525020210001_THREAD_STACK_SIZE
	int "Thread stack size"
	depends on WSEN_HIDS_2525020210001_TRIGGER_OWN_THREAD
	default 1024
	help
	  Stack size of thread used by the driver to handle interrupts.

endif # WSEN_HIDS_2525020210001
```

## drivers/sensor/wsen/wsen_isds_2536030320001/Kconfig
```kconfig
# Copyright (c) 2025 Würth Elektronik eiSos GmbH & Co. KG
# SPDX-License-Identifier: Apache-2.0

menuconfig WSEN_ISDS_2536030320001
	bool "WSEN-ISDS 3D accelerometer and 3D gyroscope sensor"
	default y
	depends on DT_HAS_WE_WSEN_ISDS_2536030320001_ENABLED
	select I2C if $(dt_compat_on_bus,$(DT_COMPAT_WE_WSEN_ISDS_2536030320001),i2c)
	select SPI if $(dt_compat_on_bus,$(DT_COMPAT_WE_WSEN_ISDS_2536030320001),spi)
	select HAS_WESENSORS
	help
	  Enable driver for the WSEN-ISDS I2C/SPI-based 3D accelerometer and 3D gyroscope sensor
	  with integrated temperature sensor.

if WSEN_ISDS_2536030320001

config WSEN_ISDS_2536030320001_DISABLE_ACCEL_HIGH_PERFORMANCE_MODE
	bool "Disable accelerometer high performance mode"
	help
	  Disables accelerometer high performance mode. If high performance mode is disabled,
	  the ODR is used to switch between power modes as follows:
	  - 1.6 Hz - 52 Hz     Low power mode
	  - 104 Hz - 208 Hz    Normal power mode
	  - 416 Hz - 6.66 kHz  High performance mode

config WSEN_ISDS_2536030320001_DISABLE_GYRO_HIGH_PERFORMANCE_MODE
	bool "Disable gyroscope high performance mode"
	help
	  Disables gyroscope high performance mode. If high performance mode is disabled,
	  the ODR is used to switch between power modes as follows:
	  - 12.5 Hz - 52 Hz    Low power mode
	  - 104 Hz - 208 Hz    Normal power mode
	  - 416 Hz - 6.66 kHz  High performance mode

choice WSEN_ISDS_2536030320001_TRIGGER_MODE
	prompt "Trigger mode"
	default WSEN_ISDS_2536030320001_TRIGGER_NONE
	help
	  Specify the type of triggering to be used by the driver.

config WSEN_ISDS_2536030320001_TRIGGER_NONE
	bool "No trigger"

config WSEN_ISDS_2536030320001_TRIGGER_GLOBAL_THREAD
	bool "Use global thread"
	depends on GPIO
	select WSEN_ISDS_2536030320001_TRIGGER

config WSEN_ISDS_2536030320001_TRIGGER_OWN_THREAD
	bool "Use own thread"
	depends on GPIO
	select WSEN_ISDS_2536030320001_TRIGGER

endchoice # WSEN_ISDS_2536030320001_TRIGGER_MODE

config WSEN_ISDS_2536030320001_TRIGGER
	bool

config WSEN_ISDS_2536030320001_EVENTS
	bool

config WSEN_ISDS_2536030320001_THREAD_PRIORITY
	int "Thread priority"
	depends on WSEN_ISDS_2536030320001_TRIGGER_OWN_THREAD
	default 10
	help
	  Priority of thread used by the driver to handle interrupts.

config WSEN_ISDS_2536030320001_THREAD_STACK_SIZE
	int "Thread stack size"
	depends on WSEN_ISDS_2536030320001_TRIGGER_OWN_THREAD
	default 1024
	help
	  Stack size of thread used by the driver to handle interrupts.

config WSEN_ISDS_2536030320001_TAP
	bool "Tap and double tap detection"
	depends on WSEN_ISDS_2536030320001_TRIGGER
	select WSEN_ISDS_2536030320001_EVENTS
	help
	  Enable tap (single/double) detection
	  Note that the recommended ODRs for tap recognition are 416 Hz and 833 Hz.

config WSEN_ISDS_2536030320001_FREEFALL
	bool "Free-fall detection"
	depends on WSEN_ISDS_2536030320001_TRIGGER
	select WSEN_ISDS_2536030320001_EVENTS
	help
	  Enable free-fall detection

config WSEN_ISDS_2536030320001_DELTA
	bool "Wake-up detection (SENSOR_TRIG_DELTA)"
	depends on WSEN_ISDS_2536030320001_TRIGGER
	select WSEN_ISDS_2536030320001_EVENTS
	help
	  Enable wake-up detection (SENSOR_TRIG_DELTA)

endif # WSEN_ISDS_2536030320001
```

## drivers/sensor/wsen/wsen_itds_2533020201601/Kconfig
```kconfig
# Copyright (c) 2025 Würth Elektronik eiSos GmbH & Co. KG
# SPDX-License-Identifier: Apache-2.0

menuconfig WSEN_ITDS_2533020201601
	bool "WSEN-ITDS-2533020201601 3-axis acceleration sensor"
	default y
	depends on DT_HAS_WE_WSEN_ITDS_2533020201601_ENABLED
	select I2C if $(dt_compat_on_bus,$(DT_COMPAT_WE_WSEN_ITDS_2533020201601),i2c)
	select SPI if $(dt_compat_on_bus,$(DT_COMPAT_WE_WSEN_ITDS_2533020201601),spi)
	select HAS_WESENSORS
	help
	  Enable driver for the WSEN-ITDS I2C/SPI-based acceleration sensor with integrated
	  temperature sensor.

if WSEN_ITDS_2533020201601

choice WSEN_ITDS_2533020201601_TRIGGER_MODE
	prompt "Trigger mode"
	default WSEN_ITDS_2533020201601_TRIGGER_NONE
	help
	  Specify the type of triggering to be used by the driver.

config WSEN_ITDS_2533020201601_TRIGGER_NONE
	bool "No trigger"

config WSEN_ITDS_2533020201601_TRIGGER_GLOBAL_THREAD
	bool "Use global thread"
	depends on GPIO
	select WSEN_ITDS_2533020201601_TRIGGER

config WSEN_ITDS_2533020201601_TRIGGER_OWN_THREAD
	bool "Use own thread"
	depends on GPIO
	select WSEN_ITDS_2533020201601_TRIGGER

endchoice # WSEN_ITDS_2533020201601_TRIGGER_MODE

config WSEN_ITDS_2533020201601_TRIGGER
	bool

config WSEN_ITDS_2533020201601_EVENTS
	bool

config WSEN_ITDS_2533020201601_THREAD_PRIORITY
	int "Thread priority"
	depends on WSEN_ITDS_2533020201601_TRIGGER_OWN_THREAD
	default 10
	help
	  Priority of thread used by the driver to handle interrupts.

config WSEN_ITDS_2533020201601_THREAD_STACK_SIZE
	int "Thread stack size"
	depends on WSEN_ITDS_2533020201601_TRIGGER_OWN_THREAD
	default 1024
	help
	  Stack size of thread used by the driver to handle interrupts.

config WSEN_ITDS_2533020201601_TAP
	bool "Tap and double tap detection"
	depends on WSEN_ITDS_2533020201601_TRIGGER
	select WSEN_ITDS_2533020201601_EVENTS
	help
	  Enable tap (single/double) detection
	  Note that the minimum ODR required for using the tap recognition functionality is 400 Hz.

config WSEN_ITDS_2533020201601_FREEFALL
	bool "Free-fall detection"
	depends on WSEN_ITDS_2533020201601_TRIGGER
	select WSEN_ITDS_2533020201601_EVENTS
	help
	  Enable free-fall detection

config WSEN_ITDS_2533020201601_DELTA
	bool "Wake-up detection (SENSOR_TRIG_DELTA)"
	depends on WSEN_ITDS_2533020201601_TRIGGER
	select WSEN_ITDS_2533020201601_EVENTS
	help
	  Enable wake-up detection (SENSOR_TRIG_DELTA)

endif # WSEN_ITDS_2533020201601
```

## drivers/sensor/wsen/wsen_pads/Kconfig
```kconfig
# Copyright (c) 2023 Würth Elektronik eiSos GmbH & Co. KG
# SPDX-License-Identifier: Apache-2.0

menuconfig WSEN_PADS
	bool "WSEN-PADS absolute pressure and temperature sensor"
	default y
	depends on DT_HAS_WE_WSEN_PADS_ENABLED
	select I2C if $(dt_compat_on_bus,$(DT_COMPAT_WE_WSEN_PADS),i2c)
	select SPI if $(dt_compat_on_bus,$(DT_COMPAT_WE_WSEN_PADS),spi)
	select HAS_WESENSORS
	help
	  Enable driver for the WSEN-PADS I2C/SPI-based absolute pressure sensor with integrated
	  temperature sensor.

if WSEN_PADS

choice WSEN_PADS_TRIGGER_MODE
	prompt "Trigger mode"
	default WSEN_PADS_TRIGGER_NONE
	help
	  Specify the type of triggering to be used by the driver.

config WSEN_PADS_TRIGGER_NONE
	bool "No trigger"

config WSEN_PADS_TRIGGER_GLOBAL_THREAD
	bool "Use global thread"
	depends on GPIO
	select WSEN_PADS_TRIGGER

config WSEN_PADS_TRIGGER_OWN_THREAD
	bool "Use own thread"
	depends on GPIO
	select WSEN_PADS_TRIGGER

endchoice # WSEN_PADS_TRIGGER_MODE

config WSEN_PADS_TRIGGER
	bool

config WSEN_PADS_THREAD_PRIORITY
	int "Thread priority"
	depends on WSEN_PADS_TRIGGER_OWN_THREAD
	default 10
	help
	  Priority of thread used by the driver to handle interrupts.

config WSEN_PADS_THREAD_STACK_SIZE
	int "Thread stack size"
	depends on WSEN_PADS_TRIGGER_OWN_THREAD
	default 1024
	help
	  Stack size of thread used by the driver to handle interrupts.

endif # WSEN_PADS
```
