## drivers/sensor/wsen/wsen_pads_2511020213301/Kconfig
```kconfig
# Copyright (c) 2025 Würth Elektronik eiSos GmbH & Co. KG
# SPDX-License-Identifier: Apache-2.0

menuconfig WSEN_PADS_2511020213301
	bool "WSEN-PADS-2511020213301 absolute pressure and temperature sensor"
	default y
	depends on DT_HAS_WE_WSEN_PADS_2511020213301_ENABLED
	select I2C if $(dt_compat_on_bus,$(DT_COMPAT_WE_WSEN_PADS),i2c)
	select SPI if $(dt_compat_on_bus,$(DT_COMPAT_WE_WSEN_PADS),spi)
	select HAS_WESENSORS
	help
	  Enable driver for the WSEN-PADS-2511020213301 I2C/SPI-based absolute pressure sensor with integrated
	  temperature sensor.

if WSEN_PADS_2511020213301

choice WSEN_PADS_2511020213301_TRIGGER_MODE
	prompt "Trigger mode"
	default WSEN_PADS_2511020213301_TRIGGER_NONE
	help
	  Specify the type of triggering to be used by the driver.

config WSEN_PADS_2511020213301_TRIGGER_NONE
	bool "No trigger"

config WSEN_PADS_2511020213301_TRIGGER_GLOBAL_THREAD
	bool "Use global thread"
	depends on GPIO
	select WSEN_PADS_2511020213301_TRIGGER

config WSEN_PADS_2511020213301_TRIGGER_OWN_THREAD
	bool "Use own thread"
	depends on GPIO
	select WSEN_PADS_2511020213301_TRIGGER

endchoice # WSEN_PADS_2511020213301_TRIGGER_MODE

config WSEN_PADS_2511020213301_TRIGGER
	bool

config WSEN_PADS_2511020213301_THREAD_PRIORITY
	int "Thread priority"
	depends on WSEN_PADS_2511020213301_TRIGGER_OWN_THREAD
	default 10
	help
	  Priority of thread used by the driver to handle interrupts.

config WSEN_PADS_2511020213301_THREAD_STACK_SIZE
	int "Thread stack size"
	depends on WSEN_PADS_2511020213301_TRIGGER_OWN_THREAD
	default 1024
	help
	  Stack size of thread used by the driver to handle interrupts.

config WSEN_PADS_2511020213301_PRESSURE_THRESHOLD
	bool "Pressure threshold triggers"
	depends on WSEN_PADS_2511020213301_TRIGGER
	help
	  Allows you to set up triggers for high and/or low pressure thresholds.
	  if activated then data ready trigger can't be set up.

endif # WSEN_PADS_2511020213301
```

## drivers/sensor/wsen/wsen_pdus_25131308XXXXX/Kconfig
```kconfig
# Copyright (c) 2024 Würth Elektronik eiSos GmbH & Co. KG
# SPDX-License-Identifier: Apache-2.0

config WSEN_PDUS_25131308XXXXX
	bool "WSEN-PDUS-25131308XXXXX differential pressure sensor"
	default y
	depends on DT_HAS_WE_WSEN_PDUS_25131308XXXXX_ENABLED
	select I2C
	select HAS_WESENSORS
	help
	  Enable driver for the WSEN-PDUS-25131308XXXXX I2C-based differential pressure sensor.
```

## drivers/sensor/wsen/wsen_tids/Kconfig
```kconfig
# Copyright (c) 2022 Würth Elektronik eiSos GmbH & Co. KG
# SPDX-License-Identifier: Apache-2.0

menuconfig WSEN_TIDS
	bool "WSEN-TIDS temperature sensor"
	default y
	depends on DT_HAS_WE_WSEN_TIDS_ENABLED
	select I2C if $(dt_compat_on_bus,$(DT_COMPAT_WE_WSEN_TIDS),i2c)
	select HAS_WESENSORS
	help
	  Enable driver for the WSEN-TIDS I2C-based temperature sensor.

if WSEN_TIDS

choice WSEN_TIDS_TRIGGER_MODE
	prompt "Trigger mode"
	default WSEN_TIDS_TRIGGER_NONE
	help
	  Specify the type of triggering to be used by the driver.

config WSEN_TIDS_TRIGGER_NONE
	bool "No trigger"

config WSEN_TIDS_TRIGGER_GLOBAL_THREAD
	bool "Use global thread"
	depends on GPIO
	select WSEN_TIDS_TRIGGER

config WSEN_TIDS_TRIGGER_OWN_THREAD
	bool "Use own thread"
	depends on GPIO
	select WSEN_TIDS_TRIGGER

endchoice # WSEN_TIDS_TRIGGER_MODE

config WSEN_TIDS_TRIGGER
	bool

config WSEN_TIDS_THREAD_PRIORITY
	int "Thread priority"
	depends on WSEN_TIDS_TRIGGER_OWN_THREAD
	default 10
	help
	  Priority of thread used by the driver to handle interrupts.

config WSEN_TIDS_THREAD_STACK_SIZE
	int "Thread stack size"
	depends on WSEN_TIDS_TRIGGER_OWN_THREAD
	default 1024
	help
	  Stack size of thread used by the driver to handle interrupts.

endif # WSEN_TIDS
```

## drivers/sensor/wsen/wsen_tids_2521020222501/Kconfig
```kconfig
# Copyright (c) 2025 Würth Elektronik eiSos GmbH & Co. KG
# SPDX-License-Identifier: Apache-2.0

menuconfig WSEN_TIDS_2521020222501
	bool "WSEN-TIDS-2521020222501 temperature sensor"
	default y
	depends on DT_HAS_WE_WSEN_TIDS_2521020222501_ENABLED
	select I2C
	select HAS_WESENSORS
	help
	  Enable driver for the WSEN-TIDS-2521020222501 I2C-based temperature sensor.

if WSEN_TIDS_2521020222501

choice WSEN_TIDS_2521020222501_TRIGGER_MODE
	prompt "Trigger mode"
	default WSEN_TIDS_2521020222501_TRIGGER_NONE
	help
	  Specify the type of triggering to be used by the driver.

config WSEN_TIDS_2521020222501_TRIGGER_NONE
	bool "No trigger"

config WSEN_TIDS_2521020222501_TRIGGER_GLOBAL_THREAD
	bool "Use global thread"
	depends on GPIO
	select WSEN_TIDS_2521020222501_TRIGGER

config WSEN_TIDS_2521020222501_TRIGGER_OWN_THREAD
	bool "Use own thread"
	depends on GPIO
	select WSEN_TIDS_2521020222501_TRIGGER

endchoice # WSEN_TIDS_2521020222501_TRIGGER_MODE

config WSEN_TIDS_2521020222501_TRIGGER
	bool

config WSEN_TIDS_2521020222501_THREAD_PRIORITY
	int "Thread priority"
	depends on WSEN_TIDS_2521020222501_TRIGGER_OWN_THREAD
	default 10
	help
	  Priority of thread used by the driver to handle interrupts.

config WSEN_TIDS_2521020222501_THREAD_STACK_SIZE
	int "Thread stack size"
	depends on WSEN_TIDS_2521020222501_TRIGGER_OWN_THREAD
	default 1024
	help
	  Stack size of thread used by the driver to handle interrupts.

endif # WSEN_TIDS_2521020222501
```

## drivers/sensor/wsen_hids/Kconfig
```kconfig
# Copyright (c) 2022 Würth Elektronik eiSos GmbH & Co. KG
# SPDX-License-Identifier: Apache-2.0

config HAS_WEPLATFORM
	bool

menuconfig HIDS
	bool "WSEN-HIDS humidity and temperature sensor"
	depends on I2C || SPI
	select HAS_WEPLATFORM
	help
	  Enable driver for the WSEN-HIDS I2C/SPI-based humidity sensor with integrated temperature sensor.

if HIDS

choice HIDS_TRIGGER_MODE
	prompt "Trigger mode"
	default HIDS_TRIGGER_NONE
	help
	  Specify the type of triggering to be used by the driver.

config HIDS_TRIGGER_NONE
	bool "No trigger"

config HIDS_TRIGGER_GLOBAL_THREAD
	bool "Use global thread"
	depends on GPIO
	select HIDS_TRIGGER

config HIDS_TRIGGER_OWN_THREAD
	bool "Use own thread"
	depends on GPIO
	select HIDS_TRIGGER

endchoice # HIDS_TRIGGER_MODE

config HIDS_TRIGGER
	bool

config HIDS_THREAD_PRIORITY
	int "Thread priority"
	depends on HIDS_TRIGGER_OWN_THREAD
	default 10
	help
	  Priority of thread used by the driver to handle interrupts.

config HIDS_THREAD_STACK_SIZE
	int "Thread stack size"
	depends on HIDS_TRIGGER_OWN_THREAD
	default 1024
	help
	  Stack size of thread used by the driver to handle interrupts.

config HIDS_ODR
	string "Output data rate"
	default "1"
	help
	  Sensor output data rate expressed in samples per second.
	  Data rates supported by the chip are "1", "7" and "12.5".

endif # HIDS
```

## drivers/sensor/wsen_itds/Kconfig
```kconfig
# SPDX-License-Identifier: Apache-2.0
#
# Copyright (c) 2020 Linumiz

config ITDS
	bool "WSEN-ITDS 3-axis accel sensor"
	default y
	depends on DT_HAS_WE_WSEN_ITDS_ENABLED
	depends on I2C
	help
	  Enable Wurth Elektronik WSEN-ITDS 3-axis acceleration sensor
	  provides acceleration and die temperature measurement.

if ITDS

config ITDS_TRIGGER
	bool "Trigger mode"
	help
	  Set to enable trigger mode using gpio interrupt, interrupts are
	  configured to line INT0.

endif # ITDS
```

## drivers/sensor/wsen_pads/Kconfig
```kconfig
# Copyright (c) 2022 Würth Elektronik eiSos GmbH & Co. KG
# SPDX-License-Identifier: Apache-2.0

config HAS_WEPLATFORM
	bool

menuconfig PADS
	bool "WSEN-PADS absolute pressure and temperature sensor"
	depends on I2C || SPI
	select HAS_WEPLATFORM
	help
	  Enable driver for the WSEN-PADS I2C/SPI-based absolute pressure sensor with integrated temperature sensor.

if PADS

choice PADS_TRIGGER_MODE
	prompt "Trigger mode"
	default PADS_TRIGGER_NONE
	help
	  Specify the type of triggering to be used by the driver.

config PADS_TRIGGER_NONE
	bool "No trigger"

config PADS_TRIGGER_GLOBAL_THREAD
	bool "Use global thread"
	depends on GPIO
	select PADS_TRIGGER

config PADS_TRIGGER_OWN_THREAD
	bool "Use own thread"
	depends on GPIO
	select PADS_TRIGGER

endchoice # PADS_TRIGGER_MODE

config PADS_TRIGGER
	bool

config PADS_THREAD_PRIORITY
	int "Thread priority"
	depends on PADS_TRIGGER_OWN_THREAD
	default 10
	help
	  Priority of thread used by the driver to handle interrupts.

config PADS_THREAD_STACK_SIZE
	int "Thread stack size"
	depends on PADS_TRIGGER_OWN_THREAD
	default 1024
	help
	  Stack size of thread used by the driver to handle interrupts.

config PADS_ODR
	int "Output data rate"
	default 1
	range 0 200
	help
	  Sensor output data rate expressed in samples per second.
	  Data rates supported by the chip are:
	  0 Hz (Power down)
	  1 Hz
	  10 Hz
	  25 Hz
	  50 Hz
	  75 Hz
	  100 Hz
	  200 Hz

endif # PADS
```

## drivers/sensor/wsen_pdus/Kconfig
```kconfig
# Copyright (c) 2023 Würth Elektronik eiSos GmbH & Co. KG
# SPDX-License-Identifier: Apache-2.0

config WSEN_PDUS
	bool "WSEN-PDUS differential pressure sensor"
	default y
	depends on DT_HAS_WE_WSEN_PDUS_ENABLED
	select I2C if $(dt_compat_on_bus,$(DT_COMPAT_WE_WSEN_PDUS),i2c)
	select HAS_WESENSORS
	help
	  Enable driver for the WSEN-PDUS I2C-based differential pressure sensor.
```

## drivers/sensor/wsen_tids/Kconfig
```kconfig
# Copyright (c) 2022 Würth Elektronik eiSos GmbH & Co. KG
# SPDX-License-Identifier: Apache-2.0

config HAS_WEPLATFORM
	bool

menuconfig TIDS
	bool "WSEN-TIDS temperature sensor"
	depends on I2C
	select HAS_WEPLATFORM
	help
	  Enable driver for the WSEN-TIDS I2C-based temperature sensor.

if TIDS

choice TIDS_TRIGGER_MODE
	prompt "Trigger mode"
	default TIDS_TRIGGER_NONE
	help
	  Specify the type of triggering to be used by the driver.

config TIDS_TRIGGER_NONE
	bool "No trigger"

config TIDS_TRIGGER_GLOBAL_THREAD
	bool "Use global thread"
	depends on GPIO
	select TIDS_TRIGGER

config TIDS_TRIGGER_OWN_THREAD
	bool "Use own thread"
	depends on GPIO
	select TIDS_TRIGGER

endchoice # TIDS_TRIGGER_MODE

config TIDS_TRIGGER
	bool

config TIDS_THREAD_PRIORITY
	int "Thread priority"
	depends on TIDS_TRIGGER_OWN_THREAD
	default 10
	help
	  Priority of thread used by the driver to handle interrupts.

config TIDS_THREAD_STACK_SIZE
	int "Thread stack size"
	depends on TIDS_TRIGGER_OWN_THREAD
	default 1024
	help
	  Stack size of thread used by the driver to handle interrupts.

menu "Attributes"

config TIDS_TEMP_HI_THRESHOLD
	depends on TIDS_TRIGGER
	int "High temperature interrupt threshold"
	default 50
	help
	  Threshold for temperature high limit interrupt event

config TIDS_TEMP_LO_THRESHOLD
	depends on TIDS_TRIGGER
	int "Low temperature interrupt threshold"
	default 10
	help
	  Threshold for temperature low limit interrupt event

config TIDS_ODR
	int "Output data rate"
	range 25 200
	default 25
	help
	  Sensor output data rate expressed in samples per second.
	  Data rates supported by the chip are:
	  25 Hz
	  50 Hz
	  100 Hz
	  200 Hz

endmenu

endif # TIDS
```

## drivers/sensor/xbr818/Kconfig
```kconfig
# Copyright (c) 2024 MASSDRIVER EI (massdriver.space)
# SPDX-License-Identifier: Apache-2.0

config XBR818
	bool "XBR818 Radar"
	default y
	depends on DT_HAS_PHOSENSE_XBR818_ENABLED
	select I2C
	help
	  Enable driver for the Phosense XBR818 Radar Sensor
```

## drivers/sensor/xgzp68xxd/Kconfig
```kconfig
# XGZP68XXD Pressure sensor configuration options

# Copyright (c) 2026 Nexrem
# SPDX-License-Identifier: Apache-2.0

config XGZP68XXD
	bool "CFSensor XGZP68XXD pressure sensor"
	default y
	depends on DT_HAS_CFSENSOR_XGZP68XXD_ENABLED
	select I2C
	help
	  Enable driver for CFSensor XGZP68XXD pressure sensor.
```

## drivers/sensor/xmc4xxx_temp/Kconfig
```kconfig
# Copyright (c) 2023 Andriy Gelman <andriy.gelman@gmail.com>
# SPDX-License-Identifier: Apache-2.0

config XMC4XXX_TEMP
	bool "XMC4XXX Temperature Sensor"
	default y
	depends on DT_HAS_INFINEON_XMC4XXX_TEMP_ENABLED
	help
	  Enable driver for temperature sensor on Infineon XMC4XXX targets.

if XMC4XXX_TEMP

config XMC4XXX_TEMP_CALIBRATE_OFFSET
	int "Offset adjumstment of the temperature reading"
	default 0
	help
	  Offset adjustment is defined as a shift of the conversion result.
	  The value is 7 bits in the range [-64, 63] which maps to -/+ 12.5C.

config XMC4XXX_TEMP_CALIBRATE_GAIN
	int "Gain adjumstment of the temperature reading"
	default 32
	help
	  Gain adjustment of the temperature reading. Range [0, 63].

endif # XMC4XXX_TEMP
```
