## drivers/sensor/st/lps25hb/Kconfig
```kconfig
# Copyright (c) 2016 Intel Corporation
# SPDX-License-Identifier: Apache-2.0

menuconfig LPS25HB
	bool "LPS25HB pressure and temperature"
	default y
	depends on DT_HAS_ST_LPS25HB_PRESS_ENABLED
	select I2C
	help
	  Enable driver for LPS25HB I2C-based pressure and temperature
	  sensor.

config LPS25HB_SAMPLING_RATE
	int "Output data rate"
	default 25
	depends on LPS25HB
	help
	  Sensor output data rate expressed in samples per second.
	  Data rates supported by the chip are 1, 7, 13, 25.
```

## drivers/sensor/st/lps2xdf/Kconfig
```kconfig
# ST Microelectronics LPS2xDF pressure and temperature sensor

# Copyright (c) 2023 STMicroelectronics
# Copyright (c) 2023 PHYTEC Messtechnik GmbH
# SPDX-License-Identifier: Apache-2.0

menuconfig LPS2XDF
	bool "LPS2xDF pressure and temperature"
	default y
	depends on DT_HAS_ST_LPS22DF_ENABLED || DT_HAS_ST_LPS28DFW_ENABLED
	depends on ZEPHYR_HAL_ST_MODULE
	select I2C if $(dt_compat_on_bus,$(DT_COMPAT_ST_LPS22DF),i2c) ||\
		      $(dt_compat_on_bus,$(DT_COMPAT_ST_LPS28DFW),i2c)
	select I2C if $(dt_compat_on_bus,$(DT_COMPAT_ST_LPS22DF),i3c) ||\
		      $(dt_compat_on_bus,$(DT_COMPAT_ST_LPS28DFW),i3c)
	select SPI if $(dt_compat_on_bus,$(DT_COMPAT_ST_LPS22DF),spi)
	select HAS_STMEMSC
	select USE_STDC_LPS22DF if DT_HAS_ST_LPS22DF_ENABLED
	select USE_STDC_LPS28DFW if DT_HAS_ST_LPS28DFW_ENABLED
	help
	  Enable driver for LPS2xDF I2C-based pressure and temperature
	  sensor.

if LPS2XDF

choice LPS2XDF_TRIGGER_MODE
	prompt "Trigger mode"
	default LPS2XDF_TRIGGER_GLOBAL_THREAD
	help
	  Specify the type of triggering to be used by the driver.

config LPS2XDF_TRIGGER_NONE
	bool "No trigger"

config LPS2XDF_TRIGGER_GLOBAL_THREAD
	bool "Use global thread"
	depends on GPIO
	select LPS2XDF_TRIGGER

config LPS2XDF_TRIGGER_OWN_THREAD
	bool "Use own thread"
	depends on GPIO
	select LPS2XDF_TRIGGER

endchoice # LPS2XDF_TRIGGER_MODE

config LPS2XDF_TRIGGER
	bool

config LPS2XDF_THREAD_PRIORITY
	int "Thread priority"
	depends on LPS2XDF_TRIGGER_OWN_THREAD
	default 10
	help
	  Priority of thread used by the driver to handle interrupts.

config LPS2XDF_THREAD_STACK_SIZE
	int "Thread stack size"
	depends on LPS2XDF_TRIGGER_OWN_THREAD
	default 1024
	help
	  Stack size of thread used by the driver to handle interrupts.

endif # LPS2XDF
```

## drivers/sensor/st/lps33hw/Kconfig
```kconfig
# Copyright (c) 2026 RAKwireless Technology Limited
# SPDX-License-Identifier: Apache-2.0

config LPS33HW
	bool "LPS33HW pressure and temperature sensor"
	default y
	depends on DT_HAS_ST_LPS33HW_ENABLED
	select I2C
	help
	  Enable the I2C driver for the STMicroelectronics LPS33HW
	  pressure and temperature sensor.
```

## drivers/sensor/st/lsm6dsr/Kconfig
```kconfig
# LSM6DSR accelerometer and gyroscope sensor configuration
# options

# Copyright (c) 2025 Helbling Technik AG
# SPDX-License-Identifier: Apache-2.0

menuconfig LSM6DSR
	bool "LSM6DSR I2C/SPI accelerometer and gyroscope Chip"
	default y
	depends on DT_HAS_ST_LSM6DSR_ENABLED
	select I2C if $(dt_compat_on_bus,$(DT_COMPAT_ST_LSM6DSR),i2c)
	select SPI if $(dt_compat_on_bus,$(DT_COMPAT_ST_LSM6DSR),spi)
	help
	  Enable driver for LSM6DSR accelerometer and gyroscope
	  sensor.

if LSM6DSR

choice LSM6DSR_TRIGGER_MODE
	prompt "Trigger mode"
	help
	  Specify the type of triggering to be used by the driver.

config LSM6DSR_TRIGGER_NONE
	bool "No trigger"

config LSM6DSR_TRIGGER_GLOBAL_THREAD
	bool "Use global thread"
	depends on GPIO
	depends on $(dt_compat_any_has_prop,$(DT_COMPAT_ST_LSM6DSR),irq-gpios)
	select LSM6DSR_TRIGGER

config LSM6DSR_TRIGGER_OWN_THREAD
	bool "Use own thread"
	depends on GPIO
	depends on $(dt_compat_any_has_prop,$(DT_COMPAT_ST_LSM6DSR),irq-gpios)
	select LSM6DSR_TRIGGER

endchoice

config LSM6DSR_TRIGGER
	bool

config LSM6DSR_THREAD_PRIORITY
	int "Thread priority"
	depends on LSM6DSR_TRIGGER_OWN_THREAD
	default 10
	help
	  Priority of thread used by the driver to handle interrupts.

config LSM6DSR_THREAD_STACK_SIZE
	int "Thread stack size"
	depends on LSM6DSR_TRIGGER_OWN_THREAD
	default 1024
	help
	  Stack size of thread used by the driver to handle interrupts.


menu "Attributes"

config LSM6DSR_GYRO_FS
	int "Gyroscope full-scale range"
	default 0
	help
	  Specify the default gyroscope full-scale range.
	  An X value for the config represents a range of +/- X degree per
	  second. Valid values are:
	  0:  Full Scale selected at runtime
	  125:   +/- 125dps
	  250:   +/- 250dps
	  500:   +/- 500dps
	  1000:  +/- 1000dps
	  2000:  +/- 2000dps
	  4000:  +/- 4000dps

config LSM6DSR_GYRO_ODR
	int "Gyroscope Output data rate frequency"
	range 0 10
	default 0
	help
	  Specify the default accelerometer output data rate expressed in
	  samples per second (Hz).
	  0: ODR selected at runtime
	  1: 12.5Hz
	  2: 26Hz
	  3: 52Hz
	  4: 104Hz
	  5: 208Hz
	  6: 416Hz
	  7: 833Hz
	  8: 1660Hz
	  9: 3330Hz
	  10: 6660Hz

config LSM6DSR_ACCEL_FS
	int "Accelerometer full-scale range"
	default 0
	help
	  Specify the default accelerometer full-scale range.
	  An X value for the config represents a range of +/- X G. Valid values
	  are:
	  0:  Full Scale selected at runtime
	  2:  +/- 2g
	  4:  +/- 4g
	  8:  +/- 8g
	  16: +/- 16g

config LSM6DSR_ACCEL_ODR
	int "Accelerometer Output data rate frequency"
	range 0 11
	default 0
	help
	  Specify the default accelerometer output data rate expressed in
	  samples per second (Hz).
	  0: ODR selected at runtime
	  1: 12.5Hz
	  2: 26Hz
	  3: 52Hz
	  4: 104Hz
	  5: 208Hz
	  6: 416Hz
	  7: 833Hz
	  8: 1666Hz
	  9: 3332Hz
	  10: 6664Hz
	  11: 1.6Hz
endmenu

endif # LSM6DSR
```

## drivers/sensor/st/lsm6dsv16x/Kconfig
```kconfig
# ST Microelectronics LSM6DSV16X 6-axis IMU sensor driver

# Copyright (c) 2023 STMicroelectronics
# SPDX-License-Identifier: Apache-2.0

menuconfig LSM6DSV16X
	bool "LSM6DSV16X I2C/SPI accelerometer and gyroscope Chip"
	default y
	depends on DT_HAS_ST_LSM6DSV16X_ENABLED
	depends on ZEPHYR_HAL_ST_MODULE
	select I2C if $(dt_compat_on_bus,$(DT_COMPAT_ST_LSM6DSV16X),i2c)
	select SPI if $(dt_compat_on_bus,$(DT_COMPAT_ST_LSM6DSV16X),spi)
	select HAS_STMEMSC
	select USE_STDC_LSM6DSV16X
	select RTIO_WORKQ if SENSOR_ASYNC_API
	help
	  Enable driver for LSM6DSV16X accelerometer and gyroscope
	  sensor.

if LSM6DSV16X

config LSM6DSV16X_STREAM
	bool "Use hardware FIFO to stream data"
	select LSM6DSV16X_TRIGGER
	default y
	depends on I2C_RTIO || SPI_RTIO
	depends on SENSOR_ASYNC_API
	help
	  Use this config option to enable streaming sensor data via RTIO subsystem.

choice LSM6DSV16X_TRIGGER_MODE
	prompt "Trigger mode"
	help
	  Specify the type of triggering to be used by the driver.

config LSM6DSV16X_TRIGGER_NONE
	bool "No trigger"

config LSM6DSV16X_TRIGGER_GLOBAL_THREAD
	bool "Use global thread"
	depends on GPIO
	depends on $(dt_compat_any_has_prop,$(DT_COMPAT_ST_LSM6DSV16X),int1-gpios) ||\
		   $(dt_compat_any_has_prop,$(DT_COMPAT_ST_LSM6DSV16X),int2-gpios)
	select LSM6DSV16X_TRIGGER

config LSM6DSV16X_TRIGGER_OWN_THREAD
	bool "Use own thread"
	depends on GPIO
	depends on $(dt_compat_any_has_prop,$(DT_COMPAT_ST_LSM6DSV16X),int1-gpios) ||\
		   $(dt_compat_any_has_prop,$(DT_COMPAT_ST_LSM6DSV16X),int2-gpios)
	select LSM6DSV16X_TRIGGER

endchoice

config LSM6DSV16X_TRIGGER
	bool

if LSM6DSV16X_TRIGGER

config LSM6DSV16X_THREAD_PRIORITY
	int "Thread priority"
	depends on LSM6DSV16X_TRIGGER_OWN_THREAD
	default 10
	help
	  Priority of thread used by the driver to handle interrupts.

config LSM6DSV16X_THREAD_STACK_SIZE
	int "Thread stack size"
	depends on LSM6DSV16X_TRIGGER_OWN_THREAD
	default 1024
	help
	  Stack size of thread used by the driver to handle interrupts.

endif # LSM6DSV16X_TRIGGER

config LSM6DSV16X_ENABLE_TEMP
	bool "Temperature"
	help
	  Enable/disable temperature

config LSM6DSV16X_SENSORHUB
	bool "I2C sensorhub feature"
	help
	  Enable/disable internal sensorhub. You can enable
	  a maximum of two external sensors (if more than two are enabled
	  the system would enumerate only the first two found)

if LSM6DSV16X_SENSORHUB

config LSM6DSV16X_EXT_LIS2MDL
	bool "LIS2MDL as external sensor"
	default y

config LSM6DSV16X_EXT_LPS22HH
	bool "LPS22HH as external sensor"

config LSM6DSV16X_EXT_HTS221
	bool "HTS221 as external sensor"

config LSM6DSV16X_EXT_LPS22HB
	bool "LPS22HB as external sensor"

config LSM6DSV16X_EXT_LPS22DF
	bool "LPS22DF as external sensor"
	default y

endif # LSM6DSV16X_SENSORHUB

endif # LSM6DSV16X
```

## drivers/sensor/st/lsm6dsvxxx/Kconfig
```kconfig
# ST Microelectronics LSM6DSVXXX accelerometer sensor

# Copyright (c) 2025 STMicroelectronics
# SPDX-License-Identifier: Apache-2.0

menuconfig LSM6DSVXXX
	bool "LSM6DSVXXX IMU sensor"
	default y
	depends on DT_HAS_ST_LSM6DSV320X_ENABLED || DT_HAS_ST_LSM6DSV80X_ENABLED ||\
		   DT_HAS_ST_ISM6HG256X_ENABLED
	depends on ZEPHYR_HAL_ST_MODULE
	select I2C if $(dt_compat_on_bus,$(DT_COMPAT_ST_LSM6DSV320X),i2c) ||\
		      $(dt_compat_on_bus,$(DT_COMPAT_ST_LSM6DSV80X),i2c) ||\
		      $(dt_compat_on_bus,$(DT_COMPAT_ST_ISM6HG256X),i2c)
	select I3C if $(dt_compat_on_bus,$(DT_COMPAT_ST_LSM6DSV320X),i3c) ||\
		      $(dt_compat_on_bus,$(DT_COMPAT_ST_LSM6DSV80X),i3c) ||\
		      $(dt_compat_on_bus,$(DT_COMPAT_ST_ISM6HG256X),i3c)
	select SPI if $(dt_compat_on_bus,$(DT_COMPAT_ST_LSM6DSV320X),spi) ||\
		      $(dt_compat_on_bus,$(DT_COMPAT_ST_LSM6DSV80X),spi) ||\
		      $(dt_compat_on_bus,$(DT_COMPAT_ST_ISM6HG256X),spi)
	select HAS_STMEMSC
	select USE_STDC_LSM6DSV320X if DT_HAS_ST_LSM6DSV320X_ENABLED
	select USE_STDC_LSM6DSV80X if DT_HAS_ST_LSM6DSV80X_ENABLED
	select USE_STDC_ISM6HG256X if DT_HAS_ST_ISM6HG256X_ENABLED
	help
	  Enable driver for LSM6DSVXXX family IMU sensors.

if LSM6DSVXXX

config LSM6DSVXXX_STREAM
	bool "LSM6DSVXXX data streaming"
	select LSM6DSVXXX_TRIGGER
	default y
	depends on SPI_RTIO || I2C_RTIO || I3C_RTIO
	depends on SENSOR_ASYNC_API
	help
	  Use this config option to enable streaming sensor data via RTIO subsystem.

config LSM6DSVXXX_TRIGGER
	bool

config LSM6DSVXXX_ENABLE_TEMP
	bool "Temperature"
	help
	  Enable/disable temperature sensor


endif # LSM6DSVXXX
```

## drivers/sensor/st/lsm9ds0_gyro/Kconfig
```kconfig
# LSM9DS0 gyroscope sensor configuration options

# Copyright (c) 2016 Intel Corporation
# SPDX-License-Identifier: Apache-2.0

menuconfig LSM9DS0_GYRO
	bool "LSM9DS0 I2C gyroscope Chip"
	default y
	depends on DT_HAS_ST_LSM9DS0_GYRO_ENABLED
	select I2C
	help
	  Enable driver for LSM9DS0 I2C-based gyroscope sensor.

if LSM9DS0_GYRO

menu "Attributes"

choice
	prompt "Default full-scale"
	default LSM9DS0_GYRO_FULLSCALE_245
	help
	  Specify the default full-scale.

config LSM9DS0_GYRO_FULLSCALE_245
	bool "245 DPS"

config LSM9DS0_GYRO_FULLSCALE_500
	bool "500 DPS"

config LSM9DS0_GYRO_FULLSCALE_2000
	bool "2000 DPS"

endchoice

config LSM9DS0_GYRO_FULLSCALE_RUNTIME
	bool "Dynamic full-scale"
	help
	  Enable alteration of full-scale attribute at runtime.

choice
	prompt "Default sampling rate frequency"
	default LSM9DS0_GYRO_SAMPLING_RATE_95
	help
	  Specify the default sampling rate frequency.

config LSM9DS0_GYRO_SAMPLING_RATE_95
	bool "95 Hz"

config LSM9DS0_GYRO_SAMPLING_RATE_190
	bool "190 Hz"

config LSM9DS0_GYRO_SAMPLING_RATE_380
	bool "380 Hz"

config LSM9DS0_GYRO_SAMPLING_RATE_760
	bool "760 Hz"

endchoice

config LSM9DS0_GYRO_SAMPLING_RATE_RUNTIME
	bool "Dynamic sampling rate"
	help
	  Enable alteration of sampling rate frequency at runtime.

endmenu

config LSM9DS0_GYRO_TRIGGERS
	bool "Triggers"
	depends on GPIO
	depends on $(dt_compat_any_has_prop,$(DT_COMPAT_ST_LSM9DS0_GYRO),irq-gpios)

config LSM9DS0_GYRO_THREAD_STACK_SIZE
	int "Thread stack size"
	depends on LSM9DS0_GYRO_TRIGGERS
	default 1024
	help
	  Specify the internal thread stack size.

config LSM9DS0_GYRO_TRIGGER_DRDY
	bool "Data ready trigger"
	depends on LSM9DS0_GYRO_TRIGGERS

endif # LSM9DS0_GYRO
```

## drivers/sensor/st/qdec_stm32/Kconfig
```kconfig
# Copyright (c) 2022, Valerio Setti <vsetti@baylibre.com>
# SPDX-License-Identifier: Apache-2.0
#

config QDEC_STM32
	bool "STM32 QDEC driver"
	default y
	depends on DT_HAS_ST_STM32_QDEC_ENABLED
	select PINCTRL
	select USE_STM32_LL_TIM
	help
	  STM32 family Quadrature Decoder driver.
```

## drivers/sensor/st/stm32_digi_temp/Kconfig
```kconfig
# STM32 digital temperature sensor configuration options

# Copyright (c) 2024 Aurelien Jarno
# SPDX-License-Identifier: Apache-2.0

config STM32_DIGI_TEMP
	bool "STM32 Digital Temperature Sensor"
	default y
	depends on DT_HAS_ST_STM32_DIGI_TEMP_ENABLED
	depends on SOC_FAMILY_STM32
	help
	  Enable the driver for STM32 digital temperature sensor. This sensor
	  is different from the STM32 analog temperature sensor, which is read
	  by an ADC. While both drivers have similar code footprint, the analog
	  temperature driver also requires the ADC driver to be enabled. The
	  sensors differ in precision, accuracy and power consumption. Users
	  are encouraged to consult the datasheet to select the sensor that
	  best suits their needs.
```

## drivers/sensor/st/stm32_temp/Kconfig
```kconfig
# STM32 temperature sensor configuration options

# Copyright (c) 2021 Eug Krashtan
# SPDX-License-Identifier: Apache-2.0

config STM32_TEMP
	bool "STM32 Temperature Sensor"
	default y
	depends on SOC_FAMILY_STM32
	depends on DT_HAS_ST_STM32_ADC_ENABLED
	depends on DT_HAS_ST_STM32_TEMP_ENABLED || \
		   DT_HAS_ST_STM32_TEMP_CAL_ENABLED || \
		   DT_HAS_ST_STM32C0_TEMP_CAL_ENABLED
	select ADC
	help
	  Enable driver for STM32 temperature sensor.

if STM32_TEMP

config STM32_TEMP_INJECTED
	bool "STM32 Temperature Sensor through injected channel"
	depends on ADC_STM32_INJECTED_CHANNELS
	help
	  Temperature measurement is done using the injected channel feature.
	  This will permanently enable the ADC temperature sensor (VSENSESEL bit set to 1).

endif
```

## drivers/sensor/st/stm32_vbat/Kconfig
```kconfig
# STM32 battery sensor configuration options

# Copyright (c) 2022 STMicroelectronics
# SPDX-License-Identifier: Apache-2.0

config STM32_VBAT
	bool "STM32 Vbat/Vddcore Sensor"
	default y
	depends on DT_HAS_ST_STM32_VBAT_ENABLED || DT_HAS_ST_STM32_VDDCORE_ENABLED
	depends on DT_HAS_ST_STM32_ADC_ENABLED
	depends on SOC_FAMILY_STM32 && !SOC_SERIES_STM32F1X
	select ADC
	help
	  Enable driver for STM32 Vbat/Vddcore sensor and then also ADC

if STM32_VBAT

config STM32_VBAT_INJECTED
	bool "STM32 Vbat/Vddcore Sensor through injected channel"
	depends on ADC_STM32_INJECTED_CHANNELS
	help
	  Vbat/Vddcore measurement is done using the injected channel feature.
	  This will permanently enable the ADC channel for the sensor.

endif
```

## drivers/sensor/st/stm32_vddcore/Kconfig
```kconfig
# STM32 battery sensor configuration options

# Copyright (c) 2022 STMicroelectronics
# Copyright (c) 2026 CodeWrights GmbH
# SPDX-License-Identifier: Apache-2.0

config STM32_VDDCORE
	bool "STM32 Vddcore Sensor"
	default y
	depends on DT_HAS_ST_STM32_VDDCORE_ENABLED
	depends on DT_HAS_ST_STM32_ADC_ENABLED
	depends on SOC_FAMILY_STM32
	select ADC
	help
	  Enable driver for STM32 Vddcore sensor and then also ADC

if STM32_VDDCORE

config STM32_VDDCORE_INJECTED
	bool "STM32 Vddcore Sensor through injected channel"
	depends on ADC_STM32_INJECTED_CHANNELS
	help
	  Vddcore measurement is done using the injected channel feature.
	  This will permanently enable the ADC Vddcore channel.

endif
```
