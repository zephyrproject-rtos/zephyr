## drivers/sensor/silabs/gecko_acmp/Kconfig
```kconfig
# Copyright 2025 Kickmaker
# SPDX-License-Identifier: Apache-2.0

config GECKO_ACMP
	bool "SiLabs Gecko ACMP driver"
	default y
	depends on DT_HAS_SILABS_GECKO_ACMP_ENABLED
	select SOC_GECKO_ACMP
	select PM_DEVICE if PM && SOC_FAMILY_SILABS_S2
	help
	  Enable the SiLabs Gecko ACMP driver.

if GECKO_ACMP

config GECKO_ACMP_TRIGGER
	bool "ACMP trigger support"
	default y
	help
	  Enable trigger support for the SiLabs Gecko ACMP.

config GECKO_ACMP_TRIGGER_CHECK_STATE
	bool "ACMP trigger check state"
	default n
	depends on GECKO_ACMP_TRIGGER
	help
	  ISR request a trigger: check the current ACMP state coherency
	  in workqueue before throwing the trigger callback.

config GECKO_ACMP_EDGE_COUNTER
	bool "ACMP edge counter support"
	default n
	depends on GECKO_ACMP_TRIGGER
	help
	  Enable edge counter support for the SiLabs Gecko ACMP.
	  Processed directly in ISR context.

config GECKO_ACMP_DISABLE_ON_SUSPEND
	bool "ACMP peripheral disable on suspend"
	default n
	depends on PM_DEVICE
	help
	  ACMP peripheral will be disabled on device suspension.

config GECKO_ACMP_DISABLE_INTERRUPT_ON_SUSPEND
	bool "ACMP trigger support"
	default y
	depends on PM_DEVICE
	depends on GECKO_ACMP_TRIGGER
	help
	  Disable ISR before suspending device.
	  ACMP ISR will wakeup device from sleep up to EM3.

endif # GECKO_ACMP
```

## drivers/sensor/silabs/si7006/Kconfig
```kconfig
# Copyright (c) 2019 Electronut Labs
# SPDX-License-Identifier: Apache-2.0

config SI7006
	bool "SHT21, Si7006, and HTU21D Humidity and Temperature Sensors"
	default y
	depends on DT_HAS_SILABS_SI7006_ENABLED || DT_HAS_SENSIRION_SHT21_ENABLED
	select I2C
	help
	  Enable I2C-based driver for several humidity and temperature sensors
	  compatible with the Sensirion SHT21, such as the Silicon Labs
	  Si7006/13/20/21 and Measurement Specialties HTU21D
```

## drivers/sensor/simaccel/Kconfig
```kconfig
# Kconfig - SIMACCEL simulated 3-axis accelerometer sensor driver

#
# Copyright (c) 2019 Kevin Townsend
#
# SPDX-License-Identifier: Apache-2.0
#

menuconfig SIMACCEL
	bool "SIMACCEL simulated accelerometer sensor driver"
	help
	  Enable simulated 3-axis accelerometer sensor driver.

if SIMACCEL

choice
	prompt "Measurements per second"
	default SIMACCEL_MPS_1
	help
	  Number of measurements per second.

config SIMACCEL_MPS_1
	bool "1"

config SIMACCEL_MPS_10
	bool "10"

config SIMACCEL_MPS_100
	bool "100"

config SIMACCEL_MPS_1000
	bool "1000"

endchoice

endif # SIMACCEL
```

## drivers/sensor/sngcja5/Kconfig
```kconfig
# SN-GCJA5 laser particle sensor configuration options

# Copyright (c) 2023 Panasonic Industrial Devices Europe GmbH
# SPDX-License-Identifier: Apache-2.0

config SNGCJA5
	bool "SN-GCJA5 laser particle sensor"
	default y
	depends on DT_HAS_PANASONIC_SNGCJA5_ENABLED
	select I2C
	help
	  Enable driver for SN-GCJA5 laser particle sensor.
```

## drivers/sensor/st/Kconfig
```kconfig
# Copyright (c) 2024 Analog Devices, Inc.
# SPDX-License-Identifier: Apache-2.0

# zephyr-keep-sorted-start
source "drivers/sensor/st/hts221/Kconfig"
source "drivers/sensor/st/i3g4250d/Kconfig"
source "drivers/sensor/st/iis2dh/Kconfig"
source "drivers/sensor/st/iis2dlpc/Kconfig"
source "drivers/sensor/st/iis2iclx/Kconfig"
source "drivers/sensor/st/iis2mdc/Kconfig"
source "drivers/sensor/st/iis328dq/Kconfig"
source "drivers/sensor/st/iis3dhhc/Kconfig"
source "drivers/sensor/st/ism330dhcx/Kconfig"
source "drivers/sensor/st/lis2de12/Kconfig"
source "drivers/sensor/st/lis2dh/Kconfig"
source "drivers/sensor/st/lis2ds12/Kconfig"
source "drivers/sensor/st/lis2du12/Kconfig"
source "drivers/sensor/st/lis2dux12/Kconfig"
source "drivers/sensor/st/lis2dw12/Kconfig"
source "drivers/sensor/st/lis2mdl/Kconfig"
source "drivers/sensor/st/lis3mdl/Kconfig"
source "drivers/sensor/st/lps22hb/Kconfig"
source "drivers/sensor/st/lps22hh/Kconfig"
source "drivers/sensor/st/lps25hb/Kconfig"
source "drivers/sensor/st/lps2xdf/Kconfig"
source "drivers/sensor/st/lsm303dlhc_magn/Kconfig"
source "drivers/sensor/st/lsm6ds0/Kconfig"
source "drivers/sensor/st/lsm6dsl/Kconfig"
source "drivers/sensor/st/lsm6dso/Kconfig"
source "drivers/sensor/st/lsm6dso16is/Kconfig"
source "drivers/sensor/st/lsm6dsv16x/Kconfig"
source "drivers/sensor/st/lsm9ds0_gyro/Kconfig"
source "drivers/sensor/st/lsm9ds0_mfd/Kconfig"
source "drivers/sensor/st/lsm9ds1/Kconfig"
source "drivers/sensor/st/qdec_stm32/Kconfig"
source "drivers/sensor/st/stm32_digi_temp/Kconfig"
source "drivers/sensor/st/stm32_temp/Kconfig"
source "drivers/sensor/st/stm32_vbat/Kconfig"
source "drivers/sensor/st/stm32_vref/Kconfig"
source "drivers/sensor/st/stmemsc/Kconfig"
source "drivers/sensor/st/stts22h/Kconfig"
source "drivers/sensor/st/stts751/Kconfig"
source "drivers/sensor/st/vl53l0x/Kconfig"
source "drivers/sensor/st/vl53l1x/Kconfig"
# zephyr-keep-sorted-stop
```

## drivers/sensor/st/iis2mdc/Kconfig
```kconfig
# Copyright (c) 2020 STMicroelectronics
# SPDX-License-Identifier: Apache-2.0

menuconfig IIS2MDC
	bool "IIS2MDC Magnetometer"
	default y
	depends on DT_HAS_ST_IIS2MDC_ENABLED
	depends on ZEPHYR_HAL_ST_MODULE
	select I2C if $(dt_compat_on_bus,$(DT_COMPAT_ST_IIS2MDC),i2c)
	select SPI if $(dt_compat_on_bus,$(DT_COMPAT_ST_IIS2MDC),spi)
	select HAS_STMEMSC
	select USE_STDC_IIS2MDC
	help
	  Enable driver for IIS2MDC I2C-based magnetometer sensor.

if IIS2MDC

choice IIS2MDC_TRIGGER_MODE
	prompt "Trigger mode"
	default IIS2MDC_TRIGGER_GLOBAL_THREAD
	help
	  Specify the type of triggering to be used by the driver.

config IIS2MDC_TRIGGER_NONE
	bool "No trigger"

config IIS2MDC_TRIGGER_GLOBAL_THREAD
	bool "Use global thread"
	depends on GPIO
	depends on $(dt_compat_any_has_prop,$(DT_COMPAT_ST_IIS2MDC),drdy-gpios)
	select IIS2MDC_TRIGGER

config IIS2MDC_TRIGGER_OWN_THREAD
	bool "Use own thread"
	depends on GPIO
	depends on $(dt_compat_any_has_prop,$(DT_COMPAT_ST_IIS2MDC),drdy-gpios)
	select IIS2MDC_TRIGGER

endchoice # IIS2MDC_TRIGGER_MODE

config IIS2MDC_TRIGGER
	bool

config IIS2MDC_THREAD_PRIORITY
	int "Thread priority"
	depends on IIS2MDC_TRIGGER_OWN_THREAD
	default 10
	help
	  Priority of thread used by the driver to handle interrupts.

config IIS2MDC_THREAD_STACK_SIZE
	int "Thread stack size"
	depends on IIS2MDC_TRIGGER_OWN_THREAD
	default 1024
	help
	  Stack size of thread used by the driver to handle interrupts.

config IIS2MDC_MAG_ODR_RUNTIME
	bool "Set magnetometer sampling frequency (ODR) at runtime (default: 10 Hz)"
	default y

endif # IIS2MDC
```

## drivers/sensor/st/iis328dq/Kconfig
```kconfig
# ST Microelectronics IIS328DQ 3-axis accelerometer driver

# Copyright (c) 2020 STMicroelectronics
# Copyright (c) 2024 SILA Embedded Solutions GmbH
# SPDX-License-Identifier: Apache-2.0

menuconfig IIS328DQ
	bool "IIS328DQ I2C/SPI accelerometer sensor driver"
	default y
	depends on DT_HAS_ST_IIS328DQ_ENABLED
	depends on ZEPHYR_HAL_ST_MODULE
	select I2C if $(dt_compat_on_bus,$(DT_COMPAT_ST_IIS328DQ),i2c)
	select SPI if $(dt_compat_on_bus,$(DT_COMPAT_ST_IIS328DQ),spi)
	select HAS_STMEMSC
	select USE_STDC_IIS328DQ
	help
	  Enable driver for IIS328DQ accelerometer sensor driver

if IIS328DQ

module = IIS328DQ
thread_priority = 10
thread_stack_size = 1024
source "drivers/sensor/Kconfig.trigger_template"

if IIS328DQ_TRIGGER

config IIS328DQ_THRESHOLD
	bool "Threshold detection"
	help
	  Enable threshold interrupts

endif # IIS328DQ_TRIGGER

endif # IIS328DQ
```

## drivers/sensor/st/iis3dhhc/Kconfig
```kconfig
# ST Microelectronics IIS3DHHC accelerometer sensor

# Copyright (c) 2019 STMicroelectronics
# SPDX-License-Identifier: Apache-2.0

menuconfig IIS3DHHC
	bool "IIS3DHHC accelerometer sensor"
	default y
	depends on DT_HAS_ST_IIS3DHHC_ENABLED
	depends on ZEPHYR_HAL_ST_MODULE
	select SPI
	select HAS_STMEMSC
	select USE_STDC_IIS3DHHC
	help
	  Enable driver for IIS3DHHC SPI-based accelerometer sensor.

if IIS3DHHC

choice IIS3DHHC_TRIGGER_MODE
	prompt "Trigger mode"
	default IIS3DHHC_TRIGGER_GLOBAL_THREAD
	help
	  Specify the type of triggering to be used by the driver.

config IIS3DHHC_TRIGGER_NONE
	bool "No trigger"

config IIS3DHHC_TRIGGER_GLOBAL_THREAD
	bool "Use global thread"
	depends on GPIO
	select IIS3DHHC_TRIGGER

config IIS3DHHC_TRIGGER_OWN_THREAD
	bool "Use own thread"
	depends on GPIO
	select IIS3DHHC_TRIGGER

endchoice # IIS3DHHC_TRIGGER_MODE

config IIS3DHHC_TRIGGER
	bool

config IIS3DHHC_THREAD_PRIORITY
	int "Thread priority"
	depends on IIS3DHHC_TRIGGER_OWN_THREAD
	default 10
	help
	  Priority of thread used by the driver to handle interrupts.

config IIS3DHHC_THREAD_STACK_SIZE
	int "Thread stack size"
	depends on IIS3DHHC_TRIGGER_OWN_THREAD
	default 1024
	help
	  Stack size of thread used by the driver to handle interrupts.

menu "Attributes"

config IIS3DHHC_NORM_MODE
	bool "Sensor at 1KHz"
	default y

config IIS3DHHC_DRDY_INT1
	bool "Data ready interrupt to INT1 pin"
	depends on IIS3DHHC_TRIGGER
	default y
	help
	  Say Y to route data ready interrupt to INT1 pin. Say N to route to
	  INT2 pin.

endmenu

endif # IIS3DHHC
```

## drivers/sensor/st/iis3dwb/Kconfig
```kconfig
# ST Microelectronics IIS3DWB accelerometer sensor

# Copyright (c) 2025 STMicroelectronics
# SPDX-License-Identifier: Apache-2.0

menuconfig IIS3DWB
	bool "IIS3DWB accelerometer sensor"
	default y
	depends on DT_HAS_ST_IIS3DWB_ENABLED
	depends on ZEPHYR_HAL_ST_MODULE
	select SPI
	select HAS_STMEMSC
	select USE_STDC_IIS3DWB
	help
	  Enable driver for IIS3DWB SPI-based accelerometer sensor.

if IIS3DWB

config IIS3DWB_STREAM
	bool "IIS3DWB data streaming"
	select IIS3DWB_TRIGGER
	default y
	depends on SPI_RTIO
	depends on SENSOR_ASYNC_API
	help
	  Use this config option to enable streaming sensor data via RTIO subsystem.

config IIS3DWB_TRIGGER
	bool

config IIS3DWB_ENABLE_TEMP
	bool "Temperature"
	help
	  Enable/disable temperature sensor

endif # IIS3DWB
```

## drivers/sensor/st/ism330dhcx/Kconfig
```kconfig
# ST Microelectronics ISM330DHCX 6-axis IMU sensor driver

# Copyright (c) 2020 STMicroelectronics
# SPDX-License-Identifier: Apache-2.0

menuconfig ISM330DHCX
	bool "ISM330DHCX I2C/SPI accelerometer and gyroscope Chip"
	default y
	depends on DT_HAS_ST_ISM330DHCX_ENABLED
	depends on ZEPHYR_HAL_ST_MODULE
	select I2C if $(dt_compat_on_bus,$(DT_COMPAT_ST_ISM330DHCX),i2c)
	select SPI if $(dt_compat_on_bus,$(DT_COMPAT_ST_ISM330DHCX),spi)
	select HAS_STMEMSC
	select USE_STDC_ISM330DHCX
	help
	  Enable driver for ISM330DHCX accelerometer and gyroscope
	  sensor.

if ISM330DHCX

choice ISM330DHCX_TRIGGER_MODE
	prompt "Trigger mode"
	help
	  Specify the type of triggering to be used by the driver.

config ISM330DHCX_TRIGGER_NONE
	bool "No trigger"

config ISM330DHCX_TRIGGER_GLOBAL_THREAD
	bool "Use global thread"
	depends on GPIO
	select ISM330DHCX_TRIGGER

config ISM330DHCX_TRIGGER_OWN_THREAD
	bool "Use own thread"
	depends on GPIO
	select ISM330DHCX_TRIGGER

endchoice

config ISM330DHCX_TRIGGER
	bool

if ISM330DHCX_TRIGGER

config ISM330DHCX_THREAD_PRIORITY
	int "Thread priority"
	depends on ISM330DHCX_TRIGGER_OWN_THREAD
	default 10
	help
	  Priority of thread used by the driver to handle interrupts.

config ISM330DHCX_THREAD_STACK_SIZE
	int "Thread stack size"
	depends on ISM330DHCX_TRIGGER_OWN_THREAD
	default 1024
	help
	  Stack size of thread used by the driver to handle interrupts.

endif # ISM330DHCX_TRIGGER

config ISM330DHCX_ENABLE_TEMP
	bool "Temperature"
	help
	  Enable/disable temperature

config ISM330DHCX_SENSORHUB
	bool "I2C sensorhub feature"
	help
	  Enable/disable internal sensorhub. You can enable
	  a maximum of two external sensors (if more than two are enabled
	  the system would enumerate only the first two found)

if ISM330DHCX_SENSORHUB

config ISM330DHCX_EXT_LIS2MDL
	bool "LIS2MDL as external sensor"

config ISM330DHCX_EXT_IIS2MDC
	bool "IIS2MDC as external sensor"

config ISM330DHCX_EXT_LPS22HH
	bool "LPS22HH as external sensor"

config ISM330DHCX_EXT_HTS221
	bool "HTS221 as external sensor"

config ISM330DHCX_EXT_LPS22HB
	bool "LPS22HB as external sensor"

endif # ISM330DHCX_SENSORHUB

endif # ISM330DHCX
```

## drivers/sensor/st/lis2dux12/Kconfig
```kconfig
# ST Microelectronics LIS2DUX12 3-axis accelerometer driver

# Copyright (c) 2024 STMicroelectronics
# SPDX-License-Identifier: Apache-2.0

menuconfig LIS2DUX12
	bool "LIS2DUX12 I2C/SPI accelerometer sensor driver"
	default y
	depends on DT_HAS_ST_LIS2DUX12_ENABLED || DT_HAS_ST_LIS2DUXS12_ENABLED
	depends on ZEPHYR_HAL_ST_MODULE
	select I2C if $(dt_compat_on_bus,$(DT_COMPAT_ST_LIS2DUX12),i2c) || \
		      $(dt_compat_on_bus,$(DT_COMPAT_ST_LIS2DUXS12),i2c)
	select SPI if $(dt_compat_on_bus,$(DT_COMPAT_ST_LIS2DUX12),spi) || \
		      $(dt_compat_on_bus,$(DT_COMPAT_ST_LIS2DUXS12),spi)
	select HAS_STMEMSC
	select USE_STDC_LIS2DUX12 if DT_HAS_ST_LIS2DUX12_ENABLED
	select USE_STDC_LIS2DUXS12 if DT_HAS_ST_LIS2DUXS12_ENABLED
	help
	  Enable driver for LIS2DUX12 accelerometer sensor driver

if LIS2DUX12

module = LIS2DUX12
thread_priority = 10
thread_stack_size = 1024
source "drivers/sensor/Kconfig.trigger_template"

config LIS2DUX12_ENABLE_TEMP
	bool "Temperature"
	help
	  Enable/disable temperature

endif # LIS2DUX12
```

## drivers/sensor/st/lis3mdl/Kconfig
```kconfig
# Copyright (c) 2016 Intel Corporation
# SPDX-License-Identifier: Apache-2.0

menuconfig LIS3MDL
	bool "LIS3MDL magnetometer"
	default y
	depends on DT_HAS_ST_LIS3MDL_MAGN_ENABLED
	select I2C
	help
	  Enable driver for LIS3MDL I2C-based magnetometer.

if LIS3MDL

choice LIS3MDL_TRIGGER_MODE
	prompt "Trigger mode"
	default LIS3MDL_TRIGGER_GLOBAL_THREAD
	help
	  Specify the type of triggering to be used by the driver.

config LIS3MDL_TRIGGER_NONE
	bool "No trigger"

config LIS3MDL_TRIGGER_GLOBAL_THREAD
	bool "Use global thread"
	depends on GPIO
	depends on $(dt_compat_any_has_prop,$(DT_COMPAT_ST_LIS3MDL_MAGN),irq-gpios)
	select LIS3MDL_TRIGGER

config LIS3MDL_TRIGGER_OWN_THREAD
	bool "Use own thread"
	depends on GPIO
	depends on $(dt_compat_any_has_prop,$(DT_COMPAT_ST_LIS3MDL_MAGN),irq-gpios)
	select LIS3MDL_TRIGGER

endchoice # LIS3MDL_TRIGGER_MODE

config LIS3MDL_TRIGGER
	bool

config LIS3MDL_THREAD_PRIORITY
	int "Thread priority"
	depends on LIS3MDL_TRIGGER_OWN_THREAD
	default 10
	help
	  Priority of thread used by the driver to handle interrupts.

config LIS3MDL_THREAD_STACK_SIZE
	int "Thread stack size"
	depends on LIS3MDL_TRIGGER_OWN_THREAD
	default 1024
	help
	  Stack size of thread used by the driver to handle interrupts.

config LIS3MDL_ODR
	string "Output data rate"
	default "0.625"
	help
	  Magnetometer output data rate expressed in samples per second.
	  Data rates supported by the chip are 0.625, 1.25, 2.5, 5, 10, 20,
	  40, 80, 155, 300, 560 and 1000.

config LIS3MDL_FS
	int "Full-scale range"
	default 4
	help
	  Magnetometer full-scale range.
	  An X value for the config represents a range of +/- X gauss. Valid
	  values are 4, 8, 12 and 16.

endif # LIS3MDL
```

## drivers/sensor/st/lps22hb/Kconfig
```kconfig
# Copyright (c) 2017 Linaro Limited
# SPDX-License-Identifier: Apache-2.0

menuconfig LPS22HB
	bool "LPS22HB pressure and temperature"
	default y
	depends on DT_HAS_ST_LPS22HB_PRESS_ENABLED
	select I2C
	help
	  Enable driver for LPS22HB I2C-based pressure and temperature
	  sensor.

config LPS22HB_SAMPLING_RATE
	int "Output data rate"
	default 25
	depends on LPS22HB
	help
	  Sensor output data rate expressed in samples per second.
	  Data rates supported by the chip are 1, 10, 25, 50, 75.

config EMUL_LPS22HB
	bool "Emulate a st LPS22HB sensor"
	default y
	depends on EMUL
	depends on LPS22HB
	
	help
	  This is an emulator for the st LPS22HB sensor.
```
