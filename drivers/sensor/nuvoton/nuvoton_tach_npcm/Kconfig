## drivers/sensor/nuvoton/nuvoton_tach_npcm/Kconfig
```kconfig
# NPCM tachometer sensor configuration options

# Copyright (c) 2024 Nuvoton Technology Corporation.
# SPDX-License-Identifier: Apache-2.0

config TACH_NPCM
	bool "Nuvoton NPCM Tachometer sensor"
	default y
	depends on DT_HAS_NUVOTON_NPCM_TACH_ENABLED
	depends on SOC_FAMILY_NPCM
	help
	  Enable the "Nuvoton NPCM tachometer sensor.
```

## drivers/sensor/nuvoton/nuvoton_tach_npcx/Kconfig
```kconfig
# NPCX tachometer sensor configuration options

# Copyright (c) 2021 Nuvoton Technology Corporation.
# SPDX-License-Identifier: Apache-2.0

config TACH_NPCX
	bool "Nuvoton NPCX Tachometer sensor"
	default y
	depends on DT_HAS_NUVOTON_NPCX_TACH_ENABLED
	depends on SOC_FAMILY_NPCX
	select PINCTRL
	help
	  Enable the "Nuvoton NPCX tachometer sensor.
```

## drivers/sensor/nuvoton_adc_cmp_npcx/Kconfig
```kconfig
#  ADC CMP NPCX driver configuration options

# Copyright (c) 2022 Intel Corporation.
# SPDX-License-Identifier: Apache-2.0

if ADC_NPCX

config ADC_CMP_NPCX
	bool "Nuvoton NPCX ADC threshold detection interruption"
	help
	  This option enables threshold interruption using sensor
	  trigger API.

endif # ADC_NPCX
```

## drivers/sensor/nuvoton_tach_npcx/Kconfig
```kconfig
# NPCX tachometer sensor configuration options

# Copyright (c) 2021 Nuvoton Technology Corporation.
# SPDX-License-Identifier: Apache-2.0

config TACH_NPCX
	bool "Nuvoton NPCX Tachometer sensor"
	depends on SOC_FAMILY_NPCX
	help
	  Enable the "Nuvoton NPCX tachometer sensor.
```

## drivers/sensor/nxp/Kconfig
```kconfig
# Copyright (c) 2024 Analog Devices, Inc.
# SPDX-License-Identifier: Apache-2.0

# zephyr-keep-sorted-start
source "drivers/sensor/nxp/fxas21002/Kconfig"
source "drivers/sensor/nxp/fxos8700/Kconfig"
source "drivers/sensor/nxp/mcux_acmp/Kconfig"
source "drivers/sensor/nxp/mcux_lpcmp/Kconfig"
source "drivers/sensor/nxp/nxp_kinetis_temp/Kconfig"
source "drivers/sensor/nxp/nxp_tempmon/Kconfig"
source "drivers/sensor/nxp/qdec_mcux/Kconfig"
source "drivers/sensor/nxp/qdec_nxp_s32/Kconfig"
# zephyr-keep-sorted-stop
```

## drivers/sensor/nxp/eqdc_mcux/Kconfig
```kconfig
# SPDX-FileCopyrightText: 2026 NXP
# SPDX-License-Identifier: Apache-2.0

# NXP enhanced Quadrature Decoder (eQDC) configuration options
config EQDC_MCUX
	bool "NXP eQDC driver"
	default y
	depends on DT_HAS_NXP_MCUX_EQDC_ENABLED
	select NXP_INPUTMUX
	select PINCTRL
	help
	  Enable the NXP eQDC driver. The EQDC phase inputs are routed
	  through the on-chip INPUTMUX.

if EQDC_MCUX

config EQDC_MCUX_TRIGGER
	bool "EQDC trigger support"
	help
	  Enable trigger support for EQDC. This allows the driver to
	  generate interrupts on events like position roll-over/under.

endif # EQDC_MCUX
```

## drivers/sensor/nxp/fxls8974/Kconfig
```kconfig
# FXLS8974 3-axis accelerometer

# Copyright 2024 NXP
# SPDX-License-Identifier: Apache-2.0

menuconfig FXLS8974
	bool "FXLS8974 accelerometer driver"
	default y
	depends on DT_HAS_NXP_FXLS8974_ENABLED
	select I2C if $(dt_compat_on_bus,$(DT_COMPAT_NXP_FXLS8974),i2c)
	select SPI if $(dt_compat_on_bus,$(DT_COMPAT_NXP_FXLS8974),spi)
	help
	  Enable driver for the FXLS8974 accelerometer

if FXLS8974

choice
	prompt "Trigger mode"
	default FXLS8974_TRIGGER_NONE

config FXLS8974_TRIGGER_NONE
	bool "No trigger"

config FXLS8974_TRIGGER_GLOBAL_THREAD
	bool "Use global thread"
	depends on GPIO
	depends on $(dt_compat_any_has_prop,$(DT_COMPAT_NXP_FXLS8974),int1-gpios) || \
		   $(dt_compat_any_has_prop,$(DT_COMPAT_NXP_FXLS8974),int2-gpios)
	select FXLS8974_TRIGGER

config FXLS8974_TRIGGER_OWN_THREAD
	bool "Use own thread"
	select FXLS8974_TRIGGER

endchoice

config FXLS8974_TRIGGER
	bool

config FXLS8974_DRDY_INT1
	bool "Data ready interrupt to INT1 pin"
	depends on FXLS8974_TRIGGER
	help
	  Say Y to route data ready interrupt to INT1 pin. Say N to route to
	  INT2 pin.

if FXLS8974_TRIGGER

config FXLS8974_THREAD_PRIORITY
	int "Own thread priority"
	depends on FXLS8974_TRIGGER_OWN_THREAD
	default 10

config FXLS8974_THREAD_STACK_SIZE
	int "Own thread stack size"
	depends on FXLS8974_TRIGGER_OWN_THREAD
	default 1024

endif # FXLS8974_TRIGGER

endif # FXLS8974
```

## drivers/sensor/nxp/mcux_acmp/Kconfig
```kconfig
# NXP MCUX analog comparator (ACMP) configuration options

# Copyright (c) 2020 Vestas Wind Systems A/S
# Copyright 2024 NXP
# SPDX-License-Identifier: Apache-2.0

config SENSOR_MCUX_ACMP
	bool "NXP MCUX Analog Comparator (ACMP)"
	default y
	depends on DT_HAS_NXP_KINETIS_ACMP_ENABLED
	select PINCTRL
	select MCUX_ACMP
	help
	  Enable driver for the NXP MCUX Analog Comparator (ACMP).

config SENSOR_MCUX_ACMP_TRIGGER
	bool "Trigger support"
	depends on SENSOR_MCUX_ACMP
	help
	  Enable trigger support for the NXP MCUX Analog Comparator
	  (ACMP).
```

## drivers/sensor/nxp/mcux_eqdc/Kconfig
```kconfig
# Copyright 2026 NXP
# SPDX-License-Identifier: Apache-2.0

# NXP enhanced Quadrature Decoder (eQDC) configuration options
config MCUX_EQDC
	bool "NXP eQDC driver"
	default y
	depends on DT_HAS_NXP_MCUX_EQDC_ENABLED
	select MUX_CONTROL
	select PINCTRL
	help
	  Enable the NXP eQDC driver.

if MCUX_EQDC

config MCUX_EQDC_TRIGGER
	bool "EQDC trigger support"
	help
	  Enable trigger support for EQDC. This allows the driver to
	  generate interrupts on events like position roll-over/under.

endif # MCUX_EQDC
```

## drivers/sensor/nxp/mcux_lpcmp/Kconfig
```kconfig
# NXP MCUX low power comparator (LPCMP) configuration options

# Copyright 2024 NXP
# SPDX-License-Identifier: Apache-2.0

config MCUX_LPCMP
	bool "NXP LPCMP driver [DEPRECATED]"
	depends on DT_HAS_NXP_LPCMP_ENABLED
	depends on !COMPARATOR_NXP_LPCMP
	select PINCTRL
	select DEPRECATED
	help
	  Enable the MCUX LPCMP driver.

config MCUX_LPCMP_TRIGGER
	bool "Trigger support [DEPRECATED]"
	depends on MCUX_LPCMP
	help
	  Enable trigger support for the NXP LPCMP.
```

## drivers/sensor/nxp/nxp_lpadc_temp40/Kconfig
```kconfig
# NXP LPADC_TEMP40 temperature sensor configuration options

# Copyright 2025 NXP
# SPDX-License-Identifier: Apache-2.0

config LPADC_TEMP40
	bool "NXP LPADC_TEMP40 Temperature Sensor"
	default y
	depends on DT_HAS_NXP_LPADC_TEMP40_ENABLED
	select ADC
	help
	  Enable driver for NXP LPADC_TEMP40 temperature sensor.
```

## drivers/sensor/nxp/nxp_lpc_temp/Kconfig
```kconfig
# Copyright (c) 2025 Nova Dynamics LLC
# SPDX-License-Identifier: Apache-2.0

config TEMP_LPC
	bool "NXP LPC Temperature Sensor"
	default y
	depends on ADC_MCUX_LPADC && DT_HAS_NXP_LPC_TEMPERATURE_ENABLED
	help
	  Enable driver for NXP LPC internal temperature sensor.
```

## drivers/sensor/nxp/nxp_mcx_temp/Kconfig
```kconfig
# NXP MCX temperature sensor configuration options

# Copyright (c) 2025 Vestas Wind Systems A/S
# SPDX-License-Identifier: Apache-2.0

# NXP MCX temperature sensor configuration options

# Copyright (c) 2024 NXP
# SPDX-License-Identifier: Apache-2.0

config TEMP_MCX
	bool "NXP MCX Temperature Sensor"
	default y
	depends on DT_HAS_NXP_MCX_TEMPERATURE_ENABLED
	select ADC
	help
	  Enable driver for NXP MCX temperature sensor.
```

## drivers/sensor/nxp/nxp_pmc_tmpsns/Kconfig
```kconfig
# Copyright 2025-2026 NXP
# SPDX-License-Identifier: Apache-2.0

config NXP_PMC_TMPSNS
	bool "NXP PMC Temperature Sensor (TMPSNS)"
	default y
	depends on DT_HAS_NXP_PMC_TMPSNS_ENABLED
	imply OTP
	select FPU if CPU_HAS_FPU
	select NVMEM if $(dt_compat_any_has_prop,$(DT_COMPAT_NXP_PMC_TMPSNS),nvmem-cells)
	help
	  Enable driver for the NXP PMC temperature sensor.
	  This is used to retrieve on-die operational temperature.

if NXP_PMC_TMPSNS
config NXP_PMC_TMPSNS_USE_FLOAT_CALC
	bool "Use float and FPU"
	default y
	help
	  When enabled, the driver performs more floating-point
	  calculations. If your SoC has an FPU, it is recommended
	  to select this option. Testing has shown that enabling
	  this option results in shorter code execution times.

endif
```

## drivers/sensor/nxp/nxp_tempmon/Kconfig
```kconfig
# NXP temperature monitor (TEMPMON)

# Copyright (c) 2023 Centralp
# SPDX-License-Identifier: Apache-2.0

config NXP_TEMPMON
	bool "NXP temperature monitor (TEMPMON)"
	default y
	depends on DT_HAS_NXP_TEMPMON_ENABLED
	help
	  Enable driver for the NXP temperature monitor (TEMPMON).
	  This is used to retrieve on-die operational temperature.
```

## drivers/sensor/nxp/nxp_tempsense/Kconfig
```kconfig
# Copyright 2025 NXP
# SPDX-License-Identifier: Apache-2.0

config NXP_TEMPSENSE
	bool "NXP temperature sensor (TEMPSENSE)"
	default y
	depends on DT_HAS_NXP_TEMPSENSE_ENABLED
	depends on ADC
	help
	  Enable driver for the NXP temperature sensor.
```

## drivers/sensor/nxp/nxp_tmpsns/Kconfig
```kconfig
# NXP i.MX RT temperature sensor configuration options

# Copyright (c) 2025 Polytech A/S
# SPDX-License-Identifier: Apache-2.0

config NXP_TMPSNS
	bool "NXP TMPSNS sensor"
	depends on DT_HAS_NXP_TMPSNS_ENABLED
	select FPU
	default y
	help
	  Enable temperature measurement for NXP TMPSNS sensor
```

## drivers/sensor/nxp/p3t1755/Kconfig
```kconfig
# P3T1755 digital temperature sensor

# Copyright 2024 NXP
# SPDX-License-Identifier: Apache-2.0

config P3T1755
	bool "P3T1755 digital temperature sensor driver"
	default y
	depends on DT_HAS_NXP_P3T1755_ENABLED
	select I2C if $(dt_compat_on_bus,$(DT_COMPAT_NXP_P3T1755),i2c)
	select I3C if $(dt_compat_on_bus,$(DT_COMPAT_NXP_P3T1755),i3c)
	help
	  Enable driver for the P3T1755 digital temperature sensor.
```

## drivers/sensor/nxp/qdc_mcux/Kconfig
```kconfig
# Copyright 2026 NXP
# SPDX-License-Identifier: Apache-2.0

config QDC_MCUX
	bool "NXP QDC MCUX driver"
	default y
	depends on DT_HAS_NXP_MCUX_QDC_ENABLED
	select NXP_INPUTMUX
	select PINCTRL
	help
	  Enable support for NXP MCUX QDC driver.
```

## drivers/sensor/nxp/qdec_mcux/Kconfig
```kconfig
# Copyright (c) 2022, Prevas A/S
# Copyright 2026 NXP
# SPDX-License-Identifier: Apache-2.0

config QDEC_MCUX
	bool "NXP QDEC MCUX driver"
	default y
	depends on DT_HAS_NXP_MCUX_QDEC_ENABLED
	select MUX
	select PINCTRL
	help
	  Enable support for NXP MCUX Quadrature Encoder driver.
```

## drivers/sensor/nxp/qdec_nxp_s32/Kconfig
```kconfig
# Copyright 2023 NXP
# SPDX-License-Identifier: Apache-2.0

config QDEC_NXP_S32
	bool "NXP Quad Decoder S32 drivers"
	default y
	depends on DT_HAS_NXP_QDEC_S32_ENABLED
	select NXP_S32_EMIOS
	select PINCTRL
	help
	  Enable drivers for NXP S32 QUADRATURE DECODER
```

## drivers/sensor/nxp/qdec_tpm/Kconfig
```kconfig
# Copyright 2025 NXP
# SPDX-License-Identifier: Apache-2.0

config QDEC_TPM
	bool "NXP Quad Decoder TPM driver"
	default y
	depends on DT_HAS_NXP_TPM_QDEC_ENABLED
	select PINCTRL
	help
	  Enable drivers for NXP TPM QUADRATURE DECODER
```

## drivers/sensor/nxp_kinetis_temp/Kconfig
```kconfig
# NXP Kinetis temperature sensor configuration options

# Copyright (c) 2020 Vestas Wind Systems A/S
# SPDX-License-Identifier: Apache-2.0

config TEMP_KINETIS
	bool "NXP Kinetis Temperature Sensor"
	depends on (ADC && SOC_FAMILY_KINETIS)
	help
	  Enable driver for NXP Kinetis temperature sensor.

if TEMP_KINETIS

config TEMP_KINETIS_RESOLUTION
	int "ADC resolution"
	default 16 if HAS_MCUX_ADC16
	default 12 if HAS_MCUX_ADC12
	help
	  ADC resolution to use for the temperature sensor and bandgap
	  voltage readings.

config TEMP_KINETIS_OVERSAMPLING
	int "ADC oversampling"
	default 0
	range 0 5
	help
	  ADC oversampling to use for the temperature sensor and
	  bandgap voltage readings. Oversampling can help in providing
	  more stable readings.

config TEMP_KINETIS_FILTER
	bool "Digital filtering of ADC readings"
	help
	  Enable weighted average digital filtering of the ADC
	  readings as per NXP AN3031.

endif # TEMP_KINETIS
```

## drivers/sensor/odsl8/Kconfig
```kconfig
# Leuze ODSL8 distance sensor configuration options

# SPDX-License-Identifier: Apache-2.0

menuconfig ODSL8
	bool "Leuze ODSL8 distance sensor"
	help
	  Enable Leuze ODSL8 distance sensor
```

## drivers/sensor/omron/2smpb_02e/Kconfig
```kconfig
# Copyright (c) 2025 CATIE
# SPDX-License-Identifier: Apache-2.0

config 2SMPB_02E
	bool "OMRON 2SMPB_02E digital barometric pressure sensor"
	default y
	depends on DT_HAS_OMRON_2SMPB_02E_ENABLED
	select I2C
	select FPU if CPU_HAS_FPU
	help
	  Enable driver for OMRON O2SMPB_02E digital barometric pressure sensor.
```
