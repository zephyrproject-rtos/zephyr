## drivers/sensor/Kconfig.tmp112
```kconfig
# Kconfig.tmp112 - TMP112 temperature sensor configuration options

#
# Copyright (c) 2016 Firmwave
#
# Licensed under the Apache License, Version 2.0 (the "License");
# you may not use this file except in compliance with the License.
# You may obtain a copy of the License at
#
#     http://www.apache.org/licenses/LICENSE-2.0
#
# Unless required by applicable law or agreed to in writing, software
# distributed under the License is distributed on an "AS IS" BASIS,
# WITHOUT WARRANTIES OR CONDITIONS OF ANY KIND, either express or implied.
# See the License for the specific language governing permissions and
# limitations under the License.
#

menuconfig TMP112
	bool
	prompt "TMP112 Temperature Sensor"
	depends on SENSOR && I2C
	default n
	help
	Enable driver for TMP112 infrared thermopile sensors.

config TMP112_SYS_LOG_LEVEL
	int "TMP112 Log level"
	depends on SYS_LOG && TMP112
	default 0
	range 0 4
	help
	Sets log level for TMP112 driver.
	Levels are:

	0 OFF: do not write

	1 ERROR: only write SYS_LOG_ERR

	2 WARNING: write SYS_LOG_WRN in addition to previous level

	3 INFO: write SYS_LOG_INF in addition to previous levels

	4 DEBUG: write SYS_LOG_DBG in addition to previous levels

config TMP112_NAME
	string
	prompt "Driver name"
	default "TMP112"
	depends on TMP112
	help
	Device name with which the TMP112 sensor is identified.

config TMP112_INIT_PRIORITY
	int
	prompt "Init priority"
	depends on TMP112
	default 70
	help
	Device driver initialization priority.

choice
	prompt "I2C address"
	depends on TMP112
	default TMP112_I2C_ADDR_0
	help
	I2C address of the TMP112 sensor.

config TMP112_I2C_ADDR_0
	bool
	prompt "0x48"
	help
	A0 connected GND and A1 connected to GND.

config TMP112_I2C_ADDR_1
	bool
	prompt "0x49"
	help
	A0 connected VDD and A1 connected to GND.

config TMP112_I2C_ADDR_2
	bool
	prompt "0x4A"
	help
	A0 connected SDA and A1 connected to GND.

config TMP112_I2C_ADDR_3
	bool
	prompt "0x4B"
	help
	A0 connected SCL and A1 connected to GND.

endchoice

config TMP112_I2C_MASTER_DEV_NAME
	string
	prompt "I2C master where TMP112 is connected"
	depends on TMP112
	default "I2C_0"
	help
	Specify the device name of the I2C master device to which the
	TMP112 chip is connected.
```

## drivers/sensor/Kconfig.trigger_template
```kconfig
# Common Kconfig template for all sensors
# Copyright (c) 2023 STMicroelectronics
# SPDX-License-Identifier: Apache-2.0

choice "$(module)_TRIGGER_MODE"
	prompt "Trigger mode"
	help
	  Specify the type of triggering to be used by the sensor module.

config $(module)_TRIGGER_NONE
	bool "No trigger"

config $(module)_TRIGGER_GLOBAL_THREAD
	bool "Use global thread"
	depends on GPIO
	select $(module)_TRIGGER

config $(module)_TRIGGER_OWN_THREAD
	bool "Use own thread"
	depends on GPIO
	select $(module)_TRIGGER

endchoice

config $(module)_TRIGGER
	bool

if $(module)_TRIGGER

config $(module)_THREAD_PRIORITY
	int "Thread priority"
	depends on $(module)_TRIGGER_OWN_THREAD
	default $(thread_priority)
	help
	  Priority of thread used by the driver to handle interrupts.

config $(module)_THREAD_STACK_SIZE
	int "Thread stack size"
	depends on $(module)_TRIGGER_OWN_THREAD
	default $(thread_stack_size)
	help
	  Stack size of thread used by the driver to handle interrupts.

endif # $(module)_TRIGGER
```

## drivers/sensor/a01nyub/Kconfig
```kconfig
# Copyright (c) 2023 SteadConnect
# SPDX-License-Identifier: Apache-2.0

config A01NYUB
	bool "DFRobot A01NYUB distance sensor"
	default y
	depends on DT_HAS_DFROBOT_A01NYUB_ENABLED
	depends on UART_INTERRUPT_DRIVEN
	select UART_USE_RUNTIME_CONFIGURE
	help
	  Enable driver for the DFRobot A01NYUB distance sensor.
```

## drivers/sensor/acs71020/Kconfig
```kconfig
# ACS71020 line voltage current sensor configuration options

# SPDX-License-Identifier: Apache-2.0

menuconfig ACS71020
	bool "ACS71020 i2c isolated line voltage current sensor"
	depends on I2C
	help
	  Enable driver for ACS71020 i2c line voltage current sensor.

if ACS71020

choice
	prompt "ACS71020 trigger mode"
	default ACS71020_TRIGGER_NONE

config ACS71020_TRIGGER_NONE
	bool "No trigger"

config ACS71020_TRIGGER_GLOBAL_THREAD
	depends on GPIO
	select ACS71020_TRIGGER
	bool "Use global thread"

config ACS71020_TRIGGER_OWN_THREAD
	depends on GPIO
	select ACS71020_TRIGGER
	bool "Use own thread"

endchoice

config ACS71020_TRIGGER
	bool

config ACS71020_THREAD_STACK_SIZE
	int "Sensor delayed work thread stack size"
	depends on ACS71020_TRIGGER_OWN_THREAD
	default 1024

config ACS71020_THREAD_PRIORITY
	int "ACS71020 thread priority"
	depends on ACS71020_TRIGGER_OWN_THREAD
	default 10

endif # ACS71020
```

## drivers/sensor/ad74115h/Kconfig
```kconfig
/*
 * Copyright (c) 2026 William Fish (Manulytica ltd)
 *
 * SPDX-License-Identifier: Apache-2.0
 */

config AD74115H
	bool "AD74115H SW Configurable I/O Driver"
	default y
	depends on DT_HAS_ANALOG_AD74115H_ENABLED
	select SPI
	help
	  Enable driver for Analog Devices AD74115H.
```

## drivers/sensor/ad74416h/Kconfig
```kconfig
/*
* Copyright (c) 2026 William Fish (Manulytica ltd)
*
* SPDX-License-Identifier: Apache-2.0
*/

menuconfig AD74416H
  bool "AD74416H Quad-Channel SW Configurable I/O Driver"
  default y
  depends on DT_HAS_ANALOG_AD74416H_ENABLED
  select SPI
  select GPIO
  select DAC
  help
    Enable driver for Analog Devices AD74416H.

if AD74416H

config AD74416H_NVS_CALIBRATION
  bool "NVS Persistence for Calibration"
  select NVS
  help
    Store gain/offset calibration values in Non-Volatile Storage.

config AD74416H_RTD_MATH
  bool "Internal RTD Temperature Math"
  default y
  help
    Enable Callendar-Van Dusen math to convert RTD resistance to Celsius.

endif # AD74416H
```

## drivers/sensor/adc/Kconfig
```kconfig
# Copyright (c) 2026 Nordic Semiconductor ASA
# SPDX-License-Identifier: Apache-2.0

config SENSOR_ADC
	bool "Sensor ADC virtual device driver support"
	default y
	depends on DT_HAS_SENSOR_ADC_ENABLED
	select ADC
	select ADC_ASYNC
	select SENSOR_ASYNC_API
	help
	  The sensor ADC is a virtual device which exposes ADC device's channels as
	  SENSOR_CHAN_VOLTAGE sensor channels.
```

## drivers/sensor/adc_thermistor/Kconfig
```kconfig
# Generic ADC temperature sensor configuration options

# Copyright (c) 2023 Basalte bv
# SPDX-License-Identifier: Apache-2.0

config ADC_THERMISTOR
	bool "ADC Temperature Sensor"
	default y
	depends on DT_HAS_ZEPHYR_ADC_THERMISTOR_ENABLED
	select ADC
	help
	  Enable driver for generic ADC temperature thermistor sensor.
```

## drivers/sensor/adi/Kconfig
```kconfig
# Copyright (c) 2024 Analog Devices, Inc.
# SPDX-License-Identifier: Apache-2.0

# zephyr-keep-sorted-start
source "drivers/sensor/adi/adltc2990/Kconfig"
source "drivers/sensor/adi/adt7310/Kconfig"
source "drivers/sensor/adi/adt7420/Kconfig"
source "drivers/sensor/adi/adxl345/Kconfig"
source "drivers/sensor/adi/adxl362/Kconfig"
source "drivers/sensor/adi/adxl367/Kconfig"
source "drivers/sensor/adi/adxl372/Kconfig"
# zephyr-keep-sorted-stop
```

## drivers/sensor/adi/ad2s1210/Kconfig
```kconfig
# Copyright (c) 2025, Kickmaker
# SPDX-License-Identifier: Apache-2.0

config AD2S1210
	bool "AD2S1210 10-bit to 16-bit resolution tracking resolver-to-digital converter"
	default y
	depends on DT_HAS_ADI_AD2S1210_ENABLED
	select GPIO
	select SPI
	help
	  Enable AD2S1210 10-bit to 16-bit resolution tracking resolver-to-digital converter.
```

## drivers/sensor/adi/ade7978/Kconfig
```kconfig
# Copyright (c) 2026 Filip Stojanovic <filipembedded@gmail.com>
# SPDX-License-Identifier: Apache-2.0

config ADE7978
	bool "ADE7978 Isolated energy metering chipset for polyphase shunt meters"
	default y
	depends on DT_HAS_ADI_ADE7978_ENABLED
	select SPI
	help
		Enable the driver for Analog Devices ADE7978 isolated energy chipset
		for polyphase shunt meters.

config ADE7978_SHUNT_RESISTOR
	int "Shunt resistor value"
	default 200
	help
		Value of shunt resistor in uOhms

config ADE7978_VOLTAGE_DIVIDER
	int "Voltage divider ratio"
	default 1131
	help
		Voltage divider factor
```

## drivers/sensor/adi/ade9153a/Kconfig
```kconfig
#
# ADE9153a Energy metering IC configuration options
#
# Copyright (c) 2025 Plentify (Pty) Ltd.
# SPDX-License-Identifier: Apache-2.0

menuconfig ADE9153A
	bool "ADE9153A Energy metering IC with autocalibration"
	default y
	depends on DT_HAS_ADI_ADE9153A_ENABLED
	select SPI
	help
	  Enable driver for ADE9153A Energy metering IC.

if ADE9153A

config ADE9153A_RESET_ACTIVE_TIME
	int "The amount of time (ms) spent between toggling the reset pin on startup"
	default 100
	help
	  The time the reset pin will be holding down during reset.

config ADE9153A_POST_RESET_DELAY
	int "The amount of time (ms) spent after reset on startup"
	default 1000
	help
	  The delay to wait after resetting the ADE9153A

config ADE9153A_AUTO_CALIBRATE
	bool "Auto calibrate"
	default y
	help
	  After initialized, the sensor driver will start the autocalibration procedure.

config ADE9153A_AI_PGAGAIN
	hex "Current channel A PGAGAIN value"
	default "0x000A"
	help
	  Signal on IAN, current channel gain

config ADE9153A_BI_CURRENT_CHANNEL
	bool "Use B current channel"

config ADE9153A_BI_PGAGAIN
	hex "Current channel B PGAGAIN value"
	default "0x0000"
	depends on ADE9153A_BI_CURRENT_CHANNEL
	help
	  Signal on BI, current channel gain

config  ADE9153A_CONFIG0
	hex "CONFIG0 settings"
	default "0x00000000"

config  ADE9153A_CONFIG1
	hex "CONFIG1 settings"
	default "0x0300"

config  ADE9153A_CONFIG2
	hex "CONFIG2 settings"
	default "0x0C00"

config  ADE9153A_CONFIG3
	hex "CONFIG3 settings"
	default "0x0000"

config  ADE9153A_ACCMODE
	hex "Energy accumulation modes, Bit 4, 0 for 50Hz, 1 for 60Hz"
	default "0x0010"

config  ADE9153A_VLEVEL
	hex "Assuming Vnom=1/2 of fullscale"
	default "0x002C11E8"

config  ADE9153A_ZX_CFG
	hex "ZX low-pass filter select"
	default "0x0000"

config  ADE9153A_MASK
	hex "Interrupt mask"
	default "0x00000100"

config  ADE9153A_ACT_NL_LVL
	hex "No load threshold for Active power"
	default "0x000033C8"

config  ADE9153A_REACT_NL_LVL
	hex "No load threshold for Reactive power"
	default "0x000033C8"

config  ADE9153A_APP_NL_LVL
	hex "No load threshold for Apparent power"
	default "0x000033C8"

config  ADE9153A_RUN_ON
	hex "DSP on"
	default "0x0001"


config  ADE9153A_COMPMODE
	hex "Computation mode register"
	default "0x0005"

config  ADE9153A_VDIV_RSMALL
	hex "Small resistor on board is 1kOhm=0x3E8"
	default "0x03E8"

config  ADE9153A_EP_CFG
	hex "Energy accumulation configuration"
	default "0x0009"

config  ADE9153A_EGY_TIME
	hex "Accumulate energy for 4000 samples"
	default "0x0F9F"

config  ADE9153A_TEMP_CFG
	hex "Temperature sensor configuration"
	default "0x000C"


config  ADE9153A_SETUP_ON_STARTUP
	bool "Run the setup during startup"
	default y

config  ADE9153A_ACAL_ON_STARTUP
	bool "Run autocalibration on startup"
	default y

# FIXME: [rodrigopex] Take a look at the comment values.
# Ideal Calibration Values for EV-ADE9153ASHIELDZ Shield Based on Sensor Values
# shield value 0.838190 = Q31(value=7031246, shift=0)
config  ADE9153A_CAL_IRMS_CC
	int "RMS current Calibration Constant (CC) Q31 value"
	default 1799999318
	help
	  The original default value is 0.838190. The Kconfig value is: (0.838190 * 0x7FFFFF)/(1U << shift))
	  . In the driver the value
	  will be recovered as follows: (1799999318 /(double) 0x7FFFFFFF)) * (1U << shift) =
	  0.8381899999.

config  ADE9153A_CAL_IRMS_CC_SHIFT
	int "RMS current Calibration Constant (CC) Q31 shift value"
	default 0

config  ADE9153A_CAL_VRMS_CC # shield value 13.41105 = Q31(value=7031251, shift=4)
	int "RMS voltage Calibration Constant (CC) Q31 value"
	default 1800000660
	help
	  Same happens as CAL_IRMS_CC.
# FIXME: [rodrigopex] Move the complete documentation to the first Q31 value in the Kconfig to help developers
config  ADE9153A_CAL_VRMS_CC_SHIFT
	int "RMS voltage Calibration Constant (CC) Q31 shift value"
	default 4
	help
	  Number used to scale the number. ADE9153A_CAL_VRMS_CC/(1U << ADE9153A_CAL_VRMS_CC_SHIFT)
	  to keep the number inside the interval [-1.0, 1.0[. The default original value is
	  13.41105. To make that normalized we need to use a shift of 7. The value is (13.41105/1U
	  << 7) = 0.104773827877256.

	  include <stdint.h>
	  include <stdio.h>

	  int main(int argc, char *argv[]) {
		double original_value = 13.41105;
		uint8_t shift = 7;
		int64_t q_value = (original_value / (1U << shift)) * INT32_MAX; // 0x7FFFFF
		double recovered_value = ((double)(q_value) / INT32_MAX) * (1U << shift);
		printf("The result is %0.20lf\n", recovered_value);
		return 0;
	  }

config  ADE9153A_CAL_POWER_CC # shield value 1508.743 = Q31(value=6179810, shift=11)
	int "Power Calibration Constant (CC) Q31 value"
	default 1582031699

config  ADE9153A_CAL_POWER_CC_SHIFT
	int "Power Calibration Constant (CC) Q31 shift value"
	default 11

config  ADE9153A_CAL_ENERGY_CC # shield value 0.858307 = Q31(value=7200000, shift=0)
	int "Energy Calibration Constant (CC) Q31 value"
	default 1843200246

config  ADE9153A_CAL_ENERGY_CC_SHIFT
	int "Energy Calibration Constant (CC) Q31 shift value"
	default 0

config  ADE9153A_AI_TURBO_CAL_TIME
	int "The time spent on the current turbo calibration in milliseconds"
	default 2000

config  ADE9153A_AV_TURBO_CAL_TIME
	int "The time spent on the voltage turbo calibration in milliseconds"
	default 4000

config ADE9153A_TRIGGER
	bool "Trigger on"

if ADE9153A_TRIGGER

config ADE9153A_THREAD_STACK_SIZE
	int "Trigger thread stack size."
	default 1024

config ADE9153A_THREAD_PRIORITY
	int "Trigger thread priority."
	default 4

config ADE9153A_TRIGGER_IRQ
	bool "Trigger on IRQ"
	default y
	depends on GPIO

config ADE9153A_TRIGGER_CF
	bool "Trigger on CF"
	default y
	depends on GPIO

endif # ADE9153A_TRIGGER

endif # ADE9153A
```

## drivers/sensor/adi/adis1647x/Kconfig
```kconfig
# ADIS1647x, 6-DoF MEMS IMU

# Copyright (c) 2026 Analog Devices, Inc.
# SPDX-License-Identifier: Apache-2.0

menuconfig ADIS1647X
	bool "ADIS1647x 6-DoF MEMS IMU"
	default y
	depends on DT_HAS_ADI_ADIS1647X_ENABLED
	select SPI
	select SPI_RTIO if SENSOR_ASYNC_API
	select RTIO if SENSOR_ASYNC_API
	help
	  Enable driver for ADIS1647x 6-DoF MEMS IMU.

if ADIS1647X

choice ADIS1647X_TRIGGER_MODE
	prompt "Trigger mode"
	default ADIS1647X_TRIGGER_NONE
	help
	  Specify the type of triggering used by the driver.

config ADIS1647X_TRIGGER_NONE
	bool "No trigger"

config ADIS1647X_TRIGGER_GLOBAL_THREAD
	bool "Use global thread"
	depends on GPIO
	depends on $(dt_compat_any_has_prop,$(DT_COMPAT_ADI_ADIS1647X),drdy-gpios)
	select ADIS1647X_TRIGGER

config ADIS1647X_TRIGGER_OWN_THREAD
	bool "Use own thread"
	depends on GPIO
	depends on $(dt_compat_any_has_prop,$(DT_COMPAT_ADI_ADIS1647X),drdy-gpios)
	select ADIS1647X_TRIGGER

endchoice

config ADIS1647X_STREAM
	bool "Stream IMU data via RTIO"
	depends on SPI_RTIO
	depends on SENSOR_ASYNC_API
	depends on $(dt_compat_any_has_prop,$(DT_COMPAT_ADI_ADIS1647X),drdy-gpios)
	depends on ADIS1647X_TRIGGER_GLOBAL_THREAD || ADIS1647X_TRIGGER_OWN_THREAD
	select ADIS1647X_TRIGGER
	help
	  Use this configuration option to enable streaming sensor data via RTIO
	  on the DRDY interrupt. Requires SPI_RTIO, a drdy-gpios pin in
	  devicetree, and a trigger thread mode selected.

config ADIS1647X_TRIGGER
	bool

config ADIS1647X_THREAD_PRIORITY
	int "Thread priority"
	depends on ADIS1647X_TRIGGER_OWN_THREAD && ADIS1647X_TRIGGER
	default 10
	help
	  Priority of thread used by the driver to handle interrupts.

config ADIS1647X_THREAD_STACK_SIZE
	int "Thread stack size"
	depends on ADIS1647X_TRIGGER_OWN_THREAD && ADIS1647X_TRIGGER
	default 1024
	help
	  Stack size of thread used by the driver to handle interrupts.

endif # ADIS1647X
```
