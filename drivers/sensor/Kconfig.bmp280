## drivers/sensor/Kconfig.max44009
```kconfig
# Kconfig.max44009 - MAX44009 light sensor configuration options

#
# Copyright (c) 2016 Intel Corporation
#
# Licensed under the Apache License, Version 2.0 (the "License");
# you may not use this file except in compliance with the License.
# You may obtain a copy of the License at
#
#     http://www.apache.org/licenses/LICENSE-2.0
#
# Unless required by applicable law or agreed to in writing, software
# distributed under the License is distributed on an "AS IS" BASIS,
# WITHOUT WARRANTIES OR CONDITIONS OF ANY KIND, either express or implied.
# See the License for the specific language governing permissions and
# limitations under the License.
#

menuconfig MAX44009
	bool
	prompt "MAX44009 Light Sensor"
	depends on SENSOR && I2C
	default n
	help
	Enable driver for MAX44009 light sensors.

config MAX44009_SYS_LOG_LEVEL
	int "MAX44009 Log level"
	depends on SYS_LOG && MAX44009
	default 0
	range 0 4
	help
	Sets log level for MAX44009 driver.
	Levels are:

	- 0 OFF: do not write

	- 1 ERROR: only write SYS_LOG_ERR

	- 2 WARNING: write SYS_LOG_WRN in addition to previous level

	- 3 INFO: write SYS_LOG_INF in addition to previous levels

	- 4 DEBUG: write SYS_LOG_DBG in addition to previous levels

config MAX44009_DRV_NAME
	string
	prompt "Driver name"
	default "MAX44009"
	depends on MAX44009
	help
	Device name with which the MAX44009 light is identified.


config MAX44009_I2C_ADDR
	hex
	prompt "MAX44009 I2C address"
	depends on MAX44009
	default "0x4a"
	help
	I2C address of the MAX44009 sensor. Possible configurations:

	0x4a: A0 connected to GND.
	0x4b: A0 connected to VCC.

config MAX44009_I2C_DEV_NAME
	string
	prompt "I2C master where MAX44009 is connected"
	depends on MAX44009
	default "I2C_0"
	help
	Specify the device name of the I2C master device to which the
	MAX44009 chip is connected.
```

## drivers/sensor/Kconfig.mpu6050
```kconfig
# Kconfig.mpu6050 - MPU6050 Six-Axis Motion Tracking device configuration options

#
# Copyright (c) 2016 Intel Corporation
#
# Licensed under the Apache License, Version 2.0 (the "License");
# you may not use this file except in compliance with the License.
# You may obtain a copy of the License at
#
#     http://www.apache.org/licenses/LICENSE-2.0
#
# Unless required by applicable law or agreed to in writing, software
# distributed under the License is distributed on an "AS IS" BASIS,
# WITHOUT WARRANTIES OR CONDITIONS OF ANY KIND, either express or implied.
# See the License for the specific language governing permissions and
# limitations under the License.
#

menuconfig MPU6050
	bool
	prompt "MPU6050 Six-Axis Motion Tracking Device"
	depends on SENSOR && I2C
	default n
	help
	  Enable driver for MPU6050 I2C-based six-axis motion tracking device.

config MPU6050_SYS_LOG_LEVEL
	int "MPU6050 Log level"
	depends on SYS_LOG && MPU6050
	default 0
	range 0 4
	help
	  Sets log level for MPU6050 driver.
	  Levels are:
	  0 OFF, do not write
	  1 ERROR, only write SYS_LOG_ERR
	  2 WARNING, write SYS_LOG_WRN in addition to previous level
	  3 INFO, write SYS_LOG_INF in addition to previous levels
	  4 DEBUG, write SYS_LOG_DBG in addition to previous levels

config MPU6050_NAME
	string
	prompt "Driver name"
	default "MPU6050"
	depends on MPU6050
	help
	  Device name with which the MPU6050 sensor is identified.

config MPU6050_INIT_PRIORITY
	int
	prompt "Init priority"
	depends on MPU6050
	default 70
	help
	  Device driver initialization priority.

config MPU6050_I2C_ADDR
	hex
	prompt "I2C address"
	depends on MPU6050
	default 0x68
	range 0x68 0x69
	help
	  I2C address of the MPU6050 sensor.
	  Choose 0x68 if the AD0 pin is pulled to GND or 0x69 if the AD0 pin
	  is pulled to VDD.

config MPU6050_I2C_MASTER_DEV_NAME
	string
	prompt "I2C master where MPU6050 is connected"
	depends on MPU6050
	default "I2C_0"
	help
	  Specify the device name of the I2C master device to which MPU6050 is
	  connected.

choice
	prompt "Trigger mode"
	depends on MPU6050
	default MPU6050_TRIGGER_GLOBAL_FIBER
	help
	  Specify the type of triggering to be used by the driver.

config MPU6050_TRIGGER_NONE
	bool
	prompt "No trigger"

config MPU6050_TRIGGER_GLOBAL_FIBER
	bool
	prompt "Use global fiber"
	depends on GPIO && SYSTEM_WORKQUEUE
	select MPU6050_TRIGGER

config MPU6050_TRIGGER_OWN_FIBER
	bool
	prompt "Use own fiber"
	depends on GPIO
	select MPU6050_TRIGGER

endchoice

config MPU6050_TRIGGER
	bool
	depends on MPU6050

config MPU6050_GPIO_DEV_NAME
	string
	prompt "GPIO device"
	default "GPIO_0"
	depends on MPU6050 && MPU6050_TRIGGER
	help
	  The device name of the GPIO device to which the MPU6050 interrupt pin
	  is connected.

config MPU6050_GPIO_PIN_NUM
	int
	prompt "Interrupt GPIO pin number"
	default 0
	depends on MPU6050 && MPU6050_TRIGGER
	help
	  The number of the GPIO on which the interrupt signal from the MPU6050
	  chip will be received.

config MPU6050_FIBER_PRIORITY
	int
	prompt "Fiber priority"
	depends on MPU6050 && MPU6050_TRIGGER_OWN_FIBER
	default 10
	help
	  Priority of fiber used by the driver to handle interrupts.

config MPU6050_FIBER_STACK_SIZE
	int
	prompt "Fiber stack size"
	depends on MPU6050 && MPU6050_TRIGGER_OWN_FIBER
	default 1024
	help
	  Stack size of fiber used by the driver to handle interrupts.

config MPU6050_ACCEL_FS
	int
	prompt "Accelerometer full-scale range"
	depends on MPU6050
	default 2
	help
	  Magnetometer full-scale range.
	  An X value for the config represents a range of +/- X g. Valid
	  values are 2, 4, 8 and 16.

config MPU6050_GYRO_FS
	int
	prompt "Gyroscope full-scale range"
	depends on MPU6050
	default 250
	help
	  Gyroscope full-scale range.
	  An X value for the config represents a range of +/- X degrees/second.
	  Valid values are 250, 500, 1000, 2000.
```

## drivers/sensor/Kconfig.sensor_clock
```kconfig
# Sensor clock configuration options
# Copyright(c) 2024 Cienet
# SPDX-License-Identifier: Apache-2.0

config SENSOR_CLOCK
	bool
	default y if SENSOR_ASYNC_API
	help
	  Configure the sensor clock source for the system.

if SENSOR_CLOCK

choice
	prompt "Sensor clock type"
	default SENSOR_CLOCK_SYSTEM
	help
	  Select the clock source to be used for sensor timing.

config SENSOR_CLOCK_SYSTEM
	bool "Use the system counter for sensor time"

config SENSOR_CLOCK_COUNTER
	bool "Use a counter device/API for sensor time"

config SENSOR_CLOCK_RTC
	bool "Use an RTC device/API for sensor time"

endchoice

endif # SENSOR_CLOCK
```

## drivers/sensor/Kconfig.sensor_v2
```kconfig
# Sensor V2 configuration options

# Copyright (c) 2016 Intel Corporation
# SPDX-License-Identifier: Apache-2.0

choice SENSOR_VERSION
	prompt "Select the version of the sensor API to use"
	default SENSOR_VERSION_1

config SENSOR_VERSION_1
	bool "V1 of the Sensor API"

config SENSOR_VERSION_2
	bool "V2 of the Sensor API"
	help
	  This sensor API is derived from Android's CHRE's sensor API and is required for the Zephyr
	  sensor subsystem (WIP).

endchoice # SENSOR_VERSION

if SENSOR_VERSION_2

config SENSOR_STREAMING_MODE
	bool "Implement the sensor APIs needed for streaming sensor events"
	default y
	help
	  This enables the various sample rate functionalities of the sensor API as well as FIFO
	  control.

config SENSOR_HW_CALIBRATION
	bool "Implement hardware calibration APIs when available"
	help
	  This enables the sensor_perform_calibration() API for sensors that support live
	  calibration.

endif # SENSOR_VERSION_2
```

## drivers/sensor/Kconfig.sht3xd
```kconfig
# Kconfig.sht3xd - SHT3xD temperature and humidity sensor configuration options

#
# Copyright (c) 2016 Intel Corporation
#
# Licensed under the Apache License, Version 2.0 (the "License");
# you may not use this file except in compliance with the License.
# You may obtain a copy of the License at
#
#     http://www.apache.org/licenses/LICENSE-2.0
#
# Unless required by applicable law or agreed to in writing, software
# distributed under the License is distributed on an "AS IS" BASIS,
# WITHOUT WARRANTIES OR CONDITIONS OF ANY KIND, either express or implied.
# See the License for the specific language governing permissions and
# limitations under the License.
#

menuconfig SHT3XD
	bool
	prompt "SHT3xD Temperature and Humidity Sensor"
	depends on SENSOR && I2C
	default n
	help
	  Enable driver for SHT3xD temperature and humidity sensors.

config SHT3XD_NAME
	string
	prompt "Driver name"
	default "SHT3XD"
	depends on SHT3XD
	help
	  Device name with which the SHT3xD sensor is identified.

config SHT3XD_INIT_PRIORITY
	int
	prompt "Init priority"
	depends on SHT3XD
	default 70
	help
	  Device driver initialization priority.

choice
	prompt "I2C address"
	depends on SHT3XD
	default SHT3XD_I2C_ADDR_A
	help
	  I2C address of the SHT3xD sensor.

config SHT3XD_I2C_ADDR_A
	bool
	prompt "0x44"
	help
	  Choose this option if the ADDR pin is connected to VSS.

config SHT3XD_I2C_ADDR_B
	bool
	prompt "0x45"
	help
	  Choose this option if the ADDR pin is connected to VDD.

endchoice

config SHT3XD_I2C_MASTER_DEV_NAME
	string
	prompt "I2C master where SHT3xD is connected"
	depends on SHT3XD
	default "I2C_0"
	help
	  Specify the device name of the I2C master device to which the
	  SHT3xD chip is connected.

choice
	prompt "Trigger mode"
	depends on SHT3XD
	default SHT3XD_TRIGGER_NONE
	help
	  Specify the type of triggering to be used by the driver.

config SHT3XD_TRIGGER_NONE
	bool
	prompt "No trigger"

config SHT3XD_TRIGGER_GLOBAL_FIBER
	bool
	prompt "Use global fiber"
	depends on GPIO
	select SHT3XD_TRIGGER
	select SENSOR_DELAYED_WORK

config SHT3XD_TRIGGER_OWN_FIBER
	bool
	prompt "Use own fiber"
	depends on GPIO
	select SHT3XD_TRIGGER

endchoice

config SHT3XD_TRIGGER
	bool
	depends on SHT3XD

config SHT3XD_GPIO_DEV_NAME
	string
	prompt "GPIO device"
	default "GPIO_0"
	depends on SHT3XD && SHT3XD_TRIGGER
	help
	  The device name of the GPIO device to which the SHT3xD interrupt
	  pins are connected.

config SHT3XD_GPIO_PIN_NUM
	int
	prompt "Interrupt GPIO pin number"
	default 0
	depends on SHT3XD && SHT3XD_TRIGGER
	help
	  The number of the GPIO on which the interrupt signal from the
	  SHT3xD chip will be received.

config SHT3XD_FIBER_PRIORITY
	int
	prompt "Fiber priority"
	depends on SHT3XD && SHT3XD_TRIGGER_OWN_FIBER
	default 10
	help
	  Priority of fiber used by the driver to handle interrupts.

config SHT3XD_FIBER_STACK_SIZE
	int
	prompt "Fiber stack size"
	depends on SHT3XD && SHT3XD_TRIGGER_OWN_FIBER
	default 1024
	help
	  Stack size of fiber used by the driver to handle interrupts.

choice
	prompt "Measurement repeatability"
	depends on SHT3XD
	default SHT3XD_REPEATABILITY_HIGH
	help
	  Repeatability modes differ with respect to measurement duration,
	  noise level and energy consumption.

config SHT3XD_REPEATABILITY_LOW
	bool
	prompt "low"

config SHT3XD_REPEATABILITY_MEDIUM
	bool
	prompt "medium"

config SHT3XD_REPEATABILITY_HIGH
	bool
	prompt "high"

endchoice

choice
	prompt "Measurements per second"
	depends on SHT3XD
	default SHT3XD_MPS_1
	help
	  Number of measurements per second.

config SHT3XD_MPS_05
	bool
	prompt "0.5"

config SHT3XD_MPS_1
	bool
	prompt "1"

config SHT3XD_MPS_2
	bool
	prompt "2"

config SHT3XD_MPS_4
	bool
	prompt "4"

config SHT3XD_MPS_10
	bool
	prompt "10"

endchoice
```

## drivers/sensor/Kconfig.sx9500
```kconfig
# Kconfig.sx9500 - SX9500 SAR proximity sensor configuration options

#
# Copyright (c) 2016 Intel Corporation
#
# Licensed under the Apache License, Version 2.0 (the "License");
# you may not use this file except in compliance with the License.
# You may obtain a copy of the License at
#
#     http://www.apache.org/licenses/LICENSE-2.0
#
# Unless required by applicable law or agreed to in writing, software
# distributed under the License is distributed on an "AS IS" BASIS,
# WITHOUT WARRANTIES OR CONDITIONS OF ANY KIND, either express or implied.
# See the License for the specific language governing permissions and
# limitations under the License.
#

menuconfig SX9500
	bool "SX9500 I2C SAR Proximity Chip"
	depends on SENSOR && I2C
	default n
	help
	  Enable driver for SX9500 I2C-based SAR proximity sensor.

config SX9500_SYS_LOG_LEVEL
	int "SX9500 Log level"
	depends on SYS_LOG && SX9500
	default 0
	range 0 4
	help
	Sets log level for SX9500 driver.
	Levels are:

	- 0 OFF: do not write

	- 1 ERROR: only write SYS_LOG_ERR

	- 2 WARNING: write SYS_LOG_WRN in addition to previous level

	- 3 INFO: write SYS_LOG_INF in addition to previous levels

	- 4 DEBUG: write SYS_LOG_DBG in addition to previous levels

config SX9500_DEV_NAME
	string "SX9500 device name"
	depends on SX9500
	default "SX9500"

config SX9500_INIT_PRIORITY
	int
	depends on SX9500
	default 70
	prompt "Init priority"
	help
	  Device driver initialization priority.

config SX9500_I2C_ADDR
	hex "SX9500 I2C slave address"
	depends on SX9500
	default 0x2B
	help
	  Specify the I2C slave address for the SX9500.

config SX9500_I2C_DEV_NAME
	string "I2C master where SX9500 is connected"
	depends on SX9500
	default "I2C_0"
	help
	  Specify the device name of the I2C master device to which SX9500 is
	  connected.

config SX9500_PROX_CHANNEL
	int
	default 3
	depends on SX9500
	prompt "Proximity channel to use"
	help
	  The SX9500 offers 4 separate proximity channels.  Choose which one
	  you are using.  Valid numbers are 0 to 3.

choice
	prompt "SX9500 trigger mode"
	depends on SX9500
	default SX9500_TRIGGER_GLOBAL_FIBER

config SX9500_TRIGGER_NONE
	bool "No trigger"

config SX9500_TRIGGER_GLOBAL_FIBER
	depends on GPIO && SYSTEM_WORKQUEUE
	select SX9500_TRIGGER
	bool "Use global fiber"

config SX9500_TRIGGER_OWN_FIBER
	depends on GPIO
	select SX9500_TRIGGER
	bool "Use own fiber"

endchoice

config SX9500_TRIGGER
	bool
	depends on SX9500

config SX9500_GPIO_CONTROLLER
	string "GPIO controller for SX9500 interrupt"
	depends on SX9500 && SX9500_TRIGGER
	default GPIO_0
	help
	  Specify the device name of the GPIO controller the SX9500 interrupt
	  is connected to.

config SX9500_GPIO_PIN
	int "GPIO pin for SX9500 interrupt"
	depends on SX9500 && SX9500_TRIGGER
	default 3

config SX9500_FIBER_STACK_SIZE
	int "Sensor delayed work fiber stack size"
	depends on SX9500 && SX9500_TRIGGER_OWN_FIBER
	default 1024

config SX9500_FIBER_PRIORITY
	int "Fiber priority"
	depends on SX9500 && SX9500_TRIGGER_OWN_FIBER
	default 10
```
