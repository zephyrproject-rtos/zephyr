## drivers/sensor/Kconfig.bmp280
```kconfig
# Kconfig.bmp280 - BMP280 temperature and pressure sensor configuration options

#
# Copyright (c) 2016 Intel Corporation
#
# Licensed under the Apache License, Version 2.0 (the "License");
# you may not use this file except in compliance with the License.
# You may obtain a copy of the License at
#
#     http://www.apache.org/licenses/LICENSE-2.0
#
# Unless required by applicable law or agreed to in writing, software
# distributed under the License is distributed on an "AS IS" BASIS,
# WITHOUT WARRANTIES OR CONDITIONS OF ANY KIND, either express or implied.
# See the License for the specific language governing permissions and
# limitations under the License.
#
menuconfig BMP280
	bool "BMP280 temperature and pressure sensor"
	depends on SENSOR && I2C
	default n
	help
	 Enable driver for BMP280 I2C-based temperature and pressure sensor.

config BMP280_SYS_LOG_LEVEL
	int "BMP280 Log level"
	depends on SYS_LOG && BMP280
	default 0
	range 0 4
	help
	  Sets log level for BMP280 driver.
	  Levels are:
	  0 OFF, do not write
	  1 ERROR, only write SYS_LOG_ERR
	  2 WARNING, write SYS_LOG_WRN in addition to previous level
	  3 INFO, write SYS_LOG_INF in addition to previous levels
	  4 DEBUG, write SYS_LOG_DBG in addition to previous levels

config BMP280_DEV_NAME
	string "BMP280 device name"
	depends on BMP280
	default "BMP280"

config BMP280_INIT_PRIORITY
	int
	depends on BMP280
	default 70
	prompt "Init priority"
	help
	 Device driver initialization priority.

config BMP280_I2C_ADDR
	hex "BMP280 I2C slave address"
	depends on BMP280
	default 0x76
	help
	 Specify the I2C slave address for the BMP280.

config BMP280_I2C_MASTER_DEV_NAME
	string "I2C master where BMP280 is connected"
	depends on BMP280
	default "I2C_0"
	help
	 Specify the device name of the I2C master device to which BMP280 is
	 connected.

choice
	prompt "BMP280 pressure oversampling"
	depends on BMP280
	default BMP280_PRESS_OVER_16X
	help
	  Select pressure oversampling for the BMP280 sensor.  Higher values
	  lead to more accurate readings, but higher power consumption.
config BMP280_PRESS_OVER_1X
	bool "x1"
config BMP280_PRESS_OVER_2X
	bool "x2"
config BMP280_PRESS_OVER_4X
	bool "x4"
config BMP280_PRESS_OVER_8X
	bool "x8"
config BMP280_PRESS_OVER_16X
	bool "x16"
endchoice

choice
	prompt "BMP280 temperature oversampling"
	depends on BMP280
	default BMP280_TEMP_OVER_2X
	help
	  Select temperature oversampling for the BMP280 sensor.  Higher values
	  lead to more accurate readings, but higher power consumption.
config BMP280_TEMP_OVER_1X
	bool "x1"
config BMP280_TEMP_OVER_2X
	bool "x2"
config BMP280_TEMP_OVER_4X
	bool "x4"
config BMP280_TEMP_OVER_8X
	bool "x8"
config BMP280_TEMP_OVER_16X
	bool "x16"
endchoice

choice
	prompt "BMP280 standby time"
	depends on BMP280
	default BMP280_STANDBY_1000MS
	help
	  Select standby time between measeurements for the BMP280 sensor.
	  Higher values lead to lower power consumption.
config BMP280_STANDBY_05MS
	bool "0.5ms"
config BMP280_STANDBY_62MS
	bool "62.5ms"
config BMP280_STANDBY_125MS
	bool "125ms"
config BMP280_STANDBY_250MS
	bool "250ms"
config BMP280_STANDBY_500MS
	bool "500ms"
config BMP280_STANDBY_1000MS
	bool "1000ms"
config BMP280_STANDBY_2000MS
	bool "2000ms"
config BMP280_STANDBY_4000MS
	bool "4000ms"
endchoice

choice
	prompt "BMP280 filter coefficient"
	depends on BMP280
	default BMP280_FILTER_4
	help
	  Select the filter coefficient for the BMP280 sensor.
config BMP280_FILTER_OFF
	bool "filter off"
config BMP280_FILTER_2
	bool "2"
config BMP280_FILTER_4
	bool "4"
config BMP280_FILTER_8
	bool "8"
config BMP280_FILTER_16
	bool "16"
endchoice
```

## drivers/sensor/Kconfig.hp206c
```kconfig
# Kconfig.hp206c - HopeRF Electronic HP206C precision barometer and
#                  altimeter configuration options
#
# Copyright (c) 2016 Intel Corporation
#
# Licensed under the Apache License, Version 2.0 (the "License");
# you may not use this file except in compliance with the License.
# You may obtain a copy of the License at
#
#     http://www.apache.org/licenses/LICENSE-2.0
#
# Unless required by applicable law or agreed to in writing, software
# distributed under the License is distributed on an "AS IS" BASIS,
# WITHOUT WARRANTIES OR CONDITIONS OF ANY KIND, either express or implied.
# See the License for the specific language governing permissions and
# limitations under the License.
#
menuconfig HP206C
	bool "HopeRF HP206C precision barometer and altimeter sensor"
	depends on SENSOR
	depends on I2C
	default n
	help
	  Enable HopeRF HP206C barometer and altimeter support.

config HP206C_SYS_LOG_LEVEL
	int "HP206C Log level"
	depends on SYS_LOG && HP206C
	default 0
	range 0 4
	help
	Sets log level for HP206C driver.
	Levels are:

	- 0 OFF: do not write

	- 1 ERROR: only write SYS_LOG_ERR

	- 2 WARNING: write SYS_LOG_WRN in adition to previous level

	- 3 INFO: write SYS_LOG_INF in adition to previous levels

	- 4 DEBUG: write SYS_LOG_DBG in adition to previous levels

config HP206C_INIT_PRIORITY
	int
	prompt "HP206C Init priority"
	default 70
	depends on HP206C
	help
	  Device driver initialization priority.
	  As the device is connected to SPI bus, its driver has
	  to be initialized after the SPI one.

config  HP206C_DRV_NAME
	string "Driver's name"
	depends on HP206C
	default "hp206c"
	help
	  Name for the HP206C driver which will be used for binding.

config HP206C_I2C_PORT_NAME
	string "I2C master controller port name"
	depends on HP206C
	default "I2C_0"
	help
	  Master I2C port name through which HP206C chip is accessed.

config HP206C_OSR_RUNTIME
	bool "Oversampling rate set at runtime"
	depends on HP206C
	default y

config HP206C_OSR
	int "Oversampling rate"
	depends on HP206C && !HP206C_OSR_RUNTIME
	default 4096
	help
	  Allowed values: 4096, 2048, 1024, 512, 256, 128

config HP206C_ALT_OFFSET_RUNTIME
	bool "Altitude offset set at runtime"
	depends on HP206C
	default y

config HP206C_ALT_OFFSET
	int "Altitude offset (in cm)"
	depends on HP206C && !HP206C_ALT_OFFSET_RUNTIME
	default 0
	help
	  Value, in cm, that will be used to compensate altitude calculation.
	  For more info on how to choose this value, consult section 6.1.1 in
	  the datasheet.
```

## drivers/sensor/Kconfig.hts221
```kconfig
#
# Copyright (c) 2016 Intel Corporation
#
# Licensed under the Apache License, Version 2.0 (the "License");
# you may not use this file except in compliance with the License.
# You may obtain a copy of the License at
#
#     http://www.apache.org/licenses/LICENSE-2.0
#
# Unless required by applicable law or agreed to in writing, software
# distributed under the License is distributed on an "AS IS" BASIS,
# WITHOUT WARRANTIES OR CONDITIONS OF ANY KIND, either express or implied.
# See the License for the specific language governing permissions and
# limitations under the License.
#

menuconfig HTS221
	bool
	prompt "HTS221 magnetometer"
	depends on SENSOR && I2C
	default n
	help
	  Enable driver for HTS221 I2C-based magnetometer.

config HTS221_SYS_LOG_LEVEL
	int "HTS221 Log level"
	depends on SYS_LOG && HTS221
	default 0
	range 0 4
	help
	  Sets log level for HTS221 driver.
	  Levels are:
	  0 OFF, do not write
	  1 ERROR, only write SYS_LOG_ERR
	  2 WARNING, write SYS_LOG_WRN in addition to previous level
	  3 INFO, write SYS_LOG_INF in addition to previous levels
	  4 DEBUG, write SYS_LOG_DBG in addition to previous levels

config HTS221_NAME
	string
	prompt "Driver name"
	default "HTS221"
	depends on HTS221
	help
	  Device name with which the HTS221 sensor is identified.

config HTS221_INIT_PRIORITY
	int
	prompt "Init priority"
	depends on HTS221
	default 70
	help
	  Device driver initialization priority.

config HTS221_I2C_MASTER_DEV_NAME
	string
	prompt "I2C master where HTS221 is connected"
	depends on HTS221
	default "I2C_0"
	help
	  Specify the device name of the I2C master device to which HTS221 is
	  connected.

choice
	prompt "Trigger mode"
	depends on HTS221
	default HTS221_TRIGGER_GLOBAL_FIBER
	help
	  Specify the type of triggering to be used by the driver.

config HTS221_TRIGGER_NONE
	bool
	prompt "No trigger"

config HTS221_TRIGGER_GLOBAL_FIBER
	bool
	prompt "Use global fiber"
	depends on GPIO && SYSTEM_WORKQUEUE
	select HTS221_TRIGGER

config HTS221_TRIGGER_OWN_FIBER
	bool
	prompt "Use own fiber"
	depends on GPIO
	select HTS221_TRIGGER

endchoice

config HTS221_TRIGGER
	bool
	depends on HTS221

config HTS221_GPIO_DEV_NAME
	string
	prompt "GPIO device"
	default "GPIO_0"
	depends on HTS221 && HTS221_TRIGGER
	help
	  The device name of the GPIO device to which the HTS221 interrupt pin
	  is connected.

config HTS221_GPIO_PIN_NUM
	int
	prompt "Interrupt GPIO pin number"
	default 0
	depends on HTS221 && HTS221_TRIGGER
	help
	  The number of the GPIO on which the interrupt signal from the HTS221
	  chip will be received.

config HTS221_FIBER_PRIORITY
	int
	prompt "Fiber priority"
	depends on HTS221 && HTS221_TRIGGER_OWN_FIBER
	default 10
	help
	  Priority of fiber used by the driver to handle interrupts.

config HTS221_FIBER_STACK_SIZE
	int
	prompt "Fiber stack size"
	depends on HTS221 && HTS221_TRIGGER_OWN_FIBER
	default 1024
	help
	  Stack size of fiber used by the driver to handle interrupts.

config HTS221_ODR
	string
	prompt "Output data rate"
	depends on HTS221
	default "1"
	help
	  Sensor output data rate expressed in samples per second.
	  Data rates supported by the chip are 1, 7 and 12.5.
```

## drivers/sensor/Kconfig.isl29035
```kconfig
# Kconfig.isl29035 - ISL29035 light sensor configuration options

#
# Copyright (c) 2016 Intel Corporation
#
# Licensed under the Apache License, Version 2.0 (the "License");
# you may not use this file except in compliance with the License.
# You may obtain a copy of the License at
#
#     http://www.apache.org/licenses/LICENSE-2.0
#
# Unless required by applicable law or agreed to in writing, software
# distributed under the License is distributed on an "AS IS" BASIS,
# WITHOUT WARRANTIES OR CONDITIONS OF ANY KIND, either express or implied.
# See the License for the specific language governing permissions and
# limitations under the License.
#

menuconfig ISL29035
	bool
	prompt "ISL29035 light sensor"
	default n
	depends on SENSOR && I2C && NANO_TIMERS && NANO_TIMEOUTS
	help
	  Enable driver for the ISL29035 light sensor.

config ISL29035_SYS_LOG_LEVEL
	int "ISL29035 Log level"
	depends on SYS_LOG && ISL29035
	default 0
	range 0 4
	help
	  Sets log level for ISL29035 driver.
	  Levels are:
	  0 OFF, do not write
	  1 ERROR, only write SYS_LOG_ERR
	  2 WARNING, write SYS_LOG_WRN in addition to previous level
	  3 INFO, write SYS_LOG_INF in addition to previous levels
	  4 DEBUG, write SYS_LOG_DBG in addition to previous levels

config ISL29035_NAME
	string
	prompt "Driver name"
	default "ISL29035"
	depends on ISL29035
	help
	  Device name with which the ISL29035 sensor is identified.

config ISL29035_INIT_PRIORITY
	int
	prompt "Init priority"
	default 70
	depends on ISL29035
	help
	  Device driver initialization priority for ISL29035.
	  The device should be initialized after I2C.

config ISL29035_I2C_MASTER_DEV_NAME
	string
	prompt "I2C Master"
	depends on ISL29035
	default "I2C_0"
	help
	  The device name of the I2C master device to which the ISL29035
	  chip is connected.

config ISL29035_FIBER_PRIORITY
	int
	prompt "Fiber priority"
	depends on ISL29035
	default 10
	help
	  Priority of fiber used to handle the timer and threshold triggers.

choice
	prompt "Full scale lux range"
	default ISL29035_LUX_RANGE_1K
	depends on ISL29035
	help
	  Maximum allowable lux value. Lower range values offer better
	  resolution.

config ISL29035_LUX_RANGE_1K
	bool
	prompt "1000"

config ISL29035_LUX_RANGE_4K
	bool
	prompt "4000"

config ISL29035_LUX_RANGE_16K
	bool
	prompt "16000"

config ISL29035_LUX_RANGE_64K
	bool
	prompt "64000"

endchoice

choice
	prompt "Integration time"
	default ISL29035_INTEGRATION_TIME_105K
	depends on ISL29035
	help
	  The sampling period of the internal ADC of the light sensor.
	  Lower integration time values mean lower ADC resolution.

config ISL29035_INTEGRATION_TIME_26
	bool
	prompt "0.0256 ms"

config ISL29035_INTEGRATION_TIME_410
	bool
	prompt "0.41 ms"

config ISL29035_INTEGRATION_TIME_6500
	bool
	prompt "6.5 ms"

config ISL29035_INTEGRATION_TIME_105K
	bool
	prompt "105 ms"

endchoice

choice
	prompt "Active sensing mode"
	depends on ISL29035
	default ISL29035_MODE_ALS
	help
	  Sensing mode in which the ISL29035 will function. The chip can be
	  configured either for either ambinet light or infrared sensing.

config ISL29035_MODE_ALS
	bool
	prompt "ambient light"
	help
	  Sensing mode for ambient light spectrum.

config ISL29035_MODE_IR
	bool
	prompt "infrared"
	help
	  Sensing mode for infrared spectrum.

endchoice

choice
	prompt "Trigger mode"
	depends on ISL29035 && ISL29035_MODE_ALS && GPIO
	default ISL29035_TRIGGER_NONE
	help
	  Specify the type of triggering to be used by the driver.
	  Only available for ambient light sensing mode.

config ISL29035_TRIGGER_NONE
	bool
	prompt "No trigger"

config ISL29035_TRIGGER_GLOBAL_FIBER
	bool
	prompt "Use global fiber"
	depends on GPIO
	select ISL29035_TRIGGER
	select SENSOR_DELAYED_WORK

config ISL29035_TRIGGER_OWN_FIBER
	bool
	prompt "Use own fiber"
	depends on GPIO
	select ISL29035_TRIGGER

endchoice

config ISL29035_TRIGGER
	bool
	depends on ISL29035

config ISL29035_GPIO_DEV_NAME
	string
	prompt "GPIO device"
	default "GPIO_0"
	depends on ISL29035 && ISL29035_TRIGGER
	help
	  The device name of the GPIO device to which the ISL29035 interrupt
	  pin is connected.

config ISL29035_GPIO_PIN_NUM
	int
	prompt "GPIO pin number"
	default 0
	depends on ISL29035 && ISL29035_TRIGGER
	help
	  The number of the GPIO pin to which the ISL29035 interrupt pin is
	  connected.

config ISL29035_FIBER_PRIORITY
	int
	prompt "Fiber priority"
	depends on ISL29035 && ISL29035_TRIGGER_OWN_FIBER
	default 10
	help
	  Priority of fiber used by the driver to handle interrupts.

config ISL29035_FIBER_STACK_SIZE
	int
	prompt "Fiber stack size"
	depends on ISL29035 && ISL29035_TRIGGER_OWN_FIBER
	default 1024
	help
	  Stack size of fiber used by the driver to handle interrupts.

choice
	prompt "Interrupt persist cycles"
	depends on ISL29035 && ISL29035_TRIGGER
	default ISL29035_INT_PERSIST_1
	help
	  Number of consecutive intergration cycles for which the data samples
	  need to remain outside the threshold window in order for the interrupt
	  to be triggered.

config ISL29035_INT_PERSIST_1
	bool
	prompt "1"

config ISL29035_INT_PERSIST_4
	bool
	prompt "4"

config ISL29035_INT_PERSIST_8
	bool
	prompt "8"

config ISL29035_INT_PERSIST_16
	bool
	prompt "16"

endchoice
```
