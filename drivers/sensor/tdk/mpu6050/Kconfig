## drivers/sensor/tdk/mpu6050/Kconfig
```kconfig
# MPU6050 Six-Axis Motion Tracking device configuration options

# Copyright (c) 2016 Intel Corporation
# SPDX-License-Identifier: Apache-2.0

menuconfig MPU6050
	bool "MPU6050 Six-Axis Motion Tracking Device"
	default y
	depends on DT_HAS_INVENSENSE_MPU6050_ENABLED
	select I2C
	help
	  Enable driver for MPU6050 I2C-based six-axis motion tracking device.

if MPU6050

choice
	prompt "Trigger mode"
	default MPU6050_TRIGGER_GLOBAL_THREAD
	help
	  Specify the type of triggering to be used by the driver.

config MPU6050_TRIGGER_NONE
	bool "No trigger"

config MPU6050_TRIGGER_GLOBAL_THREAD
	bool "Use global thread"
	depends on GPIO
	depends on $(dt_compat_any_has_prop,$(DT_COMPAT_INVENSENSE_MPU6050),int-gpios)
	select MPU6050_TRIGGER

config MPU6050_TRIGGER_OWN_THREAD
	bool "Use own thread"
	depends on GPIO
	depends on $(dt_compat_any_has_prop,$(DT_COMPAT_INVENSENSE_MPU6050),int-gpios)
	select MPU6050_TRIGGER

endchoice

config MPU6050_TRIGGER
	bool

config MPU6050_THREAD_PRIORITY
	int "Thread priority"
	depends on MPU6050_TRIGGER_OWN_THREAD
	default 10
	help
	  Priority of thread used by the driver to handle interrupts.

config MPU6050_THREAD_STACK_SIZE
	int "Thread stack size"
	depends on MPU6050_TRIGGER_OWN_THREAD
	default 1024
	help
	  Stack size of thread used by the driver to handle interrupts.

endif # MPU6050
```

## drivers/sensor/tdk/tad2144/Kconfig
```kconfig
# TAD2144 TMR angle sensor device configuration options

# Copyright (c) 2020 TDK Invensense
# SPDX-License-Identifier: Apache-2.0

menuconfig TAD2144
	bool "TAD2144 TMR Angle Sensor Device"
	default y
	depends on DT_HAS_INVENSENSE_TAD2144_ENABLED
	select SPI if $(dt_compat_on_bus,$(DT_COMPAT_INVENSENSE_TAD2144),spi)
	select I2C if $(dt_compat_on_bus,$(DT_COMPAT_INVENSENSE_TAD2144),i2c)
	select USE_EMD_TAD2144
	help
	  Enable driver for TAD2144 SPI-based TMR angle sensor device.

if TAD2144

choice TAD2144_TRIGGER_MODE
	prompt "Trigger mode"
	default TAD2144_TRIGGER_GLOBAL_THREAD
	help
	  Specify the type of triggering to be used by the driver.

config TAD2144_TRIGGER_NONE
	bool "No trigger"

config TAD2144_TRIGGER_GLOBAL_THREAD
	bool "Use global thread"
	depends on GPIO
	select TAD2144_TRIGGER

config TAD2144_TRIGGER_OWN_THREAD
	bool "Use own thread"
	depends on GPIO
	select TAD2144_TRIGGER

endchoice

config TAD2144_TRIGGER
	bool
	default y

config TAD2144_THREAD_PRIORITY
	int "Thread priority"
	depends on TAD2144_TRIGGER_OWN_THREAD
	default 10
	help
	  Priority of thread used by the driver to handle interrupts.

config TAD2144_THREAD_STACK_SIZE
	int "Thread stack size"
	depends on TAD2144_TRIGGER_OWN_THREAD
	default 1024
	help
	  Stack size of thread used by the driver to handle interrupts.

endif # TAD2144
```

## drivers/sensor/temp_transducer/Kconfig
```kconfig
# Copyright (C) 2026 HawkEye 360
# Copyright (C) 2026 Liam Beguin <liambeguin@gmail.com>
# SPDX-License-Identifier: Apache-2.0

config TEMP_TRANSDUCER
	bool "Temperature transducer driver"
	default y
	depends on DT_HAS_TEMPERATURE_TRANSDUCER_ENABLED
	select ADC
	help
	  Enable temperature transducer driver for converting
	  voltage/current from temperature sensors to temperature values.
	  This driver supports transducers like LTC2997 and AD590 that
	  convert thermal quantities into voltage or current.
```

## drivers/sensor/th02/Kconfig
```kconfig
# Copyright (c) 2016 Intel Corporation
# SPDX-License-Identifier: Apache-2.0

config TH02
	bool "TH02 Temperature Sensor"
	default y
	depends on DT_HAS_HOPERF_TH02_ENABLED
	depends on I2C
	help
	  Enable driver for the TH02 temperature sensor.
```

## drivers/sensor/thermistor/Kconfig
```kconfig
# Thermistor configuration options

# Copyright (c) 2023 Cypress Semiconductor Corporation (an Infineon company) or
# an affiliate of Cypress Semiconductor Corporation
#
# SPDX-License-Identifier: Apache-2.0


config THERMISTOR
	bool "thermistor"
	default y
	depends on DT_HAS_INFINEON_THERMISTOR_ENABLED
	depends on ADC
	depends on NEWLIB_LIBC
	help
	  Enable driver for thermistor.
```

## drivers/sensor/ti/Kconfig
```kconfig
# Copyright (c) 2024 Analog Devices, Inc.
# SPDX-License-Identifier: Apache-2.0

# zephyr-keep-sorted-start
source "drivers/sensor/ti/bq274xx/Kconfig"
source "drivers/sensor/ti/fdc2x1x/Kconfig"
source "drivers/sensor/ti/ina219/Kconfig"
source "drivers/sensor/ti/ina226/Kconfig"
source "drivers/sensor/ti/ina23x/Kconfig"
source "drivers/sensor/ti/ina3221/Kconfig"
source "drivers/sensor/ti/lm95234/Kconfig"
source "drivers/sensor/ti/opt3001/Kconfig"
source "drivers/sensor/ti/ti_hdc/Kconfig"
source "drivers/sensor/ti/ti_hdc20xx/Kconfig"
source "drivers/sensor/ti/tmag5170/Kconfig"
source "drivers/sensor/ti/tmag5273/Kconfig"
source "drivers/sensor/ti/tmp007/Kconfig"
source "drivers/sensor/ti/tmp1075/Kconfig"
source "drivers/sensor/ti/tmp108/Kconfig"
source "drivers/sensor/ti/tmp112/Kconfig"
source "drivers/sensor/ti/tmp114/Kconfig"
source "drivers/sensor/ti/tmp116/Kconfig"
# zephyr-keep-sorted-stop
```

## drivers/sensor/ti/adcxx1c/Kconfig
```kconfig
# TI ADCXX1C I2C Voltage sensor configuration options

# Copyright (c) 2024 Bert Outtier
#
# SPDX-License-Identifier: Apache-2.0

menuconfig ADCXX1C
	bool "ADCxx1C voltage sensor"
	default y
	depends on DT_HAS_TI_ADCXX1C_ENABLED
	select I2C
	help
	  Enable I2C-based driver for ADCXX1C voltage sensor.

if ADCXX1C

choice ADCXX1C_TRIGGER_MODE
	prompt "Trigger mode"
	default ADCXX1C_TRIGGER_NONE
	help
	  Specify the type of triggering to be used by the driver.

config ADCXX1C_TRIGGER_NONE
	bool "No trigger"

config ADCXX1C_TRIGGER_GLOBAL_THREAD
	bool "Use global thread"
	depends on GPIO
	select ADCXX1C_TRIGGER

config ADCXX1C_TRIGGER_OWN_THREAD
	bool "Use own thread"
	depends on GPIO
	select ADCXX1C_TRIGGER

endchoice

config ADCXX1C_TRIGGER
	bool

config ADCXX1C_THREAD_PRIORITY
	int "Thread priority"
	depends on ADCXX1C_TRIGGER_OWN_THREAD
	default 10
	help
	  Priority of thread used by the driver to handle interrupts.

config ADCXX1C_THREAD_STACK_SIZE
	int "Thread stack size"
	depends on ADCXX1C_TRIGGER_OWN_THREAD
	default 1024
	help
	  Stack size of thread used by the driver to handle interrupts.

endif # ADCXX1C
```

## drivers/sensor/ti/bq274xx/Kconfig
```kconfig
# Copyright (c) 2020 Linumiz
#
# SPDX-License-Identifier: Apache-2.0

menuconfig BQ274XX
	bool "BQ274xx Fuel Gauge"
	default y
	depends on DT_HAS_TI_BQ274XX_ENABLED
	select I2C
	help
	  Enable I2C-based driver for BQ274xx Fuel Gauge.

if BQ274XX

config BQ274XX_PM
	bool "BQ274XX Power Management"
	depends on PM_DEVICE
	default y
	help
	  This option enables the device power management feature of the
	  BQ274XX.
	  Note: if the int_gpios pin is not used then this feature must be
	  disabled.

choice BQ274XX_TRIGGER_MODE
	prompt "Trigger mode"
	default BQ274XX_TRIGGER_NONE
	help
	  Specify the type of triggering to be used by the driver.

config BQ274XX_TRIGGER_NONE
	bool "No trigger"

config BQ274XX_TRIGGER_GLOBAL_THREAD
	bool "Use global thread"
	depends on GPIO
	depends on $(dt_compat_any_has_prop,$(DT_COMPAT_TI_BQ274XX),int-gpios)
	select BQ274XX_TRIGGER

config BQ274XX_TRIGGER_OWN_THREAD
	bool "Use own thread"
	depends on GPIO
	depends on $(dt_compat_any_has_prop,$(DT_COMPAT_TI_BQ274XX),int-gpios)
	select BQ274XX_TRIGGER

endchoice # BQ274XX_TRIGGER_MODE

config BQ274XX_TRIGGER
	bool

config BQ274XX_THREAD_PRIORITY
	int "Thread priority"
	depends on BQ274XX_TRIGGER_OWN_THREAD
	default 10
	help
	  Priority of thread used by the driver to handle interrupts.

config BQ274XX_THREAD_STACK_SIZE
	int "Thread stack size"
	depends on BQ274XX_TRIGGER_OWN_THREAD
	default 1024
	help
	  Stack size of thread used by the driver to handle interrupts.

endif # BQ274XX
```

## drivers/sensor/ti/cc13xx_cc26xx_vbat/Kconfig
```kconfig
# CC13xx/CC26xx vbat sensor configuration options

# Copyright (c) 2026 Paweł Pielorz <pawel.pielorz@gmail.com>
# SPDX-License-Identifier: Apache-2.0

config CC13XX_CC26XX_VBAT
	bool "CC13XX/CC26XX VBAT Sensor"
	default y
	depends on DT_HAS_TI_CC13XX_CC26XX_VBAT_ENABLED
	depends on SOC_SERIES_CC13X2_CC26X2 || SOC_SERIES_CC13X2X7_CC26X2X7
	help
	  Enable driver for CC13XX/CC26XX VBat sensor.
```

## drivers/sensor/ti/fdc1004/Kconfig
```kconfig
# Copyright (c) 2026 Zephyr Project Developers
# SPDX-License-Identifier: Apache-2.0

config FDC1004
	bool "Texas Instruments FDC1004 Capacitance-to-Digital Converter"
	default y
	depends on DT_HAS_TI_FDC1004_ENABLED
	select I2C
	help
	  Enable driver for the TI FDC1004 4-channel, 16-bit capacitance-to-digital
	  converter. Communicates over I2C. Exposes four single-ended measurement
	  channels (CIN1..CIN4) via the Zephyr sensor API using private channel IDs
	  defined in <fdc1004.h>.
```

## drivers/sensor/ti/ina226/Kconfig
```kconfig
# INA226 Bidirectional Current/Power Monitor

# Copyright 2024 NXP
# SPDX-License-Identifier: Apache-2.0

config INA226
	bool "INA226 Current/Power Monitor"
	default y
	depends on DT_HAS_TI_INA226_ENABLED
	select I2C
	help
	  Enable driver for INA226 Bidirectional Current/Power Monitor.

config INA226_VSHUNT
	bool "INA226 VShunt Measurement Enable"
	depends on DT_HAS_TI_INA226_ENABLED
	help
	  Enable shunt voltage measurement for INA226.

	  This is the actual shunt voltage measured which is scaled within the
	  INA226 based upon the SHUNT_CAL register. This value is useful for
	  determining the measurement noise or debugging the SHUNT_CAL value.

	  Note that enabling this option requires an extra I2C read when the
	  SENSOR_CHAN_ALL is selected. Hence, only enable this option if the
	  shunt voltage measurement is required.
```

## drivers/sensor/ti/ina228/Kconfig
```kconfig
# Copyright (c) 2025 Jonas Berg
# SPDX-License-Identifier: Apache-2.0

config INA228
	bool "INA228 current sensor"
	default y
	depends on DT_HAS_TI_INA228_ENABLED
	select I2C
	help
	  Enable driver for INA228 Bidirectional Current/Power Monitor.

config INA228_VSHUNT
	bool "INA228 shunt voltage measurement enable"
	depends on DT_HAS_TI_INA228_ENABLED
	help
	  Enable shunt voltage measurement for INA228.

	  This is the actual shunt voltage measured which is scaled within the
	  INA228 based upon the SHUNT_CAL register.

	  Note that enabling this option requires an extra I2C read when
	  SENSOR_CHAN_ALL is selected, so only enable if the shunt voltage
	  measurement is required.

config INA228_TEMPERATURE
	bool "INA228 temperature measurement enable"
	depends on DT_HAS_TI_INA228_ENABLED
	help
	  Enable temperature measurement for INA228.

	  Note that enabling this option requires an extra I2C read when
	  SENSOR_CHAN_ALL is selected, so only enable if the temperature
	  measurement is required.

config INA228_CUMULATIVE
	bool "INA228 cumulative charge and energy enable"
	depends on DT_HAS_TI_INA228_ENABLED
	help
	  Enable cumulative charge and energy measurement for INA228.

	  Upon overflow, the charge and energy values will roll over and start
	  from zero.

	  Note that enabling this option requires two extra I2C reads when
	  SENSOR_CHAN_ALL is selected, so only enable if the cumulative charge or
	  energy is required.
```

## drivers/sensor/ti/ina23x/Kconfig
```kconfig
# Copyright 2021 The Chromium OS Authors
#
# SPDX-License-Identifier: Apache-2.0

config INA23X
	bool "INA23X Current and Power Monitor"
	default y
	depends on DT_HAS_TI_INA230_ENABLED || DT_HAS_TI_INA236_ENABLED || DT_HAS_TI_INA237_ENABLED
	select I2C
	help
	  Enable driver for INA23X Current and Power Monitor.

if INA23X

config INA230
	bool "INA230"
	default y
	depends on DT_HAS_TI_INA230_ENABLED || DT_HAS_TI_INA236_ENABLED
	help
	  Enable driver for INA230/INA231/INA236.

config INA237
	bool "INA237"
	default y
	depends on DT_HAS_TI_INA237_ENABLED
	help
	  Enable driver for INA237.

config INA237_VSHUNT
	bool "INA237 VShunt Measurement Enable"
	depends on DT_HAS_TI_INA237_ENABLED
	help
	  Enable shunt voltage measurement for INA237.

	  This is the actual shunt voltage measured which is scaled within the
	  INA237 based upon the SHUNT_CAL register.  This value is useful for
	  looking at measurement noise or debugging the SHUNT_CAL value.

	  Note that enabling this option requires an extra I2C read when
	  SENSOR_CHAN_ALL is selected, so only enable if the shunt voltage
	  measurement is required.

config INA230_TRIGGER
	bool

choice
	prompt "Trigger mode"
	default INA230_TRIGGER_GLOBAL_THREAD
	help
	Specify the type of triggering to be used by the driver.

config INA230_TRIGGER_OWN_THREAD
	bool "Use own thread"
	depends on INA230
	depends on GPIO
	depends on $(dt_compat_any_has_prop,$(DT_COMPAT_TI_INA230),alert-gpios) || $(dt_compat_any_has_prop,$(DT_COMPAT_TI_INA236),alert-gpios)
	select INA230_TRIGGER

config INA230_TRIGGER_GLOBAL_THREAD
	bool "Use global thread"
	depends on INA230
	depends on GPIO
	depends on $(dt_compat_any_has_prop,$(DT_COMPAT_TI_INA230),alert-gpios) || $(dt_compat_any_has_prop,$(DT_COMPAT_TI_INA236),alert-gpios)
	select INA230_TRIGGER
endchoice

config INA230_THREAD_PRIORITY
	int "Own thread priority"
	depends on INA230_TRIGGER_OWN_THREAD
	default 10
	help
	  The priority of the thread used for handling interrupts.

config INA230_THREAD_STACK_SIZE
	int "Own thread stack size"
	depends on INA230_TRIGGER_OWN_THREAD
	default 1024
	help
	  The thread stack size.

endif # INA23X
```

## drivers/sensor/ti/ina260/Kconfig
```kconfig
# Copyright (c) 2025 RIT Launch Initiative <launchinitiative@rit.edu>
# Copyright (c) 2025 Aaron Chan
# Copyright (c) 2025 Richard Sommers
# SPDX-License-Identifier: Apache-2.0

config INA260
	bool "INA260 Current/Power Monitor"
	default y
	depends on DT_HAS_TI_INA260_ENABLED
	select I2C
	help
	  Enable driver for INA260 Bidirectional Current/Power Sensor.
```
