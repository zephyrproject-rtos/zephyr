## drivers/sensor/ti/ina2xx/Kconfig
```kconfig
# Copyright 2021 The Chromium OS Authors
# Copyright 2024 NXP
# Copyright 2025 Nova Dynamics LLC
#
# SPDX-License-Identifier: Apache-2.0

config INA2XX
	bool "INA2XX Current and Power Monitor"
	default y
	depends on DT_HAS_TI_INA226_ENABLED || DT_HAS_TI_INA228_ENABLED || DT_HAS_TI_INA230_ENABLED || DT_HAS_TI_INA232_ENABLED || DT_HAS_TI_INA236_ENABLED || DT_HAS_TI_INA237_ENABLED
	select I2C
	help
	  Enable driver for INA2XX Current and Power Monitor.

if INA2XX

config INA2XX_HAS_CHANNEL_BUS_VOLTAGE
	bool

config INA2XX_HAS_CHANNEL_SHUNT_VOLTAGE
	bool

config INA2XX_HAS_CHANNEL_CURRENT
	bool

config INA2XX_HAS_CHANNEL_POWER
	bool

config INA2XX_HAS_CHANNEL_DIE_TEMP
	bool

config INA2XX_HAS_CHANNEL_ENERGY
	bool

config INA2XX_HAS_CHANNEL_CHARGE
	bool

config INA226
	bool "INA226 Current/Power Monitor"
	default y
	depends on DT_HAS_TI_INA226_ENABLED
	select INA2XX_HAS_CHANNEL_BUS_VOLTAGE
	select INA2XX_HAS_CHANNEL_CURRENT
	select INA2XX_HAS_CHANNEL_POWER
	help
	  Enable driver for INA226 Bidirectional Current/Power Monitor.

config INA230
	bool "INA230"
	default y
	depends on DT_HAS_TI_INA230_ENABLED || DT_HAS_TI_INA232_ENABLED || DT_HAS_TI_INA236_ENABLED
	select INA2XX_HAS_CHANNEL_BUS_VOLTAGE
	select INA2XX_HAS_CHANNEL_SHUNT_VOLTAGE
	select INA2XX_HAS_CHANNEL_CURRENT
	select INA2XX_HAS_CHANNEL_POWER
	help
	  Enable driver for INA230/INA231/INA232/INA236.

if INA230
	module = INA230
	thread_priority = 10
	thread_stack_size = 1024
	source "drivers/sensor/Kconfig.trigger_template"
endif # INA230

config INA232
	bool "INA232"
	default y
	depends on DT_HAS_TI_INA232_ENABLED
	select INA230
	help
	  Enable driver for INA232.

config INA236
	bool "INA236"
	default y
	depends on DT_HAS_TI_INA236_ENABLED
	select INA230
	help
	  Enable driver for INA236.

config INA237
	bool "INA237"
	default y
	depends on DT_HAS_TI_INA237_ENABLED || DT_HAS_TI_INA228_ENABLED
	select INA2XX_HAS_CHANNEL_BUS_VOLTAGE
	select INA2XX_HAS_CHANNEL_SHUNT_VOLTAGE
	select INA2XX_HAS_CHANNEL_CURRENT
	select INA2XX_HAS_CHANNEL_POWER
	select INA2XX_HAS_CHANNEL_DIE_TEMP
	help
	  Enable driver for INA237/INA228.

config INA228
	bool "INA228"
	default y
	depends on DT_HAS_TI_INA228_ENABLED
	select INA237
	select INA2XX_HAS_CHANNEL_ENERGY
	select INA2XX_HAS_CHANNEL_CHARGE
	help
	  Enable driver for the INA228.

endif # INA2XX
```

## drivers/sensor/ti/ina3221/Kconfig
```kconfig
# INA3221 Bidirectional Current/Power Monitor

# Copyright (c) 2023 Nordic Semiconductor ASA
# SPDX-License-Identifier: Apache-2.0

config INA3221
	bool "INA3221 Triple-Channel Current/Power Monitor"
	default y
	depends on DT_HAS_TI_INA3221_ENABLED
	select I2C
	help
	  Enable driver for INA3221 Triple-Channel Current/Power Monitor.
```

## drivers/sensor/ti/ina700/Kconfig
```kconfig
# Original license from ina23x driver:
# 	Copyright 2021 The Chromium OS Authors
# 	Copyright 2021 Grinn
#
# Copyright 2024, Remie Lowik
#
# SPDX-License-Identifier: Apache-2.0
config INA700
	bool "INA700 Current and Power Monitor"
	default y
	depends on DT_HAS_TI_INA700_ENABLED
	select I2C
	help
	  Enable driver for INA700 Current and Power Monitor.

if INA700

endif # INA700
```

## drivers/sensor/ti/ina745/Kconfig
```kconfig
# INA745 Current/Power Monitor

# Copyright The Zephyr Project Contributors
# SPDX-License-Identifier: Apache-2.0

config INA745
	bool "INA745 Current/Power Monitor"
	default y
	depends on DT_HAS_TI_INA745_ENABLED
	select I2C
	help
	  Enable driver for INA745 Bidirectional Current/Power Monitor.
```

## drivers/sensor/ti/ina7xx/Kconfig
```kconfig
# INA745 Current/Power Monitor

# Copyright The Zephyr Project Contributors
# SPDX-License-Identifier: Apache-2.0

config INA7XX
	bool "INA7xx Current/Power Monitor"
	default y
	depends on DT_HAS_TI_INA7XX_ENABLED
	select I2C
	help
	  Enable driver for INA7xx Bidirectional Current/Power Monitor.
```

## drivers/sensor/ti/lm95234/Kconfig
```kconfig
# LM95234 temperature sensor config

# Copyright (c) 2024 Calian Advanced Technologies
# SPDX-License-Identifier: Apache-2.0

config LM95234
	bool "LM95234 Temperature Sensor"
	default y
	depends on DT_HAS_NATIONAL_LM95234_ENABLED
	select I2C
	help
	  Enable the driver for the LM95234 Quad Remote Diode and Local
	  Temperature Sensor with SMBus Interface.
```

## drivers/sensor/ti/opt3001/Kconfig
```kconfig
# OPT3001 light sensor configuration options

# Copyright (c) 2019 Actinius
# SPDX-License-Identifier: Apache-2.0

config OPT3001
	bool "OPT3001 Light Sensor"
	default y
	depends on DT_HAS_TI_OPT3001_ENABLED
	select I2C
	help
	  Enable driver for OPT3001 light sensors.

if OPT3001

module = OPT3001
thread_priority = 10
thread_stack_size = 1024
source "drivers/sensor/Kconfig.trigger_template"

endif # OPT3001
```

## drivers/sensor/ti/opt300x/Kconfig
```kconfig
# OPT300X light sensor configuration options

# Copyright (c) 2019 Actinius
# SPDX-License-Identifier: Apache-2.0

config OPT300X
	bool "OPT300X Light Sensor"
	default y
	depends on DT_HAS_TI_OPT3001_ENABLED || DT_HAS_TI_OPT3004_ENABLED
	select I2C
	help
	  Enable driver for OPT300X light sensors.

if OPT300X

module = OPT300X
thread_priority = 10
thread_stack_size = 1024
source "drivers/sensor/Kconfig.trigger_template"

endif # OPT300X
```

## drivers/sensor/ti/ti_hdc/Kconfig
```kconfig
# TI_HDC temperature and humidity sensor configuration options

# Copyright (c) 2016 Intel Corporation
# SPDX-License-Identifier: Apache-2.0

config TI_HDC
	bool "Texas Instruments Temperature and Humidity Sensor (e.g. HDC1008)"
	default y
	depends on DT_HAS_TI_HDC_ENABLED
	select I2C
	help
	  Enable driver for TI temperature and humidity sensors.
```

## drivers/sensor/ti/ti_hdc302x/Kconfig
```kconfig
# TI_HDC302X temperature and humidity sensor configuration options

# Copyright (c) 2025 Psicontrol N.V.
# SPDX-License-Identifier: Apache-2.0

config TI_HDC302X
	bool "Texas Instruments HDC302X Temperature and Humidity Sensor"
	default y
	depends on DT_HAS_TI_HDC302X_ENABLED
	select I2C
	select CRC
	help
	  Enable driver for TI HDC302X temperature and humidity sensors
	  (e.g. HDC3020, HDC3021, HDC3022).
```

## drivers/sensor/ti/ti_vtm/Kconfig
```kconfig
# SPDX-License-Identifier: Apache-2.0
# SPDX-FileCopyrightText: Copyright (c) 2026 Texas Instruments Incorporated

config TI_VTM
	bool "TI Voltage and Thermal Management driver"
	default y
	depends on DT_HAS_TI_VTM_ENABLED
	help
	  Enable driver for TI VTM temperature monitoring.
```
