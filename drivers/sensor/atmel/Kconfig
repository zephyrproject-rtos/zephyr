## drivers/sensor/bmi160/Kconfig
```kconfig
# Kconfig - Bosch BMI160 inertial measurement configuration options

#
# Copyright (c) 2016 Intel Corporation
#
# SPDX-License-Identifier: Apache-2.0
#

menuconfig BMI160
	bool "Bosch BMI160 inertial measurement unit"
	depends on SPI
	help
	  Enable Bosch BMI160 inertial measurement unit that provides acceleration
	  and angular rate measurements.

if BMI160

config BMI160_NAME
	string "Driver's name"
	default "BMI160"

config BMI160_SPI_PORT_NAME
	string "SPI master controller port name"
	help
	  Master SPI port name through which BMI160 chip is accessed.

config BMI160_SLAVE
	hex "BMI160 SPI slave select pin"
	default 0
	help
	  BMI160 chip select pin.

config BMI160_SPI_BUS_FREQ
	int "BMI160 SPI bus speed in Hz"
	default 640000
	help
	  This is the maximum supported SPI bus frequency. The chip supports a
	  frequency up to 10MHz.

choice
	prompt "Trigger mode"
	default BMI160_TRIGGER_GLOBAL_THREAD
	help
	  Specify the type of triggering to be used by the driver.

config BMI160_TRIGGER_NONE
	bool "No trigger"

config BMI160_TRIGGER_GLOBAL_THREAD
	bool "Use global thread"
	select BMI160_TRIGGER

config BMI160_TRIGGER_OWN_THREAD
	bool "Use own thread"
	select BMI160_TRIGGER
endchoice

config BMI160_TRIGGER
	bool

config BMI160_THREAD_PRIORITY
	int "Own thread priority"
	depends on BMI160_TRIGGER_OWN_THREAD
	default 10
	help
	  The priority of the thread used for handling interrupts.

config BMI160_THREAD_STACK_SIZE
	int "Own thread stack size"
	depends on BMI160_TRIGGER_OWN_THREAD
	default 1024
	help
	  The thread stack size.

config BMI160_GPIO_DEV_NAME
	string "Gpio device"
	default "GPIO_1"
	depends on BMI160_TRIGGER
	help
	  The name of the GPIO device to which the BMI160 interrupt pin is
	  connected.

config BMI160_GPIO_PIN_NUM
	int "Interrupt GPIO pin number"
	default 4
	depends on BMI160_TRIGGER
	help
	  The number of the GPIO pin which is connected to BMI160 interrupt pin.

choice
	prompt "Accelerometer power mode"
	default BMI160_ACCEL_PMU_RUNTIME

config BMI160_ACCEL_PMU_RUNTIME
	bool "Set at runtime."

config BMI160_ACCEL_PMU_SUSPEND
	bool "suspended/not used"

config BMI160_ACCEL_PMU_NORMAL
	bool "normal"

config BMI160_ACCEL_PMU_LOW_POWER
	bool "low power"
endchoice

choice
	prompt "Accelerometer range setting"
	depends on BMI160_ACCEL_PMU_RUNTIME || BMI160_ACCEL_PMU_NORMAL || BMI160_ACCEL_PMU_LOW_POWER
	default BMI160_ACCEL_RANGE_RUNTIME

config BMI160_ACCEL_RANGE_RUNTIME
	bool "Set at runtime."

config BMI160_ACCEL_RANGE_2G
	bool "2G"

config BMI160_ACCEL_RANGE_4G
	bool "4G"

config BMI160_ACCEL_RANGE_8G
	bool "8G"

config BMI160_ACCEL_RANGE_16G
	bool "16G"
endchoice

choice
	prompt "Accelerometer sampling frequency."
	depends on BMI160_ACCEL_PMU_RUNTIME || BMI160_ACCEL_PMU_NORMAL || BMI160_ACCEL_PMU_LOW_POWER
	default BMI160_ACCEL_ODR_RUNTIME

config BMI160_ACCEL_ODR_RUNTIME
	bool "Set at runtime."

config BMI160_ACCEL_ODR_25_32
	depends on BMI160_ACCEL_PMU_LOW_POWER
	bool "0.78 Hz"

config BMI160_ACCEL_ODR_25_16
	depends on BMI160_ACCEL_PMU_LOW_POWER
	bool "1.56 Hz"

config BMI160_ACCEL_ODR_25_8
	depends on BMI160_ACCEL_PMU_LOW_POWER
	bool "3.125 Hz"

config BMI160_ACCEL_ODR_25_4
	depends on BMI160_ACCEL_PMU_LOW_POWER
	bool "6.25 Hz"

config BMI160_ACCEL_ODR_25_2
	bool "12.5 Hz"

config BMI160_ACCEL_ODR_25
	bool "25 Hz"

config BMI160_ACCEL_ODR_50
	bool "50 Hz"

config BMI160_ACCEL_ODR_100
	bool "100 Hz"

config BMI160_ACCEL_ODR_200
	bool "200 Hz"

config BMI160_ACCEL_ODR_400
	bool "400 Hz"

config BMI160_ACCEL_ODR_800
	bool "800 Hz"

config BMI160_ACCEL_ODR_1600
	bool "1600 Hz"
endchoice

choice
	prompt "Gyroscope power mode"
	default BMI160_GYRO_PMU_RUNTIME

config BMI160_GYRO_PMU_RUNTIME
	bool "Set at runtime."

config BMI160_GYRO_PMU_SUSPEND
	bool "suspended/not used"

config BMI160_GYRO_PMU_NORMAL
	bool "normal"

config BMI160_GYRO_PMU_FAST_STARTUP
	bool "fast start-up"
endchoice

choice
	prompt "Gyroscope range setting."
	depends on BMI160_GYRO_PMU_RUNTIME || BMI160_GYRO_PMU_NORMAL || BMI160_GYRO_PMU_FAST_STARTUP
	default BMI160_GYRO_RANGE_RUNTIME

config BMI160_GYRO_RANGE_RUNTIME
	bool "Set at runtime."

config BMI160_GYRO_RANGE_2000DPS
	bool "2000 DPS"

config BMI160_GYRO_RANGE_1000DPS
	bool "1000 DPS"

config BMI160_GYRO_RANGE_500DPS
	bool "500 DPS"

config BMI160_GYRO_RANGE_250DPS
	bool "250 DPS"

config BMI160_GYRO_RANGE_125DPS
	bool "125 DPS"
endchoice

choice
	prompt "Gyroscope sampling frequency."
	depends on BMI160_GYRO_PMU_RUNTIME || BMI160_GYRO_PMU_NORMAL || BMI160_GYRO_PMU_FAST_STARTUP
	default BMI160_GYRO_ODR_RUNTIME

config BMI160_GYRO_ODR_RUNTIME
	bool "Set at runtime."

config BMI160_GYRO_ODR_25
	bool "25 Hz"

config BMI160_GYRO_ODR_50
	bool "50 Hz"

config BMI160_GYRO_ODR_100
	bool "100 Hz"

config BMI160_GYRO_ODR_200
	bool "200 Hz"

config BMI160_GYRO_ODR_400
	bool "400 Hz"

config BMI160_GYRO_ODR_800
	bool "800 Hz"

config BMI160_GYRO_ODR_1600
	bool "1600 Hz"

config BMI160_GYRO_ODR_3200
	bool "3200 Hz"
endchoice

endif # BMI160
```

## drivers/sensor/bmi270/Kconfig
```kconfig
# BMI270 6 Axis IMU configuration

# Copyright (c) 2021 Bosch Sensortec GmbH
# Copyright (c) 2022 Nordic Semiconductor ASA
# SPDX-License-Identifier: Apache-2.0

menuconfig BMI270
	bool "BMI270 Inertial measurement unit"
	default y
	depends on DT_HAS_BOSCH_BMI270_ENABLED
	select I2C if $(dt_compat_on_bus,$(DT_COMPAT_BOSCH_BMI270),i2c)
	select SPI if $(dt_compat_on_bus,$(DT_COMPAT_BOSCH_BMI270),spi)
	help
	  Enable driver for BMI270 I2C-based imu sensor

if BMI270

config BMI270_BUS_I2C
	bool
	default y
	depends on $(dt_compat_on_bus,$(DT_COMPAT_BOSCH_BMI270),i2c)

config BMI270_BUS_SPI
	bool
	default y
	depends on $(dt_compat_on_bus,$(DT_COMPAT_BOSCH_BMI270),spi)

endif # BMI270
```

## drivers/sensor/bmm150/Kconfig
```kconfig
# BMM150 Geomagnetic sensor configuration options

# Copyright (c) 2017 Intel Corporation
# SPDX-License-Identifier: Apache-2.0

menuconfig BMM150
	bool "BMM150 I2C Geomagnetic Chip"
	default y
	depends on DT_HAS_BOSCH_BMM150_ENABLED
	depends on I2C
	help
	  Enable driver for BMM150 I2C-based Geomagnetic sensor.
if BMM150

choice
	prompt "Default preset"
	default BMM150_PRESET_REGULAR
	help
	  Specify the default preset (x/y oversampling, z oversampling, sampling
	  frequency).

config BMM150_PRESET_LOW_POWER
	bool "Low power (3, 3, 10)"

config BMM150_PRESET_REGULAR
	bool "Regular (9, 15, 10)"

config BMM150_PRESET_ENHANCED_REGULAR
	bool "Enhanced regular (15, 27, 10)"

config BMM150_PRESET_HIGH_ACCURACY
	bool "High accuracy (47, 83, 20)"

endchoice

config BMM150_SAMPLING_RATE_RUNTIME
	bool "Dynamic sampling rate"
	help
	  Enable alteration of sampling rate attribute at runtime.

config BMM150_SAMPLING_REP_XY
	bool "Dynamic XY oversampling"
	help
	  Enable alteration of XY oversampling at runtime.

config BMM150_SAMPLING_REP_Z
	bool "Dynamic Z oversampling"
	help
	  Enable alteration of Z oversampling at runtime.

endif # BMM150
```

## drivers/sensor/bmp180/Kconfig
```kconfig
# BMP180 temperature and pressure sensor configuration options

# Copyright (c) 2016 Intel Corporation
# Copyright (c) 2017 IpTronix S.r.l.
# SPDX-License-Identifier: Apache-2.0

menuconfig BMP180
	bool "BMP180 sensor"
	depends on I2C
	help
	  Enable driver for BMP180 I2C-based temperature and pressure sensor.
```

## drivers/sensor/bmp388/Kconfig
```kconfig
# Copyright (c) 2020 Facebook, Inc. and its affiliates
# SPDX-License-Identifier: Apache-2.0

menuconfig BMP388
	bool "Bosch BMP388 pressure sensor"
	default y
	depends on DT_HAS_BOSCH_BMP388_ENABLED
	select I2C if $(dt_compat_on_bus,$(DT_COMPAT_BOSCH_BMP388),i2c)
	select SPI if $(dt_compat_on_bus,$(DT_COMPAT_BOSCH_BMP388),spi)
	help
	  Enable driver for the Bosch BMP388 pressure sensor

if BMP388

choice BMP388_TRIGGER_MODE
	prompt "Trigger mode"
	default BMP388_TRIGGER_GLOBAL_THREAD
	help
	  Specify the type of triggering to be used by the driver.

config BMP388_TRIGGER_NONE
	bool "No trigger"

config BMP388_TRIGGER_GLOBAL_THREAD
	bool "Use global thread"
	select BMP388_TRIGGER

config BMP388_TRIGGER_OWN_THREAD
	bool "Use own thread"
	select BMP388_TRIGGER

config BMP388_TRIGGER_DIRECT
	bool "Use IRQ handler"
	select BMP388_TRIGGER
endchoice

config BMP388_TRIGGER
	bool

config BMP388_THREAD_PRIORITY
	int "Own thread priority"
	depends on BMP388_TRIGGER_OWN_THREAD
	default 10
	help
	  Priority of the thread used by the driver to handle interrupts.

config BMP388_THREAD_STACK_SIZE
	int "Own thread stack size"
	depends on BMP388_TRIGGER_OWN_THREAD
	default 1024
	help
	  Stack size of thread used by the driver to handle interrupts.

config BMP388_ODR_RUNTIME
	bool "Change ODR at runtime."
	default y

config BMP388_OSR_RUNTIME
	bool "Change OSR at runtime."
	default y

endif # BMP388
```

## drivers/sensor/bno055/Kconfig
```kconfig
# BNO055 accelerometer, gyroscope, magnetometer and orientation sensor
# SPDX-License-Identifier: Apache-2.0

menuconfig BNO055
	bool "BNO055 sensor"
	depends on I2C
	help
	  Enable driver for BNO055 I2C-based accelerometer, gyroscope, magnetometer and orientation.

if BNO055

choice
	prompt "BNO055 operation Mode"
	default BNO055_OPERATION_MODE_NDOF
	help
	   Operation mode settings for the BNO055 sensor.

config BNO055_OPERATION_MODE_IMUPLUS
	bool "IMU Mode"
	help
	  Inertial measurement unit. Reads accel,gyro and fusion data.

config BNO055_OPERATION_MODE_COMPASS
	bool "COMPASS Mode"
	help
	  Reads accel, mag data and fusion data.

config BNO055_OPERATION_MODE_M4G
	bool "M4G Mode"
	help
	  Reads accel, mag data and fusion data.

config BNO055_OPERATION_MODE_NDOF_FMC_OFF
	bool "NODF FMC OFF Mode"
	help
	  Nine degrees of freedom with fast magnetic calibration off.
	  Reads accel,mag, gyro and fusion data.

config BNO055_OPERATION_MODE_NDOF
	bool "NDOF MODE"
	help
	  Nine degrees of freedom.
	  Reads accel,mag, gyro and fusion data.

endchoice

endif # BNO055
```

## drivers/sensor/bosch/Kconfig
```kconfig
# Copyright (c) 2024 Analog Devices, Inc.
# SPDX-License-Identifier: Apache-2.0

# zephyr-keep-sorted-start
source "drivers/sensor/bosch/bma280/Kconfig"
source "drivers/sensor/bosch/bma4xx/Kconfig"
source "drivers/sensor/bosch/bmc150_magn/Kconfig"
source "drivers/sensor/bosch/bme280/Kconfig"
source "drivers/sensor/bosch/bme680/Kconfig"
source "drivers/sensor/bosch/bmg160/Kconfig"
source "drivers/sensor/bosch/bmi08x/Kconfig"
source "drivers/sensor/bosch/bmi160/Kconfig"
source "drivers/sensor/bosch/bmi270/Kconfig"
source "drivers/sensor/bosch/bmi323/Kconfig"
source "drivers/sensor/bosch/bmm150/Kconfig"
source "drivers/sensor/bosch/bmp180/Kconfig"
source "drivers/sensor/bosch/bmp388/Kconfig"
source "drivers/sensor/bosch/bmp581/Kconfig"
# zephyr-keep-sorted-stop
```

## drivers/sensor/bosch/bhi2xy/Kconfig
```kconfig
# Bosch BHI2xy smart sensor configuration
#
# Copyright (c) 2025, Bojan Sofronievski
# SPDX-License-Identifier: Apache-2.0

menuconfig BHI2XY
	bool "BHI2xy smart sensor"
	default y
	depends on DT_HAS_BOSCH_BHI2XY_ENABLED
	select BHI2XY_API_ENABLE
	select I2C if $(dt_compat_on_bus,$(DT_COMPAT_BOSCH_BHI2XY),i2c)
	select SPI if $(dt_compat_on_bus,$(DT_COMPAT_BOSCH_BHI2XY),spi)
	help
	  Enable driver for BHI260AP/BHI260AB ultra-low power smart sensor.
	  This sensor combines a 6-axis IMU (accelerometer and gyroscope) with
	  a programmable 32-bit microcontroller and event-driven software framework
	  for sensor fusion and processing.

if BHI2XY

config BHI2XY_BUS_I2C
	bool
	default y
	depends on $(dt_compat_on_bus,$(DT_COMPAT_BOSCH_BHI2XY),i2c)

config BHI2XY_BUS_SPI
	bool
	default y
	depends on $(dt_compat_on_bus,$(DT_COMPAT_BOSCH_BHI2XY),spi)

config BHI2XY_WORK_BUFFER_SIZE
	int "Work buffer size"
	default 2048
	help
	  Size of the work buffer used for FIFO processing operations.

config BHI2XY_USE_CUSTOM_FIRMWARE
	bool "Use custom Firmware files for the sensors"
	default n
	help
	  Instead of the pre-provided firmware files for BHI2XY sensor,
	  use user-provided firmware file, which should be named
	  "bhi2xy_firmware.inc", accessible from the include path.

endif # BHI2XY
```
