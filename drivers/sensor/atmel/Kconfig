## drivers/sensor/bma400/Kconfig
```kconfig
# BMA400 Three Axis Accelerometer configuration options

# Copyright (c) 2022 Elektronikutvecklingsbyrån EUB AB
# SPDX-License-Identifier: Apache-2.0

menuconfig BMA400
	bool "BMA400 Three Axis Accelerometer Family"
	depends on I2C
	help
	  Enable driver for BMA400 I2C-based triaxial accelerometer sensor
	  family.

if BMA400

choice
	prompt "Trigger mode"
	default BMA400_TRIGGER_NONE
	help
	  Specify the type of triggering to be used by the driver.

config BMA400_TRIGGER_NONE
	bool "No trigger"

config BMA400_TRIGGER_GLOBAL_THREAD
	bool "Use global thread"
	depends on GPIO
	select BMA400_TRIGGER

config BMA400_TRIGGER_OWN_THREAD
	bool "Use own thread"
	depends on GPIO
	select BMA400_TRIGGER

endchoice

config BMA400_TRIGGER
	bool

config BMA400_THREAD_PRIORITY
	int "Thread priority"
	depends on BMA400_TRIGGER_OWN_THREAD
	default 10
	help
	  Priority of thread used by the driver to handle interrupts.

config BMA400_THREAD_STACK_SIZE
	int "Thread stack size"
	depends on BMA400_TRIGGER_OWN_THREAD
	default 1024
	help
	  Stack size of thread used by the driver to handle interrupts.

choice
	prompt "Acceleration measurement range"
	default BMA400_RANGE_2G
	help
	  Measurement range for acceleration values.

config BMA400_RANGE_2G
	bool "+/-2g"

config BMA400_RANGE_4G
	bool "+/-4g"

config BMA400_RANGE_8G
	bool "+/-8g"

config BMA400_RANGE_16G
	bool "+/-16g"

endchoice

choice
	prompt "Acceleration sample rate"
	default BMA400_ODR_100
	help
	  Measurement range for acceleration values.

config BMA400_ODR_12_5
	bool "12.5 Hz"

config BMA400_ODR_25
	bool "25 Hz"

config BMA400_ODR_50
	bool "50 Hz"

config BMA400_ODR_100
	bool "100 Hz"

config BMA400_ODR_200
	bool "200 Hz"

config BMA400_ODR_400
	bool "400 Hz"

config BMA400_ODR_800
	bool "800 Hz"

endchoice

endif # BMA400
```

## drivers/sensor/bma422/Kconfig
```kconfig
# Copyright (c) 2023 Google LLC
# SPDX-License-Identifier: Apache-2.0

config EMUL_BMA422
	bool "BMA422 emulator"
	default y
	depends on DT_HAS_CROS_BMA422_EMUL_ENABLED
	select EMUL_COMMON_I2C
	help
	  Enable the BMA422 emulator, used to test the bma422 driver on an
	  emulated I2C bus; emulator API is in
	  zephyr/drivers/sensor/bma422/bma422_emul.h.
```

## drivers/sensor/bmc150_magn/Kconfig
```kconfig
# BMC150 magnetometer sensor configuration options

# Copyright (c) 2016 Intel Corporation
# SPDX-License-Identifier: Apache-2.0

menuconfig BMC150_MAGN
	bool "BMC150_MAGN I2C Magnetometer Chip"
	depends on I2C
	help
	  Enable driver for BMC150 I2C-based magnetometer sensor.

if BMC150_MAGN

menu "Attributes"

choice
	prompt "Default preset"
	default BMC150_MAGN_PRESET_REGULAR
	help
	  Specify the default preset (x/y oversampling, z oversampling, sampling
	  frequency).

config BMC150_MAGN_PRESET_LOW_POWER
	bool "Low power (3, 3, 10)"

config BMC150_MAGN_PRESET_REGULAR
	bool "Regular (9, 15, 10)"

config BMC150_MAGN_PRESET_ENHANCED_REGULAR
	bool "Enhanced regular (15, 27, 10)"

config BMC150_MAGN_PRESET_HIGH_ACCURACY
	bool "High accuracy (47, 83, 20)"

endchoice

config BMC150_MAGN_SAMPLING_RATE_RUNTIME
	bool "Dynamic sampling rate"
	help
	  Enable alteration of sampling rate attribute at runtime.

config BMC150_MAGN_SAMPLING_REP_XY
	bool "Dynamic XY oversampling"
	help
	  Enable alteration of XY oversampling at runtime.

config BMC150_MAGN_SAMPLING_REP_Z
	bool "Dynamic Z oversampling"
	help
	  Enable alteration of Z oversampling at runtime.

endmenu

config BMC150_MAGN_TRIGGER
	bool "Triggers"
	depends on GPIO
	help
	  Enable triggers for BMC150 magnetometer

config BMC150_MAGN_TRIGGER_THREAD_STACK
	int "Thread stack size"
	depends on BMC150_MAGN_TRIGGER
	default 1024
	help
	  Specify the internal thread stack size.

config BMC150_MAGN_TRIGGER_DRDY
	bool "Data ready trigger"
	depends on BMC150_MAGN_TRIGGER
	help
	  Enable data ready interrupt for BMC150 magnetometer

endif # BMC150_MAGN
```

## drivers/sensor/bme280/Kconfig
```kconfig
# Kconfig.bmp280 - BMP280 temperature and pressure sensor configuration options

#
# Copyright (c) 2016 Intel Corporation
# Copyright (c) 2017 IpTronix S.r.l.
#
# SPDX-License-Identifier: Apache-2.0
#
menuconfig BME280
	bool "BME280/BMP280 sensor"
	depends on I2C || SPI
	default	n
	help
	 Enable driver for BME280 I2C-based or SPI-based temperature and pressure sensor.

if BME280

menu "Attributes"

choice
	prompt "BME280 temperature oversampling"
	default BME280_TEMP_OVER_2X
	help
	  Select temperature oversampling for the BME280 sensor.  Higher values
	  lead to more accurate readings, but higher power consumption.
config BME280_TEMP_OVER_1X
	bool "x1"
config BME280_TEMP_OVER_2X
	bool "x2"
config BME280_TEMP_OVER_4X
	bool "x4"
config BME280_TEMP_OVER_8X
	bool "x8"
config BME280_TEMP_OVER_16X
	bool "x16"
endchoice

choice
	prompt "BME280 pressure oversampling"
	default BME280_PRESS_OVER_16X
	help
	  Select pressure oversampling for the BME280 sensor.  Higher values
	  lead to more accurate readings, but higher power consumption.
config BME280_PRESS_OVER_1X
	bool "x1"
config BME280_PRESS_OVER_2X
	bool "x2"
config BME280_PRESS_OVER_4X
	bool "x4"
config BME280_PRESS_OVER_8X
	bool "x8"
config BME280_PRESS_OVER_16X
	bool "x16"
endchoice

choice
	prompt "BME280 humidity oversampling"
	default BME280_HUMIDITY_OVER_16X
	help
	  Select humidity oversampling for the BME280 sensor.  Higher values
	  lead to more accurate readings, but higher power consumption.
config BME280_HUMIDITY_OVER_1X
	bool "x1"
config BME280_HUMIDITY_OVER_2X
	bool "x2"
config BME280_HUMIDITY_OVER_4X
	bool "x4"
config BME280_HUMIDITY_OVER_8X
	bool "x8"
config BME280_HUMIDITY_OVER_16X
	bool "x16"
endchoice

choice
	prompt "BME280 standby time"
	default BME280_STANDBY_1000MS
	help
	  Select standby time between measurements for the BME280 sensor.
	  Higher values lead to lower power consumption.
config BME280_STANDBY_05MS
	bool "0.5ms"
config BME280_STANDBY_62MS
	bool "62.5ms"
config BME280_STANDBY_125MS
	bool "125ms"
config BME280_STANDBY_250MS
	bool "250ms"
config BME280_STANDBY_500MS
	bool "500ms"
config BME280_STANDBY_1000MS
	bool "1000ms"
config BME280_STANDBY_2000MS
	bool "2000ms BMP280 / 10ms BME280"
config BME280_STANDBY_4000MS
	bool "4000ms BMP280 / 20ms BME280"
endchoice

choice
	prompt "BME280 filter coefficient"
	default BME280_FILTER_4
	help
	  Select the filter coefficient for the BME280 sensor.
config BME280_FILTER_OFF
	bool "filter off"
config BME280_FILTER_2
	bool "2"
config BME280_FILTER_4
	bool "4"
config BME280_FILTER_8
	bool "8"
config BME280_FILTER_16
	bool "16"
endchoice

endmenu

endif # BME280
```

## drivers/sensor/bme680/Kconfig
```kconfig
# BME680 temperature, pressure, humidity and gas sensor configuration options

# Copyright (c) 2018 Bosch Sensortec GmbH
# Copyright (c) 2022, Leonard Pollak
#
# SPDX-License-Identifier: Apache-2.0

menuconfig BME680
	bool "BME680 sensor"
	depends on I2C || SPI
	help
	  Enable driver for BME680 I2C- or SPI- based temperature, pressure, humidity and gas sensor.

if BME680

choice
	prompt "BME680 temperature oversampling"
	default BME680_TEMP_OVER_2X
	help
	  Select temperature oversampling for the BME680 sensor.  Higher values
	  lead to more accurate readings, but higher power consumption.
config BME680_TEMP_OVER_1X
	bool "x1"
config BME680_TEMP_OVER_2X
	bool "x2"
config BME680_TEMP_OVER_4X
	bool "x4"
config BME680_TEMP_OVER_8X
	bool "x8"
config BME680_TEMP_OVER_16X
	bool "x16"
endchoice

choice
	prompt "BME680 pressure oversampling"
	default BME680_PRESS_OVER_16X
	help
	  Select pressure oversampling for the BME680 sensor.  Higher values
	  lead to more accurate readings, but higher power consumption.
config BME680_PRESS_OVER_1X
	bool "x1"
config BME680_PRESS_OVER_2X
	bool "x2"
config BME680_PRESS_OVER_4X
	bool "x4"
config BME680_PRESS_OVER_8X
	bool "x8"
config BME680_PRESS_OVER_16X
	bool "x16"
endchoice

choice
	prompt "BME680 humidity oversampling"
	default BME680_HUMIDITY_OVER_1X
	help
	  Select humidity oversampling for the BME680 sensor.  Higher values
	  lead to more accurate readings, but higher power consumption.
config BME680_HUMIDITY_OVER_1X
	bool "x1"
config BME680_HUMIDITY_OVER_2X
	bool "x2"
config BME680_HUMIDITY_OVER_4X
	bool "x4"
config BME680_HUMIDITY_OVER_8X
	bool "x8"
config BME680_HUMIDITY_OVER_16X
	bool "x16"
endchoice

choice
	prompt "BME680 IIR low-pass filter coefficient"
	default BME680_FILTER_OFF
	help
	  Select the filter coefficient for the BME680 sensor.
config BME680_FILTER_OFF
	bool "filter off"
config BME680_FILTER_2
	bool "2"
config BME680_FILTER_4
	bool "4"
config BME680_FILTER_8
	bool "8"
config BME680_FILTER_16
	bool "16"
config BME680_FILTER_32
	bool "32"
config BME680_FILTER_64
	bool "64"
config BME680_FILTER_128
	bool "128"
endchoice

choice
	prompt "BME680 gas sensor's heater temperature in degree Celsius"
	default BME680_HEATR_TEMP_LP
	help
	  Select the gas sensor's heater temperature for the BME680 sensor.
config BME680_HEATR_TEMP_LP
	bool "320"
config BME680_HEATR_TEMP_ULP
	bool "400"
endchoice

choice
	prompt "BME680 gas sensor's heating duration in milliseconds"
	default BME680_HEATR_DUR_LP
	help
	  Select the gas sensor's heating duration for the BME680 sensor.
config BME680_HEATR_DUR_LP
	bool "197"
config BME680_HEATR_DUR_ULP
	bool "1943"
endchoice

endif # BME680
```

## drivers/sensor/bmg160/Kconfig
```kconfig
# Kconfig - Bosch BMG160 gyroscope configuration options

#
# Copyright (c) 2016 Intel Corporation
#
# SPDX-License-Identifier: Apache-2.0
#

menuconfig BMG160
	bool "Bosch BMG160 gyroscope support"
	depends on I2C
	default n
	help
	  Enable Bosch BMG160 gyroscope support.

config BMG160_DRV_NAME
	string "Driver's name"
	depends on BMG160
	default "bmg160"
	help
	  Name for the BMG160 driver which will be used for binding.

config BMG160_I2C_PORT_NAME
	string "I2C master controller port name"
	depends on BMG160
	default "I2C_0"
	help
	  Master I2C port name through which BMG160 chip is accessed.

config BMG160_I2C_ADDR
	hex "BMG160 I2C address"
	depends on BMG160
	default 0x68
	help
	  BMG160 chip's I2C address. Chip supports two addresses: 0x68 and 0x69 (if
	  SDO pin is pulled to GND).

choice
	prompt "BMG160 I2C bus speed"
	default BMG160_I2C_SPEED_STANDARD
	depends on BMG160

config BMG160_I2C_SPEED_STANDARD
	bool "Standard"
	help
	  Standard bus speed of up to 100kHz.

config BMG160_I2C_SPEED_FAST
	bool "Fast"
	help
	  Fast bus speed of up to 400KHz.
endchoice

choice
	prompt "Trigger mode"
	depends on BMG160
	default BMG160_TRIGGER_GLOBAL_THREAD
	help
	  Specify the type of triggering to be used by the driver.

config BMG160_TRIGGER_NONE
	bool
	prompt "No trigger"

config BMG160_TRIGGER_GLOBAL_THREAD
	bool "Use global thread"
	select BMG160_TRIGGER

config BMG160_TRIGGER_OWN_THREAD
	bool "Use own thread"
	select BMG160_TRIGGER
endchoice

config BMG160_TRIGGER
	bool
	depends on BMG160

config BMG160_THREAD_PRIORITY
	int "Own thread priority"
	depends on BMG160 && BMG160_TRIGGER_OWN_THREAD
	default 10
	help
	  The priority of the thread used for handling interrupts.

config BMG160_THREAD_STACK_SIZE
	int "Own thread stack size"
	depends on BMG160 && BMG160_TRIGGER_OWN_THREAD
	default 1024
	help
	  The thread stack size.

config BMG160_GPIO_PORT_NAME
	string "GPIO controller port name"
	depends on BMG160 && BMG160_TRIGGER
	default "GPIO_0"
	help
	  The gpio controller the interrupt pin is attached to.

config BMG160_INT_PIN
	hex "BMG160 INT PIN"
	depends on BMG160 && BMG160_TRIGGER
	default 2
	help
	  BMG160 interrupt pin.

choice
	prompt "Gyroscope range setting."
	depends on BMG160
	default BMG160_RANGE_RUNTIME

config BMG160_RANGE_RUNTIME
	bool "Set at runtime."

config BMG160_RANGE_2000DPS
	bool "2000 DPS"

config BMG160_RANGE_1000DPS
	bool "1000 DPS"

config BMG160_RANGE_500DPS
	bool "500 DPS"

config BMG160_RANGE_250DPS
	bool "250 DPS"

config BMG160_RANGE_125DPS
	bool "125 DPS"
endchoice

choice
	prompt "Gyroscope sampling frequency."
	depends on BMG160
	default BMG160_ODR_RUNTIME

config BMG160_ODR_RUNTIME
	bool "Set at runtime."

config BMG160_ODR_100
	bool "100 Hz"

config BMG160_ODR_200
	bool "200 Hz"

config BMG160_ODR_400
	bool "400 Hz"

config BMG160_ODR_1000
	bool "1000 Hz"

config BMG160_ODR_2000
	bool "2000 Hz"
endchoice
```

## drivers/sensor/bmi088/Kconfig
```kconfig
# Bosch BMI088 inertial measurement configuration options

# SPDX-License-Identifier: Apache-2.0

menuconfig BMI088
	bool "Bosch BMI088 inertial measurement unit"
	depends on SPI
	help
	  Enable Bosch BMI088 inertial measurement unit that provides acceleration
	  and angular rate measurements.
```
