## drivers/sensor/mockup/battery/Kconfig
```kconfig
# Kconfig Battery sensor mockup
#
# Copyright (c) 2018 Nordic Semiconductor ASA
#
# SPDX-License-Identifier: Apache-2.0
#

menuconfig MOCKUP_BATTERY_SENSOR
	bool "Battery charge sensor"

if MOCKUP_BATTERY_SENSOR

config BATTERY_SENSOR_DEV_NAME
	string "Device name"
	default "BATTERY"

config BATTERY_SENSOR_TRIG_PERIOD
	int "Trigger period (ms)"
	range 0 10000
	default 1000
	help
	  Interval at which SENSOR_TRIG_DATA_READY triggers are fired.

config BATTERY_SENSOR_LVL_MAX
	int "Maximum charge level (%)"
	range 0 100
	default 100

config BATTERY_SENSOR_LVL_MIN
	int "Minimum charge level (%)"
	range 0 100
	default 1

endif #MOCKUP_BATTERY_SENSOR
```
