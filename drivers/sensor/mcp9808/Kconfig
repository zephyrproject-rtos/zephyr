## drivers/sensor/mcp9808/Kconfig
```kconfig
# MCP9808 temperature sensor configuration options

# Copyright (c) 2016 Intel Corporation
# SPDX-License-Identifier: Apache-2.0

menuconfig MCP9808
	bool "MCP9808 temperature sensor"
	default y
	depends on DT_HAS_MICROCHIP_MCP9808_ENABLED
	select I2C
	help
	  Enable driver for MCP9808 temperature sensor.

if MCP9808

choice
	prompt "MCP9808 trigger mode"
	default MCP9808_TRIGGER_NONE

config MCP9808_TRIGGER_NONE
	bool "No trigger"

config MCP9808_TRIGGER_GLOBAL_THREAD
	depends on GPIO
	select MCP9808_TRIGGER
	bool "Use global thread"

config MCP9808_TRIGGER_OWN_THREAD
	depends on GPIO
	select MCP9808_TRIGGER
	bool "Use own thread"

endchoice

config MCP9808_TRIGGER
	bool

config MCP9808_THREAD_STACK_SIZE
	int "Sensor delayed work thread stack size"
	depends on MCP9808_TRIGGER_OWN_THREAD
	default 1024

config MCP9808_THREAD_PRIORITY
	int "MCP9808 thread priority"
	depends on MCP9808_TRIGGER_OWN_THREAD
	default 10

endif # MCP9808
```

## drivers/sensor/mcp98xx/Kconfig
```kconfig
# MCP98XX temperature sensor configuration options

# Copyright (c) 2016 Intel Corporation
# SPDX-License-Identifier: Apache-2.0

menuconfig MCP98XX
	bool "MCP98XX temperature sensor"
	default y
	depends on DT_HAS_MICROCHIP_MCP98XX_ENABLED
	select I2C
	help
	  Enable driver for MCP98XX temperature sensor.

if MCP98XX

choice
	prompt "MCP98XX chip type"
	default MCP98XX_CHIP_MCP9808

config MCP98XX_CHIP_MCP9808
	bool "Select MCP9808 chip type"

config MCP98XX_CHIP_MCP9844
	bool "Select MCP9844 chip type"

endchoice

choice
	prompt "MCP98XX trigger mode"
	default MCP98XX_TRIGGER_NONE

config MCP98XX_TRIGGER_NONE
	bool "No trigger"

config MCP98XX_TRIGGER_GLOBAL_THREAD
	depends on GPIO
	select MCP98XX_TRIGGER
	bool "Use global thread"

config MCP98XX_TRIGGER_OWN_THREAD
	depends on GPIO
	select MCP98XX_TRIGGER
	bool "Use own thread"

endchoice

config MCP98XX_TRIGGER
	bool

config MCP98XX_THREAD_STACK_SIZE
	int "Sensor delayed work thread stack size"
	depends on MCP98XX_TRIGGER_OWN_THREAD
	default 1024

config MCP98XX_THREAD_PRIORITY
	int "MCP98XX thread priority"
	depends on MCP98XX_TRIGGER_OWN_THREAD
	default 10

endif # MCP98XX
```

## drivers/sensor/mcux_acmp/Kconfig
```kconfig
# NXP MCUX analog comparator (ACMP) configuration options

# Copyright (c) 2020 Vestas Wind Systems A/S
# SPDX-License-Identifier: Apache-2.0

config MCUX_ACMP
	bool "NXP MCUX Analog Comparator (ACMP)"
	depends on HAS_MCUX_ACMP
	help
	  Enable driver for the NXP MCUX Analog Comparator (ACMP).

config MCUX_ACMP_TRIGGER
	bool "Trigger support"
	depends on MCUX_ACMP
	help
	  Enable trigger support for the NXP MCUX Analog Comparator
	  (ACMP).
```

## drivers/sensor/meas/Kconfig
```kconfig
# Copyright (c) 2024 Analog Devices, Inc.
# SPDX-License-Identifier: Apache-2.0

# zephyr-keep-sorted-start
source "drivers/sensor/meas/ms5607/Kconfig"
source "drivers/sensor/meas/ms5837/Kconfig"
# zephyr-keep-sorted-stop
```

## drivers/sensor/meas/htu31d/Kconfig
```kconfig
# Copyright The Zephyr Project Contributors
# SPDX-License-Identifier: Apache-2.0

config HTU31D
	bool "HTU31D Humidity and Temperature Sensor"
	default y
	depends on DT_HAS_MEAS_HTU31D_ENABLED
	select I2C
	select CRC
	help
	  Enable driver for the TE Connectivity HTU31D digital
	  humidity and temperature sensor over I2C.
```

## drivers/sensor/meas/ms5637/Kconfig
```kconfig
# Copyright The Zephyr Project Contributors
# SPDX-License-Identifier: Apache-2.0

config MS5637
	bool "MS5637 Pressure and Temperature Sensor"
	default y
	depends on DT_HAS_MEAS_MS5637_ENABLED
	select I2C
	select I2C_RTIO if SENSOR_ASYNC_API
	select RTIO_OP_DELAY if SENSOR_ASYNC_API
	help
	  Enable driver for the TE Connectivity MS5637 digital
	  pressure and temperature sensor over I2C.
```

## drivers/sensor/meas/ms56xx/Kconfig
```kconfig
# MS56XX pressure sensor configuration options

# Copyright (c) 2019 Thomas Schmid <tom@lfence.de>
# SPDX-License-Identifier: Apache-2.0

menuconfig MS56XX
	bool "MS5607/MS5611 pressure and temperature sensor"
	default y
	depends on DT_HAS_MEAS_MS56XX_ENABLED
	select I2C if $(dt_compat_on_bus,$(DT_COMPAT_MEAS_MS56XX),i2c)
	select SPI if $(dt_compat_on_bus,$(DT_COMPAT_MEAS_MS56XX),spi)
	help
	  Enable driver for the MS5607/MS5611 pressure and temperature sensor.

if MS56XX

choice
	prompt "Pressure oversampling."
	default MS56XX_PRES_OVER_2048X

config MS56XX_PRES_OVER_256X
	bool "x256"

config MS56XX_PRES_OVER_512X
	bool "x512"

config MS56XX_PRES_OVER_1024X
	bool "x1024"

config MS56XX_PRES_OVER_2048X
	bool "x2048"

config MS56XX_PRES_OVER_4096X
	bool "x4096"

endchoice


choice
	prompt "Temperature oversampling."
	default MS56XX_TEMP_OVER_2048X

config MS56XX_TEMP_OVER_256X
	bool "x256"

config MS56XX_TEMP_OVER_512X
	bool "x512"

config MS56XX_TEMP_OVER_1024X
	bool "x1024"

config MS56XX_TEMP_OVER_2048X
	bool "x2048"

config MS56XX_TEMP_OVER_4096X
	bool "x4096"

endchoice

endif # MS56XX
```

## drivers/sensor/meas/ms5837/Kconfig
```kconfig
# MS5837 pressure sensor configuration options

# Copyright (c) 2018 Jan Van Winkel <jan.van_winkel@dxplore.eu>
# Copyright (c) 2025 Ivan Wagner <ivan.wagner@tecinvent.ch>
# SPDX-License-Identifier: Apache-2.0

config MS5837
	bool "MS5837 pressure and temperature sensor"
	default y
	depends on DT_HAS_MEAS_MS5837_02BA_ENABLED || DT_HAS_MEAS_MS5837_30BA_ENABLED
	select I2C
	help
	  Enable driver for MS5837 pressure and temperature sensor.
```

## drivers/sensor/melexis/mlx90394/Kconfig
```kconfig
# Copyright (c) 2024 Florian Weber <Florian.Weber@live.de>
# SPDX-License-Identifier: Apache-2.0


config MLX90394
	bool "MLX90394 Magnetometer"
	default y
	depends on DT_HAS_MELEXIS_MLX90394_ENABLED
	select I2C
	help
	  Enable driver for MLX90394 magnetometer.
```

## drivers/sensor/melexis/mlx90632/Kconfig
```kconfig
# SPDX-FileCopyrightText: Copyright (c) Michele Tavecchio <tavecchiomichele03@gmail.com>
# SPDX-FileCopyrightText: Copyright (c) Alessandro Sola <alessandrosola03@gmail.com>
# SPDX-License-Identifier: Apache-2.0


menuconfig MLX90632
	bool "MLX90632 Infrared Temperature Sensor"
	default y
	depends on DT_HAS_MELEXIS_MLX90632_ENABLED
	select I2C
	help
	  Enable driver for MLX90632 infrared temperature sensor.

if MLX90632

choice MLX90632_MODE
	prompt "Operating Mode"
	default MLX90632_MODE_CONTINUOUS
	help
	  Select the measurement mode for the sensor.

config MLX90632_MODE_CONTINUOUS
	bool "Continuous Mode"
	help
	  Measurements are executed continuously.

config MLX90632_MODE_STEP
	bool "Step Mode"
	help
	  Device remains active but waits for a Start of Conversion (SOC) command.

config MLX90632_MODE_SLEEPING_STEP
	bool "Sleeping Step Mode"
	help
	  Device sleeps between measurements to save power (2.5uA).

endchoice

config MLX90632_REFRESH_RATE
	int "Refresh Rate (0...7)"
	range 0 7
	default 2
	help
	  Set the refresh rate.
	  Medical Mode: 0=0.5Hz, 1=1Hz, 2=2Hz, 3=4Hz, 4=8Hz, 5=16Hz, 6=32Hz, 7=64Hz.
	  Extended Mode: 0=0.16Hz, 1=0.32Hz, 2=0.65Hz, 3=1.3Hz, 4=2.6Hz, 5=5Hz, 6=10Hz, 7=20Hz.

config MLX90632_EXTENDED_MODE
	bool "Extended Range Mode"
	default n
	help
	  Enable the extended range measurement mode for the MLX90632 sensor.
	  This changes the measurement type (meas_select = 0x11) and uses
	  extended RAM registers and calculations.
endif # MLX90632
```

## drivers/sensor/memsic/Kconfig
```kconfig
# SPDX-License-Identifier: Apache-2.0
#
# Copyright (c) 2024 Intel

# zephyr-keep-sorted-start
source "drivers/sensor/memsic/mc3419/Kconfig"
source "drivers/sensor/memsic/mmc56x3/Kconfig"
# zephyr-keep-sorted-stop
```

## drivers/sensor/memsic/mc3419/Kconfig
```kconfig
# SPDX-License-Identifier: Apache-2.0
#
# Copyright (c) 2023 Linumiz

menuconfig MC3419
	bool "MC3419 acclerometer driver"
	default y
	depends on DT_HAS_MEMSIC_MC3419_ENABLED
	select I2C if $(dt_compat_on_bus,$(DT_COMPAT_MEMSIC_MC3419),i2c)
	help
	 Enable driver for MC3419 acclerometer.

if MC3419

config MC3419_TRIGGER
	bool "Trigger mode"

if MC3419_TRIGGER

config MC3419_TRIGGER_OWN_THREAD
	bool "Use own thread"
	help
	 Enable trigger to run in own thread. By
	 default it is global thread mode.

config MC3419_THREAD_PRIORITY
	int "Own thread priority"
	depends on MC3419_TRIGGER_OWN_THREAD
	default 10

config MC3419_THREAD_STACK_SIZE
	int "Own thread stask size"
	depends on MC3419_TRIGGER_OWN_THREAD
	default 1024

endif # MC3419_TRIGGER

endif # MC3419
```

## drivers/sensor/memsic/mmc56x3/Kconfig
```kconfig
# SPDX-License-Identifier: Apache-2.0
#
# Copyright (c) 2024 Intel

config MMC56X3
	bool "Memsic MMC56X3 magnetometer driver"
	default y
	depends on DT_HAS_MEMSIC_MMC56X3_ENABLED
	select I2C if $(dt_compat_on_bus,$(DT_COMPAT_MEMSIC_MMC56X3),i2c)
	help
	 Enable driver for MMC56X3 magnetometer and temperature sensor.
```

## drivers/sensor/mhz19b/Kconfig
```kconfig
# Copyright (c) 2021 G-Technologies Sdn. Bhd.
# SPDX-License-Identifier: Apache-2.0

config MHZ19B
	bool "Winsen CO2 sensor"
	default y
	depends on DT_HAS_WINSEN_MHZ19B_ENABLED
	depends on UART_INTERRUPT_DRIVEN
	help
	  Enable driver for the MHZ19B CO2 Sensor.
```

## drivers/sensor/microchip/Kconfig
```kconfig
# Copyright (c) 2024 Analog Devices, Inc.
# Copyright (c) 2025 Microchip Technology Inc.
# SPDX-License-Identifier: Apache-2.0

source "drivers/sensor/microchip/*/Kconfig"
```

## drivers/sensor/microchip/mcp9600/Kconfig
```kconfig
# I2C Compatible, Thermocouple EMF to Temperature Converter
#
# Copyright (c) 2022, Maxmillion McLaughlin
# Copyright (c) 2020, SER Consulting LLC / Steven Riedl
#
# SPDX-License-Identifier: Apache-2.0

config MCP9600
	bool "MCP9600 i2c thermocouple temperature sensor"
	default y
	depends on DT_HAS_MICROCHIP_MCP9600_ENABLED
	select I2C
	help
	  Enable driver for MCP9600 i2c thermocouple temperature sensor.
```

## drivers/sensor/microchip/mcp9843/Kconfig
```kconfig
# Copyright 2024 Vogl Electronic GmbH
# SPDX-License-Identifier: Apache-2.0

config MCP9843
	bool "MCP9843 temperature sensor"
	default y
	depends on DT_HAS_MICROCHIP_MCP9843_ENABLED
	select I2C
	help
	  Enable MCP9843 temperature sensor support.
```

## drivers/sensor/microchip/mec5_tach/Kconfig
```kconfig
# Microchip MEC5 HAL based tachometer sensor configuration options

# Copyright (c) 2024 Microchip Technology Inc.
# SPDX-License-Identifier: Apache-2.0

config TACH_MEC5
	bool "Microchip MEC5 HAL based Tachometer sensor"
	default y
	depends on DT_HAS_MICROCHIP_MEC5_TACH_ENABLED
	depends on SOC_FAMILY_MICROCHIP_MEC
	depends on HAS_MEC5_HAL
	select PINCTRL
	help
	  Enable the Microchip MEC5 HAL based tachometer sensor.

if TACH_MEC5

config TACH_MEC5_INTERRUPT
	bool "Microchip MEC5 TACH driver use interrupt"
	default n
	help
	  Enable the MCHP MEC5 TACH driver to use interrupts
	  instead of a polling loop.

endif # TACH_MEC5
```

## drivers/sensor/microchip/mtch9010/Kconfig
```kconfig
# Copyright (c) 2025 Microchip Technology Inc.
# SPDX-License-Identifier: Apache-2.0

menuconfig MTCH9010
	bool "MTCH9010"
	default y
	depends on DT_HAS_MICROCHIP_MTCH9010_ENABLED
	help
	Configure the MTCH9010 driver

if MTCH9010

	config MTCH9010_RESET_ON_STARTUP
		bool "Reset MTCH9010 on Startup"
		default y
		help
		  Resets the MTCH9010 before the driver configures it.
		  If disabled and the MTCH9010 was configured already, configuration will fail.

	config MTCH9010_LOCK_ON_STARTUP
		bool "Save MTCH9010 Settings on Startup"
		default n
		help
		  If set, this option will assert SYS_LK after initialization.
		  The sensor will use these parameters if SYS_LK is asserted on the next POR.

	config MTCH9010_SAMPLE_DELAY_TIMEOUT_MS
		int "Maximum wait time to get a sample (ms)"
		default 500
		help
		  Sets the maximum amount of time in milliseconds to wait for a response from the MTCH9010
		  when asking for a sample. Conductive mode is much faster than capacitive mode.

	config MTCH9010_OVERRIDE_DELAY_ENABLE
		bool "Override Delay if not Wake on Request"
		default y
		help
		  If the MTCH9010 has a sleep period defined, the wake pin will not wake the device.
		  If this option is set, the API will allow for <sleep period + timeout> length
		  delays during fetch. Otherwise, the API will use the normal timeout, and likely fail.

	config MTCH9010_REFERENCE_AVERAGING_COUNT
		int "Reference Averaging Count"
		default 1
		range 1 64
		help
		  If the MTCH9010 is using the current measurement as its reference, then this
		  is the number of samples to average.

	config MTCH9010_HEARTBEAT_MONITORING_ENABLE
		bool "Heartbeat Monitoring"
		default y
		help
		  Configures monitoring of the heartbeat output

	# Logging Settings
	module = MTCH9010
	module-str = MTCH9010
	source "subsys/logging/Kconfig.template.log_config"

endif
```

## drivers/sensor/microchip/pac194x/Kconfig
```kconfig
# Microchip PAC195X power monitor driver
#
# Copyright (c) 2026 Google, LLC
#
# SPDX-License-Identifier: Apache-2.0

config PAC194X
	bool "PAC194X/PAC195X power monitor sensor"
	default y
	depends on DT_HAS_MICROCHIP_PAC194X_ENABLED
	select I2C
	help
	  Enables PAC194X/PAC195X power monitor driver.
```

## drivers/sensor/microchip/tcn75a/Kconfig
```kconfig
# Copyright 2023 Daniel DeGrasse <daniel@degrasse.com>
# SPDX-License-Identifier: Apache-2.0

config TCN75A
	bool "TCN75A Ambient Temperature Sensor"
	default y
	depends on DT_HAS_MICROCHIP_TCN75A_ENABLED
	select I2C
	help
	  Enable TCN75A ambient temperature to digital converter

if TCN75A

choice
	prompt "TCN75A Trigger mode"
	default TCN75A_TRIGGER_NONE

config TCN75A_TRIGGER_NONE
	bool "No trigger"

config TCN75A_TRIGGER_OWN_THREAD
	bool "Use own thread"
	select TCN75A_TRIGGER

config TCN75A_TRIGGER_GLOBAL_THREAD
	bool "Use global thread"
	select TCN75A_TRIGGER

endchoice

config TCN75A_TRIGGER
	bool
	help
	  Enable interrupt based trigger support for TCN75A. Requires that
	  the sensor be set to continuous sample mode.

if TCN75A_TRIGGER_OWN_THREAD

config TCN75A_THREAD_PRIORITY
	int "Own thread priority"
	default 10

config TCN75A_THREAD_STACK_SIZE
	int "Own thread stack size"
	default 1024

endif # TCN75A_TRIGGER_OWN_THREAD


endif # TCN75A
```

## drivers/sensor/mma8451q/Kconfig
```kconfig
# Kconfig - MMA8451Q Accelerometer sensor configuration options
#
# Copyright (c) 2018 Lars Knudsen
#
# SPDX-License-Identifier: Apache-2.0
#

menuconfig MMA8451Q
	bool "MMA8451Q Accelerometer driver"
	depends on I2C && HAS_DTS_I2C
	help
	  Enable driver for MMA8451Q Accelerometer.

if MMA8451Q

config MMA8451Q_WHOAMI
	hex "WHOAMI value"
	default 0x1A
	help
	  The whoami value for MMA8451Q (0x1A).

choice
	prompt "Range"
	default MMA8451Q_RANGE_2G

config MMA8451Q_RANGE_8G
	bool "8g (0.976 mg/LSB)"

config MMA8451Q_RANGE_4G
	bool "4g (0.488 mg/LSB)"

config MMA8451Q_RANGE_2G
	bool "2g (0.244 mg/LSB)"

endchoice

endif # MMA8451Q
```

## drivers/sensor/mma8653fc/Kconfig
```kconfig
# Kconfig - MMA8653 Accelerometer sensor configuration options
#
# Copyright (c) 2018 William Fish
#
# SPDX-License-Identifier: Apache-2.0
#

menuconfig MMA8653
	bool "MMA8653 Accelerometer driver"
	depends on I2C
	help
	  Enable driver for MMA8653 Accelerometer.

if MMA8653

if !HAS_DTS_I2C_DEVICE

config MMA8653_NAME
	string "Device name"
	default "MMA8653"

config MMA8653_I2C_NAME
	string "I2C device name"
	default I2C_0_NAME

config MMA8653_I2C_ADDRESS
	hex "I2C address for MMA8653 Sensor"
	default 0x3A
	help
	  I2C address of the MMA8653 sensor.
	  0x1D: I2C_ADDR

endif # !HAS_DTS_I2C_DEVICE

config MMA8653_WHOAMI
	hex "WHOAMI value"
	default 0x5A
	help
	  The whoami value for MMA8653 (0x5A).

choice
	prompt "Range"
	default MMA8653_RANGE_2G

config MMA8653_RANGE_8G
	bool "8g (0.976 mg/LSB)"

config MMA8653_RANGE_4G
	bool "4g (0.488 mg/LSB)"

config MMA8653_RANGE_2G
	bool "2g (0.244 mg/LSB)"

endchoice

endif # MMA8653
```

## drivers/sensor/mockup/Kconfig
```kconfig
# Kconfig Mockup sensors
#
# Copyright (c) 2018 Nordic Semiconductor ASA
#
# SPDX-License-Identifier: Apache-2.0
#

menu "Mockup sensor drivers"

source "drivers/sensor/mockup/battery/Kconfig"

endmenu
```
