## drivers/sensor/zephyr_thermistor/Kconfig
```kconfig
# Zephyr Generic NTC Thermistor
#
# Copyright (c) 2023 Google LLC
#
# SPDX-License-Identifier: Apache-2.0

config ZEPHYR_NTC_THERMISTOR
	bool "Zephyr Generic NTC Thermistor"
	default y
	depends on DT_HAS_ZEPHYR_NTC_THERMISTOR_ENABLED
	depends on DT_HAS_ZEPHYR_NTC_THERMISTOR_RT_TABLE_ENABLED
	select ADC
	help
	  Enable driver for Zephyr NTC Thermistor.
```

## drivers/sent/Kconfig
```kconfig
# Copyright 2025 NXP
# SPDX-License-Identifier: Apache-2.0

menuconfig SENT
	bool "SENT Single Edge Nibble Transmission (SENT)"
	help
	  Enable SENT Driver Configuration

if SENT

module = SENT
module-str = sent
source "subsys/logging/Kconfig.template.log_config"

config SENT_INIT_PRIORITY
	int "SENT driver init priority"
	default KERNEL_INIT_PRIORITY_DEVICE
	help
	  SENT driver device initialization priority.

source "drivers/sent/Kconfig.nxp_s32"

endif # SENT
```

## drivers/sent/Kconfig.nxp_s32
```kconfig
# Copyright 2025 NXP
# SPDX-License-Identifier: Apache-2.0

config SENT_NXP_S32
	bool "NXP S32 SENT driver"
	default y
	depends on DT_HAS_NXP_S32_SENT_ENABLED
	select PINCTRL if $(dt_compat_any_has_prop,$(DT_COMPAT_NXP_S32_SENT),pinctrl-0)
	help
	  Enable support for NXP S32 SENT driver.
```

## drivers/serial/Kconfig
```kconfig
# Serial driver configuration options

# Copyright (c) 2014-2015 Wind River Systems, Inc.
# SPDX-License-Identifier: Apache-2.0

menuconfig SERIAL
	bool "Serial drivers"
	help
	  Enable options for serial drivers.

if SERIAL

comment "Capabilities"

config SERIAL_HAS_DRIVER
	bool
	help
	  This is an option to be enabled by individual serial driver
	  to signal that there is a serial driver. This is being used
	  by other drivers which are dependent on serial.

config SERIAL_SUPPORT_ASYNC
	bool
	help
	  This is an option to be enabled by individual serial driver
	  to signal that the driver and hardware supports async operation.

config SERIAL_SUPPORT_INTERRUPT
	bool
	help
	  This is an option to be enabled by individual serial driver
	  to signal that the driver and hardware supports interrupts.

config SERIAL_INIT_PRIORITY
	int "Serial init priority"
	default KERNEL_INIT_PRIORITY_DEVICE
	help
	  Serial driver device initialization priority.

module = UART
module-str = uart
source "subsys/logging/Kconfig.template.log_config"

config SERIAL_SUPPORT_WIDE_DATA
	bool
	help
	  This is an option to be enabled by individual serial driver
	  to signal that the driver and hardware support data longer
	  than 8-bit.

config UART_USE_RUNTIME_CONFIGURE
	bool "Runtime configuration for UART controllers"
	default y
	help
	  Enable runtime configuration of UART controllers.
	  This allows applications to call uart_configure() to
	  configure the UART controllers at runtime, and calling
	  uart_config_get() to retrieve configuration. If this is
	  disabled, UART controllers rely on UART driver's
	  initialization function to properly configure
	  the controller.

	  Say y if unsure. Disable this to reduce footprint for
	  applications that do not require runtime UART configuration.

config UART_ASYNC_API
	bool "Asynchronous UART API"
	depends on SERIAL_SUPPORT_ASYNC
	help
	  This option enables asynchronous UART API.

config UART_INTERRUPT_DRIVEN
	bool "UART Interrupt support"
	depends on SERIAL_SUPPORT_INTERRUPT
	help
	  This option enables interrupt support for UART allowing console
	  input and other UART based drivers.

config UART_EXCLUSIVE_API_CALLBACKS
	bool "Use exclusive callbacks for multiple APIs"
	depends on UART_ASYNC_API && UART_INTERRUPT_DRIVEN
	default y
	help
	  When multiple set of APIs support callbacks, enabling this
	  option will result in only the callbacks of one set of API
	  being active at a time. Setting a new callback to one set of
	  API will remove callbacks to other set of APIs. For example,
	  calling uart_callback_set() would disable the callback
	  previously set via uart_irq_callback_set().

	  Says yes unless you are absolutely sure you know what you are
	  doing and promise not to file bug when things do not work out.

config UART_LINE_CTRL
	bool "Serial Line Control API"
	help
	  This enables the API for apps to control the serial line,
	  such as baud rate, CTS and RTS.

	  Implementation is up to individual driver.

	  Says no if not sure.

config UART_DRV_CMD
	bool "Driver commands API"
	help
	  This enables the API to send extra commands to drivers.
	  This allows drivers to expose hardware specific functions.

	  Says no if not sure.

config UART_WIDE_DATA
	bool "API to support data longer than 8-bit"
	help
	  This enables the API to process data longer than 8-bit.
	  This is up to the driver to implement the necessary functions
	  to properly support this.

config UART_PIPE
	bool "Pipe UART driver"
	select UART_INTERRUPT_DRIVEN
	help
	  Enable pipe UART driver. This driver allows application to communicate
	  over UART with custom defined protocol. Driver doesn't inspect received
	  data (as contrary to console UART driver) and all aspects of received
	  protocol data are handled by application provided callback.

config UART_ASYNC_RX_HELPER
	bool "Helper for UART asynchronous reception"
	help
	  Module implements handling of reception of variable length data using
	  Asynchronous UART API. It can be used in cases where received data processing
	  is delayed. Module implements zero-copy approach with multiple reception
	  buffers.

config UART_ASYNC_TO_INT_DRIVEN_API
	bool
	select UART_ASYNC_RX_HELPER
	help
	  Asynchronous to Interrupt driven adaptation layer. When enabled device
	  which implements only asynchronous API can be used with interrupt driven
	  API implemented by the generic adaptation layer.

config UART_ASYNC_TO_INT_DRIVEN_RX_TIMEOUT
	int "Receiver timeout (in bauds)"
	depends on UART_ASYNC_TO_INT_DRIVEN_API
	default 100
	help
	  Receiver inactivity timeout. It is used to calculate timeout in microseconds.

config UART_SHELL
	bool "UART Shell commands"
	depends on SHELL
	help
	  UART Shell commands

comment "Serial Drivers"

rsource "Kconfig.*"

endif # SERIAL
```

## drivers/serial/Kconfig.acts
```kconfig
# Actions Semi UART

# Copyright (c) 2019 Actions (Zhuhai) Technology Co., Ltd
# Copyright (c) 2019 Manivannan Sadhasivam <mani@kernel.org>
# SPDX-License-Identifier: Apache-2.0

menuconfig UART_ACTS
	bool "Actions Semi UART driver"
	default n
	select SERIAL_HAS_DRIVER
	select SERIAL_SUPPORT_INTERRUPT
	depends on SOC_FAMILY_ACTIONS
	help
	  Enable the Actions Semi UART driver.

config UART_ACTS_UART_0
	bool "Enable Actions Semi UART0 port"
	depends on UART_ACTS
	help
	  Enable support for UART0 port in the driver.
	  Say y here if you want to use UART0 device.

config UART_ACTS_UART_1
	bool "Enable Actions Semi UART1 port"
	depends on UART_ACTS
	help
	  Enable support for UART1 port in the driver.
	  Say y here if you want to use UART1 device.

config UART_ACTS_UART_2
	bool "Enable Actions Semi UART2 port"
	depends on UART_ACTS
	help
	  Enable support for UART2 port in the driver.
	  Say y here if you want to use UART2 device.
```

## drivers/serial/Kconfig.aesc
```kconfig
# Copyright (c) 2025 Aesc Silicon
# SPDX-License-Identifier: Apache-2.0

config UART_AESC
	bool "Aesc Silicon UART driver"
	default y
	depends on DT_HAS_AESC_UART_ENABLED
	select SERIAL_HAS_DRIVER
	help
	  Enable the Aesc Silicon UART driver.
```

## drivers/serial/Kconfig.altera
```kconfig
# Copyright (c) 2023 Intel Corporation
# SPDX-License-Identifier: Apache-2.0

config UART_ALTERA
	bool "ALTERA UART driver"
	depends on DT_HAS_ALTR_UART_ENABLED
	select SERIAL_HAS_DRIVER
	select SERIAL_SUPPORT_INTERRUPT
	help
	  Enable the Altera UART driver, that can be built into Intel NiosV CPU designs.

config UART_ALTERA_EOP
	bool "ALTERA UART end of packet feature"
	depends on UART_ALTERA && UART_DRV_CMD && UART_INTERRUPT_DRIVEN
	help
	  Use driver command CMD_ENABLE_EOP and CMD_DISABLE_EOP to use the feature.

config UART_ALTERA_LINE_CTRL_WORKAROUND
	bool "ALTERA UART flow control workaround"
	depends on UART_ALTERA && UART_LINE_CTRL
	help
	  Before enabling this, please try to optimise the ISR to fetch the receive data faster.
	  Enabling this will cause the transmitter to wait for rising edge of CTS before sending.
	  The receiver will deassert RTS as soon as a byte is received and reassert after the byte is fetched.
```

## drivers/serial/Kconfig.altera_jtag
```kconfig
# Copyright (c) 2017-2023 Intel Corporation
# SPDX-License-Identifier: Apache-2.0

config UART_ALTERA_JTAG
	bool "NiosV JTAG UART driver"
	default y
	depends on DT_HAS_ALTR_JTAG_UART_ENABLED
	select SERIAL_HAS_DRIVER
	help
	  Enable the Altera JTAG UART driver, built in to many NiosV CPU
	  designs.

config UART_ALTERA_JTAG_SUPPORT_INTERRUPT
	bool
	depends on UART_ALTERA_JTAG
	default y
	select SERIAL_SUPPORT_INTERRUPT
	help
	  This is a helper config. Altera JTAG UART driver will support interrupt,
	  if UART_ALTERA_JTAG_HAL is disabled.
```

## drivers/serial/Kconfig.ambiq
```kconfig
# Copyright (c) 2025, Ambiq Micro Inc. <www.ambiq.com>
# SPDX-License-Identifier: Apache-2.0

config UART_AMBIQ
	bool "AMBIQ UART driver"
	default y
	depends on DT_HAS_AMBIQ_UART_ENABLED
	depends on SOC_SERIES_APOLLO5X || SOC_SERIES_APOLLO4X
	select SERIAL_HAS_DRIVER
	select SERIAL_SUPPORT_INTERRUPT
	select SERIAL_SUPPORT_ASYNC if SOC_SERIES_APOLLO5X
	select PINCTRL
	select AMBIQ_HAL
	select AMBIQ_HAL_USE_UART
	help
	  Enable the AMBIQ UART driver.

if UART_AMBIQ

config UART_AMBIQ_HANDLE_CACHE
	bool "Turn on cache handling in uart driver"
	default y
	depends on CACHE_MANAGEMENT && DCACHE
	help
	  Disable this if cache has been handled in upper layers.

endif # UART_AMBIQ
```

## drivers/serial/Kconfig.ameba
```kconfig
# AMEBA UART configuration

# Copyright (c) 2024 Realtek Semiconductor Corp.
# SPDX-License-Identifier: Apache-2.0

config UART_AMEBA
	bool "AMEBA MCU serial driver"
	default y
	depends on DT_HAS_REALTEK_AMEBA_UART_ENABLED
	select PINCTRL
	select SERIAL_HAS_DRIVER
	select SERIAL_SUPPORT_INTERRUPT
	# the ASYNC implementation requires a DMA controller
	select SERIAL_SUPPORT_ASYNC \
		if DT_HAS_REALTEK_AMEBA_GDMA_ENABLED
	select DMA if UART_ASYNC_API
	help
	  This option enables the UART driver for AMEBA family of processors.
	  Say y if you wish to use serial port on AMEBA MCU.

config SERIAL_ASYNC_WITH_ERETI
	bool
	# realize serial async mechanism with ERETI interrupt
```

## drivers/serial/Kconfig.apbuart
```kconfig
# Copyright (c) 2019-2020 Cobham Gaisler AB
# SPDX-License-Identifier: Apache-2.0

config UART_APBUART
	bool "ABPUART serial driver"
	depends on SOC_SPARC_LEON
	select SERIAL_HAS_DRIVER
	select SERIAL_SUPPORT_INTERRUPT
	help
	  This option enables the APBUART driver for LEON processors.
```

## drivers/serial/Kconfig.asclin
```kconfig
# Copyright (c) 2024 Infineon Technologies AG
# SPDX-License-Identifier: Apache-2.0

config UART_ASCLIN
	bool "ASCLIN serial driver"
	default y
	select PINCTRL
	depends on DT_HAS_INFINEON_ASCLIN_UART_ENABLED
	select SERIAL_HAS_DRIVER
	select SERIAL_SUPPORT_INTERRUPT
	help
	  This option enables the ASCLIN driver for Aurix processors.
```

## drivers/serial/Kconfig.at32
```kconfig
# Copyright (c) 2021 ATL Electronics
# SPDX-License-Identifier: Apache-2.0

config USART_AT32
	bool "AT32 serial driver"
	default y
	depends on DT_HAS_ARTERY_AT32_USART_ENABLED
	select PINCTRL
	select SERIAL_HAS_DRIVER
	select SERIAL_SUPPORT_INTERRUPT
	help
	  This option enables the USART driver for AT32 SoC family.
```

## drivers/serial/Kconfig.atm
```kconfig
# Atmosic UART Configuration

# Copyright (c) 2022 Atmosic
# SPDX-License-Identifier: Apache-2.0

config UART_ATM
	bool "Atmosic UART driver"
	default y
	depends on DT_HAS_ATMOSIC_ATM_UART_ENABLED
	select SERIAL_HAS_DRIVER
	select SERIAL_SUPPORT_INTERRUPT
	help
	  This option enables the UART driver for Atmosic

if UART_ATM && PM

config UART_ATM_PM_RX_THREAD_STACK_SIZE
	int "Receive power management thread size"
	default 512

config UART_ATM_PM_RX_THREAD_PRIO
	int "Receive power management thread priority"
	default 2

config UART_ATM_RTT_LPC
	int "Flow control round trip time"
	default 4
	help
	  This value takes into consideration all delays that would influence RTS deassertion,
	  including cable length and peer data equipment responsiveness.
	  Measured in LP cycles.

config UART_ATM_AFTER_ACTIVE_MS
	int "Stay active delay after Rx activity"
	default 20
	help
	  Keep RTS asserted for a finite duration after receiving data.
	  Helps maintain good throughput with power management.
	  Measured in milliseconds.

config UART_ATM_AFTER_WAKE_MS
	int "Stay active delay after waking from SUSPEND_TO_RAM"
	default 2
	help
	  Keep RTS asserted for a finite duration after waking from SUSPEND_TO_RAM.
	  Helps maintain good throughput with power management.
	  Measured in milliseconds.

config UART_ATM_MAX_SLEEP_MS
	int "Maximum duration of sleep"
	default 100
	help
	  Maximum time spent sleeping with RTS forced off (aka: Rx prevented).
	  Helps maintain good Rx latency with power management.
	  Measured in milliseconds.

endif
```

## drivers/serial/Kconfig.atmel_sam3
```kconfig
menuconfig UART_ATMEL_SAM3
	bool "[deprecated] Atmel SAM3 family processor UART driver"
	default n
	select SERIAL_HAS_DRIVER
	depends on SOC_SERIES_SAM3X
	help

	This driver is deprecated and will be removed. Use
	"Atmel SAM MCU family UART driver" instead.

	This option enables the UART driver for Atmel SAM3
	family processors. Note that there is only one
	UART controller on SAM3. It has only two wires
	for RX and TX, and does not have other pins
	(such as CTS and RTS).

config UART_ATMEL_SAM3_IRQ_PRI
	int "Atmel SAM3 UART Interrupt Priority"
	default 0
	depends on UART_ATMEL_SAM3
	help
	  The interrupt priority for UART port.

config UART_ATMEL_SAM3_BAUD_RATE
	int "Atmel SAM3 UART Baud Rate"
	default 0
	depends on UART_ATMEL_SAM3
	help
	  The baud rate for UART port to be set to at boot.

config UART_ATMEL_SAM3_CLK_FREQ
	int "Atmel SAM3 UART Clock Frequency"
	default 0
	depends on UART_ATMEL_SAM3
	help
	  The clock frequency for UART port.
```

## drivers/serial/Kconfig.b91
```kconfig
# Copyright (c) 2021 Telink Semiconductor
# SPDX-License-Identifier: Apache-2.0

# Telink B91 UART configuration options

config UART_TELINK_B91
	bool "Telink B91 UART driver"
	default y
	depends on DT_HAS_TELINK_B91_UART_ENABLED
	select SERIAL_HAS_DRIVER
	select SERIAL_SUPPORT_INTERRUPT
	select PINCTRL
	help
	  This option enables the B91 serial driver.
```

## drivers/serial/Kconfig.b9x
```kconfig
# Copyright (c) 2021-2024 Telink Semiconductor
# SPDX-License-Identifier: Apache-2.0

# Telink B9X UART configuration options

config UART_TELINK_B9X
	bool "Telink B9x UART driver"
	default y
	depends on DT_HAS_TELINK_B9X_UART_ENABLED
	select SERIAL_HAS_DRIVER
	select SERIAL_SUPPORT_INTERRUPT
	help
	  This option enables the B9x serial driver.
```

## drivers/serial/Kconfig.bcm2711
```kconfig
# Copyright (c) 2023 honglin leng <a909204013@gmail.com>
# SPDX-License-Identifier: Apache-2.0

config UART_BCM2711_MU
	bool "bcm2711_mu"
	default y
	depends on DT_HAS_BRCM_BCM2711_AUX_UART_ENABLED
	select SERIAL_HAS_DRIVER
	select SERIAL_SUPPORT_INTERRUPT
	help
	  bcm2711_mu Low Power Serial Port.
```

## drivers/serial/Kconfig.bee
```kconfig
# Copyright (c) 2026, Realtek Semiconductor Corporation
# SPDX-License-Identifier: Apache-2.0

config UART_BEE
	bool "Realtek Bee series UART driver"
	default y
	depends on DT_HAS_REALTEK_BEE_UART_ENABLED
	select HAL_REALTEK_BEE_UART
	select SERIAL_HAS_DRIVER
	select SERIAL_SUPPORT_INTERRUPT
	select PINCTRL
	help
	  This option enables the UART driver for Realtek Bee SoCs.
```

## drivers/serial/Kconfig.bflb
```kconfig
# Copyright (c) 2021-2025 ATL Electronics
#
# SPDX-License-Identifier: Apache-2.0

config UART_BFLB
	bool "Bouffalo Lab serial driver"
	depends on DT_HAS_BFLB_UART_ENABLED
	select PINCTRL
	select SERIAL_HAS_DRIVER
	select USE_BFLB_UART
	help
	  This option enables the UART driver for Bouffalo Lab SoC family.
```
