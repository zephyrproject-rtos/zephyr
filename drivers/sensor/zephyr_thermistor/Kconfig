## drivers/serial/Kconfig.bitbang
```kconfig
# Copyright (c) 2025 Joel Guittet
# SPDX-License-Identifier: Apache-2.0

config UART_BITBANG
	bool "Bitbang UART controller driver"
	default y
	depends on DT_HAS_ZEPHYR_UART_BITBANG_ENABLED
	select SERIAL_HAS_DRIVER
	select SERIAL_SUPPORT_INTERRUPT
	select COUNTER
	select RING_BUFFER
	help
	  Enable the Bitbang UART controller.
	  The driver relies on counter interrupts to generate/sample UART
	  frames. By nature the accuracy of the interrupts period is not
	  guaranteed and subject to some impacts from the other activities of
	  the application. The relative deviation that could be observed is
	  lower when the baudrate is low. It is also recommended to have parity
	  and/or other error detection mechanisms to detect transmission
	  errors.
	  This driver is provided in the hope it will be useful to provide
	  extra UART interfaces and/or supports modes that are not supported by
	  hardware UART peripherals on some platforms. Applications integrating
	  this driver should be aware of the above limitations.
```

## drivers/serial/Kconfig.bridge
```kconfig
# Copyright 2025 Google LLC
# SPDX-License-Identifier: Apache-2.0

config UART_BRIDGE
	bool "UART bridge"
	default y
	depends on DT_HAS_ZEPHYR_UART_BRIDGE_ENABLED
	select UART_INTERRUPT_DRIVEN
	select RING_BUFFER
	help
	  Enable the UART bridge driver.

config UART_BRIDGE_BUF_SIZE
	int "UART bridge buffer size"
	default 256
	depends on UART_BRIDGE
	help
	  Size of the bridge ring buffers in bytes.
```

## drivers/serial/Kconfig.bt
```kconfig
# Copyright (c) 2024 Croxel, Inc.
# SPDX-License-Identifier: Apache-2.0

config UART_BT
	bool "UART over NUS Bluetooth LE"
	depends on BT_ZEPHYR_NUS
	depends on DT_HAS_ZEPHYR_NUS_UART_ENABLED
	select UART_INTERRUPT_DRIVEN
	select RING_BUFFER
	select EXPERIMENTAL
	select SERIAL_SUPPORT_INTERRUPT
	help
	  Enable the UART over NUS Bluetooth driver, which can be used to pipe
	  serial data over Bluetooth LE GATT using NUS (Nordic UART Service).

if UART_BT

config UART_BT_WORKQUEUE_PRIORITY
	int "UART NUS Work-queue Priority"
	default MAIN_THREAD_PRIORITY
	help
	  Select UART NUS Work-queue priority based on the application context.

config UART_BT_WORKQUEUE_STACK_SIZE
	int "UART NUS Work-queue Stack Size"
	default 1024
	help
	  Set UART NUS Work-queue Stack-size based on the application context.

endif

config UART_BT_SPP
	bool "UART over Bluetooth Classic SPP (RFCOMM)"
	depends on BT_RFCOMM
	depends on DT_HAS_ZEPHYR_BT_SPP_UART_ENABLED
	select UART_INTERRUPT_DRIVEN
	select RING_BUFFER
	select EXPERIMENTAL
	select SERIAL_SUPPORT_INTERRUPT
	help
	  Enable the UART over Bluetooth Classic SPP driver, which can be used
	  to pipe serial data over RFCOMM. This follows the same pattern as the
	  NUS UART driver (CONFIG_UART_BT) but for BR/EDR connections.

if UART_BT_SPP

config UART_BT_SPP_WORKQUEUE_PRIORITY
	int "SPP UART work-queue priority"
	default MAIN_THREAD_PRIORITY
	help
	  Priority of the SPP UART work-queue thread.

config UART_BT_SPP_WORKQUEUE_STACK_SIZE
	int "SPP UART work-queue stack size"
	default 1024
	help
	  Stack size of the SPP UART work-queue thread.

endif # UART_BT_SPP
```

## drivers/serial/Kconfig.cc13xx_cc26xx
```kconfig
# TI CC13xx / CC26xx UART configuration options

# Copyright (c) 2019 Brett Witherspoon
# SPDX-License-Identifier: Apache-2.0

config UART_CC13XX_CC26XX
	bool "TI SimpleLink CC13xx / CC26xx UART driver"
	default y
	depends on DT_HAS_TI_CC13XX_CC26XX_UART_ENABLED
	select SERIAL_HAS_DRIVER
	select SERIAL_SUPPORT_INTERRUPT
	select PINCTRL
	help
	  Enable the TI SimpleLink CC13xx / CC26xx UART driver.
```

## drivers/serial/Kconfig.cc23x0
```kconfig
# Copyright (c) 2024 Texas Instruments Incorporated
# Copyright (c) 2024 BayLibre, SAS
#
# SPDX-License-Identifier: Apache-2.0

config UART_CC23X0
	bool "TI SimpleLink CC23x0 UART driver"
	default y
	depends on DT_HAS_TI_CC23X0_UART_ENABLED
	select SERIAL_HAS_DRIVER
	select SERIAL_SUPPORT_INTERRUPT
	select SERIAL_SUPPORT_ASYNC
	select PINCTRL
	help
	  Enable the TI SimpleLink CC23x0 UART driver.

config UART_CC23X0_DMA_DRIVEN
	bool "DMA support for TI CC23X0 UART devices"
	depends on UART_CC23X0
	depends on UART_ASYNC_API
	select DMA
	help
	  DMA driven mode offloads data transfer tasks from the CPU.
```
