## drivers/sensor/adi/adt75/Kconfig
```kconfig
# ADT75 temperature sensor configuration options

# Copyright (c) 2024 Analog Devices Inc.
# SPDX-License-Identifier: Apache-2.0

config ADT75
	bool "ADT75 Temperature Sensor"
	default y
	depends on DT_HAS_ADI_ADT75_ENABLED
	select I2C
	help
	  Enable the driver for Analog Devices ADT75
	  12-bit Digital I2C Temperature Sensors.
```

## drivers/sensor/adi/adxl345/Kconfig
```kconfig
# ADXL345, 3-Axis, +/-16g Digital Accelerometer

# Copyright (c) 2020 Antmicro <www.antmicro.com>
# SPDX-License-Identifier: Apache-2.0

config ADXL345
	bool "ADXL345 Three Axis accelerometer"
	default y
	depends on DT_HAS_ADI_ADXL345_ENABLED
	select I2C if $(dt_compat_on_bus,$(DT_COMPAT_ADI_ADXL345),i2c)
	select SPI if $(dt_compat_on_bus,$(DT_COMPAT_ADI_ADXL345),spi)
	help
	  Enable driver for ADXL345 Three-Axis Digital Accelerometer.
```

## drivers/sensor/adi/adxl345/unit_test/adxl345_accel_convert/testcase.yaml
```yaml
tests:
  adxl345.adxl345_accel_convert:
    tags: adxl345
    type: unit
    extra_args:
      # add -g to allow debugging in vscode
      - EXTRA_CPPFLAGS="-g;-DZEPHYR_INCLUDE_DEVICE_H_;-DZEPHYR_INCLUDE_KERNEL_THREAD_STACK_H"
```

## drivers/sensor/adi/adxl34x/Kconfig
```kconfig
#
# Copyright (c) 2024 Chaim Zax
# SPDX-License-Identifier: Apache-2.0
#

menuconfig ADXL34X
	bool "ADXL343, ADXL344, ADXL345 and ADXL346 accelerometers"
	default y
	depends on DT_HAS_ADI_ADXL34X_ENABLED
	select I2C if $(dt_compat_on_bus,$(DT_COMPAT_ADI_ADXL34X),i2c)
	select SPI if $(dt_compat_on_bus,$(DT_COMPAT_ADI_ADXL34X),spi)
	help
	  Enable support for the ADXL343, ADXL344, ADXL345 and ADXL346 Three
	  Axis accelerometer

if ADXL34X

config ADXL34X_BUS_I2C
	bool
	default y
	depends on $(dt_compat_on_bus,$(DT_COMPAT_ADI_ADXL34X),i2c)

config ADXL34X_BUS_SPI
	bool
	default y
	depends on $(dt_compat_on_bus,$(DT_COMPAT_ADI_ADXL34X),spi)

config ADXL34X_DECODER
	bool "Decoder logic"
	default y
	select ADXL34X_ASYNC_API
	depends on SENSOR_ASYNC_API
	help
	  Compile the ADXL34X decoder API which allows decoding raw data
	  returned from the sensor.

if ADXL34X_DECODER

choice
	prompt "Decoder data type"
	default ADXL34X_DATA_TYPE_Q31
	help
	  Data type returned by the decoder.

config ADXL34X_DATA_TYPE_Q31
	bool "q31"
	help
	  Return q31 sensor type values from the decoder

config ADXL34X_DATA_TYPE_SENSOR_VALUE
	bool "sensor_value"
	help
	  Return sensor_value sensor type values from the decoder

config ADXL34X_DATA_TYPE_DOUBLE
	bool "double"
	help
	  Return double sensor type values from the decoder

endchoice

endif # ADXL34X_DECODER

choice ADXL34X_FIFO_MODE
	prompt "FIFO mode"
	default ADXL34X_FIFO_MODE_BYPASS
	help
	  Specify the FIFO mode to be used by the driver

config ADXL34X_FIFO_MODE_BYPASS
	bool "Bypass"
	help
	  No FIFO, the FIFO of the adxl34x is bypassed. The sensor can only be
	  used in polling mode, no triggers are available. Use this mode when
	  the interrupt line of the adxl34x is not connected.

config ADXL34X_FIFO_MODE_FIFO
	bool "FIFO"
	select ADXL34X_TRIGGER
	select ADXL34X_ASYNC_API
	depends on SENSOR_ASYNC_API
	help
	  FIFO collects up to 32 values and then stops collecting data,
	  collecting new data only when FIFO is not full. Use this config option
	  to enable streaming sensor data via RTIO subsystem. This mode requires
	  the interrupt line of the adxl34x to be connected.

config ADXL34X_FIFO_MODE_STREAM
	bool "Stream"
	select ADXL34X_TRIGGER
	select ADXL34X_ASYNC_API
	depends on SENSOR_ASYNC_API
	help
	  FIFO holds the last 32 data values. When FIFO is full, the oldest data
	  is overwritten with newer data. This mode requires the interrupt line
	  of the adxl34x to be connected.

config ADXL34X_FIFO_MODE_TRIGGER
	bool "Trigger"
	select ADXL34X_TRIGGER
	select ADXL34X_ASYNC_API
	depends on SENSOR_ASYNC_API
	help
	  When triggered by the trigger bit, FIFO holds the last data samples
	  before the trigger event and then continues to collect data until
	  full. New data is collected only when FIFO is not full. This mode
	  requires the interrupt line of the adxl34x to be connected.

endchoice

config EMUL_ADXL34X
	bool "Emulator for the ADXL34X"
	default y
	depends on EMUL
	help
	  Enable the hardware emulator for the ADXL34X. Doing so allows
	  exercising sensor APIs for this driver in native_sim and qemu.

config ADXL34X_EXTENDED_API
	bool "Extended API"
	default y
	help
	  Enable the extended API for the ADXL34X. This option gives access to
	  all registers of the adxl34x when not using user space.

config ADXL34X_ADXL345_COMPATIBLE
	bool "ADXL345 compatible"
	default n
	help
	  Enable compatibility with the (old) ADXL345 driver. Enable this
	  feature when the (existing) application was written for the ADXL345
	  driver. The ADXL345 driver uses the FIFO when calling
	  sensor_sample_fetch, and will return the number of samples collected
	  (which is not the official API). This allows sensor_sample_get to be
	  called multiple times to read all FIFO data.

config ADXL34X_TRIGGER
	bool

config ADXL34X_ASYNC_API
	bool

endif # ADXL34X
```

## drivers/sensor/adi/adxl355/Kconfig
```kconfig
#ADXL355 Three-Axis Digital Accelerometer

# Copyright (c) 2026 Analog Devices, Inc.
# SPDX-License-Identifier: Apache-2.0

config ADXL355
	bool "ADXL355 Three-Axis Digital Accelerometer"
	default y
	depends on DT_HAS_ADI_ADXL355_ENABLED
	select I2C if $(dt_compat_on_bus,$(DT_COMPAT_ADI_ADXL355),i2c)
	select SPI if $(dt_compat_on_bus,$(DT_COMPAT_ADI_ADXL355),spi)
	select RTIO_WORKQ if SENSOR_ASYNC_API
	help
	  Enable driver for ADXL355 Three-Axis Digital Accelerometers.

if ADXL355

choice ADXL355_OP_MODE
	prompt "Operating mode"
	default ADXL355_MEASUREMENT_MODE

config ADXL355_MEASUREMENT_MODE
	bool "Measurement Mode"
	help
	  In this mode, acceleration data is provided continuously at the
	  output data rate (ODR).

endchoice

choice ADXL355_TRIGGER_MODE
	prompt "Trigger mode"
	default ADXL355_TRIGGER_NONE
	help
	  Specify the type of triggering used by the driver.

config ADXL355_TRIGGER_NONE
	bool "No trigger"

config ADXL355_TRIGGER_GLOBAL_THREAD
	bool "Use global thread"
	depends on GPIO
	select ADXL355_TRIGGER

config ADXL355_TRIGGER_OWN_THREAD
	bool "Use own thread"
	depends on GPIO
	select ADXL355_TRIGGER

endchoice

config ADXL355_TRIGGER
	bool

config ADXL355_THREAD_PRIORITY
	int "Thread priority"
	depends on ADXL355_TRIGGER_OWN_THREAD && ADXL355_TRIGGER
	default 10
	help
	  Priority of thread used by the driver to handle interrupts.
config ADXL355_THREAD_STACK_SIZE
	int "Thread stack size"
	depends on ADXL355_TRIGGER_OWN_THREAD && ADXL355_TRIGGER
	default 1024
	help
	  Stack size of thread used by the driver to handle interrupts.

config ADXL355_INIT_PRIORITY
	int "Init priority"
	default SENSOR_INIT_PRIORITY
	help
	  Device initialization priority for ADXL355.

	  Lower values initialize earlier during boot. Higher values defer
	  initialization until later in the boot sequence.

	  Defaults to CONFIG_SENSOR_INIT_PRIORITY. Increase this value
	  (e.g., to 90) to defer initialization when self-test is enabled,
	  avoiding delays to critical boot tasks.

config ADXL355_STREAM
	bool "Use FIFO to stream data"
	select ADXL355_TRIGGER
	depends on (SPI_RTIO || I2C_RTIO)
	depends on SENSOR_ASYNC_API
	help
	  Use this configuration option to enable streaming sensor data via RTIO.

endif # ADXL355
```

## drivers/sensor/adi/adxl362/Kconfig
```kconfig
# ADXL362 Three-Axis Digital Accelerometers

# Copyright (c) 2017 IpTronix S.r.l.
# SPDX-License-Identifier: Apache-2.0

menuconfig ADXL362
	bool "ADXL362 sensor"
	default y
	depends on DT_HAS_ADI_ADXL362_ENABLED
	select SPI
	select RTIO_WORKQ if SENSOR_ASYNC_API
	help
	  Enable driver for ADXL362 Three-Axis Digital Accelerometers.

if ADXL362

choice
	prompt "Accelerometer range setting"
	default ADXL362_ACCEL_RANGE_RUNTIME

config ADXL362_ACCEL_RANGE_RUNTIME
	bool "Set at runtime."

config ADXL362_ACCEL_RANGE_2G
	bool "2G"

config ADXL362_ACCEL_RANGE_4G
	bool "4G"

config ADXL362_ACCEL_RANGE_8G
	bool "8G"

endchoice

choice
	prompt "Accelerometer sampling frequency."
	default ADXL362_ACCEL_ODR_RUNTIME

config ADXL362_ACCEL_ODR_RUNTIME
	bool "Set at runtime."

config ADXL362_ACCEL_ODR_12_5
	bool "12.5 Hz"

config ADXL362_ACCEL_ODR_25
	bool "25 Hz"

config ADXL362_ACCEL_ODR_50
	bool "50 Hz"

config ADXL362_ACCEL_ODR_100
	bool "100 Hz"

config ADXL362_ACCEL_ODR_200
	bool "200 Hz"

config ADXL362_ACCEL_ODR_400
	bool "400 Hz"

endchoice

choice
	prompt "Trigger mode"
	default ADXL362_TRIGGER_NONE
	help
	  Specify the type of triggering used by the driver.

config ADXL362_TRIGGER_NONE
	bool "No trigger"

config ADXL362_TRIGGER_GLOBAL_THREAD
	bool "Use global thread"
	depends on GPIO
	depends on $(dt_compat_any_has_prop,$(DT_COMPAT_ADI_ADXL362),int1-gpios)
	select ADXL362_TRIGGER

config ADXL362_TRIGGER_OWN_THREAD
	bool "Use own thread"
	depends on GPIO
	depends on $(dt_compat_any_has_prop,$(DT_COMPAT_ADI_ADXL362),int1-gpios)
	select ADXL362_TRIGGER

endchoice

config ADXL362_STREAM
	bool "Use FIFO to stream data"
	select ADXL362_TRIGGER
	default y
	depends on SPI_RTIO
	depends on SENSOR_ASYNC_API
	help
	  Use this configuration option to enable streaming sensor data via RTIO.

config ADXL362_TRIGGER
	bool

config ADXL362_THREAD_PRIORITY
	int "Thread priority"
	depends on ADXL362_TRIGGER_OWN_THREAD && ADXL362_TRIGGER
	default 10
	help
	  Priority of thread used by the driver to handle interrupts.

config ADXL362_THREAD_STACK_SIZE
	int "Thread stack size"
	depends on ADXL362_TRIGGER_OWN_THREAD && ADXL362_TRIGGER
	default 1024
	help
	  Stack size of thread used by the driver to handle interrupts.

config ADXL362_ACTIVITY_THRESHOLD
	int "Upper threshold value"
	default 1000
	help
	  Unsigned value that the adxl362 samples are
	  compared to in activity trigger mode.

config ADXL362_ACTIVITY_TIME
       int "Upper threshold time"
       default 1
       help
         8 bit value written to the activity timer register
         0 to 254, seconds is this value div by ODR

config ADXL362_INACTIVITY_THRESHOLD
	int "Lower threshold value"
	default 100
	help
	  Unsigned value that the adxl362 samples are
	  compared to in inactivity trigger mode.

config ADXL362_INACTIVITY_TIME
  int "Lower threshold time"
  default 1
  help
    16 bit value written to the activity timer register
    0 to 65535, seconds is this value div by ODR

config ADXL362_INTERRUPT_MODE
	int "Activity and inactivity interrupt mode"
	default 0
	help
	  Unsigned value that sets the ADXL362 in different
	  interrupt modes.
	  0 - Default mode
	  1 - Linked mode
	  3 - Loop mode

config ADXL362_ABS_REF_MODE
	int "Absolute or referenced interrupt"
	default 0
	help
	  Unsigned value that sets the ADXL362 interrupt
	  mode in either absolute or referenced mode.
	  0 - Absolute mode
	  1 - Referenced mode

endif # ADXL362
```

## drivers/sensor/adi/adxl367/Kconfig
```kconfig
# Micropower, 3-Axis, +/-200g Digital Accelerometer

# Copyright (c) 2023 Analog Devices Inc.
# SPDX-License-Identifier: Apache-2.0

menuconfig ADXL367
	bool "ADXL367 Three Axis High-g I2C/SPI accelerometer"
	default y
	depends on DT_HAS_ADI_ADXL367_ENABLED
	select I2C if $(dt_compat_on_bus,$(DT_COMPAT_ADI_ADXL367),i2c)
	select SPI if $(dt_compat_on_bus,$(DT_COMPAT_ADI_ADXL367),spi)
	help
	  Enable driver for ADXL367 Three-Axis Digital Accelerometers.

if ADXL367

choice ADXL367_OP_MODE
	prompt "Operating mode"
	default ADXL367_MEASUREMENT_MODE

config ADXL367_MEASUREMENT_MODE
	bool "Measurement Mode"
	help
	  In this mode, acceleration data is provided continuously at the
	  output data rate (ODR).

endchoice

config ADXL367_ACTIVITY_THRESHOLD
	int "Activity threshold in raw value"
	range 0 8191
	default 100
	help
	  Threshold for activity detection.

config ADXL367_INACTIVITY_THRESHOLD
	int "In-activity threshold in raw value"
	range 0 8191
	default 100
	help
	  Threshold for in-activity detection.

config ADXL367_ACTIVITY_TIME
	int "Activity time"
	range 0 $(UINT8_MAX)
	default 100
	help
	  The activity timer implements a robust activity detection that
	  minimizes false positive motion triggers. When the timer is used,
	  only sustained motion can trigger activity detection. Value is the
	  number of samples. For example, at 100Hz ODR, 100 value translates
	  to 1 second.

config ADXL367_INACTIVITY_TIME
	int "In-activity time"
	range 0 $(UINT16_MAX)
	default 100
	help
	  The time that all enabled axes must be lower than the inactivity
	  threshold for an inactivity event to be detected. Value is the
	  number of samples. For example, at 100Hz ODR, 100 value translates
	  to 1 second.

config ADXL367_ACTIVITY_DETECTION_MODE
	bool "Use activity detection"
	default y
	help
	  Enable Activity detection.

config ADXL367_INACTIVITY_DETECTION_MODE
	bool "Use inactivity detection"
	default y
	help
	  Enable Inactivity detection.


config ADXL367_REFERENCED_ACTIVITY_DETECTION_MODE
	bool "Use referenced activity detection"
	default y
	help
	  Activity detection can be configured as referenced or absolute.
	  When using absolute activity detection, acceleration samples are
	  compared directly to a user set threshold to determine whether
	  motion is present.

config ADXL367_REFERENCED_INACTIVITY_DETECTION_MODE
	bool "Use referenced inactivity detection"
	default y
	help
	  Inactivity detection can be configured as referenced or absolute.
	  When using absolute inactivity detection, acceleration samples are
	  compared directly to a user set threshold to determine whether
	  motion is present.

choice ADXL367_TRIGGER_MODE
	prompt "Trigger mode"
	default ADXL367_TRIGGER_NONE
	help
	  Specify the type of triggering used by the driver.

config ADXL367_TRIGGER_NONE
	bool "No trigger"

config ADXL367_TRIGGER_GLOBAL_THREAD
	bool "Use global thread"
	depends on GPIO
	depends on $(dt_compat_any_has_prop,$(DT_COMPAT_ADI_ADXL367),int1-gpios)
	select ADXL367_TRIGGER

config ADXL367_TRIGGER_OWN_THREAD
	bool "Use own thread"
	depends on GPIO
	depends on $(dt_compat_any_has_prop,$(DT_COMPAT_ADI_ADXL367),int1-gpios)
	select ADXL367_TRIGGER

endchoice

config ADXL367_STREAM
	bool "Use FIFO to stream data"
	select ADXL367_TRIGGER
	default y
	depends on SPI_RTIO
	depends on SENSOR_ASYNC_API
	help
	  Use this configuration option to enable streaming sensor data via RTIO.

config ADXL367_TRIGGER
	bool

config ADXL367_THREAD_PRIORITY
	int "Thread priority"
	depends on ADXL367_TRIGGER_OWN_THREAD && ADXL367_TRIGGER
	default 10
	help
	  Priority of thread used by the driver to handle interrupts.

config ADXL367_THREAD_STACK_SIZE
	int "Thread stack size"
	depends on ADXL367_TRIGGER_OWN_THREAD && ADXL367_TRIGGER
	default 1024
	help
	  Stack size of thread used by the driver to handle interrupts.

endif # ADXL367
```
