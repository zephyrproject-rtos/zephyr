## drivers/sensor/adi/adxl372/Kconfig
```kconfig
# Micropower, 3-Axis, +/-200g Digital Accelerometer

# Copyright (c) 2018 Analog Devices Inc.
# SPDX-License-Identifier: Apache-2.0

menuconfig ADXL372
	bool "ADXL372 Three Axis High-g I2C/SPI accelerometer"
	default y
	depends on DT_HAS_ADI_ADXL372_ENABLED
	select I2C if $(dt_compat_on_bus,$(DT_COMPAT_ADI_ADXL372),i2c)
	select SPI if $(dt_compat_on_bus,$(DT_COMPAT_ADI_ADXL372),spi)
	select RTIO_WORKQ if SENSOR_ASYNC_API
	help
	  Enable driver for ADXL372 Three-Axis Digital Accelerometers.

if ADXL372

choice ADXL372_OP_MODE
	prompt "Operating mode"
	default ADXL372_PEAK_DETECT_MODE

config ADXL372_PEAK_DETECT_MODE
	bool "Max Peak detect mode"
	help
	  In most high-g applications, a single (3-axis) acceleration sample at
	  the peak of an impact event contains sufficient information
	  about the event, and the full acceleration history is not required.
	  In this mode the device returns only the over threshold
	  Peak Acceleration between two consecutive sample fetches.

config ADXL372_MEASUREMENT_MODE
	bool "Measurement Mode"
	help
	  In this mode, acceleration data is provided continuously at the
	  output data rate (ODR).

endchoice

config ADXL372_ACTIVITY_THRESHOLD
	int "Activity threshold in mg"
	range 0 200000
	default 500
	help
	  Threshold for activity detection.

config ADXL372_INACTIVITY_THRESHOLD
	int "In-activity threshold in mg"
	range 0 200000
	default 400
	help
	  Threshold for in-activity detection.

config ADXL372_ACTIVITY_TIME
	int "Activity time"
	range 0 $(UINT8_MAX)
	default 1
	help
	  The activity timer implements a robust activity detection that
	  minimizes false positive motion triggers. When the timer is used,
	  only sustained motion can trigger activity detection.
	  Number of multiples of 3.3 ms activity timer for which above threshold
	  acceleration is required to detect activity. It is 3.3 ms per code
	  for 6400 Hz ODR, and it is 6.6 ms per code for 3200 Hz ODR and below.

config ADXL372_INACTIVITY_TIME
	int "In-activity time"
	range 0 $(UINT8_MAX)
	default 2
	help
	  The time that all enabled axes must be lower than the inactivity
	  threshold for an inactivity event to be detected. Number of multiples
	  of 26 ms inactivity timer for which below threshold acceleration is
	  required to detect inactivity. It is 26 ms per code for 3200 Hz ODR
	  and below, and it is 13 ms per code for 6400 Hz ODR.

config ADXL372_REFERENCED_ACTIVITY_DETECTION_MODE
	bool "Use referenced activity/in-activity detection"
	default y
	help
	  Activity detection can be configured as referenced or absolute.
	  When using absolute activity detection, acceleration samples are
	  compared directly to a user set threshold to determine whether
	  motion is present. In many applications, it is advantageous for
	  activity detection to be based not on an absolute threshold,
	  but on a deviation from a reference point or orientation.

choice ADXL372_TRIGGER_MODE
	prompt "Trigger mode"
	default ADXL372_TRIGGER_NONE
	help
	  Specify the type of triggering used by the driver.

config ADXL372_TRIGGER_NONE
	bool "No trigger"

config ADXL372_TRIGGER_GLOBAL_THREAD
	bool "Use global thread"
	depends on GPIO
	depends on $(dt_compat_any_has_prop,$(DT_COMPAT_ADI_ADXL372),int1-gpios)
	select ADXL372_TRIGGER

config ADXL372_TRIGGER_OWN_THREAD
	bool "Use own thread"
	depends on GPIO
	depends on $(dt_compat_any_has_prop,$(DT_COMPAT_ADI_ADXL372),int1-gpios)
	select ADXL372_TRIGGER

endchoice

config ADXL372_STREAM
	bool "Use FIFO to stream data"
	select ADXL372_TRIGGER
	default y
	depends on SPI_RTIO
	depends on SENSOR_ASYNC_API
	help
	  Use this configuration option to enable streaming sensor data via RTIO.

config ADXL372_TRIGGER
	bool

config ADXL372_THREAD_PRIORITY
	int "Thread priority"
	depends on ADXL372_TRIGGER_OWN_THREAD && ADXL372_TRIGGER
	default 10
	help
	  Priority of thread used by the driver to handle interrupts.

config ADXL372_THREAD_STACK_SIZE
	int "Thread stack size"
	depends on ADXL372_TRIGGER_OWN_THREAD && ADXL372_TRIGGER
	default 1024
	help
	  Stack size of thread used by the driver to handle interrupts.

endif # ADXL372
```

## drivers/sensor/adi/adxl375/Kconfig
```kconfig
# Low power, 3-Axis, +/-200g Digital Accelerometer

# Copyright (c) 2023 Aaron Chan
# SPDX-License-Identifier: Apache-2.0

config ADXL375
	bool "ADXL375 Three Axis High-g I2C/SPI accelerometer"
	default y
	depends on DT_HAS_ADI_ADXL375_ENABLED
	select I2C if $(dt_compat_on_bus,$(DT_COMPAT_ADI_ADXL375),i2c)
	select SPI if $(dt_compat_on_bus,$(DT_COMPAT_ADI_ADXL375),spi)
	help
	  Enable driver for ADXL375 Three-Axis Digital Accelerometers.
```

## drivers/sensor/adi/ltc4286/Kconfig
```kconfig
# LTC4286 power monitor configuration options

# Copyright (c) 2026 Analog Devices Inc.
# SPDX-License-Identifier: Apache-2.0

menuconfig LTC4286
	bool "LTC4286 Power Monitor"
	default y
	depends on DT_HAS_ADI_LTC4286_ENABLED
	select I2C
	help
	  Enable the driver for Analog Devices LTC4286 High Power Positive
	  Hot-Swap Controller with Power Monitor.

if LTC4286

choice
	prompt "Trigger mode"
	default LTC4286_TRIGGER_NONE
	help
	  Specify the type of triggers used by the driver.

config LTC4286_TRIGGER_NONE
	bool "No trigger"

config LTC4286_TRIGGER_GLOBAL_THREAD
	bool "Use global thread"
	depends on GPIO
	depends on LTC4286_HAS_TRIGGER_GPIO
	select LTC4286_TRIGGER

config LTC4286_TRIGGER_OWN_THREAD
	bool "Use thread allocated to self"
	depends on GPIO
	depends on LTC4286_HAS_TRIGGER_GPIO
	select LTC4286_TRIGGER

endchoice

config LTC4286_TRIGGER
	bool

config LTC4286_HAS_TRIGGER_GPIO
	bool
	default y
	depends on $(dt_compat_any_has_prop,$(DT_COMPAT_ADI_LTC4286),op-status-gpios) || \
		$(dt_compat_any_has_prop,$(DT_COMPAT_ADI_LTC4286),oc-status-gpios) || \
		$(dt_compat_any_has_prop,$(DT_COMPAT_ADI_LTC4286),comp-out-gpios) || \
		$(dt_compat_any_has_prop,$(DT_COMPAT_ADI_LTC4286),fault-out-gpios)|| \
		$(dt_compat_any_has_prop,$(DT_COMPAT_ADI_LTC4286),power-good-gpios) || \
		$(dt_compat_any_has_prop,$(DT_COMPAT_ADI_LTC4286),alert-gpios)

config LTC4286_THREAD_PRIORITY
	int "Thread priority"
	depends on LTC4286_TRIGGER_OWN_THREAD && LTC4286_TRIGGER
	default 10
	help
	  Priority of thread used by driver to handle interrupts.

config LTC4286_THREAD_STACK_SIZE
	int "Thread stack size"
	depends on LTC4286_TRIGGER_OWN_THREAD && LTC4286_TRIGGER
	default 1024
	help
	  Stack size allocated to the thread used by the driver to handle interrupts.

endif #LTC4286
```

## drivers/sensor/adi/max30009/Kconfig
```kconfig
# MAX30009 Bio-Impedance AFE

# Copyright (c) 2026 Analog Devices, Inc.
# SPDX-License-Identifier: Apache-2.0

config MAX30009
	bool "MAX30009 Bio-Impedance AFE"
	default y
	depends on DT_HAS_ADI_MAX30009_ENABLED
	select I2C if $(dt_compat_on_bus,$(DT_COMPAT_ADI_MAX30009),i2c)
	select SPI if $(dt_compat_on_bus,$(DT_COMPAT_ADI_MAX30009),spi)
	select RTIO_WORKQ if SENSOR_ASYNC_API
	help
	  Enable driver for MAX30009 Bio-Impedance AFE.

if MAX30009

choice MAX30009_TRIGGER_MODE
	prompt "Trigger mode"
	default MAX30009_TRIGGER_NONE
	help
	  Specify the type of triggering used by the driver.

config MAX30009_TRIGGER_NONE
	bool "No trigger"

config MAX30009_TRIGGER_GLOBAL_THREAD
	bool "Use global thread"
	select GPIO
	select MAX30009_TRIGGER

config MAX30009_TRIGGER_OWN_THREAD
	bool "Use own thread"
	select GPIO
	select MAX30009_TRIGGER
endchoice

config MAX30009_TRIGGER
	bool

config MAX30009_THREAD_PRIORITY
	int "Thread priority"
	depends on MAX30009_TRIGGER_OWN_THREAD && MAX30009_TRIGGER
	default 10
	help
	  Priority of thread used by the driver to handle interrupts.

config MAX30009_THREAD_STACK_SIZE
	int "Thread stack size"
	depends on MAX30009_TRIGGER_OWN_THREAD && MAX30009_TRIGGER
	default 4096
	help
	  Stack size of thread used by the driver to handle interrupts.

config MAX30009_INIT_PRIORITY
	int "Initialization priority"
	default SENSOR_INIT_PRIORITY
	help
	  Initialization priority of the MAX30009 driver. Should be lower than the priority of any
	  thread that needs to use the driver.

config MAX30009_STREAM
	bool "Use streaming mode"
	select MAX30009_TRIGGER
	select SPI_RTIO if $(dt_compat_on_bus,$(DT_COMPAT_ADI_MAX30009),spi)
	select I2C_RTIO if $(dt_compat_on_bus,$(DT_COMPAT_ADI_MAX30009),i2c)
	select SENSOR_ASYNC_API
	help
	  Use this configuration option to enable streaming sensor data via RTIO.

endif # MAX30009
```

## drivers/sensor/adi/max30210/Kconfig
```kconfig
# Copyright (c) 2025 Analog Devices Inc.
# SPDX-License-Identifier: Apache-2.0
#
# This file contains the binding for MAX30210 sensor

menuconfig MAX30210
	bool "MAX30210 Temperature Sensor"
	default y
	depends on DT_HAS_ADI_MAX30210_ENABLED
	select I2C
	help
	  Enable driver for the MAX30210 temperature sensor.

if MAX30210

config MAX30210_TRIGGER
	bool

choice MAX30210_TRIGGER_MODE
	prompt "Sets trigger mode"
	default MAX30210_TRIGGER_NONE
	help
	  Sets thread type for the interrupt handler.

config MAX30210_TRIGGER_NONE
	bool "No trigger"

config MAX30210_TRIGGER_GLOBAL_THREAD
	bool "Use global thread"
	depends on $(dt_compat_any_has_prop,$(DT_COMPAT_ADI_MAX30210),interrupt-gpios)
	select GPIO
	select MAX30210_TRIGGER
	help
	  Use a global thread for the interrupt handler.

config MAX30210_TRIGGER_OWN_THREAD
	bool "Use own thread"
	depends on $(dt_compat_any_has_prop,$(DT_COMPAT_ADI_MAX30210),interrupt-gpios)
	select GPIO
	select MAX30210_TRIGGER
	help
	  Use a separate thread for the interrupt handler.

endchoice # MAX30210_TRIGGER_MODE

if MAX30210_TRIGGER_OWN_THREAD

config MAX30210_THREAD_PRIORITY
	int "Thread priority of the interrupt handler"
	default 10
	help
	  Thread priority of the interrupt handler. A higher number implies a
	  higher priority. The thread is cooperative and will not be interrupted by
	  another thread until execution is released.

config MAX30210_THREAD_STACK_SIZE
	int "Stack size of the interrupt handler thread"
	default 1024
	help
	  Stack size of the interrupt handler thread.

endif # MAX30210_TRIGGER_OWN_THREAD

endif # MAX30210
```

## drivers/sensor/adi/max31825/Kconfig
```kconfig
# MAX31825 temperature sensor configuration options

# Copyright (C) 2024 Analog Devices, Inc.
# SPDX-License-Identifier: Apache-2.0

config MAX31825
	bool "MAX31825 Temperature Sensor"
	default y
	depends on DT_HAS_ADI_MAX31825_ENABLED
	select W1
	help
	  Enable driver for MAX31825 1-Wire temperature sensors.
```

## drivers/sensor/adi/max32664c/Kconfig
```kconfig
# Copyright(c) 2025, Daniel Kampert
# SPDX-License-Identifier: Apache-2.0

config SENSOR_MAX32664C
	bool "MAX32664C Driver"
	default y
	depends on DT_HAS_MAXIM_MAX32664C_ENABLED
	select I2C
	help
	  Enable the driver for the MAX32664C biometric sensor hub.

if SENSOR_MAX32664C
config MAX32664C_USE_FIRMWARE_LOADER
	bool "Use this option if you want to flash the sensor hub over the I2C firmware loader"

config MAX32664C_USE_EXTERNAL_ACC
	bool "Use this option if you want to use an external accelerometer"

config MAX32664C_USE_EXTENDED_REPORTS
	bool "Use this option if you want to use extended reports instead of the default reports"

config MAX32664C_USE_STATIC_MEMORY
	bool "Disable this option if the driver should use dynamic memory"
	default y

config MAX32664C_QUEUE_SIZE
	int "Length of the message queue"
	default 32

config MAX32664C_SAMPLE_BUFFER_SIZE
	depends on MAX32664C_USE_STATIC_MEMORY
	int "Length of the sample buffer for the I2C reading thread"
	default 64
	help
	  This is the number of samples that will be read from the sensor hub in one go.
	  The maximum value is 64, but you can set it lower if you want to reduce memory usage.

config MAX32664C_THREAD_STACK_SIZE
	int "MAX32664C sample thread stack size"
	default 4096

config MAX32664C_USE_INTERRUPT
	bool "Use this option if you want to use the MFIO interrupt support"
	depends on GPIO
endif
```

## drivers/sensor/adt7420/Kconfig
```kconfig
# ADT7420 temperature sensor configuration options

# Copyright (c) 2018 Analog Devices Inc.
# SPDX-License-Identifier: Apache-2.0

menuconfig ADT7420
	bool "ADT7420 Temperature Sensor"
	depends on I2C
	help
	  Enable the driver for Analog Devices ADT7420 High-Accuracy
	  16-bit Digital I2C Temperature Sensors.

if ADT7420

config ADT7420_TEMP_HYST
	int "Temperature hysteresis in °C"
	range 0 15
	default 5
	help
	  Specify the temperature hysteresis in °C for the THIGH, TLOW,
	  and TCRIT temperature limits.

config ADT7420_TEMP_CRIT
	int "Critical overtemperature in °C"
	range -40 150
	default 147
	help
	  The critical overtemperature pin asserts when the temperature
	  exceeds this value. The default value of 147 is the reset default
	  of the ADT7420.

choice
	prompt "Trigger mode"
	default ADT7420_TRIGGER_NONE
	help
	  Specify the type of triggering used by the driver.

config ADT7420_TRIGGER_NONE
	bool "No trigger"

config ADT7420_TRIGGER_GLOBAL_THREAD
	bool "Use global thread"
	depends on GPIO
	select ADT7420_TRIGGER

config ADT7420_TRIGGER_OWN_THREAD
	bool "Use own thread"
	depends on GPIO
	select ADT7420_TRIGGER

endchoice

config ADT7420_TRIGGER
	bool

config ADT7420_THREAD_PRIORITY
	int "Thread priority"
	depends on ADT7420_TRIGGER_OWN_THREAD && ADT7420_TRIGGER
	default 10
	help
	  Priority of thread used by the driver to handle interrupts.

config ADT7420_THREAD_STACK_SIZE
	int "Thread stack size"
	depends on ADT7420_TRIGGER_OWN_THREAD && ADT7420_TRIGGER
	default 1024
	help
	  Stack size of thread used by the driver to handle interrupts.

endif # ADT7420
```
