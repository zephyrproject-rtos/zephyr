## drivers/sensor/adxl345/Kconfig
```kconfig
# ADXL345, 3-Axis, +/-16g Digital Accelerometer

# Copyright (c) 2020 Antmicro <www.antmicro.com>
# SPDX-License-Identifier: Apache-2.0

config ADXL345
	bool "ADXL345 Three Axis accelerometer"
	default y
	depends on DT_HAS_ADI_ADXL345_ENABLED
	select I2C if $(dt_compat_on_bus,$(DT_COMPAT_ADI_ADXL345),i2c)
	select SPI if $(dt_compat_on_bus,$(DT_COMPAT_ADI_ADXL345),spi)
	help
	  Enable driver for ADXL345 Three-Axis Digital Accelerometer.

if ADXL345

choice
	prompt "Trigger mode"
	default ADXL345_TRIGGER_NONE
	help
	  Specify the type of triggering used by the driver.

config ADXL345_TRIGGER_NONE
	bool "No trigger"

config ADXL345_TRIGGER_GLOBAL_THREAD
	bool "Use global thread"
	depends on GPIO
	select ADXL345_TRIGGER

config ADXL345_TRIGGER_OWN_THREAD
	bool "Use own thread"
	depends on GPIO
	select ADXL345_TRIGGER

endchoice

config ADXL345_TRIGGER
	bool

config ADXL345_THREAD_PRIORITY
	int "Thread priority"
	depends on ADXL345_TRIGGER_OWN_THREAD && ADXL345_TRIGGER
	default 10
	help
	  Priority of thread used by the driver to handle interrupts.

config ADXL345_THREAD_STACK_SIZE
	int "Thread stack size"
	depends on ADXL345_TRIGGER_OWN_THREAD && ADXL345_TRIGGER
	default 1024
	help
	  Stack size of thread used by the driver to handle interrupts.

config ADXL345_ACTIVITY_THRESHOLD
	int "Upper threshold value"
	default 2000
	help
	  Unsigned value that the adxl345 samples are
	  compared to in activity trigger mode in mg.

config ADXL345_INACTIVITY_THRESHOLD
	int "Lower threshold value"
	default 1000
	help
	  Unsigned value that the adxl345 samples are
	  compared to in inactivity trigger mode in mg.

config ADXL345_INACTIVITY_TIME
	int "Lower threshold time"
	default 1
	help
	  8 bit value written to the activity timer register
	  0 to 255 in seconds.

config ADXL345_AUTO_SLEEP
	int "Put device into sleep mode when inactivity is detected."
	default 0

config ADXL345_LINK_MODE
	int "Link activity and inactivity functions."
	default 1

config ADXL345_SLEEP
	int "Put device into sleep mode."
	default 0

config ADXL345_WAKEUP_POLL_FREQ
	int "Control how often activity is being polled in sleep mode."
	default 0
	help
		0 - 8 Hz
		1 - 4 Hz
		2 - 2 Hz
		3 - 1 Hz

config ADXL345_ODR
	int "Output data rate of the device."
	default 8
	help
	  0 - 0.1 Hz
	  1 - 0.2 Hz
	  2 - 0.39 Hz
	  3 - 0.78 Hz
	  4 - 1.56 Hz
	  5 - 3.13 Hz
	  6 - 6.25 Hz
	  7 - 12.5 Hz
	  8 - 25 Hz
	  9 - 50 Hz
	  10 - 100 Hz
	  11 - 200 Hz
	  12 - 400 Hz
	  13 - 800 Hz
	  14 - 1600 Hz
	  15 - 3200 Hz

config ADXL345_ABS_REF_ACTIVITY
	int "Absolute or referenced activity detection"
	default 0
	help
	  Unsigned value that sets the ADXL345 activity
	  detection in either absolute or referenced mode.
	  0 - Absolute mode
	  1 - Referenced mode

config ADXL345_ABS_REF_INACTIVITY
	int "Absolute or referenced inactivity detection"
	default 0
	help
	  Unsigned value that sets the ADXL345 inactivity
	  detection in either absolute or referenced mode.
	  0 - Absolute mode
	  1 - Referenced mode

config ADXL345_INACTIVITY_AXES
	string "Axes included in inactivity detection"
	default ""
	help
	  "" - No axis is selected
	  "z" - Z axis
	  "y" - Y axis
	  "x" - X axis
	  To choose multiple axes concatenate desired axes.

config ADXL345_ACTIVITY_AXES
	string "Axes included in activity detection"
	default ""
	help
	  "" - No axis is selected
	  "z" - Z axis
	  "y" - Y axis
	  "x" - X axis
	  To choose multiple axes concatenate desired axes.

endif # ADXL345
```

## drivers/sensor/adxl362/Kconfig
```kconfig
# Kconfig.adxl362 - ADXL362 Three-Axis Digital Accelerometers

#
# Copyright (c) 2017 IpTronix S.r.l.
#
# SPDX-License-Identifier: Apache-2.0
#
menuconfig ADXL362
	bool "ADXL362 sensor"
	depends on SPI && HAS_DTS_SPI
	help
	  Enable driver for ADXL362 Three-Axis Digital Accelerometers.

if ADXL362

choice
	prompt "Accelerometer range setting"
	default ADXL362_ACCEL_RANGE_RUNTIME

config ADXL362_ACCEL_RANGE_RUNTIME
	bool "Set at runtime."

config ADXL362_ACCEL_RANGE_2G
	bool "2G"

config ADXL362_ACCEL_RANGE_4G
	bool "4G"

config ADXL362_ACCEL_RANGE_8G
	bool "8G"

endchoice

choice
	prompt "Accelerometer sampling frequency."
	default ADXL362_ACCEL_ODR_RUNTIME

config ADXL362_ACCEL_ODR_RUNTIME
	bool "Set at runtime."

config ADXL362_ACCEL_ODR_12_5
	bool "12.5 Hz"

config ADXL362_ACCEL_ODR_25
	bool "25 Hz"

config ADXL362_ACCEL_ODR_50
	bool "50 Hz"

config ADXL362_ACCEL_ODR_100
	bool "100 Hz"

config ADXL362_ACCEL_ODR_200
	bool "200 Hz"

config ADXL362_ACCEL_ODR_400
	bool "400 Hz"

endchoice

endif # ADXL362
```

## drivers/sensor/adxl372/Kconfig
```kconfig
# Kconfig - Micropower, 3-Axis, +/-200g Digital Accelerometer
#
# Copyright (c) 2018 Analog Devices Inc.
#
# SPDX-License-Identifier: Apache-2.0
#

menuconfig ADXL372
	bool "ADXL372 Three Axis High-g I2C/SPI accelerometer"
	depends on (I2C && HAS_DTS_I2C) || SPI
	help
	  Enable driver for ADXL372 Three-Axis Digital Accelerometers.

if ADXL372

choice ADXL372_BUS_TYPE
	prompt "Interface type"
	help
	  Select interface the digital interface type for the ADXL372

config ADXL372_I2C
	depends on I2C
	bool "I2C Interface"

config ADXL372_SPI
	depends on SPI
	bool "SPI Interface"

endchoice

choice
	prompt "Operating mode"
	default ADXL372_PEAK_DETECT_MODE

config ADXL372_PEAK_DETECT_MODE
	bool "Max Peak detect mode"
	help
	  In most high-g applications, a single (3-axis) acceleration sample at
	  the peak of an impact event contains sufficient information
	  about the event, and the full acceleration history is not required.
	  In this mode the device returns only the over threshold
	  Peak Acceleration between two consecutive sample fetches.

config ADXL372_MEASUREMENT_MODE
	bool "Measurement Mode"
	help
	  In this mode, acceleration data is provided continuously at the
	  output data rate (ODR).

endchoice

choice
	prompt "Accelerometer sampling frequency (ODR)"
	default ADXL372_ODR_6400HZ if ADXL372_PEAK_DETECT_MODE
	default ADXL372_ODR_400HZ if ADXL372_MEASUREMENT_MODE

config ADXL372_ODR_400HZ
	bool "400 Hz"

config ADXL372_ODR_800HZ
	bool "800 Hz"

config ADXL372_ODR_1600HZ
	bool "1600 Hz"

config ADXL372_ODR_3200HZ
	bool "3200 Hz"

config ADXL372_ODR_6400HZ
	bool "6400 Hz"

endchoice

choice
	prompt "Low-Pass (Antialiasing) Filter corner frequency"
	default ADXL372_BW_200HZ if ADXL372_ODR_400HZ
	default ADXL372_BW_400HZ if ADXL372_ODR_800HZ
	default ADXL372_BW_800HZ if ADXL372_ODR_1600HZ
	default ADXL372_BW_1600HZ if ADXL372_ODR_3200HZ
	default ADXL372_BW_3200HZ if ADXL372_ODR_6400HZ
	help
	  High g events often include acceleration content over a wide range
	  of frequencies. The ADC of the ADXL372 samples the input acceleration
	  at the user selected ODR.
	  In the absence of antialiasing filters, input signals whose frequency
	  is more than half the ODR alias or fold into the measurement bandwidth
	  can lead to inaccurate measurements.

config ADXL372_LPF_DISABLE
	bool "Disabled"

config ADXL372_BW_200HZ
	bool "200 Hz"

config ADXL372_BW_400HZ
	bool "400 Hz"

config ADXL372_BW_800HZ
	bool "800 Hz"

config ADXL372_BW_1600HZ
	bool "1600 Hz"

config ADXL372_BW_3200HZ
	bool "3200 Hz"

endchoice

choice
	prompt "High-Pass Filter corner frequency"
	default ADXL372_HPF_CORNER0
	help
	  The ADXL372 offers a one-pole, high-pass filter with a user
	  selectable −3 dB frequency. Applications that do not require dc
	  acceleration measurements can use the high-pass filter to minimize
	  constant or slow varying offset errors including initial bias,
	  bias drift due to temperature, and bias drift due to supply voltage

config ADXL372_HPF_DISABLE
	bool "Disabled"

config ADXL372_HPF_CORNER0
	bool "ODR/210"

config ADXL372_HPF_CORNER1
	bool "ODR/411"

config ADXL372_HPF_CORNER2
	bool "ODR/812"

config ADXL372_HPF_CORNER3
	bool "ODR/1616"

endchoice


config ADXL372_ACTIVITY_THRESHOLD
	int "Activity threshold in mg"
	range 0 200000
	default 500
	help
	  Threshold for activity detection.

config ADXL372_INACTIVITY_THRESHOLD
	int "In-activity threshold in mg"
	range 0 200000
	default 400
	help
	  Threshold for in-activity detection.

config ADXL372_ACTIVITY_TIME
	int "Activity time"
	range 0 255
	default 1
	help
	  The activity timer implements a robust activity detection that
	  minimizes false positive motion triggers. When the timer is used,
	  only sustained motion can trigger activity detection.
	  Number of multiples of 3.3 ms activity timer for which above threshold
	  acceleration is required to detect activity. It is 3.3 ms per code
	  for 6400 Hz ODR, and it is 6.6 ms per code for 3200 Hz ODR and below.

config ADXL372_INACTIVITY_TIME
	int "In-activity time"
	range 0 255
	default 2
	help
	  The time that all enabled axes must be lower than the inactivity
	  threshold for an inactivity event to be detected. Number of multiples
	  of 26 ms inactivity timer for which below threshold acceleration is
	  required to detect inactivity. It is 26 ms per code for 3200 Hz ODR
	  and below, and it is 13 ms per code for 6400 Hz ODR.

config ADXL372_REFERENCED_ACTIVITY_DETECTION_MODE
	bool "Use referenced activity/in-activity detection"
	default y
	help
	  Activity detection can be configured as referenced or absolute.
	  When using absolute activity detection, acceleration samples are
	  compared directly to a user set threshold to determine whether
	  motion is present. In many applications, it is advantageous for
	  activity detection to be based not on an absolute threshold,
	  but on a deviation from a reference point or orientation.

choice
	prompt "Trigger mode"
	default ADXL372_TRIGGER_NONE
	help
	  Specify the type of triggering used by the driver.

config ADXL372_TRIGGER_NONE
	bool "No trigger"

config ADXL372_TRIGGER_GLOBAL_THREAD
	bool "Use global thread"
	depends on GPIO
	select ADXL372_TRIGGER

config ADXL372_TRIGGER_OWN_THREAD
	bool "Use own thread"
	depends on GPIO
	select ADXL372_TRIGGER

endchoice

config ADXL372_TRIGGER
	bool

config ADXL372_THREAD_PRIORITY
	int "Thread priority"
	depends on ADXL372_TRIGGER_OWN_THREAD && ADXL372_TRIGGER
	default 10
	help
	  Priority of thread used by the driver to handle interrupts.

config ADXL372_THREAD_STACK_SIZE
	int "Thread stack size"
	depends on ADXL372_TRIGGER_OWN_THREAD && ADXL372_TRIGGER
	default 1024
	help
	  Stack size of thread used by the driver to handle interrupts.

endif #ADXL372
```

## drivers/sensor/adxrs290/Kconfig
```kconfig
# Kconfig - ADXRS290 Ultralow Noise, Dual-Axis MEMS Gyroscope

#
# Copyright (c) 2017 IpTronix S.r.l.
#
# SPDX-License-Identifier: Apache-2.0
#
menuconfig ADXRS290
	bool "ADXRS290 sensor"
	depends on SENSOR && SPI
	default n
	help
	  Enable driver for ADXL362 Ultralow Noise, Dual-Axis MEMS Gyroscope.

config ADXRS290_DEV_NAME
	string "ADXRS290 device name"
	depends on ADXRS290
	default "ADXRS290"

config ADXRS290_SPI_DEV_NAME
	string "SPI device where ADXRS290 is connected"
	depends on ADXRS290
	default "SPI_0"
	help
	  Specify the device name of the SPI device to which ADXRS290 is
	  connected.

config ADXRS290_SPI_DEV_SLAVE
	int "SPI Slave Select where ADXRS290 is connected"
	depends on ADXRS290
	default 1
	help
	  Specify the device name of the SPI device to which ADXRS290 is
	  connected.
```

## drivers/sensor/ags10/Kconfig
```kconfig
# Copyright (c) 2023 Balthazar Deliers
# SPDX-License-Identifier: Apache-2.0

# AOSONG AGS10 TVOC sensor driver options.

config AGS10
	bool "AOSONG AGS10 TVOC sensor"
	default y
	depends on DT_HAS_AOSONG_AGS10_ENABLED
	select I2C
	help
	  Enable AOSONG AGS10 TVOC sensor driver.
```

## drivers/sensor/aht20/Kconfig
```kconfig
# AHT20 temperature and humidity sensor driver configuration

# Copyright (c) 2023 Konrad Sikora
# SPDX-License-Identifier: Apache-2.0

config AHT20
	bool "AHT20 temperature and humidity sensor"
	default y
	depends on DT_HAS_AOSONG_AHT20_ENABLED
	select I2C
	help
	  Enable driver for AHT20 temperature and humidity sensor.

config AHT20_CRC
	bool "Use CRC error detection"
	default y
	select CRC
	help
	  Verify CRC of the RX data
```

## drivers/sensor/ak8975/Kconfig
```kconfig
# AK8975 magnetometer configuration options

# Copyright (c) 2016 Intel Corporation
# SPDX-License-Identifier: Apache-2.0

config AK8975
	bool "AK8975 Magnetometer"
	default y
	depends on DT_HAS_ASAHI_KASEI_AK8975_ENABLED
	depends on I2C
	help
	  Enable driver for AK8975 magnetometer.
```

## drivers/sensor/akm09918c/Kconfig
```kconfig
# Copyright (c) 2023 Google LLC
# SPDX-License-Identifier: Apache-2.0

config AKM09918C
	bool "AKM09918C Magnetometer"
	default y
	depends on DT_HAS_ASAHI_KASEI_AKM09918C_ENABLED
	select I2C
	help
	  Enable driver for AK8975 magnetometer.

config EMUL_AKM09918C
	bool "Emulator for AKM09918C"
	default y
	depends on AKM09918C
	depends on EMUL
	help
	  Enable the hardware emulator for the AKM09918C. Doing so allows exercising
	  sensor APIs for this magnetometer in native_posix and qemu.
```

## drivers/sensor/als31300/Kconfig
```kconfig
# Copyright (c) 2025 Croxel
# SPDX-License-Identifier: Apache-2.0

# ALS31300 3D Linear Hall-Effect Sensor configuration options

config ALS31300
	bool "ALS31300 3D Linear Hall-Effect Sensor"
	default y
	depends on DT_HAS_ALLEGRO_ALS31300_ENABLED
	select I2C
	help
	  Enable driver for ALS31300 3D Linear Hall-Effect Sensor.
	  This sensor provides 12-bit magnetic field measurements
	  on X, Y, and Z axes via I2C interface.
```

## drivers/sensor/am2301b/Kconfig
```kconfig
# Copyright (c) 2022 Hisanori YAMAOKU
# SPDX-License-Identifier: Apache-2.0

menuconfig AM2301B
	bool "Aosong AM2301B Humidity and Temperature Module"
	select I2C
	depends on DT_HAS_AOSONG_AM2301B_ENABLED
	default y
	help
	  Enable driver for Aosong AM2301B Humidity and Temperature Module.

if AM2301B

config AM2301B_CRC_CHECK
	bool "Use CRC Check"
	imply CRC
	default y
	help
	  Check the crc of measurement data.

endif # AM2301B
```
