## drivers/sensor/ti/tmag5170/Kconfig
```kconfig
# Texas Instruments TMAG5170 high-precision, linear 3D Hall-effect sensor with SPI bus interface

# Copyright (c) 2023 Michal Morsisko
# SPDX-License-Identifier: Apache-2.0

menuconfig TMAG5170
	bool "TMAG5170 SPI Hall-effect sensor driver"
	default y
	depends on DT_HAS_TI_TMAG5170_ENABLED
	select SPI
	help
	  Enable driver for TMAG5170 Hall-effect sensor driver

if TMAG5170

choice TMAG5170_TRIGGER_MODE
	prompt "Trigger mode"
	help
	  Specify the type of triggering to be used by the driver.

config TMAG5170_TRIGGER_NONE
	bool "No trigger"

config TMAG5170_TRIGGER_GLOBAL_THREAD
	bool "Use global thread"
	depends on GPIO
	depends on $(dt_compat_any_has_prop,$(DT_COMPAT_TI_TMAG5170),int-gpios)
	select TMAG5170_TRIGGER

config TMAG5170_TRIGGER_OWN_THREAD
	bool "Use own thread"
	depends on GPIO
	depends on $(dt_compat_any_has_prop,$(DT_COMPAT_TI_TMAG5170),int-gpios)
	select TMAG5170_TRIGGER

config TMAG5170_TRIGGER_DIRECT
	bool "Process trigger within interrupt context"
	depends on GPIO
	depends on $(dt_compat_any_has_prop,$(DT_COMPAT_TI_TMAG5170),int-gpios)
	select TMAG5170_TRIGGER

endchoice

config TMAG5170_CRC
	bool "Use CRC error detection"
	default y
	select CRC
	help
	  Verify CRC of RX data and append CRC to TX data

config TMAG5170_TRIGGER
	bool

if TMAG5170_TRIGGER

config TMAG5170_THREAD_PRIORITY
	int "Thread priority"
	depends on TMAG5170_TRIGGER_OWN_THREAD
	default 10
	help
	  Priority of thread used by the driver to handle interrupts.

config TMAG5170_THREAD_STACK_SIZE
	int "Thread stack size"
	depends on TMAG5170_TRIGGER_OWN_THREAD
	default 1024
	help
	  Stack size of thread used by the driver to handle interrupts.

endif # TMAG5170_TRIGGER

endif # TMAG5170
```

## drivers/sensor/ti/tmag5273/Kconfig
```kconfig
# TMAG5273 Low-Power Linear 3D Hall-Effect Sensor configuration options

# Copyright (c) 2023 deveritec GmbH
# SPDX-License-Identifier: Apache-2.0

config TMAG5273
	bool "TMAG5273/TMAG3001 3D Hall-Effect Sensor"
	default y
	depends on DT_HAS_TI_TMAG5273_ENABLED || DT_HAS_TI_TMAG3001_ENABLED
	select I2C
	select GPIO
	imply CRC
	help
	  Enable driver for TMAG5273 and TMAG3001 I2C-based 3d Hall-Effect sensor.
```

## drivers/sensor/ti/tmp114/Kconfig
```kconfig
# TMP114 temperature sensor configuration options

# Copyright (c) 2024 Fredrik Gihl
# SPDX-License-Identifier: Apache-2.0

config TMP114
	bool "TMP114 Temperature Sensor"
	default y
	depends on DT_HAS_TI_TMP114_ENABLED
	select I2C
	help
	  Enable driver for TMP114 temperature sensors.
```

## drivers/sensor/ti/tmp11x/Kconfig
```kconfig
# TMP11X temperature sensor configuration options

# Copyright (c) 2019 Centaur Analytics, Inc
# SPDX-License-Identifier: Apache-2.0

config TMP11X
	bool "TMP116, TMP117 and TMP119 Temperature Sensors"
	default y
	depends on DT_HAS_TI_TMP11X_ENABLED
	select I2C
	help
	  Enable driver for TMP116, TMP117 and TMP119 temperature sensors.

if TMP11X

module = TMP11X
thread_priority = 10
thread_stack_size = 1024
source "drivers/sensor/Kconfig.trigger_template"

endif
```

## drivers/sensor/ti/tmp435/Kconfig
```kconfig
# Copyright (c) 2024 Bittium Corporation
# SPDX-License-Identifier: Apache-2.0
#

config TMP435
	bool "TMP435 temperature sensor"
	default y
	depends on DT_HAS_TI_TMP435_ENABLED
	select I2C
	help
	  Enable the driver for the TMP435 temperature sensor
```

## drivers/sensor/ti/tmp451/Kconfig
```kconfig
# TMP451 temperature sensor driver config options

# Copyright (c) 2026 Open Device Partnership and Contributors
# SPDX-License-Identifier: Apache-2.0

menuconfig TMP451
	bool "TMP451 temperature sensor driver"
	default y
	depends on DT_HAS_TI_TMP451_ENABLED
	select I2C
	help
	  Enable the driver for the TMP451 temperature sensor.

if TMP451

module = TMP451
thread_priority = 10
thread_stack_size = 1024
source "drivers/sensor/Kconfig.trigger_template"

endif # TMP451
```

## drivers/sensor/ti_hdc/Kconfig
```kconfig
# Kconfig - TI_HDC temperature and humidity sensor configuration options

#
# Copyright (c) 2016 Intel Corporation
#
# SPDX-License-Identifier: Apache-2.0
#

config TI_HDC
	bool "Texas Instruments Temperature and Humidity Sensor (e.g. HDC1008)"
	depends on I2C && HAS_DTS_I2C
	help
	  Enable driver for TI temperature and humidity sensors.
```

## drivers/sensor/ti_hdc20xx/Kconfig
```kconfig
# TI_HDC20XX temperature and humidity sensor configuration options

# Copyright (c) 2021 Aurelien Jarno
# SPDX-License-Identifier: Apache-2.0

config TI_HDC20XX
	bool "Texas Instruments HDC20XX Temperature and Humidity Sensor"
	default y
	depends on DT_HAS_TI_HDC2010_ENABLED || DT_HAS_TI_HDC2021_ENABLED || \
		   DT_HAS_TI_HDC2022_ENABLED || DT_HAS_TI_HDC2080_ENABLED
	select I2C
	help
	  Enable driver for TI HDC20XX temperature and humidity sensors
	  (e.g. HDC2010, HDC2021, HDC2022, HDC2080).
```

## drivers/sensor/tmd2635/Kconfig
```kconfig
# Copyright (c) 2023 PHYTEC Messtechnik GmbH
# SPDX-License-Identifier: Apache-2.0

menuconfig TMD2635
	bool "OSRAM-AMS TMD2635 Proxmimity Sensor"
	default y
	depends on DT_HAS_AMS_TMD2635_ENABLED
	select I2C
	help
	  Enable driver for TMD2635 Sensor

if TMD2635

choice
	prompt "Trigger Mode"
	default TMD2635_TRIGGER_NONE
	help
	  Specify the type of triggering to be used by the driver.

config TMD2635_TRIGGER_NONE
	bool "No Trigger"

config TMD2635_TRIGGER_GLOBAL_THREAD
	bool "Use global thread"
	depends on GPIO
	select TMD2635_TRIGGER

endchoice # Trigger Mode

config TMD2635_TRIGGER
	bool

endif # TMD2635
```

## drivers/sensor/tmd26xx/Kconfig
```kconfig
# Copyright (c) 2023 PHYTEC Messtechnik GmbH
# Copyright(c) 2023 Carl Zeiss Meditec AG
# SPDX-License-Identifier: Apache-2.0

menuconfig TMD26XX
	bool "OSRAM-AMS TMD26XX Proxmimity Sensor"
	default y
	depends on DT_HAS_AMS_TMD2635_ENABLED || DT_HAS_AMS_TMD2620_ENABLED
	select I2C
	help
	  Enable driver for TMD26XX Sensor (e.g. TMD2635, TMD2620).

if TMD26XX

choice
	prompt "Trigger Mode"
	default TMD26XX_TRIGGER_NONE
	help
	  Specify the type of triggering to be used by the driver.

config TMD26XX_TRIGGER_NONE
	bool "No Trigger"

config TMD26XX_TRIGGER_GLOBAL_THREAD
	bool "Use global thread"
	depends on GPIO
	select TMD26XX_TRIGGER

endchoice # Trigger Mode

config TMD26XX_TRIGGER
	bool

choice	TMD26XX_SELECT_MODE
	prompt "Select Sensor type"
	default TMD26XX_SELECT_TMD2620
	help
	  Specify the type of triggering to be used by the driver.

config TMD26XX_SELECT_TMD2620
	bool "select none default support tmd2620"
	depends on TMD26XX
	select TMD2620

config TMD26XX_SELECT_TMD2635
	bool "supports tmd2635"
	depends on TMD26XX
	select TMD2635

endchoice

config TMD2620
	bool
config TMD2635
	bool

endif # TMD26XX
```

## drivers/sensor/tmp007/Kconfig
```kconfig
# TMP007 infrared thermopile sensor configuration options

# Copyright (c) 2016 Intel Corporation
# SPDX-License-Identifier: Apache-2.0

menuconfig TMP007
	bool "TMP007 Infrared Thermopile Sensor"
	default y
	depends on DT_HAS_TI_TMP007_ENABLED
	select I2C
	help
	  Enable driver for TMP007 infrared thermopile sensors.

if TMP007

choice
	prompt "Trigger mode"
	default TMP007_TRIGGER_NONE
	help
	  Specify the type of triggering to be used by the driver.

config TMP007_TRIGGER_NONE
	bool "No trigger"

config TMP007_TRIGGER_GLOBAL_THREAD
	bool "Use global thread"
	depends on GPIO
	select TMP007_TRIGGER

config TMP007_TRIGGER_OWN_THREAD
	bool "Use own thread"
	depends on GPIO
	select TMP007_TRIGGER

endchoice

config TMP007_TRIGGER
	bool

config TMP007_THREAD_PRIORITY
	int "Thread priority"
	depends on TMP007_TRIGGER_OWN_THREAD
	default 10
	help
	  Priority of thread used by the driver to handle interrupts.

config TMP007_THREAD_STACK_SIZE
	int "Thread stack size"
	depends on TMP007_TRIGGER_OWN_THREAD
	default 1024
	help
	  Stack size of thread used by the driver to handle interrupts.

endif # TMP007
```

## drivers/sensor/tmp100/Kconfig
```kconfig
menuconfig TMP100
        bool "TMP100 Temperature Sensor"
        depends on I2C
        help
                Enable tmp100 sensor
```

## drivers/sensor/tmp108/Kconfig
```kconfig
# TMP108 temperature sensor configuration options

# Copyright (c) 2021 Jimmy Johnson <catch22@fastmail.net>
# Copyright (c) 2022 T-Mobile USA, Inc.
# SPDX-License-Identifier: Apache-2.0

menuconfig TMP108
	bool "TMP108 Temperature Sensor"
	default y
	depends on DT_HAS_TI_TMP108_ENABLED || DT_HAS_AMS_AS6212_ENABLED
	select I2C

	help
	  Enable driver for the TMP108 temperature sensor and/or it's variant
	  the AMS AS621.

if TMP108

config TMP108_ALERT_INTERRUPTS
	bool "Allow interrupts to service over and under temp alerts"
	help
	  This will set up interrupts to service under and over temp alerts
	  see TMP108 spec sheet for more information on how these work.

endif # TMP108
```

## drivers/sensor/tmp112/Kconfig
```kconfig
# TMP112 temperature sensor configuration options

# Copyright (c) 2016 Firmwave
# SPDX-License-Identifier: Apache-2.0

config TMP112
	bool "TMP112 Temperature Sensor"
	depends on I2C
	help
	  Enable the driver for Texas Instruments TMP112 High-Accuracy Digital
	  Temperature Sensors.

	  The TMP102 is compatible with the TMP112 but is less accurate and has
	  been successfully tested with this driver.

config TMP112_FULL_SCALE_RUNTIME
	bool "Allow to set extended mode at runtime"
	default y
	help
	  When set extended mode can be selected using tmp112_attr_set
	  with SENSOR_ATTR_FULL_SCALE and value to set either 128 or 150

config TMP112_SAMPLING_FREQUENCY_RUNTIME
	bool "Allow to set conversion rate at runtime"
	default y
	help
	  When set conversion rate can be set at runtime using sensor_attr_set
	  with SENSOR_ATTR_SAMPLING_FREQUENCY
```

## drivers/sensor/tmp116/Kconfig
```kconfig
# TMP116 temperature sensor configuration options

# Copyright (c) 2019 Centaur Analytics, Inc
# SPDX-License-Identifier: Apache-2.0

config TMP116
	bool "TMP116 and TMP117 Temperature Sensors"
	default y
	depends on DT_HAS_TI_TMP116_ENABLED
	depends on I2C
	help
	  Enable driver for TMP116 and TMP117 temperature sensors.
```

## drivers/sensor/tsic_xx6/Kconfig
```kconfig
# Copyright (c) 2024 Vitrolife A/S
# SPDX-License-Identifier: Apache-2.0

config TSIC_XX6
	bool "TSic xx6 driver"
	default y
	depends on DT_HAS_IST_TSIC_XX6_ENABLED
	select PWM
	select PWM_CAPTURE
	help
	  Enable driver for TSic 206/306/316/506F/516/716.
```

## drivers/sensor/tsl2520/Kconfig
```kconfig
# TSL2520 Highly Sensitive Ambient Light Sensor configuration options

# Copyright(c) 2023 Carl Zeiss Meditec AG
# SPDX-License-Identifier: Apache-2.0

config TSL2520
	bool "TSL2520 Ambient Light Sensor"
	default y
	depends on DT_HAS_AMS_TSL2520_ENABLED
	select I2C
	help
	  Enable driver for TSL2520 sensors.
```

## drivers/sensor/vcnl36825t/Kconfig
```kconfig
# VCNL36825T Proximity Sensor configuration options

# Copyright (c) 2024 Juliane Schulze, deveritec Gmbh
# SPDX-License-Identifier: Apache-2.0

config VCNL36825T
	bool "VCNL36825T Proximity Sensor"
	default y
	depends on DT_HAS_VISHAY_VCNL36825T_ENABLED
	select I2C
	help
	  Enable driver for VCNL36825T sensors.
```

## drivers/sensor/vcnl4040/Kconfig
```kconfig
# VCNL4040 Proximity and Ambient Light Sensor configuration options

# Copyright (c) 2020 Richard Osterloh
# SPDX-License-Identifier: Apache-2.0

menuconfig VCNL4040
	bool "VCNL4040 Proximity and Ambient Light Sensor"
	depends on I2C && HAS_DTS_I2C && HAS_DTS_GPIO
	help
	  Enable driver for VCNL4040 sensors.

if VCNL4040

config VCNL4040_ENABLE_ALS
	bool "Enable ambient light sensor"
	help
	  Enable Ambient Light Sense (ALS).

config VCNL4040_TRIGGER
	bool

choice
	prompt "Trigger mode"
	default VCNL4040_TRIGGER_NONE
	help
	  Specify the type of triggering to be used by the driver.

config VCNL4040_TRIGGER_NONE
	bool "No trigger"

config VCNL4040_TRIGGER_GLOBAL_THREAD
	bool "Use global thread"
	depends on GPIO
	select VCNL4040_TRIGGER

config VCNL4040_TRIGGER_OWN_THREAD
	bool "Use own thread"
	depends on GPIO
	select VCNL4040_TRIGGER

endchoice

config VCNL4040_THREAD_PRIORITY
	int "Thread priority"
	depends on VCNL4040_TRIGGER_OWN_THREAD
	default 10
	help
	  Priority of thread used by the driver to handle interrupts.

config VCNL4040_THREAD_STACK_SIZE
	int "Thread stack size"
	depends on VCNL4040_TRIGGER_OWN_THREAD
	default 1024
	help
	  Stack size of thread used by the driver to handle interrupts.

endif # VCNL4040
```

## drivers/sensor/veaa_x_3/Kconfig
```kconfig
# VEAA-X-3 configuration options

# Copyright (c) 2024, Vitrolife A/S
# SPDX-License-Identifier: Apache-2.0

config VEAA_X_3
	bool "VEAA-X-3 pressure driver"
	default y
	depends on DT_HAS_FESTO_VEAA_X_3_ENABLED
	depends on ADC
	depends on DAC
	help
	  Enable driver for Festo VEAA-X-3.

	  The driver assumes that the maximum ADC value matches the maximum
	  output from the device, and that the maximum DAC value matches the
	  maximum input value for the device. External hardware is probably
	  required between the ADC/DAC and the device.
```

## drivers/sensor/veml7700/Kconfig
```kconfig
# VEML7700 light sensor configuration options

# Copyright (c) 2022 Nikolaus Huber
# SPDX-License-Identifier: Apache-2.0

config VEML7700
	bool "VEML7700 sensor"
	depends on I2C
	help
		Enable driver for VEML7700 I2C-based light sensor
```

## drivers/sensor/vesc/Kconfig
```kconfig
# VESC BLDC Motor Controller

menuconfig VESC
    bool "VESC BLDC Motor Controller"
    depends on UART
    help
        Enable VESC BLDC Motor Controller driver
```

## drivers/sensor/vishay/Kconfig
```kconfig
# Copyright (c) 2024 Analog Devices, Inc.
# SPDX-License-Identifier: Apache-2.0

# zephyr-keep-sorted-start
source "drivers/sensor/vishay/vcnl36825t/Kconfig"
source "drivers/sensor/vishay/vcnl4040/Kconfig"
source "drivers/sensor/vishay/veml6031/Kconfig"
source "drivers/sensor/vishay/veml7700/Kconfig"
# zephyr-keep-sorted-stop
```

## drivers/sensor/vishay/vcnl36825t/Kconfig
```kconfig
# VCNL36825T Proximity Sensor configuration options

# Copyright (c) 2024 Juliane Schulze, deveritec Gmbh
# SPDX-License-Identifier: Apache-2.0

config VCNL36825T
	bool "VCNL36825T Proximity Sensor"
	default y
	depends on DT_HAS_VISHAY_VCNL36825T_ENABLED
	select I2C
	help
	  Enable driver for VCNL36825T sensors.

if VCNL36825T

config VCNL36825T_TRIGGER
	bool

choice VCNL36825T_TRIGGER_CHOICE
	prompt "trigger mode"
	default VCNL36825T_TRIGGER_NONE
	help
	  Specify the type of triggering to be used by the driver.
	  Note: Since figuring out which interrupt was triggered, using the Zephyr
	  standard types will deactivate the other interrupt.

config VCNL36825T_TRIGGER_NONE
	bool "no trigger"

config VCNL36825T_TRIGGER_GLOBAL_THREAD
	bool "use global thread"
	select VCNL36825T_TRIGGER

config VCNL36825T_TRIGGER_OWN_THREAD
	bool "use own thread"
	select VCNL36825T_TRIGGER

endchoice

if VCNL36825T_TRIGGER

config VCNL36825T_THREAD_PRIORITY
	int "thread priority"
	depends on VCNL36825T_TRIGGER_OWN_THREAD
	default 10
	help
	  Priority of thread used by the driver to handle interrupts.

config VCNL36825T_THREAD_STACK_SIZE
	int "thread stack size"
	depends on VCNL36825T_TRIGGER_OWN_THREAD
	default 1024
	help
	  Stack size of thread used by the driver to handle interrupts.

endif # VCNL36825T_TRIGGER

endif # VCNL36825T
```
