## drivers/sensor/omron/Kconfig
```kconfig
# Copyright (c) 2025 Prevas A/S
# SPDX-License-Identifier: Apache-2.0

source "drivers/sensor/omron/*/Kconfig"
```

## drivers/sensor/omron/d6f/Kconfig
```kconfig
# Copyright (c) 2025 Prevas A/S
# SPDX-License-Identifier: Apache-2.0

config D6F
	bool "D6F mass flow rate sensor"
	default y
	depends on DT_HAS_OMRON_D6F_P0001_ENABLED || DT_HAS_OMRON_D6F_P0010_ENABLED
	select ADC
	select FPU if CPU_HAS_FPU
	help
	  Enable Omron D6F mass flow rate sensor driver. The sensor series
	  outputs an analogue voltage which is read using an ADC.
```

## drivers/sensor/omron_2smpp03/Kconfig
```kconfig
# Copyright (c) 2020 Teslabs Engineering S.L.
# SPDX-License-Identifier: Apache-2.0

menuconfig OMRON_2SMPP03
	bool "Omron Gauge Type Pressure Sensor 2SMPP-03"
	depends on ADC
	help
	  Enable driver for Omron Gauge Type Pressure Sensor 2SMPP-03

config OMRON_2SMPP03_ADC_RESOLUTION
	int "ADC resolution"
	default 8
	depends on OMRON_2SMPP03
	help
	  ADC sampling resolution (bits)
```

## drivers/sensor/opt3001/Kconfig
```kconfig
# OPT3001 light sensor configuration options

# Copyright (c) 2019 Actinius
# SPDX-License-Identifier: Apache-2.0

menuconfig OPT3001
	bool "OPT3001 Light Sensor"
	default y
	depends on DT_HAS_TI_OPT3001_ENABLED
	select I2C
	help
	  Enable driver for OPT3001 light sensors.

if OPT3001

choice OPT3001_TRIGGER_MODE
	prompt "Trigger mode"
	help
	  Specify the type of triggering to be used by the driver.

config OPT3001_TRIGGER_NONE
	bool "No trigger"

config OPT3001_TRIGGER_GLOBAL_THREAD
	bool "Use global thread"
	depends on GPIO
	select OPT3001_TRIGGER

config OPT3001_TRIGGER_OWN_THREAD
	bool "Use own thread"
	depends on GPIO
	select OPT3001_TRIGGER

endchoice

config OPT3001_TRIGGER
	bool

if OPT3001_TRIGGER

config OPT3001_THREAD_PRIORITY
	int "Thread priority"
	depends on OPT3001_TRIGGER_OWN_THREAD
	default 10
	help
	  Priority of thread used by the driver to handle interrupts.

config OPT3001_THREAD_STACK_SIZE
	int "Thread stack size"
	depends on OPT3001_TRIGGER_OWN_THREAD
	default 1024
	help
	  Stack size of thread used by the driver to handle interrupts.

endif # OPT3001_TRIGGER

endif # OPT3001
```

## drivers/sensor/photosensor/Kconfig
```kconfig
# Copyright (c) 2026 Nordic Semiconductor ASA
# SPDX-License-Identifier: Apache-2.0

config SENSOR_PHOTOSENSOR
	bool "Photosensor sensor driver support"
	default y
	depends on DT_HAS_PHOTOSENSOR_ENABLED
	select GPIO
	select ADC
	select ADC_ASYNC
	select SENSOR_ASYNC_API

if SENSOR_PHOTOSENSOR

config SENSOR_PHOTOSENSOR_ADC_READ_CALIBRATE
	bool "Perform calibration before ADC read"
	default y

endif # SENSOR_PHOTOSENSOR
```

## drivers/sensor/pinnacle/Kconfig
```kconfig
# Cirque Pinnacle 1CA027 touch controller based device configuration options
#
# Copyright (c) 2024 Ilia Kharin
# SPDX-License-Identifier: Apache-2.0

menuconfig PINNACLE
	bool "Cirque Pinnacle 1CA027 Touch Controller Based Device"
	default y
	select SPI
	help
	  Enable driver for 1CA027 SPI-based trackpad device.

if PINNACLE

choice PINNACLE_TRIGGER_MODE
	prompt "Trigger mode"
	default PINNACLE_TRIGGER_OWN_THREAD
	help
	  Specify the type of triggering to be used by the driver.

config PINNACLE_TRIGGER_NONE
	bool "No trigger"

config PINNACLE_TRIGGER_GLOBAL_THREAD
	bool "Use global thread"
	depends on GPIO
	select PINNACLE_TRIGGER

config PINNACLE_TRIGGER_OWN_THREAD
	bool "Use own thread"
	depends on GPIO
	select PINNACLE_TRIGGER

endchoice

config PINNACLE_TRIGGER
	bool

config PINNACLE_THREAD_PRIORITY
	int "Thread priority"
	depends on PINNACLE_TRIGGER_OWN_THREAD && PINNACLE_TRIGGER
	default 10
	help
	  Priority of thread used by the driver to handle interrupts.

config PINNACLE_THREAD_STACK_SIZE
	int "Thread stack size"
	depends on PINNACLE_TRIGGER_OWN_THREAD && PINNACLE_TRIGGER
	default 512
	help
	  Stack size of thread used by the driver to handle interrupts.

endif # PINNACLE
```

## drivers/sensor/pixart/Kconfig
```kconfig
# Copyright (c) 2025 Croxel Inc.
# Copyright (c) 2025 CogniPilot Foundation
# Copyright (c) 2025 Paul Timke <ptimkec@live.com>
# SPDX-License-Identifier: Apache-2.0

# zephyr-keep-sorted-start
source "drivers/sensor/pixart/paa3905/Kconfig"
source "drivers/sensor/pixart/paj7620/Kconfig"
source "drivers/sensor/pixart/pat9136/Kconfig"
# zephyr-keep-sorted-stop
```

## drivers/sensor/pixart/paa3905/Kconfig
```kconfig
# Copyright (c) 2025 Croxel Inc.
# Copyright (c) 2025 CogniPilot Foundation
# SPDX-License-Identifier: Apache-2.0

config PAA3905
	bool "Optical Flow Sensor PAA3905"
	default y
	depends on DT_HAS_PIXART_PAA3905_ENABLED
	select SPI
	select SPI_RTIO
	select SENSOR_ASYNC_API
	help
	  Enable driver for PAA3905 Optical Flow sensor.

if PAA3905

config PAA3905_STREAM
	bool "Streaming mode"
	depends on $(dt_compat_any_has_prop,$(DT_COMPAT_PIXART_PAA3905),int-gpios)
	select RTIO_WORKQ
	help
	  Enable streaming mode for the PAA3905 sensor.

endif # PAA3905
```

## drivers/sensor/pixart/paj7620/Kconfig
```kconfig
# PAJ7620 gesture sensor configuration options

# Copyright (c) 2025 Paul Timke <ptimkec@live.com>
# SPDX-License-Identifier: Apache-2.0

menuconfig PAJ7620
	bool "PAJ7620 gesture sensor driver"
	default y
	depends on DT_HAS_PIXART_PAJ7620_ENABLED
	select I2C
	help
	  Enable driver for the PAJ7620 gesture sensor

if PAJ7620

module = PAJ7620
thread_priority = 10
thread_stack_size = 1024
source "drivers/sensor/Kconfig.trigger_template"

endif # PAJ7620
```

## drivers/sensor/pixart/pat9136/Kconfig
```kconfig
# Copyright (c) 2025 Croxel Inc.
# Copyright (c) 2025 CogniPilot Foundation
# SPDX-License-Identifier: Apache-2.0

config PAT9136
	bool "Optical Flow Sensor PAT9136"
	default y
	depends on DT_HAS_PIXART_PAT9136_ENABLED
	select SPI
	select SPI_RTIO
	select RTIO_WORKQ
	select SENSOR_ASYNC_API
	help
	  Enable driver for PAT9136 Optical Flow sensor.

if PAT9136

config PAT9136_STREAM
	bool "Streaming mode"
	depends on $(dt_compat_any_has_prop,$(DT_COMPAT_PIXART_PAT9136),int-gpios)
	help
	  Enable streaming mode for the PAT9136 sensor.

endif # PAT9136
```

## drivers/sensor/plantower/Kconfig
```kconfig
# Copyright (c) 2026 RAKwireless Technology Limited
# SPDX-License-Identifier: Apache-2.0

# zephyr-keep-sorted-start
source "drivers/sensor/plantower/pms7003/Kconfig"
# zephyr-keep-sorted-stop
```

## drivers/sensor/plantower/pmsa003i/Kconfig
```kconfig
# Copyright (c) 2026 RAKwireless Technology Limited
# SPDX-License-Identifier: Apache-2.0

config PMSA003I
	bool "PMSA003I particulate matter sensor"
	default y
	depends on DT_HAS_PLANTOWER_PMSA003I_ENABLED
	depends on I2C
	help
	  Enable driver for pmsa003i particulate matter sensor.
```

## drivers/sensor/pms7003/Kconfig
```kconfig
# PMS7003 particulate matter sensor configuration options

# Copyright (c) 2017 Intel Corporation
# SPDX-License-Identifier: Apache-2.0

config PMS7003
	bool "PMS7003 particulate matter sensor"
	default y
	depends on DT_HAS_PLANTOWER_PMS7003_ENABLED
	depends on SERIAL
	help
	  Enable driver for pms7003 particulate matter sensor.
```

## drivers/sensor/pmsX003/Kconfig
```kconfig
# PMS7003 particulate matter sensor configuration options

# Copyright (c) 2017 Intel Corporation
# SPDX-License-Identifier: Apache-2.0

config PMSX003
	bool "PMSX003 particulate matter sensor"
	default y
	depends on DT_HAS_PLANTOWER_PMSX003_ENABLED
	depends on SERIAL
	help
	  Enable driver for pms7003, pms5003 and pms6003 particulate matter sensor.
```

## drivers/sensor/pni/Kconfig
```kconfig
# Copyright (c) 2025 Croxel, Inc.
# Copyright (c) 2025 CogniPilot Foundation
# SPDX-License-Identifier: Apache-2.0

# zephyr-keep-sorted-start
source "drivers/sensor/pni/rm3100/Kconfig"
# zephyr-keep-sorted-stop
```

## drivers/sensor/pni/rm3100/Kconfig
```kconfig
# Copyright (c) 2025 Croxel, Inc.
# Copyright (c) 2025 CogniPilot Foundation
# SPDX-License-Identifier: Apache-2.0

config RM3100
	bool "RM3100 3-Axis Magnetometer"
	default y
	depends on DT_HAS_PNI_RM3100_ENABLED
	select SPI if $(dt_compat_on_bus,$(DT_COMPAT_PNI_RM3100),spi)
	select SPI_RTIO if $(dt_compat_on_bus,$(DT_COMPAT_PNI_RM3100),spi)
	select I2C if $(dt_compat_on_bus,$(DT_COMPAT_PNI_RM3100),i2c)
	select I2C_RTIO if $(dt_compat_on_bus,$(DT_COMPAT_PNI_RM3100),i2c)
	select SENSOR_ASYNC_API
	help
	  Enable driver for PNI RM3100 high-accuracy 3-axis magnetometer.

config RM3100_STREAM
	bool "RM3100 Streaming Mode"
	depends on $(dt_compat_any_has_prop,$(DT_COMPAT_PNI_RM3100),int-gpios)
	help
	  Enable streaming mode for the RM3100 sensor.
	  This mode allows for continuous data output at a specified rate.
```

## drivers/sensor/pzem004t/Kconfig
```kconfig
# PZEM004T Multifunction AC Meter configuration options

# Copyright (c) 2025 Srishtik Bhandarkar
# SPDX-License-Identifier: Apache-2.0

config PZEM004T
	bool "PZEM004T Multifunction AC Meter"
	default y
	depends on DT_HAS_PEACEFAIR_PZEM004T_ENABLED
	depends on MODBUS
	depends on MODBUS_SERIAL
	depends on MODBUS_RAW_ADU
	help
	  Enable the driver for the Peacefair PZEM004T Multifunction AC Meter.

config PZEM004T_ENABLE_RESET_ENERGY
	bool "Include support for resetting energy value"
	depends on PZEM004T
	help
	  Enable support for resetting the energy counter on the PZEM004T device.
```

## drivers/sensor/qdec_nrfx/Kconfig
```kconfig
# Copyright (c) 2018, Nordic Semiconductor ASA
# SPDX-License-Identifier: Apache-2.0

config QDEC_NRFX
	bool "Nordic QDEC nrfx driver"
	depends on HAS_HW_NRF_QDEC0
	select NRFX_QDEC
	help
	  Enable support for nrfx QDEC driver for nRF MCU series.
```

## drivers/sensor/qdec_sam/Kconfig
```kconfig
# Atmel SAM MCU family Quadrature Decoder (TC) driver configuration options
#
# Copyright (c) 2021, Piotr Mienkowski
# SPDX-License-Identifier: Apache-2.0
#

config QDEC_SAM
	bool "Atmel SAM QDEC driver"
	default y
	depends on DT_HAS_ATMEL_SAM_TC_QDEC_ENABLED
	depends on SOC_FAMILY_ATMEL_SAM
	select PINCTRL
	help
	  Atmel SAM MCU family Quadrature Decoder (TC) driver.
```

## drivers/sensor/qorvo/Kconfig
```kconfig
# Copyright (c) 2026 HawkEye 360
# SPDX-License-Identifier: Apache-2.0

rsource "cmd170p4/Kconfig"
```

## drivers/sensor/qorvo/cmd170p4/Kconfig
```kconfig
# Copyright (c) 2026 HawkEye 360
# SPDX-License-Identifier: Apache-2.0

config QORVO_CMD170P4
	bool "Qorvo CMD170P4 RF power detector driver"
	default y
	depends on DT_HAS_QORVO_CMD170P4_ENABLED
	select ADC
	help
	  Enable driver for the Qorvo CMD170P4 7.5-9 GHz driver amplifier
	  with integrated power detector. The driver uses table-based
	  interpolation to convert detector voltage (0-5V) to RF output
	  power (0-30 dBm) according to the manufacturer's transfer function.
```

## drivers/sensor/qst/Kconfig
```kconfig
# SPDX-FileCopyrightText: Copyright The Zephyr Project Contributors
# SPDX-License-Identifier: Apache-2.0

source "drivers/sensor/qst/qmi8658a/Kconfig"
```

## drivers/sensor/qstcorp/Kconfig
```kconfig
# Copyright (c) 2025 LCKFB
# SPDX-License-Identifier: Apache-2.0

# zephyr-keep-sorted-start
source "drivers/sensor/qstcorp/qmc5883l/Kconfig"
source "drivers/sensor/qstcorp/qmi8658c/Kconfig"
# zephyr-keep-sorted-stop
```

## drivers/sensor/qstcorp/qmc5883l/Kconfig
```kconfig
# Copyright (c) 2025 LCKFB
# SPDX-License-Identifier: Apache-2.0

config QMC5883L
	bool "QMC5883L magnetometer sensor"
	default y
	depends on DT_HAS_QSTCORP_QMC5883L_ENABLED
	select I2C
	help
	  Enable driver for QSTCORP QMC5883L I2C-based magnetometer sensor.
```

## drivers/sensor/qstcorp/qmi8658c/Kconfig
```kconfig
# Copyright (c) 2025 LCKFB
# SPDX-License-Identifier: Apache-2.0

config QMI8658C
	bool "QMI8658C 6-axis IMU sensor"
	default n
	depends on DT_HAS_QSTCORP_QMI8658C_ENABLED
	select I2C
	help
	  Enable driver for QSTCORP QMI8658C 6-axis IMU sensor (accelerometer + gyroscope).
```
