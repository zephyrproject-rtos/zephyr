## drivers/sensor/realtek/Kconfig
```kconfig
# Copyright (c) 2025, Realtek, SIBG-SD7
# SPDX-License-Identifier: Apache-2.0

source "drivers/sensor/realtek/rts5912/Kconfig"
```

## drivers/sensor/realtek/qdec_bee/Kconfig
```kconfig
# Copyright (c) 2026, Realtek Semiconductor Corporation
# SPDX-License-Identifier: Apache-2.0

config QDEC_BEE
	bool "Realtek Bee series QDEC driver"
	default y
	depends on DT_HAS_REALTEK_BEE_BASIC_QDEC_ENABLED || DT_HAS_REALTEK_BEE_AON_QDEC_ENABLED
	select HAL_REALTEK_BEE_QDEC if DT_HAS_REALTEK_BEE_BASIC_QDEC_ENABLED
	select HAL_REALTEK_BEE_AON_QDEC if DT_HAS_REALTEK_BEE_AON_QDEC_ENABLED
	select PINCTRL
	help
	  This option enables the QDEC driver for Realtek Bee SoCs.
```

## drivers/sensor/realtek/rts5912/Kconfig
```kconfig
# Copyright (c) 2025, Realtek, SIBG-SD7
# SPDX-License-Identifier: Apache-2.0

config TACH_RTS5912
	bool "RTS5912 Tachometer sensor"
	default y
	depends on DT_HAS_REALTEK_RTS5912_TACH_ENABLED
	help
	  Enable the Realtek RTS5912 tachometer sensor.

config TACH_RTS5912_DISCARD_SAMPLES
	bool "Discard the first two samples on fetch"
	depends on TACH_RTS5912
	help
	  Discard the first two sample on fetch(), this is useful when the
	  tachometer is used while the chip is in a low power state, as the
	  first two samples can be unreliable.

config TACH_RTS5912_ASYNC_FETCH
	bool "Asynchronous sample fetch"
	depends on TACH_RTS5912
	help
	  Make sample_fetch() asynchronous by returning immediately without waiting
	  for the tachometer reading to complete. Note that this is not the normal
	  behavior of the Zephyr sensor sample fetch API.
```

## drivers/sensor/renesas/Kconfig
```kconfig
# Copyright (c) 2024 Ian Morris
# SPDX-License-Identifier: Apache-2.0

source "drivers/sensor/renesas/*/Kconfig"
```

## drivers/sensor/renesas/hs300x/Kconfig
```kconfig
# Renesas HS300x temperature and humidity sensor configuration options

# Copyright (c) 2023 Ian Morris
# SPDX-License-Identifier: Apache-2.0

config HS300X
	bool "HS300x Temperature and Humidity Sensor"
	default y
	depends on DT_HAS_RENESAS_HS300X_ENABLED
	select I2C
	help
	  Enable driver for HS300x temperature and humidity sensors.
```

## drivers/sensor/renesas/hs400x/Kconfig
```kconfig
# HS400X temperature and humidity sensor

# Copyright (c) 2024 Renesas Electronics Corporation
# SPDX-License-Identifier: Apache-2.0

config HS400X
	bool "HS400x sensor"
	default y
	depends on DT_HAS_RENESAS_HS400X_ENABLED
	help
	  Enable driver for HS400x temperature and humidity sensors.

if HS400X

config HS400X_CRC
	bool "HS400X CRC check"
	select CRC
	help
	 Verify the checksum byte from measurements

endif # HS400x
```

## drivers/sensor/renesas/qdec_ra/Kconfig
```kconfig
# Renesas RA family Quadrature Decoder driver configuration options
#
# Copyright (c) 2025, Pivot International Inc.
# SPDX-License-Identifier: Apache-2.0
#

config QDEC_RENESAS_RA
	bool "Renesas RA family QDEC driver"
	default y
	depends on DT_HAS_RENESAS_RA_QDEC_ENABLED
	select USE_RA_FSP_GPT
	select PINCTRL
	help
	  Enable Renesas RA family Quadrature Decoder driver.
```

## drivers/sensor/renesas/rrh46410/Kconfig
```kconfig
# RRH46410 air quality sensor

# Copyright (c) 2024 Renesas Electronics Corporation
# SPDX-License-Identifier: Apache-2.0

config RRH46410
	bool "RRH46410 sensor"
	default y
	depends on DT_HAS_RENESAS_RRH46410_ENABLED
	select I2C if $(dt_compat_on_bus,$(DT_COMPAT_RENESAS_RRH46410),i2c)
	select UART if $(dt_compat_on_bus,$(DT_COMPAT_RENESAS_RRH46410),uart)
	depends on GPIO

	help
	  Enable driver for RRH46410 TVOC sensor.
```

## drivers/sensor/rohm/Kconfig
```kconfig
# Copyright (c) 2024 Analog Devices, Inc.
# SPDX-License-Identifier: Apache-2.0

# zephyr-keep-sorted-start
source "drivers/sensor/rohm/bd8lb600fs/Kconfig"
source "drivers/sensor/rohm/bh1750/Kconfig"
# zephyr-keep-sorted-stop
```

## drivers/sensor/rohm/bd8lb600fs/Kconfig
```kconfig
# Copyright (c) 2024 SILA Embedded Solutions GmbH
# SPDX-License-Identifier: Apache-2.0

config BD8LB600FS_DIAGNOSTICS
	bool "Sensors of BD8LB600FS"
	default y
	depends on DT_HAS_ROHM_BD8LB600FS_DIAGNOSTICS_ENABLED
	select MFD
	help
	  Enable driver for the open load detection, over current
	  protection and thermal shutdown sensors of the low side
	  switch BD8LB600FS.
```

## drivers/sensor/rohm/bh1730/Kconfig
```kconfig
# BH1730 ambient light sensor configuration options

# Copyright (c) 2025, Borislav Kereziev
# SPDX-License-Identifier: Apache-2.0

config BH1730
	bool "BH1730 Ambient Light Sensor"
	default y
	depends on DT_HAS_ROHM_BH1730_ENABLED
	select I2C
	help
		Enable driver for BH1730 ambient light sensor.
```

## drivers/sensor/rohm/bh1750/Kconfig
```kconfig
# BH1750 ambient light sensor configuration options

# Copyright (c) 2022 Michal Morsisko
# SPDX-License-Identifier: Apache-2.0

config BH1750
	bool "BH1750 ambient light sensor"
	default y
	depends on DT_HAS_ROHM_BH1750_ENABLED
	select I2C
	help
	  Enable driver for BH1750 ambient light sensor.

config EMUL_BH1750
	bool "Emulate a BH1759 ambient light sensor"
	default y
	depends on EMUL
	depends on BH1750
	help
	  This is an emulator for the BH1750 ambient light sensor.

	  It provides readings which follow a simple sequence, thus allowing
	  test code to check that things are working as expected.
```

## drivers/sensor/rohm/bh1790/Kconfig
```kconfig
# BH1790 BH1790 Optical Sensor for Heart Rate Monitor IC sensor configuration options

# Copyright (c) 2025 Magpie Embedded
# SPDX-License-Identifier: Apache-2.0

config BH1790
	bool "BH1790 Optical Sensor for Heart Rate Monitor IC"
	default y
	depends on DT_HAS_ROHM_BH1790_ENABLED
	select I2C
	help
	  BH1790 Optical Sensor for Heart Rate Monitor IC.
```

## drivers/sensor/rpi_pico_temp/Kconfig
```kconfig
# Raspberry Pi Pico temperature sensor configuration options

# Copyright (c) 2023 TOKITA Hiroshi
# SPDX-License-Identifier: Apache-2.0

config RPI_PICO_TEMP
	bool "Raspberry Pi Pico CPU Temperature Sensor"
	default y
	depends on DT_HAS_RASPBERRYPI_PICO_TEMP_ENABLED
	depends on ADC

	help
	  Enable driver for Raspberry Pi Pico CPU temperature sensor.
```

## drivers/sensor/rv3032_temp/Kconfig
```kconfig
# Copyright (c) 2025 Baylibre SAS
# SPDX-License-Identifier: Apache-2.0

config RV3032_TEMP
	bool "RV3032 Temperature Sensor"
	default y
	depends on DT_HAS_MICROCRYSTAL_RV3032_TEMP_ENABLED
	select MFD_RV3032
	help
	  Enable driver for temperature sensor on rv-3032-c7 RTC.

config RV3032_TEMP_TRIGGER
	bool "Trigger support"
	depends on RV3032_TEMP
	default y
	help
	  Enable trigger support for the RV3032 TEMP.

config TEMP_MICROCRYSTAL_RV3032_INIT_PRIORITY
	int "Init priority of rc3032c7 Temperature Sensor"
	depends on RV3032_TEMP
	default 50
	help
	  Initialization priority for the Microcrystal rv3032c7 Sensor driver.
```

## drivers/sensor/s11059/Kconfig
```kconfig
# S11059 color sensor

# Copyright (c) 2022 Hiroki Tada
# SPDX-License-Identifier: Apache-2.0

config S11059
	bool "S11059 color sensor"
	default y
	depends on DT_HAS_HAMAMATSU_S11059_ENABLED
	select I2C
	help
		Enable driver for S11059 color sensor
```

## drivers/sensor/s9706/Kconfig
```kconfig
# Copyright (c) 2026 Carl Zeiss AG
# SPDX-License-Identifier: Apache-2.0

menuconfig S9706
	bool "S9706 Digital Color Sensor"
	default y
	depends on DT_HAS_HAMAMATSU_S9706_ENABLED
	select GPIO
	help
	  Enable driver for the S9706 digital color sensor

if S9706

config S9706_DEFAULT_RANGE
	bool "S9706: Default range setting"
	default y
	depends on S9706
	help
	  When selected, the driver will enable the full sensor by default.
	  Otherwise, only the center part will be used.

endif # S9706
```

## drivers/sensor/sbs_gauge/Kconfig
```kconfig
# Copyright (c) 2021 Leica Geosystems AG
# SPDX-License-Identifier: Apache-2.0

config SBS_GAUGE
	bool "Smart Battery Fuel Gauge"
	default y
	depends on DT_HAS_SBS_SBS_GAUGE_ENABLED
	select I2C
	help
	  Enable I2C-based/SMBus-based driver for a Smart Battery Fuel Gauge.

# Maintain access to emul_sbs_gauge.
source "drivers/fuel_gauge/sbs_gauge/Kconfig.emul_sbs_gauge"
```

## drivers/sensor/scd30/Kconfig
```kconfig
# Sensirion SCD30 CO2 sensor configuration options

# Copyright (c) 2021 Advanced Climate Systems
# SPDX-License-Identifier: Apache-2.0

config SCD30
	bool "Sensirion SCD30 CO2 Sensor"
	depends on I2C
```

## drivers/sensor/scd4x/Kconfig
```kconfig
# SCD4x co2, temperature, and humidity sensor configuration options

# Copyright (c) 2022 Stephen Oliver
# SPDX-License-Identifier: Apache-2.0

config SCD4X
	bool "SCD4x CO2/Temperature/Humidity Sensor"
	depends on I2C
	help
	  Enable driver for SCD4x co2, temperature, and humidity sensors.

config SCD4X_POWER_DOWN_SINGLE_SHOT_MEASUREMENT
	bool "SCD41 only: power down sensor between single-shot measurements"
	depends on SCD4X
	help
	  Will send the power_down command to the sensor after a measurement, and wake it up again
	  before the next measurement. Only works on SCD41 model.
```

## drivers/sensor/seeed/Kconfig
```kconfig
# Copyright (c) 2024 Analog Devices, Inc.
# SPDX-License-Identifier: Apache-2.0

# zephyr-keep-sorted-start
source "drivers/sensor/seeed/grove/Kconfig"
source "drivers/sensor/seeed/hm330x/Kconfig"
# zephyr-keep-sorted-stop
```

## drivers/sensor/seeed/grove/Kconfig
```kconfig
# Drivers configuration options for SeeedStudio Grove Devices

# Copyright (c) 2015 Intel Corporation
# SPDX-License-Identifier: Apache-2.0

config GROVE_SENSORS
	bool "Seeed Grove sensors support"
	default y
	depends on DT_HAS_SEEED_GROVE_LIGHT_ENABLED || DT_HAS_SEEED_GROVE_TEMPERATURE_ENABLED
	help
	  Enable Seeed Grove sensors support.

if GROVE_SENSORS

config GROVE_LIGHT_SENSOR
	bool "The Seeed Grove Light Sensor"
	default y
	depends on DT_HAS_SEEED_GROVE_LIGHT_ENABLED
	depends on ADC && !MINIMAL_LIBC
	help
	  Setting this value will enable driver support for the Grove Light
	  Sensor.

config GROVE_TEMPERATURE_SENSOR
	bool "The Seeed Grove Temperature Sensor"
	default y
	depends on DT_HAS_SEEED_GROVE_TEMPERATURE_ENABLED
	depends on ADC && !MINIMAL_LIBC
	help
	  Setting this value will enable driver support for the Grove
	  Temperature Sensor.

endif # GROVE_SENSORS
```

## drivers/sensor/seeed/hm330x/Kconfig
```kconfig
# Seeed Studio HM330x dust particle sensor configuration options

# Copyright (c) 2023 Benjamin Cabé <benjamin@zephyrproject.org>
# SPDX-License-Identifier: Apache-2.0

config HM330X
	bool "HM330X dust particle sensor"
	default y
	depends on DT_HAS_SEEED_HM330X_ENABLED
	select I2C
	help
	  Enable driver for the HM330X dust particle sensor.
```

## drivers/sensor/sensirion/Kconfig
```kconfig
# Copyright (c) 2024 Analog Devices, Inc.
# SPDX-License-Identifier: Apache-2.0

# zephyr-keep-sorted-start
source "drivers/sensor/sensirion/sdp3x/Kconfig"
source "drivers/sensor/sensirion/sgp40/Kconfig"
source "drivers/sensor/sensirion/sht3xd/Kconfig"
source "drivers/sensor/sensirion/sht4x/Kconfig"
source "drivers/sensor/sensirion/shtcx/Kconfig"
# zephyr-keep-sorted-stop
```

## drivers/sensor/sensirion/scd4x/Kconfig
```kconfig
# Drivers configuration options for Sensirion SCD4x

# Copyright (c) 2024 Jan Fäh
# SPDX-License-Identifier: Apache-2.0

config SCD4X
	bool "SCD4x Carbon Dioxide Sensor"
	default y
	depends on DT_HAS_SENSIRION_SCD41_ENABLED || DT_HAS_SENSIRION_SCD40_ENABLED
	select I2C
	select CRC
	help
	  Enable driver for the Sensirion SCD4x carbon dioxide sensors.
```
