## drivers/sensor/lm35/Kconfig
```kconfig
# LM35 temperature sensor config

# Copyright (c) 2024 Renato Soma <renatoys08@gmail.com>
# SPDX-License-Identifier: Apache-2.0

config LM35
	bool "LM35 Temperature Sensor"
	default y
	depends on DT_HAS_LM35_ENABLED
	select ADC
	help
	  Enable the driver for the LM35 digital temperature Sensor
```

## drivers/sensor/lm73c/Kconfig
```kconfig
# Copyright (c) 2020 SER Consulting LLC
# SPDX-License-Identifier: Apache-2.0

config LM73C
	bool "LM73C Temperature Sensor"
	depends on I2C
	help
	  Enable I2C-based driver for LM73C Temperature Sensor.
```

## drivers/sensor/lm75/Kconfig
```kconfig
# LM75 temperature sensor config

# Copyright (c) 2021 Leica Geosystems AG
# SPDX-License-Identifier: Apache-2.0

config LM75
	bool "LM75 Temperature Sensor"
	default y
	depends on DT_HAS_LM75_ENABLED
	select I2C
	help
	  Enable the driver for the LM75 digital temperature Sensor with 2-wire
	  interface.

if LM75

choice
	prompt "Trigger mode"
	default LM75_TRIGGER_NONE
	help
	  Specify the type of triggering to be used by the driver.

config LM75_TRIGGER_NONE
	bool "No trigger"

config LM75_TRIGGER_GLOBAL_THREAD
	bool "Use global thread"
	depends on $(dt_compat_any_has_prop,$(DT_COMPAT_LM75),int-gpios)
	depends on GPIO
	select LM75_TRIGGER

endchoice

config LM75_TRIGGER
	bool

if LM75_TRIGGER

config LM75_TRIGGER_THREAD_STACK_SIZE
	int "Stack size for the trigger workqueue thread"
	default 512
	help
	  Size of the stack used for the internal trigger workqueue thread.

config LM75_TRIGGER_THREAD_PRIO
	int "Priority for the trigger workqueue thread"
	default 0
	help
	  Priority level for the internal trigger workqueue thread.

endif # LM75_TRIGGER

endif # LM75
```

## drivers/sensor/lm77/Kconfig
```kconfig
# LM77 temperature sensor configuration
#
# Copyright (c) 2021 Vestas Wind Systems A/S
# SPDX-License-Identifier: Apache-2.0

menuconfig LM77
	bool "LM77 Temperature Sensor"
	default y
	depends on DT_HAS_LM77_ENABLED
	default $(dt_compat_enabled,lm77)
	select I2C
	help
	  Enable driver for the LM77 digital temperature sensor with 2-wire
	  interface.

config LM77_TRIGGER
	bool "Trigger support"
	depends on LM77
	default y
	help
	  Enable trigger support for the LM77 digital temperature sensor.

	  Trigger events are based on the LM77 INT signal (configured for event
	  interrupt mode). After a trigger event the LM77 temperature must be
	  read in order to reset and rearm the trigger.

if LM77_TRIGGER

config LM77_TRIGGER_THREAD_STACK_SIZE
	int "Stack size for the trigger workqueue thread"
	default 512
	help
	  Size of the stack used for the internal trigger workqueue thread.

config LM77_TRIGGER_THREAD_PRIO
	int "Priority for the trigger workqueue thread"
	default 0
	help
	  Priority level for the internal trigger workqueue thread.

endif # LM77_TRIGGER
```

## drivers/sensor/lps22df/Kconfig
```kconfig
# ST Microelectronics LPS22DF pressure and temperature sensor

# Copyright (c) 2023 STMicroelectronics
# SPDX-License-Identifier: Apache-2.0

menuconfig LPS22DF
	bool "LPS22DF pressure and temperature"
	default y
	depends on DT_HAS_ST_LPS22DF_ENABLED
	select I2C if $(dt_compat_on_bus,$(DT_COMPAT_ST_LPS22DF),i2c)
	select I3C if $(dt_compat_on_bus,$(DT_COMPAT_ST_LPS22DF),i3c)
	select SPI if $(dt_compat_on_bus,$(DT_COMPAT_ST_LPS22DF),spi)
	select HAS_STMEMSC
	select USE_STDC_LPS22DF
	help
	  Enable driver for LPS22DF I2C-based pressure and temperature
	  sensor.

if LPS22DF

choice LPS22DF_TRIGGER_MODE
	prompt "Trigger mode"
	default LPS22DF_TRIGGER_GLOBAL_THREAD
	help
	  Specify the type of triggering to be used by the driver.

config LPS22DF_TRIGGER_NONE
	bool "No trigger"

config LPS22DF_TRIGGER_GLOBAL_THREAD
	bool "Use global thread"
	depends on GPIO
	select LPS22DF_TRIGGER

config LPS22DF_TRIGGER_OWN_THREAD
	bool "Use own thread"
	depends on GPIO
	select LPS22DF_TRIGGER

endchoice # LPS22DF_TRIGGER_MODE

config LPS22DF_TRIGGER
	bool

config LPS22DF_THREAD_PRIORITY
	int "Thread priority"
	depends on LPS22DF_TRIGGER_OWN_THREAD
	default 10
	help
	  Priority of thread used by the driver to handle interrupts.

config LPS22DF_THREAD_STACK_SIZE
	int "Thread stack size"
	depends on LPS22DF_TRIGGER_OWN_THREAD
	default 1024
	help
	  Stack size of thread used by the driver to handle interrupts.

endif # LPS22DF
```

## drivers/sensor/lps22hb/Kconfig
```kconfig
# Copyright (c) 2017 Linaro Limited
# SPDX-License-Identifier: Apache-2.0

menuconfig LPS22HB
	bool "LPS22HB pressure and temperature"
	default y
	depends on DT_HAS_ST_LPS22HB_PRESS_ENABLED
	depends on I2C
	help
	  Enable driver for LPS22HB I2C-based pressure and temperature
	  sensor.

config LPS22HB_SAMPLING_RATE
	int "Output data rate"
	default 25
	depends on LPS22HB
	help
	  Sensor output data rate expressed in samples per second.
	  Data rates supported by the chip are 1, 10, 25, 50, 75.
```

## drivers/sensor/lps22hh/Kconfig
```kconfig
# ST Microelectronics LPS22HH pressure and temperature sensor

# Copyright (c) 2019 STMicroelectronics
# SPDX-License-Identifier: Apache-2.0

menuconfig LPS22HH
	bool "LPS22HH pressure and temperature"
	default y
	depends on DT_HAS_ST_LPS22HH_ENABLED
	depends on I2C || SPI
	select HAS_STMEMSC
	select USE_STDC_LPS22HH
	help
	  Enable driver for LPS22HH I2C-based pressure and temperature
	  sensor.

if LPS22HH

choice LPS22HH_TRIGGER_MODE
	prompt "Trigger mode"
	default LPS22HH_TRIGGER_GLOBAL_THREAD
	help
	  Specify the type of triggering to be used by the driver.

config LPS22HH_TRIGGER_NONE
	bool "No trigger"

config LPS22HH_TRIGGER_GLOBAL_THREAD
	bool "Use global thread"
	depends on GPIO
	select LPS22HH_TRIGGER

config LPS22HH_TRIGGER_OWN_THREAD
	bool "Use own thread"
	depends on GPIO
	select LPS22HH_TRIGGER

endchoice # LPS22HH_TRIGGER_MODE

config LPS22HH_TRIGGER
	bool

config LPS22HH_THREAD_PRIORITY
	int "Thread priority"
	depends on LPS22HH_TRIGGER_OWN_THREAD
	default 10
	help
	  Priority of thread used by the driver to handle interrupts.

config LPS22HH_THREAD_STACK_SIZE
	int "Thread stack size"
	depends on LPS22HH_TRIGGER_OWN_THREAD
	default 1024
	help
	  Stack size of thread used by the driver to handle interrupts.

endif # LPS22HH
```

## drivers/sensor/lps25hb/Kconfig
```kconfig
#
# Copyright (c) 2016 Intel Corporation
#
# SPDX-License-Identifier: Apache-2.0
#

menuconfig LPS25HB
	bool "LPS25HB pressure and temperature"
	depends on I2C && HAS_DTS_I2C
	help
	  Enable driver for LPS25HB I2C-based pressure and temperature
	  sensor.

if LPS25HB

menu "Attributes"

config LPS25HB_SAMPLING_RATE
	int "Output data rate"
	default 25
	help
	  Sensor output data rate expressed in samples per second.
	  Data rates supported by the chip are 1, 7, 13, 25.

endmenu

endif # LPS25HB
```

## drivers/sensor/lps28dfw/Kconfig
```kconfig
# ST Microelectronics LPS28DFW pressure and temperature sensor

# Copyright (c) 2023 STMicroelectronics
# SPDX-License-Identifier: Apache-2.0

menuconfig LPS28DFW
	bool "LPS28DFW pressure and temperature"
	default y
	depends on DT_HAS_ST_LPS28DFW_ENABLED
	select I2C if $(dt_compat_on_bus,$(DT_COMPAT_ST_LPS28DFW),i2c)
	select I3C if $(dt_compat_on_bus,$(DT_COMPAT_ST_LPS28DFW),i3c)
	select HAS_STMEMSC
	select USE_STDC_LPS28DFW
	help
	  Enable driver for LPS28DFW I2C-based pressure and temperature
	  sensor.

if LPS28DFW

choice LPS28DFW_TRIGGER_MODE
	prompt "Trigger mode"
	default LPS28DFW_TRIGGER_GLOBAL_THREAD
	help
	  Specify the type of triggering to be used by the driver.

config LPS28DFW_TRIGGER_NONE
	bool "No trigger"

config LPS28DFW_TRIGGER_GLOBAL_THREAD
	bool "Use global thread"
	depends on GPIO
	select LPS28DFW_TRIGGER

config LPS28DFW_TRIGGER_OWN_THREAD
	bool "Use own thread"
	depends on GPIO
	select LPS28DFW_TRIGGER

endchoice # LPS28DFW_TRIGGER_MODE

config LPS28DFW_TRIGGER
	bool

config LPS28DFW_THREAD_PRIORITY
	int "Thread priority"
	depends on LPS28DFW_TRIGGER_OWN_THREAD
	default 10
	help
	  Priority of thread used by the driver to handle interrupts.

config LPS28DFW_THREAD_STACK_SIZE
	int "Thread stack size"
	depends on LPS28DFW_TRIGGER_OWN_THREAD
	default 1024
	help
	  Stack size of thread used by the driver to handle interrupts.

endif # LPS28DFW
```

## drivers/sensor/lsm303dlhc_accel/Kconfig
```kconfig
# Kconfig - LSM303DLHC Three Axis Accelerometer configuration options

#
# Copyright (c) 2018 Philémon Jaermann
#
# SPDX-License-Identifier: Apache-2.0
#

menuconfig LSM303DLHC_ACCEL
	bool "LSM303DLHC Three Axis Accelerometer"
	depends on I2C
	help
	  Enable driver for LSM303DLHC I2C-based triaxial accelerometer sensor.

config LSM303DLHC_ACCEL_RANGE
	int "Acceleration measurement range"
	depends on LSM303DLHC_ACCEL
	range 0 3
	default 0
	help
	  Selects the acceleration output data rate
	  0: +/-2g
	  1: +/-4g
	  2: +/-8g
	  3: +/-16g

config LSM303DLHC_ACCEL_POWER_MODE
	int "Power mode"
	depends on LSM303DLHC_ACCEL
	range 0 1
	default 0
	help
	  Choose between normal or low power operation mode for chip.
	  0: Normal mode
	  1: Low power mode

config  LSM303DLHC_ACCEL_ODR
	int "Data rate frequency"
	depends on LSM303DLHC_ACCEL
	range 1 9
	default 1
	help
	  Selects the acceleration output data rate
	  1: 1Hz
	  2: 10Hz
	  3: 25Hz
	  4: 50Hz
	  5: 100Hz
	  6: 200Hz
	  7: 400Hz
	  8: 1.62KHz in low power mode only
	  9: 1.344KHz in normal power mode, 5.376 KHz in low power mode
```

## drivers/sensor/lsm303dlhc_magn/Kconfig
```kconfig
# Kconfig - LSM303DLHC Three Axis Magnetometer configuration options

#
# Copyright (c) 2018 Philémon Jaermann
#
# SPDX-License-Identifier: Apache-2.0
#

menuconfig LSM303DLHC_MAGN
	bool "LSM303DLHC Three Axis Magnetometer"
	depends on I2C
	help
	  Enable driver for LSM303DLHC I2C-based triaxial magnetometer sensor.

config LSM303DLHC_MAGN_RANGE
	int "Magnetometer measurement range"
	depends on LSM303DLHC_MAGN
	range 1 7
	default 1
	help
	  1: +/-1.3 gauss
	  2: +/-1.9 gauss
	  3: +/-2.5 gauss
	  4: +/-4 gauss
	  5: +/-4.7 gauss
	  6: +/-5.6 gauss
	  7: +/-8.1 gauss

config LSM303DLHC_MAGN_ODR
	int "Data rate frequency"
	depends on LSM303DLHC_MAGN
	range 0 7
	default 0
	help
	  0: 0.75Hz
	  1: 1.5 Hz
	  2: 3Hz
	  3: 7.5Hz
	  4: 15Hz
	  5: 30Hz
	  6: 75Hz
	  7: 220Hz
```

## drivers/sensor/lsm6ds0/Kconfig
```kconfig
# LSM6DS0 accelerometer and gyroscope sensor configuration
# options

# Copyright (c) 2016 Intel Corporation
# SPDX-License-Identifier: Apache-2.0

menuconfig LSM6DS0
	bool "LSM6DS0 I2C accelerometer and gyroscope Chip"
	depends on I2C
	help
	  Enable driver for LSM6DS0 I2C-based accelerometer and gyroscope
	  sensor.

if LSM6DS0

config LSM6DS0_ACCEL_ENABLE_X_AXIS
	bool "Accelerometer X axis"
	default y
	help
	  Enable/disable accelerometer X axis totally by stripping everything
	  related in driver.

config LSM6DS0_ACCEL_ENABLE_Y_AXIS
	bool "Accelerometer Y axis"
	default y
	help
	  Enable/disable accelerometer Y axis totally by stripping everything
	  related in driver.

config LSM6DS0_ACCEL_ENABLE_Z_AXIS
	bool "Accelerometer Z axis"
	default y
	help
	  Enable/disable accelerometer Z axis totally by stripping everything
	  related in driver.

config LSM6DS0_GYRO_ENABLE_X_AXIS
	bool "Gyroscope X axis"
	default y
	help
	  Enable/disable gyroscope X axis totally by stripping everything
	  related in driver.

config LSM6DS0_GYRO_ENABLE_Y_AXIS
	bool "Gyroscope Y axis"
	default y
	help
	  Enable/disable gyroscope Y axis totally by stripping everything
	  related in driver.

config LSM6DS0_GYRO_ENABLE_Z_AXIS
	bool "Gyroscope Z axis"
	default y
	help
	  Enable/disable gyroscope Z axis totally by stripping everything
	  related in driver.

config LSM6DS0_ENABLE_TEMP
	bool "Temperature"
	help
	  Enable/disable temperature totally by stripping everything related in
	  driver.

menu "Attributes"

config LSM6DS0_GYRO_FULLSCALE
	int "Gyroscope full-scale range"
	default 245
	help
	  Specify the default gyroscope full-scale range.
	  An X value for the config represents a range of +/- X degree per
	  second. Valid values are 245, 500 and 2000.

config LSM6DS0_GYRO_SAMPLING_RATE
	int "Output data rate"
	default 15
	help
	  Specify the default gyroscope output data rate expressed in samples
	  per second (Hz).
	  Data rates supported by the chip are 0, 15, 60, 119, 238, 476,
	  952.

config LSM6DS0_ACCEL_FULLSCALE
	int "Accelerometer full-scale range"
	default 2
	help
	  Specify the default accelerometer full-scale range.
	  An X value for the config represents a range of +/- X G. Valid values
	  are 2, 4, 8 and 16.

config LSM6DS0_ACCEL_SAMPLING_RATE
	int "Output data rate"
	default 10
	help
	  Specify the default accelerometer output data rate expressed in
	  samples per second (Hz).
	  Data rates supported by the chip are 0, 10, 50, 119, 238, 476, 952.

endmenu

endif # LSM6DS0
```

## drivers/sensor/lsm6dsl/Kconfig
```kconfig
# LSM6DSL accelerometer and gyroscope sensor configuration
# options

# Copyright (c) 2017 Linaro Limited
# SPDX-License-Identifier: Apache-2.0

menuconfig LSM6DSL
	bool "LSM6DSL I2C/SPI accelerometer and gyroscope Chip"
	depends on I2C || SPI
	help
	  Enable driver for LSM6DSL accelerometer and gyroscope
	  sensor.

if LSM6DSL

choice LSM6DSL_TRIGGER_MODE
	prompt "Trigger mode"
	help
	  Specify the type of triggering to be used by the driver.

config LSM6DSL_TRIGGER_NONE
	bool "No trigger"

config LSM6DSL_TRIGGER_GLOBAL_THREAD
	bool "Use global thread"
	depends on GPIO
	select LSM6DSL_TRIGGER

config LSM6DSL_TRIGGER_OWN_THREAD
	bool "Use own thread"
	depends on GPIO
	select LSM6DSL_TRIGGER

endchoice

config LSM6DSL_TRIGGER
	bool

config LSM6DSL_THREAD_PRIORITY
	int "Thread priority"
	depends on LSM6DSL_TRIGGER_OWN_THREAD
	default 10
	help
	  Priority of thread used by the driver to handle interrupts.

config LSM6DSL_THREAD_STACK_SIZE
	int "Thread stack size"
	depends on LSM6DSL_TRIGGER_OWN_THREAD
	default 1024
	help
	  Stack size of thread used by the driver to handle interrupts.

config LSM6DSL_ENABLE_TEMP
	bool "Enable temperature"
	help
	  Enable/disable temperature

config LSM6DSL_SENSORHUB
	bool "Enable I2C sensorhub feature"
	help
	  Enable/disable internal sensorhub

choice LSM6DSL_EXTERNAL_SENSOR_0
	prompt "External sensor 0"
	depends on LSM6DSL_SENSORHUB
	help
	  Choose the external sensor 0 connected to LSM6DS3.

config LSM6DSL_EXT0_LIS2MDL
	bool "LIS2MDL"

config LSM6DSL_EXT0_LPS22HB
	bool "LPS22HB"

endchoice

menu "Attributes"

config LSM6DSL_GYRO_FS
	int "Gyroscope full-scale range"
	default 0
	help
	  Specify the default gyroscope full-scale range.
	  An X value for the config represents a range of +/- X degree per
	  second. Valid values are:
	  0:  Full Scale selected at runtime
	  125:   +/- 125dps
	  245:   +/- 245dps
	  500:   +/- 500dps
	  1000:  +/- 1000dps
	  2000:  +/- 2000dps

config LSM6DSL_GYRO_ODR
	int "Gyroscope Output data rate frequency"
	range 0 10
	default 0
	help
	  Specify the default accelerometer output data rate expressed in
	  samples per second (Hz).
	  0: ODR selected at runtime
	  1: 12.5Hz
	  2: 26Hz
	  3: 52Hz
	  4: 104Hz
	  5: 208Hz
	  6: 416Hz
	  7: 833Hz
	  8: 1660Hz
	  9: 3330Hz
	  10: 6660Hz

config LSM6DSL_ACCEL_FS
	int "Accelerometer full-scale range"
	default 0
	help
	  Specify the default accelerometer full-scale range.
	  An X value for the config represents a range of +/- X G. Valid values
	  are:
	  0:  Full Scale selected at runtime
	  2:  +/- 2g
	  4:  +/- 4g
	  8:  +/- 8g
	  16: +/- 16g

config LSM6DSL_ACCEL_ODR
	int "Accelerometer Output data rate frequency"
	range 0 10
	default 0
	help
	  Specify the default accelerometer output data rate expressed in
	  samples per second (Hz).
	  0: ODR selected at runtime
	  1: 12.5Hz
	  2: 26Hz
	  3: 52Hz
	  4: 104Hz
	  5: 208Hz
	  6: 416Hz
	  7: 833Hz
	  8: 1660Hz
	  9: 3330Hz
	  10: 6660Hz
endmenu

endif # LSM6DSL
```
