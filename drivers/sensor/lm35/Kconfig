## drivers/sensor/lsm6dso/Kconfig
```kconfig
# ST Microelectronics LSM6DSO 6-axis IMU sensor driver

# Copyright (c) 2019 STMicroelectronics
# SPDX-License-Identifier: Apache-2.0

menuconfig LSM6DSO
	bool "LSM6DSO I2C/SPI accelerometer and gyroscope Chip"
	default y
	depends on DT_HAS_ST_LSM6DSO_ENABLED
	depends on I2C || SPI
	select HAS_STMEMSC
	select USE_STDC_LSM6DSO
	help
	  Enable driver for LSM6DSO accelerometer and gyroscope
	  sensor.

if LSM6DSO

choice LSM6DSO_TRIGGER_MODE
	prompt "Trigger mode"
	help
	  Specify the type of triggering to be used by the driver.

config LSM6DSO_TRIGGER_NONE
	bool "No trigger"

config LSM6DSO_TRIGGER_GLOBAL_THREAD
	bool "Use global thread"
	depends on GPIO
	select LSM6DSO_TRIGGER

config LSM6DSO_TRIGGER_OWN_THREAD
	bool "Use own thread"
	depends on GPIO
	select LSM6DSO_TRIGGER

endchoice

config LSM6DSO_TRIGGER
	bool

if LSM6DSO_TRIGGER

config LSM6DSO_THREAD_PRIORITY
	int "Thread priority"
	depends on LSM6DSO_TRIGGER_OWN_THREAD
	default 10
	help
	  Priority of thread used by the driver to handle interrupts.

config LSM6DSO_THREAD_STACK_SIZE
	int "Thread stack size"
	depends on LSM6DSO_TRIGGER_OWN_THREAD
	default 1024
	help
	  Stack size of thread used by the driver to handle interrupts.

endif # LSM6DSO_TRIGGER

config LSM6DSO_ENABLE_TEMP
	bool "Temperature"
	help
	  Enable/disable temperature

config LSM6DSO_SENSORHUB
	bool "I2C sensorhub feature"
	help
	  Enable/disable internal sensorhub. You can enable
	  a maximum of two external sensors (if more than two are enabled
	  the system would enumerate only the first two found)

if LSM6DSO_SENSORHUB

config LSM6DSO_EXT_LIS2MDL
	bool "LIS2MDL as external sensor"
	default y

config LSM6DSO_EXT_LPS22HH
	bool "LPS22HH as external sensor"
	default y

config LSM6DSO_EXT_HTS221
	bool "HTS221 as external sensor"

config LSM6DSO_EXT_LPS22HB
	bool "LPS22HB as external sensor"

endif # LSM6DSO_SENSORHUB

endif # LSM6DSO
```

## drivers/sensor/lsm6dso16is/Kconfig
```kconfig
# ST Microelectronics LSM6DSO16IS 6-axis IMU sensor driver

# Copyright (c) 2023 STMicroelectronics
# SPDX-License-Identifier: Apache-2.0

menuconfig LSM6DSO16IS
	bool "LSM6DSO16IS I2C/SPI accelerometer and gyroscope Chip"
	default y
	depends on DT_HAS_ST_LSM6DSO16IS_ENABLED
	depends on ZEPHYR_HAL_ST_MODULE
	select I2C if $(dt_compat_on_bus,$(DT_COMPAT_ST_LSM6DSO16IS),i2c)
	select SPI if $(dt_compat_on_bus,$(DT_COMPAT_ST_LSM6DSO16IS),spi)
	select HAS_STMEMSC
	select USE_STDC_LSM6DSO16IS
	help
	  Enable driver for LSM6DSO16IS accelerometer and gyroscope
	  sensor.

if LSM6DSO16IS

choice LSM6DSO16IS_TRIGGER_MODE
	prompt "Trigger mode"
	help
	  Specify the type of triggering to be used by the driver.

config LSM6DSO16IS_TRIGGER_NONE
	bool "No trigger"

config LSM6DSO16IS_TRIGGER_GLOBAL_THREAD
	bool "Use global thread"
	depends on GPIO
	select LSM6DSO16IS_TRIGGER

config LSM6DSO16IS_TRIGGER_OWN_THREAD
	bool "Use own thread"
	depends on GPIO
	select LSM6DSO16IS_TRIGGER

endchoice

config LSM6DSO16IS_TRIGGER
	bool

if LSM6DSO16IS_TRIGGER

config LSM6DSO16IS_THREAD_PRIORITY
	int "Thread priority"
	depends on LSM6DSO16IS_TRIGGER_OWN_THREAD
	default 10
	help
	  Priority of thread used by the driver to handle interrupts.

config LSM6DSO16IS_THREAD_STACK_SIZE
	int "Thread stack size"
	depends on LSM6DSO16IS_TRIGGER_OWN_THREAD
	default 1024
	help
	  Stack size of thread used by the driver to handle interrupts.

endif # LSM6DSO16IS_TRIGGER

config LSM6DSO16IS_ENABLE_TEMP
	bool "Temperature"
	help
	  Enable/disable temperature

config LSM6DSO16IS_SENSORHUB
	bool "I2C sensorhub feature"
	help
	  Enable/disable internal sensorhub. You can enable
	  a maximum of two external sensors (if more than two are enabled
	  the system would enumerate only the first two found)

if LSM6DSO16IS_SENSORHUB

config LSM6DSO16IS_EXT_LIS2MDL
	bool "LIS2MDL as external sensor"
	default y

config LSM6DSO16IS_EXT_LPS22HH
	bool "LPS22HH as external sensor"

config LSM6DSO16IS_EXT_HTS221
	bool "HTS221 as external sensor"

config LSM6DSO16IS_EXT_LPS22HB
	bool "LPS22HB as external sensor"

config LSM6DSO16IS_EXT_LPS22DF
	bool "LPS22DF as external sensor"
	default y

endif # LSM6DSO16IS_SENSORHUB

endif # LSM6DSO16IS
```

## drivers/sensor/lsm6dsr/Kconfig
```kconfig
# LSM6DSR accelerometer and gyroscope sensor configuration
# options

# Copyright (c) 2019 STMicroelectronics
# SPDX-License-Identifier: Apache-2.0

menuconfig LSM6DSR
	bool "LSM6DSR I2C/SPI accelerometer and gyroscope Chip"
	default y
	depends on DT_HAS_ST_LSM6DSR_ENABLED
	select I2C if $(dt_compat_on_bus,$(DT_COMPAT_ST_LSM6DSR),i2c)
	select SPI if $(dt_compat_on_bus,$(DT_COMPAT_ST_LSM6DSR),spi)
	select HAS_STMEMSC
	select USE_STDC_LSM6DSR
	help
	  Enable driver for LSM6DSR accelerometer and gyroscope
	  sensor.

if LSM6DSR

choice LSM6DSR_TRIGGER_MODE
	prompt "Trigger mode"
	help
	  Specify the type of triggering to be used by the driver.

config LSM6DSR_TRIGGER_NONE
	bool "No trigger"

config LSM6DSR_TRIGGER_GLOBAL_THREAD
	bool "Use global thread"
	depends on GPIO
	select LSM6DSR_TRIGGER

config LSM6DSR_TRIGGER_OWN_THREAD
	bool "Use own thread"
	depends on GPIO
	select LSM6DSR_TRIGGER

endchoice

config LSM6DSR_TRIGGER
	bool

if LSM6DSR_TRIGGER

config LSM6DSR_THREAD_PRIORITY
	int "Thread priority"
	depends on LSM6DSR_TRIGGER_OWN_THREAD
	default 10
	help
	  Priority of thread used by the driver to handle interrupts.

config LSM6DSR_THREAD_STACK_SIZE
	int "Thread stack size"
	depends on LSM6DSR_TRIGGER_OWN_THREAD
	default 1024
	help
	  Stack size of thread used by the driver to handle interrupts.

endif # LSM6DSR_TRIGGER

config LSM6DSR_ENABLE_TEMP
	bool "Temperature"
	help
	  Enable/disable temperature

endif # LSM6DSR
```

## drivers/sensor/lsm9ds0_gyro/Kconfig
```kconfig
# Kconfig - LSM9DS0 gyroscope sensor configuration options

#
# Copyright (c) 2016 Intel Corporation
#
# SPDX-License-Identifier: Apache-2.0
#

menuconfig LSM9DS0_GYRO
	bool "LSM9DS0 I2C gyroscope Chip"
	depends on I2C
	default n
	help
	  Enable driver for LSM9DS0 I2C-based gyroscope sensor.

config LSM9DS0_GYRO_DEV_NAME
	string "LSM9DS0_GYRO device name"
	depends on LSM9DS0_GYRO
	default "lsm9ds0_gyro"

config LSM9DS0_GYRO_I2C_ADDR
	hex
	prompt "LSM9DS0_GYRO I2C slave address"
	default 0x6A
	depends on LSM9DS0_GYRO
	help
	  Specify the I2C slave address for the LSM9DS0_GYRO.

	  0x6A: GND
	  0x6B: VCC

config LSM9DS0_GYRO_I2C_MASTER_DEV_NAME
	string "I2C master where LSM9DS0 gyroscope is connected"
	depends on LSM9DS0_GYRO
	default "I2C_0"
	help
	  Specify the device name of the I2C master device to which LSM9DS0_GYRO
	  is connected.

menu "Attributes"
	depends on LSM9DS0_GYRO

choice
	prompt "Default full-scale"
	default LSM9DS0_GYRO_FULLSCALE_245
	depends on LSM9DS0_GYRO
	help
	  Specify the default full-scale.

config LSM9DS0_GYRO_FULLSCALE_245
	bool
	prompt "245 DPS"

config LSM9DS0_GYRO_FULLSCALE_500
	bool
	prompt "500 DPS"

config LSM9DS0_GYRO_FULLSCALE_2000
	bool
	prompt "2000 DPS"

endchoice

config LSM9DS0_GYRO_FULLSCALE_RUNTIME
	bool "Enable dynamic full-scale"
	depends on LSM9DS0_GYRO
	default n
	help
	  Enable alteration of full-scale attribute at runtime.

choice
	prompt "Default sampling rate frequency"
	default LSM9DS0_GYRO_SAMPLING_RATE_95
	depends on LSM9DS0_GYRO
	help
	  Specify the default sampling rate frequency.

config LSM9DS0_GYRO_SAMPLING_RATE_95
	bool
	prompt "95 Hz"

config LSM9DS0_GYRO_SAMPLING_RATE_190
	bool
	prompt "190 Hz"

config LSM9DS0_GYRO_SAMPLING_RATE_380
	bool
	prompt "380 Hz"

config LSM9DS0_GYRO_SAMPLING_RATE_760
	bool
	prompt "760 Hz"

endchoice

config LSM9DS0_GYRO_SAMPLING_RATE_RUNTIME
	bool "Enable dynamic sampling rate"
	depends on LSM9DS0_GYRO
	default n
	help
	  Enable alteration of sampling rate frequency at runtime.

endmenu

config LSM9DS0_GYRO_TRIGGERS
	bool "Enable triggers"
	depends on LSM9DS0_GYRO && GPIO
	default n

config LSM9DS0_GYRO_THREAD_STACK_SIZE
	int "Thread stack size"
	depends on LSM9DS0_GYRO_TRIGGERS
	default 1024
	help
	  Specify the internal thread stack size.

config LSM9DS0_GYRO_TRIGGER_DRDY
	bool "Enable data ready trigger"
	depends on LSM9DS0_GYRO_TRIGGERS
	default n

config LSM9DS0_GYRO_GPIO_DRDY_DEV_NAME
	string "GPIO device where LSM9DS0_GYRO data ready interrupt is connected"
	depends on LSM9DS0_GYRO_TRIGGER_DRDY
	default GPIO_0
	help
	  Specify the device name of the GPIO controller the BMC150_MAGN interrupt
	  is connected to.

config LSM9DS0_GYRO_GPIO_DRDY_INT_PIN
	int
	default 3
	depends on LSM9DS0_GYRO_TRIGGER_DRDY
	prompt "GPIO pin number for the data ready interrupt pin"
```

## drivers/sensor/lsm9ds0_mfd/Kconfig
```kconfig
# Kconfig - LSM9DS0 accelerometer, magnetometer and temperature
# configuration options

#
# Copyright (c) 2016 Intel Corporation
#
# SPDX-License-Identifier: Apache-2.0
#

menuconfig LSM9DS0_MFD
	bool "LSM9DS0 I2C accelerometer, magnetometer and temperature sensor chip"
	depends on (I2C && HAS_DTS_I2C)
	help
	  Enable driver for LSM9DS0 I2C-based MFD sensor.

if LSM9DS0_MFD

config LSM9DS0_MFD_ACCEL_ENABLE
	bool "Enable accelerometer"
	default y
	help
	  Enable/disable accelerometer totally by stripping everything related
	  in driver.

config LSM9DS0_MFD_MAGN_ENABLE
	bool "Enable magnetometer"
	default y
	help
	  Enable/disable magnetometer totally by stripping everything related in
	  driver.

config LSM9DS0_MFD_TEMP_ENABLE
	bool "Enable temperature sensor"
	help
	  Enable/disable temperature sensor totally by stripping everything
	  related in driver.

menu "Attributes"

choice
	prompt "Accelerometer sampling rate"
	default LSM9DS0_MFD_ACCEL_SAMPLING_RATE_25
	depends on LSM9DS0_MFD_ACCEL_ENABLE
	help
	  Specify the default sampling rate frequency for accelerometer.

config LSM9DS0_MFD_ACCEL_SAMPLING_RATE_0
	bool "0 Hz (power down)"

config LSM9DS0_MFD_ACCEL_SAMPLING_RATE_3_125
	bool "3.125 Hz"

config LSM9DS0_MFD_ACCEL_SAMPLING_RATE_6_25
	bool "6.25 Hz"

config LSM9DS0_MFD_ACCEL_SAMPLING_RATE_12_5
	bool "12.5 Hz"

config LSM9DS0_MFD_ACCEL_SAMPLING_RATE_25
	bool "25 Hz"

config LSM9DS0_MFD_ACCEL_SAMPLING_RATE_50
	bool "50 Hz"

config LSM9DS0_MFD_ACCEL_SAMPLING_RATE_100
	bool "100 Hz"

config LSM9DS0_MFD_ACCEL_SAMPLING_RATE_200
	bool "200 Hz"

config LSM9DS0_MFD_ACCEL_SAMPLING_RATE_400
	bool "400 Hz"

config LSM9DS0_MFD_ACCEL_SAMPLING_RATE_800
	bool "800 Hz"

config LSM9DS0_MFD_ACCEL_SAMPLING_RATE_1600
	bool "1600 Hz"

endchoice

config LSM9DS0_MFD_ACCEL_SAMPLING_RATE_RUNTIME
	bool "Enable dynamic sampling rate for accelerometer"
	depends on LSM9DS0_MFD_ACCEL_ENABLE
	help
	  Enable alteration of accelerometer sampling rate attribute at
	  runtime.

choice
	prompt "Accelerometer full-scale"
	default LSM9DS0_MFD_ACCEL_FULL_SCALE_2
	depends on LSM9DS0_MFD_ACCEL_ENABLE
	help
	  Specify the default full-scale for accelerometer.

config LSM9DS0_MFD_ACCEL_FULL_SCALE_2
	bool "2G"

config LSM9DS0_MFD_ACCEL_FULL_SCALE_4
	bool "4G"

config LSM9DS0_MFD_ACCEL_FULL_SCALE_6
	bool "6G"

config LSM9DS0_MFD_ACCEL_FULL_SCALE_8
	bool "8G"

config LSM9DS0_MFD_ACCEL_FULL_SCALE_16
	bool "16G"

endchoice

config LSM9DS0_MFD_ACCEL_FULL_SCALE_RUNTIME
	bool "Enable dynamic full-scale for accelerometer"
	depends on LSM9DS0_MFD_ACCEL_ENABLE
	help
	  Enable alteration of accelerometer full-scale attribute at
	  runtime.

config LSM9DS0_MFD_ACCEL_ENABLE_X
	bool "Enable accelerometer X axis"
	depends on LSM9DS0_MFD_ACCEL_ENABLE
	default y

config LSM9DS0_MFD_ACCEL_ENABLE_Y
	bool "Enable accelerometer Y axis"
	depends on LSM9DS0_MFD_ACCEL_ENABLE
	default y

config LSM9DS0_MFD_ACCEL_ENABLE_Z
	bool "Enable accelerometer Z axis"
	depends on LSM9DS0_MFD_ACCEL_ENABLE
	default y

choice
	prompt "Magnetometer sampling rate"
	default LSM9DS0_MFD_MAGN_SAMPLING_RATE_25
	depends on LSM9DS0_MFD_MAGN_ENABLE
	help
	  Specify the default sampling rate frequency for magnetometer.

config LSM9DS0_MFD_MAGN_SAMPLING_RATE_3_125
	bool "3.125 Hz"

config LSM9DS0_MFD_MAGN_SAMPLING_RATE_6_25
	bool "6.25 Hz"

config LSM9DS0_MFD_MAGN_SAMPLING_RATE_12_5
	bool "12.5 Hz"

config LSM9DS0_MFD_MAGN_SAMPLING_RATE_25
	bool "25 Hz"

config LSM9DS0_MFD_MAGN_SAMPLING_RATE_50
	bool "50 Hz"

config LSM9DS0_MFD_MAGN_SAMPLING_RATE_100
	bool "100 Hz"

endchoice

config LSM9DS0_MFD_MAGN_SAMPLING_RATE_RUNTIME
	bool "Enable dynamic sampling rate for magnetometer"
	depends on LSM9DS0_MFD_MAGN_ENABLE
	help
	  Enable alteration of magnetometer sampling rate attribute at
	  runtime.

choice
	prompt "Magnetometer full-scale"
	default LSM9DS0_MFD_MAGN_FULL_SCALE_2
	depends on LSM9DS0_MFD_MAGN_ENABLE
	help
	  Specify the default full-scale for magnetometer.

config LSM9DS0_MFD_MAGN_FULL_SCALE_2
	bool "2 Gauss"

config LSM9DS0_MFD_MAGN_FULL_SCALE_4
	bool "4 Gauss"

config LSM9DS0_MFD_MAGN_FULL_SCALE_8
	bool "8 Gauss"

config LSM9DS0_MFD_MAGN_FULL_SCALE_12
	bool "12 Gauss"

endchoice

config LSM9DS0_MFD_MAGN_FULL_SCALE_RUNTIME
	bool "Enable dynamic full-scale for magnetometer"
	depends on LSM9DS0_MFD_MAGN_ENABLE
	help
	  Enable alteration of magnetometer full-scale attribute at
	  runtime.

endmenu

endif # LSM9DS0_MFD
```

## drivers/sensor/lsm9ds1/Kconfig
```kconfig
# Kconfig - LSM9DS1 Six-Axis Motion Tracking device configuration options

#
# Copyright (c) 2016 Intel Corporation
# Copyright (c) 2020 Luca Quaer
#
# SPDX-License-Identifier: Apache-2.0
#

menuconfig LSM9DS1
	bool "LSM9DS1 Nine-Axis Motion Tracking Device"
	depends on I2C
	help
	  Enable driver for LSM9DS1 I2C-based six-axis motion tracking device.

if LSM9DS1

config LSM9DS1_GYRO_LOW_POWER
	bool "LSM9DS1 Gyro performance(High / Low)"
	default false
	help
	  GYRO sensor performance(High or Low).
	  default Low.

endif # LSM9DS1
```

## drivers/sensor/ltc4162/Kconfig
```kconfig
# LTC4162 Battery Charger

# Copyright (c) 2021 Linumiz
# SPDX-License-Identifier: Apache-2.0

config LTC4162
	bool "LTC4163 battery charger"
	depends on I2C
	help
	  Enable driver for LTC4162 I2C based charger
```

## drivers/sensor/ltr329/Kconfig
```kconfig
# Lite-On LTR-329 light sensor driver configuration

# Copyright (c) 2023 Konrad Sikora
# SPDX-License-Identifier: Apache-2.0

config LTR329
	bool "LTR329 Ambient light sensor support"
	default y
	depends on DT_HAS_LTR_329_ENABLED
	select I2C
	help
	  Enable driver for Lite-On LTR-329 ambient light sensor.
```

## drivers/sensor/ltr329als01/Kconfig
```kconfig
#
# Copyright (c) 2018 Vaishali Pathak vaishali@electronut.in
#
#
# SPDX-License-Identifier: Apache-2.0
#

config LTR329ALS01
	bool "LTR329ALS01 Digital Ambient Light Sensor"
	depends on (I2C && HAS_DTS_I2C)
	help
	  Enable I2C-based driver for LTR329ALS01 light sensor.
```

## drivers/sensor/ltr390/Kconfig
```kconfig
# LTR390 temperature sensor configuration options

# Copyright (c) 2022 Luke Holt
# SPDX-License-Identifier: Apache-2.0

DT_COMPAT_LITEON_LTR390 := liteon,ltr390

menuconfig LTR390
	bool "Liteon LTR390 I2C ambient light sensor and ultraviolet light sensor"
	default y
	depends on DT_HAS_LITEON_LTR390_ENABLED
	select I2C
	help
	  Enable I2C driver for Liteon LTR390 ambient light sensor and ultraviolet light sensor.

if LTR390

choice
	prompt "LTR390 trigger mode"
	default LTR390_TRIGGER_NONE

config LTR390_TRIGGER_NONE
	bool "No trigger"

config LTR390_TRIGGER_GLOBAL_THREAD
	depends on GPIO
	select LTR390_TRIGGER
	bool "Use global thread"

config LTR390_TRIGGER_OWN_THREAD
	depends on GPIO
	select LTR390_TRIGGER
	bool "Use own thread"

endchoice

config LTR390_TRIGGER
	bool

config LTR390_THREAD_STACK_SIZE
	int "Sensor delayed work thread stack size"
	depends on LTR390_TRIGGER_OWN_THREAD
	default 1024

config LTR390_THREAD_PRIORITY
	int "LTR390 thread priority"
	depends on LTR390_TRIGGER_OWN_THREAD
	default 10

endif # LTR390
```

## drivers/sensor/magntek/Kconfig
```kconfig
# Copyright (c) 2024 Vinicius Miguel
# SPDX-License-Identifier: Apache-2.0

# zephyr-keep-sorted-start
source "drivers/sensor/magntek/magntek_mt6701/Kconfig"
# zephyr-keep-sorted-stop
```
