## drivers/sensor/at581x/Kconfig
```kconfig
# Copyright (c) 2026 NotioNext Ltd.
# SPDX-License-Identifier: Apache-2.0

# AT581X Radar Sensor configuration

config AT581X
	bool "AT581X radar sensor"
	default y
	depends on DT_HAS_ANDAR_AT581X_ENABLED
	depends on I2C
	help
	  Enable driver for AT581X radar sensor.

	  This sensor uses I2C to communicate with the host processor.

if AT581X

choice AT581X_TRIGGER_MODE
	prompt "Trigger mode"
	default AT581X_TRIGGER_GLOBAL_THREAD
	help
	  Specify the type of triggering to be used by the driver.

config AT581X_TRIGGER_NONE
	bool "No trigger"

config AT581X_TRIGGER_GLOBAL_THREAD
	bool "Use global thread"
	depends on GPIO
	select AT581X_TRIGGER

config AT581X_TRIGGER_OWN_THREAD
	bool "Use own thread"
	depends on GPIO
	select AT581X_TRIGGER

endchoice

config AT581X_TRIGGER
	bool

config AT581X_THREAD_PRIORITY
	int "Thread priority"
	depends on AT581X_TRIGGER_OWN_THREAD
	default 10
	help
	  Priority of thread used by the driver to handle interrupts.

config AT581X_THREAD_STACK_SIZE
	int "Thread stack size"
	depends on AT581X_TRIGGER_OWN_THREAD
	default 1024
	help
	  Stack size of thread used by the driver to handle interrupts.

endif # AT581X
```
