## drivers/sensor/am2320/Kconfig
```kconfig
#
# Copyright (c) 2017 Tidy Jiang <tidyjiang@163.com>
#
# SPDX-License-Identifier: Apache-2.0
#

menuconfig AM2320
	bool
	prompt "AM2320 temperature and humidity sensor"
	depends on SENSOR && I2C
	default n
	help
	  Enable driver for AM2320 I2C-based temperature and humidity sensor.

config AM2320_NAME
	string
	prompt "Driver name"
	default "AM2320"
	depends on AM2320
	help
	  Device name with which the AM2320 sensor is identified.

config AM2320_I2C_MASTER_DEV_NAME
	string
	prompt "I2C master where AM2320 is connected"
	depends on AM2320
	default "I2C_0"
	help
	  Specify the device name of the I2C master device to which AM2320 is
	  connected.
```

## drivers/sensor/amd/Kconfig
```kconfig
# Copyright (c) 2026 Advanced Micro Devices, Inc. (AMD)
# SPDX-License-Identifier: Apache-2.0

config VERSAL_SYSMON
	bool "AMD/Xilinx Versal SysMon driver"
	default y
	depends on DT_HAS_XLNX_VERSAL_SYSMON_ENABLED
	help
	  Enable AMD/Xilinx Versal System Monitor (SysMon) driver.
	  This driver provides access to on-chip voltage and
	  temperature monitoring using the Zephyr sensor subsystem.
```

## drivers/sensor/amd_sb_tsi/Kconfig
```kconfig
# SB-TSI configuration options

# Copyright (c) 2023 Google LLC
# SPDX-License-Identifier: Apache-2.0

config AMD_SB_TSI
	bool "AMD SB Temperature Sensor Interface"
	default y
	depends on DT_HAS_AMD_SB_TSI_ENABLED
	select I2C
	help
	  Enable the driver for SB Temperature Sensor Interface. This
	  is an I2C temperature sensor on AMD SoCs.

config EMUL_AMD_SB_TSI
	bool "Emulator for AMD SB-TSI"
	default y
	depends on AMD_SB_TSI
	depends on EMUL
	help
	  Enable the hardware emulator for the AMD SB-TSI.
```

## drivers/sensor/amg88xx/Kconfig
```kconfig
# AMG88XX infrared thermopile sensor configuration options

# Copyright (c) 2017 Phytec Messtechnik GmbH
# SPDX-License-Identifier: Apache-2.0

menuconfig AMG88XX
	bool "AMG88XX Infrared Thermopile Sensor"
	default y
	depends on DT_HAS_PANASONIC_AMG88XX_ENABLED
	select I2C
	help
	  Enable driver for AMG88XX infrared thermopile sensor.

if AMG88XX

choice
	prompt "Trigger mode"
	default AMG88XX_TRIGGER_NONE
	help
	  Specify the type of triggering used by the driver.

config AMG88XX_TRIGGER_NONE
	bool "No trigger"

config AMG88XX_TRIGGER_GLOBAL_THREAD
	bool "Use global thread"
	depends on GPIO
	depends on $(dt_compat_any_has_prop,$(DT_COMPAT_PANASONIC_AMG88XX),int-gpios)
	select AMG88XX_TRIGGER

config AMG88XX_TRIGGER_OWN_THREAD
	bool "Use own thread"
	depends on GPIO
	depends on $(dt_compat_any_has_prop,$(DT_COMPAT_PANASONIC_AMG88XX),int-gpios)
	select AMG88XX_TRIGGER

endchoice

config AMG88XX_TRIGGER
	bool

config AMG88XX_THREAD_PRIORITY
	int "Thread priority"
	depends on AMG88XX_TRIGGER_OWN_THREAD
	default 10
	help
	  Priority of thread used by the driver to handle interrupts.

config AMG88XX_THREAD_STACK_SIZE
	int "Thread stack size"
	depends on AMG88XX_TRIGGER_OWN_THREAD
	default 1024
	help
	  Stack size of thread used by the driver to handle interrupts.

endif # AMG88XX
```

## drivers/sensor/ams/Kconfig
```kconfig
# Copyright (c) 2024 Analog Devices, Inc.
# SPDX-License-Identifier: Apache-2.0

# zephyr-keep-sorted-start
source "drivers/sensor/ams/ams_as5600/Kconfig"
source "drivers/sensor/ams/ams_iAQcore/Kconfig"
source "drivers/sensor/ams/ccs811/Kconfig"
source "drivers/sensor/ams/ens210/Kconfig"
source "drivers/sensor/ams/tcs3400/Kconfig"
source "drivers/sensor/ams/tmd2620/Kconfig"
source "drivers/sensor/ams/tsl2540/Kconfig"
source "drivers/sensor/ams/tsl2561/Kconfig"
source "drivers/sensor/ams/tsl2591/Kconfig"
# zephyr-keep-sorted-stop
```

## drivers/sensor/ams/ams_as5048/Kconfig
```kconfig
# AS5048 Angular position sensor configuration option

# Copyright (c) 2025, Felipe Neves.
# SPDX-License-Identifier: Apache-2.0

config AMS_AS5048
	bool "AMS AS5048 magnetic angle sensor"
	default y
	depends on DT_HAS_AMS_AS5048_ENABLED
	select SPI
	help
	  Enable driver for the AMS AS5048 magnetic rotary encoder. The driver
	  supports reading the absolute angle via the SPI interface.
```

## drivers/sensor/ams/ams_as5600/Kconfig
```kconfig
# AS5600 Angular position sensor configuration option

# Copyright (c) 2022, Felipe Neves.
# SPDX-License-Identifier: Apache-2.0

config AMS_AS5600
	bool "AS5600 Angular position sensor"
	default y
	depends on DT_HAS_AMS_AS5600_ENABLED
	select I2C
	help
	  Enable driver for AS5600 Angular position sensor.
```

## drivers/sensor/ams/ens210/Kconfig
```kconfig
# ENS210 Digital Temperature and Humidity sensor configuration options

# Copyright (c) 2018 Alexander Wachter.
# SPDX-License-Identifier: Apache-2.0

menuconfig ENS210
	bool "ENS210 Digital Temperature and Humidity sensor"
	default y
	depends on DT_HAS_AMS_ENS210_ENABLED
	select I2C
	help
	  Enable driver for ENS210 Digital Temperature and Humidity sensor.
if ENS210

choice
	prompt "Temperature measurement mode"
	default ENS210_TEMPERATURE_CONTINUOUS
	help
	  Enable/disable temperature measurements and set measurement mode.
config ENS210_TEMPERATURE_OFF
	bool "Disable temperature measurements"
config ENS210_TEMPERATURE_SINGLE
	bool "Temperature measurements in single shot mode"
config ENS210_TEMPERATURE_CONTINUOUS
	bool "Temperature measurements in continuous mode"
endchoice

choice
	prompt "Humidity measurement mode"
	default ENS210_HUMIDITY_CONTINUOUS
	help
	  Enable/disable relative humidity measurements and set measurement mode.
config ENS210_HUMIDITY_OFF
	bool "Disable relative humidity measurements"
config ENS210_HUMIDITY_SINGLE
	bool "Relative humidity measurements in single shot mode"
config ENS210_HUMIDITY_CONTINUOUS
	bool "Relative humidity measurements in continuous mode"
endchoice

config ENS210_CRC_CHECK
	bool "CRC Check"
	default y
	help
	  Check the crc value after data reading.

config ENS210_MAX_STAT_RETRIES
	int "Number of status read retries"
	default 4
	help
	  Number of retries when status reading failed or device not ready.

config ENS210_MAX_READ_RETRIES
	int "Number of value reading retries"
	default 4
	help
	  Number of retries when value reading failed, value not valid
	  or crc not ok.

endif # ENS210
```

## drivers/sensor/ams/tcs3400/Kconfig
```kconfig
# Copyright 2023 Google LLC
# SPDX-License-Identifier: Apache-2.0

config TCS3400
	bool "TCS3400 Sensor"
	default y
	depends on DT_HAS_AMS_TCS3400_ENABLED
	select I2C
	help
	  Enable driver for TCS3400 sensors.
```

## drivers/sensor/ams/tmd2620/Kconfig
```kconfig
# Copyright (c) 2023 PHYTEC Messtechnik GmbH
# SPDX-License-Identifier: Apache-2.0

menuconfig TMD2620
	bool "OSRAM-AMS TMD2620 Proxmimity Sensor"
	default y
	depends on DT_HAS_AMS_TMD2620_ENABLED
	select I2C
	help
	  Enable driver for TMD2620 Sensor

if TMD2620

choice
	prompt "Trigger Mode"
	default TMD2620_TRIGGER_NONE
	help
	  Specify the type of triggering to be used by the driver.

config TMD2620_TRIGGER_NONE
	bool "No Trigger"

config TMD2620_TRIGGER_GLOBAL_THREAD
	bool "Use global thread"
	depends on GPIO
	depends on $(dt_compat_any_has_prop,$(DT_COMPAT_AMS_TMD2620),int-gpios)
	select TMD2620_TRIGGER

endchoice # Trigger Mode

config TMD2620_TRIGGER
	bool

endif # TMD2620
```

## drivers/sensor/ams/tsl2540/Kconfig
```kconfig
# TSL2540 Ambient Light Sensor configuration options

# Copyright (c) 2022 T-Mobile USA, Inc.
# SPDX-License-Identifier: Apache-2.0

menuconfig TSL2540
	bool "TSL2540 Ambient Light Sensor"
	default y
	depends on DT_HAS_AMS_TSL2540_ENABLED
	select I2C
	help
	  Enable driver for TSL2540 sensors.

if TSL2540

config TSL2540_TRIGGER
	bool

choice
	prompt "Trigger mode"
	default TSL2540_TRIGGER_NONE
	help
	  Specify the type of triggering to be used by the driver.

config TSL2540_TRIGGER_NONE
	bool "No trigger"

config TSL2540_TRIGGER_GLOBAL_THREAD
	bool "Use global thread"
	depends on GPIO
	depends on $(dt_compat_any_has_prop,$(DT_COMPAT_AMS_TSL2540),int-gpios)
	select TSL2540_TRIGGER

config TSL2540_TRIGGER_OWN_THREAD
	bool "Use own thread"
	depends on GPIO
	depends on $(dt_compat_any_has_prop,$(DT_COMPAT_AMS_TSL2540),int-gpios)
	select TSL2540_TRIGGER

endchoice

config TSL2540_THREAD_PRIORITY
	int "Thread priority"
	depends on TSL2540_TRIGGER_OWN_THREAD
	default 10
	help
	  Priority of thread used by the driver to handle interrupts.

config TSL2540_THREAD_STACK_SIZE
	int "Thread stack size"
	depends on TSL2540_TRIGGER_OWN_THREAD
	default 1024
	help
	  Stack size of thread used by the driver to handle interrupts.

endif # TSL2540
```

## drivers/sensor/ams/tsl2561/Kconfig
```kconfig
# Copyright (c) 2023 Gustavo Silva
# SPDX-License-Identifier: Apache-2.0

config TSL2561
	bool "OSRAM-AMS TSL2561 light sensor"
	default y
	depends on DT_HAS_AMS_TSL2561_ENABLED
	select I2C
	help
	  Enable driver for TSL2561 sensor.
```

## drivers/sensor/ams/tsl2591/Kconfig
```kconfig
# Copyright (c) 2023 Kurtis Dinelle
# SPDX-License-Identifier: Apache-2.0

menuconfig TSL2591
	bool "OSRAM-AMS TSL2591 light sensor"
	default y
	depends on DT_HAS_AMS_TSL2591_ENABLED
	select I2C
	help
	  Enable driver for TSL2591 sensor.

if TSL2591
config TSL2591_FETCH_WAIT
	bool "Wait for valid sensor reading before fetch"
	help
	  If set, the driver will automatically wait for the duration of an integration cycle
	  during a fetch call if necessary.

config TSL2591_WARN_SATURATED
	bool "Warn if sensor is potentially saturated"
	help
	  If set, the driver will warn if the sensor ADC is
	  potentially saturated after a data fetch.

config TSL2591_TRIGGER
	bool

choice
	prompt "Trigger mode"
	default TSL2591_TRIGGER_NONE
	help
	  Specify the type of triggering to be used by the driver.

config TSL2591_TRIGGER_NONE
	bool "No trigger"

config TSL2591_TRIGGER_GLOBAL_THREAD
	bool "Use global thread"
	depends on GPIO
	select TSL2591_TRIGGER

config TSL2591_TRIGGER_OWN_THREAD
	bool "Use own thread"
	depends on GPIO
	select TSL2591_TRIGGER

endchoice

config TSL2591_THREAD_PRIORITY
	int "Thread priority"
	depends on TSL2591_TRIGGER_OWN_THREAD
	default 10
	help
	  Priority of thread used by the driver to handle interrupts.

config TSL2591_THREAD_STACK_SIZE
	int "Thread stack size"
	depends on TSL2591_TRIGGER_OWN_THREAD
	default 1024
	help
	  Stack size of thread used by the driver to handle interrupts.

endif # TSL2591
```

## drivers/sensor/ams5915/Kconfig
```kconfig
# AMS5915 pressure and temperature sensor configuration options

# Copyright (c) 2024 BoRob Engineering
#
# SPDX-License-Identifier: Apache-2.0

config AMS5915
	bool "AMS5915 I2C-based pressure and temperature sensor"
	default y
	depends on DT_HAS_ANALOGMICRO_AMS5915_ENABLED
	select I2C
	help
	  Enable driver for AMS5915 I2C-based pressure and temperature sensor.
```

## drivers/sensor/ams_iAQcore/Kconfig
```kconfig
# iAQ-core Digital VOC sensor configuration options

# Copyright (c) 2018 Alexander Wachter
# SPDX-License-Identifier: Apache-2.0

menuconfig AMS_IAQ_CORE
	bool "iAQ-core Digital VOC sensor"
	default y
	depends on DT_HAS_AMS_IAQCORE_ENABLED
	select I2C
	help
	  Enable driver for iAQ-core Digital VOC sensor.

config IAQ_CORE_MAX_READ_RETRIES
	int "Number of read retries"
	default 4
	depends on AMS_IAQ_CORE
	help
	  Number of retries when reading failed or device not ready.
```

## drivers/sensor/aosong/Kconfig
```kconfig
# Copyright (c) 2024 Analog Devices, Inc.
# SPDX-License-Identifier: Apache-2.0

# zephyr-keep-sorted-start
source "drivers/sensor/aosong/ags10/Kconfig"
source "drivers/sensor/aosong/dht/Kconfig"
source "drivers/sensor/aosong/dht20/Kconfig"
# zephyr-keep-sorted-stop
```

## drivers/sensor/aosong/dht/Kconfig
```kconfig
# DHT Temperature and Humidity Sensor configuration options

# Copyright (c) 2016 Intel Corporation
# SPDX-License-Identifier: Apache-2.0

menuconfig DHT
	bool "DHT Temperature and Humidity Sensor"
	default y
	depends on DT_HAS_AOSONG_DHT_ENABLED
	depends on GPIO
	help
	  Enable driver for the DHT temperature and humidity sensor family.

if DHT

config DHT_LOCK_IRQS
	bool "Lock IRQs for sensor measurement"
	help
	  Locks IRQs when taking sensor readings, this greatly improves the chances of getting a
	  reading successfully from the sensor at the cost of delayed interrupt servicing (e.g.
	  Bluetooth). Note that other systems might need to be adjusted to account for this.

endif # DHT
```

## drivers/sensor/apds9253/Kconfig
```kconfig
# Copyright(c) 2017 Intel Corporation
# Copyright(c) 2018 Phytec Messtechnik GmbH
# SPDX-License-Identifier: Apache-2.0

config APDS9253
	bool "APDS9253 Sensor"
	default y
	depends on DT_HAS_AVAGO_APDS9253_ENABLED
	select I2C
	help
	  Enable driver for APDS9253 sensors.
```

## drivers/sensor/apds9306/Kconfig
```kconfig
# SPDX-License-Identifier: Apache-2.0
# Copyright (c) 2024 Daniel Kampert
# Author: Daniel Kampert <DanielKampert@Kampis-Elektroecke.de>

config APDS9306
	bool "APDS9306 Sensor"
	default y
	depends on DT_HAS_AVAGO_APDS9306_ENABLED
	select I2C
	help
	  Enable the driver for the APDS9306 digital light sensor.
```

## drivers/sensor/apds9960/Kconfig
```kconfig
# Copyright (c) 2017 Intel Corporation
# Copyright (c) 2018 Phytec Messtechnik GmbH
# SPDX-License-Identifier: Apache-2.0

menuconfig APDS9960
	bool "APDS9960 Sensor"
	default y
	depends on DT_HAS_AVAGO_APDS9960_ENABLED
	select I2C
	help
	  Enable driver for APDS9960 sensors.

if APDS9960

choice
	prompt "Trigger mode"
	default APDS9960_TRIGGER_NONE
	help
	  Specify the type of triggering used by the driver.

config APDS9960_TRIGGER_NONE
	bool "No trigger"

config APDS9960_TRIGGER_GLOBAL_THREAD
	bool "Use global thread"
	depends on GPIO
	depends on $(dt_compat_any_has_prop,$(DT_COMPAT_AVAGO_APDS9960),int-gpios)
	select APDS9960_TRIGGER

endchoice

config APDS9960_TRIGGER
	bool

choice APDS9960_FETCH_MODE
	prompt "Fetching Mode"
	default APDS9960_FETCH_MODE_INTERRUPT
	help
	  Specify whether to wait for interrupt

config APDS9960_FETCH_MODE_POLL
	bool "Poll without interrupt pin"
	help
	  Uses I2C to check sample

config APDS9960_FETCH_MODE_INTERRUPT
	bool "Wait for interrupt"
	depends on GPIO
	depends on $(dt_compat_any_has_prop,$(DT_COMPAT_AVAGO_APDS9960),int-gpios)
	help
	  Wait for interrupt before reading

endchoice

config APDS9960_ENABLE_ALS
	bool "Ambient Light Sense"
	default y
	help
	  Enable Ambient Light Sense (ALS).

config APDS9960_ENABLE_GESTURE
	bool "Gesture Sense"
	default n
	help
	  Enable Gesture Sense.

endif # APDS9960
```

## drivers/sensor/as5601/Kconfig
```kconfig
# ...

menuconfig AS5601
	bool "AS5601 magnetic rotary position sensor"
	depends on I2C
	help
	  Enable driver for AS5601, I2C-based, magnetic rotary
	  position sensor.

config AS5601_STEPS_PER_ROTATION
	int "Steps count per rotation"
	default 16
	depends on AS5601
	help
	  Steps count, per rotation, of the quadrature encoder signal.
```

## drivers/sensor/as5x47/Kconfig
```kconfig
# AMS AS5x47 rotary position sensor

menuconfig AS5X47
    bool "AMS AS5x47 rotary position sensor"
    depends on SPI
    help
        Enable AMS AS5x47 rotary position sensor driver
```

## drivers/sensor/asahi_kasei/Kconfig
```kconfig
# Copyright (c) 2024 Analog Devices, Inc.
# SPDX-License-Identifier: Apache-2.0

# zephyr-keep-sorted-start
source "drivers/sensor/asahi_kasei/ak8975/Kconfig"
source "drivers/sensor/asahi_kasei/akm09918c/Kconfig"
# zephyr-keep-sorted-stop
```

## drivers/sensor/asahi_kasei/akm09918c/Kconfig
```kconfig
# Copyright (c) 2023 Google LLC
# Copyright (c) 2024 Croxel Inc.
# SPDX-License-Identifier: Apache-2.0

config AKM09918C
	bool "AKM09918C Magnetometer"
	default y
	depends on DT_HAS_ASAHI_KASEI_AKM09918C_ENABLED
	select I2C
	select I2C_RTIO if SENSOR_ASYNC_API
	select RTIO_WORKQ if SENSOR_ASYNC_API
	help
	  Enable driver for AK8975 magnetometer.

config EMUL_AKM09918C
	bool "Emulator for AKM09918C"
	default y
	depends on AKM09918C
	depends on EMUL
	help
	  Enable the hardware emulator for the AKM09918C. Doing so allows exercising
	  sensor APIs for this magnetometer in native_sim and qemu.
```
