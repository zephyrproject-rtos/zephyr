## drivers/sensor/ccs811/Kconfig
```kconfig
# CCS811 Digital Gas sensor configuration options

# Copyright (c) 2018 Linaro Ltd.
# Copyright (c) 2018 Peter Bigot Consulting, LLC
#
# SPDX-License-Identifier: Apache-2.0

menuconfig CCS811
	bool "CCS811 Digital Gas Sensor"
	default y
	depends on DT_HAS_AMS_CCS811_ENABLED
	select I2C
	help
	  Enable driver for CCS811 Gas sensors.

if CCS811

choice CCS811_DRIVE_MODE
	prompt "Measurement drive mode"
	default CCS811_DRIVE_MODE_1
	help
	  Specifies the measurement rate used by the driver.

config CCS811_DRIVE_MODE_0
	bool "Measurements disabled"

config CCS811_DRIVE_MODE_1
	bool "Measurement every second"

config CCS811_DRIVE_MODE_2
	bool "Measurement every ten seconds"

config CCS811_DRIVE_MODE_3
	bool "Measurement every sixty seconds"

config CCS811_DRIVE_MODE_4
	bool "Measurement every 250 milliseconds"

endchoice

config CCS811_TRIGGER
	bool

choice
	prompt "Trigger mode"
	default CCS811_TRIGGER_NONE
	help
	  Specify the type of triggering to be used by the driver.

config CCS811_TRIGGER_NONE
	bool "No trigger"

config CCS811_TRIGGER_GLOBAL_THREAD
	bool "Use global thread"
	depends on GPIO
	select CCS811_TRIGGER

config CCS811_TRIGGER_OWN_THREAD
	bool "Use own thread"
	depends on GPIO
	select CCS811_TRIGGER

endchoice

config CCS811_THREAD_PRIORITY
	int "Thread priority"
	depends on CCS811_TRIGGER_OWN_THREAD
	default 10
	help
	  Priority of thread used by the driver to handle interrupts.

config CCS811_THREAD_STACK_SIZE
	int "Thread stack size"
	depends on CCS811_TRIGGER_OWN_THREAD
	default 1024
	help
	  Stack size of thread used by the driver to handle interrupts.

endif # CCS811
```

## drivers/sensor/cht8315/Kconfig
```kconfig
# Copyright (c) 2026 MASSDRIVER EI
# SPDX-License-Identifier: Apache-2.0

config CHT8315
	bool "Sensylink CHT8315 Temperature and Humidity Sensor"
	default y
	depends on DT_HAS_SENSYLINK_CHT8315_ENABLED
	select I2C
	help
	  Enable driver for Sensylink CHT8315 Temperature and Humidity Sensor.

config CHT8315_TRIGGER
	bool "Sensylink CHT8315 Trigger"
	default y
	depends on GPIO
	depends on $(dt_compat_any_has_prop,$(DT_COMPAT_SENSYLINK_CHT8315),alert-gpios)
	help
	  Enable interrupt based trigger support for CHT8315.
	  Requires that the sensor to not be set to one shot mode.
```

## drivers/sensor/chx01/Kconfig
```kconfig
# Copyright (c) 2023 Google LLC
# SPDX-License-Identifier: Apache-2.0

config CHX01
	bool
	default y if CH101 || CH201

config CH101
	bool "TDK CH101 chirp ToF device"
	default y
	depends on DT_HAS_INVENSENSE_CH101_ENABLED
	select I2C
	help
	  Enable driver for the TDK I2C based chirp ToF device CH101. By default
	  this device will be loaded with the "general purpose range finding"
	  firmware provided by TDK. Other functionality can be configured via
	  devicetree or at runtime.

config CH201
	bool "TDK CH201 chirp ToF device"
	default y
	depends on DT_HAS_INVENSENSE_CH201_ENABLED
	select I2C
	help
	  Enable driver for the TDK I2C based chirp ToF device CH201. By default
	  this device will be loaded with the "general purpose range finding"
	  firmware provided by TDK. Other functionality can be configured via
	  devicetree or at runtime.

config CHX01_MAX_PROG_XFER_SIZE
	int "Maximum bust program transfer size"
	default 0
	depends on CHX01
	help
	  Forces the firmware upload to use smaller bursts. Use 0 to disable,
	  otherwise set to the number of bytes.

if CH101

config CH101_GPR_FW
	bool "Include the GPR (general purpose range-finding) firmware"
	default y
	help
	  Include the binary for common range finding. This firmware is provided
	  by TDK.

config CH101_GPR_SR_FW
	bool "Include the GPR short range firmware"
	help
	  Include the binary for a short range version of the GPR. This firmware
	  is provided by TDK.

endif # CH101

if CHX01

config CHX01_VERBOSE_DEBUGGING
	bool "Print verbose debugging messages"
	help
	  Add extra logging messages intended to help debugging the chirp sensors.

endif # CHX01
```

## drivers/sensor/current_amp/Kconfig
```kconfig
# Current sense amplifier driver
#
# Copyright (c) 2023 FTP Technologies
#
# SPDX-License-Identifier: Apache-2.0

config CURRENT_AMP
	bool "Current sense amplifier driver"
	default y
	depends on DT_HAS_CURRENT_SENSE_AMPLIFIER_ENABLED
	select ADC
	help
	  Enable current sense amplifier driver.

config CURRENT_AMP_HIGH_RANGE
	bool "Support voltages outside +-32V"
	depends on CURRENT_AMP
	help
	  Support handling voltages outside +-32V at the
	  cost of reducing the output resolution to milliamps
	  instead of microamps.
```

## drivers/sensor/dht/Kconfig
```kconfig
# DHT Temperature and Humidity Sensor configuration options

# Copyright (c) 2016 Intel Corporation
# SPDX-License-Identifier: Apache-2.0

config DHT
	bool "DHT Temperature and Humidity Sensor"
	default y
	depends on DT_HAS_AOSONG_DHT_ENABLED
	depends on GPIO
	help
	  Enable driver for the DHT temperature and humidity sensor family.
```

## drivers/sensor/dht20/Kconfig
```kconfig
# AOSONG DHT20 temperature and humidity sensor configuration options
# This driver can also be used for AHT20 or AM2301B which seem to be the same sensor

# Copyright (c) 2024 Nathan Olff
# SPDX-License-Identifier: Apache-2.0

config DHT20
	bool "DHT20 / AHT20 / AM2301B Temperature and Humidity Sensor"
	default y
	depends on DT_HAS_AOSONG_DHT20_ENABLED \
		|| DT_HAS_AOSONG_AHT20_ENABLED \
		|| DT_HAS_AOSONG_AM2301B_ENABLED
	select I2C
	help
	  Enable driver for DHT20 / AHT20 / AM2301B temperature and humidity sensors.

if DHT20

config DHT20_CRC
	bool "Use CRC error detection"
	default n
	select CRC
	help
	  Verify CRC byte in RX data

endif # DHT20
```

## drivers/sensor/dps310/Kconfig
```kconfig
# DPS310 temperature and pressure sensor configuration options

# Copyright (c) 2019 Infineon Technologies AG
# SPDX-License-Identifier: Apache-2.0

menuconfig DPS310
	bool "DPS310 sensor"
	default y
	depends on DT_HAS_INFINEON_DPS310_ENABLED
	select I2C
	help
	  Enable driver for DPS310 I2C-based temperature and pressure sensor.

if DPS310

menu "Attributes"

choice
	prompt "DPS310 temperature oversampling"
	default DPS310_TEMP_OSR_8X
	help
	  Select temperature oversampling for the DPS310 sensor.  Higher values
	  lead to more accurate readings, but higher power consumption.
config DPS310_TEMP_OSR_1X
	bool "x1"
config DPS310_TEMP_OSR_2X
	bool "x2"
config DPS310_TEMP_OSR_4X
	bool "x4"
config DPS310_TEMP_OSR_8X
	bool "x8"
config DPS310_TEMP_OSR_16X
	bool "x16"
config DPS310_TEMP_OSR_32X
	bool "x32"
config DPS310_TEMP_OSR_64X
	bool "x64"
config DPS310_TEMP_OSR_128X
	bool "x128"
endchoice

choice
	prompt "DPS310 pressure oversampling"
	default DPS310_PRESS_OSR_8X
	help
	  Select pressure oversampling for the DPS310 sensor.  Higher values
	  lead to more accurate readings, but higher power consumption.
config DPS310_PRESS_OSR_1X
	bool "x1"
config DPS310_PRESS_OSR_2X
	bool "x2"
config DPS310_PRESS_OSR_4X
	bool "x4"
config DPS310_PRESS_OSR_8X
	bool "x8"
config DPS310_PRESS_OSR_16X
	bool "x16"
config DPS310_PRESS_OSR_32X
	bool "x32"
config DPS310_PRESS_OSR_64X
	bool "x64"
config DPS310_PRESS_OSR_128X
	bool "x128"
endchoice

endmenu

endif # DPS310
```

## drivers/sensor/ds18b20/Kconfig
```kconfig
# DS18B20 temperature and humidity sensor configuration options

# Copyright (c) 2022 Thomas Stranger
# SPDX-License-Identifier: Apache-2.0

config DS18B20
	bool "DS18B20 Temperature Sensor"
	default y
	depends on DT_HAS_MAXIM_DS18B20_ENABLED
	depends on W1_NET
	help
	  Enable driver for DS18B20 1-Wire temperature sensors.
```

## drivers/sensor/dti/Kconfig
```kconfig
# Copyright (c) 2024 Rapid Silicon.
# SPDX-License-Identifier: Apache-2.0

menuconfig DTI_PVT
    bool "DTI Process, Voltage and Thermal Sensor Configuration"
    default n
    depends on SENSOR
    depends on DT_HAS_DTI_PVT_ENABLED

    menu "PVT Timing Configuration Register Values"
        depends on DTI_PVT

        config DTI_PVT_RST_TREG_TIMEOUT
            hex "Enter Timeout Value"
            default 0x80
                help
                    This is the timeout value for process monitor

        config DTI_PVT_RST_TREG_EN
            hex "Enter the Enable Time value"
            default 0x14
                help
                    Enable time before starting the monitor/sensor, RoundUp(100ns * CLK)

        config DTI_PVT_RST_TREG_MSTEP
            hex "Enter the measurement time value"
            default 0x6
                help
                    Measuring time, RoundUp(30ns * CLK)
              
    endmenu

    menu "PVT config register"        
        depends on DTI_PVT

        config DTI_PVT_RST_CONF_TRIM
            hex "Enter the resistor adjustment value"
            default 0x6
                help
                    Resistor value adjustment for post silicon to calibrate to simualtion results

        config DTI_PVT_RST_CONF_VMRANGE
            int "Enter to select VM Range"
            range 0 1
            default 0
                help
                    Voltage Monitor Range. Enter 1 for VM range to monitor
                    the voltage between 0 - 2 volts. And Enter 0 for VM range
                    of 0 - 1 volts.

    endmenu

    menu "VM and TS Process Corner Values"
        depends on DTI_PVT

        config DTI_PVT_VM_PROCESS_CORNER
            int "Enter a value between 2,3 and 4"
            default 4
                help
                  Voltage sensor LUT index based on process corner
                    DTI_PVT_VM_FF_1_98 = 2
                    DTI_PVT_VM_ss_1_62 = 3
                    DTI_PVT_VM_TT_1_80 = 4      

        config DTI_PVT_TS_PROCESS_CORNER
            int "Enter a value between 1 to 6"
            default 6
                help
                  Temperature sensor LUT index based on process corner
                    DTI_PVT_TS_FF_1_62 = 1
                    DTI_PVT_TS_FF_1_98 = 2
                    DTI_PVT_TS_SS_1_62 = 3
                    DTI_PVT_TS_SS_1_98 = 4
                    DTI_PVT_TS_TT_1_62 = 5
                    DTI_PVT_TS_TT_1_98 = 6       

    endmenu

module = DTI_PVT
module-str = dti_pvt
source "subsys/logging/Kconfig.template.log_config"
```

## drivers/sensor/ene/Kconfig
```kconfig
# Copyright (c) 2026 ENE Technology Inc.
# SPDX-License-Identifier: Apache-2.0

source "drivers/sensor/ene/kb106x/Kconfig"
```

## drivers/sensor/ene/kb106x/Kconfig
```kconfig
# Copyright (c) 2026 ENE Technology Inc.
# SPDX-License-Identifier: Apache-2.0

config TACH_ENE_KB106X
	bool "ENE KB106X tachometer sensor"
	default y
	depends on DT_HAS_ENE_KB106X_TACH_ENABLED
	select PINCTRL
	help
	  Enable the ENE KB106X tachometer sensor.
```

## drivers/sensor/ene_tach_kb1200/Kconfig
```kconfig
# KB1200 tachometer sensor configuration options

# Copyright (c) 2024 ENE Technology Inc.
# SPDX-License-Identifier: Apache-2.0

config TACH_ENE_KB1200
	bool "ENE KB1200 tachometer sensor"
	default y
	depends on DT_HAS_ENE_KB1200_TACH_ENABLED
	select PINCTRL
	help
	  Enable tachometer sensor for ENE KB1200.
```

## drivers/sensor/ens160/Kconfig
```kconfig
# Copyright (c) 2024 Gustavo Silva
# SPDX-License-Identifier: Apache-2.0

menuconfig ENS160
	bool "ENS160 multi-gas sensor"
	default y
	depends on DT_HAS_SCIOSENSE_ENS160_ENABLED
	select I2C if $(dt_compat_on_bus,$(DT_COMPAT_SCIOSENSE_ENS160),i2c)
	select SPI if $(dt_compat_on_bus,$(DT_COMPAT_SCIOSENSE_ENS160),spi)
	help
	  Enable driver for ENS160 Digital Metal Oxide Multi-Gas Sensor.

if ENS160

choice
	prompt "Trigger Mode"
	default ENS160_TRIGGER_NONE
	help
	  Specify the type of triggering to be used by the driver.

config ENS160_TRIGGER_NONE
	bool "No trigger"

config ENS160_TRIGGER_GLOBAL_THREAD
	bool "Use global thread"
	depends on GPIO
	depends on $(dt_compat_any_has_prop,$(DT_COMPAT_SCIOSENSE_ENS160),int-gpios)
	select ENS160_TRIGGER

config ENS160_TRIGGER_OWN_THREAD
	bool "Use own thread"
	depends on GPIO
	depends on $(dt_compat_any_has_prop,$(DT_COMPAT_SCIOSENSE_ENS160),int-gpios)
	select ENS160_TRIGGER

endchoice # Trigger Mode

config ENS160_TRIGGER
	bool

config ENS160_THREAD_PRIORITY
	int "Thread priority"
	depends on ENS160_TRIGGER_OWN_THREAD && ENS160_TRIGGER
	default 10
	help
	  Priority of thread used by the driver to handle interrupts.

config ENS160_THREAD_STACK_SIZE
	int "Thread stack size"
	depends on ENS160_TRIGGER_OWN_THREAD && ENS160_TRIGGER
	default 1024
	help
	  Stack size of thread used by the driver to handle interrupts.

endif # ENS160
```

## drivers/sensor/ens210/Kconfig
```kconfig
# ENS210 Digital Temperature and Humidity sensor configuration options

# Copyright (c) 2018 Alexander Wachter.
# SPDX-License-Identifier: Apache-2.0

menuconfig ENS210
	bool "ENS210 Digital Temperature and Humidity sensor"
	depends on I2C
	help
	  Enable driver for ENS210 Digital Temperature and Humidity sensor.
if ENS210

choice
	prompt "Temperature measurement mode"
	default ENS210_TEMPERATURE_CONTINUOUS
	help
	  Enable/disable temperature measurements and set measurement mode.
config ENS210_TEMPERATURE_OFF
	bool "Disable temperature measurements"
config ENS210_TEMPERATURE_SINGLE
	bool "Enable temperature measurements in single shot mode"
config ENS210_TEMPERATURE_CONTINUOUS
	bool "Enable temperature measurements in continuous mode"
endchoice

choice
	prompt "Humidity measurement mode"
	default ENS210_HUMIDITY_CONTINUOUS
	help
	  Enable/disable relative humidity measurements and set measurement mode.
config ENS210_HUMIDITY_OFF
	bool "Disable relative humidity measurements"
config ENS210_HUMIDITY_SINGLE
	bool "Enable relative humidity measurements in single shot mode"
config ENS210_HUMIDITY_CONTINUOUS
	bool "Enable relative humidity measurements in continuous mode"
endchoice

config ENS210_CRC_CHECK
	bool "Enable CRC Check"
	default y
	help
	  Check the crc value after data reading.

config ENS210_MAX_STAT_RETRIES
	int "Number of status read retries"
	default 4
	help
	  Number of retries when status reading failed or device not ready.

config ENS210_MAX_READ_RETRIES
	int "Number of value reading retries"
	default 4
	help
	  Number of retries when value reading failed, value not valid
	  or crc not ok.

endif # ENS210
```

## drivers/sensor/esp32_temp/Kconfig
```kconfig
# Copyright (c) 2022 Espressif Systems (Shanghai) Co., Ltd.
# SPDX-License-Identifier: Apache-2.0

config ESP32_TEMP
	bool "ESP32 Temperature Sensor"
	default y
	depends on DT_HAS_ESPRESSIF_ESP32_TEMP_ENABLED
	depends on !SOC_SERIES_ESP32
	select ESP32_HAL_USE_TEMP_SENSOR
	help
	  Enable driver for temperature sensor on certain ESP targets.
```

## drivers/sensor/espressif/Kconfig
```kconfig
# Copyright (c) 2024 Analog Devices, Inc.
# SPDX-License-Identifier: Apache-2.0

# zephyr-keep-sorted-start
source "drivers/sensor/espressif/esp32_temp/Kconfig"
source "drivers/sensor/espressif/pcnt_esp32/Kconfig"
# zephyr-keep-sorted-stop
```

## drivers/sensor/espressif/esp32_temp/Kconfig
```kconfig
# Copyright (c) 2022 Espressif Systems (Shanghai) Co., Ltd.
# SPDX-License-Identifier: Apache-2.0

config ESP32_TEMP
	bool "ESP32 Temperature Sensor"
	default y
	depends on DT_HAS_ESPRESSIF_ESP32_TEMP_ENABLED
	depends on !SOC_SERIES_ESP32
	help
	  Enable driver for temperature sensor on certain ESP targets.
```

## drivers/sensor/espressif/pcnt_esp32/Kconfig
```kconfig
# ESP32 Pulse Counter configuration

# Copyright (c) 2022 Espressif Systems (Shanghai) Co., Ltd.
# SPDX-License-Identifier: Apache-2.0

config PCNT_ESP32
	bool "ESP32 Pulse Counter driver"
	default y
	depends on DT_HAS_ESPRESSIF_ESP32_PCNT_ENABLED
	help
	  This option enables the PCNT driver for ESP32 family of
	  processors.

config PCNT_ESP32_TRIGGER
	bool "Trigger support"
	depends on PCNT_ESP32
	default y
	help
	  Enable trigger support for the PCNT.
```

## drivers/sensor/everlight/Kconfig
```kconfig
# Copyright (c) 2025 Dipak Shetty <shetty.dipak@gmx.com>
# SPDX-License-Identifier: Apache-2.0

# zephyr-keep-sorted-start
source "drivers/sensor/everlight/als_pt19/Kconfig"
# zephyr-keep-sorted-stop
```
