## drivers/sensor/everlight/als_pt19/Kconfig
```kconfig
# Copyright (c) 2025 Dipak Shetty <shetty.dipak@gmx.com>
# SPDX-License-Identifier: Apache-2.0

config EVERLIGHT_ALS_PT19
	bool "Everlight ALS-PT19 Ambient Light Sensor"
	default y
	depends on DT_HAS_EVERLIGHT_ALS_PT19_ENABLED
	select ADC
	help
	  Enable support for the Everlight ALS-PT19 ambient light sensor.
```

## drivers/sensor/explorir_m/Kconfig
```kconfig
# ExplorIR-M CO2 sensor configuration options

# Copyright (c) 2023, Vitrolife A/S
# SPDX-License-Identifier: Apache-2.0

config EXPLORIR_M
	bool "ExplorIR-M CO2 Sensor"
	default y
	depends on DT_HAS_GSS_EXPLORIR_M_ENABLED
	depends on UART_INTERRUPT_DRIVEN
	select UART
	help
	  Enable driver for ExplorIR-M CO2 Sensor.
```

## drivers/sensor/f75303/Kconfig
```kconfig
# F75303 temperature sensor configuration options

# Copyright (c) 2023 Google LLC
# SPDX-License-Identifier: Apache-2.0

config F75303
	bool "F75303 Temperature Sensor"
	default y
	depends on DT_HAS_FINTEK_F75303_ENABLED
	select I2C
	help
	  Enable the driver for Fintek F75303 Temperature Sensor.
	  This device has three temperature channels - one local (on-chip),
	  and two remote.

config EMUL_F75303
	bool "Emulator for F75303"
	default y
	depends on F75303
	depends on EMUL
	help
	  Enable the hardware emulator for F75303 Temperature Sensor.
```

## drivers/sensor/fcx_mldx5/Kconfig
```kconfig
# FCX-MLDx5 O2 sensor configuration options

# Copyright (c) 2024, Vitrolife A/S
# SPDX-License-Identifier: Apache-2.0

config FCX_MLDX5
	bool "FCX-MLDx5 O2 Sensor"
	default y
	depends on DT_HAS_AP_FCX_MLDX5_ENABLED
	depends on UART_INTERRUPT_DRIVEN
	select UART
	help
	  Enable driver for FCX-MLD25 or FCX-MLD95 O2 Sensor.
```

## drivers/sensor/fdc2x1x/Kconfig
```kconfig
# FDC2X1X Capacitance-to-Digital Converter configuration options

# Copyright (c) 2020 arithmetics.io
# SPDX-License-Identifier: Apache-2.0

menuconfig FDC2X1X
	bool "FDC2X1X Capacitance-to-Digital Converter"
	default y
	depends on DT_HAS_TI_FDC2X1X_ENABLED
	depends on I2C && NEWLIB_LIBC
	help
	  Enable driver for FDC2X1X Capacitance-to-Digital Converter.

if FDC2X1X

choice
	prompt "Trigger mode"
	default FDC2X1X_TRIGGER_NONE
	help
	  Specify the type of triggering used by the driver.

config FDC2X1X_TRIGGER_NONE
	bool "No trigger"

config FDC2X1X_TRIGGER_GLOBAL_THREAD
	bool "Use global thread"
	depends on GPIO
	select FDC2X1X_TRIGGER

config FDC2X1X_TRIGGER_OWN_THREAD
	bool "Use own thread"
	depends on GPIO
	select FDC2X1X_TRIGGER

endchoice

config FDC2X1X_TRIGGER
	bool

config FDC2X1X_THREAD_PRIORITY
	int "Thread priority"
	depends on FDC2X1X_TRIGGER_OWN_THREAD && FDC2X1X_TRIGGER
	default 10
	help
	  Priority of thread used by the driver to handle interrupts.

config FDC2X1X_THREAD_STACK_SIZE
	int "Thread stack size"
	depends on FDC2X1X_TRIGGER_OWN_THREAD && FDC2X1X_TRIGGER
	default 1024
	help
	  Stack size of thread used by the driver to handle interrupts.

endif # FDC2X1X
```

## drivers/sensor/flow_meter/Kconfig
```kconfig
# Flow meter sensor driver configuration
# Copyright (c) 2026 Nicolas Belin <nbelin@baylibre.com>
# SPDX-License-Identifier: Apache-2.0

config FLOW_METER
	bool "Hall-effect flow meter driver"
	default y
	depends on DT_HAS_ZEPHYR_FLOW_METER_ENABLED
	depends on GPIO
	help
	  Enable driver for Hall-effect pulse-output flow meters.
	  Provides flow rate and cumulative volume channels.
```
