## drivers/sensor/sensirion/sdp3x/Kconfig
```kconfig
# SDP3X temperature and differential pressure sensor configuration options

# Copyright (c) 2024 Yann Gaillard
# SPDX-License-Identifier: Apache-2.0

menuconfig SDP3X
	bool "SDP3x"
	default y
	depends on DT_HAS_SENSIRION_SDP3X_ENABLED
	select I2C
	select CRC
	help
	  Enable driver for SDP3x temperature and differential pressure sensors.

if SDP3X

choice SDP3X_MEASUREMENT_MODE
	prompt "Measurement mode"
	default SDP3X_PERIODIC_MODE

config SDP3X_SINGLE_SHOT_MODE
	bool "single shot"

config SDP3X_PERIODIC_MODE
	bool "periodic data acquisition"

endchoice

endif
```

## drivers/sensor/sensirion/sen6x/Kconfig
```kconfig
# Copyright 2025 sevenlab engineering GmbH
# SPDX-License-Identifier: Apache-2.0

menuconfig SEN6X
	bool "SEN6x environmental sensor"
	default y
	depends on DT_HAS_SENSIRION_SEN6X_ENABLED
	select CRC
	select I2C
	select I2C_RTIO
	select SENSOR_ASYNC_API
	help
	  Enable driver for SEN6x environmental sensor.

	  The sensor does not have an interrupt pin, but it's status registers
	  are being made available through other means:
	  - Every time data is read, the driver checks if the data has actually
	    changed. This information can be retrieved using the decoders
	    has_trigger API with the SENSOR_TRIG_DATA_READY trigger.
	  - You can register a status callback with the driver to get notified
	    about sensor errors. If any callbacks are registered, the status
	    register is read and callbacks are triggered on every call to the
	    sensors submit function.
	    The driver allows submitting a read with 0 channels, to poll just
	    the status.

if SEN6X

config SEN6X_SHELL
	bool "SEN6x shell"
	depends on SHELL

endif # SEN6X
```

## drivers/sensor/sensirion/sps30/Kconfig
```kconfig
# Copyright (c) 2026 Shi Weizhi
# SPDX-License-Identifier: Apache-2.0

config SPS30
	bool "SPS30 Particulate Matter Sensor"
	default y
	depends on DT_HAS_SENSIRION_SPS30_ENABLED
	select I2C
	select CRC
	help
	  Enable driver for the Sensirion SPS30 particulate matter sensor.
```

## drivers/sensor/sensirion/stc31/Kconfig
```kconfig
# STC31 CO2 sensor configuration options

# Copyright (c) 2026 RAKwireless Technology Limited
# SPDX-License-Identifier: Apache-2.0

config STC31
	bool "Sensirion STC31 CO2 Sensor"
	default y
	depends on DT_HAS_SENSIRION_STC31_ENABLED
	select I2C
	select CRC
	help
	  Enable driver for the Sensirion STC31 thermal conductivity
	  carbon dioxide sensor.
```

## drivers/sensor/sensirion/stcc4/Kconfig
```kconfig
# Copyright The Zephyr Project Contributors
# SPDX-License-Identifier: Apache-2.0

config STCC4
	bool "STCC4 CO2 Sensor"
	default y
	depends on DT_HAS_SENSIRION_STCC4_ENABLED
	select I2C
	select CRC
	help
	  Enable driver for the Sensirion STCC4 CO2 sensor based on
	  thermal conductivity. Provides CO2, temperature, and humidity.
```

## drivers/sensor/sensirion/sts4x/Kconfig
```kconfig
# Drivers configuration options for Sensirion STS4x

# Copyright (c) 2024 Jan Fäh
# SPDX-License-Identifier: Apache-2.0

config STS4X
	bool "STS4x Temperature Sensor"
	default y
	depends on DT_HAS_SENSIRION_STS4X_ENABLED
	select I2C
	select CRC
	help
	  Enable driver for the Sensirion STS4x temperature sensors.
```

## drivers/sensor/sensor_sim_async/Kconfig
```kconfig
# Sensor data simulator

# Copyright (c) 2025 COGNID Telematik GmbH
# SPDX-License-Identifier: Apache-2.0

DT_COMPAT_SENSOR_SIM_ASYNC := zephyr,sensor-sim-async

config SENSOR_SIM_ASYNC
	bool "Simple sensor simulator with Async API"
	default y if $(dt_compat_enabled,$(DT_COMPAT_SENSOR_SIM_ASYNC))
	select RING_BUFFER
	select SENSOR_ASYNC_API
	help
	  Enable the sensor simulator.

if SENSOR_SIM_ASYNC

config SENSOR_SIM_ASYNC_SCALE
	int "Internal scaling of the values"
	default 1024
	help
	  Sensor values are internally saved as 16-bit integers with 1 LSB = 1 / SENSOR_SIM_ASYNC_SCALE.
	  Default value is 1024 as it allows for a range of +/- 32 and a ~0.001 accuracy, which is a good compromise for
	  sensors like accelerometers.

endif
```

## drivers/sensor/sgp30/Kconfig
```kconfig
menuconfig SGP30
    bool "SGP30 VOC sensor"
    help
      Enable the Sensirion SGP30 sensor

if SGP30

comment "SGP30 Options"

config SGP30_ABSOLUTE_HUMIDITY_COMP
    bool "SGP30 Humdity compensation"
    help
      Enable absolute humidity compensation in the SGP30
      driver. This will require the user of this device to
      this value using sensor_attr_set().

endif
```

## drivers/sensor/sgp40/Kconfig
```kconfig
# SGP40 multipixel gas sensor configuration options

# Copyright (c) 2021 Leonard Pollak
# SPDX-License-Identifier: Apache-2.0

config SGP40
	bool "SGP40 Multipixel Gas Sensor"
	default y
	depends on DT_HAS_SENSIRION_SGP40_ENABLED
	select I2C
	help
	  Enable driver for SGP40 Multipixel Gas Sensor.
```

## drivers/sensor/sht21/Kconfig
```kconfig
# Copyright (c) 2020 Philémon Jaermann
#
# SPDX-License-Identifier: Apache-2.0

menuconfig SHT21
	bool "SHT21 Humidity sensor"
	depends on I2C && HAS_DTS_I2C
	help
	  Enable driver for SHT21 I2C-based Humidity sensor.
	  This driver also support the HTU21D and the SI7021
	  clones.

if SHT21

choice SHT21_MEAS_RES
	prompt "Measurement resolution"
	default SHT21_MEAS_RES_RH_12_BITS
	help
	  Specify the desired measurement resolution.

config SHT21_MEAS_RES_RH_8_BITS
	bool "8 bits RH, 12 bits temperature"

config SHT21_MEAS_RES_RH_10_BITS
	bool "10 bits RH, 13 bits temperature"

config SHT21_MEAS_RES_RH_11_BITS
	bool "11 bits RH, 11 bits temperature"

config SHT21_MEAS_RES_RH_12_BITS
	bool "12 bits RH, 14 bits temperature"

endchoice # SHT21_MEASUREMENT_RESOLUTION

config SHT21_ENABLE_HEATER
	bool "Enable on chip heater"

config SHT21_ENABLE_OTP_RELOAD
	bool "Enable OTP reload"

if SHT21_ENABLE_HEATER

config SI7021_HEATER_CURRENT
	int "Heater current settings"
	range 0 15
	default 0
	help
	  Set the current consumption of the on chip heater, influencing
	  the heating power.
	  This setting is only available on the Si7021 sensor. Refer to
	  the Si7021 datasheet for actual current consumption.

endif # SHT21_ENABLE_HEATER

endif # SHT21
```

## drivers/sensor/sht2x/Kconfig
```kconfig
# SHT2x temperature and humidity sensor configuration options

# Copyright (c) 2024 Amarula Solutions B.V.
# SPDX-License-Identifier: Apache-2.0

config SHT2X
	bool "SHT2x Temperature and Humidity Sensor"
	depends on DT_HAS_SENSIRION_SHT2X_ENABLED
	select I2C
	select CRC
	help
	  Enable driver for SHT2x temperature and humidity sensors.
```

## drivers/sensor/sht3xd/Kconfig
```kconfig
# SHT3xD temperature and humidity sensor configuration options

# Copyright (c) 2016 Intel Corporation
# SPDX-License-Identifier: Apache-2.0

menuconfig SHT3XD
	bool "SHT3xD Temperature and Humidity Sensor"
	default y
	depends on DT_HAS_SENSIRION_SHT3XD_ENABLED
	select I2C
	help
	  Enable driver for SHT3xD temperature and humidity sensors.

if SHT3XD

choice SHT3XD_TRIGGER_MODE
	prompt "Trigger mode"
	default SHT3XD_TRIGGER_NONE
	help
	  Specify the type of triggering to be used by the driver.

config SHT3XD_TRIGGER_NONE
	bool "No trigger"

config SHT3XD_TRIGGER_GLOBAL_THREAD
	bool "Use global thread"
	depends on GPIO
	select SHT3XD_TRIGGER

config SHT3XD_TRIGGER_OWN_THREAD
	bool "Use own thread"
	depends on GPIO
	select SHT3XD_TRIGGER

endchoice

config SHT3XD_TRIGGER
	bool

config SHT3XD_THREAD_PRIORITY
	int "Thread priority"
	depends on SHT3XD_TRIGGER_OWN_THREAD
	default 10
	help
	  Priority of thread used by the driver to handle interrupts.

config SHT3XD_THREAD_STACK_SIZE
	int "Thread stack size"
	depends on SHT3XD_TRIGGER_OWN_THREAD
	default 1024
	help
	  Stack size of thread used by the driver to handle interrupts.

choice SHT3XD_REPEATABILITY
	prompt "Measurement repeatability"
	default SHT3XD_REPEATABILITY_HIGH
	help
	  Repeatability modes differ with respect to measurement duration,
	  noise level and energy consumption.

config SHT3XD_REPEATABILITY_LOW
	bool "low"

config SHT3XD_REPEATABILITY_MEDIUM
	bool "medium"

config SHT3XD_REPEATABILITY_HIGH
	bool "high"

endchoice

choice SHT3XD_MEASUREMENT_MODE
	prompt "Measurement mode"
	default SHT3XD_PERIODIC_MODE

config SHT3XD_SINGLE_SHOT_MODE
	bool "single shot"

config SHT3XD_PERIODIC_MODE
	bool "periodic data acquisition"

endchoice

choice SHT3XD_MPS
	prompt "Measurements per second"
	default SHT3XD_MPS_1
	depends on SHT3XD_PERIODIC_MODE
	help
	  Number of measurements per second.

config SHT3XD_MPS_05
	bool "0.5"

config SHT3XD_MPS_1
	bool "1"

config SHT3XD_MPS_2
	bool "2"

config SHT3XD_MPS_4
	bool "4"

config SHT3XD_MPS_10
	bool "10"

endchoice

endif # SHT3XD
```

## drivers/sensor/sht4x/Kconfig
```kconfig
# SHT4x temperature and humidity sensor configuration options

# Copyright (c) 2021 Leonard Pollak
# SPDX-License-Identifier: Apache-2.0

config SHT4X
	bool "SHT4x Temperature and Humidity Sensor"
	default y
	depends on DT_HAS_SENSIRION_SHT4X_ENABLED
	select I2C
	help
	  Enable driver for SHT4x temperature and humidity sensors.
```

## drivers/sensor/shtcx/Kconfig
```kconfig
# SHTCX temperature and humidity sensor configuration options

# Copyright (c) 2021 Thomas Stranger
# SPDX-License-Identifier: Apache-2.0

config SHTCX
	bool "SHTCX: SHTC1 and SHTC3 Temperature and Humidity Sensor"
	default y
	depends on DT_HAS_SENSIRION_SHTCX_ENABLED
	select I2C
	help
	  Enable driver for SHTC1 and SHTC3 temperature and humidity sensors.
```

## drivers/sensor/si1133/Kconfig
```kconfig
# Si1133 UV Index and Ambient Light Sensor configuration options

# Copyright (c) 2021 Murali Tejeshwar Janaswami
# SPDX-License-Identifier: Apache-2.0

config SI1133
	bool "Si1133 UV Index and Ambient Light Sensor"
	depends on I2C
	help
	  Enable driver for Si1133 UV Index and Ambient Light Sensor.

if SI1133

choice SI1133_OPERATING_MODE
	prompt "Sensor operating mode"
	default SI1133_OPERATING_MODE_LL
	help
	  Configure Si1133 for operating under low-light(ex: indoor lighting) or bright-light(ex: sunlight) conditions.

config SI1133_OPERATING_MODE_LL
	bool "Low-light"

config SI1133_OPERATING_MODE_BL
	bool "Bright-light"

endchoice

endif
```

## drivers/sensor/si1153/Kconfig
```kconfig
# Kconfig.si1153 - SI1153 Proximity/Ambient Light Sensor IC with I2C Interface

#
# Copyright (c) 2017 IpTronix S.r.l.
#
# SPDX-License-Identifier: Apache-2.0
#

menuconfig SI1153
	bool "SI1153 sensor"
	depends on SENSOR && I2C
	default n
	help
	 Enable driver for SI1153 Proximity/Ambient Light Sensor IC with I2C Interface.

config SI1153_DEV_NAME
	string "SI1153 device name"
	depends on SI1153
	default "SI1153"

config SI1153_I2C_DEV_NAME
	string "I2C device where SI1153 is connected"
	depends on SI1153
	default "I2C_0"
	help
	 Specify the device name of the I2C device to which SI1153 is
	 connected.

config SI1153_I2C_DEV_ADDRESS
	hex "I2C address where SI1153 is connected"
	depends on SI1153
	default 0x53
	help
	 Specify the I2C address to which SI1153 is connected.

config SI1153_INTERRUPT
	prompt "Enable interrupt handling"
	bool
	default false
	depends on SI1153

config SI1153_GPIO_DEV_NAME
	string "Gpio device"
	default "GPIO_1"
	depends on SI1153 && SI1153_INTERRUPT
	help
	  The name of the GPIO device to which the SI1153 interrupt pin is
	  connected.

config SI1153_GPIO_PIN_NUM
	int "Interrupt GPIO pin number"
	default 4
	depends on SI1153 && SI1153_INTERRUPT
	help
	  The number of the GPIO pin which is connected to SI1153 interrupt pin.

config SI1153_OWN_THREAD
	prompt "Enable thread handling"
	bool
	default false
	depends on SI1153

config SI1153_THREAD_PRIORITY
	int
	prompt "Thread priority"
	depends on SI1153 && SI1153_OWN_THREAD
	default 10
	help
	  Priority of thread used by the driver to handle interrupts.

config SI1153_THREAD_STACK_SIZE
	int
	prompt "Thread stack size"
	depends on SI1153 && SI1153_OWN_THREAD
	default 1024
	help
	  Stack size of thread used by the driver to handle interrupts.
```

## drivers/sensor/si7006/Kconfig
```kconfig
# Copyright (c) 2019 Electronut Labs
# SPDX-License-Identifier: Apache-2.0

config SI7006
	bool "Si7006 Temperature and Humidity Sensor"
	depends on I2C
	help
	  Enable I2C-based driver for Si7006 Temperature and Humidity Sensor.
```

## drivers/sensor/si7021/Kconfig
```kconfig
# Copyright (c) 2020 Nikolaus Huber, Uppsala University
# SPDX -License-Identifier: Apache-2.0

menuconfig SI7021
    bool "Si7021 Temperature and Relative Humidity Sensor"
    depends on I2C
    help
        Enable I2C - based driver for Si7021 from Silicon Labratories.

if SI7021
    config SI7021_ENABLE_CHECKSUM
    bool "Si7021 Checksum on measurement"
    help
        Validates the additional checksum byte per measurement.
endif
```

## drivers/sensor/si7055/Kconfig
```kconfig
# Copyright (c) 2019 Electronut Labs
# Copyright (c) 2020 Laird Connectivity
# SPDX-License-Identifier: Apache-2.0

menuconfig SI7055
	bool "Si7055 Temperature Sensor"
	default y
	depends on DT_HAS_SILABS_SI7055_ENABLED
	depends on I2C
	help
	  Enable I2C-based driver for Si7055 Temperature Sensor.

if SI7055

config SI7055_ENABLE_CHECKSUM
	bool "SI7055 Checksum On Measurement"
	help
	  Validates the additional checksum byte for temperature measurements.

endif # SI7055
```

## drivers/sensor/si7060/Kconfig
```kconfig
# SI7060 temperature sensor configuration options

# Copyright (c) 2019 Actinius
# SPDX-License-Identifier: Apache-2.0

config SI7060
	bool "SI7060 Temperature Sensor"
	default y
	depends on DT_HAS_SILABS_SI7060_ENABLED
	depends on I2C
	help
	  Enable driver for SI7060 temperature sensors.
```

## drivers/sensor/si7210/Kconfig
```kconfig
# Si7210 Hall Effect Magnetic Position and Temperature Sensor configuration options
# Copyright (c) 2019 Actinius
# SPDX-License-Identifier: Apache-2.0

config SI7210
	bool "Si7210 Hall Effect Magnetic Position and Temperature Sensor"
	default y
	depends on DT_HAS_SILABS_SI7210_ENABLED
	depends on I2C
	help
	  Enable driver for Si7210 Hall Effect Magnetic Position and Temperature Sensor.
```

## drivers/sensor/sifli/Kconfig
```kconfig
# Copyright (c) 2025, Qingsong Gou <gouqs@hotmail.com>
# SPDX-License-Identifier: Apache-2.0

source "drivers/sensor/sifli/sf32lb_tsen/Kconfig"
```

## drivers/sensor/sifli/sf32lb_tsen/Kconfig
```kconfig
# Copyright (c) 2025, Qingsong Gou <gouqs@hotmail.com>
# SPDX-License-Identifier: Apache-2.0

config SF32LB_TSEN
	bool "SIFLI SF32LB TSEN temperature sensor driver"
	default y
	depends on DT_HAS_SIFLI_SF32LB_TSEN_ENABLED
	help
	  Enable driver for the SIFLI SF32LB on-chip temperature sensor (TSEN).
```

## drivers/sensor/sifli/sf32lb_vbat/Kconfig
```kconfig
# Copyright (c) 2025, Qingsong Gou <gouqs@hotmail.com>
# SPDX-License-Identifier: Apache-2.0

config SF32LB_VBAT
	bool "SF32LB VBAT sensor"
	default y
	depends on DT_HAS_SIFLI_SF32LB_VBAT_ENABLED
	select ADC
	select NVMEM
	select OTP
	help
	  Enable support for measuring the SF32LB internal VBAT channel using the
	  Zephyr ADC API.
```

## drivers/sensor/silabs/Kconfig
```kconfig
# Copyright (c) 2024 Analog Devices, Inc.
# SPDX-License-Identifier: Apache-2.0

# zephyr-keep-sorted-start
source "drivers/sensor/silabs/si7006/Kconfig"
source "drivers/sensor/silabs/si7055/Kconfig"
source "drivers/sensor/silabs/si7060/Kconfig"
source "drivers/sensor/silabs/si7210/Kconfig"
# zephyr-keep-sorted-stop
```
