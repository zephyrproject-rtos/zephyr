## drivers/sensor/tdk/icm4268x/Kconfig
```kconfig
# ICM4268X-P Six-Axis Motion Tracking device configuration options
#
# Copyright (c) 2022 Intel Corporation
# Copyright (c) 2024 Croxel Inc.
#
# SPDX-License-Identifier: Apache-2.0

menuconfig ICM4268X
	bool "ICM4268X Six-Axis Motion Tracking Device"
	default y
	depends on DT_HAS_INVENSENSE_ICM4268X_ENABLED
	select SPI
	select RTIO_WORKQ if SENSOR_ASYNC_API
	help
	  Enable driver for ICM4268X SPI-based six-axis motion tracking device.

if ICM4268X

config EMUL_ICM4268X
	bool "Emulator for the ICM4268X"
	default y
	depends on EMUL
	help
	  Enable the hardware emulator for the ICM4268X. Doing so allows exercising
	  sensor APIs for this IMU in native_sim and qemu.

config ICM4268X_DECODER
	bool "ICM4268X decoder logic"
	default y
	select SENSOR_ASYNC_API
	help
	  Compile the ICM4268X decoder API which allows decoding raw data returned
	  from the sensor.

choice
	prompt "Trigger mode"
	default ICM4268X_TRIGGER_NONE if ICM4268X_STREAM
	default ICM4268X_TRIGGER_GLOBAL_THREAD
	help
	  Specify the type of triggering to be used by the driver

config ICM4268X_TRIGGER_NONE
	bool "No trigger"

config ICM4268X_TRIGGER_GLOBAL_THREAD
	bool "Use global thread"
	depends on GPIO
	depends on $(dt_compat_any_has_prop,$(DT_COMPAT_INVENSENSE_ICM4268X),int-gpios)
	select ICM4268X_TRIGGER

config ICM4268X_TRIGGER_OWN_THREAD
	bool "Use own thread"
	depends on GPIO
	depends on $(dt_compat_any_has_prop,$(DT_COMPAT_INVENSENSE_ICM4268X),int-gpios)
	select ICM4268X_TRIGGER

endchoice

config ICM4268X_STREAM
	bool "Use hardware FIFO to stream data"
	select ICM4268X_TRIGGER
	default y
	depends on SPI_RTIO
	depends on SENSOR_ASYNC_API
	help
	  Use this config option to enable streaming sensor data via RTIO subsystem.

config ICM4268X_TRIGGER
	bool

config ICM4268X_THREAD_PRIORITY
	int "Own thread priority"
	depends on ICM4268X_TRIGGER_OWN_THREAD
	default 10
	help
	  The priority of the thread used for handling interrupts.

config ICM4268X_THREAD_STACK_SIZE
	int "Own thread stack size"
	depends on ICM4268X_TRIGGER_OWN_THREAD
	default 1024
	help
	  The thread stack size.

endif # ICM4268X
```

## drivers/sensor/tdk/icm42x70/Kconfig
```kconfig
# ICM42670-P ICM42670-S Six-Axis Motion Tracking device configuration options
#
# Copyright (c) 2024 TDK Invensense
# Copyright (c) 2022 Esco Medical ApS
# Copyright (c) 2020 TDK Invensense
#
# SPDX-License-Identifier: Apache-2.0
config TDK_APEX
	bool

menuconfig ICM42X70
	bool "ICM42670-P/-S Six-Axis or ICM42370-P Three-Axis Motion Tracking Device"
	default y
	depends on DT_HAS_INVENSENSE_ICM42670P_ENABLED \
		|| DT_HAS_INVENSENSE_ICM42670S_ENABLED \
		|| DT_HAS_INVENSENSE_ICM42370P_ENABLED
	depends on ZEPHYR_HAL_TDK_MODULE
	select SPI if $(dt_compat_on_bus,$(DT_COMPAT_INVENSENSE_ICM42670P),spi) \
		|| $(dt_compat_on_bus,$(DT_COMPAT_INVENSENSE_ICM42670S),spi) \
		|| $(dt_compat_on_bus,$(DT_COMPAT_INVENSENSE_ICM42370P),spi)
	select I2C if $(dt_compat_on_bus,$(DT_COMPAT_INVENSENSE_ICM42670P),i2c) \
		|| $(dt_compat_on_bus,$(DT_COMPAT_INVENSENSE_ICM42670S),i2c) \
		|| $(dt_compat_on_bus,$(DT_COMPAT_INVENSENSE_ICM42370P),i2c)
	select TDK_APEX if $(dt_node_str_prop_equals,$(dt_nodelabel_path,icm42670p),apex,pedometer) \
		|| $(dt_node_str_prop_equals,$(dt_nodelabel_path,icm42670p),apex,tilt) \
		|| $(dt_node_str_prop_equals,$(dt_nodelabel_path,icm42670p),apex,smd) \
		|| $(dt_node_str_prop_equals,$(dt_nodelabel_path,icm42670p),apex,wom) \
		|| $(dt_node_str_prop_equals,$(dt_nodelabel_path,icm42670s),apex,pedometer) \
		|| $(dt_node_str_prop_equals,$(dt_nodelabel_path,icm42670s),apex,tilt) \
		|| $(dt_node_str_prop_equals,$(dt_nodelabel_path,icm42670s),apex,smd) \
		|| $(dt_node_str_prop_equals,$(dt_nodelabel_path,icm42670s),apex,wom) \
		|| $(dt_node_str_prop_equals,$(dt_nodelabel_path,icm42370p),apex,pedometer) \
		|| $(dt_node_str_prop_equals,$(dt_nodelabel_path,icm42370p),apex,tilt) \
		|| $(dt_node_str_prop_equals,$(dt_nodelabel_path,icm42370p),apex,smd) \
		|| $(dt_node_str_prop_equals,$(dt_nodelabel_path,icm42370p),apex,wom)
	select USE_EMD_ICM42670 if DT_HAS_INVENSENSE_ICM42670P_ENABLED || DT_HAS_INVENSENSE_ICM42670S_ENABLED
	select USE_EMD_ICM42370 if DT_HAS_INVENSENSE_ICM42370P_ENABLED
	select SENSOR_ASYNC_API
	help
	  Enable driver for ICM42x70 SPI-based or I2C-based Six-Axis or Three-Axis Motion Tracking device.

if ICM42X70

choice ICM42X70_TRIGGER_MODE
	prompt "Trigger mode"
	default ICM42X70_TRIGGER_NONE
	help
	  Specify the type of triggering to be used by the driver.

config ICM42X70_TRIGGER_NONE
	bool "No trigger"

config ICM42X70_TRIGGER_GLOBAL_THREAD
	bool "Use global thread"
	depends on GPIO
	depends on $(dt_compat_any_has_prop,$(DT_COMPAT_INVENSENSE_ICM42670P),int-gpios) \
		|| $(dt_compat_any_has_prop,$(DT_COMPAT_INVENSENSE_ICM42670S),int-gpios) \
		|| $(dt_compat_any_has_prop,$(DT_COMPAT_INVENSENSE_ICM42370P),int-gpios)
	select ICM42X70_TRIGGER

config ICM42X70_TRIGGER_OWN_THREAD
	bool "Use own thread"
	depends on GPIO
	depends on $(dt_compat_any_has_prop,$(DT_COMPAT_INVENSENSE_ICM42670P),int-gpios) \
		|| $(dt_compat_any_has_prop,$(DT_COMPAT_INVENSENSE_ICM42670S),int-gpios) \
		|| $(dt_compat_any_has_prop,$(DT_COMPAT_INVENSENSE_ICM42370P),int-gpios)
	select ICM42X70_TRIGGER

endchoice

config ICM42X70_TRIGGER
	bool

config ICM42X70_THREAD_PRIORITY
	int "Thread priority"
	depends on ICM42X70_TRIGGER_OWN_THREAD
	default 10
	help
	  Priority of thread used by the driver to handle interrupts.

config ICM42X70_THREAD_STACK_SIZE
	int "Thread stack size"
	depends on ICM42X70_TRIGGER_OWN_THREAD
	default 1024
	help
	  Stack size of thread used by the driver to handle interrupts.

endif # ICM42X70
```

## drivers/sensor/tdk/icm45605/Kconfig
```kconfig
# Copyright (c) 2025 Croxel Inc.
# Copyright (c) 2025 CogniPilot Foundation
# Copyright (c) 2026 Swarovski Optik AG & Co KG.
# SPDX-License-Identifier: Apache-2.0

menuconfig ICM45605
	bool "ICM45605 High-precision 6-Axis Motion Tracking Device"
	default y
	depends on DT_HAS_INVENSENSE_ICM45605_ENABLED
	select SPI if $(dt_compat_on_bus,$(DT_COMPAT_INVENSENSE_ICM45605),spi)
	select SPI_RTIO if $(dt_compat_on_bus,$(DT_COMPAT_INVENSENSE_ICM45605),spi)
	select I2C if $(dt_compat_on_bus,$(DT_COMPAT_INVENSENSE_ICM45605),i2c)
	select I2C_RTIO if $(dt_compat_on_bus,$(DT_COMPAT_INVENSENSE_ICM45605),i2c)
	select I3C if $(dt_compat_on_bus,$(DT_COMPAT_INVENSENSE_ICM45605),i3c)
	select I3C_RTIO if $(dt_compat_on_bus,$(DT_COMPAT_INVENSENSE_ICM45605),i3c)
	help
	  Enable driver for ICM45605 High-precision 6-axis motion
	  tracking device.

if ICM45605

choice
	prompt "Trigger mode"
	default ICM45605_TRIGGER_GLOBAL_THREAD
	help
	  Specify the type of triggering to be used by the driver

config ICM45605_TRIGGER_NONE
	bool "No trigger"

config ICM45605_TRIGGER_GLOBAL_THREAD
	bool "Use global thread"
	depends on GPIO
	depends on $(dt_compat_any_has_prop,$(DT_COMPAT_INVENSENSE_ICM45605),int-gpios)
	depends on !ICM45605_STREAM
	select ICM45605_TRIGGER

config ICM45605_TRIGGER_OWN_THREAD
	bool "Use own thread"
	depends on GPIO
	depends on $(dt_compat_any_has_prop,$(DT_COMPAT_INVENSENSE_ICM45605),int-gpios)
	depends on !ICM45605_STREAM
	select ICM45605_TRIGGER

endchoice

config ICM45605_TRIGGER
	bool

config ICM45605_THREAD_PRIORITY
	int "Own thread priority"
	depends on ICM45605_TRIGGER_OWN_THREAD
	default 10
	help
	  The priority of the thread used for handling triggers.

config ICM45605_THREAD_STACK_SIZE
	int "Own thread stack size"
	depends on ICM45605_TRIGGER_OWN_THREAD
	default 1024
	help
	  The thread stack size.

config ICM45605_STREAM
	bool "Streaming mode"
	depends on GPIO || \
		   $(dt_compat_on_bus,$(DT_COMPAT_INVENSENSE_ICM45605),i3c)
	depends on $(dt_compat_any_has_prop,$(DT_COMPAT_INVENSENSE_ICM45605),int-gpios) || \
		   $(dt_compat_on_bus,$(DT_COMPAT_INVENSENSE_ICM45605),i3c)
	help
	  Enable streaming of sensor data.

endif # ICM45605
```

## drivers/sensor/tdk/icm45686/Kconfig
```kconfig
# Copyright (c) 2025 Croxel Inc.
# Copyright (c) 2025 CogniPilot Foundation
# SPDX-License-Identifier: Apache-2.0

menuconfig ICM45686
	bool "ICM45686 High-precision 6-Axis Motion Tracking Device"
	default y
	depends on DT_HAS_INVENSENSE_ICM45686_ENABLED
	select SPI if $(dt_compat_on_bus,$(DT_COMPAT_INVENSENSE_ICM45686),spi)
	select SPI_RTIO if $(dt_compat_on_bus,$(DT_COMPAT_INVENSENSE_ICM45686),spi)
	select I2C if $(dt_compat_on_bus,$(DT_COMPAT_INVENSENSE_ICM45686),i2c)
	select I2C_RTIO if $(dt_compat_on_bus,$(DT_COMPAT_INVENSENSE_ICM45686),i2c)
	select I3C if $(dt_compat_on_bus,$(DT_COMPAT_INVENSENSE_ICM45686),i3c)
	select I3C_RTIO if $(dt_compat_on_bus,$(DT_COMPAT_INVENSENSE_ICM45686),i3c)
	help
	  Enable driver for ICM45686 High-precision 6-axis motion
	  tracking device.

if ICM45686

choice
	prompt "Trigger mode"
	default ICM45686_TRIGGER_GLOBAL_THREAD
	help
	  Specify the type of triggering to be used by the driver

config ICM45686_TRIGGER_NONE
	bool "No trigger"

config ICM45686_TRIGGER_GLOBAL_THREAD
	bool "Use global thread"
	depends on GPIO
	depends on $(dt_compat_any_has_prop,$(DT_COMPAT_INVENSENSE_ICM45686),int-gpios)
	depends on !ICM45686_STREAM
	select ICM45686_TRIGGER

config ICM45686_TRIGGER_OWN_THREAD
	bool "Use own thread"
	depends on GPIO
	depends on $(dt_compat_any_has_prop,$(DT_COMPAT_INVENSENSE_ICM45686),int-gpios)
	depends on !ICM45686_STREAM
	select ICM45686_TRIGGER

endchoice

config ICM45686_TRIGGER
	bool

config ICM45686_THREAD_PRIORITY
	int "Own thread priority"
	depends on ICM45686_TRIGGER_OWN_THREAD
	default 10
	help
	  The priority of the thread used for handling triggers.

config ICM45686_THREAD_STACK_SIZE
	int "Own thread stack size"
	depends on ICM45686_TRIGGER_OWN_THREAD
	default 1024
	help
	  The thread stack size.

config ICM45686_STREAM
	bool "Streaming mode"
	depends on GPIO || \
		   $(dt_compat_on_bus,$(DT_COMPAT_INVENSENSE_ICM45686),i3c)
	depends on $(dt_compat_any_has_prop,$(DT_COMPAT_INVENSENSE_ICM45686),int-gpios) || \
		   $(dt_compat_on_bus,$(DT_COMPAT_INVENSENSE_ICM45686),i3c)
	help
	  Enable streaming of sensor data.

endif # ICM45686
```

## drivers/sensor/tdk/icm566xx/Kconfig
```kconfig
# Copyright (c) 2025 Croxel Inc.
# Copyright (c) 2025 CogniPilot Foundation
# SPDX-License-Identifier: Apache-2.0

menuconfig ICM566XX
	bool "ICM566XX High-precision 6-Axis Motion Tracking Device"
	default y
	depends on DT_HAS_INVENSENSE_ICM56622_ENABLED || \
		DT_HAS_INVENSENSE_ICM56686_ENABLED
	select SPI if $(dt_compat_on_bus,$(DT_COMPAT_INVENSENSE_ICM56622),spi) \
		|| $(dt_compat_on_bus,$(DT_COMPAT_INVENSENSE_ICM56686),spi)
	select SPI_RTIO if $(dt_compat_on_bus,$(DT_COMPAT_INVENSENSE_ICM56622),spi) \
		|| $(dt_compat_on_bus,$(DT_COMPAT_INVENSENSE_ICM56686),spi)
	select I2C if $(dt_compat_on_bus,$(DT_COMPAT_INVENSENSE_ICM56622),i2c) \
		|| $(dt_compat_on_bus,$(DT_COMPAT_INVENSENSE_ICM56686),i2c)
	select I2C_RTIO if $(dt_compat_on_bus,$(DT_COMPAT_INVENSENSE_ICM56622),i2c) \
		|| $(dt_compat_on_bus,$(DT_COMPAT_INVENSENSE_ICM56686),i2c)
	select I3C if $(dt_compat_on_bus,$(DT_COMPAT_INVENSENSE_ICM56622),i3c) \
		|| $(dt_compat_on_bus,$(DT_COMPAT_INVENSENSE_ICM56686),i3c)
	select I3C_RTIO if $(dt_compat_on_bus,$(DT_COMPAT_INVENSENSE_ICM56622),i3c) \
		|| $(dt_compat_on_bus,$(DT_COMPAT_INVENSENSE_ICM56686),i3c)
	select USE_EMD_ICM56622 if DT_HAS_INVENSENSE_ICM56622_ENABLED
	select USE_EMD_ICM56686 if DT_HAS_INVENSENSE_ICM56686_ENABLED
	help
	  Enable driver for ICM566XX High-precision 6-axis motion
	  tracking device.

if ICM566XX

choice
	prompt "Trigger mode"
	default ICM566XX_TRIGGER_GLOBAL_THREAD
	help
	  Specify the type of triggering to be used by the driver

config ICM566XX_TRIGGER_NONE
	bool "No trigger"

config ICM566XX_TRIGGER_GLOBAL_THREAD
	bool "Use global thread"
	select GPIO
	depends on $(dt_compat_any_has_prop,$(DT_COMPAT_INVENSENSE_ICM56622),int-gpios) || \
			$(dt_compat_any_has_prop,$(DT_COMPAT_INVENSENSE_ICM56686),int-gpios)
	depends on !ICM566XX_STREAM
	select ICM566XX_TRIGGER

config ICM566XX_TRIGGER_OWN_THREAD
	bool "Use own thread"
	select GPIO
	depends on $(dt_compat_any_has_prop,$(DT_COMPAT_INVENSENSE_ICM56622),int-gpios) || \
			$(dt_compat_any_has_prop,$(DT_COMPAT_INVENSENSE_ICM56686),int-gpios)
	depends on !ICM566XX_STREAM
	select ICM566XX_TRIGGER

endchoice

config TDK_APEX
	bool

config ICM566XX_TRIGGER
	bool

config ICM566XX_THREAD_PRIORITY
	int "Own thread priority"
	depends on ICM566XX_TRIGGER_OWN_THREAD
	default 10
	help
	  The priority of the thread used for handling triggers.

config ICM566XX_THREAD_STACK_SIZE
	int "Own thread stack size"
	depends on ICM566XX_TRIGGER_OWN_THREAD
	default 1024
	help
	  The thread stack size.

config ICM566XX_STREAM
	bool "Streaming mode"
	depends on $(dt_compat_any_has_prop,$(DT_COMPAT_INVENSENSE_ICM56622),int-gpios) || \
			$(dt_compat_any_has_prop,$(DT_COMPAT_INVENSENSE_ICM56686),int-gpios) || \
			$(dt_compat_on_bus,$(DT_COMPAT_INVENSENSE_ICM56622),i3c) || \
			$(dt_compat_on_bus,$(DT_COMPAT_INVENSENSE_ICM56686),i3c)
	help
	  Enable streaming of sensor data.

endif # ICM566XX
```

## drivers/sensor/tdk/icp10125/Kconfig
```kconfig
# ICP10125 barometric pressure/temperature sensor configuration options

# Copyright (c) 2022 Mizuki Agawa <agawa.mizuki@fujitsu.com>
# SPDX-License-Identifier: Apache-2.0

menuconfig ICP10125
	bool "ICP10125 Barometric Pressure & Temperature Sensor"
	default y
	depends on DT_HAS_INVENSENSE_ICP10125_ENABLED
	select I2C
	help
	  Enable driver for ICP10125 barometric pressure/temperature sensor.

if ICP10125

config ICP10125_CHECK_CRC
	bool "Check the CRC of measument data"
	imply CRC
	default y
	help
	  Verify the CRC checksum that appended to the measurement data.

endif # ICP10125
```

## drivers/sensor/tdk/icp201xx/Kconfig
```kconfig
# ICP201xx High Accuracy, Low Power, Barometric Pressure and Temperature Sensor IC
#
# Copyright (c) 2025 TDK Invensense
#
# SPDX-License-Identifier: Apache-2.0

menuconfig ICP201XX
	bool "ICP201xx Barometric Pressure and Temperature Sensor"
	default y
	depends on DT_HAS_INVENSENSE_ICP201XX_ENABLED
	select I2C if $(dt_compat_on_bus,$(DT_COMPAT_INVENSENSE_ICP201XX),i2c)
	select SPI if $(dt_compat_on_bus,$(DT_COMPAT_INVENSENSE_ICP201XX),spi)
	select USE_EMD_ICP201XX
	select FPU if CPU_HAS_FPU
	help
		Enable driver for ICP101xx Barometric Pressure and Temperature Sensor.

if ICP201XX

module = ICP201XX
thread_priority = 10
thread_stack_size = 1024
source "drivers/sensor/Kconfig.trigger_template"

endif # ICP201XX
```

## drivers/sensor/tdk/iim4623x/Kconfig
```kconfig
# Copyright (c) 2025 Sentry Technologies ApS
#
# SPDX-License-Identifier: Apache-2.0

config IIM4623X
	bool "TDK Invensense IIM4623x IMU sensor family"
	default y
	depends on DT_HAS_INVENSENSE_IIM46234_ENABLED || \
		   DT_HAS_INVENSENSE_IIM46230_ENABLED
	select SPI
	select SPI_RTIO
	help
	  Enable TDK Invensense IIM46234 IMU sensor family support.
```
