## drivers/sensor/st/stm32_vref/Kconfig
```kconfig
# STM32 vref sensor configuration options

# Copyright (c) 2023 Kenneth J. Miller <ken@miller.ec>
# SPDX-License-Identifier: Apache-2.0

config STM32_VREF
	bool "STM32 VREF Sensor"
	default y
	depends on DT_HAS_ST_STM32_ADC_ENABLED
	depends on DT_HAS_ST_STM32_VREF_ENABLED
	depends on SOC_FAMILY_STM32 && !SOC_SERIES_STM32F1X
	select ADC
	help
	  Enable driver for STM32 Vref sensor.

if STM32_VREF

config STM32_VREF_READ_CALIB_VIA_NVMEM
	bool "Read VREF calibration data using NVMEM"
	default y
	depends on OTP && NVMEM
	help
	  Read calibration data using the NVMEM subsystem
	  instead of using raw memory accesses.

endif # STM32_VREF
```

## drivers/sensor/st/stmemsc/Kconfig
```kconfig
# ST MEMS sensor configuration options

# Copyright (c) 2025 Meta Platforms
# SPDX-License-Identifier: Apache-2.0

config STMEMSC_I3C_I2C_WRITE_BUFFER_SIZE
	int "ST memsc I2C write buffer size"
	default 16
	depends on I2C || I3C
	depends on HAS_STMEMSC
	help
	  The size of the buffer pushed on the stack used to copy
	  the data to be written along with the register address.
```

## drivers/sensor/st/stts22h/Kconfig
```kconfig
# ST Microelectronics STTS22H temperature sensor

# Copyright (c) 2024 STMicroelectronics
# SPDX-License-Identifier: Apache-2.0

menuconfig STTS22H
	bool "STTS22H temperature sensor"
	default y
	depends on DT_HAS_ST_STTS22H_ENABLED
	depends on ZEPHYR_HAL_ST_MODULE
	select I2C
	select HAS_STMEMSC
	select USE_STDC_STTS22H
	help
	  Enable driver for STTS22H I2C-based temperature sensor.

if STTS22H

module = STTS22H
thread_priority = 10
thread_stack_size = 1024
source "drivers/sensor/Kconfig.trigger_template"

endif # STTS22H
```

## drivers/sensor/stc3100/Kconfig
```kconfig
# Copyright (c) 2024 Benedikt Schmidt <benediktibk@gmail.com>
# SPDX-License-Identifier: Apache-2.0

config STC3100
	bool "STC3100 temperature sensor"
	default y
	depends on DT_HAS_ST_STC3100_ENABLED
	select I2C
	help
	  Enable driver for the STC3100 battery monitor sensor.
```

## drivers/sensor/stm32/Kconfig
```kconfig
# Kconfig - STM32F401x temperature sensor configuration options

#
# Copyright (c) 2016 ARM Ltd.
# Copyright (c) 2017 Linaro Limited.
#
# SPDX-License-Identifier: Apache-2.0
#

menuconfig TEMP_STM32F401X
	bool
	prompt "STM32F401x Temperature Sensor"
	depends on SENSOR && SOC_SERIES_STM32F4X
	default n
	help
	  Enable driver for STM32F401x temperature sensor.

config TEMP_STM32F401X_NAME
	string
	prompt "Driver name"
	default "TEMP_0"
	depends on TEMP_STM32F401X
	help
	  Device name with which the STM32F401x temperature sensor is identified.
```

## drivers/sensor/stm32_temp/Kconfig
```kconfig
# STM32 temperature sensor configuration options

# Copyright (c) 2021 Eug Krashtan
# SPDX-License-Identifier: Apache-2.0

config STM32_TEMP
	bool "STM32 Temperature Sensor"
	default y
	depends on DT_HAS_ST_STM32_TEMP_ENABLED || DT_HAS_ST_STM32_TEMP_CAL_ENABLED
	depends on (ADC && SOC_FAMILY_STM32)
	help
	  Enable driver for STM32 temperature sensor.
```

## drivers/sensor/stm32_vbat/Kconfig
```kconfig
# STM32 battery sensor configuration options

# Copyright (c) 2022 STMicroelectronics
# SPDX-License-Identifier: Apache-2.0

config STM32_VBAT
	bool "STM32 Vbat Sensor"
	depends on ADC && (SOC_FAMILY_STM32 && !SOC_SERIES_STM32F1X)
	help
	  Enable driver for STM32 Vbat sensor and then also ADC
```

## drivers/sensor/stmpe811/Kconfig
```kconfig
#
# Copyright (c) 2017 Linaro Ltd.
#
# SPDX-License-Identifier: Apache-2.0
#

menuconfig STMPE811
	bool "STMPE811 touchscreen driver"
	depends on SENSOR && I2C

if STMPE811

config STMPE811_NAME
	string "Device name for the STMPE811 touchscreen driver"
	default "STMPE811"

config STMPE811_IRQ_PRI
	int "Interrupt priority for the STMPE811"
	default 0

config STMPE811_I2C_DEVICE
	string "Name of I2C device that the STMPE811 is attached to"

config STMPE811_I2C_ADDR
	int "I2C address of the STMPE811 device"
	default 65

config STMPE811_Z_SAMPLES
	bool "Include Z coordinate (pressure) samples"

config STMPE811_FRACTION_Z
	int "Value for the TSC_FRACTION_Z register"
	depends on STMPE811_Z_SAMPLES
	range 0 7
	default 4
	help
	  This value governs the range of the Z coordinate (pressure) and
	  a suitable value depend on the resistance of the touchscreen.

endif
```

## drivers/sensor/stts22h/Kconfig
```kconfig
#ST Microelectronics STTS22H temperature sensor

#Copyright (c) 2024 Javad Rahimipetroudi <javad.rahimipetroudi@mind.be>
# SPDX-License-Identifier: Apache-2.0

menuconfig STTS22H
	bool "STTS22H temperature sensor"
	default y
	depends on DT_HAS_ST_STTS22H_ENABLED
	depends on ZEPHYR_HAL_ST_MODULE
	select I2C
	select HAS_STMEMSC
	select USE_STDC_STTS22H
	help
	  Enable driver for STTS22H I2C-based temperature sensor.

if STTS22H

choice STTS22H_TRIGGER_MODE
	prompt "Trigger mode"
	default STTS22H_TRIGGER_NONE
	help
	  Specify the type of triggering to be used by the driver.

config STTS22H_TRIGGER_NONE
	bool "No trigger"

config STTS22H_TRIGGER_GLOBAL_THREAD
	bool "Use global thread"
	depends on GPIO
	select STTS22H_TRIGGER

config STTS22H_TRIGGER_OWN_THREAD
	bool "Use own thread"
	depends on GPIO
	select STTS22H_TRIGGER

endchoice # STTS22H_TRIGGER_MODE

config STTS22H_TRIGGER
	bool

config STTS22H_THREAD_PRIORITY
	int "Thread priority"
	depends on STTS22H_TRIGGER_OWN_THREAD
	default 10
	help
	  Priority of thread used by the driver to handle interrupts.

config STTS22H_THREAD_STACK_SIZE
	int "Thread stack size"
	depends on STTS22H_TRIGGER_OWN_THREAD
	default 1024
	help
	  Stack size of thread used by the driver to handle interrupts.

menu "Attributes"

config STTS22H_TEMP_HI_THRESHOLD
	depends on STTS22H_TRIGGER
	int "High temperature threshold alarm"
	default 50
	help
	  HIGH temperature threshold to trigger an alarm

config STTS22H_TEMP_LO_THRESHOLD
	depends on STTS22H_TRIGGER
	int "Low temperature threshold alarm"
	default 10
	help
	  LOW temperature threshold to trigger an alarm

config STTS22H_SAMPLING_RATE
	int "Output data rate"
	range 0 4
	default 0
	help
	  Sensor output data rate in freerun mode:
	  0:  1 Hz
	  1:  25 Hz
	  2:  50 Hz
	  3:  100 Hz
	  4:  200 Hz

endmenu

endif # STTS22H
```

## drivers/sensor/stts751/Kconfig
```kconfig
# ST Microelectronics STTS751 temperature sensor

# Copyright (c) 2019 STMicroelectronics
# SPDX-License-Identifier: Apache-2.0

menuconfig STTS751
	bool "STTS751 temperature sensor"
	default y
	depends on DT_HAS_ST_STTS751_ENABLED
	depends on ZEPHYR_HAL_ST_MODULE
	select I2C
	select HAS_STMEMSC
	select USE_STDC_STTS751
	help
	  Enable driver for STTS751 I2C-based temperature sensor.

if STTS751

choice STTS751_TRIGGER_MODE
	prompt "Trigger mode"
	default STTS751_TRIGGER_GLOBAL_THREAD
	help
	  Specify the type of triggering to be used by the driver.

config STTS751_TRIGGER_NONE
	bool "No trigger"

config STTS751_TRIGGER_GLOBAL_THREAD
	bool "Use global thread"
	depends on GPIO
	select STTS751_TRIGGER

config STTS751_TRIGGER_OWN_THREAD
	bool "Use own thread"
	depends on GPIO
	select STTS751_TRIGGER

endchoice # STTS751_TRIGGER_MODE

config STTS751_TRIGGER
	bool

config STTS751_THREAD_PRIORITY
	int "Thread priority"
	depends on STTS751_TRIGGER_OWN_THREAD
	default 10
	help
	  Priority of thread used by the driver to handle interrupts.

config STTS751_THREAD_STACK_SIZE
	int "Thread stack size"
	depends on STTS751_TRIGGER_OWN_THREAD
	default 1024
	help
	  Stack size of thread used by the driver to handle interrupts.

menu "Attributes"

config STTS751_TEMP_HI_THRESHOLD
	depends on STTS751_TRIGGER
	int "High temperature threshold alarm"
	default 50
	help
	  HIGH temperature threshold to trigger an alarm

config STTS751_TEMP_LO_THRESHOLD
	depends on STTS751_TRIGGER
	int "Low temperature threshold alarm"
	default 10
	help
	  LOW temperature threshold to trigger an alarm

config STTS751_SAMPLING_RATE
	int "Output data rate"
	range 0 9
	default 4
	help
	  Sensor output data rate expressed in conversions per second.
	  Data rates supported by the chip are:
	  0:  1 conv  every 16 sec
	  1:  1 conv  every 8 sec
	  2:  1 conv  every 4 sec
	  3:  1 conv  every 2 sec
	  4:  1 conv  every sec
	  5:  2 convs every sec
	  6:  4 convs every sec
	  7:  8 convs every sec
	  8: 16 convs every sec
	  9: 32 convs every sec

endmenu

endif # STTS751
```

## drivers/sensor/sx9500/Kconfig
```kconfig
# SX9500 SAR proximity sensor configuration options

# Copyright (c) 2016 Intel Corporation
# SPDX-License-Identifier: Apache-2.0

menuconfig SX9500
	bool "SX9500 I2C SAR Proximity Chip"
	default y
	depends on DT_HAS_SEMTECH_SX9500_ENABLED
	select I2C
	help
	  Enable driver for SX9500 I2C-based SAR proximity sensor.

if SX9500

config SX9500_PROX_CHANNEL
	int "Proximity channel to use"
	default 3
	help
	  The SX9500 offers 4 separate proximity channels.  Choose which one
	  you are using.  Valid numbers are 0 to 3.

choice
	prompt "SX9500 trigger mode"
	default SX9500_TRIGGER_GLOBAL_THREAD

config SX9500_TRIGGER_NONE
	bool "No trigger"

config SX9500_TRIGGER_GLOBAL_THREAD
	depends on GPIO
	select SX9500_TRIGGER
	bool "Use global thread"

config SX9500_TRIGGER_OWN_THREAD
	depends on GPIO
	select SX9500_TRIGGER
	bool "Use own thread"

endchoice

config SX9500_TRIGGER
	bool

config SX9500_THREAD_STACK_SIZE
	int "Sensor delayed work thread stack size"
	depends on SX9500_TRIGGER_OWN_THREAD
	default 1024

config SX9500_THREAD_PRIORITY
	int "Thread priority"
	depends on SX9500_TRIGGER_OWN_THREAD
	default 10

endif # SX9500
```

## drivers/sensor/tach_gpio/Kconfig
```kconfig
# Copyright (c) 2025 Prevas A/S
# SPDX-License-Identifier: Apache-2.0

config TACH_GPIO
	bool "Tachometer GPIO sensor"
	default y
	depends on DT_HAS_ZEPHYR_TACH_GPIO_ENABLED
	depends on GPIO
	help
	  Enable tachometer sensor using GPIO interrupts.
```

## drivers/sensor/tcs3472x/Kconfig
```kconfig
# TCS3472x color sensor configuration options

# Copyright (c) 2023, Thomas Kiss <thokis@gmail.com>
# SPDX-License-Identifier: Apache-2.0

menuconfig TCS3472X
	bool "TCS3472X sensor"
	default y
	depends on DT_HAS_AMS_TCS3472X_ENABLED
	select I2C
	help
	  Enable driver for TCS3472x I2C-based color sensor.
```

## drivers/sensor/tdk/Kconfig
```kconfig
# Copyright (c) 2024 Analog Devices, Inc.
# SPDX-License-Identifier: Apache-2.0

# zephyr-keep-sorted-start
source "drivers/sensor/tdk/icm42605/Kconfig"
source "drivers/sensor/tdk/icm42688/Kconfig"
source "drivers/sensor/tdk/icm42x70/Kconfig"
source "drivers/sensor/tdk/icm45686/Kconfig"
source "drivers/sensor/tdk/icp101xx/Kconfig"
source "drivers/sensor/tdk/icp201xx/Kconfig"
source "drivers/sensor/tdk/mpu6050/Kconfig"
source "drivers/sensor/tdk/mpu9250/Kconfig"
# zephyr-keep-sorted-stop
```

## drivers/sensor/tdk/icm20608/Kconfig
```kconfig
# ICM20608 Six-Axis Motion Tracking device configuration options
#
# Copyright (c) 2024 Han Wu
# email: wuhanstudios@gmail.com
#
# SPDX-License-Identifier: Apache-2.0

menuconfig ICM20608
	bool "ICM20608 Six-Axis Motion Tracking Device"
	default y
	depends on DT_HAS_INVENSENSE_ICM20608_ENABLED
	select I2C if $(dt_compat_on_bus,$(DT_COMPAT_INVENSENSE_ICM20608),i2c)
	help
	  Enable driver for ICM20608 I2C-based six-axis motion tracking device.

if ICM20608

choice ICM20608_TRIGGER_MODE
	prompt "Trigger mode"
	default ICM20608_TRIGGER_NONE
	help
	  Specify the type of triggering to be used by the driver.

config ICM20608_TRIGGER_NONE
	bool "No trigger"

config ICM20608_TRIGGER_GLOBAL_THREAD
	bool "Use global thread"
	depends on GPIO
	select ICM20608_TRIGGER

config ICM20608_TRIGGER_OWN_THREAD
	bool "Use own thread"
	depends on GPIO
	select ICM20608_TRIGGER

endchoice

config ICM20608_TRIGGER
	bool

config ICM20608_THREAD_PRIORITY
	int "Thread priority"
	depends on ICM20608_TRIGGER_OWN_THREAD
	default 10
	help
	  Priority of thread used by the driver to handle interrupts.

config ICM20608_THREAD_STACK_SIZE
	int "Thread stack size"
	depends on ICM20608_TRIGGER_OWN_THREAD
	default 1024
	help
	  Stack size of thread used by the driver to handle interrupts.

endif # ICM20608
```

## drivers/sensor/tdk/icm40627/Kconfig
```kconfig
# ICM40627 Six-Axis Motion Tracking device configuration options
#
# Copyright (c) 2025 PHYTEC America LLC
#
# SPDX-License-Identifier: Apache-2.0

menuconfig ICM40627
	bool "ICM40627 Six-Axis Motion Tracking Device"
	default y
	depends on DT_HAS_INVENSENSE_ICM40627_ENABLED
	select I2C
	help
	  Enable driver for ICM40627 I2C-based six-axis motion tracking device.

if ICM40627

module = ICM40627
thread_priority = 10
thread_stack_size = 1024
source "drivers/sensor/Kconfig.trigger_template"

endif # ICM40627
```

## drivers/sensor/tdk/icm42670/Kconfig
```kconfig
# ICM42670-P ICM42670-S Six-Axis Motion Tracking device configuration options
#
# Copyright (c) 2024 TDK Invensense
# Copyright (c) 2022 Esco Medical ApS
# Copyright (c) 2020 TDK Invensense
#
# SPDX-License-Identifier: Apache-2.0
config TDK_APEX
	bool "TDK APEX features"

menuconfig ICM42670
	bool "ICM42670-P/-S Six-Axis Motion Tracking Device"
	default y
	depends on DT_HAS_INVENSENSE_ICM42670P_ENABLED \
		|| DT_HAS_INVENSENSE_ICM42670S_ENABLED
	depends on ZEPHYR_HAL_TDK_MODULE
	select SPI if $(dt_compat_on_bus,$(DT_COMPAT_INVENSENSE_ICM42670P),spi) \
		|| $(dt_compat_on_bus,$(DT_COMPAT_INVENSENSE_ICM42670S),spi)
	select I2C if $(dt_compat_on_bus,$(DT_COMPAT_INVENSENSE_ICM42670P),i2c) \
		|| $(dt_compat_on_bus,$(DT_COMPAT_INVENSENSE_ICM42670S),i2c)
	select TDK_APEX if $(dt_node_str_prop_equals,$(dt_nodelabel_path,icm42670p),apex,pedometer) \
		|| $(dt_node_str_prop_equals,$(dt_nodelabel_path,icm42670p),apex,tilt) \
		|| $(dt_node_str_prop_equals,$(dt_nodelabel_path,icm42670p),apex,smd) \
		|| $(dt_node_str_prop_equals,$(dt_nodelabel_path,icm42670p),apex,wom) \
		|| $(dt_node_str_prop_equals,$(dt_nodelabel_path,icm42670s),apex,pedometer) \
		|| $(dt_node_str_prop_equals,$(dt_nodelabel_path,icm42670s),apex,tilt) \
		|| $(dt_node_str_prop_equals,$(dt_nodelabel_path,icm42670s),apex,smd) \
		|| $(dt_node_str_prop_equals,$(dt_nodelabel_path,icm42670s),apex,wom)
	help
	  Enable driver for ICM42670 SPI-based or I2C-based Six-Axis Motion Tracking device.

if ICM42670

choice ICM42670_TRIGGER_MODE
	prompt "Trigger mode"
	default ICM42670_TRIGGER_NONE
	help
	  Specify the type of triggering to be used by the driver.

config ICM42670_TRIGGER_NONE
	bool "No trigger"

config ICM42670_TRIGGER_GLOBAL_THREAD
	bool "Use global thread"
	depends on GPIO
	depends on $(dt_compat_any_has_prop,$(DT_COMPAT_INVENSENSE_ICM42670P),int-gpios) \
		|| $(dt_compat_any_has_prop,$(DT_COMPAT_INVENSENSE_ICM42670S),int-gpios)
	select ICM42670_TRIGGER

config ICM42670_TRIGGER_OWN_THREAD
	bool "Use own thread"
	depends on GPIO
	depends on $(dt_compat_any_has_prop,$(DT_COMPAT_INVENSENSE_ICM42670P),int-gpios) \
		|| $(dt_compat_any_has_prop,$(DT_COMPAT_INVENSENSE_ICM42670S),int-gpios)
	select ICM42670_TRIGGER

endchoice

config ICM42670_TRIGGER
	bool

config ICM42670_THREAD_PRIORITY
	int "Thread priority"
	depends on ICM42670_TRIGGER_OWN_THREAD
	default 10
	help
	  Priority of thread used by the driver to handle interrupts.

config ICM42670_THREAD_STACK_SIZE
	int "Thread stack size"
	depends on ICM42670_TRIGGER_OWN_THREAD
	default 1024
	help
	  Stack size of thread used by the driver to handle interrupts.

endif # ICM42670
```
