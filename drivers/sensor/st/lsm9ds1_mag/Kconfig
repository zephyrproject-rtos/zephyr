## drivers/sensor/st/lsm9ds1_mag/Kconfig
```kconfig
# Copyright (c) 2024 Bootlin
# SPDX-License-Identifier: Apache-2.0

config LSM9DS1_MAG
	bool "LSM9DS1 I2C/SPI magnetometer chip"
	default y
	depends on DT_HAS_ST_LSM9DS1_MAG_ENABLED
	depends on ZEPHYR_HAL_ST_MODULE
	select I2C if $(dt_compat_on_bus,$(DT_COMPAT_ST_LSM9DS1_MAG),i2c)
	select SPI if $(dt_compat_on_bus,$(DT_COMPAT_ST_LSM9DS1_MAG),spi)
	select HAS_STMEMSC
	select USE_STDC_LSM9DS1
```

## drivers/sensor/st/sths34pf80/Kconfig
```kconfig
# Copyright (c) 2026 Dotcom IoT LLP
# SPDX-License-Identifier: Apache-2.0

config STHS34PF80
	bool "ST STHS34PF80 infrared presence sensor"
	default y
	depends on DT_HAS_ST_STHS34PF80_ENABLED
	select I2C
	help
	  Enable the ST STHS34PF80 infrared presence and motion
	  detection sensor driver.
```

## drivers/sensor/st/vl53l4cd/Kconfig
```kconfig
# Copyright (c) 2026 Dotcom IoT LLP
# SPDX-License-Identifier: Apache-2.0

config VL53L4CD
	bool "VL53L4CD time-of-flight distance sensor"
	default y
	depends on DT_HAS_ST_VL53L4CD_ENABLED
	depends on SENSOR_ASYNC_API
	select I2C
	select RTIO_WORKQ
	help
	  Enable the driver for the ST VL53L4CD time-of-flight distance sensor.
	  The driver only implements the Read and Decode API (sensor_read() and
	  sensor_get_decoder()).
```

## drivers/sensor/st/vl53l5cx/Kconfig
```kconfig
# Copyright (c) 2024 Fabian Blatz <fabianblatz@gmail.com>
# Copyright (c) 2026 STMicroelectronics
# SPDX-License-Identifier: Apache-2.0

menuconfig VL53L5CX
	bool "VL53L5CX Time-of-Flight sensor"
	default y
	depends on DT_HAS_ST_VL53L5CX_ENABLED
	depends on ZEPHYR_HAL_ST_MODULE
	depends on !BUILD_ONLY_NO_BLOBS
	select I2C
	select HAS_STLIB
	select RTIO_WORKQ if SENSOR_ASYNC_API
	help
	  Enable support for the VL53L5CX Time-of-Flight sensor.

config VL53L5CX_MAX_I2C_CHUNK_SIZE
	int "Maximum I2C chunk size allowed"
	default 1024
	depends on VL53L5CX
	help
	  Allow to limit the size of each i2c chunk.
```

## drivers/sensor/tdk/icm20689/Kconfig
```kconfig
# ICM20689 Six-Axis Motion Tracking device configuration options
#
# Copyright (c) 2022 Esco Medical ApS
# Copyright (c) 2020 TDK Invensense
#
# SPDX-License-Identifier: Apache-2.0

menuconfig ICM20689
	bool "ICM-20689 6-Axis Inertial Sensor"
	default y
	depends on DT_HAS_INVENSENSE_ICM20689_ENABLED
	select SPI
	help
	  Enable driver for ICM20689 SPI-based six-axis motion tracking device.

if ICM20689

choice ICM20689_TRIGGER_MODE
	prompt "Trigger mode"
	default ICM20689_TRIGGER_NONE
	help
	  Specify the type of triggering to be used by the driver.

config ICM20689_TRIGGER_NONE
	bool "No trigger"

config ICM20689_TRIGGER_GLOBAL_THREAD
	bool "Use global thread"
	depends on GPIO
	select ICM20689_TRIGGER

config ICM20689_TRIGGER_OWN_THREAD
	bool "Use own thread"
	depends on GPIO
	select ICM20689_TRIGGER

endchoice

config ICM20689_TRIGGER
	bool

config ICM20689_THREAD_PRIORITY
	int "Thread priority"
	depends on ICM20689_TRIGGER_OWN_THREAD
	default 10
	help
	  Priority of thread used by the driver to handle interrupts.

config ICM20689_THREAD_STACK_SIZE
	int "Thread stack size"
	depends on ICM20689_TRIGGER_OWN_THREAD
	default 1024
	help
	  Stack size of thread used by the driver to handle interrupts.

endif # ICM20689
```

## drivers/sensor/tdk/icm20948/Kconfig
```kconfig
# ICM20948 Nine-Axis Motion Tracking device configuration options
#
# Copyright (c) 2026 T3 Gemstone
#	T3 Gemstone Developer Team <support@t3gemstone.org>
#
# SPDX-License-Identifier: Apache-2.0

menuconfig ICM20948
	bool "ICM20948 Nine-Axis Motion Tracking Device"
	default y
	depends on DT_HAS_INVENSENSE_ICM20948_ENABLED
	select SPI
	help
	  Enable driver for the InvenSense ICM20948 motion tracking device.

if ICM20948

choice
	prompt "Trigger mode"
	default ICM20948_TRIGGER_NONE
	help
	  Specify the type of triggering to be used by the driver.

config ICM20948_TRIGGER_NONE
	bool "No trigger"

config ICM20948_TRIGGER_GLOBAL_THREAD
	bool "Use global thread"
	depends on GPIO
	depends on $(dt_compat_any_has_prop,$(DT_COMPAT_INVENSENSE_ICM20948),irq-gpios)
	select ICM20948_TRIGGER

config ICM20948_TRIGGER_OWN_THREAD
	bool "Use own thread"
	depends on GPIO
	depends on $(dt_compat_any_has_prop,$(DT_COMPAT_INVENSENSE_ICM20948),irq-gpios)
	select ICM20948_TRIGGER

endchoice

config ICM20948_TRIGGER
	bool

config ICM20948_THREAD_PRIORITY
	int "Thread priority"
	depends on ICM20948_TRIGGER_OWN_THREAD
	default 10
	help
	  Priority of the thread the driver handles interrupts in.

config ICM20948_THREAD_STACK_SIZE
	int "Thread stack size"
	depends on ICM20948_TRIGGER_OWN_THREAD
	default 1024
	help
	  Stack size of the thread the driver handles interrupts in.

config EMUL_ICM20948
	bool "Emulator for the ICM20948"
	default y
	depends on EMUL
	help
	  Enable the hardware emulator for the ICM20948. Doing so allows
	  exercising the driver without the device being present.

config ICM20948_MAGN_EN
	bool "Magnetometer enable"
	default y
	help
	  Enable the AK09916 magnetometer that sits behind the auxiliary
	  I2C bus of the device.

endif # ICM20948
```

## drivers/sensor/tdk/ictx53xx/Kconfig
```kconfig
# ICTX53XX High Precision 3-axis TMR Magnetometer Sensor
#
# Copyright (c) 2025 TDK Invensense
#
# SPDX-License-Identifier: Apache-2.0

config ICTX53XX
	bool "ICTX53XX High Precision 3-axis TMR Magnetometer Sensor"
	default y
	depends on DT_HAS_INVENSENSE_ICTX53XX_ENABLED
	depends on ZEPHYR_HAL_TDK_MODULE
	select I2C
	select I2C_RTIO
	select USE_EMD_ICTX53XX
	help
	  Enable driver for ICTX53XX I2C-based TMR Magnetometer Sensor.
```

## drivers/sensor/ti/ldc1x1x/Kconfig
```kconfig
# Copyright (c) 2026 RAKwireless Technology Limited
# SPDX-License-Identifier: Apache-2.0

menuconfig LDC1X1X
	bool "LDC1X1X Inductance-to-Digital Converter"
	default y
	depends on DT_HAS_TI_LDC1X1X_ENABLED
	select I2C
	help
	  Enable driver for the Texas Instruments LDC1312, LDC1314,
	  LDC1612, and LDC1614 inductance-to-digital converters.

if LDC1X1X

choice
	prompt "Trigger mode"
	default LDC1X1X_TRIGGER_NONE
	help
	  Specify the type of triggering used by the driver.

config LDC1X1X_TRIGGER_NONE
	bool "No trigger"

config LDC1X1X_TRIGGER_GLOBAL_THREAD
	bool "Use global thread"
	depends on GPIO
	depends on $(dt_compat_any_has_prop,$(DT_COMPAT_TI_LDC1X1X),intb-gpios)
	select LDC1X1X_TRIGGER

config LDC1X1X_TRIGGER_OWN_THREAD
	bool "Use own thread"
	depends on GPIO
	depends on $(dt_compat_any_has_prop,$(DT_COMPAT_TI_LDC1X1X),intb-gpios)
	select LDC1X1X_TRIGGER

endchoice

config LDC1X1X_TRIGGER
	bool

config LDC1X1X_THREAD_PRIORITY
	int "Thread priority"
	depends on LDC1X1X_TRIGGER_OWN_THREAD && LDC1X1X_TRIGGER
	default 10
	help
	  Priority of thread used by the driver to handle interrupts.

config LDC1X1X_THREAD_STACK_SIZE
	int "Thread stack size"
	depends on LDC1X1X_TRIGGER_OWN_THREAD && LDC1X1X_TRIGGER
	default 1024
	help
	  Stack size of thread used by the driver to handle interrupts.

endif # LDC1X1X
```

## drivers/sensor/ti/opt4048/Kconfig
```kconfig
# Copyright (c) 2026 Darshan Maru <darshanmaru1411@gmail.com>
# SPDX-License-Identifier: Apache-2.0

config OPT4048
	bool "TI OPT4048 XYZ tristimulus color sensor"
	default y
	depends on DT_HAS_TI_OPT4048_ENABLED
	select I2C
	select RTIO_WORKQ if SENSOR_ASYNC_API
	help
	  Enable the driver for the TI OPT4048 XYZ tristimulus color sensor.
	  The driver implements the sensor read and decode API
	  (sensor_read() / sensor_decode()), which needs
	  CONFIG_SENSOR_ASYNC_API.

if OPT4048

config OPT4048_CRC_CHECK
	bool "Verify output CRC of every channel"
	default y
	help
	  Verify the 4-bit CRC returned with each channel result. A mismatch
	  makes the read fail with -EIO.

endif # OPT4048
```

## drivers/sensor/ti/tmp1075/Kconfig
```kconfig
# Copyright (c) 2024 Arrow Electronics.
# SPDX-License-Identifier: Apache-2.0

# TMP1075 temperature sensor configuration options

menuconfig TMP1075
	bool "TMP1075 Temperature Sensor"
	default y
	depends on DT_HAS_TI_TMP1075_ENABLED
	select I2C
	select GPIO if $(dt_compat_any_has_prop,$(DT_COMPAT_TI_TMP1075),alert-gpios)

	help
	  Enable the driver for Texas Instruments TMP1075 High-Accuracy Digital
	  Temperature Sensors.

if TMP1075

module = TMP1075
thread_priority = 10
thread_stack_size = 1024
source "drivers/sensor/Kconfig.trigger_template"

endif # TMP1075
```

## drivers/sensor/ti/tmp108/Kconfig
```kconfig
# TMP108 temperature sensor configuration options

# Copyright (c) 2021 Jimmy Johnson <catch22@fastmail.net>
# Copyright (c) 2022 T-Mobile USA, Inc.
# Copyright (c) 2025 Byteflies NV
# SPDX-License-Identifier: Apache-2.0

menuconfig TMP108
	bool "TMP108 Temperature Sensor"
	default y
	depends on DT_HAS_TI_TMP108_ENABLED || DT_HAS_AMS_AS6212_ENABLED \
			|| DT_HAS_AMS_AS6221_ENABLED
	select I2C

	help
	  Enable driver for the TMP108 temperature sensor and/or it's variants,
	  the AMS AS621x, AS6221.

if TMP108

module = TMP108
thread_priority = 10
thread_stack_size = 1024
source "drivers/sensor/Kconfig.trigger_template"

endif # TMP108
```

## drivers/sensor/wsen/wsen_hids_2525020210002/Kconfig
```kconfig
# Copyright (c) 2024 Würth Elektronik eiSos GmbH & Co. KG
# SPDX-License-Identifier: Apache-2.0

config WSEN_HIDS_2525020210002
	bool "WSEN-HIDS-2525020210002 humidity sensor"
	default y
	depends on DT_HAS_WE_WSEN_HIDS_2525020210002_ENABLED
	depends on ZEPHYR_HAL_WURTHELEKTRONIK_MODULE
	select I2C
	select HAS_WESENSORS
	help
	  Enable driver for the WSEN-HIDS-2525020210002 I2C-based humidity sensor.
```

## drivers/sensor/wsen/wsen_pdms_25131308XXX05/Kconfig
```kconfig
# Copyright (c) 2025 Würth Elektronik eiSos GmbH & Co. KG
# SPDX-License-Identifier: Apache-2.0

config WSEN_PDMS_25131308XXX05
	bool "WSEN-PDMS-25131308XXX05 differential pressure sensor"
	default y
	depends on DT_HAS_WE_WSEN_PDMS_25131308XXX05_ENABLED
	depends on ZEPHYR_HAL_WURTHELEKTRONIK_MODULE
	select I2C if $(dt_compat_on_bus,$(DT_COMPAT_WE_WSEN_PDMS_25131308XXX05),i2c)
	select SPI if $(dt_compat_on_bus,$(DT_COMPAT_WE_WSEN_PDMS_25131308XXX05),spi)
	select HAS_WESENSORS
	help
	  Enable driver for the WSEN-PDMS-25131308XXX05 I2C/SPI-based differential pressure sensor.
```

## drivers/serial/Kconfig.abov32
```kconfig
# Copyright (c) 2026 ABOV Semiconductor Co., Ltd.
# SPDX-License-Identifier: Apache-2.0

config USART_ABOV32
	bool "ABOV32 USART serial driver"
	default y
	depends on DT_HAS_ABOV_ABOV32_USART_ENABLED
	select PINCTRL
	select CLOCK_CONTROL
	select SERIAL_HAS_DRIVER
	select SERIAL_SUPPORT_INTERRUPT
	help
	  Enable the asynchronous (UART mode) driver for the ABOV32 USART
	  peripheral, built on the ABOV HLL USART API (hll_usart.h).
```

## drivers/serial/Kconfig.ameba_loguart
```kconfig
# Copyright (c) 2024 Realtek Semiconductor Corp.
# SPDX-License-Identifier: Apache-2.0

config UART_AMEBA_LOGUART
	bool "Ameba LOGUART driver"
	default y
	depends on DT_HAS_REALTEK_AMEBA_LOGUART_ENABLED
	select SERIAL_HAS_DRIVER
	select SERIAL_SUPPORT_INTERRUPT
	help
	  This option enables the LOGUART driver for Realtek Ameba SoCs.

config UART_AMEBA_LOGUART_XCORE_LOCK
	bool "Serialize LOGUART output across cores"
	depends on UART_AMEBA_LOGUART
	help
	  The LOGUART muxes the CA32, KM4 and KM0 TX paths per byte, so
	  concurrent console output interleaves mid-line. Buffer a line per
	  core and flush it under a hardware semaphore; only useful when more
	  than one core runs this driver.

if UART_AMEBA_LOGUART_XCORE_LOCK

config UART_AMEBA_LOGUART_XCORE_LINE_MAX
	int "Per-core console line buffer size"
	default 128
	help
	  Bytes buffered per core before a flush. Longer lines are flushed in
	  chunks that may interleave with other cores.

config UART_AMEBA_LOGUART_XCORE_SEM_ID
	int "Core-to-core hardware semaphore index"
	range 7 15
	default 15
	help
	  IPC hardware semaphore for the console line flush. IDs 0-6 belong to
	  the vendor firmware (IMQ/FLASH/OTP/CRYPTO/DIAGNOSE/SYSON/GDMA).

endif # UART_AMEBA_LOGUART_XCORE_LOCK
```

## drivers/serial/Kconfig.beken
```kconfig
# Copyright The Zephyr Project Contributors
# SPDX-License-Identifier: Apache-2.0

config UART_BEKEN_BK7258
	bool "Beken BK7258 serial driver"
	default y
	depends on DT_HAS_BEKEN_BK7258_UART_ENABLED
	select SERIAL_HAS_DRIVER
	select SERIAL_SUPPORT_INTERRUPT
	select PINCTRL
	help
	  This option enables the Beken BK7258 serial driver.
```

## drivers/serial/Kconfig.bk7258
```kconfig
# Copyright (c) 2026 Beken Corporation
# SPDX-License-Identifier: Apache-2.0

config UART_BK7258
	bool "Beken BK7258 UART driver"
	default y
	depends on DT_HAS_BEKEN_BK7258_UART_ENABLED
	select SERIAL_HAS_DRIVER
	help
	  UART driver for the Beken BK7258, polled mode:
	  poll_in / poll_out / err_check and the optional runtime configure.

config UART_BK7258_NO_HW_INIT
	bool "Do not initialise the UART hardware"
	depends on UART_BK7258
	help
	  With this set, driver init only registers the device and writes no
	  register at all; transmit and receive go straight to the FIFO.

	  This is for ports that the firmware the device ships with configured
	  before this image started, and that this image may only borrow: the normal
	  init sequence (soft reset, pin muxing, divider) would break that console.
```

## drivers/serial/Kconfig.cc27xx
```kconfig
# Copyright (c) 2024 Texas Instruments Incorporated
# Copyright (c) 2024 BayLibre, SAS
#
# SPDX-License-Identifier: Apache-2.0

config UART_CC27XX
	bool "TI SimpleLink Cc27xx UART driver"
	default y
	depends on DT_HAS_TI_CC27XX_UART_ENABLED
	select SERIAL_HAS_DRIVER
	select SERIAL_SUPPORT_INTERRUPT
	select SERIAL_SUPPORT_ASYNC
	select PINCTRL
	help
	  Enable the TI SimpleLink CC27XX UART driver.

config UART_CC27XX_DMA_DRIVEN
	bool "DMA support for TI CC27XX UART devices"
	depends on UART_CC27XX
	depends on UART_ASYNC_API
	select DMA
	help
	  DMA driven mode offloads data transfer tasks from the CPU.
```

## drivers/serial/Kconfig.cc35xx
```kconfig
# SPDX-License-Identifier: Apache-2.0

config UART_CC35XX
	bool "CC35XX UART driver"
	default y
	depends on DT_HAS_TI_CC35XX_UART_ENABLED
	select SERIAL_HAS_DRIVER
	select SERIAL_SUPPORT_INTERRUPT
	select PINCTRL
	help
	  This option enables the CC35XX UART driver
```

## drivers/serial/Kconfig.emul_bridge
```kconfig
# SPDX-FileCopyrightText: 2026 Muhammad Waleed Badar
# SPDX-License-Identifier: Apache-2.0

config UART_EMUL_BRIDGE
	bool "Emulated UART bridge"
	default y
	depends on DT_HAS_ZEPHYR_UART_EMUL_BRIDGE_ENABLED
	depends on UART_EMUL
	select UART_INTERRUPT_DRIVEN
	help
	  Bridge a UART with the wire side of an emulated UART, so a terminal
	  on the UART drives the console or shell running on the emulated one.

config UART_EMUL_BRIDGE_BUF_SIZE
	int "Bytes buffered towards the UART"
	default 64
	depends on UART_EMUL_BRIDGE
	help
	  Data from the emulated UART waits here until the UART transmits it.
```

## drivers/serial/Kconfig.goldfish
```kconfig
# Copyright (c) 2026 Dimitri Varpusvuori
# SPDX-License-Identifier: Apache-2.0

config UART_GOLDFISH
	bool "Goldfish TTY driver"
	default y
	depends on DT_HAS_GOOGLE_GOLDFISH_TTY_ENABLED
	select SERIAL_HAS_DRIVER
```

## drivers/serial/Kconfig.hi3861
```kconfig
# SPDX-FileCopyrightText: Copyright The Zephyr Project Contributors
# SPDX-License-Identifier: Apache-2.0

DT_COMPAT_HISILICON_HI3861_UART := hisilicon,hi3861-uart

config UART_HI3861
	bool "HiSilicon Hi3861 UART"
	default y
	depends on DT_HAS_HISILICON_HI3861_UART_ENABLED
	select SERIAL_HAS_DRIVER
	select SERIAL_SUPPORT_INTERRUPT if SYS_CLOCK_EXISTS
	select PINCTRL if $(dt_compat_any_has_prop,$(DT_COMPAT_HISILICON_HI3861_UART),pinctrl-0)
	help
	  Enable the Hi3861 UART driver, with polling, runtime configuration
	  and interrupt-driven transfers. Hardware RTS/CTS is available on
	  UART1 and UART2, but not UART0.

	  Interrupt-driven TX uses a one-shot kernel timer to seed the FIFO
	  in ISR context, and requires the system clock.
```
