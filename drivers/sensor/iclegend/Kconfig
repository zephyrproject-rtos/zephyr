## drivers/sensor/iclegend/Kconfig
```kconfig
# SPDX-FileCopyrightText: Copyright The Zephyr Project Contributors
# SPDX-License-Identifier: Apache-2.0

source "drivers/sensor/iclegend/s3km1110/Kconfig"
```

## drivers/sensor/iclegend/s3km1110/Kconfig
```kconfig
# SPDX-FileCopyrightText: Copyright The Zephyr Project Contributors
# SPDX-License-Identifier: Apache-2.0

config S3KM1110
	bool "Iclegend S3KM1110 24GHz mmWave sensor"
	default y
	depends on DT_HAS_ICLEGEND_S3KM1110_ENABLED
	depends on UART_INTERRUPT_DRIVEN
	select UART
	help
	  Enable driver for the Iclegend S3KM1110 UART radar.

config S3KM1110_UART_TIMEOUT_MS
	int "UART frame timeout in milliseconds"
	default 100
	depends on S3KM1110
	help
	  Timeout used while waiting for each report frame.
```

## drivers/sensor/icm20600/Kconfig
```kconfig
# Kconfig - ICM20600 Six-Axis Motion Tracking device configuration options

#
# SPDX-License-Identifier: Apache-2.0
#

menuconfig ICM20600
	bool "ICM20600 Six-Axis Motion Tracking Device"
	depends on I2C
	help
	  Enable driver for ICM20600 I2C-based six-axis motion tracking device.

if ICM20600

choice
	prompt "Trigger mode"
	default ICM20600_TRIGGER_NONE    #ICM20600_TRIGGER_GLOBAL_THREAD
	help
	  Specify the type of triggering to be used by the driver.

config ICM20600_TRIGGER_NONE
	bool "No trigger"

config ICM20600_TRIGGER_GLOBAL_THREAD
	bool "Use global thread"
	select ICM20600_TRIGGER

config ICM20600_TRIGGER_OWN_THREAD
	bool "Use own thread"
	select ICM20600_TRIGGER

endchoice

config ICM20600_TRIGGER
	bool

config ICM20600_THREAD_PRIORITY
	int "Own thread priority"
	depends on BMI160_TRIGGER_OWN_THREAD
	default 10
	help
	  The priority of the thread used for handling interrupts.

config ICM20600_THREAD_STACK_SIZE
	int "Own thread stack size"
	depends on BMI160_TRIGGER_OWN_THREAD
	default 1024
	help
	  The thread stack size.

config ICM20600_ACCEL_FS
	int "Accelerometer full-scale range"
	default 2
	help
	  Magnetometer full-scale range.
	  An X value for the config represents a range of +/- X g. Valid
	  values are 2, 4, 8 and 16.

config ICM20600_GYRO_FS
	int "Gyroscope full-scale range"
	default 250
	help
	  Gyroscope full-scale range.
	  An X value for the config represents a range of +/- X degrees/second.
	  Valid values are 250, 500, 1000, 2000.

endif # ICM20600
```

## drivers/sensor/icm20948/Kconfig
```kconfig
# Kconfig.ICM20498 - ICM20498 ICM-20498 I2C-based or SPI-based IMU
# SPDX-License-Identifier: Apache-2.0

menuconfig ICM20948
	bool "ICM20498 sensor"
	depends on I2C || SPI
	help
	  Enable driver for ICM-20498 I2C-based or SPI-based IMU.

if ICM20948
choice
	prompt "Accelerometer full-scale range"
	default ICM20948_ACCEL_RANGE_RUNTIME

config ICM20948_ACCEL_RANGE_RUNTIME
	bool "Set at runtime (Default 2G)"

config ICM20948_ACCEL_RANGE_2G
	bool "2G"

config ICM20948_ACCEL_RANGE_4G
	bool "4G"

config ICM20948_ACCEL_RANGE_8G
	bool "8G"

config ICM20948_ACCEL_RANGE_16G
	bool "16G"

endchoice


choice
	prompt "Gyro full-scale range"
	default ICM20948_GYRO_RANGE_RUNTIME

config ICM20948_GYRO_RANGE_RUNTIME
	bool "Set at runtime (Default +-250 dps)"

config ICM20948_GYRO_RANGE_250
	bool "+-250 dps"

config ICM20948_GYRO_RANGE_500
	bool "+-500 dps"

config ICM20948_GYRO_RANGE_1000
	bool "+-1000 dps"

config ICM20948_GYRO_RANGE_2000
	bool "+-2000 dps"
endchoice

config ICM20948_I2C_AD0
	bool "AD0"
	default y
	help
	  The AD0 will determine the slave address of the device in i2C mode.
	  AD0 high will yield 0x69 and AD0 low will yield 0x68

endif # ICM20948
```

## drivers/sensor/icm42370/Kconfig
```kconfig
# ICM42370 Three-Axis Motion Tracking device configuration options
#
# Copyright (c) 2024 TDK Invensense
#
# SPDX-License-Identifier: Apache-2.0

menuconfig ICM42370
	bool "ICM42370 Three-Axis Motion Tracking Device"
	default y
	depends on DT_HAS_INVENSENSE_ICM42370_ENABLED
	select I2C
	help
	  Enable driver for ICM42370 I2C-based three-axis motion tracking device.

if ICM42370

choice ICM42370_TRIGGER_MODE
	prompt "Trigger mode"
	default ICM42370_TRIGGER_GLOBAL_THREAD
	help
	  Specify the type of triggering to be used by the driver.

config ICM42370_TRIGGER_NONE
	bool "No trigger"

config ICM42370_TRIGGER_GLOBAL_THREAD
	bool "Use global thread"
	depends on GPIO
	select ICM42370_TRIGGER

config ICM42370_TRIGGER_OWN_THREAD
	bool "Use own thread"
	depends on GPIO
	select ICM42370_TRIGGER

endchoice

config ICM42370_TRIGGER
	bool

config ICM42370_THREAD_PRIORITY
	int "Thread priority"
	depends on ICM42370_TRIGGER_OWN_THREAD
	default 10
	help
	  Priority of thread used by the driver to handle interrupts.

config ICM42370_THREAD_STACK_SIZE
	int "Thread stack size"
	depends on ICM42370_TRIGGER_OWN_THREAD
	default 1024
	help
	  Stack size of thread used by the driver to handle interrupts.

endif # ICM42370
```

## drivers/sensor/icm42605/Kconfig
```kconfig
# ICM42605 Six-Axis Motion Tracking device configuration options

# Copyright (c) 2020 TDK Invensense
# SPDX-License-Identifier: Apache-2.0

menuconfig ICM42605
	bool "ICM42605 Six-Axis Motion Tracking Device"
	default y
	depends on DT_HAS_INVENSENSE_ICM42605_ENABLED
	depends on SPI
	help
	  Enable driver for ICM42605 SPI-based six-axis motion tracking device.

if ICM42605

choice ICM42605_TRIGGER_MODE
	prompt "Trigger mode"
	default ICM42605_TRIGGER_GLOBAL_THREAD
	help
	  Specify the type of triggering to be used by the driver.

config ICM42605_TRIGGER_NONE
	bool "No trigger"

config ICM42605_TRIGGER_GLOBAL_THREAD
	bool "Use global thread"
	depends on GPIO
	select ICM42605_TRIGGER

endchoice

config ICM42605_TRIGGER
	bool

config ICM42605_THREAD_PRIORITY
	int "Thread priority"
	depends on ICM42605_TRIGGER_GLOBAL_THREAD
	default 10
	help
	  Priority of thread used by the driver to handle interrupts.

config ICM42605_THREAD_STACK_SIZE
	int "Thread stack size"
	depends on ICM42605_TRIGGER_GLOBAL_THREAD
	default 1024
	help
	  Stack size of thread used by the driver to handle interrupts.

endif # ICM42605
```

## drivers/sensor/icm42670/Kconfig
```kconfig
# ICM42670 Six-Axis Motion Tracking device configuration options
#
# Copyright (c) 2022 Esco Medical ApS
# Copyright (c) 2020 TDK Invensense
#
# SPDX-License-Identifier: Apache-2.0

DT_COMPAT_ICM42670 := invensense,icm42670

menuconfig ICM42670
	bool "ICM42670 Six-Axis Motion Tracking Device"
	default $(dt_compat_enabled,$(DT_COMPAT_ICM42670))
	depends on SPI
	help
	  Enable driver for ICM42670 SPI-based six-axis motion tracking device.

if ICM42670

choice ICM42670_TRIGGER_MODE
	prompt "Trigger mode"
	default ICM42670_TRIGGER_NONE
	help
	  Specify the type of triggering to be used by the driver.

config ICM42670_TRIGGER_NONE
	bool "No trigger"

config ICM42670_TRIGGER_GLOBAL_THREAD
	bool "Use global thread"
	depends on GPIO
	select ICM42670_TRIGGER

config ICM42670_TRIGGER_OWN_THREAD
	bool "Use own thread"
	depends on GPIO
	select ICM42670_TRIGGER

endchoice

config ICM42670_TRIGGER
	bool

config ICM42670_THREAD_PRIORITY
	int "Thread priority"
	depends on ICM42670_TRIGGER_OWN_THREAD
	default 10
	help
	  Priority of thread used by the driver to handle interrupts.

config ICM42670_THREAD_STACK_SIZE
	int "Thread stack size"
	depends on ICM42670_TRIGGER_OWN_THREAD
	default 1024
	help
	  Stack size of thread used by the driver to handle interrupts.

endif # ICM42670
```

## drivers/sensor/icm42688/Kconfig
```kconfig
# ICM42688-P Six-Axis Motion Tracking device configuration options
#
# Copyright (c) 2022 Intel Corporation
#
# SPDX-License-Identifier: Apache-2.0

config ICM42688
	bool "ICM42688 Six-Axis Motion Tracking Device"
	default y
	depends on DT_HAS_INVENSENSE_ICM42688_ENABLED
	select SPI
	help
	  Enable driver for ICM42688 SPI-based six-axis motion tracking device.

config EMUL_ICM42688
	bool "Emulator for the ICM42688"
	default y
	depends on ICM42688
	depends on EMUL
	help
	  Enable the hardware emulator for the ICM42688. Doing so allows exercising
	  sensor APIs for this IMU in native_posix and qemu.

if ICM42688

choice
	prompt "Trigger mode"
	default ICM42688_TRIGGER_GLOBAL_THREAD
	help
	  Specify the type of triggering to be used by the driver

config ICM42688_TRIGGER_NONE
	bool "No trigger"

config ICM42688_TRIGGER_GLOBAL_THREAD
	bool "Use global thread"
	select ICM42688_TRIGGER

config ICM42688_TRIGGER_OWN_THREAD
	bool "Use own thread"
	select ICM42688_TRIGGER

endchoice

config ICM42688_TRIGGER
	bool

config ICM42688_THREAD_PRIORITY
	int "Own thread priority"
	depends on ICM42688_TRIGGER_OWN_THREAD
	default 10
	help
	  The priority of the thread used for handling interrupts.

config ICM42688_THREAD_STACK_SIZE
	int "Own thread stack size"
	depends on ICM42688_TRIGGER_OWN_THREAD
	default 1024
	help
	  The thread stack size.

endif # ICM42688
```

## drivers/sensor/iis2dh/Kconfig
```kconfig
# ST Microelectronics IIS2DH 3-axis accelerometer driver

# Copyright (c) 2020 STMicroelectronics
# SPDX-License-Identifier: Apache-2.0

menuconfig IIS2DH
	bool "IIS2DH I2C/SPI accelerometer sensor driver"
	default y
	depends on DT_HAS_ST_IIS2DH_ENABLED
	select I2C if $(dt_compat_on_bus,$(DT_COMPAT_ST_IIS2DH),i2c)
	select SPI if $(dt_compat_on_bus,$(DT_COMPAT_ST_IIS2DH),spi)
	select HAS_STMEMSC
	select USE_STDC_IIS2DH
	help
	  Enable driver for IIS2DH accelerometer sensor driver

if IIS2DH

choice IIS2DH_TRIGGER_MODE
	prompt "Trigger mode"
	help
	  Specify the type of triggering to be used by the driver.

config IIS2DH_TRIGGER_NONE
	bool "No trigger"

config IIS2DH_TRIGGER_GLOBAL_THREAD
	bool "Use global thread"
	depends on GPIO
	select IIS2DH_TRIGGER

config IIS2DH_TRIGGER_OWN_THREAD
	bool "Use own thread"
	depends on GPIO
	select IIS2DH_TRIGGER

endchoice

config IIS2DH_TRIGGER
	bool

if IIS2DH_TRIGGER

config IIS2DH_THREAD_PRIORITY
	int "Thread priority"
	depends on IIS2DH_TRIGGER_OWN_THREAD
	default 10
	help
	  Priority of thread used by the driver to handle interrupts.

config IIS2DH_THREAD_STACK_SIZE
	int "Thread stack size"
	depends on IIS2DH_TRIGGER_OWN_THREAD
	default 1024
	help
	  Stack size of thread used by the driver to handle interrupts.

endif # IIS2DH_TRIGGER

config IIS2DH_RANGE
	int "Accelerometer Full-scale range setting"
	default 0
	help
	  Specify the default accelerometer full-scale range.
	  Valid values are:
	  0:  Full Scale selected at runtime
	  2:  +/- 2g
	  4:  +/- 4g
	  8:  +/- 8g
	  16: +/- 16g

config IIS2DH_ODR
	int "Accelerometer sampling frequency (ODR)"
	range 0 9
	default 0
	help
	  Specify the default accelerometer output data rate expressed in
	  samples per second (Hz).
	  0: ODR selected at runtime
	  1: 1 Hz
	  2: 10 Hz
	  3: 25 Hz
	  4: 50 Hz
	  5: 100 Hz
	  6: 200 Hz
	  7: 400 Hz
	  8: 1620 Hz (only LP)
	  9: Depends by mode. LP: 5376 Hz - NORM or HR: 1344 Hz

config IIS2DH_POWER_MODE
	int "Sensor Power Modes"
	range 0 2
	default 0
	help
	  Specify the sensor power mode
	  0: High Resolution mode
	  1: Normal mode
	  2: Low Power mode

endif # IIS2DH
```

## drivers/sensor/iis2dlpc/Kconfig
```kconfig
# ST Microelectronics IIS2DLPC 3-axis accelerometer driver

# Copyright (c) 2020 STMicroelectronics
# SPDX-License-Identifier: Apache-2.0

menuconfig IIS2DLPC
	bool "IIS2DLPC I2C/SPI accelerometer sensor driver"
	default y
	depends on DT_HAS_ST_IIS2DLPC_ENABLED
	select I2C if $(dt_compat_on_bus,$(DT_COMPAT_ST_IIS2DLPC),i2c)
	select SPI if $(dt_compat_on_bus,$(DT_COMPAT_ST_IIS2DLPC),spi)
	select HAS_STMEMSC
	select USE_STDC_IIS2DLPC
	help
	  Enable driver for IIS2DLPC accelerometer sensor driver

if IIS2DLPC

choice IIS2DLPC_TRIGGER_MODE
	prompt "Trigger mode"
	help
	  Specify the type of triggering to be used by the driver.

config IIS2DLPC_TRIGGER_NONE
	bool "No trigger"

config IIS2DLPC_TRIGGER_GLOBAL_THREAD
	bool "Use global thread"
	depends on GPIO
	select IIS2DLPC_TRIGGER

config IIS2DLPC_TRIGGER_OWN_THREAD
	bool "Use own thread"
	depends on GPIO
	select IIS2DLPC_TRIGGER

endchoice

config IIS2DLPC_TRIGGER
	bool

if IIS2DLPC_TRIGGER

config IIS2DLPC_THREAD_PRIORITY
	int "Thread priority"
	depends on IIS2DLPC_TRIGGER_OWN_THREAD
	default 10
	help
	  Priority of thread used by the driver to handle interrupts.

config IIS2DLPC_THREAD_STACK_SIZE
	int "Thread stack size"
	depends on IIS2DLPC_TRIGGER_OWN_THREAD
	default 1024
	help
	  Stack size of thread used by the driver to handle interrupts.

config IIS2DLPC_TAP
	bool "Tap and Tap-Tap detection"
	help
	  Enable tap (single/double) detection

config IIS2DLPC_ACTIVITY
	bool "Activity detection"
	help
	  Enable activity/inactivity detection

endif # IIS2DLPC_TRIGGER

endif # IIS2DLPC
```

## drivers/sensor/iis2iclx/Kconfig
```kconfig
# ST Microelectronics IIS2ICLX 2-axis accelerometer sensor driver

# Copyright (c) 2020 STMicroelectronics
# SPDX-License-Identifier: Apache-2.0

menuconfig IIS2ICLX
	bool "IIS2ICLX I2C/SPI accelerometer Chip"
	default y
	depends on DT_HAS_ST_IIS2ICLX_ENABLED
	depends on I2C || SPI
	select HAS_STMEMSC
	select USE_STDC_IIS2ICLX
	help
	  Enable driver for IIS2ICLX accelerometer
	  sensor.

if IIS2ICLX

choice IIS2ICLX_TRIGGER_MODE
	prompt "Trigger mode"
	help
	  Specify the type of triggering to be used by the driver.

config IIS2ICLX_TRIGGER_NONE
	bool "No trigger"

config IIS2ICLX_TRIGGER_GLOBAL_THREAD
	bool "Use global thread"
	depends on GPIO
	select IIS2ICLX_TRIGGER

config IIS2ICLX_TRIGGER_OWN_THREAD
	bool "Use own thread"
	depends on GPIO
	select IIS2ICLX_TRIGGER

endchoice

config IIS2ICLX_TRIGGER
	bool

if IIS2ICLX_TRIGGER

config IIS2ICLX_THREAD_PRIORITY
	int "Thread priority"
	depends on IIS2ICLX_TRIGGER_OWN_THREAD
	default 10
	help
	  Priority of thread used by the driver to handle interrupts.

config IIS2ICLX_THREAD_STACK_SIZE
	int "Thread stack size"
	depends on IIS2ICLX_TRIGGER_OWN_THREAD
	default 1024
	help
	  Stack size of thread used by the driver to handle interrupts.

endif # IIS2ICLX_TRIGGER

config IIS2ICLX_ENABLE_TEMP
	bool "Temperature"
	help
	  Enable/disable temperature

config IIS2ICLX_SENSORHUB
	bool "I2C sensorhub feature"
	help
	  Enable/disable internal sensorhub. You can enable
	  a maximum of two external sensors (if more than two are enabled
	  the system would enumerate only the first two found)

if IIS2ICLX_SENSORHUB

config IIS2ICLX_EXT_LIS2MDL
	bool "LIS2MDL as external sensor"

config IIS2ICLX_EXT_IIS2MDC
	bool "IIS2MDC as external sensor"

config IIS2ICLX_EXT_LPS22HH
	bool "LPS22HH as external sensor"

config IIS2ICLX_EXT_HTS221
	bool "HTS221 as external sensor"

config IIS2ICLX_EXT_LPS22HB
	bool "LPS22HB as external sensor"

endif # IIS2ICLX_SENSORHUB

endif # IIS2ICLX
```

## drivers/sensor/iis2mdc/Kconfig
```kconfig
# Copyright (c) 2020 STMicroelectronics
# SPDX-License-Identifier: Apache-2.0

menuconfig IIS2MDC
	bool "IIS2MDC Magnetometer"
	depends on I2C || SPI
	select HAS_STMEMSC
	select USE_STDC_IIS2MDC
	help
	  Enable driver for IIS2MDC I2C-based magnetometer sensor.

if IIS2MDC

choice IIS2MDC_TRIGGER_MODE
	prompt "Trigger mode"
	default IIS2MDC_TRIGGER_GLOBAL_THREAD
	help
	  Specify the type of triggering to be used by the driver.

config IIS2MDC_TRIGGER_NONE
	bool "No trigger"

config IIS2MDC_TRIGGER_GLOBAL_THREAD
	bool "Use global thread"
	depends on GPIO
	select IIS2MDC_TRIGGER

config IIS2MDC_TRIGGER_OWN_THREAD
	bool "Use own thread"
	depends on GPIO
	select IIS2MDC_TRIGGER

endchoice # IIS2MDC_TRIGGER_MODE

config IIS2MDC_TRIGGER
	bool

config IIS2MDC_THREAD_PRIORITY
	int "Thread priority"
	depends on IIS2MDC_TRIGGER_OWN_THREAD
	default 10
	help
	  Priority of thread used by the driver to handle interrupts.

config IIS2MDC_THREAD_STACK_SIZE
	int "Thread stack size"
	depends on IIS2MDC_TRIGGER_OWN_THREAD
	default 1024
	help
	  Stack size of thread used by the driver to handle interrupts.

config IIS2MDC_MAG_ODR_RUNTIME
	bool "Set magnetometer sampling frequency (ODR) at runtime (default: 10 Hz)"
	default y

config IIS2MDC_SPI_FULL_DUPLEX
	bool "Enable SPI 4wire mode (separated MISO and MOSI lines)"
	depends on SPI

endif # IIS2MDC
```
