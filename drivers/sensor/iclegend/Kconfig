## drivers/sensor/iis3dwb/Kconfig
```kconfig
# ST Microelectronics IIS3DWB 3-axis accelerometer driver

# Copyright (c) 2020 STMicroelectronics
# SPDX-License-Identifier: Apache-2.0

menuconfig IIS3DWB
	bool "IIS3DWB SPI accelerometer sensor driver"
	depends on SPI
	select HAS_STMEMSC
	select USE_STDC_IIS3DWB
	help
	  Enable driver for IIS3DWB accelerometer sensor driver

if IIS3DWB

choice IIS3DWB_TRIGGER_MODE
	prompt "Trigger mode"
	help
	  Specify the type of triggering to be used by the driver.

config IIS3DWB_TRIGGER_NONE
	bool "No trigger"

config IIS3DWB_TRIGGER_GLOBAL_THREAD
	bool "Use global thread"
	depends on GPIO
	select IIS3DWB_TRIGGER

config IIS3DWB_TRIGGER_OWN_THREAD
	bool "Use own thread"
	depends on GPIO
	select IIS3DWB_TRIGGER

endchoice

config IIS3DWB_TRIGGER
	bool

if IIS3DWB_TRIGGER

config IIS3DWB_THREAD_PRIORITY
	int "Thread priority"
	depends on IIS3DWB_TRIGGER_OWN_THREAD
	default 10
	help
	  Priority of thread used by the driver to handle interrupts.

config IIS3DWB_THREAD_STACK_SIZE
	int "Thread stack size"
	depends on IIS3DWB_TRIGGER_OWN_THREAD
	default 1024
	help
	  Stack size of thread used by the driver to handle interrupts.

endif # IIS3DWB_TRIGGER

endif # IIS3DWB
```

## drivers/sensor/ina219/Kconfig
```kconfig
# INA219 Bidirectional Current/Power Monitor

# Copyright (c) 2021 Leonard Pollak
# SPDX-License-Identifier: Apache-2.0

config INA219
	bool "INA219 Current/Power Monitor"
	default y
	depends on DT_HAS_TI_INA219_ENABLED
	depends on I2C
	help
	  Enable driver for INA219 Bidirectional Current/Power Monitor.
```

## drivers/sensor/ina23x/Kconfig
```kconfig
# Copyright 2021 The Chromium OS Authors
#
# SPDX-License-Identifier: Apache-2.0

config INA23X
	bool "INA23X Current and Power Monitor"
	depends on I2C
	help
	  Enable driver for INA23X Current and Power Monitor.

if INA23X

config INA230
	bool "INA230"
	help
	  Enable driver for INA230/INA231.

config INA237
	bool "INA237"
	help
	  Enable driver for INA237.

config INA230_TRIGGER
	bool "INA230 trigger mode"
	depends on INA230
	help
	  Set to enable trigger mode using gpio interrupt, where
	  interrupts are configured to line ALERT PIN.

endif # INA23X
```

## drivers/sensor/infineon/Kconfig
```kconfig
# SPDX-FileCopyrightText: <text>Copyright (c) 2026 Infineon Technologies AG,
# or an affiliate of Infineon Technologies AG. All rights reserved.</text>
#
# SPDX-License-Identifier: Apache-2.0

# zephyr-keep-sorted-start
source "drivers/sensor/infineon/autanalog_temp/Kconfig"
source "drivers/sensor/infineon/dps310/Kconfig"
source "drivers/sensor/infineon/tle9104/Kconfig"
source "drivers/sensor/infineon/xmc4xxx_temp/Kconfig"
# zephyr-keep-sorted-stop
```

## drivers/sensor/infineon/autanalog_temp/Kconfig
```kconfig
# SPDX-FileCopyrightText: <text>Copyright (c) 2026 Infineon Technologies AG,
# or an affiliate of Infineon Technologies AG. All rights reserved.</text>
#
# SPDX-License-Identifier: Apache-2.0

config INFINEON_AUTANALOG_TEMP
	bool "Infineon AutAnalog die temperature sensor"
	default y
	depends on DT_HAS_INFINEON_AUTANALOG_DIE_TEMP_ENABLED
	select ADC
	help
	  Enable the Infineon PSOC Edge AutAnalog die temperature sensor driver.
	  The driver wraps the AutAnalog SAR ADC internal temperature-sensor MUX
	  channel and exposes it as a Zephyr SENSOR_CHAN_DIE_TEMP channel.

config INFINEON_AUTANALOG_TEMP_VREF_TRIM_WORKAROUND
	bool "Clear the AREF VREF bandgap trim after AutAnalog init"
	default y
	depends on INFINEON_AUTANALOG_TEMP
	help
	  Workaround for B0 silicon: Cy_AutAnalog_Init() loads the factory
	  AREF VREF trim constants from RRAM into INFRA->AREF.VREF_TRIM1 and
	  VREF_TRIM2.  On B0 silicon these constants are not valid and skew the
	  bandgap reference, which makes the SAR die-temperature conversion read
	  low.  When enabled, the MFD driver clears VREF_TRIM1 and VREF_TRIM2
	  immediately after Cy_AutAnalog_Init(), so the correction applies to all
	  AutAnalog consumers (SAR ADC samples and the die-temperature sensor
	  driver) without per-application code.  Disable on silicon revisions
	  that ship with valid AREF VREF trim values.
```

## drivers/sensor/infineon/tle9104/Kconfig
```kconfig
# Copyright (c) 2024 SILA Embedded Solutions GmbH
# SPDX-License-Identifier: Apache-2.0

config TLE9104_DIAGNOSTICS
	bool "Output diagnostics of TLE9104"
	default y
	depends on DT_HAS_INFINEON_TLE9104_DIAGNOSTICS_ENABLED
	help
	  Enable driver for the output diagnostics of the power train
	  switch TLE9104.
```

## drivers/sensor/infineon/tlv493d/Kconfig
```kconfig
# TLV493D 3D magnetic sensor configuration options

# Copyright (c) 2026 Junseo Pyun
# SPDX-License-Identifier: Apache-2.0

config TLV493D
	bool "TLV493D Magnetic Sensor"
	default y
	depends on DT_HAS_INFINEON_TLV493D_ENABLED
	select I2C
	help
	  Enable the driver for Infineon TLV493D 3D Magnetic Sensor.
```

## drivers/sensor/isl29035/Kconfig
```kconfig
# Kconfig - ISL29035 light sensor configuration options

#
# Copyright (c) 2016 Intel Corporation
#
# SPDX-License-Identifier: Apache-2.0
#

menuconfig ISL29035
	bool "ISL29035 light sensor"
	depends on I2C
	help
	  Enable driver for the ISL29035 light sensor.

if ISL29035

config ISL29035_NAME
	string "Driver name"
	default "ISL29035"
	help
	  Device name with which the ISL29035 sensor is identified.

config ISL29035_I2C_MASTER_DEV_NAME
	string "I2C Master"
	default "I2C_0"
	help
	  The device name of the I2C master device to which the ISL29035
	  chip is connected.

config ISL29035_THREAD_PRIORITY
	int "Thread priority"
	default 10
	help
	  Priority of thread used to handle the timer and threshold triggers.

choice
	prompt "Full scale lux range"
	default ISL29035_LUX_RANGE_1K
	help
	  Maximum allowable lux value. Lower range values offer better
	  resolution.

config ISL29035_LUX_RANGE_1K
	bool "1000"

config ISL29035_LUX_RANGE_4K
	bool "4000"

config ISL29035_LUX_RANGE_16K
	bool "16000"

config ISL29035_LUX_RANGE_64K
	bool "64000"

endchoice

choice
	prompt "Integration time"
	default ISL29035_INTEGRATION_TIME_105K
	help
	  The sampling period of the internal ADC of the light sensor.
	  Lower integration time values mean lower ADC resolution.

config ISL29035_INTEGRATION_TIME_26
	bool "0.0256 ms"

config ISL29035_INTEGRATION_TIME_410
	bool "0.41 ms"

config ISL29035_INTEGRATION_TIME_6500
	bool "6.5 ms"

config ISL29035_INTEGRATION_TIME_105K
	bool "105 ms"

endchoice

choice
	prompt "Active sensing mode"
	default ISL29035_MODE_ALS
	help
	  Sensing mode in which the ISL29035 will function. The chip can be
	  configured either for either ambient light or infrared sensing.

config ISL29035_MODE_ALS
	bool "ambient light"
	help
	  Sensing mode for ambient light spectrum.

config ISL29035_MODE_IR
	bool "infrared"
	help
	  Sensing mode for infrared spectrum.

endchoice

choice
	prompt "Trigger mode"
	depends on ISL29035_MODE_ALS && GPIO
	default ISL29035_TRIGGER_NONE
	help
	  Specify the type of triggering to be used by the driver.
	  Only available for ambient light sensing mode.

config ISL29035_TRIGGER_NONE
	bool "No trigger"

config ISL29035_TRIGGER_GLOBAL_THREAD
	bool "Use global thread"
	depends on GPIO
	select ISL29035_TRIGGER

config ISL29035_TRIGGER_OWN_THREAD
	bool "Use own thread"
	depends on GPIO
	select ISL29035_TRIGGER

endchoice

config ISL29035_TRIGGER
	bool

config ISL29035_GPIO_DEV_NAME
	string "GPIO device"
	default "GPIO_0"
	depends on ISL29035_TRIGGER
	help
	  The device name of the GPIO device to which the ISL29035 interrupt
	  pin is connected.

config ISL29035_GPIO_PIN_NUM
	int "GPIO pin number"
	default 0
	depends on ISL29035_TRIGGER
	help
	  The number of the GPIO pin to which the ISL29035 interrupt pin is
	  connected.

config ISL29035_THREAD_PRIORITY
	int "Thread priority"
	depends on ISL29035_TRIGGER_OWN_THREAD
	default 10
	help
	  Priority of thread used by the driver to handle interrupts.

config ISL29035_THREAD_STACK_SIZE
	int "Thread stack size"
	depends on ISL29035_TRIGGER_OWN_THREAD
	default 1024
	help
	  Stack size of thread used by the driver to handle interrupts.

choice
	prompt "Interrupt persist cycles"
	depends on ISL29035_TRIGGER
	default ISL29035_INT_PERSIST_1
	help
	  Number of consecutive integration cycles for which the data samples
	  need to remain outside the threshold window in order for the interrupt
	  to be triggered.

config ISL29035_INT_PERSIST_1
	bool "1"

config ISL29035_INT_PERSIST_4
	bool "4"

config ISL29035_INT_PERSIST_8
	bool "8"

config ISL29035_INT_PERSIST_16
	bool "16"

endchoice

endif # ISL29035
```

## drivers/sensor/isl29125/Kconfig
```kconfig
# ISL29125 Color Light to Digital Converter configuration options

# Copyright(c) 2020 Intive
# SPDX-License-Identifier: Apache-2.0

menuconfig ISL29125
	bool "ISL29125 Color Light to Digital Converter"
	depends on I2C
	help
	  Enable driver for ISL29125 Color Light to Digital Converter.

if ISL29125

choice
	prompt "Trigger mode"
	depends on GPIO
	default ISL29125_TRIGGER_NONE
	help
	  Specify the type of triggering to be used by the driver.

config ISL29125_TRIGGER_NONE
	bool "No trigger"

config ISL29125_TRIGGER_GLOBAL_THREAD
	bool "Use global thread"
	depends on GPIO
	select ISL29125_TRIGGER

config ISL29125_TRIGGER_OWN_THREAD
	bool "Use own thread"
	depends on GPIO
	select ISL29125_TRIGGER
endchoice

config ISL29125_TRIGGER
	bool

config ISL29125_THREAD_PRIORITY
	int "Thread priority"
	depends on ISL29125_TRIGGER_OWN_THREAD
	default 10
	help
	  Priority of thread used by the driver to handle interrupts.

config ISL29125_THREAD_STACK_SIZE
	int "Thread stack size"
	depends on ISL29125_TRIGGER_OWN_THREAD
	default 1024
	help
	  Stack size of thread used by the driver to handle interrupts.

endif # ISL29125
```

## drivers/sensor/ism330dhcx/Kconfig
```kconfig
# ST Microelectronics ISM330DHCX 6-axis IMU sensor driver

# Copyright (c) 2020 STMicroelectronics
# SPDX-License-Identifier: Apache-2.0

menuconfig ISM330DHCX
	bool "ISM330DHCX I2C/SPI accelerometer and gyroscope Chip"
	depends on I2C || SPI
	select HAS_STMEMSC
	select USE_STDC_ISM330DHCX
	help
	  Enable driver for ISM330DHCX accelerometer and gyroscope
	  sensor.

if ISM330DHCX

choice ISM330DHCX_TRIGGER_MODE
	prompt "Trigger mode"
	help
	  Specify the type of triggering to be used by the driver.

config ISM330DHCX_TRIGGER_NONE
	bool "No trigger"

config ISM330DHCX_TRIGGER_GLOBAL_THREAD
	bool "Use global thread"
	depends on GPIO
	select ISM330DHCX_TRIGGER

config ISM330DHCX_TRIGGER_OWN_THREAD
	bool "Use own thread"
	depends on GPIO
	select ISM330DHCX_TRIGGER

endchoice

config ISM330DHCX_TRIGGER
	bool

if ISM330DHCX_TRIGGER

config ISM330DHCX_THREAD_PRIORITY
	int "Thread priority"
	depends on ISM330DHCX_TRIGGER_OWN_THREAD
	default 10
	help
	  Priority of thread used by the driver to handle interrupts.

config ISM330DHCX_THREAD_STACK_SIZE
	int "Thread stack size"
	depends on ISM330DHCX_TRIGGER_OWN_THREAD
	default 1024
	help
	  Stack size of thread used by the driver to handle interrupts.

choice ISM330DHCX_INT_PIN
	prompt "Sensor INT pin number"
	default ISM330DHCX_INT_PIN_1
	help
	  The number of ISM330DHCX int pin used to generate interrupt to cpu.
	  Supported values are int1 or int2

config ISM330DHCX_INT_PIN_1
	bool "int1"

config ISM330DHCX_INT_PIN_2
	bool "int2"
endchoice

endif # ISM330DHCX_TRIGGER

config ISM330DHCX_ENABLE_TEMP
	bool "Enable temperature"
	help
	  Enable/disable temperature

config ISM330DHCX_SENSORHUB
	bool "Enable I2C sensorhub feature"
	help
	  Enable/disable internal sensorhub. You can enable
	  a maximum of two external sensors (if more than two are enabled
	  the system would enumerate only the first two found)

if ISM330DHCX_SENSORHUB

config ISM330DHCX_EXT_LIS2MDL
	bool "Enable LIS2MDL as external sensor"

config ISM330DHCX_EXT_IIS2MDC
	bool "Enable IIS2MDC as external sensor"

config ISM330DHCX_EXT_LPS22HH
	bool "Enable LPS22HH as external sensor"

config ISM330DHCX_EXT_HTS221
	bool "Enable HTS221 as external sensor"

config ISM330DHCX_EXT_LPS22HB
	bool "Enable LPS22HB as external sensor"

endif # ISM330DHCX_SENSORHUB

menu "Attributes"

config ISM330DHCX_GYRO_FS
	int "Gyroscope full-scale range"
	default 0
	help
	  Specify the default gyroscope full-scale range.
	  An X value for the config represents a range of +/- X degree per
	  second. Valid values are:
	  0:  Full Scale selected at runtime
	  125:   +/- 125dps
	  250:   +/- 250dps
	  500:   +/- 500dps
	  1000:  +/- 1000dps
	  2000:  +/- 2000dps

config ISM330DHCX_GYRO_ODR
	int "Gyroscope Output data rate frequency"
	range 0 10
	default 0
	help
	  Specify the default accelerometer output data rate expressed in
	  samples per second (Hz).
	  0: ODR selected at runtime
	  1: 12.5Hz
	  2: 26Hz
	  3: 52Hz
	  4: 104Hz
	  5: 208Hz
	  6: 416Hz
	  7: 833Hz
	  8: 1660Hz
	  9: 3330Hz
	  10: 6660Hz

config ISM330DHCX_ACCEL_FS
	int "Accelerometer full-scale range"
	default 0
	help
	  Specify the default accelerometer full-scale range.
	  An X value for the config represents a range of +/- X G. Valid values
	  are:
	  0:  Full Scale selected at runtime
	  2:  +/- 2g
	  4:  +/- 4g
	  8:  +/- 8g
	  16: +/- 16g

config ISM330DHCX_ACCEL_ODR
	int "Accelerometer Output data rate frequency"
	range 0 10
	default 0
	help
	  Specify the default accelerometer output data rate expressed in
	  samples per second (Hz).
	  0: ODR selected at runtime
	  1: 12.5Hz
	  2: 26Hz
	  3: 52Hz
	  4: 104Hz
	  5: 208Hz
	  6: 416Hz
	  7: 833Hz
	  8: 1660Hz
	  9: 3330Hz
	  10: 6660Hz
endmenu

endif # ISM330DHCX
```

## drivers/sensor/ist8310/Kconfig
```kconfig
# IST8310 Geomagnetic sensor configuration options

# Copyright (c) 2023 NXP Semiconductors
# Copyright (c) 2023 Cognipilot Foundation
# SPDX-License-Identifier: Apache-2.0

config IST8310
	bool "IST8310 I2C Geomagnetic Chip"
	default y
	depends on DT_HAS_ISENTEK_IST8310_ENABLED
	select I2C
	help
	  Enable driver for IST8310 I2C-based Geomagnetic sensor.
```

## drivers/sensor/ite/Kconfig
```kconfig
# Copyright (c) 2024 Analog Devices, Inc.
# SPDX-License-Identifier: Apache-2.0

# zephyr-keep-sorted-start
source "drivers/sensor/ite/ite_tach_it8xxx2/Kconfig"
source "drivers/sensor/ite/ite_vcmp_it8xxx2/Kconfig"
# zephyr-keep-sorted-stop
```

## drivers/sensor/ite/ite_tach_it51xxx/Kconfig
```kconfig
# Copyright (c) 2025 ITE Technology Corporation.
# SPDX-License-Identifier: Apache-2.0

config TACH_IT51XXX
	bool "ITE it51xxx Tachometer sensor"
	default y
	depends on DT_HAS_ITE_IT51XXX_TACH_ENABLED
	depends on SOC_IT51XXX
	select PINCTRL
	help
	  Enable the ITE it51xxx tachometer sensor,
	  it51xxx supports three 16-bit tachometer sensor, each sensor has two
	  input pin, and we need to select one input from them.
```
