## drivers/sensor/mpr/Kconfig
```kconfig
# MPR pressure sensor configuration options

# Copyright (c) 2020 Sven Herrmann
# SPDX-License-Identifier: Apache-2.0

menuconfig MPR
	bool "MPR pressure sensor"
	depends on I2C && HAS_DTS_I2C
	help
	  Enable driver for MPR pressure sensor.

if MPR

choice
	prompt "MPR Pressure Range"
	default MPR_PRESSURE_RANGE_0025
config MPR_PRESSURE_RANGE_0001
	bool "0 to 1"
config MPR_PRESSURE_RANGE_01_6
	bool "0 to 1.6"
config MPR_PRESSURE_RANGE_02_5
	bool "0 to 2.5"
config MPR_PRESSURE_RANGE_0015
	bool "0 to 15"
config MPR_PRESSURE_RANGE_0025
	bool "0 to 25"
config MPR_PRESSURE_RANGE_0030
	bool "0 to 30"
config MPR_PRESSURE_RANGE_0060
	bool "0 to 60"
config MPR_PRESSURE_RANGE_0100
	bool "0 to 100"
config MPR_PRESSURE_RANGE_0160
	bool "0 to 160"
config MPR_PRESSURE_RANGE_0250
	bool "0 to 250"
config MPR_PRESSURE_RANGE_0400
	bool "0 to 400"
config MPR_PRESSURE_RANGE_0600
	bool "0 to 600"
endchoice

choice
	prompt "MPR Pressure Unit"
	default MPR_PRESSURE_UNIT_P
config MPR_PRESSURE_UNIT_P
	bool "psi"
config MPR_PRESSURE_UNIT_K
	bool "kPa"
config MPR_PRESSURE_UNIT_B
	bool "bar"
config MPR_PRESSURE_UNIT_M
	bool "mbar"
endchoice

choice
	prompt "MPR Transfer Function"
	default MPR_TRANSFER_FUNCTION_A
config MPR_TRANSFER_FUNCTION_A
	bool "A"
config MPR_TRANSFER_FUNCTION_B
	bool "B"
config MPR_TRANSFER_FUNCTION_C
	bool "C"
endchoice

endif # MPR
```

## drivers/sensor/mpu6050/Kconfig
```kconfig
# Kconfig - MPU6050 Six-Axis Motion Tracking device configuration options

#
# Copyright (c) 2016 Intel Corporation
#
# SPDX-License-Identifier: Apache-2.0
#

menuconfig MPU6050
	bool "MPU6050 Six-Axis Motion Tracking Device"
	depends on I2C
	help
	  Enable driver for MPU6050 I2C-based six-axis motion tracking device.

if MPU6050

config MPU6050_NAME
	string "Driver name"
	default "MPU6050"
	help
	  Device name with which the MPU6050 sensor is identified.

config MPU6050_I2C_ADDR
	hex "I2C address"
	default 0x68
	range 0x68 0x69
	help
	  I2C address of the MPU6050 sensor.
	  Choose 0x68 if the AD0 pin is pulled to GND or 0x69 if the AD0 pin
	  is pulled to VDD.

config MPU6050_I2C_MASTER_DEV_NAME
	string "I2C master where MPU6050 is connected"
	default "I2C_0"
	help
	  Specify the device name of the I2C master device to which MPU6050 is
	  connected.

choice
	prompt "Trigger mode"
	default MPU6050_TRIGGER_GLOBAL_THREAD
	help
	  Specify the type of triggering to be used by the driver.

config MPU6050_TRIGGER_NONE
	bool "No trigger"

config MPU6050_TRIGGER_GLOBAL_THREAD
	bool "Use global thread"
	depends on GPIO
	select MPU6050_TRIGGER

config MPU6050_TRIGGER_OWN_THREAD
	bool "Use own thread"
	depends on GPIO
	select MPU6050_TRIGGER

endchoice

config MPU6050_TRIGGER
	bool

config MPU6050_GPIO_DEV_NAME
	string "GPIO device"
	default "GPIO_0"
	depends on MPU6050_TRIGGER
	help
	  The device name of the GPIO device to which the MPU6050 interrupt pin
	  is connected.

config MPU6050_GPIO_PIN_NUM
	int "Interrupt GPIO pin number"
	default 0
	depends on MPU6050_TRIGGER
	help
	  The number of the GPIO on which the interrupt signal from the MPU6050
	  chip will be received.

config MPU6050_THREAD_PRIORITY
	int "Thread priority"
	depends on MPU6050_TRIGGER_OWN_THREAD
	default 10
	help
	  Priority of thread used by the driver to handle interrupts.

config MPU6050_THREAD_STACK_SIZE
	int "Thread stack size"
	depends on MPU6050_TRIGGER_OWN_THREAD
	default 1024
	help
	  Stack size of thread used by the driver to handle interrupts.

config MPU6050_ACCEL_FS
	int "Accelerometer full-scale range"
	default 2
	help
	  Magnetometer full-scale range.
	  An X value for the config represents a range of +/- X g. Valid
	  values are 2, 4, 8 and 16.

config MPU6050_GYRO_FS
	int "Gyroscope full-scale range"
	default 250
	help
	  Gyroscope full-scale range.
	  An X value for the config represents a range of +/- X degrees/second.
	  Valid values are 250, 500, 1000, 2000.

endif # MPU6050
```

## drivers/sensor/mpu9150/Kconfig
```kconfig
# MPU9150 Nine-Axis Motion Tracking device configuration options

# Copyright (c) 2022 Benjamin Björnsson <benjamin.bjornsson@gmail.com>.
# SPDX-License-Identifier: Apache-2.0

config MPU9150
	bool "MPU9150 Nine-Axis Motion Tracking Device"
	depends on I2C
	help
	  Enable driver for MPU9150 I2C-based nine-axis motion tracking device.
```

## drivers/sensor/mpu9250/Kconfig
```kconfig
# MPU9250 Nine-Axis Motion Tracking device configuration options

# Copyright (c) 2021 Nordic Semiconductor ASA
# SPDX-License-Identifier: Apache-2.0

menuconfig MPU9250
	bool "MPU9250 Nine-Axis Motion Tracking Device"
	default y
	depends on DT_HAS_INVENSENSE_MPU9250_ENABLED
	select I2C
	help
	  Enable driver for MPU9250 I2C-based nine-axis motion tracking device.

if MPU9250

choice
	prompt "Trigger mode"
	default MPU9250_TRIGGER_GLOBAL_THREAD
	help
	  Specify the type of triggering to be used by the driver.

config MPU9250_TRIGGER_NONE
	bool "No trigger"

config MPU9250_TRIGGER_GLOBAL_THREAD
	bool "Use global thread"
	depends on GPIO
	select MPU9250_TRIGGER

config MPU9250_TRIGGER_OWN_THREAD
	bool "Use own thread"
	depends on GPIO
	select MPU9250_TRIGGER

endchoice

config MPU9250_TRIGGER
	bool

config MPU9250_THREAD_PRIORITY
	int "Thread priority"
	depends on MPU9250_TRIGGER_OWN_THREAD
	default 10
	help
	  Priority of thread used by the driver to handle interrupts.

config MPU9250_THREAD_STACK_SIZE
	int "Thread stack size"
	depends on MPU9250_TRIGGER_OWN_THREAD
	default 1024
	help
	  Stack size of thread used by the driver to handle interrupts.

config MPU9250_MAGN_EN
	bool "Magnetometer enable"
	default y
	help
	  Enable AK8963 builtin magnetometer.

endif # MPU9250
```

## drivers/sensor/ms5607/Kconfig
```kconfig
# MS5607 pressure sensor configuration options

# Copyright (c) 2019 Thomas Schmid <tom@lfence.de>
# SPDX-License-Identifier: Apache-2.0

menuconfig MS5607
	bool "MS5607 pressure and temperature sensor"
	default y
	depends on DT_HAS_MEAS_MS5607_ENABLED
	depends on I2C || SPI
	help
	  Enable driver for MS5607 pressure and temperature sensor.

if MS5607

choice
	prompt "Pressure oversampling."
	default MS5607_PRES_OVER_2048X

config MS5607_PRES_OVER_256X
	bool "x256"

config MS5607_PRES_OVER_512X
	bool "x512"

config MS5607_PRES_OVER_1024X
	bool "x1024"

config MS5607_PRES_OVER_2048X
	bool "x2048"

config MS5607_PRES_OVER_4096X
	bool "x4096"

endchoice


choice
	prompt "Temperature oversampling."
	default MS5607_TEMP_OVER_2048X

config MS5607_TEMP_OVER_256X
	bool "x256"

config MS5607_TEMP_OVER_512X
	bool "x512"

config MS5607_TEMP_OVER_1024X
	bool "x1024"

config MS5607_TEMP_OVER_2048X
	bool "x2048"

config MS5607_TEMP_OVER_4096X
	bool "x4096"

endchoice

endif # MS5607
```

## drivers/sensor/ms5611/Kconfig
```kconfig
# MS5611 barometer

# Copyright (c) 2022, Karol Duda
# SPDX-License-Identifier: Apache-2.0

config MS5611
	bool "MS5611 Barometer"
	default y
	depends on DT_HAS_MEAS_MS5611_ENABLED
	select I2C
	help
		Enable MS5611 barometer driver.
```

## drivers/sensor/ms5837/Kconfig
```kconfig
# MS5837 pressure sensor configuration options

# Copyright (c) 2018 Jan Van Winkel <jan.van_winkel@dxplore.eu>
# SPDX-License-Identifier: Apache-2.0

config MS5837
	bool "MS5837 pressure and temperature sensor"
	depends on I2C
	help
	  Enable driver for MS5837 pressure and temperature sensor.
```

## drivers/sensor/nct75/Kconfig
```kconfig
# Copyright (c) 2024 Benedikt Schmidt <benediktibk@gmail.com>
# SPDX-License-Identifier: Apache-2.0

config NCT75
	bool "NCT75 temperature sensor"
	default y
	depends on DT_HAS_ONNN_NCT75_ENABLED
	select I2C
	help
	  Enable driver for the NCT75 temperature sensor.
```

## drivers/sensor/nooploop/Kconfig
```kconfig
# Copyright (c) 2025 Alex Fabre
# SPDX-License-Identifier: Apache-2.0

# zephyr-keep-sorted-start
source "drivers/sensor/nooploop/tofsense/Kconfig"
# zephyr-keep-sorted-stop
```

## drivers/sensor/nooploop/tofsense/Kconfig
```kconfig
# Nooploop TOFSense Time of Flight sensor configuration options

# Copyright (c) 2025 Alex Fabre
# SPDX-License-Identifier: Apache-2.0

menuconfig TOFSENSE
	bool "Nooploop TOFSense ToF sensor"
	default y
	depends on DT_HAS_NOOPLOOP_TOFSENSE_ENABLED
	help
	  Enable UART/CAN-based driver for the Nooploop TOFSense,
	  time of flight sensor.

if TOFSENSE

config TOFSENSE_BUS_UART
	bool "UART TOFSense driver"
	default y
	depends on $(dt_compat_on_bus,$(DT_COMPAT_NOOPLOOP_TOFSENSE),uart)
	depends on UART_INTERRUPT_DRIVEN
	select UART

config TOFSENSE_BUS_CAN
	bool "CAN TOFSense driver"
	default y
	depends on $(dt_compat_any_has_prop,$(DT_COMPAT_NOOPLOOP_TOFSENSE),can-bus)
	select CAN

endif # TOFSENSE
```

## drivers/sensor/nordic/Kconfig
```kconfig
# Copyright (c) 2024 Analog Devices, Inc.
# SPDX-License-Identifier: Apache-2.0

# zephyr-keep-sorted-start
source "drivers/sensor/nordic/npm1300_charger/Kconfig"
source "drivers/sensor/nordic/npm2100_vbat/Kconfig"
source "drivers/sensor/nordic/qdec_nrfx/Kconfig"
source "drivers/sensor/nordic/temp/Kconfig"
# zephyr-keep-sorted-stop
```

## drivers/sensor/nordic/npm10xx_adc/Kconfig
```kconfig
# Copyright (c) 2026 Nordic Semiconductor
# SPDX-License-Identifier: Apache-2.0

config NPM10XX_ADC
	bool "nPM10xx ADC driver"
	default y
	depends on DT_HAS_NORDIC_NPM10XX_ADC_ENABLED
	select I2C
	help
	  Enable the Nordic nPM10xx ADC driver.
```

## drivers/sensor/nordic/npm13xx_charger/Kconfig
```kconfig
# Copyright (c) 2023 Nordic Semiconductor ASA
#
# SPDX-License-Identifier: Apache-2.0

config NPM13XX_CHARGER
	bool "nPM13xx Charger"
	default y
	depends on DT_HAS_NORDIC_NPM1300_CHARGER_ENABLED || DT_HAS_NORDIC_NPM1304_CHARGER_ENABLED
	select I2C
	select MFD
	select REQUIRES_FULL_LIBC
	help
	  Enable nPM13xx charger driver.
```

## drivers/sensor/nordic/npm2100_vbat/Kconfig
```kconfig
# Copyright (c) 2024 Nordic Semiconductor ASA
#
# SPDX-License-Identifier: Apache-2.0

config NPM2100_VBAT
	bool "NPM2100 Battery Voltage"
	default y
	depends on DT_HAS_NORDIC_NPM2100_VBAT_ENABLED
	select I2C
	select MFD
	help
	  Enable NPM2100 battery voltage driver.
```

## drivers/sensor/nordic/nrf5/Kconfig
```kconfig
# nRF5 temperature sensor configuration options

# Copyright (c) 2016 ARM Ltd.
# SPDX-License-Identifier: Apache-2.0

config TEMP_NRF5_FORCE_ALT
	bool
	depends on SOC_COMPATIBLE_NRF
	help
	  This option can be enabled to force an alternative implementation
	  of the temperature sensor driver.

config TEMP_NRF5
	bool "nRF5 Temperature Sensor"
	default y
	depends on DT_HAS_NORDIC_NRF_TEMP_ENABLED
	depends on HAS_HW_NRF_TEMP
	depends on MULTITHREADING || TEMP_NRF5_FORCE_ALT
	help
	  Enable driver for nRF5 temperature sensor.
```

## drivers/sensor/nordic/qdec_nrfx/Kconfig
```kconfig
# Copyright (c) 2018, Nordic Semiconductor ASA
# SPDX-License-Identifier: Apache-2.0

config QDEC_NRFX
	bool "Nordic QDEC nrfx driver"
	default y
	depends on DT_HAS_NORDIC_NRF_QDEC_ENABLED
	select NRFX_QDEC0 if HAS_HW_NRF_QDEC0
	select NRFX_QDEC1 if HAS_HW_NRF_QDEC1
	select NRFX_QDEC20 if HAS_HW_NRF_QDEC20
	select NRFX_QDEC21 if HAS_HW_NRF_QDEC21
	select NRFX_QDEC130 if HAS_HW_NRF_QDEC130
	select NRFX_QDEC131 if HAS_HW_NRF_QDEC131
	select PINCTRL
	help
	  Enable support for nrfx QDEC driver for nRF MCU series.
```

## drivers/sensor/nordic/temp/Kconfig
```kconfig
# nRF temperature sensor configuration options

# Copyright (c) 2016 ARM Ltd.
# Copyright (c) 2024 Nordic Semiconductor ASA
# SPDX-License-Identifier: Apache-2.0

config TEMP_NRF5_FORCE_ALT
	bool
	depends on SOC_COMPATIBLE_NRF
	help
	  This option can be enabled to force an alternative implementation
	  of the temperature sensor driver.

config TEMP_NRF5
	bool "nRF5 Temperature Sensor"
	default y
	depends on DT_HAS_NORDIC_NRF_TEMP_ENABLED
	depends on MULTITHREADING || TEMP_NRF5_FORCE_ALT
	help
	  Enable driver for nRF5 temperature sensor.

config TEMP_NRFS
	bool "nRF Temperature Sensor accessed via nrfs"
	default y
	depends on DT_HAS_NORDIC_NRF_TEMP_NRFS_ENABLED
	depends on NRFS
	help
	  Enable driver for nRF temperature sensor accessed through the nRF
	  Services (nrfs) layer.

if TEMP_NRFS && NRFS_TEMP_SERVICE_SUBSCRIPTION_ENABLED

module = TEMP_NRFS
thread_priority = 10
thread_stack_size = 1024
source "drivers/sensor/Kconfig.trigger_template"

endif
```

## drivers/sensor/nordic/vbat/Kconfig
```kconfig
# Copyright (c) 2026 Nordic Semiconductor ASA
#
# SPDX-License-Identifier: Apache-2.0

config NRF_VBAT
	bool "nRF battery voltage sensor (SAADC via Zephyr ADC)"
	default y
	depends on DT_HAS_NORDIC_NRF_VBAT_ENABLED
	select ADC
	help
	  Enable the Nordic nRF VBAT sensor driver. The devicetree node must
	  specify io-channels defining an SAADC channel.
```

## drivers/sensor/npm1300_charger/Kconfig
```kconfig
# Copyright (c) 2023 Nordic Semiconductor ASA
#
# SPDX-License-Identifier: Apache-2.0

config NPM1300_CHARGER
	bool "NPM1300 Charger"
	default y
	depends on DT_HAS_NORDIC_NPM1300_CHARGER_ENABLED
	select I2C
	select MFD
	select REQUIRES_FULL_LIBC
	help
	  Enable NPM1300 charger driver.
```

## drivers/sensor/nrf5/Kconfig
```kconfig
# nRF5 temperature sensor configuration options

# Copyright (c) 2016 ARM Ltd.
# SPDX-License-Identifier: Apache-2.0

config TEMP_NRF5
	bool "nRF5 Temperature Sensor"
	depends on HAS_HW_NRF_TEMP
	help
	  Enable driver for nRF5 temperature sensor.
```

## drivers/sensor/ntc_thermistor/Kconfig
```kconfig
# Copyright (c) 2023 Google LLC
#
# SPDX-License-Identifier: Apache-2.0

config NTC_THERMISTOR
	bool "NTC Thermistor"
	default y
	depends on DT_HAS_NTC_THERMISTOR_GENERIC_ENABLED || \
		   DT_HAS_EPCOS_B57861S0103A039_ENABLED  || \
		   DT_HAS_MURATA_NCP15WB473_ENABLED || \
		   DT_HAS_TDK_NTCG163JF103FT1_ENABLED
	select ADC
	help
	  Enable driver for Zephyr NTC Thermistor.
```

## drivers/sensor/nuvoton/Kconfig
```kconfig
# Copyright (c) 2024 Analog Devices, Inc.
# SPDX-License-Identifier: Apache-2.0

# zephyr-keep-sorted-start
source "drivers/sensor/nuvoton/nuvoton_adc_cmp_npcx/Kconfig"
source "drivers/sensor/nuvoton/nuvoton_tach_npcx/Kconfig"
source "drivers/sensor/nuvoton/nuvoton_tach_npcm/Kconfig"
source "drivers/sensor/nuvoton/nuvoton_tach_nct/Kconfig"
# zephyr-keep-sorted-stop
```

## drivers/sensor/nuvoton/nuvoton_adc_cmp_npcx/Kconfig
```kconfig
#  ADC CMP NPCX driver configuration options

# Copyright (c) 2022 Intel Corporation.
# SPDX-License-Identifier: Apache-2.0

if ADC_NPCX

config ADC_CMP_NPCX
	bool "Nuvoton NPCX ADC threshold detection interruption"
	default y
	depends on DT_HAS_NUVOTON_ADC_CMP_ENABLED
	help
	  This option enables threshold interruption using sensor
	  trigger API.

if ADC_CMP_NPCX

config ADC_CMP_NPCX_WORKQUEUE
	bool "NPCX ADC threshold detection uses internal work queue"
	help
	  Threshold detection ISR utilizes system work queue for calling
	  trigger handlers; set this option to use dedicated work queue instead.

if ADC_CMP_NPCX_WORKQUEUE

config ADC_CMP_NPCX_WORKQUEUE_PRIORITY
	int "Nuvoton NPCX ADC trheshold detection work queue priority"
	default SYSTEM_WORKQUEUE_PRIORITY
	help
	  This option sets internal ADC NPCX threshold detection workqueue
	  priority.

config ADC_CMP_NPCX_WORKQUEUE_STACK_SIZE
	int "Nuvoton NPCX ADC trheshold detection work queue stack size"
	default 768
	help
	  This option sets internal ADC NPCX threshold detection workqueue
	  stack size.

endif # ADC_CMP_NPCX_WORKQUEUE

endif # ADC_CMP_NPCX

endif # ADC_NPCX
```

## drivers/sensor/nuvoton/nuvoton_adc_v2t_npcx/Kconfig
```kconfig
#  ADC V2T NPCX driver configuration options

# Copyright (c) 2025 Intel Corporation.
# SPDX-License-Identifier: Apache-2.0

config ADC_V2T_NPCX
	bool "Nuvoton NPCX ADC V2T enable"
	default y
	depends on ADC_NPCX
	depends on DT_HAS_NUVOTON_NPCX_ADC_V2T_ENABLED
	depends on $(dt_compat_any_has_prop,$(DT_COMPAT_NUVOTON_NPCX_ADC_V2T),support-npckn-v1,True)
	help
	  This option enables the ADC V2T (voltage to temperature)
	  driver.
```
