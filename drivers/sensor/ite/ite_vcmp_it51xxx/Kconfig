## drivers/sensor/lis2ds12/Kconfig
```kconfig
# ST Microelectronics LIS2DS12 3-axis accelerometer driver

# Copyright (c) 2019 STMicroelectronics
# SPDX-License-Identifier: Apache-2.0

menuconfig LIS2DS12
	bool "LIS2DS12 I2C/SPI accelerometer sensor driver"
	default y
	depends on DT_HAS_ST_LIS2DS12_ENABLED
	select I2C if $(dt_compat_on_bus,$(DT_COMPAT_ST_LIS2DS12),i2c)
	select SPI if $(dt_compat_on_bus,$(DT_COMPAT_ST_LIS2DS12),spi)
	select HAS_STMEMSC
	select USE_STDC_LIS2DS12
	help
	  Enable driver for LIS2DS12 accelerometer sensor driver

if LIS2DS12

choice LIS2DS12_TRIGGER_MODE
	prompt "Trigger mode"
	help
	  Specify the type of triggering to be used by the driver.

config LIS2DS12_TRIGGER_NONE
	bool "No trigger"

config LIS2DS12_TRIGGER_GLOBAL_THREAD
	bool "Use global thread"
	depends on GPIO
	select LIS2DS12_TRIGGER

config LIS2DS12_TRIGGER_OWN_THREAD
	bool "Use own thread"
	depends on GPIO
	select LIS2DS12_TRIGGER

endchoice

config LIS2DS12_TRIGGER
	bool

config LIS2DS12_THREAD_PRIORITY
	int "Thread priority"
	depends on LIS2DS12_TRIGGER_OWN_THREAD
	default 10
	help
	  Priority of thread used by the driver to handle interrupts.

config LIS2DS12_THREAD_STACK_SIZE
	int "Thread stack size"
	depends on LIS2DS12_TRIGGER_OWN_THREAD
	default 1024
	help
	  Stack size of thread used by the driver to handle interrupts.

config LIS2DS12_ENABLE_TEMP
	bool "Temperature"
	help
	  Enable/disable temperature

endif # LIS2DS12
```

## drivers/sensor/lis2du12/Kconfig
```kconfig
# ST Microelectronics LIS2DU12 3-axis accelerometer sensor driver

# Copyright (c) 2023 STMicroelectronics
# SPDX-License-Identifier: Apache-2.0

menuconfig LIS2DU12
	bool "LIS2DU12 I2C/SPI smartxl Chip"
	default y
	depends on DT_HAS_ST_LIS2DU12_ENABLED
	depends on ZEPHYR_HAL_ST_MODULE
	select I2C if $(dt_compat_on_bus,$(DT_COMPAT_ST_LIS2DU12),i2c)
	select SPI if $(dt_compat_on_bus,$(DT_COMPAT_ST_LIS2DU12),spi)
	select HAS_STMEMSC
	select USE_STDC_LIS2DU12
	help
	  Enable driver for LIS2DU12 smartxl sensor.

if LIS2DU12

module = LIS2DU12
thread_priority = 10
thread_stack_size = 1024
source "drivers/sensor/Kconfig.trigger_template"

endif # LIS2DU12
```

## drivers/sensor/lis2dux12/Kconfig
```kconfig
# ST Microelectronics LIS2DUX12 3-axis accelerometer sensor driver

# Copyright (c) 2023 STMicroelectronics
# SPDX-License-Identifier: Apache-2.0

menuconfig LIS2DUX12
	bool "LIS2DUX12 I2C/SPI smartxl Chip"
	default y
	depends on DT_HAS_ST_LIS2DUX12_ENABLED
	select I2C if $(dt_compat_on_bus,$(DT_COMPAT_ST_LIS2DUX12),i2c)
	select SPI if $(dt_compat_on_bus,$(DT_COMPAT_ST_LIS2DUX12),spi)
	select HAS_STMEMSC
	select USE_STDC_LIS2DUX12
	help
	  Enable driver for LIS2DUX12 smartxl
	  sensor.

if LIS2DUX12

choice LIS2DUX12_TRIGGER_MODE
	prompt "Trigger mode"
	help
	  Specify the type of triggering to be used by the driver.

config LIS2DUX12_TRIGGER_NONE
	bool "No trigger"

config LIS2DUX12_TRIGGER_GLOBAL_THREAD
	bool "Use global thread"
	depends on GPIO
	select LIS2DUX12_TRIGGER

config LIS2DUX12_TRIGGER_OWN_THREAD
	bool "Use own thread"
	depends on GPIO
	select LIS2DUX12_TRIGGER

endchoice

config LIS2DUX12_TRIGGER
	bool

if LIS2DUX12_TRIGGER

config LIS2DUX12_THREAD_PRIORITY
	int "Thread priority"
	depends on LIS2DUX12_TRIGGER_OWN_THREAD
	default 10
	help
	  Priority of thread used by the driver to handle interrupts.

config LIS2DUX12_THREAD_STACK_SIZE
	int "Thread stack size"
	depends on LIS2DUX12_TRIGGER_OWN_THREAD
	default 1024
	help
	  Stack size of thread used by the driver to handle interrupts.

endif # LIS2DUX12_TRIGGER

config LIS2DUX12_ENABLE_TEMP
	bool "Temperature"
	help
	  Enable/disable temperature

endif # LIS2DUX12
```

## drivers/sensor/lis2duxs12/Kconfig
```kconfig
# ST Microelectronics LIS2DUXS12 3-axis accelerometer sensor driver

# Copyright (c) 2023 STMicroelectronics
# SPDX-License-Identifier: Apache-2.0

menuconfig LIS2DUXS12
	bool "LIS2DUXS12 I2C/SPI smartxl Chip"
	default y
	depends on DT_HAS_ST_LIS2DUXS12_ENABLED
	select I2C if $(dt_compat_on_bus,$(DT_COMPAT_ST_LIS2DUXS12),i2c)
	select SPI if $(dt_compat_on_bus,$(DT_COMPAT_ST_LIS2DUXS12),spi)
	select HAS_STMEMSC
	select USE_STDC_LIS2DUXS12
	help
	  Enable driver for LIS2DUXS12 smartxl
	  sensor.

if LIS2DUXS12

choice LIS2DUXS12_TRIGGER_MODE
	prompt "Trigger mode"
	help
	  Specify the type of triggering to be used by the driver.

config LIS2DUXS12_TRIGGER_NONE
	bool "No trigger"

config LIS2DUXS12_TRIGGER_GLOBAL_THREAD
	bool "Use global thread"
	depends on GPIO
	select LIS2DUXS12_TRIGGER

config LIS2DUXS12_TRIGGER_OWN_THREAD
	bool "Use own thread"
	depends on GPIO
	select LIS2DUXS12_TRIGGER

endchoice

config LIS2DUXS12_TRIGGER
	bool

if LIS2DUXS12_TRIGGER

config LIS2DUXS12_THREAD_PRIORITY
	int "Thread priority"
	depends on LIS2DUXS12_TRIGGER_OWN_THREAD
	default 10
	help
	  Priority of thread used by the driver to handle interrupts.

config LIS2DUXS12_THREAD_STACK_SIZE
	int "Thread stack size"
	depends on LIS2DUXS12_TRIGGER_OWN_THREAD
	default 1024
	help
	  Stack size of thread used by the driver to handle interrupts.

endif # LIS2DUXS12_TRIGGER

config LIS2DUXS12_ENABLE_TEMP
	bool "Temperature"
	help
	  Enable/disable temperature

endif # LIS2DUXS12
```

## drivers/sensor/lis2dw12/Kconfig
```kconfig
# ST Microelectronics LIS2DW12 3-axis accelerometer driver

# Copyright (c) 2019 STMicroelectronics
# SPDX-License-Identifier: Apache-2.0

menuconfig LIS2DW12
	bool "LIS2DW12 I2C/SPI accelerometer sensor driver"
	default y
	depends on DT_HAS_ST_LIS2DW12_ENABLED
	select I2C if $(dt_compat_on_bus,$(DT_COMPAT_ST_LIS2DW12),i2c)
	select SPI if $(dt_compat_on_bus,$(DT_COMPAT_ST_LIS2DW12),spi)
	select HAS_STMEMSC
	select USE_STDC_LIS2DW12
	help
	  Enable driver for LIS2DW12 accelerometer sensor driver

if LIS2DW12

choice LIS2DW12_TRIGGER_MODE
	prompt "Trigger mode"
	help
	  Specify the type of triggering to be used by the driver.

config LIS2DW12_TRIGGER_NONE
	bool "No trigger"

config LIS2DW12_TRIGGER_GLOBAL_THREAD
	bool "Use global thread"
	depends on GPIO
	select LIS2DW12_TRIGGER

config LIS2DW12_TRIGGER_OWN_THREAD
	bool "Use own thread"
	depends on GPIO
	select LIS2DW12_TRIGGER

endchoice

config LIS2DW12_TRIGGER
	bool

if LIS2DW12_TRIGGER

config LIS2DW12_THREAD_PRIORITY
	int "Thread priority"
	depends on LIS2DW12_TRIGGER_OWN_THREAD
	default 10
	help
	  Priority of thread used by the driver to handle interrupts.

config LIS2DW12_THREAD_STACK_SIZE
	int "Thread stack size"
	depends on LIS2DW12_TRIGGER_OWN_THREAD
	default 1024
	help
	  Stack size of thread used by the driver to handle interrupts.

config LIS2DW12_TAP
	bool "Tap and Tap-Tap detection"
	help
	  Enable tap (single/double) detection

endif # LIS2DW12_TRIGGER

config LIS2DW12_THRESHOLD
	bool "Wakeup threshold trigger (via interrupt)"
	help
	  Enable the wakeup threshold trigger feature.
	  The wake-up interrupt signal is generated if a certain number of
	  consecutive data exceed the configured threshold (config in DT).
	  The threshold is applied to both positive and negative data: for
	  a wake-up interrupt generation at least one of the three axes must
	  be bigger than the threshold. See ST AN5038 for more details about
	  the feature.


endif # LIS2DW12
```

## drivers/sensor/lis2mdl/Kconfig
```kconfig
# Copyright (c) 2018-2019 STMicroelectronics
# SPDX-License-Identifier: Apache-2.0

menuconfig LIS2MDL
	bool "LIS2MDL Magnetometer"
	default y
	depends on DT_HAS_ST_LIS2MDL_ENABLED
	depends on I2C || SPI
	select HAS_STMEMSC
	select USE_STDC_LIS2MDL
	help
	  Enable driver for LIS2MDL I2C-based magnetometer sensor.

if LIS2MDL

choice LIS2MDL_TRIGGER_MODE
	prompt "Trigger mode"
	default LIS2MDL_TRIGGER_GLOBAL_THREAD
	help
	  Specify the type of triggering to be used by the driver.

config LIS2MDL_TRIGGER_NONE
	bool "No trigger"

config LIS2MDL_TRIGGER_GLOBAL_THREAD
	bool "Use global thread"
	depends on GPIO
	select LIS2MDL_TRIGGER

config LIS2MDL_TRIGGER_OWN_THREAD
	bool "Use own thread"
	depends on GPIO
	select LIS2MDL_TRIGGER

endchoice # LIS2MDL_TRIGGER_MODE

config LIS2MDL_TRIGGER
	bool

config LIS2MDL_THREAD_PRIORITY
	int "Thread priority"
	depends on LIS2MDL_TRIGGER_OWN_THREAD
	default 10
	help
	  Priority of thread used by the driver to handle interrupts.

config LIS2MDL_THREAD_STACK_SIZE
	int "Thread stack size"
	depends on LIS2MDL_TRIGGER_OWN_THREAD
	default 1024
	help
	  Stack size of thread used by the driver to handle interrupts.

config LIS2MDL_MAG_ODR_RUNTIME
	bool "Set magnetometer sampling frequency (ODR) at runtime (default: 10 Hz)"
	default y

endif # LIS2MDL
```

## drivers/sensor/lis3dh/Kconfig
```kconfig
# Kconfig - LIS3DH Three Axis Accelerometer configuration options

#
# Copyright (c) 2016 Intel Corporation
#
# SPDX-License-Identifier: Apache-2.0
#

menuconfig LIS3DH
	bool "LIS3DH Three Axis Accelerometer"
	depends on I2C
	help
	  Enable driver for LIS3DH I2C-based triaxial accelerometer sensor.

if LIS3DH

config LIS3DH_NAME
	string "Driver name"
	default "LIS3DH"
	help
	  Device name with which the LIS3DH sensor is identified.

config LIS3DH_I2C_ADDR
	hex "LIS3DH I2C address"
	default 0x18
	help
	  I2C address of the LIS3DH sensor.

	  0x18: Choose this option if the SDO pin is pulled to GND.
	  0x19: Choose this option if the SDO pin is pulled to VDDIO.

config LIS3DH_I2C_MASTER_DEV_NAME
	string "I2C master where LIS3DH is connected"
	default "I2C_0"
	help
	  Specify the device name of the I2C master device to which LIS3DH is
	  connected.

choice
	prompt "Trigger mode"
	default LIS3DH_TRIGGER_GLOBAL_THREAD
	help
	  Specify the type of triggering to be used by the driver.

config LIS3DH_TRIGGER_NONE
	bool "No trigger"

config LIS3DH_TRIGGER_GLOBAL_THREAD
	bool "Use global thread"
	depends on GPIO
	select LIS3DH_TRIGGER

config LIS3DH_TRIGGER_OWN_THREAD
	bool "Use own thread"
	depends on GPIO
	select LIS3DH_TRIGGER

endchoice

config LIS3DH_TRIGGER
	bool

config LIS3DH_GPIO_DEV_NAME
	string "GPIO device"
	default "GPIO_0"
	depends on LIS3DH_TRIGGER
	help
	  The device name of the GPIO device to which the LIS3DH interrupt pins
	  are connected.

config LIS3DH_GPIO_PIN_NUM
	int "Interrupt GPIO pin number"
	default 0
	depends on LIS3DH_TRIGGER
	help
	  The number of the GPIO on which the interrupt signal from the LIS3DH
	  chip will be received.

config LIS3DH_THREAD_PRIORITY
	int "Thread priority"
	depends on LIS3DH_TRIGGER_OWN_THREAD
	default 10
	help
	  Priority of thread used by the driver to handle interrupts.

config LIS3DH_THREAD_STACK_SIZE
	int "Thread stack size"
	depends on LIS3DH_TRIGGER_OWN_THREAD
	default 1024
	help
	  Stack size of thread used by the driver to handle interrupts.

choice
	prompt "Acceleration measurement range"
	default LIS3DH_ACCEL_RANGE_2G
	help
	  Measurement full scale range for acceleration values.

config LIS3DH_ACCEL_RANGE_2G
	bool "+/-2g"

config LIS3DH_ACCEL_RANGE_4G
	bool "+/-4g"

config LIS3DH_ACCEL_RANGE_8G
	bool "+/-8g"

config LIS3DH_ACCEL_RANGE_16G
	bool "+/-16g"

endchoice

choice
	prompt "Power mode"
	default LIS3DH_POWER_MODE_NORMAL
	help
	  Choose between normal or low power operation mode for chip.

config LIS3DH_POWER_MODE_NORMAL
	bool "normal"

config LIS3DH_POWER_MODE_LOW
	bool "low"

endchoice

choice
	prompt "Data rate frequency"
	default LIS3DH_ODR_1
	help
	  Data rate frequency of acceleration data.

config LIS3DH_ODR_1
	bool "1Hz"

config LIS3DH_ODR_2
	bool "10Hz"

config LIS3DH_ODR_3
	bool "25Hz"

config LIS3DH_ODR_4
	bool "50Hz"

config LIS3DH_ODR_5
	bool "100Hz"

config LIS3DH_ODR_6
	bool "200Hz"

config LIS3DH_ODR_7
	bool "400Hz"

config LIS3DH_ODR_8
	bool "1.6KHz"
	depends on LIS3DH_POWER_MODE_LOW

config LIS3DH_ODR_9_NORMAL
	bool "1.25KHz"
	depends on LIS3DH_POWER_MODE_NORMAL

config LIS3DH_ODR_9_LOW
	bool "5KHz"
	depends on LIS3DH_POWER_MODE_LOW

endchoice

endif # LIS3DH
```

## drivers/sensor/lis3dhh/Kconfig
```kconfig
# LIS3DHH Three Axis Accelerometer configuration options

# Copyright (C) NEXPLORE
# https://www.nexplore.com

# SPDX-License-Identifier: Apache-2.0

menuconfig LIS3DHH
	bool "LIS3DHH Three Axis Accelerometer"
	depends on SPI
	help
	  Enable SPI-based driver for LIS3DHH triaxial
	  accelerometer sensor. Initial settings can be changed
	  during runtime.

if LIS3DHH

choice LIS3DHH_MODE_SELECTION
	prompt "Mode selection"
	help
	  Enable or disable the sensor on startup.

config LIS3DHH_NORMAL_MODE
	bool "Turn on sensor"

config LIS3DHH_DISABLE
	bool "Turn off sensor"

endchoice # LIS3DHH_MODE_SELECTION

config LIS3DHH_IF_ADD_INC
	bool "Auto increment register address"
	depends on LIS3DHH_NORMAL_MODE
	help
	  Startup configuration. Register address automatically
	  incremented during a multiple byte access with SPI
	  serial interface.

config LIS3DHH_ENABLE_BDU
	bool "Block data update"
	depends on LIS3DHH_NORMAL_MODE
	help
	  Startup configuration. Output registers are not
	  updated until MSB and LSB are read.

config LIS3DHH_INT1_AS_EXT_ASYNC_INPUT_TRIG
	bool "INT1 as asynchronous input trigger to FIFO"
	depends on LIS3DHH_NORMAL_MODE
	help
	  Configures the INT1 pad as external asynchronous
	  input trigger to FIFO on startup. Otherwise,
	  INT1 is configured as output for FIFO flags.

choice LIS3DHH_FILTER_SELECTION
	prompt "Digital filter mode selection"
	help
	  Enable either FIR linear phase oder IIR nonlinear
	  phase filter on startup. Both are digital filters.

config LIS3DHH_FILTER_FIR
	bool "FIR linear phase filter"

config LIS3DHH_FILTER_IIR
	bool "IIR nonlinear phase filter"

endchoice # LIS3DHH_FILTER_SELECTION

choice LIS3DHH_BANDWIDTH_SELECTION
	prompt "Bandwidth selection"
	help
	  Choose either 440 Hz or 235 Hz typ bandwidth on startup.

config LIS3DHH_BANDWIDTH_440HZ
	bool "440 Hz"

config LIS3DHH_BANDWIDTH_235HZ
	bool "235 Hz"

endchoice # LIS3DHH_BANDWIDTH_SELECTION

choice LIS3DHH_INT1_MODE_SELECTION
	prompt "INT1 pin mode selection"
	help
	  Choose either push-pull or open drain on INT1 on startup.

config LIS3DHH_INT1_PUSH_PULL
	bool "push-pull on INT1 pin"

config LIS3DHH_INT1_OPEN_DRAIN
	bool "open drain on INT1 pin"

endchoice # LIS3DHH_INT1_MODE_SELECTION

choice LIS3DHH_INT2_MODE_SELECTION
	prompt "INT2 pin mode selection"
	help
	  Choose either push-pull or open drain on INT2 on startup.

config LIS3DHH_INT2_PUSH_PULL
	bool "push-pull on INT2 pin"

config LIS3DHH_INT2_OPEN_DRAIN
	bool "open drain on INT2 pin"

endchoice # LIS3DHH_INT2_MODE_SELECTION

config LIS3DHH_ENABLE_FIFO
	bool "Enable FIFO"
	depends on LIS3DHH_NORMAL_MODE
	help
	  Enables the FIFO memory.

config LIS3DHH_SPI_HS_CONFIG
	bool "Enable SPI high speed configuration"
	depends on LIS3DHH_NORMAL_MODE
	help
	  Startup configuration.
	  Enables the SPI high speed configuration for the
	  FIFO block that is used to guarantee a minimum
	  duration of the window in which writing operation
	  of RAM output is blocked. This is recommended for
	  SPI clock frequencies higher than 6 MHz.

choice LIS3DHH_FIFO_MODE_SELECTION
	prompt "FIFO mode selection"
	depends on LIS3DHH_ENABLE_FIFO
	help
	  Configure the mode in which FIFO operates at startup.

config LIS3DHH_FIFO_BYPASS
	bool "Bypass mode. FIFO turned off."

config LIS3DHH_FIFO_NORMAL
	bool "FIFO mode. Stops collecting data when FIFO is full."

config LIS3DHH_FIFO_CONTINUOUS_TO_FIFO
	bool "Continuous mode until trigger is asserted, then FIFO mode."

config LIS3DHH_FIFO_BYPASS_TO_CONTINUOUS
	bool "Bypass mode until trigger is asserted, then Continuous mode."

config LIS3DHH_FIFO_CONTINUOUS
	bool "Continuous mode. If the FIFO is full, the new sample overwrites the oldest sample."

endchoice # LIS3DHH_FIFO_MODE_SELECTION

config LIS3DHH_FIFO_THRESHOLD
	int "Threshold for FIFO."
	range 1 32
	default 32
	depends on LIS3DHH_ENABLE_FIFO
	help
	  Configure the initial FIFO threshold level setting freely
	  from a minimum of 1 to a maximum of 32.

endif # LIS3DHH
```
