## drivers/sensor/ite/ite_vcmp_it51xxx/Kconfig
```kconfig
# ITE Voltage Comparator driver configuration options

# Copyright (c) 2025 ITE Technology Corporation.
# SPDX-License-Identifier: Apache-2.0

config VCMP_IT51XXX
	bool "ITE it51xxx Voltage Comparator"
	default y
	depends on DT_HAS_ITE_IT51XXX_VCMP_ENABLED
	depends on SOC_IT51XXX && ADC_ITE_IT51XXX
	help
	  This option enables the ITE it51xxx voltage comparator,
	  it51xxx supports three 10-bit threshold voltage comparator
	  channels, and the input of each comparator comes from ADC pin.

if VCMP_IT51XXX

choice VCMP_IT51XXX_SCAN_PERIOD
	prompt "VCMP_IT51XXX_SCAN_PERIOD"
	default VCMP_IT51XXX_SCAN_PERIOD_600US

config VCMP_IT51XXX_SCAN_PERIOD_100US
	bool "VCMP_IT51XXX_SCAN_PERIOD_100US"

config VCMP_IT51XXX_SCAN_PERIOD_200US
	bool "VCMP_IT51XXX_SCAN_PERIOD_200US"

config VCMP_IT51XXX_SCAN_PERIOD_400US
	bool "VCMP_IT51XXX_SCAN_PERIOD_400US"

config VCMP_IT51XXX_SCAN_PERIOD_600US
	bool "VCMP_IT51XXX_SCAN_PERIOD_600US"

config VCMP_IT51XXX_SCAN_PERIOD_800US
	bool "VCMP_IT51XXX_SCAN_PERIOD_800US"

config VCMP_IT51XXX_SCAN_PERIOD_1MS
	bool "VCMP_IT51XXX_SCAN_PERIOD_1MS"

config VCMP_IT51XXX_SCAN_PERIOD_1_5MS
	bool "VCMP_IT51XXX_SCAN_PERIOD_1_5MS"

config VCMP_IT51XXX_SCAN_PERIOD_2MS
	bool "VCMP_IT51XXX_SCAN_PERIOD_2MS"

config VCMP_IT51XXX_SCAN_PERIOD_2_5MS
	bool "VCMP_IT51XXX_SCAN_PERIOD_2_5MS"

config VCMP_IT51XXX_SCAN_PERIOD_3MS
	bool "VCMP_IT51XXX_SCAN_PERIOD_3MS"

config VCMP_IT51XXX_SCAN_PERIOD_4MS
	bool "VCMP_IT51XXX_SCAN_PERIOD_4MS"

config VCMP_IT51XXX_SCAN_PERIOD_5MS
	bool "VCMP_IT51XXX_SCAN_PERIOD_5MS"

endchoice

config VCMP_IT51XXX_INIT_PRIORITY
	int "ITE it51xxx voltage comparator device instance init priority"
	default SENSOR_INIT_PRIORITY
	help
	  This option sets ITE voltage comparator device instance init priority.

config VCMP_IT51XXX_WORKQUEUE
	bool "ITE it51xxx voltage comparator threshold detection uses internal work queue"
	help
	  Threshold detection ISR utilizes system work queue for calling
	  trigger handlers; set this option to use dedicated work queue instead.

if VCMP_IT51XXX_WORKQUEUE

config VCMP_IT51XXX_WORKQUEUE_PRIORITY
	int "ITE it51xxx voltage comparator threshold detection work queue priority"
	default SYSTEM_WORKQUEUE_PRIORITY
	help
	  This option sets internal ITE voltage comparator threshold detection
	  workqueue priority.

config VCMP_IT51XXX_WORKQUEUE_STACK_SIZE
	int "ITE it51xxx voltage comparator threshold detection work queue stack size"
	default 768
	help
	  This option sets internal ITE voltage comparator threshold detection
	  workqueue stack size.

endif # VCMP_IT51XXX_WORKQUEUE

endif # VCMP_IT51XXX
```

## drivers/sensor/ite/ite_vcmp_it8xxx2/Kconfig
```kconfig
# ITE Voltage Comparator driver configuration options

# Copyright (c) 2022 ITE Technology Corporation.
# SPDX-License-Identifier: Apache-2.0

config VCMP_IT8XXX2
	bool "ITE it8xxx2 Voltage Comparator"
	default y
	depends on DT_HAS_ITE_IT8XXX2_VCMP_ENABLED
	depends on SOC_IT8XXX2 && ADC_ITE_IT8XXX2
	help
	  This option enables the ITE it8xxx2 voltage comparator,
	  it8xxx2 supports six 10-bit resolution voltage comparator
	  channels, and the input of each comparator comes from ADC pin.

if VCMP_IT8XXX2

config VCMP_IT8XXX2_INIT_PRIORITY
	int "ITE it8xxx2 voltage comparator device instance init priority"
	default SENSOR_INIT_PRIORITY
	help
	  This option sets ITE voltage comparator device instance init priority.

config VCMP_IT8XXX2_WORKQUEUE
	bool "ITE it8xxx2 voltage comparator threshold detection uses internal work queue"
	help
	  Threshold detection ISR utilizes system work queue for calling
	  trigger handlers; set this option to use dedicated work queue instead.

if VCMP_IT8XXX2_WORKQUEUE

config VCMP_IT8XXX2_WORKQUEUE_PRIORITY
	int "ITE it8xxx2 voltage comparator threshold detection work queue priority"
	default SYSTEM_WORKQUEUE_PRIORITY
	help
	  This option sets internal ITE voltage comparator threshold detection
	  workqueue priority.

config VCMP_IT8XXX2_WORKQUEUE_STACK_SIZE
	int "ITE it8xxx2 voltage comparator threshold detection work queue stack size"
	default 768
	help
	  This option sets internal ITE voltage comparator threshold detection
	  workqueue stack size.

endif # VCMP_IT8XXX2_WORKQUEUE

endif # VCMP_IT8XXX2
```

## drivers/sensor/ite_adc_cmp_it8xxx2/Kconfig
```kconfig
#  ADC CMP NPCX driver configuration options

# Copyright (c) 2022 Intel Corporation.
# SPDX-License-Identifier: Apache-2.0

if ADC_ITE_IT8XXX2

config ADC_VCMP_ITE_IT8XXX2
	bool "ITE IT8XXX2 ADC threshold detection interruption"
	default n
	help
	  This option enables threshold interruption using sensor
	  trigger API.

endif # ADC_CMP_ITE_IT8XXX2
```

## drivers/sensor/ite_tach_it8xxx2/Kconfig
```kconfig
# ITE tachometer sensor configuration options

# Copyright (c) 2021 ITE Technology Corporation.
# SPDX-License-Identifier: Apache-2.0

config TACH_IT8XXX2
	bool "ITE it8xxx2 Tachometer sensor"
	depends on SOC_IT8XXX2
	help
	  Enable the ITE it8xxx2 tachometer sensor,
	  it8xxx2 supports two 16-bit tachometer sensor, each sensor has two
	  input channel and we can select one input from two channel.
```

## drivers/sensor/ite_vcmp_it8xxx2/Kconfig
```kconfig
# ITE Voltage Comparator driver configuration options

# Copyright (c) 2022 ITE Technology Corporation.
# SPDX-License-Identifier: Apache-2.0

config VCMP_IT8XXX2
	bool "ITE it8xxx2 Voltage Comparator"
	default y
	depends on DT_HAS_ITE_IT8XXX2_VCMP_ENABLED
	depends on SOC_IT8XXX2 && ADC_ITE_IT8XXX2
	help
	  This option enables the ITE it8xxx2 voltage comparator,
	  it8xxx2 supports six 10-bit resolution voltage comparator
	  channels, and the input of each comparator comes from ADC pin.
```

## drivers/sensor/jedec/Kconfig
```kconfig
# Copyright (c) 2024 Vogl Electronic GmbH
# SPDX-License-Identifier: Apache-2.0

source "drivers/sensor/jedec/*/Kconfig"
```

## drivers/sensor/jedec/jc42/Kconfig
```kconfig
# JEDEC JC 42.4 compliant temperature sensor configuration options

# Copyright (c) 2016 Intel Corporation
# Copyright (c) 2024 Vogl Electronic GmbH
# SPDX-License-Identifier: Apache-2.0

menuconfig JC42
	bool "JC42 temperature sensor"
	default y
	depends on DT_HAS_JEDEC_JC_42_4_TEMP_ENABLED
	select I2C
	help
	  Enable driver for JC42 temperature sensor.

if JC42

choice
	prompt "JC42 trigger mode"
	default JC42_TRIGGER_NONE

config JC42_TRIGGER_NONE
	bool "No trigger"

config JC42_TRIGGER_GLOBAL_THREAD
	depends on GPIO
	depends on $(dt_compat_any_has_prop,$(DT_COMPAT_JEDEC_JC_42_4_TEMP),int-gpios)
	select JC42_TRIGGER
	bool "Use global thread"

config JC42_TRIGGER_OWN_THREAD
	depends on GPIO
	depends on $(dt_compat_any_has_prop,$(DT_COMPAT_JEDEC_JC_42_4_TEMP),int-gpios)
	select JC42_TRIGGER
	bool "Use own thread"

endchoice

config JC42_TRIGGER
	bool

config JC42_THREAD_STACK_SIZE
	int "Sensor delayed work thread stack size"
	depends on JC42_TRIGGER_OWN_THREAD
	default 1024

config JC42_THREAD_PRIORITY
	int "JC42 thread priority"
	depends on JC42_TRIGGER_OWN_THREAD
	default 10

endif # JC42
```

## drivers/sensor/kb1200/Kconfig
```kconfig
# KB1200 tachometer sensor configuration options

# Copyright (c) 2021 ENE Technology Inc.
# SPDX-License-Identifier: Apache-2.0

config TACH_KB1200
	bool "ENE KB1200 Tachometer sensor"
	default n
	help
	  Enable the "ENE KB1200 tachometer sensor.

if TACH_KB1200

config SENSOR_LOG_LEVEL
	default 4

config SENSOR_INIT_PRIORITY
	int "Sensor init priority"
	default 90
	help
	  Sensor initialization priority.

endif # BBRAM_KB1200
```

## drivers/sensor/kx022/Kconfig
```kconfig
#Kionix KX022 3 - axis accelerometer driver
#Copyright(c) 2021 G - Technologies Sdn.Bhd.
#
#SPDX - License - Identifier : Apache - 2.0

menuconfig KX022
	bool "KX022 I2C accelerometer sensor driver"
	depends on I2C
	help
	  Enable driver for KX022 accelerometer sensor driver

if KX022

choice KX022_TRIGGER_MODE
	prompt "Trigger mode"
	help
	  Specify the type of triggering to be used by the driver.

config KX022_TRIGGER_GLOBAL_THREAD
	bool "Use global thread"
	depends on GPIO
	select KX022_TRIGGER

config KX022_TRIGGER_OWN_THREAD
	bool "Use own thread"
	depends on GPIO
	select KX022_TRIGGER

endchoice

config KX022_TRIGGER
	bool "Trigger"

config KX022_THREAD_PRIORITY
	int "Thread priority"
	depends on KX022_TRIGGER_OWN_THREAD
	default 10
	help
	  Priority of thread used by the driver to handle interrupts.

config KX022_THREAD_STACK_SIZE
	int "Thread stack size"
	depends on KX022_TRIGGER_OWN_THREAD
	default 1024
	help
	  Stack size of thread used by the driver to handle interrupts.

config KX022_DIAGNOSTIC_MODE
	bool "Use diagnostic mode"
	help
	  Get kx022 register value

config KX022_ODR_RUNTIME
	bool "set odr in runtime"
	help
	  Set odr in runtime

config KX022_FS_RUNTIME
	bool "set full-scale in runtime"
	help
	  Set full-scale in runtime

config KX022_RES_RUNTIME
	bool "set resolution in runtime"
	help
	  Set resolution in runtime

config KX022_MOTION_DETECTION_TIMER_RUNTIME
	bool "Set wake up delay time in runtime"
	help
	  Set wake up delay time in runtime

config KX022_MOTION_DETECT_THRESHOLD_RUNTIME
	bool "Set motion detect threshold in runtime"
	help
	  Set motion detect threshold in runtime

config KX022_TILT_TIMER_RUNTIME
	bool "Set tilt timer in runtime"
	help
	  Set tilt timer in runtime

config KX022_TILT_ANGLE_LL_RUNTIME
	bool "Set tilt angle ll in runtime"
	help
	  Set tilt angle ll in runtime 
endif # KX022
```

## drivers/sensor/ld2410/Kconfig
```kconfig
# LD2410 hilink radar sensor Configuration options

# Copyright (c) 2023 Fabian Blatz
# SPDX-License-Identifier: Apache-2.0

menuconfig LD2410
	bool "LD2410 radar sensor"
	default y
	depends on DT_HAS_HILINK_LD2410_ENABLED
	depends on SERIAL
	select RING_BUFFER
	help
	  Enable driver for LD2410 Radar Sensor.

if LD2410

choice
	prompt "Trigger mode"
	default LD2410_TRIGGER_NONE
	help
	  Specify the type of triggering used by the driver.

config LD2410_TRIGGER_NONE
	bool "No trigger"

config LD2410_TRIGGER_GLOBAL_THREAD
	bool "Use global thread"
	depends on GPIO
	select LD2410_TRIGGER

config LD2410_TRIGGER_OWN_THREAD
	bool "Use own thread"
	depends on GPIO
	select LD2410_TRIGGER

endchoice


config LD2410_TRIGGER
	bool

config LD2410_THREAD_PRIORITY
	int "Thread priority"
	depends on LD2410_TRIGGER_OWN_THREAD && LD2410_TRIGGER
	default 10
	help
	  Priority of thread used by the driver to handle interrupts.

config LD2410_THREAD_STACK_SIZE
	int "Thread stack size"
	depends on LD2410_TRIGGER_OWN_THREAD && LD2410_TRIGGER
	default 1024
	help
	  Stack size of thread used by the driver to handle interrupts.

endif # LD2410
```

## drivers/sensor/lis2de12/Kconfig
```kconfig
# ST Microelectronics LIS2DE12 3-axis accelerometer sensor driver

# Copyright (c) 2024 STMicroelectronics
# SPDX-License-Identifier: Apache-2.0

menuconfig LIS2DE12
	bool "LIS2DE12 I2C/SPI smartxl Chip"
	default y
	depends on DT_HAS_ST_LIS2DE12_ENABLED
	depends on ZEPHYR_HAL_ST_MODULE
	select I2C if $(dt_compat_on_bus,$(DT_COMPAT_ST_LIS2DE12),i2c)
	select SPI if $(dt_compat_on_bus,$(DT_COMPAT_ST_LIS2DE12),spi)
	select HAS_STMEMSC
	select USE_STDC_LIS2DE12
	help
	  Enable driver for LIS2DE12 smartxl sensor.

if LIS2DE12

module = LIS2DE12
thread_priority = 10
thread_stack_size = 1024
source "drivers/sensor/Kconfig.trigger_template"

config LIS2DE12_ENABLE_TEMP
	bool "Die temperature sensor"
	help
	  Enable/disable die temperature sensor

endif # LIS2DE12
```

## drivers/sensor/lis2dh/Kconfig
```kconfig
# LIS2DH Three Axis Accelerometer configuration options

# Copyright (c) 2017 Intel Corporation
# SPDX-License-Identifier: Apache-2.0

menuconfig LIS2DH
	bool "LIS2DH Three Axis Accelerometer"
	default y
	depends on DT_HAS_ST_LIS2DH_ENABLED
	select I2C if $(dt_compat_on_bus,$(DT_COMPAT_ST_LIS2DH),i2c)
	select SPI if $(dt_compat_on_bus,$(DT_COMPAT_ST_LIS2DH),spi)
	help
	  Enable SPI/I2C-based driver for LIS2DH, LIS3DH, LSM303DLHC,
	  LIS2DH12, LSM303AGR triaxial accelerometer sensors.

if LIS2DH

choice LIS2DH_TRIGGER_MODE
	prompt "Trigger mode"
	help
	  Specify the type of triggering to be used by the driver.

config LIS2DH_TRIGGER_NONE
	bool "No trigger"

config LIS2DH_TRIGGER_GLOBAL_THREAD
	bool "Use global thread"
	depends on GPIO
	select LIS2DH_TRIGGER

config LIS2DH_TRIGGER_OWN_THREAD
	bool "Use own thread"
	depends on GPIO
	select LIS2DH_TRIGGER

endchoice

config LIS2DH_TRIGGER
	bool

config LIS2DH_THREAD_PRIORITY
	int "Thread priority"
	depends on LIS2DH_TRIGGER_OWN_THREAD
	default 10
	help
	  Priority of thread used by the driver to handle interrupts.

config LIS2DH_THREAD_STACK_SIZE
	int "Thread stack size"
	depends on LIS2DH_TRIGGER_OWN_THREAD
	default 1024
	help
	  Stack size of thread used by the driver to handle interrupts.

choice LIS2DH_ACCEL_RANGE
	prompt "Acceleration measurement range"
	default LIS2DH_ACCEL_RANGE_RUNTIME
	help
	  Initial measurement full scale range for acceleration values.

config LIS2DH_ACCEL_RANGE_RUNTIME
	bool "Set at runtime"

config LIS2DH_ACCEL_RANGE_2G
	bool "+/-2g"

config LIS2DH_ACCEL_RANGE_4G
	bool "+/-4g"

config LIS2DH_ACCEL_RANGE_8G
	bool "+/-8g"

config LIS2DH_ACCEL_RANGE_16G
	bool "+/-16g"

endchoice

choice LIS2DH_OPER_MODE
	prompt "Operation mode"
	default LIS2DH_OPER_MODE_NORMAL
	help
	  Choose between high resolution, normal or low power operation
	  mode for chip at init.

config LIS2DH_OPER_MODE_HIGH_RES
	bool "high resolution (12 bit)"

config LIS2DH_OPER_MODE_NORMAL
	bool "normal (10 bit)"

config LIS2DH_OPER_MODE_LOW_POWER
	bool "low power (8 bit)"

endchoice

choice LIS2DH_ODR
	prompt "Output data rate frequency"
	default LIS2DH_ODR_RUNTIME
	help
	  Initial data rate frequency of acceleration data at initialization.
	  Supported values:
	  1Hz, 10Hz, 25Hz, 50Hz, 100Hz, 200Hz, 400Hz in all power modes
	  1620Hz, 5376Hz in low power mode only
	  1344Hz in normal power mode

config LIS2DH_ODR_RUNTIME
	bool "Set at runtime"

config LIS2DH_ODR_1
	bool "1Hz"

config LIS2DH_ODR_2
	bool "10Hz"

config LIS2DH_ODR_3
	bool "25Hz"

config LIS2DH_ODR_4
	bool "50Hz"

config LIS2DH_ODR_5
	bool "100Hz"

config LIS2DH_ODR_6
	bool "200Hz"

config LIS2DH_ODR_7
	bool "400Hz"

config LIS2DH_ODR_8
	bool "1.6KHz"
	depends on LIS2DH_OPER_MODE_LOW_POWER

config LIS2DH_ODR_9_NORMAL
	bool "1.25KHz"
	depends on LIS2DH_OPER_MODE_NORMAL || LIS2DH_OPER_MODE_HIGH_RES

config LIS2DH_ODR_9_LOW
	bool "5KHz"
	depends on LIS2DH_OPER_MODE_LOW_POWER

endchoice

config LIS2DH_BLOCK_DATA_UPDATE
	bool "Output registers not updated until MSB and LSB read"

config LIS2DH_MEASURE_TEMPERATURE
	bool "Temperature measurements"
	select LIS2DH_BLOCK_DATA_UPDATE
	help
	  The temperature sensor is most suitable for measuring
	  relative temperature. For example, it is X degrees C
	  cooler or warmer.
	  Each chip has an offset.  This offset must be applied
	  to the result. The offset can be obtained by comparing the
	  the reported temperature to a reference.
	  This option does not apply to the LSM330DLHC.

endif # LIS2DH
```
