## drivers/sensor/bosch/bma4xx/Kconfig
```kconfig
# BMA4XX 3-axis accelerometer config options
#
# Copyright (c) 2023 Google LLC
# Copyright (c) 2024 Croxel Inc.
# Copyright (c) 2024 Cienet
#
# SPDX-License-Identifier: Apache-2.0

menuconfig BMA4XX
	bool "BMA4XX 3-axis acceleration sensor"
	default y
	depends on DT_HAS_BOSCH_BMA4XX_ENABLED
	depends on SENSOR_ASYNC_API
	select I2C
	select I2C_RTIO
	select RTIO_WORKQ
	help
	  Enable driver for Bosch BMA4XX (I2C-based)

if BMA4XX

config BMA4XX_TEMPERATURE
	bool "Allow reading the BMA4XX die temperature"
	default n
	help
	  Allow reading the BMA4xx's on-chip temperature sensor. This creates
	  extra bus activity and increases code size.

config EMUL_BMA4XX
	bool "Emulator for the BMA4XX"
	default y
	depends on EMUL
	help
	  Enable the hardware emulator for the BMA4XX. Doing so allows exercising
	  sensor APIs for this sensor in native_sim and qemu.

config BMA4XX_STREAM
	bool "Use hardware FIFO to stream data"
	default y
	depends on GPIO
	depends on $(dt_compat_any_has_prop,$(DT_COMPAT_BOSCH_BMA4XX),int1-gpios)
	help
	  Use this config option to enable streaming sensor data via RTIO subsystem.

endif # BMA4XX
```

## drivers/sensor/bosch/bma530/Kconfig
```kconfig
# Copyright (c) 2024 Arrow Electronics.
# SPDX-License-Identifier: Apache-2.0

menuconfig BMA530
	bool "BMA530 3-axis acceleration sensor"
	default y
	depends on DT_HAS_BOSCH_BMA530_ENABLED
	select I2C
	help
	  Enable driver for Bosch BMA530 (I2C-based)

config BMA530_TEMPERATURE
	bool "Allow reading the BMA530 die temperature"
	default n
	depends on BMA530
	help
	  Allow reading the BMA530's on-chip temperature sensor. This creates
	  extra bus activity and increases code size.

config BMA530_DELAY_COMMUNICATION_AFTER_POWER_ON
	bool "Delay communication with BMA530 after power on"
	default n
	depends on BMA530
	help
	  It is recommended to wait at least 3 ms after power on before any
	  communication with the accelerometer. This time should already pass until
	  Zephyr initializes the driver. Enable this wait time in case sensor
	  sensor initialization occurs earlier
```

## drivers/sensor/bosch/bmc150_magn/Kconfig
```kconfig
# BMC150 magnetometer sensor configuration options

# Copyright (c) 2016 Intel Corporation
# SPDX-License-Identifier: Apache-2.0

menuconfig BMC150_MAGN
	bool "BMC150_MAGN I2C Magnetometer Chip"
	default y
	depends on DT_HAS_BOSCH_BMC150_MAGN_ENABLED
	select I2C
	help
	  Enable driver for BMC150 I2C-based magnetometer sensor.

if BMC150_MAGN

menu "Attributes"

choice
	prompt "Default preset"
	default BMC150_MAGN_PRESET_REGULAR
	help
	  Specify the default preset (x/y oversampling, z oversampling, sampling
	  frequency).

config BMC150_MAGN_PRESET_LOW_POWER
	bool "Low power (3, 3, 10)"

config BMC150_MAGN_PRESET_REGULAR
	bool "Regular (9, 15, 10)"

config BMC150_MAGN_PRESET_ENHANCED_REGULAR
	bool "Enhanced regular (15, 27, 10)"

config BMC150_MAGN_PRESET_HIGH_ACCURACY
	bool "High accuracy (47, 83, 20)"

endchoice

config BMC150_MAGN_SAMPLING_RATE_RUNTIME
	bool "Dynamic sampling rate"
	help
	  Enable alteration of sampling rate attribute at runtime.

config BMC150_MAGN_SAMPLING_REP_XY
	bool "Dynamic XY oversampling"
	help
	  Enable alteration of XY oversampling at runtime.

config BMC150_MAGN_SAMPLING_REP_Z
	bool "Dynamic Z oversampling"
	help
	  Enable alteration of Z oversampling at runtime.

endmenu

config BMC150_MAGN_TRIGGER
	bool "Triggers"
	depends on GPIO
	depends on $(dt_compat_any_has_prop,$(DT_COMPAT_BOSCH_BMC150_MAGN),drdy-gpios)
	help
	  Enable triggers for BMC150 magnetometer

config BMC150_MAGN_TRIGGER_THREAD_STACK
	int "Thread stack size"
	depends on BMC150_MAGN_TRIGGER
	default 1024
	help
	  Specify the internal thread stack size.

config BMC150_MAGN_TRIGGER_DRDY
	bool "Data ready trigger"
	depends on BMC150_MAGN_TRIGGER
	help
	  Enable data ready interrupt for BMC150 magnetometer

endif # BMC150_MAGN
```

## drivers/sensor/bosch/bme280/Kconfig
```kconfig
# BMP280 temperature and pressure sensor configuration options

# Copyright (c) 2016 Intel Corporation
# Copyright (c) 2017 IpTronix S.r.l.
# SPDX-License-Identifier: Apache-2.0

menuconfig BME280
	bool "BME280/BMP280 sensor"
	default y
	depends on DT_HAS_BOSCH_BME280_ENABLED
	select I2C if $(dt_compat_on_bus,$(DT_COMPAT_BOSCH_BME280),i2c)
	select SPI if $(dt_compat_on_bus,$(DT_COMPAT_BOSCH_BME280),spi)
	help
	  Enable driver for BME280 I2C-based or SPI-based temperature and pressure sensor.

if BME280

choice
	prompt "BME280 sampling mode"
	default BME280_MODE_NORMAL
	help
	  Select sampling mode. In normal mode continuous measurements are
	  performed, whereas in forced mode only single measurement is performed.
config BME280_MODE_NORMAL
	bool "normal"
config BME280_MODE_FORCED
	bool "forced"
endchoice

choice
	prompt "BME280 temperature oversampling"
	default BME280_TEMP_OVER_2X
	help
	  Select temperature oversampling for the BME280 sensor.  Higher values
	  lead to more accurate readings, but higher power consumption.
config BME280_TEMP_OVER_1X
	bool "x1"
config BME280_TEMP_OVER_2X
	bool "x2"
config BME280_TEMP_OVER_4X
	bool "x4"
config BME280_TEMP_OVER_8X
	bool "x8"
config BME280_TEMP_OVER_16X
	bool "x16"
endchoice

choice
	prompt "BME280 pressure oversampling"
	default BME280_PRESS_OVER_16X
	help
	  Select pressure oversampling for the BME280 sensor.  Higher values
	  lead to more accurate readings, but higher power consumption.
config BME280_PRESS_OVER_1X
	bool "x1"
config BME280_PRESS_OVER_2X
	bool "x2"
config BME280_PRESS_OVER_4X
	bool "x4"
config BME280_PRESS_OVER_8X
	bool "x8"
config BME280_PRESS_OVER_16X
	bool "x16"
endchoice

choice
	prompt "BME280 humidity oversampling"
	default BME280_HUMIDITY_OVER_16X
	help
	  Select humidity oversampling for the BME280 sensor.  Higher values
	  lead to more accurate readings, but higher power consumption.
config BME280_HUMIDITY_OVER_1X
	bool "x1"
config BME280_HUMIDITY_OVER_2X
	bool "x2"
config BME280_HUMIDITY_OVER_4X
	bool "x4"
config BME280_HUMIDITY_OVER_8X
	bool "x8"
config BME280_HUMIDITY_OVER_16X
	bool "x16"
endchoice

choice
	prompt "BME280 standby time"
	default BME280_STANDBY_1000MS
	help
	  Select standby time between measurements for the BME280 sensor.
	  Higher values lead to lower power consumption.
config BME280_STANDBY_05MS
	bool "0.5ms"
config BME280_STANDBY_62MS
	bool "62.5ms"
config BME280_STANDBY_125MS
	bool "125ms"
config BME280_STANDBY_250MS
	bool "250ms"
config BME280_STANDBY_500MS
	bool "500ms"
config BME280_STANDBY_1000MS
	bool "1000ms"
config BME280_STANDBY_2000MS
	bool "2000ms BMP280 / 10ms BME280"
config BME280_STANDBY_4000MS
	bool "4000ms BMP280 / 20ms BME280"
endchoice

choice
	prompt "BME280 filter coefficient"
	default BME280_FILTER_4
	help
	  Select the filter coefficient for the BME280 sensor.
config BME280_FILTER_OFF
	bool "filter off"
config BME280_FILTER_2
	bool "2"
config BME280_FILTER_4
	bool "4"
config BME280_FILTER_8
	bool "8"
config BME280_FILTER_16
	bool "16"
endchoice

endif # BME280
```

## drivers/sensor/bosch/bmg160/Kconfig
```kconfig
# Bosch BMG160 gyroscope configuration options

# Copyright (c) 2016 Intel Corporation
# SPDX-License-Identifier: Apache-2.0

menuconfig BMG160
	bool "Bosch BMG160 gyroscope support"
	default y
	depends on DT_HAS_BOSCH_BMG160_ENABLED
	select I2C
	help
	  Enable Bosch BMG160 gyroscope support.

if BMG160

choice
	prompt "BMG160 I2C bus speed"
	default BMG160_I2C_SPEED_STANDARD

config BMG160_I2C_SPEED_STANDARD
	bool "Standard"
	help
	  Standard bus speed of up to 100kHz.

config BMG160_I2C_SPEED_FAST
	bool "Fast"
	help
	  Fast bus speed of up to 400KHz.
endchoice

choice
	prompt "Trigger mode"
	default BMG160_TRIGGER_GLOBAL_THREAD
	help
	  Specify the type of triggering to be used by the driver.

config BMG160_TRIGGER_NONE
	bool "No trigger"

config BMG160_TRIGGER_GLOBAL_THREAD
	bool "Use global thread"
	depends on GPIO
	depends on $(dt_compat_any_has_prop,$(DT_COMPAT_BOSCH_BMG160),int-gpios)
	select BMG160_TRIGGER

config BMG160_TRIGGER_OWN_THREAD
	bool "Use own thread"
	depends on GPIO
	depends on $(dt_compat_any_has_prop,$(DT_COMPAT_BOSCH_BMG160),int-gpios)
	select BMG160_TRIGGER
endchoice

config BMG160_TRIGGER
	bool

config BMG160_THREAD_PRIORITY
	int "Own thread priority"
	depends on BMG160_TRIGGER_OWN_THREAD
	default 10
	help
	  The priority of the thread used for handling interrupts.

config BMG160_THREAD_STACK_SIZE
	int "Own thread stack size"
	depends on BMG160_TRIGGER_OWN_THREAD
	default 1024
	help
	  The thread stack size.

choice
	prompt "Gyroscope range setting."
	default BMG160_RANGE_RUNTIME

config BMG160_RANGE_RUNTIME
	bool "Set at runtime."

config BMG160_RANGE_2000DPS
	bool "2000 DPS"

config BMG160_RANGE_1000DPS
	bool "1000 DPS"

config BMG160_RANGE_500DPS
	bool "500 DPS"

config BMG160_RANGE_250DPS
	bool "250 DPS"

config BMG160_RANGE_125DPS
	bool "125 DPS"
endchoice

choice
	prompt "Gyroscope sampling frequency."
	default BMG160_ODR_RUNTIME

config BMG160_ODR_RUNTIME
	bool "Set at runtime."

config BMG160_ODR_100
	bool "100 Hz"

config BMG160_ODR_200
	bool "200 Hz"

config BMG160_ODR_400
	bool "400 Hz"

config BMG160_ODR_1000
	bool "1000 Hz"

config BMG160_ODR_2000
	bool "2000 Hz"
endchoice

endif # BMG160
```

## drivers/sensor/bosch/bmi08x/Kconfig
```kconfig
# Bosch BMI08X inertial measurement configuration options

# Copyright (c) 2022 Meta Platforms, Inc. and its affiliates
# SPDX-License-Identifier: Apache-2.0

menuconfig BMI08X
	bool "Bosch BMI08X inertial measurement unit"
	default y
	depends on DT_HAS_BOSCH_BMI08X_ACCEL_ENABLED || DT_HAS_BOSCH_BMI08X_GYRO_ENABLED
	select I2C if $(dt_compat_on_bus,$(DT_COMPAT_BOSCH_BMI08X_ACCEL),i2c) \
		|| $(dt_compat_on_bus,$(DT_COMPAT_BOSCH_BMI08X_GYRO),i2c)
	select SPI if $(dt_compat_on_bus,$(DT_COMPAT_BOSCH_BMI08X_ACCEL),spi) \
		|| $(dt_compat_on_bus,$(DT_COMPAT_BOSCH_BMI08X_GYRO),spi)
	help
	  Enable Bosch BMI08X inertial measurement unit that provides acceleration
	  and angular rate measurements.

if BMI08X

choice BMI08X_ACCEL_TRIGGER_MODE
	prompt "Accelerometer trigger mode"
	default BMI08X_ACCEL_TRIGGER_GLOBAL_THREAD
	help
	  Specify the type of triggering to be used by the driver.

config BMI08X_ACCEL_TRIGGER_NONE
	bool "No trigger"

config BMI08X_ACCEL_TRIGGER_GLOBAL_THREAD
	bool "Use global thread"
	select BMI08X_ACCEL_TRIGGER

config BMI08X_ACCEL_TRIGGER_OWN_THREAD
	bool "Use own thread"
	select BMI08X_ACCEL_TRIGGER
endchoice

config BMI08X_ACCEL_TRIGGER
	bool

config BMI08X_ACCEL_THREAD_PRIORITY
	int "Accelerometer own thread priority"
	depends on BMI08X_ACCEL_TRIGGER_OWN_THREAD
	default 10
	help
	  The priority of the thread used for handling interrupts.

config BMI08X_ACCEL_THREAD_STACK_SIZE
	int "Accelerometer own thread stack size"
	depends on BMI08X_ACCEL_TRIGGER_OWN_THREAD
	default 1536
	help
	  The thread stack size.

choice BMI08X_GYRO_TRIGGER_MODE
	prompt "Gyroscope trigger mode"
	default BMI08X_GYRO_TRIGGER_NONE
	default BMI08X_GYRO_TRIGGER_GLOBAL_THREAD
	help
	  Specify the type of triggering to be used by the driver.

config BMI08X_GYRO_TRIGGER_NONE
	bool "No trigger"

config BMI08X_GYRO_TRIGGER_GLOBAL_THREAD
	bool "Use global thread"
	select BMI08X_GYRO_TRIGGER

config BMI08X_GYRO_TRIGGER_OWN_THREAD
	bool "Use own thread"
	select BMI08X_GYRO_TRIGGER
endchoice

config BMI08X_GYRO_TRIGGER
	bool

config BMI08X_GYRO_THREAD_PRIORITY
	int "Own thread priority"
	depends on BMI08X_GYRO_TRIGGER_OWN_THREAD
	default 10
	help
	  The priority of the thread used for handling interrupts.

config BMI08X_GYRO_THREAD_STACK_SIZE
	int "Own thread stack size"
	depends on BMI08X_GYRO_TRIGGER_OWN_THREAD
	default 1536
	help
	  The thread stack size.

config BMI08X_I2C_WRITE_BURST_SIZE
	int "Maximum length of single i2c write"
	default 16

endif # BMI08X
```
