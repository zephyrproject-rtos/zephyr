## drivers/sensor/bosch/bmi160/Kconfig
```kconfig
# Bosch BMI160 inertial measurement configuration options

# Copyright (c) 2016 Intel Corporation
# SPDX-License-Identifier: Apache-2.0

menuconfig BMI160
	bool "Bosch BMI160 inertial measurement unit"
	default y
	depends on DT_HAS_BOSCH_BMI160_ENABLED
	select I2C if $(dt_compat_on_bus,$(DT_COMPAT_BOSCH_BMI160),i2c)
	select SPI if $(dt_compat_on_bus,$(DT_COMPAT_BOSCH_BMI160),spi)
	help
	  Enable Bosch BMI160 inertial measurement unit that provides acceleration
	  and angular rate measurements.

if BMI160

choice
	prompt "Trigger mode"
	default BMI160_TRIGGER_GLOBAL_THREAD
	help
	  Specify the type of triggering to be used by the driver.

config BMI160_TRIGGER_NONE
	bool "No trigger"

config BMI160_TRIGGER_GLOBAL_THREAD
	bool "Use global thread"
	depends on GPIO
	depends on $(dt_compat_any_has_prop,$(DT_COMPAT_BOSCH_BMI160),int-gpios)
	select BMI160_TRIGGER

config BMI160_TRIGGER_OWN_THREAD
	bool "Use own thread"
	depends on GPIO
	depends on $(dt_compat_any_has_prop,$(DT_COMPAT_BOSCH_BMI160),int-gpios)
	select BMI160_TRIGGER
endchoice

config BMI160_TRIGGER
	bool

config BMI160_THREAD_PRIORITY
	int "Own thread priority"
	depends on BMI160_TRIGGER_OWN_THREAD
	default 10
	help
	  The priority of the thread used for handling interrupts.

config BMI160_THREAD_STACK_SIZE
	int "Own thread stack size"
	depends on BMI160_TRIGGER_OWN_THREAD
	default 1024
	help
	  The thread stack size.

choice
	prompt "Accelerometer power mode"
	default BMI160_ACCEL_PMU_RUNTIME

config BMI160_ACCEL_PMU_RUNTIME
	bool "Set at runtime."

config BMI160_ACCEL_PMU_SUSPEND
	bool "suspended/not used"

config BMI160_ACCEL_PMU_NORMAL
	bool "normal"

config BMI160_ACCEL_PMU_LOW_POWER
	bool "low power"
endchoice

choice
	prompt "Accelerometer range setting"
	depends on BMI160_ACCEL_PMU_RUNTIME || BMI160_ACCEL_PMU_NORMAL || BMI160_ACCEL_PMU_LOW_POWER
	default BMI160_ACCEL_RANGE_RUNTIME

config BMI160_ACCEL_RANGE_RUNTIME
	bool "Set at runtime."

config BMI160_ACCEL_RANGE_2G
	bool "2G"

config BMI160_ACCEL_RANGE_4G
	bool "4G"

config BMI160_ACCEL_RANGE_8G
	bool "8G"

config BMI160_ACCEL_RANGE_16G
	bool "16G"
endchoice

choice
	prompt "Accelerometer sampling frequency."
	depends on BMI160_ACCEL_PMU_RUNTIME || BMI160_ACCEL_PMU_NORMAL || BMI160_ACCEL_PMU_LOW_POWER
	default BMI160_ACCEL_ODR_RUNTIME

config BMI160_ACCEL_ODR_RUNTIME
	bool "Set at runtime."

config BMI160_ACCEL_ODR_25_32
	depends on BMI160_ACCEL_PMU_LOW_POWER
	bool "0.78 Hz"

config BMI160_ACCEL_ODR_25_16
	depends on BMI160_ACCEL_PMU_LOW_POWER
	bool "1.56 Hz"

config BMI160_ACCEL_ODR_25_8
	depends on BMI160_ACCEL_PMU_LOW_POWER
	bool "3.125 Hz"

config BMI160_ACCEL_ODR_25_4
	depends on BMI160_ACCEL_PMU_LOW_POWER
	bool "6.25 Hz"

config BMI160_ACCEL_ODR_25_2
	bool "12.5 Hz"

config BMI160_ACCEL_ODR_25
	bool "25 Hz"

config BMI160_ACCEL_ODR_50
	bool "50 Hz"

config BMI160_ACCEL_ODR_100
	bool "100 Hz"

config BMI160_ACCEL_ODR_200
	bool "200 Hz"

config BMI160_ACCEL_ODR_400
	bool "400 Hz"

config BMI160_ACCEL_ODR_800
	bool "800 Hz"

config BMI160_ACCEL_ODR_1600
	bool "1600 Hz"
endchoice

choice
	prompt "Gyroscope power mode"
	default BMI160_GYRO_PMU_RUNTIME

config BMI160_GYRO_PMU_RUNTIME
	bool "Set at runtime."

config BMI160_GYRO_PMU_SUSPEND
	bool "suspended/not used"

config BMI160_GYRO_PMU_NORMAL
	bool "normal"

config BMI160_GYRO_PMU_FAST_STARTUP
	bool "fast start-up"
endchoice

choice
	prompt "Gyroscope range setting."
	depends on BMI160_GYRO_PMU_RUNTIME || BMI160_GYRO_PMU_NORMAL || BMI160_GYRO_PMU_FAST_STARTUP
	default BMI160_GYRO_RANGE_RUNTIME

config BMI160_GYRO_RANGE_RUNTIME
	bool "Set at runtime."

config BMI160_GYRO_RANGE_2000DPS
	bool "2000 DPS"

config BMI160_GYRO_RANGE_1000DPS
	bool "1000 DPS"

config BMI160_GYRO_RANGE_500DPS
	bool "500 DPS"

config BMI160_GYRO_RANGE_250DPS
	bool "250 DPS"

config BMI160_GYRO_RANGE_125DPS
	bool "125 DPS"
endchoice

choice
	prompt "Gyroscope sampling frequency."
	depends on BMI160_GYRO_PMU_RUNTIME || BMI160_GYRO_PMU_NORMAL || BMI160_GYRO_PMU_FAST_STARTUP
	default BMI160_GYRO_ODR_RUNTIME

config BMI160_GYRO_ODR_RUNTIME
	bool "Set at runtime."

config BMI160_GYRO_ODR_25
	bool "25 Hz"

config BMI160_GYRO_ODR_50
	bool "50 Hz"

config BMI160_GYRO_ODR_100
	bool "100 Hz"

config BMI160_GYRO_ODR_200
	bool "200 Hz"

config BMI160_GYRO_ODR_400
	bool "400 Hz"

config BMI160_GYRO_ODR_800
	bool "800 Hz"

config BMI160_GYRO_ODR_1600
	bool "1600 Hz"

config BMI160_GYRO_ODR_3200
	bool "3200 Hz"
endchoice


config EMUL_BMI160
	bool "Emulate a Bosch BMI160 accelerometer"
	default y
	depends on EMUL
	depends on BMI160
	help
	  This is an emulator for the Bosch BMI160 accelerometer.

	  It provides readings which follow a simple sequence, thus allowing
	  test code to check that things are working as expected.

	  It supports both I2C and SPI which is why it is not in one of the
	  i2c/ or spi/ directories.

endif # BMI160
```

## drivers/sensor/bosch/bmi270/Kconfig
```kconfig
# BMI270 6 Axis IMU configuration

# Copyright (c) 2021 Bosch Sensortec GmbH
# Copyright (c) 2022 Nordic Semiconductor ASA
# SPDX-License-Identifier: Apache-2.0

menuconfig BMI270
	bool "BMI270 Inertial measurement unit"
	default y
	depends on DT_HAS_BOSCH_BMI270_ENABLED
	select I2C if $(dt_compat_on_bus,$(DT_COMPAT_BOSCH_BMI270),i2c)
	select SPI if $(dt_compat_on_bus,$(DT_COMPAT_BOSCH_BMI270),spi)
	help
	  Enable driver for BMI270 I2C-based imu sensor

if BMI270

config BMI270_BUS_I2C
	bool
	default y
	depends on $(dt_compat_on_bus,$(DT_COMPAT_BOSCH_BMI270),i2c)

config BMI270_BUS_SPI
	bool
	default y
	depends on $(dt_compat_on_bus,$(DT_COMPAT_BOSCH_BMI270),spi)

choice BMI270_TRIGGER_MODE
	prompt "Trigger mode"
	help
	  Specify the type of triggering to be used by the driver.

config BMI270_TRIGGER_NONE
	bool "No trigger"

config BMI270_TRIGGER_GLOBAL_THREAD
	bool "Use global thread"
	depends on GPIO
	depends on $(dt_compat_any_has_prop,$(DT_COMPAT_BOSCH_BMI270),irq-gpios)
	select BMI270_TRIGGER

config BMI270_TRIGGER_OWN_THREAD
	bool "Use own thread"
	depends on GPIO
	depends on $(dt_compat_any_has_prop,$(DT_COMPAT_BOSCH_BMI270),irq-gpios)
	select BMI270_TRIGGER

endchoice

config BMI270_TRIGGER
	bool

config BMI270_THREAD_PRIORITY
	int "Thread priority"
	depends on BMI270_TRIGGER_OWN_THREAD
	default 10
	help
	  Priority of thread used by the driver to handle interrupts.

config BMI270_THREAD_STACK_SIZE
	int "Thread stack size"
	depends on BMI270_TRIGGER_OWN_THREAD
	default 1024
	help
	  Stack size of thread used by the driver to handle interrupts.

config BMI270_LOW_POWER_MODE
	bool "Force low-power (power-optimized) filter mode at all ODRs"
	default n
	help
	  When set, the accelerometer and gyroscope always use the
	  power-optimized filter mode (acc_filter_perf=0, gyr_filter_perf=0,
	  gyr_noise_perf=0) regardless of ODR. By default the driver switches
	  to performance mode at ODR >= 100 Hz. Enabling this saves power at
	  the cost of higher noise (no digital filtering / OSR).

config BMI270_STREAM
	bool "FIFO streaming via sensor_stream()"
	depends on BMI270_TRIGGER
	depends on $(dt_compat_any_has_prop,$(DT_COMPAT_BOSCH_BMI270),irq-gpios)
	select SENSOR_ASYNC_API
	help
	  Enable FIFO watermark/full streaming using the standard Zephyr
	  sensor_stream() API and SENSOR_TRIG_FIFO_WATERMARK trigger.

config BMI270_FIFO_ON_INT2
	bool "Route FIFO watermark/full interrupt to INT2 instead of INT1"
	depends on BMI270_STREAM
	default n
	help
	  By default, FIFO watermark and full interrupts are mapped to INT1
	  and the single irq-gpios pin is assigned to INT1. Enable this only
	  if your board routes the FIFO interrupt to the sensor's INT2 pin.

config BMI270_FIFO_POLL_FALLBACK
	bool "Poll-based FIFO fallback alongside GPIO interrupt"
	depends on BMI270_STREAM
	default n
	help
	  When set, a periodic poll checks the FIFO fill level via SPI/I2C
	  and triggers a read when the watermark is reached, as a fallback
	  for hardware where the GPIO interrupt line is not connected.
	  The poll period is set by BMI270_FIFO_POLL_PERIOD_MS.

config BMI270_FIFO_POLL_PERIOD_MS
	int "FIFO poll fallback period (ms)"
	depends on BMI270_FIFO_POLL_FALLBACK
	default 100
	range 10 1000
	help
	  How often (in milliseconds) the poll fallback checks the FIFO fill
	  level. Lower values reduce latency but increase SPI/I2C bus traffic.

config BMI270_FIFO_WORKQ_STACK_SIZE
	int "Stack size for FIFO handler work queue thread"
	depends on BMI270_STREAM
	default 4096
	help
	  The FIFO watermark handler runs in a dedicated work queue thread to avoid
	  stack overflow in the trigger thread. Increase if you see crashes when
	  the interrupt fires.

config BMI270_FIFO_HEADERLESS
	bool "Use FIFO headerless mode (no per-frame headers)"
	depends on BMI270_STREAM
	default n
	help
	  When set, FIFO is configured with FIFO_CONFIG_1.fifo_header_en=0.
	  Requires identical ODR for accelerometer and gyroscope.
	  Only regular frames are stored (no skip/sensortime/config);
	  watermark = WATERMARK_SAMPLES*12 gives exactly that many samples per interrupt.

config BMI270_FIFO_WATERMARK_SAMPLES
	int "FIFO watermark in number of samples (acc+gyr frames)"
	depends on BMI270_STREAM
	default 10
	help
	  Desired number of accelerometer and gyroscope data samples per watermark interrupt.
	  In headerless mode the byte watermark is SAMPLES*12 (exact).

config BMI270_FIFO_WATERMARK_CONTROL_MARGIN
	int "Extra bytes added to FIFO byte-watermark for control frames"
	depends on BMI270_STREAM && !BMI270_FIFO_HEADERLESS
	default 0
	help
	  In header mode the FIFO may insert control/skip frames between data
	  frames. This margin is added to (WATERMARK_SAMPLES * frame_bytes) when
	  programming the hardware watermark register, so the interrupt fires
	  after at least WATERMARK_SAMPLES data frames. Set to 0 if you do not
	  need extra headroom for control frames.

config BMI270_FIFO_STREAM_BLOCK_SIZE
	int "Stream RTIO mempool block size (bytes)"
	depends on BMI270_STREAM
	default 384
	help
	  Must match the block size used in RTIO_DEFINE_WITH_MEMPOOL for the
	  sensor stream. Each FIFO read is capped to fit in one block (minus
	  encoded header). Size needed: WATERMARK_SAMPLES*13 + CONTROL_MARGIN
	  + ~32 bytes encoded header. Default 384 supports 10 samples in
	  header mode (10*13+40+32=202) with headroom.

endif # BMI270
```

## drivers/sensor/bosch/bmi323/Kconfig
```kconfig
# Copyright (c) 2023 Trackunit Corporation
# SPDX-License-Identifier: Apache-2.0

menuconfig BMI323
	bool "BMI323 measurement unit"
	default y
	depends on DT_HAS_BOSCH_BMI323_ENABLED
	help
	  Enable driver for BMI323 IMU sensor.
	  The driver implements the following features:

	  * Enable and disable accelerometer and gyroscope respectively
	  * Set full scale for accelerometer and gyroscope respectively
	  * Set data rate for accelerometer and gyroscope respectively
	  * Get samples (x,y,z) from accelerometer and gyroscope respectively
	  * Get die temperature
	  * Set trigger to accelerometer data ready, and accelerometer any motion.

	  The driver implements device and device runtime power management. If
	  runtime management is used, it is initialized into the suspended state,
	  which soft-resets the device to achieve the lowest possible power
	  consumption, otherwise it is resumed when initialized. When resumed,
	  the bus is initialized, the feature engine is enabled, and INT1 is
	  initialized.

if BMI323

config BMI323_BUS_SPI
	bool "BMI323 driver support for SPI bus"
	default y
	depends on $(dt_compat_on_bus,$(DT_COMPAT_BOSCH_BMI323),spi)
	select SPI
	select SPI_RTIO if SENSOR_ASYNC_API

config BMI323_BUS_I2C
	bool "BMI323 driver support for I2C bus"
	default y
	depends on $(dt_compat_on_bus,$(DT_COMPAT_BOSCH_BMI323),i2c)
	select I2C
	select I2C_RTIO if SENSOR_ASYNC_API

endif # BMI323
```

## drivers/sensor/bosch/bmm150/Kconfig
```kconfig
# BMM150 Geomagnetic sensor configuration options

# Copyright (c) 2017 Intel Corporation
# SPDX-License-Identifier: Apache-2.0

menuconfig BMM150
	bool "BMM150 I2C Geomagnetic Chip"
	default y
	depends on DT_HAS_BOSCH_BMM150_ENABLED
	select I2C
	help
	  Enable driver for BMM150 I2C-based Geomagnetic sensor.
if BMM150

choice
	prompt "Default preset"
	default BMM150_PRESET_REGULAR
	help
	  Specify the default preset (x/y oversampling, z oversampling, sampling
	  frequency).

config BMM150_PRESET_LOW_POWER
	bool "Low power (3, 3, 10)"

config BMM150_PRESET_REGULAR
	bool "Regular (9, 15, 10)"

config BMM150_PRESET_ENHANCED_REGULAR
	bool "Enhanced regular (15, 27, 10)"

config BMM150_PRESET_HIGH_ACCURACY
	bool "High accuracy (47, 83, 20)"

endchoice

choice BMM150_TRIGGER_MODE
	prompt "Trigger mode"
	default BMM150_TRIGGER_NONE
	help
	  Specify the type of triggering to be used by the driver.

config BMM150_TRIGGER_NONE
	bool "No trigger"

config BMM150_TRIGGER_GLOBAL_THREAD
	bool "Use global thread"
	depends on GPIO
	depends on $(dt_compat_any_has_prop,$(DT_COMPAT_BOSCH_BMM150),drdy-gpios)
	select BMM150_TRIGGER

config BMM150_TRIGGER_OWN_THREAD
	bool "Use own thread"
	depends on GPIO
	depends on $(dt_compat_any_has_prop,$(DT_COMPAT_BOSCH_BMM150),drdy-gpios)
	select BMM150_TRIGGER

config BMM150_TRIGGER_DIRECT
	bool "Use IRQ handler"
	depends on GPIO
	depends on $(dt_compat_any_has_prop,$(DT_COMPAT_BOSCH_BMM150),drdy-gpios)
	select BMM150_TRIGGER
endchoice

config BMM150_TRIGGER
	bool

config BMM150_SAMPLING_RATE_RUNTIME
	bool "Dynamic sampling rate"
	help
	  Enable alteration of sampling rate attribute at runtime.

config BMM150_SAMPLING_REP_XY
	bool "Dynamic XY oversampling"
	help
	  Enable alteration of XY oversampling at runtime.

config BMM150_SAMPLING_REP_Z
	bool "Dynamic Z oversampling"
	help
	  Enable alteration of Z oversampling at runtime.

config BMM150_THREAD_PRIORITY
	int "Own thread priority"
	depends on BMM150_TRIGGER_OWN_THREAD
	default 10
	help
	  Priority of the thread used by the driver to handle interrupts.

config BMM150_THREAD_STACK_SIZE
	int "Own thread stack size"
	depends on BMM150_TRIGGER_OWN_THREAD
	default 1024
	help
	  Stack size of thread used by the driver to handle interrupts.

endif # BMM150
```

## drivers/sensor/bosch/bmm350/Kconfig
```kconfig
# BMM350 Geomagnetic sensor configuration options

# Copyright (c) 2024 Bosch Sensortec GmbH

# SPDX-License-Identifier: Apache-2.0

menuconfig BMM350
	bool "BMM350 Geomagnetic Chip"
	default y
	depends on DT_HAS_BOSCH_BMM350_ENABLED
	select I2C if $(dt_compat_on_bus,$(DT_COMPAT_BOSCH_BMM350),i2c)
	select I2C_RTIO if $(dt_compat_on_bus,$(DT_COMPAT_BOSCH_BMM350),i2c)
	select I3C if $(dt_compat_on_bus,$(DT_COMPAT_BOSCH_BMM350),i3c)
	select I3C_RTIO if $(dt_compat_on_bus,$(DT_COMPAT_BOSCH_BMM350),i3c)
	help
	  Enable driver for BMM350 I2C/I3C-based Geomagnetic sensor.

if BMM350

module = BMM350
thread_priority = 10
thread_stack_size = 1024
source "drivers/sensor/Kconfig.trigger_template"

config BMM350_STREAM
	bool "Streaming mode"
	default y
	depends on SENSOR_ASYNC_API
	depends on GPIO
	depends on $(dt_compat_any_has_prop,$(DT_COMPAT_BOSCH_BMM350),drdy-gpios)
	depends on !BMM350_TRIGGER

endif # BMM350

config EMUL_BMM350
	bool "Emulator for the BMM350 Geomagnetic sensor"
	default y
	depends on BMM350
	depends on EMUL
	help
	  Enable the hardware emulator for the BMM350. Doing so allows exercising
	  the driver against an emulated bus without real hardware.
```

## drivers/sensor/bosch/bmp085/Kconfig
```kconfig
# Bosch BMP085 pressure sensor

# Copyright (c) 2024, Mario Paja
# SPDX-License-Identifier: Apache-2.0

config BMP085
	bool "Bosch BMP085 pressure sensor"
	default y
	depends on DT_HAS_BOSCH_BMP085_ENABLED
	select I2C
	help
	  Enable driver for the Bosch BMP085 pressure sensor.
```
