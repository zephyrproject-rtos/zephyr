## drivers/sensor/bosch/bmp180/Kconfig
```kconfig
# Copyright (c) 2024 Chris Ruehl
# SPDX-License-Identifier: Apache-2.0

menuconfig BMP180
	bool "Bosch BMP180 pressure sensor"
	default y
	depends on DT_HAS_BOSCH_BMP180_ENABLED
	select I2C
	help
	  Enable driver for the Bosch BMP180 pressure sensor

if BMP180

config BMP180_OSR_RUNTIME
	bool "Change OSR at runtime."
	help
	  Enable runtime changes of the oversampling value

endif # BMP180
```

## drivers/sensor/bosch/bmp280/Kconfig
```kconfig
# Copyright (c) 2025 Sentry Robotics
# SPDX-License-Identifier: Apache-2.0

menuconfig BMP280
	bool "Bosch BMP280 pressure sensor"
	default y
	depends on DT_HAS_BOSCH_BMP280_ENABLED
	select I2C
	help
	  Enable driver for the Bosch BMP280 pressure sensor

if BMP280

endif # BMP280
```

## drivers/sensor/bosch/bmp3xx/Kconfig
```kconfig
# Copyright (c) 2020 Facebook, Inc. and its affiliates
# SPDX-License-Identifier: Apache-2.0

menuconfig BMP3XX
	bool "Bosch BMP388, BMP390 pressure sensor"
	default y
	depends on DT_HAS_BOSCH_BMP388_ENABLED || DT_HAS_BOSCH_BMP390_ENABLED
	select I2C if $(dt_compat_on_bus,$(DT_COMPAT_BOSCH_BMP388),i2c) || \
			$(dt_compat_on_bus,$(DT_COMPAT_BOSCH_BMP390),i2c)
	select SPI if $(dt_compat_on_bus,$(DT_COMPAT_BOSCH_BMP388),spi) || \
			$(dt_compat_on_bus,$(DT_COMPAT_BOSCH_BMP390),spi)
	help
	  Enable driver for the Bosch BMP388 / BMP390 pressure sensor

if BMP3XX

choice BMP3XX_TRIGGER_MODE
	prompt "Trigger mode"
	default BMP3XX_TRIGGER_GLOBAL_THREAD
	help
	  Specify the type of triggering to be used by the driver.

config BMP3XX_TRIGGER_NONE
	bool "No trigger"

config BMP3XX_TRIGGER_GLOBAL_THREAD
	bool "Use global thread"
	depends on GPIO
	depends on $(dt_compat_any_has_prop,$(DT_COMPAT_BOSCH_BMP388),int-gpios) || \
		   $(dt_compat_any_has_prop,$(DT_COMPAT_BOSCH_BMP390),int-gpios)
	select BMP3XX_TRIGGER

config BMP3XX_TRIGGER_OWN_THREAD
	bool "Use own thread"
	depends on GPIO
	depends on $(dt_compat_any_has_prop,$(DT_COMPAT_BOSCH_BMP388),int-gpios) || \
		   $(dt_compat_any_has_prop,$(DT_COMPAT_BOSCH_BMP390),int-gpios)
	select BMP3XX_TRIGGER

config BMP3XX_TRIGGER_DIRECT
	bool "Use IRQ handler"
	depends on GPIO
	depends on $(dt_compat_any_has_prop,$(DT_COMPAT_BOSCH_BMP388),int-gpios) || \
		   $(dt_compat_any_has_prop,$(DT_COMPAT_BOSCH_BMP390),int-gpios)
	select BMP3XX_TRIGGER
endchoice

config BMP3XX_TRIGGER
	bool

config BMP3XX_THREAD_PRIORITY
	int "Own thread priority"
	depends on BMP3XX_TRIGGER_OWN_THREAD
	default 10
	help
	  Priority of the thread used by the driver to handle interrupts.

config BMP3XX_THREAD_STACK_SIZE
	int "Own thread stack size"
	depends on BMP3XX_TRIGGER_OWN_THREAD
	default 1024
	help
	  Stack size of thread used by the driver to handle interrupts.

config BMP3XX_ODR_RUNTIME
	bool "Change ODR at runtime."
	default y

config BMP3XX_OSR_RUNTIME
	bool "Change OSR at runtime."
	default y

endif # BMP3XX
```

## drivers/sensor/bosch/bmp581/Kconfig
```kconfig
#
# Copyright (c) 2022 Badgerd Technologies B.V and its affiliates
# Copyright (c) 2025 Croxel, Inc.
# Copyright (c) 2025 CogniPilot Foundation
#
# SPDX-License-Identifier: Apache-2.0
#

config BMP581
	bool "BMP581 barometric pressure sensor"
	depends on DT_HAS_BOSCH_BMP581_ENABLED
	select I2C if $(dt_compat_on_bus,$(DT_COMPAT_BOSCH_BMP581),i2c)
	select I2C_RTIO if $(dt_compat_on_bus,$(DT_COMPAT_BOSCH_BMP581),i2c)
	select SPI if $(dt_compat_on_bus,$(DT_COMPAT_BOSCH_BMP581),spi)
	select SPI_RTIO if $(dt_compat_on_bus,$(DT_COMPAT_BOSCH_BMP581),spi)
	select I3C if $(dt_compat_on_bus,$(DT_COMPAT_BOSCH_BMP581),i3c)
	select I3C_RTIO if $(dt_compat_on_bus,$(DT_COMPAT_BOSCH_BMP581),i3c)
	default y

config BMP581_STREAM
	bool "Streaming mode"
	default y
	depends on SENSOR_ASYNC_API
	depends on GPIO
	depends on $(dt_compat_any_has_prop,$(DT_COMPAT_BOSCH_BMP581),int-gpios)
```

## drivers/sensor/bq24155/Kconfig
```kconfig
# Copyright (c) 2021 Greyp Bikes d.o.o
# SPDX-License-Identifier: Apache-2.0

config BQ24155
	bool "BQ24155 One-Cell Li-Ion Charger"
	depends on I2C
	help
	  Enable I2C-based driver for BQ24155 Li-Ion Charger.
```

## drivers/sensor/bq2415x/Kconfig
```kconfig
# Copyright (c) 2021 Greyp Bikes d.o.o
# SPDX-License-Identifier: Apache-2.0

config BQ2415X
	bool "BQ2415x One-Cell Li-Ion Charger"
	depends on I2C
	help
	  Enable I2C-based driver for BQ2415x Li-Ion Charger.
```

## drivers/sensor/bq274xx/Kconfig
```kconfig
# Copyright (c) 2020 Linumiz
#
# SPDX-License-Identifier: Apache-2.0

menuconfig BQ274XX
	bool "BQ274xx Fuel Gauge"
	depends on I2C
	help
	  Enable I2C-based driver for BQ274xx Fuel Gauge.

if BQ274XX

config BQ274XX_LAZY_CONFIGURE
	bool "Configure on first usage instead of init"
	help
	  Configuring the sensor can take a long time, which
	  we can delay till the first sample request and keep
	  the boot time as short as possible.

endif # BQ274XX
```

## drivers/sensor/bq34110/Kconfig
```kconfig
# Copyright (c) 2021 Linumiz
#
# SPDX-License-Identifier: Apache-2.0

config BQ34110
	bool "BQ34110 Fuel Gauge"
	depends on I2C
	help
	  Enable I2C-based driver for BQ34110 Fuel Gauge.
```

## drivers/sensor/bq35100/Kconfig
```kconfig
# BQ35100 lithium primary battery fuel gauge configuration options

# Copyright (c) 2021 arithmetics.io
# SPDX-License-Identifier: Apache-2.0

menuconfig BQ35100
	bool "BQ35100 lithium primary battery fuel gauge"
	depends on I2C && NEWLIB_LIBC
	help
	  Enable driver for BQ35100 BQ35100 lithium primary battery fuel gauge.
```

## drivers/sensor/bq40zxx/Kconfig
```kconfig
# Copyright (c) 2020 ZedBlox
#
# SPDX-License-Identifier: Apache-2.0

config BQ40ZXX
	bool "BQ40Zxx Fuel Gauge"
	depends on I2C
	help
	  Enable I2C-based driver for BQ40Zxx Fuel Gauge.
```

## drivers/sensor/broadcom/Kconfig
```kconfig
# Copyright (c) 2025 Croxel Inc.
# Copyright (c) 2025 CogniPilot Foundation
# SPDX-License-Identifier: Apache-2.0

source "drivers/sensor/broadcom/afbr_s50/Kconfig"
source "drivers/sensor/broadcom/bcm283x_vc_thermal/Kconfig"
```

## drivers/sensor/broadcom/afbr_s50/Kconfig
```kconfig
# Copyright (c) 2025 Croxel Inc.
# Copyright (c) 2025 CogniPilot Foundation
# SPDX-License-Identifier: Apache-2.0

config AFBR_S50
	bool "AFBR-S50 Time-of-Flight Sensor"
	default y
	depends on DT_HAS_BRCM_AFBR_S50_ENABLED
	select SENSOR_ASYNC_API
	select SPI
	select SPI_RTIO
	select RTIO_WORKQ
	select AFBR_LIB
	select PINCTRL
	select PINCTRL_NON_STATIC
	help
	  Enable driver for the AFBR-S50 Time-of-Flight sensor.
```

## drivers/sensor/broadcom/bcm283x_vc_thermal/Kconfig
```kconfig
# Copyright (c) 2026 Jonathan Elliot Peace <jep@alphabetiq.com>
# SPDX-License-Identifier: Apache-2.0

config BCM283X_VC_THERMAL
	bool "Raspberry Pi BCM283x VideoCore SoC temperature sensor"
	default y
	depends on DT_HAS_RASPBERRYPI_BCM283X_VC_THERMAL_ENABLED
	select RASPBERRYPI_FIRMWARE
	help
	  Raspberry Pi BCM283x SoC die-temperature sensor. The temperature
	  is read through the VideoCore firmware GET_TEMPERATURE property
	  tag (the source behind `vcgencmd measure_temp`) and exposed as
	  SENSOR_CHAN_DIE_TEMP.
```
