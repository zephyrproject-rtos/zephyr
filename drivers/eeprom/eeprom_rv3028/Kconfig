## drivers/eeprom/eeprom_rv3028/Kconfig
```kconfig
# Copyright (c) 2024 ANITRA system s.r.o.
# SPDX-License-Identifier: Apache-2.0

config EEPROM_RV3028
	bool "Micro Crystal RV3028 User EEPROM support"
	default y
	depends on RTC_RV3028
	depends on DT_HAS_MICROCRYSTAL_RV3028_EEPROM_ENABLED
```

## drivers/entropy/Kconfig
```kconfig
# Entropy generator driver configuration options

# Copyright (c) 2014-2015 Wind River Systems, Inc.
# SPDX-License-Identifier: Apache-2.0

menuconfig ENTROPY_GENERATOR
	bool "Entropy drivers"
	help
	  Include entropy drivers in system config.

if ENTROPY_GENERATOR

module = ENTROPY
module-str = entropy
source "subsys/logging/Kconfig.template.log_config"

config ENTROPY_INIT_PRIORITY
	int "Entropy driver init priority"
	default KERNEL_INIT_PRIORITY_DEVICE
	help
	  Entropy driver device initialization priority.

source "drivers/entropy/Kconfig.*"

config ENTROPY_HAS_DRIVER
	bool
	help
	  This is an option to be enabled by individual entropy driver
	  to signal that there is a true entropy driver.

endif
```

## drivers/entropy/Kconfig.ambiq
```kconfig
# PUF entropy generator driver configuration

# Copyright (c) 2025, Ambiq Micro, Inc.
# SPDX-License-Identifier: Apache-2.0

config ENTROPY_AMBIQ_PUF_TRNG
	bool "Ambiq TRNG driver"
	default y
	depends on SOC_AMBIQ_HAS_PUF
	depends on DT_HAS_AMBIQ_PUF_TRNG_ENABLED
	select ENTROPY_HAS_DRIVER
	help
	  This option enables the true random number generator
	  driver based on the OTP/PUF TRNG.
```

## drivers/entropy/Kconfig.ameba
```kconfig
# AMEBA entropy generator driver configuration

# Copyright (c) 2026 Realtek Semiconductor Corp.
# SPDX-License-Identifier: Apache-2.0

config ENTROPY_AMEBA_TRNG
	bool "Ameba entropy number generator driver"
	default y
	depends on DT_HAS_REALTEK_AMEBA_TRNG_ENABLED
	select ENTROPY_HAS_DRIVER
	help
	  Enable entropy number generator support on the AMEBA family of processors.
```

## drivers/entropy/Kconfig.arm64
```kconfig
# Copyright (c) Qualcomm Technologies, Inc. and/or its subsidiaries.
# SPDX-License-Identifier: Apache-2.0

config ENTROPY_ARM64_RNG
	bool "Use ARM64 entropy driver"
	depends on ARM64_RNG && DT_HAS_ZEPHYR_ARM64_RNG_ENABLED
	select ENTROPY_HAS_DRIVER
	default y
	help
	  Enables the entropy driver based on the RNDRRS instruction from the ARM
	  extension FEAT_RNG.

if ENTROPY_ARM64_RNG

config ENTROPY_ARM64_RNG_MAX_RETRIES
	int "Maximum number of retries for ARM64 entropy driver"
	default 5
	help
	  Maximum number of consecutive RNDRRS instruction failures after which the
	  driver should return error.

config ENTROPY_ARM64_RNG_RETRY_WAIT_MSEC
	int "Retry wait time for ARM64 entropy driver"
	default 100
	help
	  Number of milliseconds driver should wait before retrying after RNDRRS
	  instruction failure.

endif # ENTROPY_ARM64_RNG
```

## drivers/entropy/Kconfig.ateccx08
```kconfig
# Microchip ATECCx08 entropy generator driver configuration

# Copyright (c) 2024 Vogl Electronic GmbH
# SPDX-License-Identifier: Apache-2.0

config ENTROPY_ATECCX08
	bool "Microchip ATECCx08 RNG driver"
	default y
	depends on DT_HAS_MICROCHIP_ATECCX08_ENTROPY_ENABLED
	depends on MFD_ATECCX08
	select ENTROPY_HAS_DRIVER
	help
	  This option enables the Microchip ATECCx08 RNG driver.

config ENTROPY_ATECCX08_INIT_PRIORITY
	int "Microchip ATECCx08 RNG driver init priority"
	default MFD_ATECCX08_SUBDEVICE_INIT_PRIORITY
	depends on ENTROPY_ATECCX08
	help
	  Microchip ATECCx08 RNG driver device initialization priority.
```

## drivers/entropy/Kconfig.atm
```kconfig
# Atmosic TRNG configuration

# Copyright (c) 2023 Atmosic
# SPDX-License-Identifier: Apache-2.0

config ENTROPY_ATM_TRNG
	bool "Atmosic True Random Number Generator (TRNG) Driver"
	default y
	depends on DT_HAS_ATMOSIC_ATM_TRNG_ENABLED
	select ENTROPY_HAS_DRIVER
	help
	  Enable True Random Number Generator (TRNG) driver for Atmosic SOCs.

config ENTROPY_ATM_RING_ENTRIES
	int "Number of entries in ring buffer between ISR and driver methods"
	default 8

config ENTROPY_ATM_STATS
	bool "Debug statistics for internal driver operations"
	default n
```

## drivers/entropy/Kconfig.b91
```kconfig
# Copyright (c) 2021 Telink Semiconductor
# SPDX-License-Identifier: Apache-2.0

# Telink B91 GPIO configuration options

config ENTROPY_TELINK_B91_TRNG
	bool "Telink B91 Entropy driver"
	default y
	depends on DT_HAS_TELINK_B91_TRNG_ENABLED
	select ENTROPY_HAS_DRIVER
	help
	  Enable the B91 Entropy driver.
```

## drivers/entropy/Kconfig.b9x
```kconfig
# Copyright (c) 2021-2024 Telink Semiconductor
# SPDX-License-Identifier: Apache-2.0

# Telink B9x-series GPIO configuration options

config ENTROPY_TELINK_B9X_TRNG
	bool "Telink B9x-series Entropy driver"
	default y
	depends on DT_HAS_TELINK_B9X_TRNG_ENABLED
	select ENTROPY_HAS_DRIVER
	help
	  Enable the B9x-series Entropy driver.
```

## drivers/entropy/Kconfig.bcm2835
```kconfig
# Copyright (c) 2026 Jonathan Elliot Peace <jep@alphabetiq.com>
# SPDX-License-Identifier: Apache-2.0

config ENTROPY_BRCM_BCM2835_RNG
	bool "Broadcom BCM2835 simple RNG driver"
	default y
	depends on DT_HAS_BRCM_BCM2835_RNG_ENABLED
	select ENTROPY_HAS_DRIVER
	help
	  Enable the Broadcom BCM2835 simple hardware RNG block driver, used
	  by the BCM2835/BCM2836/BCM2837/BCM2710 SoCs (Raspberry Pi 1/2/3/Zero
	  family). This is distinct from the iProc RNG200 on BCM2711 (Pi 4).
```

## drivers/entropy/Kconfig.bee
```kconfig
# Copyright(c) 2026, Realtek Semiconductor Corporation.
# SPDX-License-Identifier: Apache-2.0

config ENTROPY_BEE_TRNG
	bool "Realtek Bee Family TRNG driver"
	default y
	depends on DT_HAS_REALTEK_BEE_TRNG_ENABLED
	select ENTROPY_HAS_DRIVER
	help
	  Enable the TRNG driver for Realtek Bee family SoCs.
```

## drivers/entropy/Kconfig.bflb
```kconfig
# Copyright The Zephyr Project Contributors
# SPDX-License-Identifier: Apache-2.0

config ENTROPY_BFLB_SEC_ENG
	bool "Bouffalo Lab SEC Engine TRNG driver"
	default y
	depends on DT_HAS_BFLB_SEC_ENG_TRNG_ENABLED
	select ENTROPY_HAS_DRIVER
	help
	  Enable the Bouffalo Lab SEC Engine TRNG entropy driver.
	  Provides hardware true random number generation via the
	  SEC_ENG TRNG peripheral.
```

## drivers/entropy/Kconfig.bt_hci
```kconfig
# Copyright (c) 2022, Commonwealth Scientific and Industrial Research
# Organisation (CSIRO) ABN 41 687 119 230.
# SPDX-License-Identifier: Apache-2.0

config ENTROPY_BT_HCI
	bool "Bluetooth HCI RNG driver"
	default y
	depends on DT_HAS_ZEPHYR_BT_HCI_ENTROPY_ENABLED
	depends on BT_HCI_HOST
	select ENTROPY_HAS_DRIVER
	help
	  Enable Random Number Generator from a Bluetooth HCI device.

# Don't use use Bluetooth HCI as a random source since it will be slow.
# Instead, use the software implemented xoshiro RNG.
choice RNG_GENERATOR_CHOICE
	default XOSHIRO_RANDOM_GENERATOR if ENTROPY_BT_HCI
endchoice
```

## drivers/entropy/Kconfig.cc13xx_cc26xx
```kconfig
# TI CC13xx / CC26xx entropy driver configuration

# Copyright (c) 2019 Brett Witherspoon
# SPDX-License-Identifier: Apache-2.0

config ENTROPY_CC13XX_CC26XX_RNG
	bool "TI SimpleLink CC13xx / CC26xx True Random Number Generator (TRNG)"
	default y
	depends on DT_HAS_TI_CC13XX_CC26XX_TRNG_ENABLED
	select ENTROPY_HAS_DRIVER
	select RING_BUFFER
	help
	  This option enables the driver for the True Random Number Generator (TRNG)
	  for TI SimpleLink CC13xx / CC26xx SoCs.

if ENTROPY_CC13XX_CC26XX_RNG

config ENTROPY_CC13XX_CC26XX_POOL_SIZE
	int "Number of bytes in the entropy pool"
	default 512
	help
	  The size in bytes of the buffer used to store entropy generated by the
	  hardware. Should be a power of two for high performance.

config ENTROPY_CC13XX_CC26XX_SAMPLES_PER_CYCLE
	int "Number of samples to generate entropy"
	range 256 16777216
	default 240000
	help
	  The number of samples used to generate entropy. The time required to
	  generate 64 bits of entropy is determined by the number of FROs enabled,
	  the sampling (system) clock frequency, and this value.

config ENTROPY_CC13XX_CC26XX_ALARM_THRESHOLD
	int "Threshold for detected repeated patterns"
	range 0 255
	default 255
	help
	  The number of samples detected with repeating patterns before an alarm
	  event is triggered. The associated FRO is automatically shut down.

config ENTROPY_CC13XX_CC26XX_SHUTDOWN_THRESHOLD
	int "Threshold for the number of FROs automatically shut down"
	range 0 24
	default 0
	help
	  The number of FROs allowed to be shutdown before the driver attempts to
	  take corrective action.

endif # ENTROPY_CC13XX_CC26XX_RNG
```

## drivers/entropy/Kconfig.esp32
```kconfig
# esp32 entropy generator driver configuration

# Copyright (c) 2017 Intel Corporation
# SPDX-License-Identifier: Apache-2.0

config ENTROPY_ESP32_RNG
	bool "ESP32 entropy number generator driver"
	default y
	depends on DT_HAS_ESPRESSIF_ESP32_TRNG_ENABLED
	select ENTROPY_HAS_DRIVER
	help
	  This option enables the entropy number generator for ESP32 SoCs.

	  With Wi-Fi and Bluetooth disabled, this will produce pseudo-entropy
	  numbers: noise from these radios are used to feed entropy in this
	  generator.
```

## drivers/entropy/Kconfig.gd32
```kconfig
# GD32 TRNG configuration

# Copyright (c) 2025 Aleksandr Senin <al@meshium.net>
# SPDX-License-Identifier: Apache-2.0

config ENTROPY_GD32_TRNG
	bool "GigaDevice GD32F4xx TRNG driver"
	default y
	depends on DT_HAS_GD_GD32_TRNG_ENABLED
	select ENTROPY_HAS_DRIVER
	select USE_GD32_TRNG
	help
	  Enable True Random Number Generator (TRNG) driver for GigaDevice
	  GD32F4xx series. This driver uses the GD32 HAL and operates in
	  polling mode.
```

## drivers/entropy/Kconfig.gecko
```kconfig
# gecko entropy generator driver configuration

# Copyright (c) 2020 Lemonbeat GmbH
# Copyright (c) 2021 Safran Passenger Innovations Germany GmbH
# SPDX-License-Identifier: Apache-2.0

config ENTROPY_GECKO_TRNG
	bool "GECKO TRNG driver"
	default y
	depends on DT_HAS_SILABS_GECKO_TRNG_ENABLED
	select ENTROPY_HAS_DRIVER
	select CRYPTO_ACC_GECKO_TRNG if SOC_SERIES_EFR32BG22
	select CRYPTO_ACC_GECKO_TRNG if SOC_SERIES_EFR32BG27
	help
	  This option enables the true random number generator
	  driver based on the TRNG.

config ENTROPY_GECKO_SE
	bool "GECKO SE driver"
	default y
	depends on DT_HAS_SILABS_GECKO_SEMAILBOX_ENABLED
	select ENTROPY_HAS_DRIVER
	help
	  This option enables the true random number generator
	  driver based on the Secure Element (SE) module.
```

## drivers/entropy/Kconfig.infineon_mxcryptolite
```kconfig
# SPDX-FileCopyrightText: Copyright (c) 2026 Infineon Technologies AG,
# SPDX-FileCopyrightText: or an affiliate of Infineon Technologies AG. All rights reserved.
#
# SPDX-License-Identifier: Apache-2.0

config ENTROPY_INFINEON_MXCRYPTOLITE_TRNG
	bool "Infineon MXCRYPTOLITE TRNG entropy driver"
	default y
	depends on DT_HAS_INFINEON_MXCRYPTOLITE_TRNG_ENABLED
	select MFD
	select ENTROPY_HAS_DRIVER
	select USE_INFINEON_MXCRYPTOLITE_TRNG
	help
	  Enable the True Random Number Generator entropy driver for
	  Infineon devices that include the MXRYPTOLITE IP.
```

## drivers/entropy/Kconfig.iproc
```kconfig
# Copyright (c) 2025 TOKITA Hiroshi
# SPDX-License-Identifier: Apache-2.0

config ENTROPY_BRCM_IPROC_RNG200
	bool "Broadcom iProc RNG200 driver"
	default y
	depends on DT_HAS_BRCM_IPROC_RNG200_ENABLED
	select ENTROPY_HAS_DRIVER
	help
	  Enable the Broadcom iProc RNG200 random number generator
```

## drivers/entropy/Kconfig.litex
```kconfig
# LiteX PRBS entropy generator driver configuration

# Copyright (c) 2019 Antmicro <www.antmicro.com>
# SPDX-License-Identifier: Apache-2.0

config ENTROPY_LITEX_RNG
	bool "PRBS RNG driver"
	default y
	depends on DT_HAS_LITEX_PRBS_ENABLED
	select ENTROPY_HAS_DRIVER
	help
	  This option enables the RNG module, which is an entropy number
	  generator, based on Pseudo-Random Binary Sequences (PRBS)
	  for LiteX SoC builder
```

## drivers/entropy/Kconfig.max32
```kconfig
# Copyright (c) 2023-2024 Analog Devices, Inc.
# SPDX-License-Identifier: Apache-2.0

config ENTROPY_MAX32_TRNG
	bool "ADI MAX32XXX MCU Family True Random Number Generator (TRNG) Driver"
	default y
	depends on DT_HAS_ADI_MAX32_TRNG_ENABLED
	select ENTROPY_HAS_DRIVER
	help
	  Enable True Random Number Generator (TRNG) driver for ADI MAX32XXX MCUs.
```

## drivers/entropy/Kconfig.maxq10xx
```kconfig
# Copyright (c) 2025 Vogl Electronic GmbH
# SPDX-License-Identifier: Apache-2.0

config ENTROPY_MAXQ10XX_RNG
	bool "MAXQ10xx entropy number generator driver"
	default y
	depends on DT_HAS_ADI_MAXQ10XX_TRNG_ENABLED
	select ENTROPY_HAS_DRIVER
	select SPI
	select MFD
	select CRC
	help
	  This option enables the entropy number generator driver for the
	  MAXQ10xx crypto chips.

# Don't use use the MAXQ10XX RNG as a random source since it can be quite slow.
# Instead, use the software-implemented xoshiro PRNG.
choice RNG_GENERATOR_CHOICE
	default XOSHIRO_RANDOM_GENERATOR if ENTROPY_MAXQ10XX_RNG
endchoice
```

## drivers/entropy/Kconfig.mchp
```kconfig
# Copyright (c) 2025 Microchip Technology Inc.
# SPDX-License-Identifier: Apache-2.0

config ENTROPY_MCHP_TRNG_G1
	bool "Microchip MCHP G1 Entropy Driver"
	default y
	depends on DT_HAS_MICROCHIP_TRNG_G1_ENTROPY_ENABLED
	select ENTROPY_HAS_DRIVER
	help
	  This option enables Entropy driver for group (g1).
```

## drivers/entropy/Kconfig.mcux
```kconfig
# mcux entropy generator driver configuration

# Copyright (c) 2016 ARM Ltd.
# SPDX-License-Identifier: Apache-2.0

config ENTROPY_MCUX_RNGA
	bool "MCUX RNGA driver"
	default y
	depends on DT_HAS_NXP_KINETIS_RNGA_ENABLED
	select ENTROPY_HAS_DRIVER
	help
	  This option enables the random number generator accelerator (RNGA)
	  driver based on the MCUX RNGA driver.

config ENTROPY_MCUX_TRNG
	bool "MCUX TRNG driver"
	default y
	depends on DT_HAS_NXP_KINETIS_TRNG_ENABLED
	select ENTROPY_HAS_DRIVER
	help
	  This option enables the true random number generator (TRNG)
	  driver based on the MCUX TRNG driver.

config ENTROPY_MCUX_RNG
	bool "MCUX RNG driver"
	default y
	depends on DT_HAS_NXP_LPC_RNG_ENABLED
	select ENTROPY_HAS_DRIVER
	help
	  This option enables the true random number generator (TRNG)
	  driver based on the MCUX RNG driver on LPC Family.

config ENTROPY_MCUX_CAAM
	bool "MCUX CAAM driver"
	default y
	depends on DT_HAS_NXP_IMX_CAAM_ENABLED
	select ENTROPY_HAS_DRIVER
	select NOCACHE_MEMORY if ARCH_HAS_NOCACHE_MEMORY_SUPPORT
	help
	  This option enables the CAAM driver based on the MCUX
	  CAAM driver.

#
# Don't use use the MCUX TRNG as a random source as it is not designed
# to supply a continuous random stream. Instead, it is used to provide
# a seed to RNG generator.
#
# Use the software implemented xoroshiro RNG.
# Use CSPRNG for cryptographically secure RNG source.
#
choice RNG_GENERATOR_CHOICE
	default XOSHIRO_RANDOM_GENERATOR if ENTROPY_MCUX_TRNG
endchoice

choice CSPRNG_GENERATOR_CHOICE
	default CTR_DRBG_CSPRNG_GENERATOR if ENTROPY_MCUX_TRNG
endchoice

if ENTROPY_MCUX_CAAM

config ENTRY_MCUX_CAAM_POOL_SIZE
	int "CAAM random number pool size"
	range 4 1024
	default 256
	help
	  Buffer length in bytes used to store random bytes generated by
	  CAAM hardware. Please note, that size of the pool must be a
	  power of 2.

endif # ENTROPY_MCUX_CAAM
```

## drivers/entropy/Kconfig.mcxw
```kconfig
# NXP MCXW entropy configuration options

# Copyright 2025 NXP
# SPDX-License-Identifier: Apache-2.0

config ENTROPY_MCXW_TRNG
	bool "NXP MCXW TRNG driver"
	default y
	depends on DT_HAS_NXP_MCXW_TRNG_ENABLED
	select ENTROPY_HAS_DRIVER
	help
	  This option enables the MCXW true random number generator (TRNG)
```
