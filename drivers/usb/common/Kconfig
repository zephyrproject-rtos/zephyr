## drivers/usb/udc/Kconfig.rpi_pico
```kconfig
# Copyright (c) 2024 Nordic Semiconductor ASA
# SPDX-License-Identifier: Apache-2.0

config UDC_RPI_PICO
	bool "Driver for an Raspberry PI Pico USB device controller"
	default y
	depends on DT_HAS_RASPBERRYPI_PICO_USBD_ENABLED
	select SYS_MEM_BLOCKS
	help
	  Driver for an Raspberry PI Pico USB device controller.

if UDC_RPI_PICO

config UDC_RPI_PICO_STACK_SIZE
	int "UDC controller driver internal thread stack size"
	default 512
	help
	  Device controller driver internal thread stack size.

config UDC_RPI_PICO_THREAD_PRIORITY
	int "UDC controller driver thread priority"
	default 8
	help
	  Device controller driver thread priority.

endif # UDC_RPI_PICO
```

## drivers/usb/udc/Kconfig.sam0
```kconfig
# Copyright (c) 2025 Nordic Semiconductor ASA
# SPDX-License-Identifier: Apache-2.0

config UDC_SAM0
	bool "Driver for SAM0 family USB device controller"
	default y
	depends on DT_HAS_ATMEL_SAM0_USB_ENABLED
	select PINCTRL
	select EVENTS
	help
	  Driver for SAM0 family USB device controller.

if UDC_SAM0

config UDC_SAM0_STACK_SIZE
	int "UDC controller driver internal thread stack size"
	default 512
	help
	  Device controller driver internal thread stack size.

config UDC_SAM0_THREAD_PRIORITY
	int "UDC controller driver thread priority"
	default 8
	help
	  Device controller driver thread priority.

endif # UDC_SAM0
```
