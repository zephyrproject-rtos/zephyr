## drivers/usb/udc/Kconfig.ambiq
```kconfig
# Copyright (c) 2024 Ambiq Micro Inc.
# SPDX-License-Identifier: Apache-2.0

config UDC_AMBIQ
	bool "USB device controller driver for ambiq devices"
	default y
	depends on DT_HAS_AMBIQ_USB_ENABLED
	select GPIO
	select AMBIQ_HAL
	select AMBIQ_HAL_USE_USB
	select UDC_DRIVER_HAS_HIGH_SPEED_SUPPORT
	help
	  Enable USB Device Controller Driver.

if UDC_AMBIQ

config UDC_AMBIQ_STACK_SIZE
	int "UDC AMBIQ driver internal thread stack size"
	default 2048
	help
	  AMBIQ driver internal thread stack size.

config UDC_AMBIQ_THREAD_PRIORITY
	int "UDC AMBIQ driver thread priority"
	default 8
	help
	  AMBIQ driver thread priority.

config UDC_AMBIQ_MAX_QMESSAGES
	int "UDC AMBIQ maximum number of ISR event messages"
	range 4 64
	default 8
	help
	  AMBIQ maximum number of ISR event messages.

choice UDC_AMBIQ_DMA_MODE
	prompt "DMA mode for non-control USB endpoints"
	default UDC_AMBIQ_DMA0_MODE
	depends on SOC_SERIES_APOLLO5X

config UDC_AMBIQ_DMA0_MODE
	bool "DMA0 transfer mode"
	help
	  Select this option when synchronous endpoint is used.

config UDC_AMBIQ_DMA1_MODE
	bool "DMA1 transfer mode"
	help
	  This option gives best throughput when endpoint buffer is greater than Max
	  Packet Size. However this option cannot be chosen when synchronous
	  endpoint is used.

config UDC_AMBIQ_PIO_MODE
	bool "PIO transfer mode"
	help
	  Select this option when cache coherency handling is to be avoided.
endchoice

config UDC_AMBIQ_DEB_ENABLE
	hex "EP Double Buffer Enable"
	default 0x0000
	depends on SOC_SERIES_APOLLO5X
	help
	  Double Endpoint Buffer acceleration (DEB) is doubles an EP's FIFO size so
	  that USB transfer could continue to happen while waiting for DMA/CPU to
	  load/unload data from the EP FIFO. This hex value is a bitmap of endpoints
	  for DEB to be enabled. BIT0-4 represents OUT_EP 1-5, while BIT16-20
	  represents IN_EP 1-5. Take note that this feature is limited by total EP
	  FIFO size. Proper calculation should be done before enabling DEB such that
	  the total usage of FIFO for all endpoint doesn't exceed the FIFO available
	  on SoC. The list of Soc with its FIFO size is listed below. The FIFO size
	  here includes 128 bytes required by control endpoints.
	  - Apollo510: (4096 Bytes FIFO)

endif # UDC_AMBIQ
```

## drivers/usb/udc/Kconfig.bflb
```kconfig
# Copyright (c) 2024-2025 MASSDRIVER EI (massdriver.space)
# SPDX-License-Identifier: Apache-2.0

config UDC_BFLB_BL61X
	bool "BL61x USB device controller driver"
	select UDC_DRIVER_HAS_HIGH_SPEED_SUPPORT
	imply UDC_WORKQUEUE
	default y
	depends on DT_HAS_BFLB_BL61X_UDC_ENABLED
	help
	  Bouffalolab BL61x USB device controller driver

if UDC_BFLB_BL61X

config UDC_BFLB_BL61X_EVENT_COUNT
	int "Number or blocks in event slab"
	range 8 32
	default 16
	help
	  Number of blocks in slab for internal endpoint events.

endif # UDC_BFLB_BL61X
```

## drivers/usb/udc/Kconfig.bflb_v1
```kconfig
# SPDX-FileCopyrightText: Copyright The Zephyr Project Contributors
# SPDX-License-Identifier: Apache-2.0

config UDC_BFLB_V1
	bool "Bouffalo Lab USB device controller driver (USB v1 block)"
	default y
	depends on DT_HAS_BFLB_UDC_1_ENABLED
	select EVENTS
	select PINCTRL
	help
	  USB device controller driver for Bouffalo Lab SoCs with the v1 USB
	  block (BL702/BL706). Supports USB 1.1 Full-Speed with 8 endpoints,
	  each supporting IN and OUT.

if UDC_BFLB_V1

config UDC_BFLB_V1_STACK_SIZE
	int "UDC controller driver internal thread stack size"
	default 1024
	help
	  Bouffalo Lab USB device controller driver internal thread stack size.

config UDC_BFLB_V1_THREAD_PRIORITY
	int "UDC controller driver thread priority"
	default 8
	help
	  Bouffalo Lab USB device controller driver thread priority.

endif # UDC_BFLB_V1
```

## drivers/usb/udc/Kconfig.cdns3
```kconfig
# Copyright (c) 2026 Texas Instruments
# SPDX-License-Identifier: Apache-2.0

config UDC_CDNS3
	bool "Cadence CDNS3 USB Device Controller driver"
	default y
	depends on DT_HAS_CDNS_USB3_ENABLED
	select UDC_DRIVER_HAS_HIGH_SPEED_SUPPORT
	help
	  Enable the Cadence CDNS3 USB Device Controller driver.

if UDC_CDNS3

config UDC_CDNS3_NUM_TRBS
	int "Number of TRBs per endpoint"
	default 16
	range 4 256
	help
	  Number of Transfer Request Blocks (TRBs) allocated per endpoint.
	  Each TRB represents one transfer operation and is 12 bytes in size.

	  Total memory per EP = num_trbs * 16 bytes + buffer pointers

config UDC_CDNS3_POOL_SIZE
	int "CDNS3 DMA pool size in bytes"
	default 8192
	help
	  Size of the DMA-coherent memory pool used for TRB (Transfer Request
	  Block) allocation. This pool is shared among all endpoints for
	  storing transfer descriptors.

	  The pool should be large enough to accommodate all active endpoints.

endif # UDC_CDNS3
```

## drivers/usb/udc/Kconfig.dwc2
```kconfig
# Copyright (c) 2023 Nordic Semiconductor ASA
# SPDX-License-Identifier: Apache-2.0

config UDC_DWC2
	bool "DWC2 USB device controller driver"
	default y
	depends on DT_HAS_SNPS_DWC2_ENABLED
	select UDC_DRIVER_HAS_HIGH_SPEED_SUPPORT
	select NRFS if NRFS_HAS_VBUS_DETECTOR_SERVICE
	select NRFS_VBUS_DETECTOR_SERVICE_ENABLED if NRFS_HAS_VBUS_DETECTOR_SERVICE
	select EVENTS
	help
	  DWC2 USB device controller driver.

config UDC_DWC2_DMA
	bool "DWC2 USB DMA support"
	default y
	depends on UDC_DWC2
	help
	  Enable Buffer DMA if DWC2 USB controller supports Internal DMA.

config UDC_DWC2_HIBERNATION
	bool "DWC2 USB Hibernation support"
	default y
	depends on UDC_DWC2
	help
	  Enable Hibernation if DWC2 USB controller supports hibernation.

config UDC_DWC2_STACK_SIZE
	int "UDC DWC2 driver internal thread stack size"
	depends on UDC_DWC2
	default 512
	help
	  DWC2 driver internal thread stack size.

config UDC_DWC2_THREAD_PRIORITY
	int "UDC DWC2 driver thread priority"
	depends on UDC_DWC2
	default 8
	help
	  DWC2 driver thread priority.

config UDC_DWC2_USBHS_VBUS_READY_TIMEOUT
	int "UDC DWC2 USBHS VBUS ready event timeout in ms"
	depends on UDC_DWC2
	depends on NRFS_HAS_VBUS_DETECTOR_SERVICE
	default 0
	help
	  UDC DWC2 USBHS VBUS ready event timeout. If the VBUS is not ready
	  and the Nordic USBHS controller is used, the udc_enable() is
	  blocked for this amount of time. Set it to zero to wait forever.
```

## drivers/usb/udc/Kconfig.dwc3
```kconfig
# SPDX-FileCopyrightText: Copyright tinyVision.ai Inc.
# SPDX-License-Identifier: Apache-2.0

config UDC_DWC3
	bool "Synopsys USB device controller driver"
	default y
	select NOCACHE_MEMORY if ARCH_HAS_NOCACHE_MEMORY_SUPPORT
	select UDC_BUF_FORCE_NOCACHE
	select UDC_DRIVER_HAS_HIGH_SPEED_SUPPORT
	depends on DT_HAS_SNPS_DWC3_ENABLED
	help
	  Synopsys DWC3 USB device controller driver.

if UDC_DWC3

config UDC_DWC3_EVENTS_NUM
	int "Number of events in the event ring buffer"
	default 16
	help
	  It is typically not needed to increase the number of events, but
	  if it were to happen due to some rare condition, increasing this
	  number could be useful.

config UDC_DWC3_TRB_NUM
	int "Number of buffers for each non-control endpoint"
	default 4
	range 3 32
	help
	  This is a general knob for the number of buffers present for each
	  endpoint. This does not affect control endpoints. The default is
	  enough for most conditions, but for performance and debug purposes,
	  increasing could reveal useful.

endif # UDC_DWC3
```

## drivers/usb/udc/Kconfig.elan
```kconfig
# Copyright (c) 2025 ELAN Microelectronics Corp.
# SPDX-License-Identifier: Apache-2.0

config UDC_ELAN_ELANDEV
	bool "Elan USB device controller driver"
	depends on DT_HAS_ELAN_ELANDEV_USBD_ENABLED
	default y
	help
	  E967 USB device controller driver.

if UDC_ELAN_ELANDEV

config UDC_E967_STACK_SIZE
	int "UDC controller driver internal thread stack size"
	default 4096
	help
	  ELAN USB device controller driver internal thread stack size.

config UDC_E967_THREAD_PRIORITY
	int "ELAN USB controller driver thread priority"
	default 8
	help
	  ELAN USB device controller driver thread priority.

config UDC_E967_MSG_QUEUE_SIZE
	int "UDC message queue size"
	default 32
	help
	  Maximum number of messages the driver can queue for interrupt bottom half processing.

endif # UDC_ELAN_ELANDEV
```

## drivers/usb/udc/Kconfig.em32
```kconfig
# Copyright (c) 2021-2022 Nordic Semiconductor ASA
# SPDX-License-Identifier: Apache-2.0

config UDC_ELAN_EM32
	bool "Elan USB device controller driver"
	depends on DT_HAS_ELAN_EM32_USBD_ENABLED
	default y
	help
	  EM32 USB device controller driver.

if UDC_ELAN_EM32

config UDC_EM32_STACK_SIZE
	int "UDC controller driver internal thread stack size"
	default 4096
	help
	  ELAN USB device controller driver internal thread stack size.

config UDC_EM32_THREAD_PRIORITY
	int "ELAN USB controller driver thread priority"
	default 8
	help
	  ELAN USB device controller driver thread priority.

config UDC_EM32_MSG_QUEUE_SIZE
	int "UDC EM32 message queue size"
	default 32
	help
	  Maximum number of messages the driver can queue for interrupt bottom half processing.

endif # UDC_ELAN_EM32
```

## drivers/usb/udc/Kconfig.it51xxx
```kconfig
# Copyright (c) 2026 ITE Corporation.
# SPDX-License-Identifier: Apache-2.0

config UDC_IT51XXX
	bool "IT51XXX USB device controller driver"
	default y
	depends on DT_HAS_ITE_IT51XXX_USB_ENABLED
	select IT51XXX_USB_SOF_CALIBRATION
	help
	  IT51XXX USB device controller driver.

if UDC_IT51XXX

config UDC_IT51XXX_CLEAR_READY_BIT_SUPPORTED
	bool
	default y if !SOC_IT51526AW && !SOC_IT51526BW
	help
	  Indicates whether the IT51XXX UDC IP supports firmware clearing of
	  the ready bit. If not supported, the driver clears the enable bit
	  instead when disabling or dequeuing endpoint.

config UDC_IT51XXX_EVENT_COUNT
	int "UDC IT51XXX event count"
	range 4 64
	default 8
	help
	  Maximum number of queued messages for SETUP, IN, OUT, and
	  XFER events.

config UDC_IT51XXX_STACK_SIZE
	int "IT51XXX UDC driver internal thread stack size"
	default 1024
	help
	  Size of the stack used in the driver for IT51XXX USBD ISR event
	  handling.

config UDC_IT51XXX_THREAD_PRIORITY
	int "IT51XXX UDC driver internal thread priority"
	default 8
	help
	  IT51XXX UDC driver internal thread priority.

endif # UDC_IT51XXX
```

## drivers/usb/udc/Kconfig.it82xx2
```kconfig
# Copyright (c) 2023 ITE Corporation.
# SPDX-License-Identifier: Apache-2.0

config UDC_IT82XX2
	bool "IT82XX2 USB device controller driver"
	default y
	depends on DT_HAS_ITE_IT82XX2_USB_ENABLED
	help
	  IT82xx2 USB device controller driver.

if UDC_IT82XX2

config UDC_IT82xx2_EVENT_COUNT
	int "UDC IT82xx2 event count"
	range 4 64
	default 8
	help
	  IT82xx2 event count.

config UDC_IT82xx2_STACK_SIZE
	int "IT82xx2 UDC driver internal thread stack size"
	default 1024
	help
	  Size of the stack used in the driver for IT82xx2 USBD ISR event
	  handling.

endif # UDC_IT82XX2
```

## drivers/usb/udc/Kconfig.max32
```kconfig
# Copyright (c) 2025 Analog Devices, Inc.
# SPDX-License-Identifier: Apache-2.0

config UDC_MAX32
	bool "MAX32 USB device controller driver"
	default y
	depends on DT_HAS_ADI_MAX32_USBHS_ENABLED
	select UDC_DRIVER_HAS_HIGH_SPEED_SUPPORT
	help
	  MAX32 USB device controller driver.

if UDC_MAX32

config UDC_MAX32_THREAD_PRIORITY
	int "MAX32 USB device controller driver thread priority"
	default 8
	help
	  MAX32 USB device device controller driver thread priority.

config UDC_MAX32_THREAD_STACK_SIZE
	int "MAX32 UDC driver internal thread stack size"
	default 1024
	help
	  Size of the stack for the driver internal thread.

config UDC_MAX32_MAX_QMESSAGES
	int "MAX32 UDC driver maximum number of ISR event messages"
	range 4 64
	default 8
	help
	  Maximum number of messages for handling of MAX32 USBD ISR events.

endif # UDC_MAX32
```

## drivers/usb/udc/Kconfig.mchp_sam
```kconfig
# Copyright (C) 2025 Microchip Technology Inc. and its subsidiaries
#
# SPDX-License-Identifier: Apache-2.0
#

config UDC_MCHP_SAM
	bool "Microchip SAM UDPHS USB Device High Speed Port"
	default y
	depends on DT_HAS_MICROCHIP_SAM_UDPHS_ENABLED
	select CACHE_MANAGEMENT
	select PINCTRL
	select GPIO
	select SYS_MEM_BLOCKS
	select EVENTS
	select UDC_DRIVER_HAS_HIGH_SPEED_SUPPORT
	help
	  Enable the Microchip SAM UDPHS driver.

if UDC_MCHP_SAM

config UDC_MCHP_SAM_STACK_SIZE
	int "UDC controller driver internal thread stack size"
	default 1024
	help
	  Device controller driver internal thread stack size.

config UDC_MCHP_SAM_THREAD_PRI
	int "UDC controller driver thread priority"
	default 8
	help
	  Device controller driver thread priority.

config UDC_MCHP_SAM_BURST_LOCK
	bool "Lock bus access for maximum bandwidth"
	default n
	help
	  USB packets system data bursts will be locked for
	  maximum optimization of the bus bandwidth usage.

config UDC_MCHP_SAM_RAW_DEBUG
	bool "UDC controller driver raw debug"
	default n
	depends on LOG_MODE_IMMEDIATE
	help
	  Enable driver raw debugging for short and real-time log outputs.

endif # UDC_MCHP_SAM
```

## drivers/usb/udc/Kconfig.nrf
```kconfig
# Copyright (c) 2021 Nordic Semiconductor ASA
# SPDX-License-Identifier: Apache-2.0

config UDC_NRF
	bool "Nordic Semiconductor USB device controller driver"
	default y
	depends on DT_HAS_NORDIC_NRF_USBD_ENABLED
	select NRF_USBD_COMMON
	select NRFX_POWER
	help
	  nRF USB device controller driver.

if UDC_NRF

config UDC_NRF_THREAD_STACK_SIZE
	int "nRF UDC driver internal thread stack size"
	default 512
	help
	  Size of the stack used in the driver for nRF USBD ISR event handling.

config UDC_NRF_MAX_QMESSAGES
	int "nRF UDC driver maximum number of ISR event messages"
	range 4 64
	default 8
	help
	  Maximum number of messages for handling of nRF USBD ISR events.

endif # UDC_NRF
```

## drivers/usb/udc/Kconfig.numaker
```kconfig
# Copyright (c) 2024 Nuvoton Technology Corporation
# SPDX-License-Identifier: Apache-2.0

config UDC_NUMAKER
	bool "Nuvoton NuMaker USB 1.1 device controller"
	default y
	depends on DT_HAS_NUVOTON_NUMAKER_USBD_ENABLED
	help
	  Enable Nuvoton NuMaker USB 1.1 device controller driver

if UDC_NUMAKER

config UDC_NUMAKER_MSG_QUEUE_SIZE
	int "UDC NuMaker message queue size"
	default 32
	help
	  Maximum number of messages the driver can queue for interrupt bottom half processing.

config UDC_NUMAKER_THREAD_STACK_SIZE
	int "UDC NuMaker driver internal thread stack size"
	default 1536
	help
	  Size of the stack for the driver internal thread.

config UDC_NUMAKER_THREAD_PRIORITY
	int "UDC NuMaker driver internal thread priority"
	default 8
	help
	  Priority of the driver internal thread.

endif # UDC_NUMAKER
```

## drivers/usb/udc/Kconfig.renesas_ra
```kconfig
# Copyright (c) 2024 Renesas Electronics Corporation
# SPDX-License-Identifier: Apache-2.0

config UDC_RENESAS_RA
	bool "Renesas RA family UDC driver"
	default y
	depends on DT_HAS_RENESAS_RA_UDC_ENABLED
	select USE_RA_FSP_USB_DEVICE
	select PINCTRL
	help
	  Enable Renesas RA family UDC driver.

if UDC_RENESAS_RA

config UDC_RENESAS_RA_STACK_SIZE
	int "UDC controller driver internal thread stack size"
	default 512
	help
	  Renesas RA device controller driver internal thread stack size.

config UDC_RENESAS_RA_THREAD_PRIORITY
	int "Renesas RA family UDC driver thread priority"
	default 8
	help
	  Renesas RA device controller driver thread priority.

config UDC_RENESAS_RA_MAX_QMESSAGES
	int "Renesas RA family UDC driver maximum number of ISR event messages"
	range 4 64
	default 8
	help
	  Maximum number of messages for handling of Renesas RA USBD ISR events.

endif
```
