## drivers/usb/uhc/Kconfig.renesas_ra
```kconfig
# Copyright (c) 2024 Renesas Electronics Corporation
# SPDX-License-Identifier: Apache-2.0

DT_COMPAT_UHC_RENESAS_RA := renesas,ra-uhc

config UHC_RENESAS_RA
	bool "Renesas RA family UHC driver"
	default y
	depends on DT_HAS_RENESAS_RA_UHC_ENABLED
	select USE_RA_FSP_USB_HOST
	help
	  Enable Renesas RA family UHC driver.

if UHC_RENESAS_RA

config UHC_RENESAS_RA_STACK_SIZE
	int "UHC controller driver internal thread stack size"
	default 512
	help
	  Renesas RA device controller driver internal thread stack size.

config UHC_RENESAS_RA_THREAD_PRIORITY
	int "Renesas RA family UHC driver thread priority"
	default 8
	help
	  Renesas RA device controller driver thread priority.

config UHC_RENESAS_RA_MAX_MSGQ
	int "Renesas RA family internal UHC driver msgq size"
	default 10
	help
	  Renesas RA device controller driver internal msgq size.

config UHC_RENESAS_RA_OSC_WAIT_RETRIES
	int "Maximum retries for oscillator ready event"
	default 3
	help
	  Specify the number of retries for oscillator ready event.

endif	# UHC_RENESAS_RA
```

## drivers/usb/uhc/Kconfig.stm32_otghs
```kconfig
# SPDX-FileCopyrightText: Copyright (c) 2026 Narek Aydinyan
# SPDX-License-Identifier: Apache-2.0

config UHC_STM32_OTGHS
	bool "STM32 OTGHS UHC driver"
	default y
	depends on SOC_SERIES_STM32U5X
	depends on DT_HAS_ST_STM32_OTGHS_ENABLED

	select USE_STM32_HAL_HCD
	select USE_STM32_LL_USB
	select USE_STM32_HAL_PWR
	select USE_STM32_HAL_PWR_EX
	select STM32_USB_COMMON

	help
	  USB Host Controller (UHC) driver for STM32 OTGHS using HAL HCD.

	  This driver has only been tested on STM32U5.

if UHC_STM32_OTGHS

module = UHC_STM32_OTGHS
module-str = STM32 OTGHS UHC driver
source "subsys/logging/Kconfig.template.log_config"

config UHC_STM32_OTGHS_DMA
	bool "OTGHS host DMA"
	default y
	help
	  Enable the STM32 OTGHS internal DMA engine for host transfers.
	  This reduces RX FIFO interrupt load and allows BULK OUT transfers to
	  run through the HAL DMA path.

	  Transfer buffers must also satisfy the STM32 OTGHS DMA alignment
	  requirements.

	  Disabling this option currently requires STM32 HAL support for the
	  IN NAK limiter path used by the non-DMA fallback.

config UHC_STM32_OTGHS_SOF
	bool "SOF interrupt delivery"
	help
	  Enable SOF interrupt generation in host mode and allow the HAL
	  SOF callback path to run.

	  When enabled, the driver can use the 1 kHz SOF tick as the periodic
	  wake source for HAL-parked URB_NAK_WAIT retries instead of relying
	  only on a kernel timer.

config UHC_STM32_OTGHS_FORCE_VBUS_VALID
	bool "Ignore VBUS sensing and force session valid"
	default y
	help
	  Disable hardware VBUS sensing and force a valid host session after
	  HAL init. Keep this enabled for self-powered downstream devices or
	  boards without wired host-side VBUS sensing/control.

	  Disable this on boards that provide real OTGHS VBUS sensing and
	  want the controller to rely on the hardware VBUS path.

endif # UHC_STM32_OTGHS
```

## drivers/usb/uvb/Kconfig
```kconfig
#
# Copyright (c) 2022 Nordic Semiconductor
#
# SPDX-License-Identifier: Apache-2.0
#

menuconfig UVB
	bool
	prompt "USB virtual bus"
	help
	  USB virtual bus service intended for use by virtual UDC
	  and UHC controllers.

if UVB

config UVB_MAX_MESSAGES
	int "Maximum number of messages allocatable"
	range 4 256
	default 16
	help
	  Maximum number of messages allocatable.

module = UVB
module-str = USB virtual bus service
source "$(ZEPHYR_BASE)/subsys/logging/Kconfig.template.log_config"

endif # UVB
```

## drivers/usb/vbus_detect/Kconfig
```kconfig
# Copyright (c) 2026 Leica Geosystems AG
# SPDX-License-Identifier: Apache-2.0

menuconfig USB_VBUS_DETECT
	bool "USB VBUS Detection Drivers"
	default y if DT_HAS_ZEPHYR_USB_VBUS_DETECT_GPIO_ENABLED
	depends on UDC_DRIVER
	help
	  Enable USB VBUS detection driver support. Automatically enabled
	  when a VBUS detect node is present in the devicetree.

if USB_VBUS_DETECT

module = USB_VBUS_DETECT
module-str = usb_vbus_detect
source "subsys/logging/Kconfig.template.log_config"

config USB_VBUS_DETECT_INIT_PRIORITY
	int "USB VBUS detect driver init priority"
	default 80
	help
	  USB VBUS detection driver initialization priority.

config USB_VBUS_DETECT_GPIO
	bool "GPIO-based VBUS detector"
	default y
	depends on DT_HAS_ZEPHYR_USB_VBUS_DETECT_GPIO_ENABLED
	depends on GPIO
	help
	  Enable GPIO-based USB VBUS detection driver.

endif # USB_VBUS_DETECT
```

## drivers/usb_c/Kconfig
```kconfig
# USB-C configuration options

# Copyright 2022 The Chromium OS Authors
# SPDX-License-Identifier: Apache-2.0

source "drivers/usb_c/tcpc/Kconfig"
source "drivers/usb_c/vbus/Kconfig"

config USBC_INIT_PRIORITY
	int "USBC driver init priority"
	default 80
	help
	  USB-C device driver initialization priority.
	  Do not mess with it unless you know what you are doing.
	  Note that the priority needs to be lower than the USBC stack
	  so that it can start before the USBC sub-system.

module = USBC
module-str = usbc
source "subsys/logging/Kconfig.template.log_config"
```

## drivers/usb_c/ppc/Kconfig
```kconfig
# Power path controllers configuration options

# Copyright 2023 Google LLC
# SPDX-License-Identifier: Apache-2.0

menuconfig USBC_PPC_DRIVER
	bool "USB-C PPC drivers"
	help
	  Enable USB-C Power Path Controllers support

if USBC_PPC_DRIVER

config USBC_PPC_INIT_PRIORITY
	int "USBC PPC driver init priority"
	default 82
	help
	  Initialization priority of the USB-C PPC drivers in POST_KERNEL.

config USBC_PPC_SHELL
	bool "Shell commands for PPC"
	help
	  Add useful shell commands to manipulate and debug the PPCs

source "drivers/usb_c/ppc/Kconfig.nxp"
source "drivers/usb_c/ppc/Kconfig.numaker"

module = USBC_PPC
module-str = usbc-ppc
source "subsys/logging/Kconfig.template.log_config"

endif # USBC_PPC_DRIVER
```

## drivers/usb_c/ppc/Kconfig.numaker
```kconfig
# Nuvoton NuMaker USB-C PPC device configuration options

# Copyright (c) 2024 Nuvoton Technology Corporation
# SPDX-License-Identifier: Apache-2.0

config USBC_PPC_NUMAKER
	bool "Nuvoton NuMaker USB-C PPC"
	default y
	depends on DT_HAS_NUVOTON_NUMAKER_PPC_ENABLED && USBC_TCPC_NUMAKER
	help
	  Enable USB-C PPC support for Nuvoton NuMaker chip with UTCPD.
```

## drivers/usb_c/ppc/Kconfig.nxp
```kconfig
# NXP NX20P3483 Configuration menu

# Copyright 2023 Google LLC
# SPDX-License-Identifier: Apache-2.0

config USBC_PPC_NX20P3483
	bool "NXP NX20P3483 support"
	default y
	depends on DT_HAS_NXP_NX20P3483_ENABLED
	help
	  Enable USB-C PPC support for NXP nx20p3483 chip

if USBC_PPC_NX20P3483

config USBC_PPC_NX20P3483_DUMP_FULL_REG_NAMES
	bool "Dump full register names"
	help
	  Dump human-readable names instead of offsets of registers

endif
```

## drivers/usb_c/tcpc/Kconfig
```kconfig
# USBC TCPC configuration options

# Copyright 2022 The Chromium OS Authors
# SPDX-License-Identifier: Apache-2.0

menuconfig USBC_TCPC_DRIVER
	bool "USB-C TCPC drivers"
	help
	  Enable USB TypeC Port Controller (TCPC) drivers

if USBC_TCPC_DRIVER

config USBC_TCPC_INIT_PRIORITY
	int "USB-C TCPC driver init priority"
	default 80
	help
	  USB-C device driver initialization priority.
	  Do not mess with it unless you know what you are doing.
	  Note that the priority needs to be lower than the USBC stack
	  so that it can start before the USBC sub-system.

config USBC_TCPC_SHELL
	bool "Shell commands for TCPC subsystem"
	help
	  Enable support for TCPC shell commands that helps with USB-C diagnostics.
	  Example functions are printing vbus, chip information and dumping registers.

source "drivers/usb_c/tcpc/Kconfig.tcpc_stm32"
source "drivers/usb_c/tcpc/Kconfig.tcpc_numaker"

module = USBC
module-str = usbc
source "subsys/logging/Kconfig.template.log_config"

endif # USBC_TCPC_DRIVER
```

## drivers/usb_c/tcpc/Kconfig.tcpc_fusb302b
```kconfig
config USBC_TCPC_FUSB302B
	bool "USB-C Enable FUSB302 Driver"
	default y
	depends on DT_HAS_FCS_FUSB302B_ENABLED
	depends on USBC_TCPC_DRIVER
	select I2C
	help
	  FUSB302B driver

if USBC_TCPC_FUSB302B

config EMUL_FUSB302B
	bool "Emulate a FUSB302B"
	default y
	depends on EMUL
	depends on USBC_TCPC_FUSB302B
	help
	  This is an emulator for the FUSB302B.

endif # USBC_TCPC_FUSB302B
```

## drivers/usb_c/tcpc/Kconfig.tcpc_fusb307
```kconfig
# ON Semiconductor FUSB307 TCPC configuration options

# Copyright (c) 2025 Jianxiong Gu <jianxiong.gu@outlook.com>
# SPDX-License-Identifier: Apache-2.0

config USBC_TCPC_FUSB307
	bool "USB-C TCPC device controller driver"
	select USBC_TCPC_TCPCI
	default y
	depends on DT_HAS_ONNN_FUSB307_TCPC_ENABLED
	help
	  Enable Type-C Port Controller driver for FUSB307.

if USBC_TCPC_FUSB307

config USBC_TCPC_FUSB307_INIT_DELAY
	int "FUSB307 init delay"
	default 5
	help
	  Delay between each try of the TCPC initialization

config USBC_TCPC_FUSB307_INIT_RETRIES
	int "FUSB307 init retries"
	default 10
	help
	  Number of initialization tries that will be performed

endif
```
