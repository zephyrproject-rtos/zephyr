## drivers/usb/udc/Kconfig.sam_udp
```kconfig
# Copyright (c) 2026 Gerson Fernando Budke <nandojve@gmail.com>
# SPDX-License-Identifier: Apache-2.0

config UDC_SAM_UDP
	bool "Atmel SAM USB Device Port (UDP) Controller"
	default y
	depends on DT_HAS_ATMEL_SAM_UDP_ENABLED
	depends on SOC_FAMILY_ATMEL_SAM
	select PINCTRL
	select EVENTS
	help
	  Enable Atmel SAM USB Device Port (UDP) controller driver.
	  This controller supports full-speed USB 2.0 device mode with
	  8 endpoints.

if UDC_SAM_UDP

config UDC_SAM_UDP_THREAD_STACK_SIZE
	int "USB device controller driver thread stack size"
	default 2048
	help
	  Stack size of the USB device controller driver thread.
	  The thread processes USB events including OUT data reception.
	  A larger stack is needed to handle the callback chain from
	  udc_submit_ep_event() which may invoke USB class drivers.

config UDC_SAM_UDP_THREAD_PRIORITY
	int "USB device controller driver thread priority"
	default 8
	help
	  Priority of the USB device controller driver thread.

endif # UDC_SAM_UDP
```

## drivers/usb/udc/Kconfig.sam_usbc
```kconfig
# Copyright (c) 2025-2026 Gerson Fernando Budke <nandojve@gmail.com>
# SPDX-License-Identifier: Apache-2.0

config UDC_SAM_USBC
	bool "SAM USBC family USB device controller driver"
	default y
	depends on DT_HAS_ATMEL_SAM_USBC_ENABLED
	select PINCTRL
	select EVENTS
	help
	  Driver for SAM USBC family USB device controller (SAM4L series).

if UDC_SAM_USBC

config UDC_SAM_USBC_STACK_SIZE
	int "UDC controller driver internal thread stack size"
	default 512
	help
	  Device controller driver internal thread stack size.

config UDC_SAM_USBC_THREAD_PRIORITY
	int "UDC controller driver thread priority"
	default 8
	help
	  Device controller driver thread priority.

endif # UDC_SAM_USBC
```

## drivers/usb/udc/Kconfig.sam_usbhs
```kconfig
# Copyright (c) 2026 Gerson Fernando Budke <nandojve@gmail.com>
# SPDX-License-Identifier: Apache-2.0

DT_SAM_HAS_HIGH_SPEED := $(dt_compat_any_has_prop,$(DT_COMPAT_ATMEL_SAM_USBHS),maximum-speed,high-speed)

config UDC_SAM_USBHS
	bool "SAM USBHS USB Device Controller driver"
	default y
	depends on DT_HAS_ATMEL_SAM_USBHS_ENABLED
	select PINCTRL
	select EVENTS
	select UDC_DRIVER_HAS_HIGH_SPEED_SUPPORT if $(DT_SAM_HAS_HIGH_SPEED)
	help
	  SAM E70/S70/V70/V71 family USBHS device controller driver.

	  The driver support High-Speed (480 Mbps) and Full-Speed (12 Mbps)
	  operation.

if UDC_SAM_USBHS

config UDC_SAM_USBHS_STACK_SIZE
	int "UDC controller driver internal thread stack size"
	default 512
	help
	  Device controller driver internal thread stack size.

config UDC_SAM_USBHS_THREAD_PRIORITY
	int "UDC controller driver thread priority"
	default 8
	help
	  Device controller driver thread priority.

endif # UDC_SAM_USBHS
```

## drivers/usb/udc/Kconfig.sf32lb
```kconfig
# Copyright (c) 2024 SiFli Technologies(Nanjing) Co., Ltd.
# SPDX-License-Identifier: Apache-2.0

config UDC_SF32LB
	bool "SF32LB USB device controller driver"
	depends on DT_HAS_SIFLI_SF32LB_USBD_ENABLED
	default y
	help
	  SF32LB USB device controller driver.
```

## drivers/usb/udc/Kconfig.skeleton
```kconfig
# Copyright (c) 2023 Nordic Semiconductor ASA
# SPDX-License-Identifier: Apache-2.0

config UDC_SKELETON
	bool "Skeleton for an USB device controller driver"
	default y
	depends on DT_HAS_ZEPHYR_UDC_SKELETON_ENABLED
	help
	  Skeleton for an USB device controller driver.

config UDC_SKELETON_STACK_SIZE
	int "UDC controller driver internal thread stack size"
	depends on UDC_SKELETON
	default 512
	help
	  Skeleton device controller driver internal thread stack size.

config UDC_SKELETON_THREAD_PRIORITY
	int "Skeleton controller driver thread priority"
	depends on UDC_SKELETON
	default 8
	help
	  Skeleton device controller driver thread priority.
```

## drivers/usb/udc/Kconfig.smartbond
```kconfig
# Copyright (c) 2024 Renesas Electronics Corporation
# SPDX-License-Identifier: Apache-2.0

config UDC_SMARTBOND
	bool "Smartbond USB device controller driver"
	default y
	depends on DT_HAS_RENESAS_SMARTBOND_USBD_ENABLED
	select DMA
	help
	  Smartbond USB device controller driver.
```

## drivers/usb/udc/Kconfig.stm32
```kconfig
# Copyright (c) 2023 Linaro Limited
# SPDX-License-Identifier: Apache-2.0

config UDC_STM32
	bool "STM32 USB device controller driver"
	depends on DT_HAS_ST_STM32_OTGFS_ENABLED \
		|| DT_HAS_ST_STM32_OTGHS_ENABLED \
		|| DT_HAS_ST_STM32_USB_ENABLED
	select USE_STM32_LL_USB
	select USE_STM32_HAL_PCD
	select USE_STM32_HAL_PCD_EX
	select UDC_DRIVER_HAS_HIGH_SPEED_SUPPORT
	select STM32_USB_COMMON
	select PINCTRL
	default y
	help
	  STM32 USB device controller driver.

if UDC_STM32

config UDC_STM32_STACK_SIZE
	int "UDC controller driver internal thread stack size"
	default 512
	help
	  STM32 USB device controller driver internal thread stack size.

config UDC_STM32_THREAD_PRIORITY
	int "STM32 USB controller driver thread priority"
	default 8
	help
	  STM32 USB device controller driver thread priority.

config UDC_STM32_MAX_QMESSAGES
	int "STM32 UDC driver maximum number of ISR event messages"
	range 4 64
	default 8
	help
	  Maximum number of messages for handling of STM32 USBD ISR events.

config UDC_STM32_CLOCK_CHECK
	bool "Runtime USB 48MHz clock check"
	default n if SOC_SERIES_STM32F1X || \
		     SOC_SERIES_STM32F3X || \
		     SOC_SERIES_STM32U5X || \
		     SOC_SERIES_STM32WBAX
	default y
	help
	  Enable USB clock 48MHz configuration runtime check.
	  In specific cases, this check might provide wrong verdict and should
	  be disabled.

menu "OTGHS/OTGFS options"
	depends on DT_HAS_ST_STM32_OTGFS_ENABLED \
		|| DT_HAS_ST_STM32_OTGHS_ENABLED

config UDC_STM32_OTG_RXFIFO_BASELINE_SIZE
	int "Baseline RxFIFO size (in bytes)"
	default 600
	help
	  Baseline value for RXFIFO size computation

	  The OTG_FS and OTG_HS USB controllers use a single "RxFIFO" to hold
	  data received by all OUT endpoints. The RxFIFO's size is influenced
	  by various parameters: the optimal value depends on the exact USB
	  configuration that will be used, which the driver does not know by
	  the time it has to configure the RxFIFO size.

	  The total RxFIFO size will be equal to the value of this option
	  plus a fixed overhead that the driver can derive from the hardware
	  configuration (e.g., number of endpoints implemented).

	  Refer to STM32 Reference Manuals for more details about the RxFIFO.
endmenu

menu "ST USB options"
	depends on DT_HAS_ST_STM32_USB_ENABLED

config UDC_STM32_STUSB_ISO_OUT_EP_NUM
	int "Number of endpoints reserved for isochronous OUT"
	default 0
	range 0 $(UINT8_MAX)
	help
	  Number of endpoints reserved for OUT isochronous mode operation

	  This option is used to reserve endpoints for configuration in
	  isochronous mode, as it requires special handling which cannot
	  be done easily with the current stack design. This option works
	  toghether with the CONFIG_UDC_STM32_STUSB_ISO_IN_EP_NUM option.

	  The first CONFIG_UDC_STM32_STUSB_ISO_OUT_EP_NUM endpoints are
	  reserved and can only be configured as isochronous OUT. The
	  next UDC_STM32_STUSB_ISO_IN_EP_NUM endpoints are reserved
	  and can only be configured as isochronous IN. All remaining
	  endpoints can be configured as bulk/interrupt in any direction
	  (reservations start at EP1: EP0 is reserved as control endpoint).

	  As an example, if CONFIG_UDC_STM32_STUSB_ISO_OUT_EP_NUM is set
	  to 1 and CONFIG_UDC_STM32_STUSB_ISO_IN_EP_NUM is also set to 1:
	    - (EP0 OUT/IN is reserved as control endpoint)

	    - EP1 OUT is reserved for isochronous mode
	    - EP1 IN is reserved and cannot be used

	    - EP2 OUT is reserved and cannot be used
	    - EP2 IN is reserved for isochronous mode

	    - EP3~EPn OUT/IN can be used freely in bulk/interrupt mode

	  When this option is set to zero, it is not possible to configure
	  any endpoint as isochronous OUT.

config UDC_STM32_STUSB_ISO_IN_EP_NUM
	int "Number of endpoints reserved for isochronous IN"
	default 0
	range 0 $(UINT8_MAX)
	help
	  Number of endpoints reserved for IN isochronous mode operation

	  When this option is set to zero, it is not possible to configure
	  any endpoint in isochronous IN mode.

	  Refer to CONFIG_UDC_STM32_STUSB_ISO_OUT_EP_NUM for more details.

endmenu

endif
```

## drivers/usb/udc/Kconfig.virtual
```kconfig
# Copyright (c) 2022 Nordic Semiconductor ASA
# SPDX-License-Identifier: Apache-2.0

config UDC_VIRTUAL
	bool "Virtual USB device controller driver"
	select UVB
	default y
	depends on DT_HAS_ZEPHYR_UDC_VIRTUAL_ENABLED
	help
	  Virtual USB device controller driver.

config UDC_VIRTUAL_STACK_SIZE
	int "Virtual controller driver internal thread stack size"
	depends on UDC_VIRTUAL
	default 512
	help
	  Virtual device controller driver internal thread stack size.

config UDC_VIRTUAL_THREAD_PRIORITY
	int "Virtual controller driver thread priority"
	depends on UDC_VIRTUAL
	default 8
	help
	  Virtual device controller driver thread priority.
```

## drivers/usb/udc/Kconfig.wch
```kconfig
# Copyright (c) 2023 Nordic Semiconductor ASA
# SPDX-License-Identifier: Apache-2.0

config UDC_WCH
	bool "WCH USB device controller driver"
	default y
	depends on DT_HAS_WCH_USBFS_ENABLED
	help
	  WCH USB device controller driver.

config UDC_WCH_STACK_SIZE
	int "UDC controller driver internal thread stack size"
	depends on UDC_WCH
	default 512
	help
	  WCH USB device controller driver internal thread stack size.

config UDC_WCH_THREAD_PRIORITY
	int "WCH USB controller driver thread priority"
	depends on UDC_WCH
	default 8
	help
	  WCH USB device controller driver thread priority.

config UDC_WCH_MAX_QMESSAGES
	int "WCH UDC driver maximum number of ISR event messages"
	range 4 64
	default 8
	help
	  Maximum number of messages for handling of WCH USBD ISR events.
```

## drivers/usb/uhc/Kconfig
```kconfig
# Copyright (c) 2022 Nordic Semiconductor ASA
# SPDX-License-Identifier: Apache-2.0


menuconfig UHC_DRIVER
	bool "USB host controller drivers [EXPERIMENTAL]"
	select EXPERIMENTAL
	select NET_BUF
	help
	  USB host controller driver.

if UHC_DRIVER

config UHC_XFER_COUNT
	int "Number of transfers in the pool"
	range 2 256
	default 16
	help
	  Number of UHC transfers available.

config UHC_BUF_COUNT
	int "Number of buffers in the pool"
	range 16 256
	default 16
	help
	  Number of UHC request buffers in the pool.

config UHC_BUF_POOL_SIZE
	int "Memory available for buffers"
	range 64 32768
	default 1024
	help
	  Total amount of memory available for UHC buffers.

module = UHC_DRIVER
module-str = uhc drv
source "subsys/logging/Kconfig.template.log_config"

source "drivers/usb/uhc/Kconfig.max3421e"
source "drivers/usb/uhc/Kconfig.stm32"
source "drivers/usb/uhc/Kconfig.virtual"

endif # UHC_DRIVER
```

## drivers/usb/uhc/Kconfig.dwc
```kconfig
# Copyright (c) 2023 Intel Corporation
# SPDX-License-Identifier: Apache-2.0

DT_COMPAT_UHC_DWC_HS := snps,designware_usbh

config UHC_DWC_HS
	bool "DWC 2.0 host driver"
	default y
	depends on DT_HAS_SNPS_DESIGNWARE_USBH_ENABLED
	help
	  This option enables DWC 2.0 USB controller in host mode.

if UHC_DWC_HS

config DWC_THREAD_STACK_SIZE
	int "Driver internal thread stack size"
	default 3072
	help
	  Size of the stack used in the driver.

endif #UHC_DWC_HS
```

## drivers/usb/uhc/Kconfig.dwc2
```kconfig
# Copyright (c) 2026 Roman Leonov <jam_roma@yahoo.com>
# SPDX-License-Identifier: Apache-2.0

config UHC_DWC2
	bool "DWC2 USB host controller driver"
	default y
	depends on DT_HAS_SNPS_DWC2_ENABLED
	select EVENTS
	help
	  DWC2 USB host controller driver.

if UHC_DWC2

config UHC_DWC2_STACK_SIZE
	int "UHC DWC2 driver thread stack size"
	default 512
	help
	  DWC2 driver thread stack size.

config UHC_DWC2_THREAD_PRIORITY
	int "UHC DWC2 driver thread priority"
	default 8
	help
	  DWC2 driver thread priority.

config UHC_DWC2_DEBOUNCE_DELAY_MS
	int "Debounce delay in ms"
	range 100 250
	default 250
	help
	  On connection of a USB device, the USB 2.0 specification requires a
	  "debounce interval with a minimum duration of 100ms" to allow
	  the connection to stabilize (see USB 2.0 chapter 7.1.7.3 for more details).
	  During the debounce interval, no new connection/disconnection events are registered.

	  The default value is set to 250 ms to be safe.

config UHC_DWC2_RESET_HOLD_MS
	int "Reset hold in ms"
	range 10 50
	default 50
	help
	  Root-port reset hold time in milliseconds.

	  USB 2.0 requires ordinary reset signaling to be asserted for at least
	  10 ms, but reset issued from a root port must last at least 50 ms..

	  The default value is set to 50 ms.

config UHC_DWC2_RESET_RECOVERY_MS
	int "Reset recovery delay in ms"
	range 10 30
	default 30
	help
	  Post-reset recovery delay in milliseconds.

	  USB 2.0 requires system software to allow at least 10 ms for reset
	  recovery after the port stops driving reset, before the attached
	  device is expected to respond to data transfers.

	  The attached device may ignore data transfers during this recovery
	  interval.

	  The default value is set to 30 ms.

config UHC_DWC2_SET_ADDR_DELAY_MS
	int "Delay after set device address"
	range 2 30
	default 10
	help
	  "After successful completion of the Status stage, the device is allowed
	  a SetAddress() recovery interval of 2 ms. At the end of this interval,
	  the device must be able to accept Setup packets addressed to the new address.
	  Also, at the end of the recovery interval, the device must not respond
	  to tokens sent to the old address (unless, of course, the old and new
	  address is the same)." See USB 2.0 chapter 9.2.6.3 for more details.

	  The default value is set to 10 ms to be safe.

endif # UHC_DWC2
```

## drivers/usb/uhc/Kconfig.max3421e
```kconfig
# Copyright (c) 2022 Nordic Semiconductor ASA
# SPDX-License-Identifier: Apache-2.0

config UHC_MAX3421E
	bool "MAX3421E driver"
	default y
	depends on DT_HAS_MAXIM_MAX3421E_SPI_ENABLED
	select SPI
	help
	  This option enables MAX3421E USB Peripheral/Host Controller with SPI
	  Interface.

if UHC_MAX3421E

config MAX3421E_THREAD_STACK_SIZE
	int "Driver internal thread stack size"
	default 512
	help
	  Size of the stack used in the driver.

config MAX3421E_OSC_WAIT_RETRIES
	int "Maximum retries for oscillator ready event"
	default 3
	help
	  Specify the number of retries for oscillator ready event.

config MAX3421E_MAX_TIMEOUT_RETRIES
	int "Maximum retries when receiving a TIMEOUT from the device"
	default 3
	range 0 255
	help
	  Specify the number of retries when the device returns TIMEOUT when trying to communicate.

endif #UHC_MAX3421E
```

## drivers/usb/uhc/Kconfig.mcux
```kconfig
# Copyright 2024 NXP
# SPDX-License-Identifier: Apache-2.0

config UHC_NXP_EHCI
	bool "NXP MCUX USB EHCI Host controller driver"
	default y
	depends on DT_HAS_NXP_UHC_EHCI_ENABLED
	select EVENTS
	select NOCACHE_MEMORY if CPU_HAS_DCACHE
	select DYNAMIC_INTERRUPTS if UDC_NXP_EHCI
	help
	  NXP MCUX USB Host Controller Driver for EHCI.

config UHC_NXP_KHCI
	bool "NXP MCUX USB KHCI Host controller driver"
	default y
	depends on DT_HAS_NXP_UHC_KHCI_ENABLED
	select EVENTS
	select DYNAMIC_INTERRUPTS if UDC_KINETIS
	help
	  NXP MCUX USB Host Controller Driver for KHCI.

config UHC_NXP_IP3516HS
	bool "NXP MCUX USB IP3516HS Host controller driver"
	default y
	depends on DT_HAS_NXP_UHC_IP3516HS_ENABLED
	select EVENTS
	help
	  NXP MCUX USB Host Controller Driver for ip3516hs.

config UHC_NXP_OHCI
	bool "NXP MCUX USB IP3516HS Host controller driver"
	default y
	depends on DT_HAS_NXP_UHC_OHCI_ENABLED
	select EVENTS
	help
	  NXP MCUX USB Host Controller Driver for ohci.

config HEAP_MEM_POOL_ADD_SIZE_UHC_MCUX
	int "The heap that NXP hal usb host controller drivers need"
	default 4096

config UHC_NXP_THREAD_STACK_SIZE
	int "MCUX UHC Driver internal thread stack size"
	default 2048
	help
	  Size of the stack used in the driver.
```
