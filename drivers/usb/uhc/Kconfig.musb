## drivers/usb/uhc/Kconfig.musb
```kconfig
# SPDX-FileCopyrightText: Copyright (c) 2026 Microchip Technology Inc.
# SPDX-License-Identifier: Apache-2.0

config UHC_MUSB
	bool "MUSB USB host controller driver"
	default y
	depends on DT_HAS_MENTOR_MUSB_HOST_ENABLED
	select GPIO
	select EVENTS
	help
	  Mentor Graphics MUSB USB host controller driver. Vendor-specific
	  glue, such as the Microchip USBHS G1 wrapper, is selected by the
	  devicetree compatible of the controller node.

if UHC_MUSB

config UHC_MUSB_STACK_SIZE
	int "UHC MUSB driver internal thread stack size"
	default 1024
	help
	  Size of the stack used by the MUSB host controller driver worker
	  thread.

config UHC_MUSB_THREAD_PRIORITY
	int "UHC MUSB driver thread priority"
	default 2
	help
	  Cooperative priority of the MUSB host controller driver worker
	  thread.

endif # UHC_MUSB
```

## drivers/usb/uhc/Kconfig.stm32
```kconfig
# Copyright (c) 2026 Hamza Bahri
# SPDX-License-Identifier: Apache-2.0

config UHC_STM32
	bool "STM32 USB_DRD_FS host controller driver [EXPERIMENTAL]"
	default y
	depends on DT_HAS_ST_STM32_USB_DRD_ENABLED
	select EXPERIMENTAL
	select EVENTS
	select USE_STM32_LL_USB
	select USE_STM32_HAL_HCD
	select STM32_USB_COMMON
	select PINCTRL
	help
	  STM32 USB host controller driver for the USB_DRD_FS controller,
	  built on the STM32Cube HAL HCD. Full-speed and low-speed devices,
	  control, bulk and interrupt transfers; isochronous is not supported.

if UHC_STM32

config UHC_STM32_STACK_SIZE
	int "UHC STM32 driver thread stack size"
	default 2048
	help
	  STM32 UHC driver thread stack size.

config UHC_STM32_THREAD_PRIORITY
	int "UHC STM32 driver thread priority"
	default 2
	help
	  STM32 UHC driver thread priority (cooperative).

config UHC_STM32_DEBOUNCE_DELAY_MS
	int "Connect/disconnect debounce delay in ms"
	range 100 500
	default 200
	help
	  The USB 2.0 specification requires a debounce interval of at least
	  100 ms on connection (chapter 7.1.7.3). The connect/disconnect event
	  is only reported once the line has been stable this long; 200 ms
	  covers the bouncing seen on NUCLEO-H563ZI.

endif # UHC_STM32
```

## drivers/uwb/Kconfig
```kconfig
# Copyright 2026 NXP
# SPDX-License-Identifier: Apache-2.0

if UWB

rsource "emul/Kconfig"
rsource "nxp/Kconfig"

endif
```

## drivers/video/Kconfig.htpa_colorizer
```kconfig
# SPDX-FileCopyrightText: Copyright The Zephyr Project Contributors
# SPDX-License-Identifier: Apache-2.0

menuconfig VIDEO_HTPA_COLORIZER
	bool "HTPA frame colorization video device"
	depends on DT_HAS_HEIMANN_HTPA_COLORIZER_ENABLED
	default y
	help
	  Convert signed HTPA samples from a video source to grayscale or false color.

if VIDEO_HTPA_COLORIZER

config VIDEO_HTPA_COLORIZER_MIN_GREY_RANGE
	int "Minimum HTPA grayscale input range"
	default 256
	range 1 65535
	help
	  Minimum span between the grayscale scaling bounds, in corrected
	  sensor levels. Smaller spans are expanded around their midpoint.

config VIDEO_HTPA_COLORIZER_INIT_PRIORITY
	int "HTPA colorizer initialization priority"
	default 62
	help
	  Initialization priority after the source video device.

config VIDEO_HTPA_COLORIZER_STACK_SIZE
	int "HTPA colorizer worker stack size"
	default 1024
	help
	  Stack size of the frame colorization worker.

config VIDEO_HTPA_COLORIZER_THREAD_PRIORITY
	int "HTPA colorizer worker priority"
	default 5
	help
	  Scheduling priority of the frame colorization worker.

endif # VIDEO_HTPA_COLORIZER
```

## drivers/video/Kconfig.htpa_compensator
```kconfig
# SPDX-FileCopyrightText: Copyright The Zephyr Project Contributors
# SPDX-License-Identifier: Apache-2.0

menuconfig VIDEO_HTPA_COMPENSATOR
	bool "HTPA frame compensation video device"
	depends on DT_HAS_HEIMANN_HTPA_COMPENSATOR_ENABLED
	default y
	help
	  Capture raw HTPA frames from a video source and correct electrical
	  offsets and pixel ordering.

if VIDEO_HTPA_COMPENSATOR

config VIDEO_HTPA_COMPENSATOR_INIT_PRIORITY
	int "HTPA compensator initialization priority"
	default 61
	help
	  Initialization priority after the source video device.

config VIDEO_HTPA_COMPENSATOR_STACK_SIZE
	int "HTPA compensator worker stack size"
	default 1024
	help
	  Stack size of the frame compensation worker.

config VIDEO_HTPA_COMPENSATOR_THREAD_PRIORITY
	int "HTPA compensator worker priority"
	default 5
	help
	  Scheduling priority of the frame compensation worker.

endif # VIDEO_HTPA_COMPENSATOR
```

## drivers/video/Kconfig.imx662
```kconfig
# SPDX-FileCopyrightText: Copyright The Zephyr Project Contributors
# SPDX-FileCopyrightText: Copyright (c) 2026 Kirill Shypachov
#
# SPDX-License-Identifier: Apache-2.0

config VIDEO_IMX662
	bool "IMX662 CMOS digital image sensor"
	select I2C
	select GPIO if $(dt_compat_any_has_prop,$(DT_COMPAT_SONY_IMX662),reset-gpios)
	depends on DT_HAS_SONY_IMX662_ENABLED
	default y
	help
	  Enable driver for IMX662 CMOS digital image sensor device
```

## drivers/video/Kconfig.jpegenc
```kconfig
# SPDX-FileCopyrightText: Copyright The Zephyr Project Contributors
# SPDX-License-Identifier: Apache-2.0

config VIDEO_JPEGENC
	bool "Software JPEG encoder based on the jpegenc module"
	default y
	depends on DT_HAS_ZEPHYR_VIDEO_JPEGENC_ENABLED
	depends on VIDEO_ENCODER_JPEG
	depends on ZEPHYR_JPEGENC_MODULE
	select JPEGENC
	help
	  Enable a software baseline JPEG encoder based on the jpegenc module.
	  It encodes NV12, YUV420, YUYV, RGB565 (either byte order) or GREY
	  frames and runs on any platform, including native_sim and QEMU. It
	  needs no heap: the encoder state (about 3.3 KiB) is part of the
	  device data, and the image is written directly into the output
	  buffer. Encoding runs in the thread calling video_enqueue(). The
	  quality control maps onto the encoder's four quality levels.
```

## drivers/video/Kconfig.max96724
```kconfig
# Copyright (c) 2026 Charles Dias
# SPDX-License-Identifier: Apache-2.0

config VIDEO_MAX96724
	bool "ADI MAX96724 GMSL2 deserializer"
	select I2C
	depends on DT_HAS_ADI_MAX96724_ENABLED
	default y
	help
	  Enable driver for the ADI MAX96724 quad GMSL2 deserializer.
	  The MAX96724 receives video data over a GMSL2 coaxial link
	  and outputs it via MIPI CSI-2 D-PHY.

if VIDEO_MAX96724

config VIDEO_MAX96724_INIT_PRIORITY
	int "MAX96724 init priority"
	default 56
	help
	  Initialization priority for the MAX96724 deserializer. Must run
	  after the host I2C controller (typically priority 50) and before
	  the MAX96717 serializer (default 58), so that the deserializer's
	  I2C proxy is live when the serializer is initialized through it.
	  Slot 57 belongs to the deserializer's I2C gate.

endif
```

## drivers/video/Kconfig.native_sim_fifo
```kconfig
# Copyright The Zephyr Project Contributors
# SPDX-License-Identifier: Apache-2.0

config VIDEO_NATIVE_SIM_FIFO
	bool "Native simulator host FIFO and V4L2 video source"
	default y
	depends on DT_HAS_ZEPHYR_NATIVE_SIM_VIDEO_FIFO_ENABLED
	depends on NATIVE_LIBRARY
	select NATIVE_USE_NSI_ERRNO
	select NATIVE_SIMULATOR_PREFER_REAL_TIME
	help
	  Enable a video capture device reading raw frames from a named pipe
	  (FIFO) fed by a host process such as ffmpeg, or capturing them from
	  a host V4L2 device.
```

## drivers/watchdog/Kconfig.npcm
```kconfig
# Copyright (c) 2026 Nuvoton Technology Corporation.
# SPDX-License-Identifier: Apache-2.0

config WDT_NPCM
	bool "Nuvoton NPCM Watchdog Timer driver"
	default y
	depends on DT_HAS_NUVOTON_NPCM_WATCHDOG_ENABLED
	select HAS_WDT_DISABLE_AT_BOOT
	help
	  This option enables the Watchdog Timer driver for the Nuvoton NPCM
	  family of processors.

config WDT_NPCM_WARNING_LEADING_TIME_MS
	int "Milliseconds before generating watchdog reset"
	depends on WDT_NPCM
	default 500
	range 0 3750
	help
	  When a timeout callback is installed, this option defines the window
	  between the watchdog event (callback) and the SoC reset. The window
	  is rounded up to the watchdog clock period of the selected timeout
	  range. The 8-bit watchdog counter limits it to 3750 ms for timeouts
	  just below 60 sec.
```

## drivers/watchdog/Kconfig.renesas_rcar_wwdt
```kconfig
# SPDX-FileCopyrightText: Copyright (c) 2026 Renesas Electronics Corporation
# SPDX-License-Identifier: Apache-2.0

config WDT_RENESAS_RCAR_WWDT
	bool "Renesas R-Car Gen5 window watchdog driver"
	default y
	depends on DT_HAS_RENESAS_RCAR_GEN5_WWDT_ENABLED
	depends on CLOCK_CONTROL
	select SYSCON
	select HAS_WDT_NO_CALLBACKS
	help
	  Enable the R-Car Gen5 window watchdog on compatible devices.
```

## drivers/wifi/hwsim/Kconfig
```kconfig
# Copyright (c) 2026 Nordic Semiconductor ASA
# SPDX-License-Identifier: Apache-2.0

config WIFI_HWSIM
	bool "Virtual Wi-Fi simulator driver (hwsim)"
	depends on WIFI
	depends on NET_L2_ETHERNET
	select NET_L2_WIFI_MGMT
	select WIFI_USE_NATIVE_NETWORKING
	help
	  Registers N virtual Wi-Fi interfaces backed by an in-process
	  frame relay bus. Intended for testing hostapd and wpa_supplicant
	  on native_sim without real hardware.

if WIFI_HWSIM

module = WIFI_HWSIM
module-str = Log level for WiFi hwsim driver
module-help = Sets log level for the WiFi hwsim driver (wifi_hwsim module).
source "subsys/logging/Kconfig.template.log_config"

config WIFI_HWSIM_NUM_RADIOS
	int "Number of virtual radios"
	default 2
	range 2 8
	help
	  Each radio becomes one net_if. Minimum 2 (one AP, one STA).

menuconfig WIFI_HWSIM_NAN
	bool "NAN lifecycle simulation"
	depends on WIFI_NM_WPA_SUPPLICANT_NAN_MGMT_IFACE
	help
	  Enable dedicated NAN management nodes marked with nan-management in
	  devicetree. Simulate start, an asynchronous cluster notification, and
	  stop. These nodes do not participate in the frame relay and do not
	  implement discovery, synchronization, data paths, or pairing.

if WIFI_HWSIM_NAN

config WIFI_HWSIM_NAN_CLUSTER_EVENT_DELAY_MS
	int "Cluster notification delay (ms)"
	default 1
	range 1 1000
	help
	  Delay between an accepted NAN start and the modeled cluster event.
	  Stop or interface removal cancels a pending notification.

config WIFI_HWSIM_NAN_SHARED_IFACE
	bool "Share one device between the STA and NAN roles"
	help
	  Alternate topology where a single hwsim device exposes both the
	  station and NAN roles as two net_ifs of the same devicetree
	  instance, instead of two separate nodes. Mutually exclusive in
	  practice with nan-management, which stays meaningful only for the
	  separate-device topology.

endif # WIFI_HWSIM_NAN

config WIFI_HWSIM_DEFAULT_CHANNEL
	int "Default channel (2.4 GHz)"
	default 6
	range 1 14

config WIFI_HWSIM_DEFAULT_SIGNAL_DBM
	int "Default simulated RSSI (dBm)"
	default -50
	range -100 -10

config WIFI_HWSIM_CONNECT_TIMEOUT_SEC
	int "Connect timeout in seconds (for tests)"
	default 15
	range 1 120
	help
	  Max time to wait for connect result in automated tests.

config WIFI_HWSIM_SHELL
	bool "hwsim shell commands"
	depends on SHELL
	default y
	help
	  Exposes 'hwsim channel/signal/loss/dump' shell commands for
	  manual fault injection during interactive testing.

config WIFI_HWSIM_RX_STACK_SIZE
	int "RX thread stack size per radio"
	default 2048

config WIFI_HWSIM_MEM_SLAB_COUNT
	int "Frame pool size (number of frames)"
	default 32
	help
	  Number of struct hwsim_frame entries in the k_mem_slab pool. Each
	  entry holds one in-flight frame (up to HWSIM_FRAME_MTU bytes) plus
	  per-frame metadata.

endif # WIFI_HWSIM
```

## drivers/wifi/nxp/Kconfig.preset
```kconfig
# Copyright 2026 NXP
# SPDX-License-Identifier: Apache-2.0

if NETWORKING

configdefault NET_TC_TX_COUNT
	default 1

configdefault NET_TC_RX_COUNT
	default 1

configdefault NET_TX_STACK_SIZE
	default 2048

configdefault NET_RX_STACK_SIZE
	default 2048

configdefault NET_TC_THREAD_PRIO_CUSTOM
	default y

configdefault NET_TC_TX_THREAD_BASE_PRIO
	default 3

configdefault NET_TC_TX_SKIP_FOR_HIGH_PRIO
	default y

configdefault NET_TC_RX_THREAD_BASE_PRIO
	default 3

configdefault NET_CONTEXT_PRIORITY
	default y

configdefault NET_MAX_CONTEXTS
	default 10

if NET_MGMT_EVENT

configdefault NET_MGMT_EVENT_STACK_SIZE
	default 6144 if WIFI_NM_WPA_SUPPLICANT
	default 4608

configdefault NET_MGMT_THREAD_PRIO_CUSTOM
	default y

configdefault NET_MGMT_THREAD_PRIORITY
	default 3

endif # NET_MGMT_EVENT

if NET_IP

configdefault NET_MAX_CONN
	default 10

endif # NET_IP

if NET_TCP

configdefault NET_TCP_WORKQ_STACK_SIZE
	default 2048

configdefault NET_TCP_WORKER_PRIO
	default -16

endif # NET_TCP

if NET_IPV4

configdefault NET_IF_MAX_IPV4_COUNT
	default 2

if NET_IPV4_FRAGMENT

configdefault NET_IPV4_FRAGMENT_MAX_COUNT
	default 3

configdefault NET_IPV4_FRAGMENT_MAX_PKT
	default 7

configdefault NET_IPV4_FRAGMENT_TIMEOUT
	default 3

endif # NET_IPV4_FRAGMENT

endif # NET_IPV4

if NET_IPV6

configdefault NET_IF_MAX_IPV6_COUNT
	default 2

if NET_IPV6_FRAGMENT

configdefault NET_IPV6_FRAGMENT_MAX_COUNT
	default 3

configdefault NET_IPV6_FRAGMENT_MAX_PKT
	default 8

configdefault NET_IPV6_FRAGMENT_TIMEOUT
	default 3

endif # NET_IPV6_FRAGMENT

endif # NET_IPV6

if DNS_RESOLVER

configdefault DNS_RESOLVER_MAX_SERVERS
	default 2

endif # DNS_RESOLVER

if NET_SOCKETS_SERVICE

configdefault NET_SOCKETS_SERVICE_STACK_SIZE
	default 4096

configdefault NET_SOCKETS_SERVICE_THREAD_PRIO
	default 3

endif # NET_SOCKETS_SERVICE

if NET_ZPERF

configdefault ZPERF_WORK_Q_THREAD_PRIORITY
	default 3

configdefault NET_ZPERF_MAX_SESSIONS
	default 6

configdefault NET_ZPERF_MAX_PACKET_SIZE
	default 1500

configdefault ZPERF_WORK_Q_STACK_SIZE
	default 4096

endif # NET_ZPERF

if ZVFS

configdefault ZVFS_OPEN_MAX
	default 30

configdefault ZVFS_POLL_MAX
	default 14

endif # ZVFS

endif # NETWORKING

choice NET_TC_THREAD_TYPE
	default NET_TC_THREAD_PREEMPTIVE
endchoice # NET_TC_THREAD_TYPE

configdefault CODE_DATA_RELOCATION_SRAM
	default y

if WIFI_NXP

configdefault NXP_WIFI_TX_RX_ZERO_COPY
	default y

configdefault NXP_WIFI_FW_DEBUG
	default y if !NXP_WIFI_SLIM

configdefault NXP_WIFI_WAKE_TIMER_ENABLE
	default y if !NXP_WIFI_SLIM

endif # WIFI_NXP

if WIFI_NM_WPA_SUPPLICANT

configdefault WIFI_NM_WPA_SUPPLICANT_WQ_PRIO
	default 3

configdefault WIFI_NM_WPA_SUPPLICANT_PRIO
	default 3

configdefault WIFI_NM_WPA_SUPPLICANT_WQ_STACK_SIZE
	default 12288

configdefault WIFI_NM_WPA_SUPPLICANT_THREAD_STACK_SIZE
	default 12288

configdefault WIFI_NM_MAX_MANAGED_INTERFACES
	default 2

configdefault WIFI_NM_WPA_SUPPLICANT_CLEANUP_INTERVAL
	default 120

if WIFI_NM_HOSTAPD_AP

configdefault WIFI_NM_HOSTAPD_CLEANUP_INTERVAL
	default 120

endif # WIFI_NM_HOSTAPD_AP

if MBEDTLS_ENABLE_HEAP

configdefault MBEDTLS_HEAP_SIZE
	default 75072 if NXP_RW610
	default 90432 if NXP_IW610 || NXP_IW61X || NXP_IW416

endif # MBEDTLS_ENABLE_HEAP

if WIFI_NM_WPA_SUPPLICANT_CRYPTO_ENTERPRISE

configdefault MBEDTLS_SSL_IN_CONTENT_LEN
	default 8192

configdefault MBEDTLS_SSL_OUT_CONTENT_LEN
	default 8192

configdefault MBEDTLS_HAVE_TIME_DATE
	default y

endif # WIFI_NM_WPA_SUPPLICANT_CRYPTO_ENTERPRISE

configdefault SAE_PWE_EARLY_EXIT
	default y

endif # WIFI_NM_WPA_SUPPLICANT
```
