## dts/bindings/auxdisplay/st,slcd.yaml
```yaml
#
# Copyright (c) 2026 Renato Mauro
#
# SPDX-License-Identifier: Apache-2.0
#

description:
  STMicroelectronics MCU Segment LCD (SLCD) controller used as segment-style
  auxiliary display.

compatible: "st,slcd"

include: [base.yaml, pinctrl-device.yaml]

properties:
  reg:
    required: true
    description: Base address and length of the LCD peripheral register block.

  pinctrl-0:
    required: true
  pinctrl-names:
    required: true
  clocks:
    required: true
    description: The kernel clock selection should be done on the RTC node directly.

  lcd-duty:
    required: true
    type: string
    enum:
      - LCD_DUTY_STATIC
      - LCD_DUTY_1_2
      - LCD_DUTY_1_3
      - LCD_DUTY_1_4
      - LCD_DUTY_1_8
    description: |
      The LCD duty cycle is the hardware parameter defining the time-slicing
      interval used by the microcontroller to drive the segment LCD's common
      (COM) lines. It specifies the fraction of a full clock cycle during
      which a single COM line is active and electrically energized.
      Duty selection:
      - LCD_DUTY_STATIC : 100.0%
      - LCD_DUTY_1_2    :  50.0%
      - LCD_DUTY_1_3    :  33.3%
      - LCD_DUTY_1_4AA  :  25.0% (the only one valid for ST GH08172T)
      - LCD_DUTY_1_8    :  12.5%

  lcd-bias:
    required: true
    type: string
    enum:
      - LCD_BIAS_1_4
      - LCD_BIAS_1_2
      - LCD_BIAS_1_3
    description: |
      The LCD bias is the hardware parameter defining the voltage division ratio
      used by the microcontroller to generate intermediate voltage levels for the
      segment LCD's lines. It specifies the fractional steps of the total driving
      voltage used to prevent ghosting and optimize contrast on inactive segments.
      Bias selection:
      - LCD_BIAS_1_4 : x 1/4
      - LCD_BIAS_1_2 : x 1/2
      - LCD_BIAS_1_3 : x 1/3 (the only one valid for ST GH08172T)

  lcd-mux-segment:
    required: true
    type: string
    enum:
      - LCD_MUXSEGMENT_DISABLE
      - LCD_MUXSEGMENT_ENABLE
    description: |
      The LCD mux segment is the hardware parameter defining the pin mapping and
      multiplexing configuration for the segment LCD's output lines. It specifies
      the internal routing layout of the microcontroller to correctly map logical
      segments to their respective physical pins on the display.
      Mux segment selection:
      - LCD_MUXSEGMENT_DISABLE : no segment multiplexing (the only one valid for ST GH08172T)
      - LCD_MUXSEGMENT_ENABLE  : segment multiplexing activated

  lcd-voltage-source:
    required: true
    type: int
    enum:
      - 0
      - 1
    description: |
      The LCD voltage source is the hardware parameter defining the power supply
      origin used by the microcontroller to drive the segment LCD. It specifies whether
      the required driving voltages are generated internally via the integrated step-up
      converter or supplied externally through a dedicated power pin.
      Voltage source selection:
      - 0 : use the lcd internal voltage source, thus the integrated step-up converter
      - 1 : use the lcd external voltage source, thus the dedicated power pin

  lcd-prescaler:
    required: true
    type: int
    enum:
      - 1
      - 2
      - 4
      - 8
      - 16
      - 32
      - 64
      - 128
      - 256
      - 512
      - 1024
      - 2048
      - 4096
      - 8192
      - 16384
      - 32768
    description: |
      The LCD prescaler is the hardware parameter defining the clock division factor
      used by the microcontroller to scale down the main clock source. It specifies
      the division ratio applied to the input frequency to establish the base timebase
      required for the LCD frame rate generation.
      Prescaler selection:
      - x : 1/x division ratio is applied

  lcd-divider:
    required: true
    type: int
    min: 16
    max: 31
    description: |
      The LCD divider is the hardware parameter defining the frequency division factor
      used by the microcontroller to further reduce the pre-scaled clock frequency. It
      specifies the final denominator applied to the clock tree to compute the precise
      frame rate frequency required by the segment LCD.
      Divider selection:
      - x : x is the final denominator applied to the clock

  lcd-contrast:
    required: true
    type: int
    min: 0
    max: 7
    description: |
      The LCD contrast level is the hardware parameter defining the voltage amplitude
      configuration used by the microcontroller to fine-tune the display grid's peak
      voltages. It specifies the step adjustment applied to the driving waveforms to
      balance segment visibility and maximize contrast for optimal readability.
      Contrast selection:
      - 0 : min contrast level
      - 7 : max contrast level

  lcd-pulse-on-duration:
    required: true
    type: int
    min: 0
    max: 7
    description: |
      The LCD pulse duration is the hardware parameter defining the time interval during
      which the microcontroller activates the internal low-resistance voltage generator
      for each frame change. It specifies the pulse width used to rapidly charge the
      segment capacitance before switching to a high-resistance, low-power buffer to
      minimize overall power consumption.
      Pulse duration selection:
      - 0 : min pulse duration
      - 7 : max pulse duration

  lcd-dead-time:
    required: true
    type: int
    min: 0
    max: 7
    description: |
      The LCD dead time is the hardware parameter defining the time-delay interval
      inserted by the microcontroller between consecutive LCD frame phases. It specifies
      the duration during which no voltage is applied to the segments to eliminate
      residual charges, thereby reducing power consumption and preventing ghosting
      artifacts.
      Dead time selection:
      - 0 : min dead-time
      - 7 : max dead-time

  lcd-high-drive:
    required: true
    type: string
    enum:
      - LCD_HIGHDRIVE_DISABLE
      - LCD_HIGHDRIVE_ENABLE
    description: |
      The LCD high drive is the hardware parameter defining the operational status
      of the internal low-resistance voltage buffer used by the microcontroller.
      It specifies whether the high-drive current capability is enabled or disabled
      to satisfy the charging requirements of larger segments.
      High drive selection:
      - LCD_HIGHDRIVE_DISABLE : no high-drive current
      - LCD_HIGHDRIVE_ENABLE  : high-drive current activated

  lcd-blink-mode:
    required: true
    type: string
    enum:
      - LCD_BLINKMODE_OFF
      - LCD_BLINKMODE_SEG0_COM0
      - LCD_BLINKMODE_SEG0_ALLCOM
      - LCD_BLINKMODE_ALLSEG_ALLCOM
    description: |
      The LCD blink mode is the hardware parameter defining the blinking status
      and operational behavior of the display segments. It specifies whether the
      blinking feature is disabled, applied to all display segments simultaneously,
      or limited exclusively to the segments tied to the first common line.
      Blink mode selection:
      - LCD_BLINKMODE_OFF           : nothing blinks
      - LCD_BLINKMODE_SEG0_COM0     : just segments associated to SEG0 and COM0 blink
      - LCD_BLINKMODE_SEG0_ALLCOM   : just all segments associated to SEG0 on any COM blink
      - LCD_BLINKMODE_ALLSEG_ALLCOM : all segments on any COM blink

  lcd-blink-frequency:
    required: true
    type: int
    enum:
      - 8
      - 16
      - 32
      - 64
      - 128
      - 256
      - 512
      - 1024
    description: |
      The LCD blink frequency is the hardware parameter defining the blinking rate
      of the display segments. It specifies the clock division factor applied to
      the main LCD frame clock to determine the precise timing interval and speed
      at which the configured segments toggle between their active and inactive states.
      Blink frequency selection:
      - x : 1/x of the main LCD frame clock frequency

  pin-list:
    type: array
    description: |
      The list of MCU AF11 channel names associated to the corresponding LCD segment pin.

  com-list:
    type: array
    description: |
      Used just to have the count of the COM registers, not used to directly evaluate the COM
      register index.

  character-bit-list:
    type: array
    description: |
      The list of bits of the controller registers that are used to control the segments.

  character-com-list:
    type: array
    description: |
      The list of com registers of the controller that are used to control the segments.

  indicator-bit-list:
    type: array
    description: |
      The list of bits of the controller registers that are used to control the indicators.

  indicator-com-list:
    type: array
    description: |
      The list of com registers of the controller that are used to control the indicators.

  custom-character-slot-count:
    type: int
    default: 32
    description: |
      Number of custom characters the application can store into the driver and then use.
```

## dts/bindings/bluetooth/zephyr,bt-hci-usbh.yaml
```yaml
# SPDX-FileCopyrightText: Copyright The Zephyr Project Contributors
# SPDX-License-Identifier: Apache-2.0

description: |
  Bluetooth HCI provided by a USB Bluetooth controller attached to the
  USB host stack.

  The node does not describe the controller itself, which is found by
  enumeration as a Wireless Controller class (0xE0/0x01/0x01) function.

  Example:

    / {
            chosen {
                    zephyr,bt-hci = &bt_hci_usbh;
            };

            bt_hci_usbh: bt-hci-usbh {
                    compatible = "zephyr,bt-hci-usbh";
                    status = "okay";
            };
    };

compatible: "zephyr,bt-hci-usbh"

include: bt-hci.yaml

properties:
  bt-hci-name:
    default: "USB host"
  bt-hci-bus:
    default: "usb"
```

## dts/bindings/can/atmel,sam0-can.yaml
```yaml
# Copyright (c) 2024 Gerson Fernando Budke <nandojve@gmail.com>
# SPDX-License-Identifier: Apache-2.0

description: |
  Specialization of Bosch m_can CAN FD controller for Atmel SAM0 and
  Microchip PIC32CX SG.

  On Atmel SAM0 SoCs, the clocks are the "GCLK" channel and the "MCLK" bus
  clock, and atmel,assigned-clocks, atmel,assigned-clock-names and divider
  select the GCLK generator feeding the controller; all three are required.

  On Microchip PIC32CX SG SoCs, the clocks are the "GCLK" peripheral channel
  and the "MCLK" bus clock of the Microchip clock controller. The GCLK
  generator is set by the clock controller node, and
  atmel,assigned-clocks, atmel,assigned-clock-names and divider are not
  used.

compatible: "atmel,sam0-can"

include:
  - name: bosch,m_can-base.yaml
  - name: pinctrl-device.yaml
  - name: atmel,assigned-clocks.yaml

properties:
  reg:
    required: true

  interrupts:
    required: true

  interrupt-names:
    required: true

  clocks:
    required: true

  clock-names:
    required: true

  divider:
    type: int
    description: |
      Clock divider of the GCLK generator used by CAN as clock source.
      Required on Atmel SAM0 SoCs.
```
