## dts/bindings/adc/infineon,dsadc.yaml
```yaml
# SPDX-FileCopyrightText: Copyright (c) 2026 Infineon Technologies AG,
# SPDX-FileCopyrightText: or an affiliate of Infineon Technologies AG. All rights reserved.
#
# SPDX-License-Identifier: Apache-2.0

description: |
  Infineon Delta-Sigma ADC (DSADC)

  Delta-Sigma ADC found in the Programmable Analog Channel Sub-System
  (PACSS) of the PSOC4 HVPA devices. The PACSS has two analog front-ends
  (ACHAN) and four digital channels (DCHAN).

  Each Zephyr ADC channel maps to the digital channel with the same index
  (0 to 3). The analog front-end is selected by the driver: channels that
  use the shunt inputs (RSH/RSL) are converted by ACHAN0 (current channel),
  all other channels by ACHAN1 (voltage channel).

  Channels are configured with the standard ADC channel properties:
  - zephyr,gain: ADC_GAIN_1_2 to ADC_GAIN_128 in powers of two.
  - zephyr,reference: ADC_REF_INTERNAL (1.2 V HPBGR), ADC_REF_VDD_1_3,
    ADC_REF_VDD_1_4 or ADC_REF_EXTERNAL0. ADC_REF_EXTERNAL0 selects the
    external temperature sensor reference (VTS_REF - VTS_RET) for ratiometric
    thermistor measurements on the VTS input.
  - zephyr,acquisition-time: ADC_ACQ_TIME_DEFAULT (16 modulator clocks) or
    ADC_ACQ_TIME_TICKS (0 to 255 modulator clocks) channel select delay.
  - zephyr,input-positive / zephyr,input-negative: values from
    <zephyr/dt-bindings/adc/infineon-dsadc.h>. Single-ended channels are
    measured against VSSA.
  - zephyr,resolution: 8 to 20 bits. Results up to 16 bits are stored as
    16-bit samples, larger results as 32-bit samples.
  - zephyr,oversampling: 0 only.

  The decimator uses the ModusToolbox current, voltage and temperature channel
  settings, for which the factory calibration stored in SFLASH is scaled. The
  driver scales the result to the requested resolution.

  The modulator clock should be 3 MHz. With a 48 MHz HFCLK, use an integer
  divider of 16.

  Example:

    &peri_clk_div1 {
        clock-div = <16>;
        status = "okay";
    };

    &adc0 {
        status = "okay";
        hpbgr-external-capacitor;
        #address-cells = <1>;
        #size-cells = <0>;

        channel@0 {
            reg = <0>;
            zephyr,gain = "ADC_GAIN_1";
            zephyr,reference = "ADC_REF_INTERNAL";
            zephyr,acquisition-time = <ADC_ACQ_TIME_DEFAULT>;
            zephyr,input-positive = <IFX_DSADC_POS_GPIO3>;
            zephyr,resolution = <16>;
        };

        channel@1 {
            reg = <1>;
            zephyr,gain = "ADC_GAIN_32";
            zephyr,reference = "ADC_REF_INTERNAL";
            zephyr,acquisition-time = <ADC_ACQ_TIME_DEFAULT>;
            zephyr,differential;
            zephyr,input-positive = <IFX_DSADC_POS_RSH_0>;
            zephyr,input-negative = <IFX_DSADC_NEG_RSL_0>;
            zephyr,resolution = <20>;
        };
    };

compatible: "infineon,dsadc"

include:
  - name: adc-controller.yaml
  - name: pinctrl-device.yaml

properties:
  reg:
    required: true
    description: Base address of the PACSS registers

  interrupts:
    required: true
    description: |
      Digital channel 0 to 3 interrupts (pacss_interrupts_dch_0 to 3), in
      channel order.

  clocks:
    required: true
    description: Clock divider phandle for the delta-sigma modulator clock

  clk-dst:
    type: int
    required: true
    description: Peripheral clock destination for the delta-sigma modulator clock

  "#io-channel-cells":
    const: 1

  hpbgr-external-capacitor:
    type: boolean
    description: |
      Set if an external capacitor is connected to the high precision bandgap
      reference (HPBGR) output. This selects the HPBGR buffer compensation.

io-channel-cells:
  - input
```

## dts/bindings/adc/st,stm32wb0-adc.yaml
```yaml
# SPDX-License-Identifier: Apache-2.0

description: STM32WB0 Analog-to-Digital Converter

compatible: "st,stm32wb0-adc"

include: [adc-controller.yaml, pinctrl-device.yaml]

properties:
  reg:
    required: true

  clocks:
    required: true

  clock-names:
    required: true
    const: ["digital", "analog"]
    description: |
      The two ADC clock domains can be controlled independently:
      - "digital" for the digital part of the ADC block
      - "analog" for the analog part of the ADC block

  interrupts:
    required: true

  "#io-channel-cells":
    const: 1

  io-booster:
    type: boolean
    description: |
      When set, the I/O Booster block is enabled during ADC usage. Otherwise, the
      I/O Booster block is always disabled. This property MUST be set if VBAT voltage
      may reach a value below 2.7V to guarantee that the ADC behavior remains correct.

io-channel-cells:
  - input
```

## dts/bindings/adc/ti,am335x-adc.yaml
```yaml
# Copyright (c) 2025 Texas Instruments
#
# SPDX-License-Identifier: Apache-2.0

description: TI AM335X ADC

compatible: "ti,am335x-adc"

include: [adc-controller.yaml, pinctrl-device.yaml]

properties:
  interrupts:
    required: true

  ti,vrefp:
    type: int
    description: Reference Voltage (in mV)

  ti,fifo:
    type: int
    required: true
    enum:
      - 0
      - 1
    description: FIFO for storing conversions

  channel-count:
    type: int
    default: 8
    enum: [1, 2, 3, 4, 5, 6, 7, 8]
    description: |
      Number of analog inputs of this ADC instance. The default is the full
      8-input mux, all bonded out on AM64x; a SoC that bonds out fewer, such
      as AM62L, must set it.

  "#io-channel-cells":
    const: 1

io-channel-cells:
  - input

child-binding:
  properties:
    ti,open-delay:
      type: int
      default: 0
      description: Delay before acquisition period

    zephyr,resolution:
      default: 12

    zephyr,oversampling:
      default: 0
```

## dts/bindings/adc/wisblock-adc.yaml
```yaml
# Copyright (c) 2026 RAKwireless Technology Limited
# SPDX-License-Identifier: Apache-2.0

title: WisBlock ADC Channel Map

description: |
  ADC channels exposed on the WisBlock IO connector.

  The WisBlock specification defines AIN0, AIN1, and IO1 through IO7 as
  possible ADC-capable connector signals. Individual Core boards may expose
  only a subset of these signals to the SoC ADC. This binding provides a
  nexus mapping from the common WISBLOCK_ADC_* indices defined in
  <zephyr/dt-bindings/adc/wisblock-adc.h> to the board's actual ADC channels.

  Example usage in a WisBlock Core board file:

    wisblock_adc: wisblock-adc {
      compatible = "wisblock-adc";
      io-channel-map =
        <WISBLOCK_ADC_AIN0 &adc 3>,
        <WISBLOCK_ADC_AIN1 &adc 7>,
        <WISBLOCK_ADC_IO4  &adc 2>,
        <WISBLOCK_ADC_IO7  &adc 4>;
      #io-channel-cells = <1>;
    };

compatible: "wisblock-adc"

include: [base.yaml, io-channel-nexus.yaml]

properties:
  io-channel-map:
    description: |
      Nexus mapping from WisBlock ADC pin indices to SoC ADC channels.
      Each entry is a tuple of (wisblock-pin, adc-phandle, adc-channel).

  "#io-channel-cells":
    description: Number of cells in an ADC specifier. Must be 1.
```

## dts/bindings/arm/nordic,nrf-mutex.yaml
```yaml
# Copyright (c) 2022 Nordic Semiconductor ASA
# SPDX-License-Identifier: Apache-2.0

description: Nordic nRF family MUTEX (Mutual Exclusive Peripheral)

compatible: "nordic,nrf-mutex"

include: base.yaml

properties:
  reg:
    required: true

  "#mutex-cells":
    type: int
    const: 1
    description: |
      Number of cells in a specifier. The single cell is the
      index of the hardware mutex within this MUTEX instance.

  nordic,mutex-count:
    type: int
    required: true
    description: |
      Number of hardware mutexes provided by this MUTEX instance.

mutex-cells:
  - index
```

## dts/bindings/audio/cirrus,cs42l51.yaml
```yaml
# Copyright (c) 2026 ZAL Zentrum für Angewandte Luftfahrtforschung GmbH
# SPDX-License-Identifier: Apache-2.0

description: Cirrus CS42L51 Audio Codec

include: [i2c-device.yaml]

compatible: "cirrus,cs42l51"

properties:
  reg:
    required: true

  clocks:
    type: phandle-array
    required: true
    description: |
      Phandle to the clock supplying the codec's MCLK pin. If the clock
      is not backed by a real clock controller, a "fixed-clock" node can
      be used to describe its frequency.

  clock-names:
    type: string-array
    required: true
    enum:
      - mclk
    description: Must contain "mclk" matching the MCLK input

  reset-gpios:
    required: true
    type: phandle-array
    description: |
      RESET pin

  input-channel:
    type: int
    enum:
      - 1
      - 2
      - 3
    description: |
      Analog input pair that feeds the ADC, applied to both the A and B
      channels:
        1 = AIN1
        2 = AIN2
        3 = the MICIN1/MICIN2 pins, wired directly to the ADC without
            the mic preamp
```

## dts/bindings/audio/nuvoton,nau8540.yaml
```yaml
# Copyright (c) 2026 RAKwireless Technology Limited
# SPDX-License-Identifier: Apache-2.0

description: |
  Nuvoton NAU85L40 / NAU85L40B 4-channel analog microphone ADC.

  Control is over I2C (16-bit register address and 16-bit value). PCM audio
  is produced on I2S. The default I2C address is 0x1c when CSB is low, or
  0x1d when CSB is high.

  https://www.nuvoton.com/products/smart-home-audio/audio-converters/audio-adcs/nau85l40b/

compatible: "nuvoton,nau8540"

include: [i2c-device.yaml, power.yaml]

properties:
  reg:
    required: true

  csb-gpios:
    type: phandle-array
    description: |
      Optional CSB / GPIO strap that selects the I2C address LSB. The driver
      drives this pin to match the reg property (low = 0x1c, high = 0x1d)
      before the first I2C access. On RAK18040 this is MIC_CTR (WisBlock IO1)
      and must stay high for analog microphone bias.

  clock-source:
    type: string
    default: "FLL-FS"
    enum:
      - "FLL-FS"
      - "INTERNAL"
    description: |
      SYSCLK source after configure().
      - "FLL-FS": on-chip FLL locked to the I2S frame clock (host I2S controller).
      - "INTERNAL": free-running DCO at 48 kHz. The codec drives BCLK and FS.
      The default is FLL-FS because the typical use is a host I2S controller
      that supplies FS; INTERNAL is for boards that have no I2S clocks wired.

  adc-channels:
    type: int
    default: 3
    max: 15
    description: |
      Bit mask of analog ADC channels that are wired (bit0 = CH1 ... bit3 = CH4).
      The default is CH1 and CH2, which matches a stereo module such as
      RAK18040 + RAK18041. configure() maps the lowest set bits onto serial
      slots 1..N and powers those ADCs. A longer channel count is rejected.
```

## dts/bindings/audio/ti,tlv320aic3104.yaml
```yaml
# SPDX-FileCopyrightText: Copyright The Zephyr Project Contributors
# SPDX-License-Identifier: Apache-2.0

title: Texas Instruments TLV320AIC3104 stereo audio codec

description: |
  Texas Instruments TLV320AIC3104 low-power stereo audio codec.
  I2C control interface with page-based register access (pages 0 and 1).
  Datasheet: https://www.ti.com/product/TLV320AIC3104

  The 32-pin RHB package has no interrupt output pin.

compatible: "ti,tlv320aic3104"

include: i2c-device.yaml

properties:
  reset-gpios:
    type: phandle-array
    required: true
    description: GPIO for hardware reset (active-low)

  clocks:
    description: |
      Optional MCLK provider, named "mclk" in clock-names. When present,
      audio_codec_configure() takes the MCLK rate from this clock instead of
      audio_codec_cfg.mclk_freq. A provider with a clock-frequency
      property, such as a fixed-clock for an on-board oscillator, is read
      at build time. Any other provider is switched on and read through the
      clock control API (CONFIG_CLOCK_CONTROL), and its specifier may have no
      cells or a "name" cell.

  clock-names:
    description: Must be "mclk" when clocks is present.

  mic-bias-level:
    type: int
    default: 0
    enum:
      - 0
      - 1
      - 2
      - 3
    description: |
      MICBIAS output level (page 0, register 25, D7-D6).
      0 = off (default, matches the part's reset state). 1 = 2 V.
      2 = 2.5 V. 3 = connected to AVDD.

  adc-high-pass-filter:
    type: int
    default: 0
    enum:
      - 0
      - 1
      - 2
      - 3
    description: |
      ADC high-pass filter corner for both channels (page 0, register 12,
      D7-D4). 0 = disabled (default, matches the part's reset state).
      1 = 0.0045 x fS(ADC). 2 = 0.0125 x fS(ADC). 3 = 0.025 x fS(ADC).

  hprcom-vcm-output:
    type: boolean
    description: |
      Drive HPRCOM as a constant common-mode voltage and power it up
      (page 0, register 38 D5-D3 = 001, and register 72).

      Set this on a board that returns the headphone load through HPRCOM
      instead of ground - a jack whose sleeve is wired to the pin rather
      than to GND. Without it HPRCOM stays at its reset state, which is
      powered down and high-impedance, and such a load has no return path:
      the two channels end up in series with a floating midpoint, so only
      their difference is audible and a mono source is silent.

      Leave it out on a board that grounds the sleeve. HPRCOM is then
      unused, and powering it would only burn current.

  hp-single-ended:
    type: boolean
    description: |
      The board drives its headphone load from HPLOUT and HPROUT alone,
      each through a coupling capacitor, and leaves HPLCOM and HPRCOM
      unconnected. configure() then writes page 0 register 14 as 0x80:
      ac-coupled drivers, D6 (stereo fully differential configuration)
      clear.

      Without it register 14 is 0xC0, which also tells the codec that
      HPLOUT/HPLCOM and HPROUT/HPRCOM drive a fully differential load.

      Do not set it together with hprcom-vcm-output. A load returned
      through HPRCOM is a pseudo-differential one (register 14 D3), which
      the driver does not program; a build with both set fails.
```

## dts/bindings/audio/ti,tlv320aic3106.yaml
```yaml
# SPDX-FileCopyrightText: Copyright The Zephyr Project Contributors
# SPDX-License-Identifier: Apache-2.0

title: Texas Instruments TLV320AIC3106 stereo audio codec

description: |
  Texas Instruments TLV320AIC3106 low-power stereo audio codec.
  Datasheet: https://www.ti.com/product/TLV320AIC3106

  The TLV320AIC3106 uses the TLV320AIC3104 register map and adds the
  MIC3L/MIC3R and LINE2L/LINE2R inputs, so it shares the TLV320AIC3104
  driver and properties. Only I2C control is supported (SELECT pin low);
  the I2C address is 0x18 to 0x1b, set by the MFP0/MFP1 pins.

compatible: "ti,tlv320aic3106"

include: ti,tlv320aic3104.yaml

properties:
  left-capture-input:
    type: string
    default: "mic3"
    enum:
      - "line1"
      - "mic3"
      - "line2"
    description: |
      Input routed to the left ADC by audio_codec_configure().
      "line1": LINE1L (page 0, register 19). "mic3": MIC3L (register 17).
      "line2": LINE2L (register 20). The default, "mic3", uses the same
      registers as the TLV320AIC3104 default capture input.

  right-capture-input:
    type: string
    default: "mic3"
    enum:
      - "line1"
      - "mic3"
      - "line2"
    description: |
      Input routed to the right ADC by audio_codec_configure().
      "line1": LINE1R (page 0, register 22). "mic3": MIC3R (register 18).
      "line2": LINE2R (register 23).
```
