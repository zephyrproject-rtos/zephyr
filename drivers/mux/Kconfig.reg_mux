## drivers/nvmem/Kconfig.nvmem_nxp_ocotp
```kconfig
# Copyright 2025 NXP
# SPDX-License-Identifier: Apache-2.0

config NVMEM_NXP_OCOTP
	bool "NXP On-Chip OTP controller driver"
	default y
	depends on DT_HAS_NXP_OCOTP_ENABLED
	help
	  NXP On-Chip OTP controller as a FUSE provider.

config NVMEM_NXP_OCOTP_WRITE_ENABLE
	bool "Enable programming of OCOTP fuses"
	depends on NVMEM_NXP_OCOTP
	default n
	help
	  Allow programming OCOTP via the NVMEM API. Disabled by default so the
	  provider behaves as read-only unless a platform explicitly opts into
	  write capability. When disabled, nvmem_write() on this provider returns
	  -EROFS.

if NVMEM_NXP_OCOTP_WRITE_ENABLE
	comment "DANGER: OCOTP fuse programming is destructive and irreversible; enable only for provisioning in a controlled environment. Do NOT enable for production builds."
endif
```

## drivers/opamp/Kconfig
```kconfig
# Copyright 2025 NXP
# SPDX-License-Identifier: Apache-2.0

menuconfig OPAMP
	bool "Operational Amplifier (opamp) drivers"
	help
	  Enable opamp driver configuration.

if OPAMP

module = OPAMP
module-str = opamp
source "subsys/logging/Kconfig.template.log_config"

config OPAMP_INIT_PRIORITY
	int "OPAMP init priority"
	default KERNEL_INIT_PRIORITY_DEVICE
	help
	  Opamp device driver initialization priority.

# zephyr-keep-sorted-start
rsource "Kconfig.mcux_opamp"
rsource "Kconfig.mcux_opamp_fast"
rsource "Kconfig.stm32_opamp"
# zephyr-keep-sorted-stop

endif # OPAMP
```

## drivers/opamp/Kconfig.infineon_autanalog_ctb
```kconfig
# Copyright (c) 2026 Infineon Technologies AG,
# or an affiliate of Infineon Technologies AG.
#
# SPDX-License-Identifier: Apache-2.0

config OPAMP_INFINEON_AUTANALOG_CTB
	bool "Infineon AutAnalog CTB opamp driver"
	default y
	depends on DT_HAS_INFINEON_AUTANALOG_CTB_OPAMP_ENABLED
	select MFD
	help
	  Enable the Infineon AutAnalog CTB opamp driver.  Each instance
	  provides a single opamp (OA0 or OA1) within a CTB block, with
	  runtime gain control via the Autonomous Controller STT.

config OPAMP_INFINEON_AUTANALOG_CTB_INIT_PRIORITY
	int "Infineon AutAnalog CTB opamp init priority"
	default 43
	depends on OPAMP_INFINEON_AUTANALOG_CTB
	help
	  Init priority for the CTB opamp driver.  Must be higher (later)
	  than the CTB MFD init priority (default 42).
```

## drivers/opamp/Kconfig.mcux_opamp
```kconfig
# Copyright 2025 NXP
# SPDX-License-Identifier: Apache-2.0

config OPAMP_MCUX_OPAMP
	bool "NXP MCUX Opamp driver"
	default y
	depends on DT_HAS_NXP_OPAMP_ENABLED
	select PINCTRL
	select RESET if SOC_FAMILY_LPC
	select CLOCK_CONTROL
```

## drivers/opamp/Kconfig.mcux_opamp_fast
```kconfig
# Copyright 2025 NXP
# SPDX-License-Identifier: Apache-2.0

config OPAMP_MCUX_OPAMP_FAST
	bool "NXP MCUX Opamp_fast driver"
	default y
	depends on DT_HAS_NXP_OPAMP_FAST_ENABLED
	select PINCTRL
	select CLOCK_CONTROL
```

## drivers/opamp/Kconfig.stm32_opamp
```kconfig
# Copyright (c) 2025 Alexander Kozhinov <ak.alexander.kozhinov@gmail.com>
# SPDX-License-Identifier: Apache-2.0

config OPAMP_STM32
	bool "STM32 OPAMP driver"
	default y
	select PINCTRL
	depends on DT_HAS_ST_STM32_OPAMP_ENABLED
```

## drivers/openamp/Kconfig
```kconfig
# Copyright (c) 2024 Maurer Systems GmbH
# SPDX-License-Identifier: Apache-2.0

config RPMSG_VDEV
	bool "Support for RPMSG VirtualIO Device"
	depends on OPENAMP

if OPENAMP

module = OPENAMP_DRIVER
module-str = OPENAMP_DRIVER
source "subsys/logging/Kconfig.template.log_config"

config RPMSG_VDEV_INIT_PRIORITY
	int "RPMSG VirtualIO Device initialization priority"
	default 70
	help
	  Set the priority for RPMSG VirtualIO Device init

config RPMSG_VDEV_THREAD_PRIORITY
	int "Thread priority"
	default 10
	help
	  Priority of the RPMSG VirtualIO Device |
	  thread used to process vrings.

config RPMSG_VDEV_THREAD_STACK_SIZE
	int "Thread stack size"
	default 1024
	help
	  Stack size of RPMSG VirtualIO Device thread.

config OPENAMP_RESOURCE_TABLE
	bool "Support for OpenaAMP Resource Table"


endif # RPMSG_VDEV
```

## drivers/otp/Kconfig
```kconfig
# OTP driver configuration options

# Copyright (c) 2025 STMicroelectronics
# SPDX-License-Identifier: Apache-2.0

menuconfig OTP
	bool "One Time Programmable (OTP) drivers [EXPERIMENTAL]"
	select EXPERIMENTAL
	help
	  Enable support for hardware OTP. The OTP technology can be anything
	  from fuses to flash memory option bytes as long as it stays one time
	  programmable.

if OTP

module = OTP
module-str = otp

source "subsys/logging/Kconfig.template.log_config"

# zephyr-keep-sorted-start
source "drivers/otp/Kconfig.emu"
source "drivers/otp/Kconfig.mcux_ocotp"
source "drivers/otp/Kconfig.sifli"
source "drivers/otp/Kconfig.stm32"
# zephyr-keep-sorted-stop

config OTP_INIT_PRIORITY
	int "OTP init priority"
	default KERNEL_INIT_PRIORITY_DEVICE
	help
	  OTP device drivers initialization priority. This initialization
	  priority is used unless the driver implementation has its own
	  initialization priority.

config OTP_PROGRAM
	bool "Support OTP programming through Zephyr API"
	help
	  Allowing the programming of OTPs may cause irreversible damage
	  to a platform. Use it very carefully and at your own risk.

config OTP_SHELL
	bool "OTP shell"
	depends on SHELL
	help
	  Enable the OTP shell with One Time Programmable related commands.

if OTP_SHELL

config OTP_SHELL_BUFFER_SIZE
	int "OTP shell program buffer size"
	default 256
	help
	  Size of the buffer used for OTP program commands in the OTP shell.

endif # OTP_SHELL

endif # OTP
```

## drivers/otp/Kconfig.bflb
```kconfig
# Copyright (c) 2024-2026 MASSDRIVER EI (massdriver.space)
# SPDX-License-Identifier: Apache-2.0

config OTP_BFLB
	bool "Bouffalolab EFUSEs driver"
	default y
	depends on DT_HAS_BFLB_EFUSE_ENABLED
	help
	  E-Fuse access via OTP API for Bouffalolab platforms.
```

## drivers/otp/Kconfig.emu
```kconfig
# Copyright (c) 2025 STMicroelectronics
# SPDX-License-Identifier: Apache-2.0

config OTP_EMULATOR
	bool "OTP memory emulation driver"
	default y
	depends on DT_HAS_ZEPHYR_OTP_EMUL_ENABLED
	help
	  Enable OTP emulator driver which can be used for testing purposes.
	  It will use a static RAM buffer per instance whose size is defined
	  in the device tree node of the OTP device.
```

## drivers/otp/Kconfig.et171
```kconfig
# Copyright (c) 2026 Egis Technology Inc.
# SPDX-License-Identifier: Apache-2.0

config OTP_EGIS_ET171_OTP
	bool "ET171 OTP driver"
	default y
	depends on DT_HAS_EGIS_ET171_OTP_ENABLED
	help
	  Enable support for ET171 OTP driver.
```

## drivers/otp/Kconfig.mcux_ocotp
```kconfig
# Copyright (c) 2026 Basalte bv
# SPDX-License-Identifier: Apache-2.0

config OTP_MCUX_OCOTP
	bool "MCUX OCOTP driver"
	default y
	depends on DT_HAS_NXP_OCOTP_ENABLED
	select CLOCK_CONTROL if $(dt_compat_any_has_prop,$(DT_COMPAT_NXP_OCOTP),clocks)
	help
	  Enable support for MCUX OCOTP driver.
```

## drivers/otp/Kconfig.nxp_otpc
```kconfig
# SPDX-FileCopyrightText: Copyright 2026 NXP
# SPDX-License-Identifier: Apache-2.0

config OTP_NXP_OTPC
	bool "NXP OTPC eFuse driver"
	default y
	depends on DT_HAS_NXP_OTPC_ENABLED
	help
	  Enable NXP OTPC eFuse controller driver.
```
