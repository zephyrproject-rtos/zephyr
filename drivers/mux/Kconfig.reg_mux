## drivers/mux/Kconfig.reg_mux
```kconfig
# Copyright NXP 2025
# SPDX-License-Identifier: Apache-2.0

config MUX_REG_MUX
        bool "Generic register bitfield mux driver"
        default y
        depends on DT_HAS_REG_MUX_ENABLED
        help
          This driver is used for muxes that are controlled by
          writing to bitfields in a register.
```

## drivers/nble/Kconfig
```kconfig
# Kconfig - NBLE configuration options

#
# Copyright (c) 2016 Intel Corporation
#
# Licensed under the Apache License, Version 2.0 (the "License");
# you may not use this file except in compliance with the License.
# You may obtain a copy of the License at
#
#     http://www.apache.org/licenses/LICENSE-2.0
#
# Unless required by applicable law or agreed to in writing, software
# distributed under the License is distributed on an "AS IS" BASIS,
# WITHOUT WARRANTIES OR CONDITIONS OF ANY KIND, either express or implied.
# See the License for the specific language governing permissions and
# limitations under the License.
#

config NBLE
	bool "Support for custom Nordic Semiconductor BLE protocol"
	default n
	select BLUETOOTH_PERIPHERAL
	select BLUETOOTH_CENTRAL
	select BLUETOOTH_GATT_CLIENT
	select BLUETOOTH_SMP
	select UART_INTERRUPT_DRIVEN
	select NANO_TIMEOUTS
	select NET_BUF
	help
	  Enables support for using Nordic Semiconductor nRF51 Bluetooth
	  LE chips with a custom firmware. The API for this is a subset of
	  the normal Bluetooth API (include/bluetooth/*.h). This driver can
	  only be enabled if CONFIG_BLUETOOTH has not been enabled.

	  A fundamental assumption that the driver makes is that it is
	  run on an architecture with the same ABI (e.g. struct packing
	  & endianess) as the nRF51 chip. The driver cannot be used on
	  any architecture that doesn't fulfill this requirement.

if !BLUETOOTH && NBLE
config BLUETOOTH_PERIPHERAL
	bool
	default n

config BLUETOOTH_CENTRAL
	bool
	default n

config BLUETOOTH_GATT_CLIENT
	bool
	default n

config BLUETOOTH_SMP
	bool
	default n

config	BLUETOOTH_MAX_CONN
	int
	default 6

config	BLUETOOTH_MAX_PAIRED
	int
	default 7

config BLUETOOTH_DEBUG
	bool "Enable Debug"
	default n
	select STDOUT_CONSOLE

config  BLUETOOTH_RX_STACK_SIZE
	int "Size of the receiving fiber stack"
	default 1024
	range 1024 65536
	help
	  Size of the receiving fiber stack. This is the context from
	  which all event callbacks to the application occur. The
	  default value is sufficient for basic operation, but if the
	  application needs to do advanced things in its callbacks that
	  require extra stack space, this value can be increased to
	  accomodate for that.

if BLUETOOTH_DEBUG

config	BLUETOOTH_DEBUG_DRIVER
	bool "Bluetooth driver debug"
	default n
	help
	  This option enables debug support for the chosen
	  Bluetooth UART driver to Nordic chip.

config BLUETOOTH_DEBUG_GATT
	bool "Bluetooth Generic Attribute Profile (GATT) debug"
	default n
	help
	  This option enables debug support for the Bluetooth
	  Generic Attribute Profile (GATT).

config NBLE_DEBUG_GAP
	bool "NBLE Generic Access Profile (GAP) debug"
	default n
	help
	  This option enables debug support for the Bluetooth
	  Generic Access Profile (GAP) in the interfaces to the
	  Nordic chip.

config NBLE_DEBUG_RPC
	bool "NBLE RPC debug"
	default n
	help
	  This option enables debug for RPC interface to the Nordic
	  Bluetooth LE chip.

endif # BLUETOOTH_DEBUG

config  NBLE_UART_ON_DEV_NAME
	string "Device Name of UART Device for Nordic BLE"
	default "UART_0"
	depends on NBLE
	help
	  This option specifies the name of UART device to be used
	  for Nordic BLE.

endif
```

## drivers/net/Kconfig
```kconfig
# Misc network drivers configuration options
# SPDX-License-Identifier: Apache-2.0

menuconfig NET_DRIVERS
	bool "Network drivers"

if NET_DRIVERS

#
# PPP options
#
menuconfig NET_PPP
	bool "Point-to-point (PPP) UART based driver"
	depends on NET_L2_PPP
	depends on NET_NATIVE
	select RING_BUFFER
	select CRC
	select UART_MUX if GSM_MUX

if NET_PPP

config NET_PPP_ASYNC_UART
	bool "Asynchronous UART API is used"
	depends on UART_ASYNC_API
	depends on !GSM_MUX

config NET_PPP_DRV_NAME
	string "PPP Driver name"
	default "ppp"
	help
	  This option sets the driver name

config NET_PPP_MTU_MRU
	int "PPP MTU and MRU"
	default 1500
	help
	  This options sets MTU and MRU for PPP link.

config NET_PPP_UART_BUF_LEN
	int "Buffer length when reading from UART"
	default 8
	help
	  This options sets the size of the UART buffer where data
	  is being read to.

config NET_PPP_RINGBUF_SIZE
	int "PPP ring buffer size"
	default 256
	help
	  PPP ring buffer size when passing data from RX ISR to worker
	  thread that will pass the data to IP stack.

config NET_PPP_RX_STACK_SIZE
	int "Size of the stack allocated for receiving data from modem"
	default 768
	help
	  Sets the stack size which will be used by the PPP RX workqueue.

config NET_PPP_RX_PRIORITY
	int "RX workqueue thread priority"
	default 7
	help
	  Sets the priority of the RX workqueue thread.

config NET_PPP_VERIFY_FCS
	bool "Verify that received FCS is valid"
	default y
	help
	  If you have a reliable link, then it might make sense
	  to disable this as it takes some time to verify the received
	  packet.

config NET_PPP_CAPTURE
	bool "Capture received PPP packets"
	depends on NET_CAPTURE_COOKED_MODE
	help
	  This enables PPP packet capture. One needs to configure the
	  packet capturing in core network stack to send the captured packets
	  to outside system. This requires a non-PPP network connection
	  where the captured packets are sent for processing. Note that you
	  cannot use the PPP connection to sending packets as that would
	  lead recursion.

config NET_PPP_CAPTURE_BUF_SIZE
	int "Capture buffer for storing full PPP packets"
	depends on NET_PPP_CAPTURE
	default 1500
	help
	  The captured PPP frames are temporarily stored into this buffer.

config PPP_MAC_ADDR
	string "MAC address for the interface"
	help
	  Specify a MAC address for the PPP interface in the form of
	  six hex 8-bit chars separated by colons (e.g.:
	  aa:33:cc:22:e2:c0).  The default is an empty string, which
	  means the code will make 00:00:5E:00:53:XX, where XX will be
	  random.

config PPP_CLIENT_CLIENTSERVER
	bool "Reply to the request CLIENT with CLIENTSERVER"
	help
	  This is only necessary if a ppp connection should be
	  established with a Microsoft Windows PC.

config PPP_NET_IF_NO_AUTO_START
	bool "Disable PPP interface auto-start"
	help
	  This option allows user to disable autostarting of the PPP interface
	  immediately after initialization.

if NET_PPP_ASYNC_UART

config NET_PPP_ASYNC_UART_TX_BUF_LEN
	int "Length of the UART TX buffer to which data is written."
	default 2048

config NET_PPP_ASYNC_UART_TX_TIMEOUT
	int "The timeout for UART transfers in milliseconds, or 0 for no timeout."
	default 0

config NET_PPP_ASYNC_UART_RX_RECOVERY_TIMEOUT
	int "UART RX recovery timeout in milliseconds"
	default 200
	help
	  The time that UART RX is in disabled state in case
	  when we cannot receive more data from UART.

config NET_PPP_ASYNC_UART_RX_ENABLE_TIMEOUT
	int "A timeout for uart_rx_enable() in milliseconds"
	default 100

endif # NET_PPP_ASYNC_UART

module = NET_PPP
module-dep = LOG
module-str = Log level for ppp driver
module-help = Sets log level for ppp driver.
source "subsys/net/Kconfig.template.log_config.net"

endif # NET_PPP

#
# SLIP options
#
menuconfig SLIP
	bool "SLIP driver" if !QEMU_TARGET
	depends on NET_NATIVE
	select UART_PIPE
	select UART_INTERRUPT_DRIVEN

if SLIP

config SLIP_DRV_NAME
	string "SLIP Driver name"
	default "slip"
	help
	  This option sets the driver name

module = SLIP
module-dep = LOG
module-str = Log level for slip driver
module-help = Sets log level for slip driver.
source "subsys/net/Kconfig.template.log_config.net"

config SLIP_STATISTICS
	bool "SLIP network connection statistics"
	help
	  This option enables statistics support for SLIP driver.

config SLIP_TAP
	bool "Use TAP interface to host"
	default y
	help
	  In TAP the Ethernet frames are transferred over SLIP.

config SLIP_MAC_ADDR
	string "MAC address for the interface"
	help
	  Specify a MAC address for the SLIP interface in the form of
	  six hex 8-bit chars separated by colons (e.g.:
	  aa:33:cc:22:e2:c0).  The default is an empty string, which
	  means the code will make 00:00:5E:00:53:XX, where XX will be
	  random.

endif

#
# Net loopback options
#
menuconfig NET_LOOPBACK
	bool "Net loopback driver"
	select NET_L2_DUMMY

if NET_LOOPBACK

config NET_LOOPBACK_SIMULATE_PACKET_DROP
	bool "Controlable packet drop"
	help
	  Enable interface to have a controlable packet drop rate, only for
	  testing, should not be enabled for normal applications

config NET_LOOPBACK_MTU
	int "MTU for loopback interface"
	default 576
	help
	  This option sets the MTU for loopback interface.

module = NET_LOOPBACK
module-dep = LOG
module-str = Log level for network loopback driver
module-help = Sets log level for network loopback driver.
source "subsys/net/Kconfig.template.log_config.net"

endif

#
# CAN bus network driver options
#
menuconfig NET_CANBUS
	bool "Controller Area Network (CAN) bus network driver"
	help
	  Enable the CAN bus network driver. This driver provides a network interface on top of the
	  CAN controller driver API.

if NET_CANBUS

module = NET_CANBUS
module-dep = LOG
module-str = Log level for CAN bus network driver
module-help = Sets log level CAN bus network driver.
source "subsys/net/Kconfig.template.log_config.net"

config NET_CANBUS_INIT_PRIORITY
	int "CAN bus network device init priority"
	default 81
	help
	  CAN bus network device initialization priority.

	  The priority needs to be lower than the network stack and higher than the CAN controller
	  driver.

endif # NET_CAN

#
# Native simulator offloaded sockets
#

menuconfig NET_NATIVE_OFFLOADED_SOCKETS
	bool "Native Simulator offloaded sockets"
	depends on ARCH_POSIX
	depends on NATIVE_LIBRARY
	depends on NET_SOCKETS_OFFLOAD
	help
	  Offloaded sockets for Native Simulator utilize host BSD sockets API (like socket(),
	  connect(), send(), recvfrom(), etc.) in order to provide networking capability.

	  This driver main advantage is that it is possible to use this driver without any
	  additional setup on the host side, unlike with the native TAP Ethernet driver.

if NET_NATIVE_OFFLOADED_SOCKETS

config NET_NATIVE_OFFLOADED_SOCKETS_EPOLL_WAIT_INTERVAL
	int "Interval between epoll_wait() calls (in simulated microseconds)"
	default 1000
	help
	  Number of simulated microseconds before next epoll_wait() call, when there were no pending
	  events detected.

	  Decrease that value when lower network traffic latency is expected, at the expense of more
	  CPU processing overhead.

endif # NET_NATIVE_OFFLOADED_SOCKETS

endif # NET_DRIVERS
```

## drivers/neural_net/Kconfig
```kconfig
# Kconfig - Neural network accelerator driver configuration options
#
# Copyright (c) 2018 Intel Corporation
#
# SPDX-License-Identifier: Apache-2.0
#

menuconfig NEURAL_NET_ACCEL
	bool "Neural Network Accelerator Drivers"
	help
	  Enable support for Neural Network Accelerators

if NEURAL_NET_ACCEL

module = NEURAL_NET
module-str = neural_net
source "subsys/logging/Kconfig.template.log_config"

source "drivers/neural_net/Kconfig.*"

endif # NEURAL_NET
```

## drivers/neural_net/Kconfig.intel_gna
```kconfig
# Neural network accelerator driver configuration options

# Copyright (c) 2018 Intel Corporation
# SPDX-License-Identifier: Apache-2.0

menuconfig INTEL_GNA
	bool "Intel GNA Inferencing Engine"
	help
	  Enable support for Intel's GMM and Neural Network Accelerator

if INTEL_GNA

config INTEL_GNA_INIT_PRIORITY
	int "Init priority"
	default 99
	help
	  Device driver initialization priority.

config INTEL_GNA_MAX_MODELS
	int "Max number of neural network models supported by driver"
	default 4
	help
	  Max. number of unique neural network models required in the system

config INTEL_GNA_MAX_PENDING_REQUESTS
	int "Max number of pending inference requests"
	default 4
	help
	  Maximum number of pending inference requests in the driver

config INTEL_GNA_POWER_MODE
	int "GNA operation mode"
	default 0
	range 0 3
	help
	  Sets GNA operation mode for power saving
	  Levels are:
	  0 ALWAYS_ON, GNA is always on with very minimal power save
	  1 CLOCK_GATED, GNA clock is gated when not active
	  2 POWER_GATED, GNA clock and power are gated when not active
	  3 ALWAYS_OFF, GNA is tuned off and never used in the system

endif # INTEL_GNA
```

## drivers/nfc/Kconfig.nrfxnfc
```kconfig
#
# Copyright (c) 2023 Sendrato
#
# SPDX-License-Identifier: Apache-2.0
#

config NFC_NRFX
	bool "nRFx-NFC driver"
	default n
	select NRFX_NFCT
	help
		Enable nRFx NFC driver.

if NFC_NRFX

config NFC_NRFX_DRV_NAME
	string "Device Tree name of nRFx-NFC driver"
	default "nRFxNFC"
	help
		Device Tree name of nRFx-NFC driver.

config NFC_NRFX_INIT_PRIORITY
	int "NFC_NRFX NFC driver init priority"
	default 75

config NFC_NRFX_MAX_PAYLOAD_SIZE
	int "Max payload in bytes"
	default 988

# KConfig used by nrfxlib-sdk too
config NFC_T2T_NRFXLIB
	bool "NFC Type 2 Tag library"

# KConfig used by nrfxlib-sdk too
config NFC_T4T_NRFXLIB
	bool "NFC Type 4 Tag library"

endif # NFC_NRFX
```

## drivers/nfc/Kconfig.nt3h2x11
```kconfig
#
# Copyright (c) 2023 Sendrato
#
# SPDX-License-Identifier: Apache-2.0
#

config NFC_NT3H2X11
	bool "NT3H2X11 NFC driver"
	default n
	depends on I2C
	help
	  Enable I2C-based driver for NT3H2X11 led driver.

if NFC_NT3H2X11

config NFC_NT3H2X11_2K
	bool "Use 2k memory map instead of 1k"
	default n
	help
	  Use 2k memory map instead of 1k

config NFC_NT3H2X11_MAX_WRITE_DELAY
	int "delay in ms"
	default 10
	help
	  Max I2C write delay in ms for when writing EEPROM

config NFC_NT3H2X11_INIT_PRIORITY
	int "NT3H2X11 NFC driver init priority"
	default 75

module = NT3H2X11
module-str = nt3h2x11
source "${ZEPHYR_BASE}/subsys/logging/Kconfig.template.log_config"

endif # NFC_NT3H2X11
```

## drivers/nfc/Kconfig.rc522
```kconfig
# Copyright (c) 2026 Luke Bugbee <lbugbee@protonmail.com>
# SPDX-License-Identifier: Apache-2.0

config RC522
	bool "RC522 RFID reader"
	default y
	help
	  Enable driver for RC522.
```

## drivers/nvmem/Kconfig
```kconfig
# Copyright 2025 NXP
# SPDX-License-Identifier: Apache-2.0

# Because CONFIG_NVMEM is used in nvmem subsystem,
# it is temporarily called CONFIG_NVMEM_MODEL
menuconfig NVMEM_MODEL
	bool "Non-Volatile Memory (NVMEM) Driver Support"
	help
	  Non-Volatile Memory (NVMEM) driver configuration options.

if NVMEM_MODEL

module = NVMEM_MODEL
module-str = nvmem_model
source "subsys/logging/Kconfig.template.log_config"

config NVMEM_MODEL_INIT_PRIORITY
	int "NVMEM init priority"
	default KERNEL_INIT_PRIORITY_DEVICE
	help
	  NVMEM device driver initialization priority.

rsource "Kconfig.nvmem_nxp_ocotp"
rsource "Kconfig.nvmem_lpc11u6x"

endif # NVMEM_MODEL
```

## drivers/nvmem/Kconfig.nvmem_bflb_efuse
```kconfig
# Copyright (c) 2024-2025 MASSDRIVER EI (massdriver.space)
# SPDX-License-Identifier: Apache-2.0

config NVMEM_BFLB_EFUSE
    bool "Bouffalolab EFUSEs as NVMEM (OTP) provider"
    default y
    depends on DT_HAS_BFLB_EFUSE_ENABLED
    help
      Enable Bouffalolab EFUSE region as an NVMEM provider.
```

## drivers/nvmem/Kconfig.nvmem_fm25xxx
```kconfig
# Copyright (c) 2025 Luna Pes <zephyr@orangemurker.com>
# SPDX-License-Identifier: Apache-2.0

config NVMEM_FM25XXX
	bool "Infineon FM25XXX SPI FRAM (NVMEM provider)"
	default y
	depends on DT_HAS_INFINEON_FM25XXX_ENABLED
	select SPI
	help
	  Enable Infineon FM25XXX SPI FRAM as an NVMEM provider.
```

## drivers/nvmem/Kconfig.nvmem_lpc11u6x
```kconfig
# Copyright (c) 2020 Seagate Technology LLC
# SPDX-License-Identifier: Apache-2.0

config NVMEM_LPC11U6X
	bool "LPC11U6x on-chip EEPROM (NVMEM provider)"
	default y
	depends on DT_HAS_NXP_LPC11U6X_EEPROM_ENABLED
	help
	  Enable the LPC11U6x on-chip EEPROM as an NVMEM provider device.
```
