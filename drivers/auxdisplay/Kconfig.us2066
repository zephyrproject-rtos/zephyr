## drivers/can/Kconfig.ti_k3_mcan
```kconfig
# Copyright (c) 2026 Texas Instruments
# SPDX-License-Identifier: Apache-2.0

config CAN_TI_K3_MCAN
	bool "TI M_CAN driver"
	default y
	depends on DT_HAS_TI_K3_MCAN_ENABLED
	depends on CLOCK_CONTROL
	select CAN_MCAN
	select PINCTRL
	help
	  Enable support for Texas Instruments MCAN controller.
```

## drivers/can/Kconfig.xlnx
```kconfig
# Xilinx Zynq-7000 PS CAN controller configuration options

# Copyright (c) 2022 Weidmueller Interface GmbH & Co. KG
# Copyright The Zephyr Project Contributors
# SPDX-License-Identifier: Apache-2.0

config CAN_XLNX
	bool "Xilinx Zynq-7000 PS CAN driver"
	default y
	depends on DT_HAS_XLNX_ZYNQ_CAN_1_0_ENABLED
	select PINCTRL
	help
	  Enable the driver for the CAN controllers in the processing system of
	  the Xilinx Zynq-7000 SoC.

config CAN_XLNX_MAX_FILTERS
	int "Maximum number of concurrent active RX filters"
	depends on CAN_XLNX
	default 16
	range 1 32
	help
	  The hardware acceptance filters are left disabled and received CAN
	  frames are filtered in software, so the number of RX filters is only
	  limited by this option.
```

## drivers/can/transceiver/Kconfig.tle927x
```kconfig
# SPDX-FileCopyrightText: Copyright (c) 2026 Deere & Company
# SPDX-FileCopyrightText: Copyright (c) 2026 Linumiz
# SPDX-License-Identifier: Apache-2.0

config CAN_TRANSCEIVER_TLE927X
	bool "Infineon TLE927x CAN transceiver driver"
	default y
	depends on DT_HAS_INFINEON_TLE927X_CAN_ENABLED
	select MFD
	help
	  Enable Infineon TLE927x CAN transceiver driver.

if CAN_TRANSCEIVER_TLE927X

config CAN_TRANSCEIVER_TLE927X_INIT_PRIORITY
	int "TLE927x CAN transceiver driver init priority"
	default 78
	help
	  Init priority for the TLE927x CAN transceiver driver. It must be
	  greater than MFD_TLE927X_INIT_PRIORITY and lower than
	  CAN_INIT_PRIORITY.

endif # CAN_TRANSCEIVER_TLE927X
```

## drivers/charger/Kconfig.bq24295
```kconfig
# Copyright 2026 Sacra Systems Private Limited
#
# SPDX-License-Identifier: Apache-2.0

config CHARGER_BQ24295
	bool "BQ24295 Battery Charger"
	default y
	depends on DT_HAS_TI_BQ24295_ENABLED
	select I2C
	help
	  Enable BQ24295 battery charger driver.
```

## drivers/charger/Kconfig.bq2429x
```kconfig
# Copyright 2026 Sacra Systems Private Limited
#
# SPDX-License-Identifier: Apache-2.0

config CHARGER_BQ2429X
	bool "BQ2429X Battery Charger"
	default y
	depends on DT_HAS_TI_BQ24295_ENABLED || \
		DT_HAS_TI_BQ24296_ENABLED || \
		DT_HAS_TI_BQ24296M_ENABLED || \
		DT_HAS_TI_BQ24297_ENABLED || \
		DT_HAS_TI_BQ24298_ENABLED
	select I2C
	help
	  Enable the TI BQ2429X battery charger driver.

	  Supported devices include:
	    - BQ24295
	    - BQ24296
	    - BQ24296M
	    - BQ24297
	    - BQ24298
```

## drivers/charger/Kconfig.bq25620
```kconfig
# Copyright (c) 2026 Testo SE & Co. KGaA
# SPDX-License-Identifier: Apache-2.0

config CHARGER_BQ25620
	bool "TI BQ25620 battery charger driver"
	default y
	depends on DT_HAS_TI_BQ25620_CHARGER_ENABLED
	select I2C
	select MFD
	help
	  Enable the TI BQ25620 battery charger driver.
```

## drivers/charger/Kconfig.bq2589x
```kconfig
# SPDX-FileCopyrightText: Copyright The Zephyr Project Contributors
# SPDX-License-Identifier: Apache-2.0

config CHARGER_BQ2589X
	bool "BQ2589X battery charger"
	default y
	depends on DT_HAS_TI_BQ25896_ENABLED || DT_HAS_SILERGY_SY6970_ENABLED
	select I2C
	help
	  Enable the driver for the TI BQ2589X family of single cell switching
	  battery chargers.

	  Supported devices include:
	    - BQ25896
	    - SY6970
```

## drivers/charger/Kconfig.max20356
```kconfig
# Copyright (c) 2026 Analog Devices, Inc.
# SPDX-License-Identifier: Apache-2.0

config CHARGER_MAX20356
	bool "MAX20356/MAX20358 battery charger driver"
	default y
	depends on DT_HAS_ADI_MAX20356_CHARGER_ENABLED
	select MFD
	help
	  Enable the Analog Devices MAX20356/MAX20358 battery charger child
	  driver.

if CHARGER_MAX20356

config CHARGER_MAX20356_INIT_PRIORITY
	int "MAX20356 charger init priority"
	default 90
	help
	  Init priority for the MAX20356/MAX20358 charger child. Must be greater
	  than CONFIG_MFD_INIT_PRIORITY so the parent (and its INTB trigger) is
	  initialized first.

endif # CHARGER_MAX20356
```

## drivers/clock_control/Kconfig.abov32
```kconfig
# Copyright (c) 2026 ABOV Semiconductor Co., Ltd.
# SPDX-License-Identifier: Apache-2.0

config CLOCK_CONTROL_ABOV32
	bool "ABOV32 clock control driver"
	default y
	depends on DT_HAS_ABOV_ABOV32_CCTL_ENABLED
	help
	  Enable driver for ABOV System Control Clock Unit.
```
