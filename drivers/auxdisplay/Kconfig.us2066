## drivers/auxdisplay/Kconfig.us2066
```kconfig
# Copyright (c) 2026 Jasper Jonker
# SPDX-License-Identifier: Apache-2.0

config AUXDISPLAY_US2066
	bool "Newhaven Display US2066 LCD driver"
	default y
	select GPIO
	select I2C if DT_HAS_NEWHAVEN_US2066_I2C_ENABLED
	select SPI if DT_HAS_NEWHAVEN_US2066_SPI_ENABLED
	depends on DT_HAS_NEWHAVEN_US2066_I2C_ENABLED || DT_HAS_NEWHAVEN_US2066_SPI_ENABLED
	help
	  Enable driver for Newhaven Display US2066 character LCDs.
```

## drivers/basic_radio/Kconfig
```kconfig
# Copyright (c) 2026 Texas Instruments Incorporated
# SPDX-License-Identifier: Apache-2.0

menuconfig BASIC_RADIO
	bool "Basic Radio Drivers [EXPERIMENTAL]"
	select EXPERIMENTAL
	select POLL
	help
	  Vendor-agnostic API for basic radio commands

if BASIC_RADIO

module = BASIC_RADIO
module-str = basic_radio
source "subsys/logging/Kconfig.template.log_config"

config BASIC_RADIO_INIT_PRIORITY
	int "basic_radio initialization priority"
	default 90
	help
	  POST_KERNEL init priority for basic_radio drivers. Must be higher
	  than the priority of any underlying vendor HAL init.

config BASIC_RADIO_MAX_PACKET_LEN
	int "Maximum payload length"
	range 1 255
	default 255
	help
	  Largest payload in bytes any PHY of the radio can send or receive.

config BASIC_RADIO_RX_BUFFER_COUNT
	int "Number of RX buffers"
	range 1 16
	default 3
	help
	  Number of RX buffers preallocated by the backend.

config BASIC_RADIO_TX_BUFFER_COUNT
	int "Number of TX buffers"
	range 1 16
	default 4
	help
	  Depth of the backend's TX buffer pool. More buffers allow
	  back-to-back submits without waiting for the previous TX to finish.

rsource "backends/ti_cc23x0/Kconfig"
# add here more "backends/..."

endif # BASIC_RADIO
```

## drivers/basic_radio/backends/ti/cc23x0/Kconfig
```kconfig
# Copyright (c) 2026 Texas Instruments Incorporated
# SPDX-License-Identifier: Apache-2.0

config BASIC_RADIO_CC23X0
	bool "TI CC23x0 RCL backend"
	default y
	depends on DT_HAS_TI_CC23X0_BASIC_RADIO_ENABLED
	depends on SOC_SERIES_CC23X0
	select SIMPLELINK_F3_RADIO_DRIVER
	select SIMPLELINK_F3_RADIO_PHYS
	select PM
	help
	  Backend for TI CC23x0 SimpleLink SoCs.

if BASIC_RADIO_CC23X0

config BASIC_RADIO_CC23X0_RX_BUFFER_SIZE
	int "RX MultiBuffer size in bytes"
	default 512
	help
	  Size of each RCL MultiBuffer used for RX. One buffer can hold
	  several received packets.

config BASIC_RADIO_CC23X0_MAX_HDR_LEN
	int "Maximum frame header length in bytes"
	range 1 4
	default 2
	help
	  Largest frame header, up to and including the length field, of any
	  PHY passed to basic_radio_config(). TX buffers are sized for it.
	  basic_radio_config() rejects a PHY with a longer header.

# Certified boot PHYs depend on the SoCs whose catalog defines them
# (basic_radio_cc23x0_phy_catalog_<soc>.c). A new device adds its SoC
# symbol to the "depends on" of each PHY it supports, and a new PHY gets
# an option here plus a branch in the BOOT_PHY selection of
# basic_radio_cc23x0.c. CUSTOM and NONE are available on every device.
choice BASIC_RADIO_CC23X0_BOOT_PHY
	prompt "Boot PHY"
	default BASIC_RADIO_CC23X0_BOOT_PHY_BLE5_1M if SOC_CC2340R5
	default BASIC_RADIO_CC23X0_BOOT_PHY_NONE
	help
	  PHY selected at init. basic_radio_config() with a NULL phy keeps it
	  and only applies the runtime parameters.

config BASIC_RADIO_CC23X0_BOOT_PHY_BLE5_1M
	bool "BLE 5 generic, 1 Mbps"
	depends on SOC_CC2340R5

config BASIC_RADIO_CC23X0_BOOT_PHY_BLE5_2M
	bool "BLE 5 generic, 2 Mbps"
	depends on SOC_CC2340R5

config BASIC_RADIO_CC23X0_BOOT_PHY_BLE5_CODED
	bool "BLE 5 generic, LE Coded"
	depends on SOC_CC2340R5

config BASIC_RADIO_CC23X0_BOOT_PHY_IEEE_802_15_4
	bool "IEEE 802.15.4 generic, 250 kbps O-QPSK"
	depends on SOC_CC2340R5

config BASIC_RADIO_CC23X0_BOOT_PHY_PROP_250KBPS_MSK_FEC
	bool "Proprietary, 250 kbps MSK, FEC"
	depends on SOC_CC2340R5

config BASIC_RADIO_CC23X0_BOOT_PHY_PROP_2MBPS_320KHZ_GFSK
	bool "Proprietary, 2 Mbps GFSK, 320 kHz deviation"
	depends on SOC_CC2340R5

config BASIC_RADIO_CC23X0_BOOT_PHY_CUSTOM
	bool "Custom"
	help
	  SmartRF Studio export added by the application with
	  target_sources(app PRIVATE rcl_settings_<n>.c). The export must
	  keep its default LRF_config name and use the generic PBE image.

config BASIC_RADIO_CC23X0_BOOT_PHY_NONE
	bool "None"
	help
	  No PHY at init. The application passes a PHY object, certified or
	  custom (see <zephyr/drivers/basic_radio/ti/cc23x0.h>), to
	  basic_radio_config() before the first send() or recv().

endchoice

config BASIC_RADIO_CC23X0_CUSTOM_PHY_FEATURES
	hex "Custom PHY phyFeatures"
	default 0x0
	range 0x0 0xffff
	depends on BASIC_RADIO_CC23X0_BOOT_PHY_CUSTOM
	help
	  Sub-PHY selection of the custom export, one of the
	  RCL_PHY_FEATURE_* values in its header. 0x0 for exports without
	  sub-PHYs.

endif # BASIC_RADIO_CC23X0
```

## drivers/basic_radio/backends/ti_cc23x0/Kconfig
```kconfig
# Copyright (c) 2026 Texas Instruments Incorporated
# SPDX-License-Identifier: Apache-2.0

config BASIC_RADIO_CC23X0
	bool "TI CC23x0 RCL backend"
	default y
	depends on DT_HAS_BASIC_RADIO_BASE_ENABLED
	depends on SOC_SERIES_CC23X0
	select SIMPLELINK_F3_RADIO_DRIVER
	select SIMPLELINK_F3_RADIO_PHYS
	select PM
	help
	  Backend for TI CC23x0 SimpleLink SoCs.

config BASIC_RADIO_CC23X0_RX_BUFFER_SIZE
	int "RX MultiBuffer size in bytes"
	depends on BASIC_RADIO_CC23X0
	default 512
	help
	  Size of each RCL MultiBuffer used for RX. One buffer can hold
	  several received packets.
	  
```

## drivers/biometrics/Kconfig.ai10
```kconfig
# Copyright (c) 2026 Siratul Islam
# SPDX-License-Identifier: Apache-2.0

config BIOMETRICS_AI10
	bool "AI-10 biometrics driver"
	default y
	depends on DT_HAS_HILINK_AI10_ENABLED
	select SERIAL
	select UART_INTERRUPT_DRIVEN
	help
	  Enable the Hi-Link AI-10 face and palm recognition module.
	  Supports device-managed enrollment and continuous identification.

if BIOMETRICS_AI10

config BIOMETRICS_AI10_STACK_SIZE
	int "Worker thread stack size"
	default 2048
	range 1024 65536
	help
	  Stack size for protocol processing and application event callbacks.

config BIOMETRICS_AI10_THREAD_PRIORITY
	int "Worker thread priority"
	default 5
	range 0 15
	help
	  Preemptible priority of the protocol and event callback thread.

endif # BIOMETRICS_AI10
```

## drivers/biometrics/Kconfig.sen0359
```kconfig
# SPDX-FileCopyrightText: Copyright The Zephyr Project Contributors
# SPDX-License-Identifier: Apache-2.0

config BIOMETRICS_SEN0359
	bool "DFRobot SEN0359 capacitive fingerprint sensor"
	default y
	depends on DT_HAS_DFROBOT_SEN0359_ENABLED
	select I2C
	help
	  Enable driver for the DFRobot SEN0359 (ID809) I2C capacitive
	  fingerprint sensor.
```

## drivers/bluetooth/hci/Kconfig.stm32
```kconfig
# Copyright (c) 2025 STMicroelectronics
#
# SPDX-License-Identifier: Apache-2.0

menu "STM32WBA Bluetooth configuration"
	depends on BT_STM32WBA

config BT_STM32WBA_USE_TEMP_BASED_CALIB
	bool "STM32WBA Radio calibration based on temperature sensor"
	default y
	select SENSOR
	select STM32_TEMP
	help
	  Allows the linklayer to calibrate itself on the current temperature read on the ADC4

choice BT_STM32WBA_LIB_CONFIG
	prompt "STM32WBA Bluetooth library configuration"
	default BT_STM32WBA_FULL_LIB if \
		BT_PER_ADV || BT_PER_ADV_SYNC || BT_SCA_UPDATE || BT_DF_CTE_RX_AOA \
		|| BT_CTLR_DF_ANT_SWITCH_RX || BT_CTLR_DF_ANT_SWITCH_TX || BT_DF_CTE_TX_AOD \
		|| BT_PER_ADV_SYNC_TRANSFER_RECEIVER || BT_PER_ADV_SYNC_TRANSFER_SENDER \
		|| BT_CTLR_SYNC_PERIODIC || BT_ISO_UNICAST || BT_ISO_BROADCASTER \
		|| BT_ISO_SYNC_RECEIVER || BT_CTLR_ADV_PERIODIC_ADI_SUPPORT \
		|| BT_EXT_ADV_CODING_SELECTION
	default BT_STM32WBA_BASIC_PLUS_LIB if \
		BT_EXT_ADV || BT_TRANSMIT_POWER_CONTROL || BT_SUBRATING
	default BT_STM32WBA_BASIC_LIB
	help
	  Sets the library configuration according to the required Bluetooth features.

config BT_STM32WBA_BASIC_LIB
	bool "STM32WBA Bluetooth library basic configuration"
	help
	  Embed basic Bluetooth features support in STM32WBA:
	  Advertising, Scanning, Connection Peripheral and Central, Privacy,
	  Channel Selection Algorithm #2, Data Length Extension, LE Encryption,
	  Legacy Pairing, LE secure connections, LE 2Mbit PHY, LE Coded PHY.

config BT_STM32WBA_BASIC_PLUS_LIB
	bool "STM32WBA Bluetooth library basic plus configuration"
	help
	  Embed basic Plus Bluetooth features support in STM32WBA:
	  Advertising, Scanning, Connection Peripheral and Central, Privacy,
	  Channel Selection Algorithm #2, Data Length Extension, LE Encryption,
	  Legacy Pairing, LE secure connections, LE 2Mbit PHY, LE Coded PHY,
	  Extended Advertising, LE Power Control, Connection Subrating.

config BT_STM32WBA_FULL_LIB
	bool "STM32WBA Bluetooth library full configuration"
	help
	  Embed full Bluetooth features support in STM32WBA.

endchoice

endmenu

config BT_STM32_IPM
	bool
	default y
	depends on DT_HAS_ST_STM32WB_RF_ENABLED
	select USE_STM32_HAL_CORTEX
	select HAS_STM32LIB
	select BT_HCI_SETUP
	help
	  STM32WB HCI driver using the shared memory transport between
	  CPU1 and the wireless coprocessor on CPU2.

config BT_STM32_IPM_FW_INFO_CHECK
	bool "STM32WB wireless firmware runtime check"
	default y
	depends on BT_STM32_IPM
	select LOG
	help
	  Validate at runtime that the STM32WB wireless stack running on CPU2
	  matches the expected stack type and version used by the driver.

config BT_STM32_IPM_FW_CHECK_STRICT
	bool "Fail initialization on STM32WB wireless firmware mismatch"
	default y
	depends on BT_STM32_IPM_FW_INFO_CHECK
	help
	  If enabled, Bluetooth initialization fails when the detected CPU2
	  wireless firmware stack type or version does not match expectations.
	  If disabled, mismatches are logged as warnings and initialization
	  continues.

if BT_STM32_IPM_FW_INFO_CHECK

config BT_FW_EXPECTED_VERSION_MAJOR
	int "Expected STM32WB wireless firmware major version"
	help
	  Expected STM32WB wireless firmware major version.

config BT_FW_EXPECTED_VERSION_MINOR
	int "Expected STM32WB wireless firmware minor version"
	help
	  Expected STM32WB wireless firmware minor version.

config BT_FW_EXPECTED_VERSION_SUB
	int "Expected STM32WB wireless firmware sub version"
	help
	  Expected STM32WB wireless firmware sub version.

endif # BT_STM32_IPM_FW_INFO_CHECK
```

## drivers/board_id/Kconfig
```kconfig
# SPDX-License-Identifier: Apache-2.0
# Copyright (c) 2026 The Zephyr Project Contributors
# Copyright (c) 2026 Dev It Wise

menuconfig BOARD_ID
	bool "Board identity drivers"
	help
	  Enable board identity / revision detection drivers. These drivers
	  read a raw identity value encoded on the board itself (strap pins,
	  an EEPROM word, ...) so one firmware image can recognize which
	  hardware revision it is running on at runtime.

if BOARD_ID

module = BOARD_ID
module-str = board_id
source "subsys/logging/Kconfig.template.log_config"

config BOARD_ID_INIT_PRIORITY
	int "Board-id driver init priority"
	default 90
	help
	  Board-id driver initialization priority. Defaults after
	  GPIO_INIT_PRIORITY so a GPIO-backed board-id device can initialize
	  after its GPIO controller, and before APPLICATION so an application
	  init hook can gate on the board identity.

config BOARD_ID_GPIO
	bool "GPIO strap board-id driver"
	default y
	depends on DT_HAS_ZEPHYR_BOARD_ID_GPIO_ENABLED
	select GPIO
	help
	  Board-id backend that reads the identity value from a set of GPIO
	  strap pins.

endif # BOARD_ID
```

## drivers/cache/Kconfig.aspeed
```kconfig
# SPDX-License-Identifier: Apache-2.0
#
# Copyright (c) 2022 ASPEED Technology Inc.

config CACHE_ASPEED
bool "ASPEED external cache driver"
	depends on SOC_SERIES_AST10X0
	depends on SYSCON
	select CACHE_HAS_DRIVER
	select DCACHE_LINE_SIZE_DETECT_SUPPORT
	select ICACHE_LINE_SIZE_DETECT_SUPPORT
	help
	  This option enables the CACHE driver for ASPEED AST10X0 series SOC.
```

## drivers/cache/Kconfig.nxp_llc
```kconfig
# SPDX-FileCopyrightText: Copyright 2026 NXP
#
# SPDX-License-Identifier: Apache-2.0

config CACHE_NXP_LLC
	bool "NXP CodaCache last-level cache driver"
	default y
	depends on DT_HAS_NXP_LLC_ENABLED
	depends on EXTERNAL_CACHE
	select CACHE_HAS_DRIVER
	help
	  Enable the NXP CodaCache last-level cache (LLC) backend. This single
	  drivers/cache backend serves BOTH cache levels behind Zephyr's
	  level-less cache API: the CPU L1 (through the CMSIS SCB helpers) and
	  the CodaCache LLC in front of the external-memory windows. Selecting
	  EXTERNAL_CACHE removes the arch Cortex-M L1 backend
	  (arch/arm/core/cortex_m/cache.c, gated on ARCH_CACHE) from the build,
	  so this driver must cover both levels.

	  DMA buffers must not be placed in the LLC-cached aliases. See the
	  placement rule and its reasons in drivers/cache/cache_nxp_llc.c.
```

## drivers/cache/Kconfig.sam_cmcc
```kconfig
# SPDX-FileCopyrightText: Copyright (c) 2026 Basalte bv
# SPDX-License-Identifier: Apache-2.0

config CACHE_SAM_CMCC
	bool "Atmel SAM Cortex-M Cache Controller (CMCC) driver"
	default y
	depends on SOC_ATMEL_SAM_HAS_CMCC
	select CACHE_HAS_DRIVER
	help
	  Driver for the CMCC of the Atmel SAM4S and SAM4E, which caches the
	  internal flash on the code bus. It is managed as the i-cache.
```

## drivers/can/Kconfig.ameba
```kconfig
# Copyright (c) 2025 Realtek Semiconductor Corp.
# SPDX-License-Identifier: Apache-2.0

# Realtek AMEBA CAN configuration options
config CAN_AMEBA_CAN
	bool "Realtek CAN driver"
	default y
	depends on DT_HAS_REALTEK_AMEBA_CAN_ENABLED
	select PINCTRL
	help
	  This enables support for the Realtek Controller Area Network  (CAN)
	  driver.

if CAN_AMEBA_CAN

config CAN_AMEBA_MAX_FILTERS
	int "Maximum number of concurrent active RX filters"
	default 16
	range 1 32
	help
	  The Realtek Ameba CAN driver filters received CAN frames in software.
	  This defines the size of the RX filter array.

endif # CAN_AMEBA_CAN
```

## drivers/can/Kconfig.infineon_aurix
```kconfig
# SPDX-FileCopyrightText: Copyright (c) 2024 Infineon Technologies AG,
# SPDX-FileCopyrightText: or an affiliate of Infineon Technologies AG. All rights reserved.
# SPDX-FileCopyrightText: Copyright (c) 2026 Linumiz
#
# SPDX-License-Identifier: Apache-2.0

config CAN_INFINEON_AURIX
	bool "Infineon AURIX MCMCAN driver"
	default y
	depends on DT_HAS_INFINEON_AURIX_MCMCAN_NODE_ENABLED
	select CAN_MCAN
	select CLOCK_CONTROL
	select PINCTRL
	help
	  Enable the driver for the M_CAN nodes of the MCMCAN module of
	  Infineon AURIX TC3x and TC4x devices.
```

## drivers/can/Kconfig.mcan
```kconfig
# Bosch M_CAN configuration options

# Copyright (c) 2020 Alexander Wachter
# SPDX-License-Identifier: Apache-2.0

config CAN_MCAN
	bool
	help
	  Enable the Bosch M_CAN CAN IP module driver backend.

config CAN_MCAN_FIXED_MRAM_LAYOUT
	bool # hidden
	help
	  Always use 64 bytes deep RX/TX buffer elements regardless of whether CONFIG_CAN_FD_MODE is
	  enabled.

	  Drivers for Bosch M_CAN IP instances using fixed Message RAM layout (without TXESC/RXESC
	  registers) must select this.
```

## drivers/can/Kconfig.mchp
```kconfig
# Microchip M_CAN G1 configuration options

# SPDX-FileCopyrightText: Copyright The Zephyr Project Contributors
# SPDX-License-Identifier: Apache-2.0

config CAN_MCHP_MCAN_G1
	bool "Microchip M_CAN G1 driver"
	default y
	depends on DT_HAS_MICROCHIP_MCAN_G1_ENABLED
	depends on CLOCK_CONTROL
	select CAN_MCAN
	select PINCTRL
	help
	  Enable the Microchip M_CAN G1 CAN FD front end.
```

## drivers/can/Kconfig.ti_cc35xx_can
```kconfig
# Copyright (c) 2026 Conclusive Engineering Sp. z o.o.
# SPDX-License-Identifier: Apache-2.0

config CAN_TI_CC35XX
	bool "TI CC35XX CAN controller driver"
	default y
	depends on DT_HAS_TI_CC35XX_CAN_ENABLED
	select CAN_MCAN
	depends on !CAN_FD_MODE
	help
	  Enable TI CC35XX CAN controller.
```
