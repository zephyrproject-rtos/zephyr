## drivers/auxdisplay/Kconfig.nhd_k3z
```kconfig
# SPDX-FileCopyrightText: Copyright The Zephyr Project Contributors
# SPDX-License-Identifier: Apache-2.0

config AUXDISPLAY_NHD_K3Z
	bool "Newhaven NHD K3Z serial OLED display driver"
	default y
	depends on DT_HAS_NEWHAVEN_NHD_K3Z_ENABLED
	select I2C if $(dt_compat_on_bus,$(DT_COMPAT_NEWHAVEN_NHD_K3Z),i2c)
	select SPI if $(dt_compat_on_bus,$(DT_COMPAT_NEWHAVEN_NHD_K3Z),spi)
	select SERIAL if $(dt_compat_on_bus,$(DT_COMPAT_NEWHAVEN_NHD_K3Z),uart)
	help
	  Enable driver for Newhaven NHD K3Z family character OLED modules.
```

## drivers/auxdisplay/Kconfig.nxp_slcd
```kconfig
# Copyright 2026 NXP
# SPDX-License-Identifier: Apache-2.0

config AUXDISPLAY_NXP_SLCD
	bool "NXP MCUX SLCD display driver"
	default y
	depends on DT_HAS_NXP_SLCD_ENABLED
	help
	  Enable NXP MCUX SLCD (Segmented LCD) auxdisplay driver.
	  Provides the standard auxdisplay API for NXP MCX SLCD hardware,
	  handling both hardware initialization and the display panel layer
	  in a single unified driver.
```

## drivers/auxdisplay/Kconfig.pt6314
```kconfig
# Copyright (c) 2023 Chen Xingyu <hi@xingrz.me>
# SPDX-License-Identifier: Apache-2.0

config AUXDISPLAY_PT6314
	bool "PTC PT6314 dot character VFD driver"
	default y
	select SPI
	depends on DT_HAS_PTC_PT6314_ENABLED
	help
	  Enable driver for PTC PT6314.
```

## drivers/auxdisplay/Kconfig.serlcd
```kconfig
# Copyright (c) 2023 Jan Henke <Jan.Henke@taujhe.de>
# SPDX-License-Identifier: Apache-2.0

config AUXDISPLAY_SERLCD
	bool "SparkFun SerLCD dot character LCD driver"
	default y
	select I2C
	depends on DT_HAS_SPARKFUN_SERLCD_ENABLED
	help
	  Enable driver for SparkFun SerLCD.
```

## drivers/auxdisplay/Kconfig.slcd_7segment
```kconfig
# Copyright 2026 NXP
# SPDX-License-Identifier: Apache-2.0

config AUXDISPLAY_SLCD_7SEGMENT
	bool "Common 7-Segment SLCD Display Panel"
	default y
	depends on DT_HAS_SLCD_7SEGMENT_ENABLED 
	select SLCD
```

## drivers/auxdisplay/Kconfig.tm1637
```kconfig
# Copyright (c) 2025 Siratul Islam
# SPDX-License-Identifier: Apache-2.0

config AUXDISPLAY_TM1637
	bool "Titan Micro TM1637 7-segment display support"
	default y
	select GPIO
	depends on DT_HAS_TITANMEC_TM1637_ENABLED
	help
	  Enable driver for TM (Shenzhen Titan Micro Elec) TM1637 7-segment LED display.
	  This driver supports 4-digit 7-segment displays commonly found in clock modules
	  and simple numeric displays.

	  The TM1637 uses a two-wire serial interface (CLK and DIO) and can control up to
	  4 digits with brightness control.

	  This driver implements the auxdisplay API, allowing generic display usage.
	  Helper APIs for direct number display are also available.
```

## drivers/battery/Kconfig
```kconfig
# Copyright 2022 Google LLC
#
# SPDX-License-Identifier: Apache-2.0

menuconfig BATTERY
	bool "Battery drivers"
	help
	  Enable battery driver configuration.

if BATTERY

module = BATTERY
module-str = battery
source "subsys/logging/Kconfig.template.log_config"

source "drivers/battery/sbs_gauge/Kconfig"

endif # BATTERY
```

## drivers/bbram/Kconfig
```kconfig
# Copyright (c) 2021 Google Inc
# SPDX-License-Identifier: Apache-2.0

menuconfig BBRAM
	bool "Battery-backed RAM (BBRAM) drivers"
	help
	  Enable BBRAM (battery-backed RAM) driver configuration.

if BBRAM

module = BBRAM
module-str = bbram
source "subsys/logging/Kconfig.template.log_config"

config BBRAM_SHELL
	bool "Battery-backed RAM shell"
	depends on SHELL
	help
	  Enable the BBRAM shell with read and write commands.

config BBRAM_INIT_PRIORITY
	int "Init priority"
	# In STM32, BBRAM is a part of RTC. In this case init priority must be
	# lower than COUNTER_INIT_PRIORITY.
	default 65 if BBRAM_STM32
	# MCP7940N is an I2C device, therefore the init priority must be
	# greater than I2C_INIT_PRIORITY.
	default 55 if BBRAM_MICROCHIP_MCP7940N
	default 10
	help
	  BBRAM driver initialization priority

source "drivers/bbram/Kconfig.npcx"

source "drivers/bbram/Kconfig.it8xxx2"

source "drivers/bbram/Kconfig.bbram_emul"

source "drivers/bbram/Kconfig.microchip"

source "drivers/bbram/Kconfig.xec"

source "drivers/bbram/Kconfig.stm32"

source "drivers/bbram/Kconfig.rts5912"

source "drivers/bbram/Kconfig.mc146818"

endif # BBRAM
```

## drivers/bbram/Kconfig.bbram_emul
```kconfig
# Copyright (c) 2021 Google Inc
# SPDX-License-Identifier: Apache-2.0

config BBRAM_EMUL
	bool "Battery-backed RAM emulated drivers"
	default y
	depends on DT_HAS_ZEPHYR_BBRAM_EMUL_ENABLED
	help
	  This option enables the BBRAM emulation driver.
```

## drivers/bbram/Kconfig.ene
```kconfig
# Copyright (c) 2024 ENE Technology Inc.
# SPDX-License-Identifier: Apache-2.0

config BBRAM_ENE_KB1200
	bool "ENE KB1200 BBRAM Driver"
	default y
	depends on DT_HAS_ENE_KB1200_BBRAM_ENABLED
	help
	  Enable support for the KB1200 battery backed RAM.
```

## drivers/bbram/Kconfig.it8xxx2
```kconfig
# Copyright (c) 2021 Google Inc
# SPDX-License-Identifier: Apache-2.0

config BBRAM_IT8XXX2
	bool "ITE IT81202 Battery-backed RAM drivers"
	default y
	depends on DT_HAS_ITE_IT8XXX2_BBRAM_ENABLED
	help
	  This option enables the BBRAM driver for RISCV_ITE family of
	  processors.

config BBRAM_IT8XXX2_EMUL
	bool "Emulator for the ITE IT81202 BBRAM driver"
	default y
	depends on BBRAM_IT8XXX2
	depends on EMUL
	help
	  Enable the emulator for the ITE IT81202 BBRAM.
```

## drivers/bbram/Kconfig.kb1200
```kconfig
# BBRAM configuration options

# Copyright (c) 2023 ENE Technology Inc.


config BBRAM_KB1200
	bool "ENE KB1200 BBRAM Driver"
	depends on SOC_ENE_KB1200
	help
	  Enable support for the KB1200 battery backed RAM.

if BBRAM_KB1200

config BBRAM_INIT_PRIORITY
	int "Init priority"
	default 10
	help
	  BBRAM driver initialization priority

endif # BBRAM_KB1200
```

## drivers/bbram/Kconfig.mc146818
```kconfig
# Intel SoC BBRAM configuration options

# Copyright (c) 2025 Intel Corporation
# SPDX-License-Identifier: Apache-2.0

config BBRAM_MOTOROLA_MC146818
	bool "BBRAM driver for x86 CMOS/RTC clock's bbram"
	default y if !COUNTER
	select MFD
	depends on DT_HAS_MOTOROLA_MC146818_BBRAM_ENABLED
	help
	  Enable driver for Motorola mc146818 BBRAM.
```

## drivers/bbram/Kconfig.microchip
```kconfig
# Copyright (c) 2023 Nordic Semiconductor ASA
# SPDX-License-Identifier: Apache-2.0

config BBRAM_MICROCHIP_MCP7940N
	bool "Microchip MCP7940N SRAM BBRAM driver"
	default y
	depends on DT_HAS_MICROCHIP_MCP7940N_ENABLED
	select I2C
	help
	  Enable driver for Microchip MCP7940N SRAM based battery-backed RAM.

config BBRAM_MICROCHIP_MCP7940N_EMUL
	bool "Emulator for the Microchip MCP7940N SRAM BBRAM driver"
	default y
	depends on BBRAM_MICROCHIP_MCP7940N
	depends on EMUL
	help
	  Enable the emulator for the Microchip MCP7940N SRAM based
	  battery-backed RAM.
```

## drivers/bbram/Kconfig.nct
```kconfig
# Copyright (c) 2021 Google Inc
# SPDX-License-Identifier: Apache-2.0

config BBRAM_NCT
	bool "Nuvoton NCT Battery-backed RAM drivers"
	default y
	depends on DT_HAS_NUVOTON_NCT_BBRAM_ENABLED
	help
	  This option enables the BBRAM driver for NCT family of processors.
```

## drivers/bbram/Kconfig.npcx
```kconfig
# Copyright (c) 2021 Google Inc
# SPDX-License-Identifier: Apache-2.0

config BBRAM_NPCX
	bool "Nuvoton NPCX embedded controller (EC) Battery-backed RAM drivers"
	default y
	depends on DT_HAS_NUVOTON_NPCX_BBRAM_ENABLED
	help
	  This option enables the BBRAM driver for NPCX family of processors.

config BBRAM_NPCX_EMUL
	bool "Emulator for the NPCX BBRAM driver"
	default y
	depends on BBRAM_NPCX
	depends on EMUL
	help
	  Enable the emulator for the NPCX BBRAM.

config BBRAM_NPCX_STATUS_REG_WRITE_WORKAROUND
	bool
	default y if SOC_SERIES_NPCX4
	help
	  Workaround the issue documented in NPCX49nF errata rev1_5, No.2.30.
	  A write operation to the BKUP_STS register might disable write to all
	  the Battery-Backed RAM. The workaround is to read the BKUP_STS
	  register after every write to this register.
```

## drivers/bbram/Kconfig.nxp
```kconfig
# SPDX-FileCopyrightText: 2026 Basalte bv
# SPDX-License-Identifier: Apache-2.0

config BBRAM_NXP_IMX_SNVS_GPR
	bool "NXP i.MX SNVS General Purpose Registers BBRAM driver"
	default y
	depends on DT_HAS_NXP_IMX_SNVS_GPR_ENABLED
	help
	  Enable a BBRAM driver backed by the NXP i.MX SNVS Low-Power
	  General Purpose Registers. The bank's base address and size are
	  obtained from the MCUX HAL SNVS_Type definition for the active SoC.
```

## drivers/bbram/Kconfig.retained_mem
```kconfig
# Copyright (c) 2026 Google Inc
# SPDX-License-Identifier: Apache-2.0

config BBRAM_RETAINED_MEM
	bool "Battery-backed RAM driver based on retained memmory"
	default y
	depends on DT_HAS_ZEPHYR_BBRAM_RETAINED_MEM_ENABLED
	select RETAINED_MEM
	help
	  This option enables the BBRAM driver that uses retained memory
	  feature. The retained memory doesn't have additional source of
	  power so it works as BBRAM without Battery-backed voltage.
```

## drivers/bbram/Kconfig.rts5912
```kconfig
# Copyright (c) 2025, Realtek, SIBG-SD7
# SPDX-License-Identifier: Apache-2.0

config BBRAM_RTS5912
	bool "Realtek RTS5912 Battery-backed RAM drivers"
	default y
	depends on DT_HAS_REALTEK_RTS5912_BBRAM_ENABLED
	help
	  This option enables the BBRAM driver for Realtek RTS5912 of processors.
```

## drivers/bbram/Kconfig.stm32
```kconfig
# Copyright (c) 2022 Google Inc
# SPDX-License-Identifier: Apache-2.0

config BBRAM_STM32
	bool "ST STM32 Battery-backed RAM drivers"
	default y
	depends on DT_HAS_ST_STM32_BBRAM_ENABLED
	depends on COUNTER_RTC_STM32 || RTC_STM32
	help
	  This option enables the BBRAM driver for STM32 family of
	  processors.

	  STM32 BBRAM are 32-bit registers which can be used for storing user
	  application data. They are implemented in the backup domain that remains
	  powered-on by VBAT when the VDD power is switched off. They are not reset
	  by system reset or when the device wakes up from Standby mode. They are
	  reset by a backup domain reset.
```

## drivers/bbram/Kconfig.xec
```kconfig
# Copyright (c) 2021 Google Inc
# Copyright (c) 2022 Microchip Technology Inc.
# SPDX-License-Identifier: Apache-2.0

config BBRAM_XEC
	bool "Microchip XEC Battery-backed RAM drivers"
	default y
	depends on DT_HAS_MICROCHIP_XEC_BBRAM_ENABLED
	help
	  This option enables the BBRAM driver for Microchip XEC family of
	  processors.
```

## drivers/biometrics/Kconfig
```kconfig
# SPDX-License-Identifier: Apache-2.0
# Copyright (c) 2025 Siratul Islam

menuconfig BIOMETRICS
	bool "Biometrics drivers"
	help
	  Enable biometric sensor driver support.

if BIOMETRICS

module = BIOMETRICS
module-str = biometrics
source "subsys/logging/Kconfig.template.log_config"

config BIOMETRICS_INIT_PRIORITY
	int "Biometrics init priority"
	default 90
	help
	  Biometric device driver initialization priority.

config BIOMETRICS_SHELL
	bool "Biometrics Shell"
	depends on SHELL
	help
	  Enable biometric sensor shell commands for testing.
	  This provides commands for enrollment, matching, template
	  management, and device information queries.

# zephyr-keep-sorted-start
source "drivers/biometrics/Kconfig.emul"
source "drivers/biometrics/Kconfig.gt5x"
source "drivers/biometrics/Kconfig.zfm_x0"
# zephyr-keep-sorted-stop

endif # BIOMETRICS
```

## drivers/biometrics/Kconfig.as608
```kconfig
# SPDX-License-Identifier: Apache-2.0
# Copyright (c) 2025 Siratul Islam

config BIOMETRICS_AS608
	bool "AS608 Optical Fingerprint Sensor"
	default y
	depends on DT_HAS_SYNOCHIP_AS608_ENABLED
	select SERIAL
	select UART_INTERRUPT_DRIVEN
	help
	  Enable driver for AS608 optical fingerprint sensor.

if BIOMETRICS_AS608

config AS608_TIMEOUT_MS
	int "Default operation timeout in milliseconds"
	default 5000
	help
	  Default timeout for enrollment and matching operations.

endif # BIOMETRICS_AS608
```

## drivers/biometrics/Kconfig.emul
```kconfig
# Copyright (c) 2025 Siratul Islam
# SPDX-License-Identifier: Apache-2.0

config BIOMETRICS_EMUL
	bool "Emulated biometrics driver"
	default y
	depends on DT_HAS_ZEPHYR_BIOMETRICS_EMUL_ENABLED
	help
	  Enable emulated biometrics driver for testing.
```

## drivers/biometrics/Kconfig.gt5x
```kconfig
# SPDX-License-Identifier: Apache-2.0
# Copyright (c) 2025 Siratul Islam

config BIOMETRICS_GT5X
	bool "ADH GT5X Series Optical Fingerprint Sensor"
	default y
	depends on DT_HAS_ADH_TECH_GT5X_ENABLED
	select SERIAL
	select UART_INTERRUPT_DRIVEN
	help
	  Enable driver for ADH GT5X series optical fingerprint sensors.
	  Supports GT-511C1R, GT-511C3, GT-521F32, and GT-521F52 models.

if BIOMETRICS_GT5X

config GT5X_TIMEOUT_MS
	int "Default operation timeout in milliseconds"
	default 5000
	help
	  Default timeout for enrollment and matching operations.

endif # BIOMETRICS_GT5X
```
