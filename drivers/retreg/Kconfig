## drivers/retreg/Kconfig
```kconfig
menuconfig RETREG
	bool "Retention registers support"
	help
	  Enable support for the hardware retention registers

if RETREG

module = RETREG
module-str = retreg
source "subsys/logging/Kconfig.template.log_config"

endif
```

## drivers/rf/Kconfig
```kconfig
# SPDX-License-Identifier: MIT
# Copyright (c) 2020 Xilinx, Inc.
# Copyright (c) 2025 YWL, Tron Future Tech.

menuconfig RF
    bool "RF driver"
    help
      Drivers related to RF devices such like baseband, beamformer


if RF

module = RF
module-str = rf
source "drivers/rf/Kconfig.rfdc"
endif # RF
```

## drivers/rf/Kconfig.rfdc
```kconfig
# SPDX-License-Identifier: MIT
# Copyright (c) 2020 Xilinx, Inc.
# Copyright (c) 2025 YWL, Tron Future Tech.
 

config XLNX_RFDC
    bool "Xilinx RF Data Converter driver enable"

if XLNX_RFDC
config RFDC_INIT_PRIORITY
	int	"RF ADC/DAC init priority"
	default 80
endif # XLNX_RFDC
```

## drivers/rf/Kconfig.template.rf_mode
```kconfig
# SPDX-License-Identifier: Apache-2.0

choice "$(module)_INITIAL_RF_MODE"
	prompt "Initial mode"
	default $(module)_RF_MODE_IDLE
	depends on RF

config $(module)_RF_MODE_CALIBRATE
	bool "Calibrate"

config $(module)_RF_MODE_POWER_OFF
	bool "Power off"

config $(module)_RF_MODE_SLEEP
	bool "Sleep"

config $(module)_RF_MODE_IDLE
	bool "Idle"

config $(module)_RF_MODE_WAKE_ON_EVENT
	bool "Wake on event"

config $(module)_RF_MODE_WAKE_PERIODIC
	bool "Periodic wakeup"

config $(module)_RF_MODE_RX
	bool "Receive"

config $(module)_RF_MODE_TX
	bool "Transmit"

endchoice

config $(module)_INITIAL_RF_MODE
	int
	depends on RF
	default 0 if $(module)_RF_MODE_CALIBRATE
	default 1 if $(module)_RF_MODE_POWER_OFF
	default 2 if $(module)_RF_MODE_SLEEP
	default 3 if $(module)_RF_MODE_IDLE
	default 4 if $(module)_RF_MODE_WAKE_ON_EVENT
	default 5 if $(module)_RF_MODE_WAKE_PERIODIC
	default 6 if $(module)_RF_MODE_RX
	default 7 if $(module)_RF_MODE_TX
```

## drivers/rf/cc1101/Kconfig
```kconfig
# Copyright (c) 2021 Leonard Pollak
# SPDX-License-Identifier: Apache-2.0

menuconfig CC1101
	depends on SPI && GPIO && RF
	bool "CC1101 Driver"

if CC1101

config CC1101_THREAD_PRIORITY
	int "CC1101 worker thread priority"
	default 10

config CC1101_RX_MSG_QUEUE_DEPTH
	int "RX Message Queue depth"
	default 8
	help
	Message queue depth for incoming packages.

config CC1101_MAX_PACKET_SIZE
	int "CC1101 max packet size in bytes"
	default 253
	help
	Maximum Packet size.
	This is the size that will be allocated for each package on the message queue.
	Received packages larger that this will be discarded.
	Trying to send packages larger that this will result in -ENOMSG.

config CC1101_ADDITIONAL_THREAD_STACK_SIZE
	int "CC1101 additional worker thread stack size"
	default 256
	help
	This is the size that will be added to the total soze of the
	message queue to yield the total RX thread stack size.

config CC1101_WAIT_RETRIES
	int "Number of retries in wait loops"
	default 27
	help
	See: Chapter 19.6 Timing of the datasheet.

config CC1101_WAIT_INTERVAL_US
	int "Delay for wait loops"
	default 30
	help
	See: Chapter 19.6 Timing of the datasheet.

config CC1101_INITIAL_CALIBRATION
	bool "Initial calibration"
	default y
	help
	Perform calibration when initializing the device.

config CC1101_XOSC
	int "Value of the Crystal oscillator in kHz"
	default 26000
	help
	  This sets the XOSC value, it should be either 26000 or 27000.
	  This value should also be set in the settings of the SmartRF tool.
	  Do not touch this unless you know what you are doing.

module = CC1101
module-str = cc1101
rsource "../Kconfig.template.rf_mode"

endif # CC1101
```

## drivers/rfid/Kconfig.cr95hf
```kconfig
# Copyright (c) 2025,2026 Conny Marco Menebröcker
#
# SPDX-License-Identifier: Apache-2.0

config RFID_CR95HF
	bool "Support for CR95HF RFID driver"
	depends on DT_HAS_ST_CR95HF_ENABLED
	select SPI if $(dt_compat_on_bus,$(DT_COMPAT_ST_CR95HF),spi)
	select UART if $(dt_compat_on_bus,$(DT_COMPAT_ST_CR95HF),uart)
	default y
	help
	  Enable support for the CR95HF RFID driver.

config EMUL_CR95HF
	bool "Support for CR95HF emulation"
	depends on RFID_CR95HF
	select SPI
	default y if $(dt_compat_on_bus,$(DT_COMPAT_ST_CR95HF),spi)
	help
	  Enable support for the CR95HF emulation
```

## drivers/rtc/Kconfig
```kconfig
# Copyright (c) 2022 Bjarki Arge Andreasen
# SPDX-License-Identifier: Apache-2.0

menuconfig RTC
	bool "Real-Time Clock (RTC) drivers"
	help
	  Enable RTC driver configuration.

if RTC

module = RTC
module-str = rtc
source "subsys/logging/Kconfig.template.log_config"

config RTC_INIT_PRIORITY
	int "RTC init priority"
	default KERNEL_INIT_PRIORITY_DEVICE
	help
	  RTC device driver initialization priority.

config RTC_ALARM
	bool "RTC driver alarm support"
	help
	  This is an option which enables driver support for RTC alarms.

config RTC_UPDATE
	bool "RTC driver update event callback support"
	help
	  This is an option which enables driver support for the RTC
	  update event callback.

config RTC_CALIBRATION
	bool "RTC driver clock calibration support"
	help
	  This is an option which enables driver support for RTC clock
	  calibration.

config RTC_SHELL
	bool "RTC Shell commands"
	depends on SHELL
	help
	  RTC Shell commands

# zephyr-keep-sorted-start
source "drivers/rtc/Kconfig.am1805"
source "drivers/rtc/Kconfig.ambiq"
source "drivers/rtc/Kconfig.bq32002"
source "drivers/rtc/Kconfig.ds1307"
source "drivers/rtc/Kconfig.ds1337"
source "drivers/rtc/Kconfig.ds3231"
source "drivers/rtc/Kconfig.emul"
source "drivers/rtc/Kconfig.fake"
source "drivers/rtc/Kconfig.ifx_cat1"
source "drivers/rtc/Kconfig.mc146818"
source "drivers/rtc/Kconfig.numaker"
source "drivers/rtc/Kconfig.nxp_irtc"
source "drivers/rtc/Kconfig.pcf2123"
source "drivers/rtc/Kconfig.pcf8523"
source "drivers/rtc/Kconfig.pcf8563"
source "drivers/rtc/Kconfig.rpi_pico"
source "drivers/rtc/Kconfig.rts5912"
source "drivers/rtc/Kconfig.rv3028"
source "drivers/rtc/Kconfig.rv8263"
source "drivers/rtc/Kconfig.rv8803"
source "drivers/rtc/Kconfig.rx8130ce"
source "drivers/rtc/Kconfig.sam"
source "drivers/rtc/Kconfig.sam0"
source "drivers/rtc/Kconfig.siwx91x"
source "drivers/rtc/Kconfig.smartbond"
source "drivers/rtc/Kconfig.stm32"
source "drivers/rtc/Kconfig.ti_mspm0"
source "drivers/rtc/Kconfig.xmc4xxx"
# zephyr-keep-sorted-stop

endif # RTC
```

## drivers/rtc/Kconfig.am1805
```kconfig
# SPDX-License-Identifier: Apache-2.0
# Copyright (c) 2023 Linumiz
# Author: Sri Surya  <srisurya@linumiz.com>

config RTC_AM1805
	bool "AMBIQ AM1805 RTC driver"
	default y
	depends on DT_HAS_AMBIQ_AM1805_ENABLED
	select I2C
	help
	  Enable the AMBIQ AM1805 RTC driver.

if RTC_AM1805

config RTC_AM1805_THREAD_STACK_SIZE
	int "Stack size for the am1805 interrupt thread"
	default 512
	help
	  Size of the stack used for the thread handling interrupts and dispatching callbacks.

config RTC_AM1805_THREAD_PRIO
	int "Priority for the am1805 interrupt thread"
	default 0
	help
	  Priority level for the thread handling interrupts and dispatching callbacks.

endif
```

## drivers/rtc/Kconfig.ambiq
```kconfig
# Copyright (c) 2024, Ambiq Micro Inc. <www.ambiq.com>
# SPDX-License-Identifier: Apache-2.0

config RTC_AMBIQ
	bool "AMBIQ RTC driver"
	default y
	depends on DT_HAS_AMBIQ_RTC_ENABLED
	select AMBIQ_HAL
	help
	  Enable the AMBIQ RTC driver.
```

## drivers/rtc/Kconfig.ameba
```kconfig
# Copyright (c) 2026 Realtek Semiconductor Corp.
# SPDX-License-Identifier: Apache-2.0

config RTC_AMEBA
	bool "AMEBA RTC driver"
	default y
	depends on DT_HAS_REALTEK_AMEBA_RTC_ENABLED
	help
	  Build Real-Time Clock (RTC) driver for AMEBA SoCs.
```

## drivers/rtc/Kconfig.bee
```kconfig
# Copyright (c) 2026, Realtek Semiconductor Corporation
# SPDX-License-Identifier: Apache-2.0

config RTC_BEE
	bool "Realtek Bee series RTC driver"
	default n
	depends on DT_HAS_REALTEK_BEE_RTC_ENABLED
	select HAL_REALTEK_BEE_RTC
	help
	  This option enables the RTC driver for Realtek Bee SoCs.
```

## drivers/rtc/Kconfig.bq32002
```kconfig
# Copyright (c) 2025 Marcin Lyda <elektromarcin@gmail.com>
# SPDX-License-Identifier: Apache-2.0

config RTC_BQ32002
	bool "Texas Instruments BQ32002 Real-Time Clock driver"
	default y
	depends on DT_HAS_TI_BQ32002_ENABLED
	select I2C
	help
	    Enable Texas Instruments BQ32002 I2C RTC driver.
```

## drivers/rtc/Kconfig.counter
```kconfig
# Copyright 2025 NXP
# SPDX-License-Identifier: Apache-2.0

config RTC_COUNTER
	bool "Real Time Clock driver using counter API"
	default y
	depends on DT_HAS_ZEPHYR_RTC_COUNTER_ENABLED
	select COUNTER
	help
	  RTC driver applied for RTC device without broken-down time registers.
	  Wraps the counter API to provide RTC functionality.
	  Uses unix timestamp to convert between broken-down time and counter ticks.

config RTC_COUNTER_NVMEM
	bool "Epoch offset in NVMEM"
	default y
	depends on RTC_COUNTER
	depends on $(dt_compat_any_has_prop,$(DT_COMPAT_ZEPHYR_RTC_COUNTER),nvmem-cells)
	select NVMEM
	help
	  Use an NVMEM cell to write the epoch offset when `rtc_set_time` is called,
	  and read from the cell on init.
	  Only compatible nodes with an NVMEM cell named "epoch-offset" will store data.
```

## drivers/rtc/Kconfig.ds1302
```kconfig
# SPDX-License-Identifier: Apache-2.0
# Copyright (c) 2026 Harpreet Saini
# Author: Harpreet Saini <sainiharpreet29@yahoo.com>

config RTC_DS1302
	bool "MAXIM DS1302 RTC driver"
	default y
	depends on DT_HAS_MAXIM_DS1302_ENABLED
	select SPI
	help
	  Enable the MAXIM DS1302 RTC driver.
```

## drivers/rtc/Kconfig.ds1307
```kconfig
# SPDX-License-Identifier: Apache-2.0
# Copyright (c) 2023 Arunmani Alagarsamy
# Author: Arunmani Alagarsamy <arunmani27100@gmail.com>

config RTC_DS1307
	bool "MAXIM DS1307 RTC driver"
	default y
	depends on DT_HAS_MAXIM_DS1307_ENABLED
	select I2C
	help
	  Enable the MAXIM DS1307 RTC driver.
```

## drivers/rtc/Kconfig.ds1337
```kconfig
# Copyright (c) 2025 Marcin Lyda <elektromarcin@gmail.com>
# SPDX-License-Identifier: Apache-2.0

config RTC_DS1337
	bool "Maxim DS1337 RTC driver"
	default y
	depends on DT_HAS_MAXIM_DS1337_ENABLED
	select I2C
	help
	    Enable Maxim DS1337 RTC driver.
```

## drivers/rtc/Kconfig.ds3231
```kconfig
# Copyright (c) 2024, Gergo Vari <work@gergovari.com>
#
# SPDX-License-Identifier: Apache-2.0
#

config RTC_DS3231
	bool "Maxim DS3231 RTC/TCXO"
	default y
	depends on DT_HAS_MAXIM_DS3231_MFD_ENABLED
	depends on DT_HAS_MAXIM_DS3231_RTC_ENABLED
	select I2C
	select MFD
	help
	  Enable RTC driver based on Maxim DS3231 I2C device.

config RTC_DS3231_INIT_PRIORITY
	int "DS3231 RTC driver initialization priority"
	depends on RTC_DS3231
	default 86
	help
	  Initialization priority for the DS3231 RTC driver. It must be
	  greater than the I2C controller init priority and the mfd driver
	  init priority.
```

## drivers/rtc/Kconfig.esp32
```kconfig
# Copyright (c) 2025 Espressif Systems (Shanghai) CO LTD
# SPDX-License-Identifier: Apache-2.0

config RTC_ESP32
	bool "ESP32 RTC driver"
	default y
	depends on DT_HAS_ESPRESSIF_ESP32_RTC_ENABLED
	help
	  Enables the ESP32 RTC driver using the internal RTC counter hardware.
	  This provides basic timekeeping functionality based on the built-in
	  RTC counter peripheral.
```

## drivers/rtc/Kconfig.fake
```kconfig
# Fake RTC configuration options
#
# Copyright (c) 2023 Prevas A/S
# SPDX-License-Identifier: Apache-2.0

config RTC_FAKE
	bool "Fake RTC driver"
	default y
	depends on DT_HAS_ZEPHYR_FAKE_RTC_ENABLED
	help
	  Enable support for the FFF-based fake RTC driver.
```

## drivers/rtc/Kconfig.hwclock
```kconfig
# Copyright (c) 2024 Bjarki Arge Andreasen
# SPDX-License-Identifier: Apache-2.0

DT_CHOSEN_RTC := zephyr,rtc

config RTC_HWCLOCK
	bool "Hardware clock"
	default y
	depends on $(dt_chosen_enabled,$(DT_CHOSEN_RTC))
	depends on SYS_REALTIME
	help
	  The hardware clock is used to set the system
	  real-time clock on boot.

if RTC_HWCLOCK

config RTC_HWCLOCK_INIT_PRIORITY
	int "Initialization priority of hardware clock"
	default 51
	help
	  The initialization priority of the hardware clock
	  must be higher than the initialization priority of
	  the chosen RTC device driver.

endif # RTC_HWCLOCK
```

## drivers/rtc/Kconfig.ifx_cat1
```kconfig
# ==================================================================================================
# Copyright (c) 2025 Cypress Semiconductor Corporation (an Infineon company) or
# an affiliate of Cypress Semiconductor Corporation
#
# SPDX-License-Identifier: Apache-2.0
# ==================================================================================================

# Infineon CAT1 RTC configuration options

config RTC_INFINEON_CAT1
	bool "Infineon CAT1 RTC driver"
	default y
	depends on DT_HAS_INFINEON_CAT1_RTC_ENABLED
	select USE_INFINEON_RTC
	help
	  This option enables the RTC driver for Infineon CAT1 family.
```

## drivers/rtc/Kconfig.it8xxx2
```kconfig
# Copyright (c) 2026 ITE Corporation. All Rights Reserved.
# SPDX-License-Identifier: Apache-2.0

config RTC_ITE_IT8XXX2
	bool "ITE IT8XXX2 RTC driver"
	default y
	depends on DT_HAS_ITE_IT8XXX2_RTC_ENABLED
	help
	  This option enables the RTC driver for IT8XXX2.
```

## drivers/rtc/Kconfig.max31329
```kconfig
# Copyright (c) 2024 Wimansha Wijekoon <Wimanshahb@gmail.com>
# SPDX-License-Identifier: Apache-2.0

config RTC_MAX31329
	bool "Analog device MAX31329 RTC driver"
	default y
	depends on DT_HAS_ADI_MAX31329_ENABLED
	select I2C
	help
	  Enable the Analog Device MAX31329 RTC driver.
```

## drivers/rtc/Kconfig.max31331
```kconfig
# Copyright 2025 Analog Devices Inc.
# SPDX-License-Identifier: Apache-2.0

config RTC_MAX31331
	bool "MAX31331 ultra low-power RTC"
	default y
	depends on DT_HAS_ADI_MAX31331_ENABLED
	select I2C
	help
	  Enable the Analog Devices MAX31331 RTC multi-function device driver

config RTC_MAX31331_TIMESTAMPING
	bool "Timestamping support (TS0–TS3)"
	depends on DT_HAS_ADI_MAX31331_ENABLED
	help
	  Enable support for timestamping functionality using the TS0 - TS3 registers

config RTC_MAX31331_INTERRUPT
	bool "Interrupt support"

choice RTC_MAX31331_INTERRUPT_MODE
	prompt "Set option of Interrupt handling"
	default RTC_MAX31331_INTERRUPT_GLOBAL_THREAD
	depends on DT_HAS_ADI_MAX31331_ENABLED
	help
	  Choose how the interrupt handling for the MAX31331 RTC driver should be implemented.
	  This allows selecting between different interrupt handling mechanisms based
	  on the application requirements.

config RTC_MAX31331_INTERRUPT_GLOBAL_THREAD
	bool "Use global thread"
	depends on $(dt_compat_any_has_prop,$(DT_COMPAT_ADI_MAX31331),interrupt-gpios)
	select GPIO
	select RTC_MAX31331_INTERRUPT
	help
	  Use global thread for the interrupt handler

config RTC_MAX31331_INTERRUPT_OWN_THREAD
	bool "Use own thread"
	depends on $(dt_compat_any_has_prop,$(DT_COMPAT_ADI_MAX31331),interrupt-gpios)
	select GPIO
	select RTC_MAX31331_INTERRUPT
	help
	  Use own thread for the interrupt handler

endchoice # RTC_MAX31331_INTERRUPT_MODE

config RTC_MAX31331_THREAD_PRIORITY
	int "Thread Priority"
	depends on RTC_MAX31331_INTERRUPT_OWN_THREAD
	default 10
	help
	  Set the priority of the thread used for handling interrupts when "Use own thread"
	  is selected. A lower value indicates a higher priority.

config RTC_MAX31331_THREAD_STACK_SIZE
	int "Thread Stack Size"
	depends on RTC_MAX31331_INTERRUPT_OWN_THREAD
	default 1024
	help
	  Specify the stack size (in bytes) for the thread used to handle interrupts when
	  "Use own thread" is selected. Ensure the stack size is sufficient for the interrupt
	  handling logic to avoid stack overflows.
```

## drivers/rtc/Kconfig.max32
```kconfig
# Copyright (c) 2024 Analog Devices, Inc.
# SPDX-License-Identifier: Apache-2.0

config RTC_MAX32
	bool "RTC driver for MAX32 family MCUs"
	default y
	depends on DT_HAS_ADI_MAX32_RTC_ENABLED
	help
	  Enable RTC driver for MAX32 line of MCUs
```
