## drivers/dai/intel/hda/Kconfig.hda
```kconfig
# SOF HDA configuration options

# Copyright (c) 2022 Intel Corporation
# SPDX-License-Identifier: Apache-2.0

config DAI_INTEL_HDA
	bool "Intel HDA driver for Dai interface"
	default y
	depends on DT_HAS_INTEL_HDA_DAI_ENABLED
	select DMA
	help
	  Select this to enable Intel HDA driver.
```

## drivers/dai/intel/ssp/Kconfig.ssp
```kconfig
# SOF SSP configuration options

# Copyright (c) 2022 Intel Corporation
# SPDX-License-Identifier: Apache-2.0

config DAI_INTEL_SSP
	bool "Intel I2S (SSP) Bus Driver for Dai interface"
	default y
	depends on DT_HAS_INTEL_SSP_DAI_ENABLED
	select DMA
	depends on PM_DEVICE_RUNTIME
	help
	  Enable Inter Sound (I2S) bus driver based on
	  Synchronous Serial Port (SSP) module.

config DAI_SSP_HAS_POWER_CONTROL
	bool "DAI ssp pm_runtime en/dis ssp power"
	default y if SOC_SERIES_INTEL_ADSP_ACE
	depends on DAI_INTEL_SSP

if DAI_INTEL_SSP

config DAI_SSP_CLK_FORCE_DYNAMIC_CLOCK_GATING
	bool

config DAI_INTEL_SSP_NUM_BASE
	int
	default 6

config DAI_INTEL_SSP_NUM_EXT
	int
	default 0

endif
```

## drivers/dai/intel/uaol/Kconfig.uaol
```kconfig
# SOF UAOL configuration options

# Copyright (c) 2023-2024 Intel Corporation
# SPDX-License-Identifier: Apache-2.0

config DAI_INTEL_UAOL
	bool "Intel USB Audio Offload Link (UAOL) driver support for DAI interface"
	default y
	depends on DT_HAS_INTEL_UAOL_DAI_ENABLED
	depends on PM_DEVICE_RUNTIME
	help
	  Enable Intel USB Audio Offload Link (UAOL) driver for DAI interface
```

## drivers/dai/nxp/esai/Kconfig.esai
```kconfig
# Copyright 2024-2025 NXP
# SPDX-License-Identifier: Apache-2.0

config DAI_NXP_ESAI
	bool "NXP Enhanced Serial Audio Interface (ESAI) driver"
	default y
	depends on DT_HAS_NXP_DAI_ESAI_ENABLED
	select PINCTRL
	help
		Select this to enable NXP ESAI driver.
```

## drivers/dai/nxp/micfil/Kconfig.micfil
```kconfig
# Copyright 2025 NXP
# SPDX-License-Identifier: Apache-2.0

config DAI_NXP_MICFIL
	bool "NXP Pulse Density Modulation Microphone Interface (MICFIL) driver"
	default y
	depends on DT_HAS_NXP_DAI_MICFIL_ENABLED
	select PINCTRL
	help
		Select this to enable NXP PDM MICFIL driver.
```

## drivers/dai/nxp/sai/Kconfig.sai
```kconfig
# Copyright 2023 NXP
# SPDX-License-Identifier: Apache-2.0

config DAI_NXP_SAI
	bool "NXP Synchronous Audio Interface (SAI) driver"
	default y
	depends on DT_HAS_NXP_DAI_SAI_ENABLED
	select PINCTRL
	help
		Select this to enable NXP SAI driver.

if DAI_NXP_SAI

config SAI_HAS_MCLK_CONFIG_OPTION
	bool "Set if SAI has MCLK configuration options"
	default n
	help
		Select this if the SAI IP allows configuration
		of the master clock. Master clock configuration
		refers to enabling/disabling the master clock,
		setting the signal as input or output or dividing
		the master clock output.

config SAI_FIFO_WORD_SIZE
	int "Size (in bytes) of a FIFO word"
	default 4
	help
		Use this to set the size (in bytes) of a SAI
		FIFO word.

config SAI_IMX93_ERRATA_051421
	bool "Set if your SAI IP version is affected by i.MX93's ERRATA 051421"
	default n
	help
		Select this if your SAI ip version is affected by
		i.MX93's ERRATA 051421. The errata states that if
		the SAI is FSYNC/BCLK master, one of the directions
		is SYNC with the other, and the ASYNC direction has
		the BYP bit toggled, the SYNC direction's BCLK won't
		be generated properly.

endif # DAI_NXP_SAI
```

## drivers/dai/virtual/Kconfig.virtual
```kconfig
# Copyright (c) 2025, Suraj Sonawane <surajsonawane0215@gmail.com@gmail.com>
# SPDX-License-Identifier: Apache-2.0

config DAI_VIRTUAL
	bool "Virtual DAI driver"
	depends on DT_HAS_ZEPHYR_VIRTUAL_DAI_ENABLED
	help
	  Select this to enable support for a Virtual DAI driver.
	  This driver is useful for debugging and rapid prototyping without
	  real hardware. It simulates audio input/output behavior in software
	  and is useful in memory-to-memory pipelines.
```

## drivers/dali/Kconfig
```kconfig
# DALI configuration options

# Copyright (c) 2026 by Sven Hädrich <sven.haedrich@sevenlab.de>
# SPDX-License-Identifier: Apache-2.0

menuconfig DALI
	bool "Digital Addressable Lighting Interface (DALI) drivers"
	select EXPERIMENTAL
	help
	  Enable generic support for DALI bus (IEC 62386).
	  This feature is experimental and may be unstable; it requires
	  CONFIG_EXPERIMENTAL to be enabled.

if DALI

source "drivers/dali/Kconfig.pwm"

module = DALI_LOW_LEVEL
module-str = dali_low_level
source "subsys/logging/Kconfig.template.log_config"

endif # DALI
```

## drivers/dali/Kconfig.counter
```kconfig
# Counter DALI configuration options

# Copyright (c) 2025 by Sven Hädrich <sven.haedrich@sevenlab.de>
# SPDX-License-Identifier: Apache-2.0

config DALI_COUNTER
	bool "Counter based DALI driver"
	default y
	depends on DT_HAS_ZEPHYR_DALI_COUNTER_ENABLED
	select COUNTER
	help
	  Enable counter based DALI driver.

config DALI_COUNTER_PRIORITY
	int "DALI workqueue priority"
	depends on DT_HAS_ZEPHYR_DALI_COUNTER_ENABLED
	default 5
	help
	  The priority of the workqueue used for the DALI driver.

config DALI_COUNTER_STACK_SIZE
	int "DALI driver workqueue thread stack size"
	depends on DT_HAS_ZEPHYR_DALI_COUNTER_ENABLED
	default 768
	help
	  The thread stack size.
```

## drivers/dali/Kconfig.lpc11u6x
```kconfig
# LPC11U6x DALI configuration options

# Copyright (c) 2025 by Sven Hädrich <sven.haedrich@sevenlab.de>
# SPDX-License-Identifier: Apache-2.0

config DALI_LPC11U6X
	bool "LPC11U6x DALI driver"
	default y
	depends on DT_HAS_NXP_DALI_LPC11U6X_ENABLED
	help
	  Enable the DALI driver for LPC11U6X MCUs.

config DALI_LPC11U6X_PRIORITY
	int "DALI workqueue priority"
	depends on DT_HAS_NXP_DALI_LPC11U6X_ENABLED
	default 5
	help
	  The priority of the workqueue used for the DALI driver.

config DALI_LPC11U6X_STACK_SIZE
	int "DALI driver workqueue thread stack size"
	depends on DT_HAS_NXP_DALI_LPC11U6X_ENABLED
	default 768
	help
	  The thread stack size.
```

## drivers/dali/Kconfig.pwm
```kconfig
# PWM DALI configuration options

# Copyright (c) 2025 by Sven Hädrich <sven.haedrich@sevenlab.de>
# SPDX-License-Identifier: Apache-2.0

config DALI_PWM
	bool "Generic PWM DALI driver"
	default y
	depends on DT_HAS_ZEPHYR_DALI_PWM_ENABLED
	select PWM
	select COUNTER
	help
	  Enable DALI driver for generic PWM MCUs.

if DALI_PWM

config DALI_PWM_PRIORITY
	int "DALI workqueue priority"
	default 5
	help
	  The priority of the workqueue used for the DALI driver.

config DALI_PWM_STACK_SIZE
	int "DALI driver workqueue thread stack size"
	default 1120
	help
	  The thread stack size.

endif # DALI_PWM
```

## drivers/debug/Kconfig
```kconfig
# Copyright (c) 2025 Silicon Laboratories Inc.
# SPDX-License-Identifier: Apache-2.0

menuconfig DEBUG_DRIVER
	bool "Debug drivers"
	help
	  Enable support for debug drivers

if DEBUG_DRIVER

config DEBUG_DRIVER_INIT_PRIORITY
	int "Initialization priority"
	default KERNEL_INIT_PRIORITY_DEVICE
	help
	  Debug drivers initialization priority.

# zephyr-keep-sorted-start
source "drivers/debug/Kconfig.nrf"
source "drivers/debug/Kconfig.silabs"
# zephyr-keep-sorted-stop

module = DEBUG_DRIVER
module-str = debug_driver
source "subsys/logging/Kconfig.template.log_config"

endif
```

## drivers/debug/Kconfig.nrf
```kconfig
# Copyright (c) 2024 Nordic Semiconductor ASA
# SPDX-License-Identifier: Apache-2.0

DT_COMPAT_NORDIC_NRF_TBM := nordic,nrf-tbm

config DEBUG_NRF_ETR
	bool "Coresight ETR handler (with Nordic TBM)"
	depends on $(dt_compat_enabled,$(DT_COMPAT_NORDIC_NRF_TBM))
	select NRFX_TBM
	imply UART_ASYNC_API
	default y
	help
	  Module handles data stored in the ETR circular buffer (e.g. STM logging
	  data). Busyness is tracked using TBM (Trace Buffer Monitor) peripheral
	  which is specific to Nordic Semiconductor SoCs.

if DEBUG_NRF_ETR

config DEBUG_NRF_ETR_DECODE
	bool "Decode ETR content"
	default y if LOG_FRONTEND_STMESP_FSC
	select MIPI_STP_DECODER
	select CS_TRACE_DEFMT
	select LOG_FRONTEND_STMESP_DEMUX
	select LOG_OUTPUT
	imply LOG_BACKEND_SHOW_COLOR
	imply CBPRINTF_FP_SUPPORT
	help
	  In this mode, log messages stored by Coresight STM logging frontends are
	  decoded and printed in the human readable form.

config DEBUG_NRF_ETR_DECODE_DROP_PERIOD
	int "Period of dropped messages notification"
	default 5000
	help
	  Period (in milliseconds) how often it is checked if any dropped messages
	  have occurred.

config DEBUG_NRF_ETR_DEBUG
	bool "Debug mode"
	depends on !LOG_PRINTK
	select MIPI_STP_DECODER
	select CS_TRACE_DEFMT
	help
	  In debug mode STPv2 decoded data is printed.

config DEBUG_NRF_ETR_STACK_SIZE
	int "ETR thread stack size"
	default 2048 if DEBUG_NRF_ETR_DECODE || DEBUG_NRF_ETR_DEBUG
	default 1024

config DEBUG_NRF_ETR_BACKOFF
	int "Thread backoff time (ms)"
	default 10
	help
	  Determines how often attempt to dump the data is performed.

config DEBUG_NRF_ETR_FLUSH_TIMEOUT
	int "Backoff time during flushing (ms)"
	default 100
	help
	  When thread triggers flushing of ETR data, it periodically checks if
	  there is still a pending ETR data. This option specifies how often
	  thread is waking up to check. Given in milliseconds.

config DEBUG_NRF_ETR_SYNC_PERIOD
	int "Period of custom synchronization frame"
	default 0 if DEBUG_NRF_ETR_DECODE
	default 0 if DEBUG_NRF_ETR_DEBUG
	default 16
	help
	  To help find the synchronization when decoding the ETR content
	  by a host tool a synchronization pattern (16 bytes of 0xFF) can be
	  sent on regular intervals. This frame is sent between Coresight formatter
	  frames. Use 0 to disable.

config DEBUG_NRF_ETR_SHELL
	bool "Use shell"
	select UART_ASYNC_API
	select UART_ASYNC_RX_HELPER
	select SHELL_LOG_BACKEND_CUSTOM
	depends on DEBUG_NRF_ETR_DECODE
	default y if SHELL
	help
	  Enable shell with Coresight STM logging support.

if DEBUG_NRF_ETR_SHELL

config DEBUG_NRF_ETR_SHELL_PROMPT
	string "Displayed prompt name"
	default "uart:~$ "
	help
	  Displayed prompt name for UART shell with Coresight STM logging.

config DEBUG_NRF_ETR_SHELL_ASYNC_RX_BUFFER_SIZE
	int "Size of the RX buffer"
	default 16
	help
	  Size of a single RX buffer. Together with buffer count it defines the
	  space that can hold RX data. It may be decreased if shell input is
	  slow and may need to be increased if long messages are pasted directly
	  to the shell prompt.

config DEBUG_NRF_ETR_SHELL_ASYNC_RX_BUFFER_COUNT
	int "Number of RX buffers"
	default 4
	range 2 64
	help
	  Number of RX buffers.

endif # DEBUG_NRF_ETR_SHELL

endif # DEBUG_NRF_ETR

menuconfig DEBUG_CORESIGHT_NRF
	bool "Coresight Trace support"
	default y
	depends on DT_HAS_NORDIC_CORESIGHT_NRF_ENABLED
	select PINCTRL
	select NRF_IRONSIDE_TDD_SERVICE
	help
	  Support CoreSight peripherals in Test and Debug Domain for ARM
	  CoreSight System Trace Macrocell (STM) trace support.

if DEBUG_CORESIGHT_NRF

config DEBUG_CORESIGHT_NRF_ATB_TRACE_ID_STM_GLOBAL
	def_hex 0x40
	help
	  Global trace ID used by STM.

config DEBUG_CORESIGHT_NRF_STM_SYNC_BYTE_COUNT
	int "STM: Emit synhronization packet every N bytes"
	range 0 4095
	default 512

config DEBUG_CORESIGHT_NRF_STM_HWEVENTS
	bool "STM: Enable hardware events"
	help
	  Enable the output of hardware events in STM.

config DEBUG_CORESIGHT_NRF_TPIU_FFCR_TRIG
	bool "TPIU: Use flush request trigger"
	default y
	help
	  Use CTI channel 1 for triggering flush request in TPIU.

config DEBUG_CORESIGHT_NRF_TPIU_SYNC_FRAME_COUNT
	int "TPIU: Emit synchronisation packet every N frames"
	default 8

config DEBUG_CORESIGHT_NRF_TPIU_PORTSIZE
	int "TPIU: Size of the current TPIU port in bits"
	range 1 32
	default 4

config DEBUG_CORESIGHT_NRF_ATBFUNNEL_HOLD_TIME
	int "ATBFUNNEL: Hold time for the transaction"
	range 1 15
	default 4
	help
	  Number of transactions that are output on the funnel master port from the
	  same slave.

config DEBUG_CORESIGHT_NRF_TSGEN_CLK_DIV
	int
	default 8
	help
	  Clock division factor for generating trace timestamps. The timestamp
	  counter should not be slower than 10% of the fastest processor clock
	  frequency in the system, therefore its clock speed is divided by
	  eight.

module = DEBUG_CORESIGHT_NRF
module-str = CoreSight Trace
source "subsys/logging/Kconfig.template.log_config"

endif # DEBUG_CORESIGHT_NRF
```

## drivers/debug/Kconfig.silabs
```kconfig
# Copyright (c) 2025 Silicon Laboratories Inc.
# SPDX-License-Identifier: Apache-2.0

config DEBUG_SILABS_PTI
	bool "Silicon Labs Packet Trace Interface"
	default y
	depends on DT_HAS_SILABS_PTI_ENABLED
	depends on PINCTRL
	depends on SOC_GECKO_USE_RAIL
	help
	  Enable the Packet Trace Interface, providing a mechanism for viewing
	  transmitted and received radio packets for network sniffing or debugging.
```

## drivers/debug/Kconfig.swd
```kconfig
# Kconfig - SWD driver configuration options

#
# Copyright (c) 2019 Phytec Messtechnik GmbH
#
# SPDX-License-Identifier: Apache-2.0
#

menuconfig SWD_DRIVER
	bool "Serial Wire Interface driver"
	help
	  Enable SWD Driver Configuration

if SWD_DRIVER

module = SWD_DRIVER
module-str = swd driver
source "subsys/logging/Kconfig.template.log_config"

config SWD_BITBANG_DRIVER
	bool "Serial Wire Interface bit-bang driver"
	default y

config SWD_DRIVER_INIT_PRIO
	int "Serial Driver initialization priority"
	default 80
	help
	  Set the initialization priority number.

endif # SWD_DRIVER
```

## drivers/digipot/Kconfig
```kconfig
# Digipot configuration options

# Copyright (c) 2020 Libre Solar Technologies GmbH
# SPDX-License-Identifier: Apache-2.0

#
# Digipot options
#
menuconfig DIGIPOT
	bool "Digital potentiometer drivers"
	help
	  Enable Digital potentiometer driver configuration.

if DIGIPOT

module = DIGIPOT
module-str = DIGIPOT

source "subsys/logging/Kconfig.template.log_config"

config DIGIPOT_INIT_PRIORITY
	int "Digipot init priority"
	default KERNEL_INIT_PRIORITY_DEVICE
	help
	  Digipot driver device initialization priority.

source "drivers/digipot/Kconfig.ad528x"

endif # DIGIPOT
```

## drivers/digipot/Kconfig.ad528x
```kconfig
# Digipot configuration options

# SPDX-FileCopyrightText: 2025 Jocelyn Masserot <jocemass@gmail.com>
# SPDX-License-Identifier: Apache-2.0

config DIGIPOT_AD528X
	bool "Analog Devices AD528x digipot driver"
	default y
	select I2C
	depends on DT_HAS_ADI_AD5280_ENABLED \
		|| DT_HAS_ADI_AD5282_ENABLED
	help
	  Enable the driver for the Analog Devices AD528x digipot
```

## drivers/disk/Kconfig
```kconfig
# Copyright (c) 2021 Nordic Semiconductor ASA
# SPDX-License-Identifier: Apache-2.0

menuconfig DISK_DRIVERS
	bool "Disk drivers"
	help
	  Disk Driver configuration

if DISK_DRIVERS

source "drivers/disk/Kconfig.*"
source "drivers/disk/*/Kconfig"

endif # DISK_DRIVERS
```

## drivers/disk/Kconfig.ffat
```kconfig
# Copyright (c) 2023 Nordic Semiconductor ASA
# SPDX-License-Identifier: Apache-2.0

config DISK_DRIVER_FFAT
	bool "Fake FAT Disk"
	default y if DT_HAS_ZEPHYR_FFAT_DISK_ENABLED
	help
	  Fake FAT disk emulates a disk formatted with the FAT file system
	  and provides very limited functionality. It can be used for testing
	  or to map services such as firmware updates to a file on
	  the emulated disk.

if DISK_DRIVER_FFAT

module = FFATDISK
module-str = ffatdisk
source "subsys/logging/Kconfig.template.log_config"

endif # DISK_DRIVER_FFAT
```

## drivers/disk/Kconfig.flash
```kconfig
# Copyright (c) 2016 Intel Corporation
# SPDX-License-Identifier: Apache-2.0

config DISK_DRIVER_FLASH
	bool "Flash"
	depends on DT_HAS_ZEPHYR_FLASH_DISK_ENABLED
	default y
	select FLASH
	select FLASH_MAP
	help
	  Flash device is used for the file system.

if DISK_DRIVER_FLASH

config FLASHDISK_VERIFY_PAGE_LAYOUT
	bool "Verify flashdisk partition layout"
	default y
	help
	  Enable runtime zephyr,flash-disk partition page layout constraints
	  verification. Disable to reduce code size.

module = FLASHDISK
module-str = flashdisk
source "subsys/logging/Kconfig.template.log_config"

endif # DISK_DRIVER_FLASH
```
