## drivers/disk/Kconfig.loopback
```kconfig
# Copyright (c) 2024 Embedded Solutions GmbH
# SPDX-License-Identifier: Apache-2.0

menuconfig DISK_DRIVER_LOOPBACK
	bool "Loopback Disk"
	depends on FILE_SYSTEM
	help
	  Enables mounting the contents of a file as a separate disk.

if DISK_DRIVER_LOOPBACK

config LOOPBACK_DISK_SECTOR_SIZE
	int "Loopback disk sector size"
	default 512
	help
	  Sets the sector size used for loopback-mounted disks.

module = LOOPBACK_DISK
module-str = loopback_disk
source "subsys/logging/Kconfig.template.log_config"

endif # DISK_DRIVER_LOOPBACK
```

## drivers/disk/Kconfig.mmc
```kconfig
# Copyright 2023 NXP
# SPDX-License-Identifier: Apache-2.0

config DISK_DRIVER_MMC
	bool "MMC card driver"
	depends on DT_HAS_ZEPHYR_MMC_DISK_ENABLED
	default y
	help
	  MMC card driver.

if DISK_DRIVER_MMC

config SD_INIT_PRIORITY
	int "Init priority"
	default 90
	help
	  MMC controller driver initialization priority.

config MMC_SUBSYS
	bool "MMC access via SD subsystem"
	select MMC_STACK
	default y
	depends on DT_HAS_ZEPHYR_MMC_DISK_ENABLED
	help
	  Enable MMC access via SD subsystem.

module = MMC
module-str = mmc
source "subsys/logging/Kconfig.template.log_config"

endif # DISK_DRIVER_MMC
```

## drivers/disk/Kconfig.ram
```kconfig
# Copyright (c) 2016 Intel Corporation
# SPDX-License-Identifier: Apache-2.0

config DISK_DRIVER_RAM
	bool "RAM Disk"
	depends on DT_HAS_ZEPHYR_RAM_DISK_ENABLED
	default y
	help
	  RAM buffer used to emulate storage disk.
	  This option can be used to test the file
	  system.

if DISK_DRIVER_RAM

config RAM_LZ4_DECOMPRESSOR
	bool

config DISK_RAM_DECOMPRESS
	bool "Decompress the initrd"
	select RAM_LZ4_DECOMPRESSOR
	help
	  Decompress the initrd before using it as the RAM Disk.

module = RAMDISK
module-str = ramdisk
source "subsys/logging/Kconfig.template.log_config"

endif # DISK_DRIVER_RAM
```

## drivers/disk/Kconfig.renesas_ra
```kconfig
# Copyright (c) 2024 Renesas Electronics Corporation
# SPDX-License-Identifier: Apache-2.0

config SDMMC_RENESAS_RA
	bool "Renesas RA SDMMC driver"
	default y
	depends on DT_HAS_RENESAS_RA_SDMMC_ENABLED
	select USE_RA_FSP_SDHI
	select USE_RA_FSP_DTC
	help
	  File system on sdmmc accessed through renesas ra sdmmc.
```

## drivers/disk/Kconfig.sdmmc
```kconfig
# Copyright (c) 2016 Intel Corporation
# Copyright (c) 2021 Nordic Semiconductor ASA
# SPDX-License-Identifier: Apache-2.0

DT_STM32_SDMMC_HAS_DMA := $(dt_nodelabel_has_prop,sdmmc,dmas)

config DISK_DRIVER_SDMMC
	bool "SDMMC card driver"
	depends on DT_HAS_ZEPHYR_SDMMC_DISK_ENABLED || \
			DT_HAS_ST_STM32_SDMMC_ENABLED
	default y
	help
	  SDMMC card driver.

if DISK_DRIVER_SDMMC

config SD_INIT_PRIORITY
	int "Init priority"
	default 90
	help
	  SDMMC controller driver initialization priority.

config SDMMC_VOLUME_NAME
	string "SDMMC Disk mount point or drive name"
	default "SD" if FAT_FILESYSTEM_ELM
	default "SDMMC"
	help
	  Disk name as per file system naming guidelines.

config SDMMC_SUBSYS
	bool "SDMMC access via SD subsystem"
	select SDMMC_STACK
	default y
	depends on DT_HAS_ZEPHYR_SDMMC_DISK_ENABLED
	help
	  Enable SDMMC access via SD subsystem.

config SDMMC_STM32
	bool "STM32 SDMMC driver"
	default y
	depends on DT_HAS_ST_STM32_SDMMC_ENABLED
	select USE_STM32_HAL_SD if !SDMMC_STM32_EMMC
	select USE_STM32_HAL_SD_EX if !SDMMC_STM32_EMMC && SOC_SERIES_STM32L4X
	select USE_STM32_HAL_MMC if SDMMC_STM32_EMMC
	select USE_STM32_HAL_MMC_EX if SDMMC_STM32_EMMC && SOC_SERIES_STM32L4X
	select USE_STM32_LL_SDMMC
	select USE_STM32_HAL_DMA if (SOC_SERIES_STM32L4X || SOC_SERIES_STM32F7X || SOC_SERIES_STM32F4X)
	select DMA if ($(DT_STM32_SDMMC_HAS_DMA) && SOC_SERIES_STM32F4X)
	select RESET
	help
	  File system on sdmmc accessed through stm32 sdmmc.

config SDMMC_STM32_HWFC
	bool "STM32 SDMMC Hardware Flow control"
	depends on SDMMC_STM32
	depends on SOC_SERIES_STM32H5X || \
		   SOC_SERIES_STM32H7X || \
		   SOC_SERIES_STM32F7X || \
		   SOC_SERIES_STM32L4X || \
		   SOC_SERIES_STM32L5X
	help
	  Enable SDMMC Hardware Flow Control to avoid FIFO underrun (TX mode) and
	  overrun (RX mode) errors.

config SDMMC_STM32_EMMC
	bool "STM32 SDMMC eMMC mode"
	depends on SDMMC_STM32
	help
	  Use eMMC instead of SDIO (SD card) protocol. These are similar, but not entirely the same.

config SDMMC_STM32_CLOCK_CHECK
	bool "Runtime SDMMC 48MHz clock check"
	depends on SDMMC_STM32
	default y
	help
	  Enable SDMMC clock 48MHz configuration runtime check.
	  In specific cases, this check might provide wrong verdict and should
	  be disabled.

module = SDMMC
module-str = sdmmc
source "subsys/logging/Kconfig.template.log_config"

endif # DISK_DRIVER_SDMMC
```
