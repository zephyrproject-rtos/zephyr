## drivers/clock_monitor/Kconfig.nxp_anactrl
```kconfig
# SPDX-FileCopyrightText: 2026 NXP
# SPDX-License-Identifier: Apache-2.0

config CLOCK_MONITOR_NXP_ANACTRL
	bool "NXP ANACTRL frequency measure driver"
	default y
	depends on DT_HAS_NXP_ANACTRL_FREQME_ENABLED
	select MUX
	help
	  clock_monitor back-end for the NXP ANACTRL frequency-measurement block.
	  Only support measure mode.
```

## drivers/clock_monitor/Kconfig.nxp_freqme
```kconfig
# SPDX-FileCopyrightText: 2026 NXP
# SPDX-License-Identifier: Apache-2.0

config CLOCK_MONITOR_NXP_FREQME
	bool "NXP FREQME frequency measurement driver"
	default y
	depends on DT_HAS_NXP_FREQME_ENABLED
	select MUX
	select MUX_NXP_INPUTMUX
	help
	  Zephyr clock_monitor back-end for the NXP FREQME peripheral.
	  Routes the reference and target clocks through the INPUTMUX mux
	  subsystem and queries the reference rate from clock_control. Supports
	  both MEASURE (one-shot) and WINDOW (continuous MIN/MAX threshold)
	  modes, built on the FREQME frequency-measurement operate mode.
```

## drivers/clock_monitor/Kconfig.nxp_sfa
```kconfig
# SPDX-FileCopyrightText: 2026 NXP
# SPDX-License-Identifier: Apache-2.0

config CLOCK_MONITOR_NXP_SFA
	bool "NXP SFA (Signal Frequency Analyser) driver"
	default y
	depends on DT_HAS_NXP_SFA_ENABLED
	help
	  Zephyr clock_monitor back-end for the NXP Signal Frequency Analyser,
	  Supports MEASURE (one-shot) and WINDOW (monitor mode with low/high
	  limit interrupts).
```

## drivers/comparator/Kconfig.adc
```kconfig
# Copyright 2026 Google LLC
# SPDX-License-Identifier: Apache-2.0

config COMPARATOR_ADC
	bool "ADC voltage comparator driver"
	default y
	depends on DT_HAS_ADC_COMPARATOR_ENABLED
	depends on ADC
	help
	  Enable the ADC-backed voltage comparator driver.
```

## drivers/comparator/Kconfig.infineon_lpcomp
```kconfig
# SPDX-FileCopyrightText: Copyright (c) 2026 Infineon Technologies AG,
# SPDX-FileCopyrightText: or an affiliate of Infineon Technologies AG. All rights reserved.
#
# SPDX-License-Identifier: Apache-2.0


config COMPARATOR_INFINEON_LPCOMP
	bool "Infineon LPCOMP driver"
	default y
	depends on DT_HAS_INFINEON_LP_COMP_ENABLED
	select USE_INFINEON_LPCOMP
```

## drivers/comparator/Kconfig.mchp
```kconfig
# Copyright (c) 2025 Microchip Technology Inc.
# SPDX-License-Identifier: Apache-2.0

config COMPARATOR_MCHP_AC_G1
	bool "Microchip Comparator Driver for AC G1 Peripherals"
	default y
	depends on DT_HAS_MICROCHIP_AC_G1_COMPARATOR_ENABLED
	select PINCTRL
	help
	  Enable support for the Microchip Comparator driver
	  on G1 AC peripherals.

config COMPARATOR_MCHP_AC_G2
	bool "Microchip AC G2 comparator driver"
	default y
	depends on DT_HAS_MICROCHIP_AC_G2_COMPARATOR_ENABLED
	select PINCTRL
	help
	  Enable the driver for the Microchip AC G2 analog comparator.
```

## drivers/comparator/Kconfig.mspm0_comp
```kconfig
# TI MSPM0 Family

# Copyright (c) 2026, Linumiz
# SPDX-License-Identifier: Apache-2.0

config COMPARATOR_MSPM0
	bool "TI MSPM0 Comparator driver"
	default y
	depends on DT_HAS_TI_MSPM0_COMPARATOR_ENABLED
	select PINCTRL
	select SHARED_INTERRUPTS
	help
	  Enable driver for the Texas Instruments MSPM0 series comparators.
	  Supports reference voltage configuration and internal DAC control.

if COMPARATOR_MSPM0

config COMPARATOR_MSPM0_WINDOW_MODE
	bool
	default y if SOC_SERIES_MSPM0G
	help
	  Window comparator mode (auto-enabled for MSPM0G series).

config COMPARATOR_MSPM0_ANALOG_COMPARISON
	bool
	default y if SOC_SERIES_MSPM33C
	help
	  Analog comparison wakeup sequencer. Lets the comparator wake the
	  device from STOP mode by auto-sequencing through up to 4 preset
	  DAC reference levels on separate VMON inputs.

endif # COMPARATOR_MSPM0
```

## drivers/comparator/Kconfig.nxp_lpacmp
```kconfig
# SPDX-FileCopyrightText: Copyright 2026 NXP
# SPDX-License-Identifier: Apache-2.0

config COMPARATOR_NXP_LPACMP
	bool "NXP LPACMP comparator driver"
	default y
	depends on DT_HAS_NXP_LPACMP_ENABLED
	select CLOCK_CONTROL
	help
	  Enable the NXP Low-Power Analog Comparator (LPACMP) driver.
```

## drivers/comparator/Kconfig.ti_lpf3_lpcmp
```kconfig
# Copyright 2026 Texas Instruments
# SPDX-License-Identifier: Apache-2.0

config COMPARATOR_TI_LPF3_LPCMP
	bool "Texas Instruments LPF3 LPCMP comparator driver"
	default y
	depends on DT_HAS_TI_LPF3_LPCMP_ENABLED
	select PINCTRL
```

## drivers/comparator/Kconfig.wch_ch5xx
```kconfig
# SPDX-FileCopyrightText: 2026 SMILE (smile.eu)
# SPDX-License-Identifier: Apache-2.0

config COMPARATOR_WCH_CH5XX
	bool "WCH CH5xx comparator driver"
	default y
	depends on DT_HAS_WCH_CH5XX_COMPARATOR_ENABLED
	depends on PINCTRL
```

## drivers/console/Kconfig.bk7258
```kconfig
# Copyright (c) 2026 Beken Corporation
# SPDX-License-Identifier: Apache-2.0

config BK7258_MBOX_CONSOLE
	bool "Beken BK7258: forward printk over the mailbox LOG channel"
	default n
	depends on SOC_BK7258
	select PRINTK
	help
	  This core has no UART of its own: UART0 belongs to the peer.
	  Without this option the only way to print is to write straight into the
	  FIFO of the port the peer is using, relying on UART_BK7258_NO_HW_INIT to
	  keep its hands off that core's UART registers -- which works, but takes
	  over the peer's device.

	  With this option the printk output is accumulated into lines and sent to
	  the peer over the LOG logical channel (0x1E, MB_CMD_LOG_OUT), and the
	  peer prints it to UART0. Verified on hardware: the peer prints the
	  strings verbatim.

	  With this enabled:
	    - printk / LOG_* output goes over the mailbox instead of the UART TX
	      FIFO
	    - before the mailbox is up (PRE_KERNEL) it still falls back to the
	      previous hook, i.e. the UART, so the board is not blind from the
	      moment it powers on
	    - a line is dropped when the mailbox channel is busy (losing one line
	      of console output is acceptable; blocking interrupt context for it is
	      not)

	  Note that the peer prints the string as-is, without an ap0:/ap1: prefix.

	  The line length and the rotating slots are properties of the mailbox
	  transport, not of this driver, and live in soc.h as
	  SOC_MB_LOG_LINE_LEN. The shell transport (SERIAL_BK7258_MBOX) uses the
	  same primitive, so a second copy of them would only drift.
```

## drivers/counter/Kconfig.cc27xx_lgpt
```kconfig
# Copyright (c) 2025 Texas Instruments Incorporated
# SPDX-License-Identifier: Apache-2.0

config COUNTER_CC27XX_LGPT
	bool "CC27xx Counter driver based on the LGPT Timer"
	default y
	depends on DT_HAS_TI_CC27XX_LGPT_ENABLED
	help
	  Enable counter driver based on LGPT timer for CC27xx devices.
```

## drivers/counter/Kconfig.cc35xx
```kconfig
# Copyright (c) 2025 Conclusive Engineering Sp. z o.o.
#
# SPDX-License-Identifier: Apache-2.0

config COUNTER_CC35XX_LGPT
	bool "TI CC35XX Counter Driver"
	depends on DT_HAS_TI_CC35XX_LGPT_ENABLED
	help
	  Enables the Counter driver for TI CC35XX devices.
```

## drivers/counter/Kconfig.gpio
```kconfig
# SPDX-FileCopyrightText: Copyright RAKwireless Technology Limited
# SPDX-License-Identifier: Apache-2.0

config COUNTER_GPIO
	bool "Kernel clock counter with GPIO capture"
	default y
	depends on DT_HAS_ZEPHYR_COUNTER_GPIO_ENABLED
	select GPIO
	help
	  Counter that reads the kernel clock and captures on GPIO edges, for
	  boards whose timer hardware does not reach the pin an event arrives
	  on.
```

## drivers/counter/Kconfig.infineon_tcpwm
```kconfig
# SPDX-FileCopyrightText: Copyright (c) 2026 Infineon Technologies AG,
# SPDX-FileCopyrightText: or an affiliate of Infineon Technologies AG. All rights reserved.
#
# SPDX-License-Identifier: Apache-2.0

config COUNTER_INFINEON_TCPWM
	bool "Infineon TCPWM counter driver"
	default y
	depends on DT_HAS_INFINEON_TCPWM_COUNTER_ENABLED
	depends on !COUNTER_INFINEON_TCPWM_GRP
	select USE_INFINEON_TIMER
	help
	  This option enables the TCPWM counter driver for Infineon devices.

config COUNTER_INFINEON_TCPWM_GRP
	bool "Infineon TCPWM group counter driver"
	default y
	depends on DT_HAS_INFINEON_TCPWM_COUNTER_ENABLED
	depends on !SOC_FAMILY_INFINEON_PSOC4
	select CLOCK_CONTROL
	help
	  Register-level counter driver for the Infineon TCPWM peripheral.
```

## drivers/counter/Kconfig.mcux_lptmr
```kconfig
# MCUXpresso SDK Low Power Timer (LPTMR)

# Copyright (c) 2020 Vestas Wind Systems A/S
# Copyright 2026 NXP
# SPDX-License-Identifier: Apache-2.0

DT_CHOSEN_SYSTEM_TIMER_COMPANION := zephyr,system-timer-companion
DT_COMPAT_NXP_LPTMR := nxp,lptmr

config COUNTER_MCUX_LPTMR
	bool "MCUX LPTMR driver"
	default y
	depends on DT_HAS_NXP_LPTMR_ENABLED
	help
	  Enable support for the MCUX Low Power Timer (LPTMR).

config COUNTER_MCUX_LPTMR_ALARM
	bool "LPTMR alarm support"
	depends on COUNTER_MCUX_LPTMR
	default y if SYSTEM_TIMER_LPM_COMPANION_COUNTER && \
		$(dt_chosen_has_compat,$(DT_CHOSEN_SYSTEM_TIMER_COMPANION),$(DT_COMPAT_NXP_LPTMR))
	help
	  LPTMR is a commonly used wake-up source for many NXP MCUs and
	  may be used as the companion low-power timer for the Cortex-M
	  systick. Enabling single-shot alarm support requires reprogramming
	  the hardware compare register (COMPARE/CMR), which is the same
	  resource used for the periodic TOP callback. Because of this
	  hardware limitation, this Kconfig option selects whether alarm
	  support is enabled. When alarm support is enabled the driver will
	  not allow set TOP operation at runtime (attempts to set TOP will
	  return -ENOTSUP); When alarm support is disabled the driver will
	  not allow set and cancel ALARM operation at runtime (attempts to
	  set and cancel ALARM will return -ENOTSUP). Choose the configuration
	  that matches your application's requirements.

	  It defaults to enabled when this timer is the chosen system timer
	  low-power companion: the companion is armed through a single-shot
	  alarm, so without it the system timer cannot recover the time spent
	  in a low-power state.

if COUNTER_MCUX_LPTMR_ALARM
comment "NOTE: Enabling LPTMR ALARM disables set TOP operation and driver will return -ENOTSUP."
endif
```

## drivers/counter/Kconfig.mcux_tpm
```kconfig
# MCUXpresso SDK TPM

# Copyright 2023-2024, 2026 NXP
# SPDX-License-Identifier: Apache-2.0

config COUNTER_MCUX_TPM
	bool "MCUX TPM counter driver"
	default y
	depends on DT_HAS_NXP_TPM_TIMER_ENABLED
	select COUNTER_SUPPORTS_CAPTURE
	select PINCTRL if COUNTER_CAPTURE
	help
	  Enable support for mcux Timer PWM Module (TPM) counter driver.
```

## drivers/counter/Kconfig.mcux_tstmr
```kconfig
# SPDX-FileCopyrightText: Copyright 2026 NXP
# SPDX-License-Identifier: Apache-2.0

# MCUXpresso SDK Time Stamp Timer (TSTMR)

config COUNTER_MCUX_TSTMR
	bool "MCUX Time Stamp Timer (TSTMR) driver"
	default y
	depends on DT_HAS_NXP_TSTMR_ENABLED
	select COUNTER_SUPPORTS_64BITS_TICKS
	help
	  Enable support for the NXP Time Stamp Timer (TSTMR).
	  TSTMR is a 56-bit, free-running up-counter; its frequency is
	  SoC-specific (see the clock-frequency devicetree property). It does
	  not provide compare, alarm, top-value, or interrupt functionality.

config COUNTER_MCUX_TSTMR_SYSCTR_BACKEND
	bool
	default y
	depends on COUNTER_MCUX_TSTMR && DT_HAS_NXP_SYSCTR_ENABLED
	help
	  Selected automatically when the TSTMR driver is built on a SoC that
	  also has an nxp,sysctr node enabled.  On these SoCs the TSTMR is a
	  read-only view of the shared SYS_CTR hardware, so the driver needs
	  to access SYS_CTR_CONTROL registers to enable and settle the counter.
	  When this symbol is not set (standalone TSTMR without SYS_CTR, e.g.
	  MCXW or i.MX8ULP) those register accesses are compiled out entirely.
```

## drivers/counter/Kconfig.rv3028_counter
```kconfig
# Copyright (c) 2025 BayLibre, SAS
# Copyright (c) 2026 Janez Ugovsek <janez@ugovsek.info>
# SPDX-License-Identifier: Apache-2.0

config COUNTER_RV3028
	bool "Micro Crystal RV3028 counter driver"
	default y
	depends on DT_HAS_MICROCRYSTAL_RV3028_COUNTER_ENABLED
	depends on DT_HAS_MICROCRYSTAL_RV3028_ENABLED
	select MFD
	help
	  Enable the counter/timer child driver for the Micro Crystal RV3028.
	  The hardware timer is exposed through the counter API.
```

## drivers/counter/Kconfig.ti_am3352_eqep
```kconfig
# SPDX-FileCopyrightText: Copyright (c) 2026 Texas Instruments
# SPDX-License-Identifier: Apache-2.0

config COUNTER_TI_AM3352_EQEP
	bool "Whether to enable TI EQEP counter driver"
	default y
	depends on DT_HAS_TI_AM3352_EQEP_ENABLED
	depends on CLOCK_CONTROL
	select PINCTRL
	help
	  Enables the TI EQEP counter driver.

if COUNTER_TI_AM3352_EQEP
config COUNTER_TI_AM3352_EQEP_VARIANT_AM13
	bool "TI EQEP AM13E variant (QEPSRCSEL, Input X-BAR, PWREN)"
	depends on SOC_SERIES_AM13E
	default y
	select MUX
	select SYSCON
	help
	  Enable AM13E EQEP support: QEPSRCSEL, mux-states X-BAR routing,
	  and SYSCTL PWREN via ti,pwren.
endif
```

## drivers/crc/Kconfig.msp
```kconfig
# Copyright (c) 2026 Texas Instruments Inc.
# SPDX-License-Identifier: Apache-2.0

config CRC_TI_MSP
	bool "TI MSP CRC driver"
	default y
	depends on DT_HAS_TI_MSP_CRC_ENABLED
	select CRC_DRIVER_HAS_CRC16_CCITT
	select CRC_DRIVER_HAS_CRC32_IEEE
	help
	  Enable CRC hardware driver for Texas Instruments MSP
	  microcontrollers.
```

## drivers/crc/Kconfig.mspm0
```kconfig
# Copyright (c) 2026 Texas Instruments Inc.
# SPDX-License-Identifier: Apache-2.0

config CRC_TI_MSPM0
	bool "TI MSPM0 CRC driver"
	default y
	depends on DT_HAS_TI_MSPM0_CRC_ENABLED
	select CRC_DRIVER_HAS_CRC16_CCITT
	select CRC_DRIVER_HAS_CRC32_IEEE
	help
	  Enable CRC hardware driver for Texas Instruments MSP
	  microcontrollers.

config CRC_TI_MSPM0_CRCP
	bool "TI MSPM0 CRC-P driver"
	default y
	depends on DT_HAS_TI_MSPM0_CRCP_ENABLED
	select CRC_DRIVER_HAS_CRC16
	select CRC_DRIVER_HAS_CRC16_CCITT
	select CRC_DRIVER_HAS_CRC16_REFLECT
	select CRC_DRIVER_HAS_CRC16_ANSI
	select CRC_DRIVER_HAS_CRC16_ITU_T
	select CRC_DRIVER_HAS_CRC32_C
	select CRC_DRIVER_HAS_CRC32_IEEE
	select CRC_DRIVER_HAS_CRC32_K_4_2
	select CRC_DRIVER_HAS_CRC32_MPEG2
	help
	  Enable CRCP hardware driver for Texas Instruments MSP
	  microcontrollers.
```

## drivers/crypto/Kconfig.bee
```kconfig
# Copyright (c) 2026, Realtek Semiconductor Corporation
# SPDX-License-Identifier: Apache-2.0

config CRYPTO_BEE_AES
	bool "Realtek Bee AES hardware accelerator"
	default y
	depends on DT_HAS_REALTEK_BEE_AES_ENABLED
	help
	  Enable the AES hardware accelerator driver for Realtek Bee family
	  SoCs (RTL8752H, RTL87x2G). Supports AES-128 and AES-256 in ECB,
	  CBC, and CTR modes.

if CRYPTO_BEE_AES

config CRYPTO_BEE_AES_SESSIONS_MAX
	int "Maximum number of concurrent AES sessions"
	default 4
	range 1 32
	help
	  Maximum number of concurrent AES cipher sessions. Each session
	  uses approximately 64 bytes of RAM.

config CRYPTO_BEE_AES_SWAP_BUF
	bool
	default y if SOC_SERIES_RTL8752H
	help
	  Enable byte swapping before and after calling the AES hardware engine.
	  RTL8752H requires this to match the hardware engine word order, while
	  RTL87x2G accepts buffers in normal byte order and should leave this off.

endif # CRYPTO_BEE_AES

config CRYPTO_BEE_SHA256
	bool "Realtek Bee SHA-256 hardware accelerator"
	default y
	depends on DT_HAS_REALTEK_BEE_SHA256_ENABLED
	help
	  Enable the SHA-256 hardware accelerator driver for Realtek Bee
	  SoCs (RTL8752H, RTL87x2G). Supports one-shot SHA-256 calculation.
```
