## drivers/i3c/Kconfig
```kconfig
# I3C configuration options
#
# Copyright (c) 2022 Intel Corporation
#
# SPDX-License-Identifier: Apache-2.0

menuconfig I3C
	bool "Improved Inter-Integrated Circuit (I3C) bus drivers"
	help
	  Enable I3C Driver Configuration

if I3C

module = I3C
module-str = i3c
source "subsys/logging/Kconfig.template.log_config"

config I3C_SHELL
	bool "I3C Shell"
	depends on SHELL
	help
	  Enable I3C Shell.

	  The I3C shell supports info, bus recovery, CCC, I3C read and
	  write operations.

config I3C_TARGET_BUFFER_MODE
	bool "I3C target driver for buffer mode"
	help
	  This is an option to enable buffer mode.

menuconfig I3C_USE_IBI
	bool "Use In-Band Interrupt (IBI)"
	default y
	help
	  Enable this to use In-Band Interrupt (IBI).

	  Says Y if unsure.

if I3C_USE_IBI

config I3C_IBI_MAX_PAYLOAD_SIZE
	int "Maximum IBI Payload Size"
	default 16
	help
	  Maxmium IBI payload size.

menuconfig I3C_IBI_WORKQUEUE
	bool "Use IBI Workqueue"
	help
	  Use global workqueue for processing IBI.

	  This is enabled by driver if needed.

if I3C_IBI_WORKQUEUE

config I3C_IBI_WORKQUEUE_STACK_SIZE
	int "IBI workqueue stack size"
	default 1024
	help
	  Stack size for the IBI global workqueue.

config I3C_IBI_WORKQUEUE_PRIORITY
	int "IBI workqueue thread priority"
	default -1
	help
	  Thread priority for the IBI global workqueue.

config I3C_IBI_WORKQUEUE_LENGTH
	int "IBI workqueue queue length"
	default 8
	help
	  Define the maximum number of IBIs that can be
	  queued in the workqueue.

config I3C_IBI_WORKQUEUE_VERBOSE_DEBUG
	bool "Verbose debug messages for IBI workqueue"
	help
	  This turns on verbose debug for the IBI workqueue
	  when logging level is set to DEBUG, and prints
	  the IBI payload.

endif # I3C_IBI_WORKQUEUE

endif # I3C_USE_IBI

comment "Initialization Priority"

config I3C_CONTROLLER_INIT_PRIORITY
	int "I3C Controller Init Priority"
	# Default is just after CONFIG_KERNEL_INIT_PRIORITY_DEVICE
	default 50
	help
	  This is for setting up I3C controller device driver instance
	  and also to perform bus initialization (e.g. dynamic address
	  assignment).

	  Note that this needs to be done before the device driver
	  instances of the connected I2C and I3C devices start
	  initializing those devices. This is because some devices
	  may not be addressable until addresses are assigned by
	  the controller.

config I3C_INIT_RSTACT
	bool "Perform Reset Action During Bus Initialization"
	default y
	help
	  This determines whether the bus initialization routine
	  sends a reset action command to I3C targets.

config I3C_NUM_OF_DESC_MEM_SLABS
	int "Number of I3C Device Descriptors Mem Slabs"
	default 3
	help
	  This is the number of memory slabs allocated from when
	  there is a device encounted through ENTDAA or DEFTGTS that
	  is not within known I3C devices.

config I3C_I2C_NUM_OF_DESC_MEM_SLABS
	int "Number of I2C Device Descriptors Mem Slabs"
	default 3
	help
	  This is the number of memory slabs allocated from when
	  there is a device encounted through DEFTGTS that is not
	  within known I2C devices.

config I3C_RTIO
	bool "I3C RTIO API"
	select EXPERIMENTAL
	select RTIO
	select RTIO_WORKQ
	help
	  API and implementations of I3C for RTIO

if I3C_RTIO
config I3C_RTIO_SQ_SIZE
	int "Submission queue size for blocking calls"
	default 4
	help
	  Blocking i3c calls when I3C_RTIO is enabled are copied into a per driver
	  submission queue. The queue depth determines the number of possible i3c_msg
	  structs that may be in the array given to i3c_transfer. A sensible default
	  is going to be 4 given the device address, register address, and a value
	  to be read or written.

config I3C_RTIO_CQ_SIZE
	int "Completion queue size for blocking calls"
	default 4
	help
	  Blocking i3c calls when I3C_RTIO is enabled are copied into a per driver
	  submission queue. The queue depth determines the number of possible i3c_msg
	  structs that may be in the array given to i3c_transfer. A sensible default
	  is going to be 4 given the device address, register address, and a value
	  to be read or written.

config I3C_RTIO_FALLBACK_MSGS
	int "Number of available i3c_msg structs for the default handler to use"
	default 4
	help
		When RTIO is used with a driver that does not yet implement the submit API
		natively the submissions are converted back to struct i3c_msg values that
		are given to i3c_transfer. This requires some number of msgs be available to convert
		the submissions into on the stack. MISRA rules dictate we must know this in
		advance.

		In all likelihood 4 is going to work for everyone, but in case you do end up with
		an issue where you are using RTIO, your driver does not implement submit natively,

endif # I3C_RTIO

comment "Device Drivers"

rsource "Kconfig.nxp"
rsource "Kconfig.cdns"
rsource "Kconfig.npcx"
rsource "Kconfig.dw"
rsource "Kconfig.test"
rsource "Kconfig.stm32"

endif # I3C
```

## drivers/i3c/Kconfig.cdns
```kconfig
# Copyright (c) 2022 Meta Platforms, Inc. and its affiliates.
#
# SPDX-License-Identifier: Apache-2.0

module = I3C_CADENCE
module-str = i3c-cadence
source "subsys/logging/Kconfig.template.log_config"

config I3C_CADENCE
	bool "Cadence I3C driver"
	select I3C_IBI_WORKQUEUE if I3C_USE_IBI && I3C_CONTROLLER
	depends on DT_HAS_CDNS_I3C_ENABLED
	default y
	help
	  Enable Cadence I3C driver.

if I3C_CADENCE

config I3C_CADENCE_IDLE_TIMEOUT_US
	int "I3C Idle Timeout (us)"
	default 250
	help
	  The timeout value waiting for to entry I3C idle state.
	  This is due to the odd state machine of the I3C peripheral,
	  where it can be not in an idle state for a while after a transfer
	  is complete, and it does another transfer before it goes to idle.
	  It needs to wait for it to be back in the idle state before it can
	  start another transfer.

config I3C_CADENCE_TRANSFER_TIMEOUT_MARGIN_US
	int "I3C Transfer Timeout Margin (us)"
	default 10000
	help
	  Extra margin in microseconds added on top of the calculated
	  transfer time when computing the transfer completion timeout.
	  The base timeout is derived from the number of bits to be
	  transferred and the SCL frequency.

config I3C_CADENCE_RTIO
	bool "Cadence I3C native RTIO submit path"
	depends on I3C_RTIO
	select I2C
	select I2C_RTIO
	default n
	help
	  Drive the Cadence I3C controller's CMD/TX/RX FIFOs from the RTIO
	  submit path. Replaces i3c_iodev_submit_fallback. Handles
	  RTIO_OP_TX / RX / TINY_TX / I3C_CCC in SDR controller mode, plus
	  HDR-DDR streaming via TX_THR / RX_THR thresholds. HDR-TS / HDR-BT
	  fall back to -ENOTSUP. Legacy i3c_xfers() and i3c_do_ccc() become
	  thin wrappers around i3c_rtio_transfer() / i3c_rtio_ccc(). I2C-on-I3C
	  transfers also funnel through the RTIO path (i2c_rtio_*).

config I3C_CADENCE_TARGET_RX_BUF_SIZE
	int "Cadence I3C target RX buffer size"
	default 256
	depends on I3C_TARGET_BUFFER_MODE
	help
	  Size in bytes of the buffer used by the Cadence I3C target to
	  accumulate received data before delivering it to the application
	  via buf_write_received_cb. Must be large enough to hold the
	  largest expected private write payload.

endif # I3C_CADENCE
```

## drivers/i3c/Kconfig.emul
```kconfig
# Copyright (c) 2026 Meta Platforms
# SPDX-License-Identifier: Apache-2.0

config I3C_EMUL
	bool "I3C emulator"
	default y
	depends on DT_HAS_ZEPHYR_I3C_EMUL_ENABLED
	depends on EMUL
	help
	  Fake I3C bus controller that dispatches to peripheral emulators
	  registered via EMUL_DT_DEFINE. Used for testing I3C drivers and
	  higher-level subsystems on native_sim without real hardware.

if I3C_EMUL

config I3C_EMUL_TARGET_TX_FIFO_SIZE
	int "Target-mode TX FIFO size (bytes)"
	default 64
	depends on I3C_TARGET
	help
	  Size of the per-controller target-mode TX FIFO. Bytes pushed via
	  i3c_target_tx_write() are consumed by subsequent controller-side
	  read transfers. Set to 0 to fall back to the read_requested /
	  read_processed callback path.

endif # I3C_EMUL
```

## drivers/i3c/Kconfig.it51xxx
```kconfig
# Copyright (c) 2025 ITE Corporation.
# SPDX-License-Identifier: Apache-2.0

module = I3C_IT51XXX
module-str = i3c-it51xxx
source "subsys/logging/Kconfig.template.log_config"

config I3CM_IT51XXX
	bool "it51xxx i3cm driver"
	depends on DT_HAS_ITE_IT51XXX_I3CM_ENABLED
	select PINCTRL
	select I3C_IBI_WORKQUEUE if I3C_USE_IBI
	select SOC_IT51XXX_CPU_IDLE_GATING
	default y
	help
	  Enable it51xxx i3c controller driver.

if I3CM_IT51XXX

config I3CM_IT51XXX_TRANSFER_TIMEOUT_MS
	int "Set the transfer timeout in milliseconds"
	default 1000

config I3CM_IT51XXX_DLM_SIZE
	int "it51xxx i3cm dlm data size"
	depends on I3CM_IT51XXX
	default 256
	help
	  Set i3cm data-local-memory(DLM) size.

endif # I3CM_IT51XXX

config I3CS_IT51XXX
	bool "it51xxx i3cs driver"
	depends on DT_HAS_ITE_IT51XXX_I3CS_ENABLED
	select PINCTRL
	select I3C_TARGET_BUFFER_MODE
	select SOC_IT51XXX_CPU_IDLE_GATING
	default y
	help
	  Enable it51xxx i3c target driver.

if I3CS_IT51XXX

config I3CS_IT51XXX_IBI_TIMEOUT_MS
	int "Set the IBI timeout in milliseconds"
	default 1000

choice
	bool "choose i3cs tx fifo size"
	default I3CS_TX_FIFO_16_BYTE

config I3CS_TX_FIFO_16_BYTE
	bool "16"

config I3CS_TX_FIFO_32_BYTE
	bool "32"

config I3CS_TX_FIFO_64_BYTE
	bool "64"

config I3CS_TX_FIFO_128_BYTE
	bool "128"

config I3CS_TX_FIFO_4096_BYTE
	bool "4096"
endchoice

config I3CS_IT51XXX_TX_FIFO_SIZE
	int "it51xxx i3cs tx fifo size"
	default 16 if I3CS_TX_FIFO_16_BYTE
	default 32 if I3CS_TX_FIFO_32_BYTE
	default 64 if I3CS_TX_FIFO_64_BYTE
	default 128 if I3CS_TX_FIFO_128_BYTE
	default 4096 if I3CS_TX_FIFO_4096_BYTE
	default 16
	help
	  Set i3cs tx fifo size size.

choice
	bool "choose i3cs rx fifo size"
	default I3CS_RX_FIFO_16_BYTE

config I3CS_RX_FIFO_16_BYTE
	bool "16"

config I3CS_RX_FIFO_32_BYTE
	bool "32"

config I3CS_RX_FIFO_64_BYTE
	bool "64"

config I3CS_RX_FIFO_128_BYTE
	bool "128"

config I3CS_RX_FIFO_4096_BYTE
	bool "4096"
endchoice

config I3CS_IT51XXX_RX_FIFO_SIZE
	int "it51xxx i3cs rx fifo size"
	default 16 if I3CS_RX_FIFO_16_BYTE
	default 32 if I3CS_RX_FIFO_32_BYTE
	default 64 if I3CS_RX_FIFO_64_BYTE
	default 128 if I3CS_RX_FIFO_128_BYTE
	default 4096 if I3CS_RX_FIFO_4096_BYTE
	default 16
	help
	  Set i3cs rx fifo size size.

endif # I3CS_IT51XXX
```

## drivers/i3c/Kconfig.max32
```kconfig
# Copyright (c) 2024 Analog Devices, Inc.
#
# SPDX-License-Identifier: Apache-2.0

module = I3C_MAX32
module-str = i3c-max32
source "subsys/logging/Kconfig.template.log_config"

config I3C_MAX32
	bool "Analog Devices MAX32 I3C driver"
	depends on DT_HAS_ADI_MAX32_I3C_ENABLED
	select PINCTRL
	select I3C_IBI_WORKQUEUE if I3C_USE_IBI
	default y
	help
	  I3C driver for MAX32 SoC family.
```

## drivers/i3c/Kconfig.mchp_xec
```kconfig
# Microchip MEC5 I3C configuration options

# Copyright (c) 2026 Microchip Technology Inc.
# SPDX-License-Identifier: Apache-2.0

config I3C_MCHP_XEC
	bool "Microchip MEC5 family I3C driver"
	depends on DT_HAS_MICROCHIP_XEC_I3C_ENABLED
	select PINCTRL
	select I3C_IBI_WORKQUEUE if I3C_USE_IBI
	default y
	help
	  Enable the Microchip XEC family I3C driver for those SoCs
	  including this I3C hardware.
```

## drivers/i3c/Kconfig.mec5
```kconfig
# Microchip MEC5 I3C configuration options

# Copyright (c) 2024 Microchip Technology Inc.
# SPDX-License-Identifier: Apache-2.0

config I3C_MCHP_MEC5
	bool "Microchip MEC5 family I3C driver"
	default y
	depends on DT_HAS_MICROCHIP_MEC5_I3C_ENABLED
	help
	  Enable the Microchip MEC5 family I3C driver.
```
