## drivers/i2s/Kconfig.ambiq
```kconfig
# Copyright (c) 2025 Ambiq Micro Inc.
# SPDX-License-Identifier: Apache-2.0

config I2S_AMBIQ
	bool "Ambiq I2S driver"
	default y
	depends on DT_HAS_AMBIQ_I2S_ENABLED
	select AMBIQ_HAL
	select AMBIQ_HAL_USE_I2S
	select PINCTRL
	help
	  Enable support for Ambiq I2S driver for Apollo 5 MCU.

if I2S_AMBIQ

config I2S_AMBIQ_HANDLE_CACHE
	bool "Turn on cache handling in I2S driver"
	default y
	depends on CACHE_MANAGEMENT && DCACHE
	help
	  Disable this if cache has been handled in upper layers.

config I2S_AMBIQ_BUFFER_ALIGNMENT
	int "Set the I2S DMA TCB buffer alignment"
	default DCACHE_LINE_SIZE if DCACHE
	help
	  I2S buffer should be 32bytes aligned when placed in cacheable region.

config I2S_AMBIQ_RX_BLOCK_COUNT
	int "RX queue length"
	default 4

config I2S_AMBIQ_TX_BLOCK_COUNT
	int "TX queue length"
	default 4

endif # I2S_AMBIQ
```

## drivers/i2s/Kconfig.ameba
```kconfig
# AMEBA I2S driver configuration options

# Copyright (c) 2026 Realtek Semiconductor Corp.
# SPDX-License-Identifier: Apache-2.0

menuconfig I2S_AMEBA
	bool "AMEBA MCU I2S controller driver"
	default y
	depends on DT_HAS_REALTEK_AMEBA_I2S_ENABLED
	select PINCTRL
	select DMA
	help
	  Enable I2S support on the AMEBA family of processors.

if I2S_AMEBA

config I2S_AMEBA_RX_BLOCK_COUNT
	int "RX queue length"
	default 4

config I2S_AMEBA_TX_BLOCK_COUNT
	int "TX queue length"
	default 4

config I2S_AMEBA_CHANNEL_EXT
	bool "AMEBA I2S controller support for more channels"
	default n
	help
	  Enable I2S support for 6~8 channels

endif # I2S_AMEBA
```

## drivers/i2s/Kconfig.atm
```kconfig
# I2S driver configuration options

# Copyright (c) 2025 Atmosic
# SPDX-License-Identifier: Apache-2.0

menuconfig I2S_ATM
	bool "Atmosic I2S driver"
	default y
	depends on DT_HAS_ATMOSIC_ATM_I2S_ENABLED
	select CONFIG_ATM_DMA
	help
	  Enable I2S support on the ATM family of processors.

if I2S_ATM

config I2S_SAMPLE_WIDTH_32
	bool
	default y

endif # I2S_ATM
```

## drivers/i2s/Kconfig.bcm2835
```kconfig
# Broadcom BCM2835 I2S / PCM controller
#
# Copyright (c) 2026 Jonathan Elliot Peace <jep@alphabetiq.com>
# SPDX-License-Identifier: Apache-2.0

config I2S_BCM2835
	bool "Broadcom BCM2835 I2S / PCM controller driver"
	default y
	depends on DT_HAS_BRCM_BCM2835_I2S_ENABLED
	select DMA
	select CACHE_MANAGEMENT
	help
	  Enable the driver for the BCM2835 / BCM2710 / BCM2837 PCM / I2S
	  controller -- the audio interface on the Raspberry Pi 40-pin
	  header. Master mode, I2S (Philips) format, 16-bit stereo;
	  sample buffers are streamed through the BCM2835 DMA controller's
	  cyclic-chain mode, paced by the PCM TX/RX DREQ lines.

if I2S_BCM2835

config I2S_BCM2835_TX_BLOCK_COUNT
	int "TX ring depth"
	default 4
	range 2 32
	help
	  Number of internal TX buffers the driver cycles through. Deeper
	  rings absorb more application-side jitter before an underrun.
	  Capped by DMA_BCM2835_MAX_CBS_PER_CHANNEL; bump that knob in
	  step if you raise this past its default.

config I2S_BCM2835_RX_BLOCK_COUNT
	int "RX ring depth"
	default 4
	range 2 32
	help
	  Number of internal RX buffers the driver cycles through. Deeper
	  rings tolerate more application-side latency before an overrun.
	  Capped by DMA_BCM2835_MAX_CBS_PER_CHANNEL; bump that knob in
	  step if you raise this past its default.

config I2S_BCM2835_MAX_BLOCK_SIZE
	int "Maximum I2S block size in bytes"
	default 4096
	range 64 65536
	help
	  Upper bound on i2s_config.block_size for this driver. Sized for
	  the worst-case ring buffer the driver statically reserves per
	  direction (ring depth * this value, cache-line aligned). The
	  default covers up to ~23 ms of stereo 16-bit at 44.1 kHz.

endif # I2S_BCM2835
```

## drivers/i2s/Kconfig.cavs
```kconfig
# Intel S1000 I2S configuration options

# Copyright (c) 2017 Intel Corporation
# SPDX-License-Identifier: Apache-2.0

config I2S_CAVS
	bool "Intel I2S (SSP) Bus Driver"
	depends on BOARD_INTEL_S1000_CRB
	select DMA
	help
	  Enable Inter Sound (I2S) bus driver for Intel_S1000 based on
	  Synchronous Serial Port (SSP) module.
```

## drivers/i2s/Kconfig.esp32
```kconfig
# Copyright (c) 2024 Espressif Systems (Shanghai) CO LTD
#
# SPDX-License-Identifier: Apache-2.0

config I2S_ESP32
	bool "ESP32 I2S driver"
	default y
	depends on DT_HAS_ESPRESSIF_ESP32_I2S_ENABLED
	select DMA if DT_HAS_ESPRESSIF_ESP32_GDMA_ENABLED
	help
	  Enables the ESP32 I2S driver (GDMA SoCs only).

if I2S_ESP32

config I2S_ESP32_RX_BLOCK_COUNT
	int "ESP32 I2S RX block count"
	default 5
	help
	  Max number of blocks waiting to be read from the I2S RX channel.

config I2S_ESP32_TX_BLOCK_COUNT
	int "ESP32 I2S TX block count"
	default 5
	help
	  Max number of blocks waiting to be transmitted by the I2S TX channel.

config I2S_ESP32_DMA_DESC_NUM_MAX
	int "ESP32 I2S number of link descriptors"
	default 10
	depends on !DT_HAS_ESPRESSIF_ESP32_GDMA_ENABLED
	help
	  Max number of link descriptor available for DMA transfers on each I2S channel

endif
```

## drivers/i2s/Kconfig.ifx_cat1
```kconfig
# Infineon CAT1 I2S configuration options

# Copyright (c) 2025 Infineon Technologies AG,
# or an affiliate of Infineon Technologies AG.
#
# SPDX-License-Identifier: Apache-2.0

config I2S_INFINEON
	bool "Infineon CAT1 I2S driver"
	default y
	depends on DT_HAS_INFINEON_I2S_ENABLED
	select USE_INFINEON_I2S
	select PINCTRL
	help
	  This option enables the I2S driver.

if I2S_INFINEON

config I2S_INFINEON_RX_QUEUE_SIZE
	int "RX queue length"
	default 8

config I2S_INFINEON_TX_QUEUE_SIZE
	int "TX queue length"
	default 8

endif # I2S_INFINEON
```

## drivers/i2s/Kconfig.infineon
```kconfig
# SPDX-FileCopyrightText: <text>Copyright (c) 2026 Infineon Technologies AG,
# or an affiliate of Infineon Technologies AG. All rights reserved.</text>
#
# SPDX-License-Identifier: Apache-2.0

# Infineon I2S configuration options

config I2S_INFINEON
	bool "Infineon I2S driver"
	default y
	depends on DT_HAS_INFINEON_I2S_ENABLED
	select USE_INFINEON_I2S
	select PINCTRL
	select DMA
	help
	  This option enables the I2S driver.

config I2S_INFINEON_V2
	bool "Infineon I2S driver based on i2s pdl"
	default y
	depends on DT_HAS_INFINEON_I2S_V2_ENABLED
	select USE_INFINEON_I2S
	select PINCTRL
	select DMA
	help
	  This option enables the I2S driver for Infineon TRAVEO T2G AUDIOSS block.

if I2S_INFINEON || I2S_INFINEON_V2

config I2S_INFINEON_RX_QUEUE_SIZE
	int "RX queue length"
	default 8
	help
	  This option sets the number elements allocated for the rx software
	  queue. This should match the number of blocks in the memory slab
	  that will hold the i2s receive data.

config I2S_INFINEON_TX_QUEUE_SIZE
	int "TX queue length"
	default 8
	help
	  This option sets the number elements allocated for the tx software
	  queue. This should match the number of blocks in the memory slab
	  that will hold the i2s transmit data.

endif # I2S_INFINEON
```

## drivers/i2s/Kconfig.litex
```kconfig
#
# Copyright (c) 2020 Antmicro <www.antmicro.com>
#
# SPDX-License-Identifier: Apache-2.0
#

menuconfig I2S_LITEX
	bool "Litex I2S driver"
	depends on SOC_RISCV32_LITEX_VEXRISCV
	help
		Enable Litex Inter Sound (I2S) bus driver.

if I2S_LITEX

config I2S_LITEX_RX_BLOCK_COUNT
	int "RX queue length"
	default 500

config I2S_LITEX_TX_BLOCK_COUNT
	int "TX queue length"
	default 500

config I2S_LITEX_CHANNELS_CONCATENATED
	bool "Channels placed without padding in fifo"

config I2S_LITEX_DATA_BIG_ENDIAN
	bool "Received data will be stored as big endian"

endif
```

## drivers/i2s/Kconfig.max32
```kconfig
# Copyright (c) 2025 Croxel Inc.
# SPDX-License-Identifier: Apache-2.0

config I2S_MAX32
	bool "Analog Devices MAX32 series I2S driver"
	default y
	depends on DT_HAS_ADI_MAX32_I2S_ENABLED
	select DMA
	help
	  Enable support for Analog Devices MAX32 series I2S driver.

if I2S_MAX32

config I2S_MAX32_QUEUE_SIZE
	int "Queue size"
	default 8
	help
	  Size of the Tx/Rx pending block queue. This is the maximum number of
	  blocks that can be queued for transmission or reception.

endif # I2S_MAX32
```

## drivers/i2s/Kconfig.mcux
```kconfig
# MCUX I2S driver configuration options

# Copyright (c) 2021, NXP
# SPDX-License-Identifier: Apache-2.0

menuconfig I2S_MCUX_SAI
	bool "NXP MCUX I2S controller driver"
	default y
	depends on DT_HAS_NXP_MCUX_I2S_ENABLED
	select DMA
	help
	  Enable I2S support on the I.MX family of processors.

if I2S_MCUX_SAI

config I2S_RX_BLOCK_COUNT
	int "RX queue length"
	default 4

config I2S_TX_BLOCK_COUNT
	int "TX queue length"
	default 4

config I2S_EDMA_BURST_SIZE
	int "I2S EDMA BURST SIZE"
	default 2
	help
	  I2S EDMA burst size in bytes.

endif # I2S_MCUX_SAI
```

## drivers/i2s/Kconfig.mcux_flexcomm
```kconfig
# Copyright (c) 2020, NXP
# SPDX-License-Identifier: Apache-2.0

config I2S_MCUX_FLEXCOMM
	bool "MCUX FLEXCOMM I2S driver"
	default y
	depends on DT_HAS_NXP_LPC_I2S_ENABLED
	select DMA
	help
	  Enable support for mcux flexcomm i2s driver.

if I2S_MCUX_FLEXCOMM

config I2S_MCUX_FLEXCOMM_RX_BLOCK_COUNT
	int "RX queue length"
	default 4

config I2S_MCUX_FLEXCOMM_TX_BLOCK_COUNT
	int "TX queue length"
	default 4

endif # I2S_MCUX_FLEXCOMM
```

## drivers/i2s/Kconfig.nrfx
```kconfig
# Copyright (c) 2021 Nordic Semiconductor ASA
# SPDX-License-Identifier: Apache-2.0

menuconfig I2S_NRFX
	bool "nRF I2S nrfx driver"
	default y
	depends on DT_HAS_NORDIC_NRF_I2S_ENABLED
	select NRFX_I2S0 if HAS_HW_NRF_I2S0
	select NRFX_I2S20 if HAS_HW_NRF_I2S20
	select PINCTRL
	help
	  Enable support for nrfx I2S driver for nRF MCU series.

if I2S_NRFX

config I2S_NRFX_RX_BLOCK_COUNT
	int "RX queue length"
	default 4

config I2S_NRFX_TX_BLOCK_COUNT
	int "TX queue length"
	default 4

config I2S_NRFX_ALLOW_MCK_BYPASS
	bool "Allow MCK bypass if a ratio exists"
	depends on SOC_SERIES_NRF53X
	help
	  Search for a supported ratio directly from MCK and LRCK
	  and enable bypass if a ratio exists. If not, fallback to
	  the standard MCK selection mechanism.

endif # I2S_NRFX

menuconfig I2S_NRF_TDM
	bool "nRF TDM driver"
	default y
	depends on DT_HAS_NORDIC_NRF_TDM_ENABLED
	select CLOCK_CONTROL
	select PINCTRL
	help
	  Enable support for TDM driver for nRF MCU series.

if I2S_NRF_TDM

config I2S_NRF_TDM_RX_BLOCK_COUNT
	int "RX queue length"
	default 4

config I2S_NRF_TDM_TX_BLOCK_COUNT
	int "TX queue length"
	default 4

endif # I2S_NRF_TDM
```

## drivers/i2s/Kconfig.renesas_ra
```kconfig
# Renesas RA Family

# Copyright (c) 2025 Renesas Electronics Corporation
# SPDX-License-Identifier: Apache-2.0

config I2S_RENESAS_RA_SSIE
	bool "Renesas RA I2S SSIE"
	default y
	depends on DT_HAS_RENESAS_RA_I2S_SSIE_ENABLED
	select USE_RA_FSP_SSI
	select PINCTRL
	help
	  Enable Renesas RA I2S SSIE Driver.

if I2S_RENESAS_RA_SSIE

config I2S_RENESAS_RA_SSIE_DTC
	bool "DTC on Transmission and Reception"
	default y
	select USE_RA_FSP_DTC
	help
	  Enable DTC on transmission and reception

config I2S_RENESAS_RA_SSIE_RX_BLOCK_COUNT
	int "RX queue length"
	default 4

config I2S_RENESAS_RA_SSIE_TX_BLOCK_COUNT
	int "TX queue length"
	default 4

endif # I2S_RENESAS_RA_SSIE
```

## drivers/i2s/Kconfig.sam_ssc
```kconfig
# Atmel SAM I2S bus driver configuration options

# Copyright (c) 2017 Piotr Mienkowski
# SPDX-License-Identifier: Apache-2.0

menuconfig I2S_SAM_SSC
	bool "Atmel SAM MCU family I2S (SSC) Bus Driver"
	default y
	depends on DT_HAS_ATMEL_SAM_SSC_ENABLED
	select DMA
	help
	  Enable Inter Sound (I2S) bus driver for Atmel SAM MCU family based on
	  Synchronous Serial Controller (SSC) module.

if I2S_SAM_SSC

config I2S_SAM_SSC_RX_BLOCK_COUNT
	int "RX queue length"
	default 4

config I2S_SAM_SSC_TX_BLOCK_COUNT
	int "TX queue length"
	default 4

config I2S_SAM_SSC_0_PIN_RF_EN
	bool "RF pin enabled"
	default y
	help
	  If enabled RF signal is connected to RF pin. It will be configured as
	  an output or an input depending on whether the receiver is working
	  in master or slave mode.

	  If disabled RF signal is disconnected from RF pin and connected
	  internally to TF (Transmitter Frame Synchro signal).

config I2S_SAM_SSC_0_PIN_RK_EN
	bool "RK pin enabled"
	default y
	help
	  If enabled RK signal is connected to RK pin. It will be configured as
	  an output or an input depending on whether the receiver is working
	  in master or slave mode.

	  If disabled RK signal is disconnected from RK pin and connected
	  internally to TK (Transmitter Clock signal).

endif # I2S_SAM_SSC
```

## drivers/i2s/Kconfig.shell
```kconfig
# SPDX-FileCopyrightText: Copyright (c) 2026 Linumiz
# SPDX-License-Identifier: Apache-2.0

menuconfig I2S_SHELL
	bool "I2S shell"
	depends on SHELL
	help
	  Enable the 'i2s' shell: stream a generated test tone over any I2S
	  controller ('i2s tone' / 'i2s stop' / 'i2s info'). Transport only;
	  pair it with the 'codec' shell to route the audio through a codec.

if I2S_SHELL

config I2S_SHELL_STACK_SIZE
	int "I2S shell streaming thread stack size"
	default 1024
	help
	  Stack size for the background thread that feeds PCM blocks to I2S.

config I2S_SHELL_THREAD_PRIO
	int "I2S shell streaming thread priority"
	default 5
	help
	  Priority of the I2S feeder thread.

config I2S_SHELL_BLOCK_FRAMES
	int "Frames per I2S TX block (16-bit)"
	default 64
	help
	  Number of stereo frames in each TX block for 16-bit audio. For 24/32-bit
	  audio, words occupy 4 bytes, so the same block size corresponds to half as
	  many frames per block.

config I2S_SHELL_BLOCK_COUNT
	int "Number of I2S TX blocks"
	default 8
	help
	  Number of blocks in the TX slab. More blocks means more buffering
	  at the cost of RAM.

endif # I2S_SHELL
```

## drivers/i2s/Kconfig.siwx91x
```kconfig
# Copyright (c) 2025 Silicon Laboratories Inc.
# SPDX-License-Identifier: Apache-2.0

menuconfig I2S_SILABS_SIWX91X
	bool "Silabs Siwx91x MCU I2S controller driver"
	default y
	depends on DT_HAS_SILABS_SIWX91X_I2S_ENABLED
	depends on CLOCK_CONTROL
	select CACHE_MANAGEMENT if CPU_HAS_DCACHE
	select DMA
	select PINCTRL
	select GPIO
	help
	  Enable I2S support on the Siwx91x family.

if I2S_SILABS_SIWX91X

config I2S_SILABS_SIWX91X_RX_BLOCK_COUNT
	int "RX queue length"
	default 4

config I2S_SILABS_SIWX91X_TX_BLOCK_COUNT
	int "TX queue length"
	default 4

config I2S_SILABS_SIWX91X_DMA_MAX_BLOCKS
	int "Maximum DMA transfer block per channel for a transaction."
	default 16
	help
	  One block is needed for every 1024 bytes

endif # I2S_SILABS_SIWX91X
```

## drivers/i2s/Kconfig.test
```kconfig
# Copyright (c) 2024 TOKITA Hiroshi
# SPDX-License-Identifier: Apache-2.0

config I2S_TEST
	def_bool DT_HAS_VND_I2S_ENABLED
	depends on DT_HAS_VND_I2S_ENABLED
```
