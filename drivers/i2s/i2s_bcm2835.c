/*
 * Copyright (c) 2026 Jonathan Elliot Peace <jep@alphabetiq.com>
 *
 * SPDX-License-Identifier: Apache-2.0
 *
 * Broadcom BCM2835 / BCM2710 / BCM2837 PCM (I2S) controller driver.
 *
 * Master mode, 16-bit stereo I2S (Philips) format, frame-packed.
 * Buffers stream through the BCM2835 DMA controller in cyclic mode;
 * completion callbacks fire at block boundaries. Slave / target-clock
 * mode is rejected at configure() and remains a TODO.
 *
 * configure() requires block_size >= 256 bytes (one full FIFO depth),
 * mirroring Linux's bcm2835-i2s snd_pcm_hw_constraint_minmax: with
 * smaller blocks the pre-TXON DMA burst crosses the CB[0] -> CB[1]
 * boundary before the application populates slot[1], emitting one
 * FIFO-headroom of zeros at the head of every stale slot.
 *
 * The PCM bit clock is generated by the SoC clock manager (CPRMAN),
 * not by this peripheral. cm_pcm_set_rate() programs that divider
 * directly off the 19.2 MHz oscillator; there is no Zephyr clock-
 * control driver for CPRMAN yet.
 *
 * Reference: BCM2835 ARM Peripherals datasheet ch. 8 (PCM); Linux
 * sound/soc/bcm/bcm2835-i2s.c (register map, FIFO-clear handshake)
 * and drivers/clk/bcm/clk-bcm2835.c (PCM clock divider).
 */

#define DT_DRV_COMPAT brcm_bcm2835_i2s

#include <string.h>

#include <zephyr/cache.h>
#include <zephyr/device.h>
#include <zephyr/drivers/dma.h>
#include <zephyr/drivers/i2s.h>
#include <zephyr/drivers/pinctrl.h>
#include <zephyr/kernel.h>
#include <zephyr/logging/log.h>
#include <zephyr/sys/device_mmio.h>
#include <zephyr/sys/sys_io.h>
#include <zephyr/sys/util.h>

LOG_MODULE_REGISTER(i2s_bcm2835, CONFIG_I2S_LOG_LEVEL);

/* PCM register offsets (BCM2835 ARM Peripherals datasheet ch. 8). */
#define I2S_CS_A     0x00U /* control and status */
#define I2S_FIFO_A   0x04U /* TX / RX data FIFO port */
#define I2S_MODE_A   0x08U /* mode: frame + clock format */
#define I2S_RXC_A    0x0cU /* RX channel 1 / 2 config */
#define I2S_TXC_A    0x10U /* TX channel 1 / 2 config */
#define I2S_DREQ_A   0x14U /* DMA request thresholds */
#define I2S_INTEN_A  0x18U /* interrupt enables */
#define I2S_INTSTC_A 0x1cU /* interrupt status (W1C) */
#define I2S_GRAY     0x20U /* GRAY-code mode */

/* CS_A bits. */
#define CS_EN       BIT(0)      /* enable the PCM block */
#define CS_RXON     BIT(1)      /* receive on */
#define CS_TXON     BIT(2)      /* transmit on */
#define CS_TXCLR    BIT(3)      /* clear TX FIFO (2 PCM cycles) */
#define CS_RXCLR    BIT(4)      /* clear RX FIFO (2 PCM cycles) */
#define CS_TXTHR(v) ((v) << 5)  /* TX FIFO DMA-request threshold */
#define CS_RXTHR(v) ((v) << 7)  /* RX FIFO DMA-request threshold */
#define CS_DMAEN    BIT(9)      /* generate TX/RX DREQs */
#define CS_TXERR    BIT(15)     /* TX FIFO error (W1C) */
#define CS_RXERR    BIT(16)     /* RX FIFO error (W1C) */
#define CS_TXW      BIT(17)     /* TX FIFO below TXTHR (= 1/4 full @ TXTHR=1) */
#define CS_SYNC     BIT(24)     /* sync flag -- FIFO-clear timing handshake */
#define CS_STBY     BIT(25)     /* set to leave standby (4 PCM cycles) */

/* MODE_A bits. */
#define MODE_FSLEN(v) ((v) << 0)  /* frame sync pulse length */
#define MODE_FLEN(v)  ((v) << 10) /* frame length - 1 */
#define MODE_FSI      BIT(20)     /* frame sync inverted (falling edge) */
#define MODE_FSM      BIT(21)     /* frame sync target (slave) */
#define MODE_CLKI     BIT(22)     /* clock inverted */
#define MODE_CLKM     BIT(23)     /* bit clock target (slave) */
#define MODE_FTXP     BIT(24)     /* TX frame-packed (2ch / 32-bit word) */
#define MODE_FRXP     BIT(25)     /* RX frame-packed */

/* RXC_A / TXC_A: channel 1 in bits 31..16, channel 2 in bits 15..0. */
#define CHWID(v) ((v) << 0)  /* channel width: data_bits - 8 */
#define CHPOS(v) ((v) << 4)  /* channel data position within the frame */
#define CHEN     BIT(14)     /* channel enable */
#define CH1(v)   ((v) << 16)
#define CH2(v)   ((v) << 0)

/* DREQ_A: FIFO levels at which a DREQ / panic is asserted. */
#define DREQ_RX(v)       ((v) << 0)
#define DREQ_TX(v)       ((v) << 8)
#define DREQ_RX_PANIC(v) ((v) << 16)
#define DREQ_TX_PANIC(v) ((v) << 24)

/* FIFO DMA-request thresholds. TX=0x30 keeps 16 entries of headroom
 * below the FIFO-full boundary; setting it at the boundary races with
 * the PCM drain (TXERR latches and the FTXP interpretation is lost).
 * Matches Linux bcm2835-i2s.c.
 */
#define I2S_TX_PANIC 0x10U
#define I2S_RX_PANIC 0x30U
#define I2S_TX_DREQ  0x30U
#define I2S_RX_DREQ  0x20U

/* Frame geometry for 16-bit I2S, frame-packed (the only format
 * this driver programs). Two 16-bit slots per 32-bit frame; I2S
 * MSB lands one bit clock after the frame-sync edge.
 */
#define I2S_WORD_BITS  16U
#define I2S_FRAME_BITS 32U
#define I2S_CHWID_VAL  8U
#define I2S_CH1_POS    1U
#define I2S_CH2_POS    17U

/* SoC clock manager (CPRMAN) PCM clock divider: 12.12 fixed point
 * off the 19.2 MHz oscillator, password-gated. Sourced directly
 * because Zephyr has no clock-control driver for CPRMAN yet.
 */
#define CM_BASE          0x3f101000U
#define CM_SIZE          0x1000U
#define CM_PCMCTL        0x98U
#define CM_PCMDIV        0x9cU
#define CM_PASSWORD      0x5a000000U
#define CM_CTL_SRC_OSC   1U
#define CM_CTL_ENABLE    BIT(4)
#define CM_CTL_BUSY      BIT(7)
#define CM_CTL_FRAC      BIT(9) /* MASH-1: use the fractional divider */
#define CM_DIV_FRAC_BITS 12U
#define CM_OSC_HZ        19200000U

/* PCM FIFO depth (32-bit words). Not stated in the datasheet text;
 * consistent with Linux bcm2835-i2s.c and the period_bytes >= 256
 * snd_pcm_hw_constraint_minmax it enforces.
 */
#define I2S_BCM2835_FIFO_DEPTH 64U
#define I2S_BCM2835_FIFO_BYTES (I2S_BCM2835_FIFO_DEPTH * sizeof(uint32_t))

/* Ring depth per direction. */
#define I2S_BCM2835_TX_K CONFIG_I2S_BCM2835_TX_BLOCK_COUNT
#define I2S_BCM2835_RX_K CONFIG_I2S_BCM2835_RX_BLOCK_COUNT
#define I2S_BCM2835_K_MAX MAX(I2S_BCM2835_TX_K, I2S_BCM2835_RX_K)

BUILD_ASSERT(I2S_BCM2835_TX_K <= CONFIG_DMA_BCM2835_MAX_CBS_PER_CHANNEL,
	     "I2S_BCM2835_TX_BLOCK_COUNT exceeds DMA_BCM2835_MAX_CBS_PER_CHANNEL");
BUILD_ASSERT(I2S_BCM2835_RX_K <= CONFIG_DMA_BCM2835_MAX_CBS_PER_CHANNEL,
	     "I2S_BCM2835_RX_BLOCK_COUNT exceeds DMA_BCM2835_MAX_CBS_PER_CHANNEL");
BUILD_ASSERT(I2S_BCM2835_TX_K >= 2,
	     "I2S_BCM2835_TX_BLOCK_COUNT must be >= 2 for the cyclic data path");
BUILD_ASSERT(I2S_BCM2835_RX_K >= 2,
	     "I2S_BCM2835_RX_BLOCK_COUNT must be >= 2 for the cyclic data path");

/* Slot stride is rounded to the A53 cache line so DMA cache
 * maintenance never clips a neighbouring slot.
 */
#define I2S_BCM2835_CACHE_LINE 64U
#define I2S_BCM2835_SLOT_STRIDE                                                \
	ROUND_UP(CONFIG_I2S_BCM2835_MAX_BLOCK_SIZE, I2S_BCM2835_CACHE_LINE)

struct i2s_bcm2835_stream {
	enum i2s_state state;
	struct i2s_config cfg;

	uint32_t dma_channel;
	uint32_t dma_dreq;
	bool dma_channel_valid;

	/* Ring of K driver-owned slots. TX: producer = i2s_write,
	 * consumer = DMA cb. RX: producer = DMA cb, consumer = i2s_read.
	 * n_pending counts slots holding data the consumer has not yet
	 * taken; sem reflects what the consumer can take.
	 */
	uint8_t *slots;
	uint8_t  k;
	uint8_t  producer_idx;
	uint8_t  consumer_idx;
	uint8_t  n_pending;

	struct k_sem sem;

	bool dma_armed;
	bool last_block;

	struct dma_config dma_cfg;
	struct dma_block_config dma_blocks[I2S_BCM2835_K_MAX];
};

struct i2s_bcm2835_config {
	DEVICE_MMIO_ROM;
	const struct pinctrl_dev_config *pcfg;
	const struct device *dma_dev;
	uint32_t fifo_phys;
	uint32_t tx_dreq;
	uint32_t rx_dreq;
	uint8_t *tx_slot_backing;
	uint8_t *rx_slot_backing;
};

struct i2s_bcm2835_data {
	DEVICE_MMIO_RAM;
	mm_reg_t cm_base;
	struct i2s_bcm2835_stream tx;
	struct i2s_bcm2835_stream rx;

	/* DIR_BOTH DRAIN: TX drains its ring; RX keeps running until the
	 * TX cb signals STOPPING -> READY, then is halted one cb later
	 * so the loopback delivers what TX just clocked out.
	 */
	bool drain_both;
};

#define DEV_CFG(dev)  ((const struct i2s_bcm2835_config *)(dev)->config)
#define DEV_DATA(dev) ((struct i2s_bcm2835_data *)(dev)->data)

static inline uint32_t i2s_rd(const struct device *dev, uint32_t off)
{
	return sys_read32(DEVICE_MMIO_GET(dev) + off);
}

static inline void i2s_wr(const struct device *dev, uint32_t off, uint32_t val)
{
	sys_write32(val, DEVICE_MMIO_GET(dev) + off);
}

static inline uint8_t *slot_at(const struct i2s_bcm2835_stream *strm,
			       uint8_t idx)
{
	return strm->slots + (size_t)idx * I2S_BCM2835_SLOT_STRIDE;
}

/* Program the PCM bit clock divider off the 19.2 MHz oscillator with
 * MASH-1 fractional division. Sequence (glitchless stop, program,
 * enable) mirrors Linux clk-bcm2835.c.
 */
static void cm_pcm_set_rate(const struct device *dev, uint32_t bclk_hz)
{
	struct i2s_bcm2835_data *data = DEV_DATA(dev);
	mm_reg_t cm = data->cm_base;
	uint32_t cdiv, divi, divf, ctl;

	cdiv = (uint32_t)(((uint64_t)CM_OSC_HZ << CM_DIV_FRAC_BITS) / bclk_hz);
	divi = cdiv >> CM_DIV_FRAC_BITS;
	divf = cdiv & BIT_MASK(CM_DIV_FRAC_BITS);

	/* MASH-1 clamps the integer divider to a minimum of 2. */
	if (divi < 2U) {
		divi = 2U;
		divf = 0U;
	}

	ctl = sys_read32(cm + CM_PCMCTL);
	if (ctl & CM_CTL_ENABLE) {
		sys_write32(CM_PASSWORD | (ctl & ~CM_CTL_ENABLE),
			    cm + CM_PCMCTL);
		while (sys_read32(cm + CM_PCMCTL) & CM_CTL_BUSY) {
		}
	}

	ctl = CM_CTL_SRC_OSC | (divf ? CM_CTL_FRAC : 0U);
	sys_write32(CM_PASSWORD | ctl, cm + CM_PCMCTL);
	sys_write32(CM_PASSWORD | (divi << CM_DIV_FRAC_BITS) | divf,
		    cm + CM_PCMDIV);
	sys_write32(CM_PASSWORD | ctl | CM_CTL_ENABLE, cm + CM_PCMCTL);
}

static void cm_pcm_stop(const struct device *dev)
{
	struct i2s_bcm2835_data *data = DEV_DATA(dev);
	mm_reg_t cm = data->cm_base;
	uint32_t ctl = sys_read32(cm + CM_PCMCTL);

	sys_write32(CM_PASSWORD | (ctl & ~CM_CTL_ENABLE), cm + CM_PCMCTL);
	while (sys_read32(cm + CM_PCMCTL) & CM_CTL_BUSY) {
	}
}

/* Clear the requested FIFO(s). Toggling SYNC and waiting for the
 * read-back is a hardware-timed 2 PCM clock cycle delay. PCM clock
 * must be running; callers ensure that. From Linux bcm2835-i2s.c.
 */
static void i2s_bcm2835_clear_fifos(const struct device *dev, bool tx, bool rx)
{
	uint32_t cs = i2s_rd(dev, I2S_CS_A);
	uint32_t active = cs & (CS_TXON | CS_RXON);
	uint32_t off = (tx ? CS_TXON : 0U) | (rx ? CS_RXON : 0U);
	uint32_t clr = (tx ? CS_TXCLR : 0U) | (rx ? CS_RXCLR : 0U);
	uint32_t sync;
	int timeout = 1000;

	i2s_wr(dev, I2S_CS_A, cs & ~off);
	i2s_wr(dev, I2S_CS_A, i2s_rd(dev, I2S_CS_A) | clr);

	sync = i2s_rd(dev, I2S_CS_A) & CS_SYNC;
	i2s_wr(dev, I2S_CS_A, i2s_rd(dev, I2S_CS_A) ^ CS_SYNC);
	while (--timeout > 0) {
		if ((i2s_rd(dev, I2S_CS_A) & CS_SYNC) != sync) {
			break;
		}
	}
	if (timeout == 0) {
		LOG_WRN("FIFO clear: SYNC handshake timed out");
	}

	i2s_wr(dev, I2S_CS_A,
	       (i2s_rd(dev, I2S_CS_A) & ~(CS_TXON | CS_RXON)) | active);
}

/* Reset ring bookkeeping to "empty + all-K-free". TX sem starts at K
 * (all slots free for the producer); RX sem starts at 0 (no captures
 * for the consumer yet).
 */
static void i2s_ring_reset(struct i2s_bcm2835_stream *strm, bool tx)
{
	strm->producer_idx = 0U;
	strm->consumer_idx = 0U;
	strm->n_pending = 0U;
	strm->dma_armed = false;
	strm->last_block = false;
	k_sem_reset(&strm->sem);
	if (tx) {
		for (uint32_t i = 0; i < strm->k; i++) {
			k_sem_give(&strm->sem);
		}
	}
}

/* Build a cyclic DMA chain of strm->k blocks anchored at anchor_idx. */
static int i2s_build_chain(const struct device *dev,
			   struct i2s_bcm2835_stream *strm,
			   bool tx, uint8_t anchor_idx,
			   dma_callback_t cb)
{
	const struct i2s_bcm2835_config *cfg = DEV_CFG(dev);
	uint32_t i;

	for (i = 0; i < strm->k; i++) {
		uint8_t *buf = slot_at(strm, (anchor_idx + i) % strm->k);

		strm->dma_blocks[i].block_size = strm->cfg.block_size;
		strm->dma_blocks[i].source_addr_adj = tx
			? DMA_ADDR_ADJ_INCREMENT
			: DMA_ADDR_ADJ_NO_CHANGE;
		strm->dma_blocks[i].dest_addr_adj = tx
			? DMA_ADDR_ADJ_NO_CHANGE
			: DMA_ADDR_ADJ_INCREMENT;
		if (tx) {
			strm->dma_blocks[i].source_address =
				(uint32_t)(uintptr_t)buf;
			strm->dma_blocks[i].dest_address = cfg->fifo_phys;
		} else {
			strm->dma_blocks[i].source_address = cfg->fifo_phys;
			strm->dma_blocks[i].dest_address =
				(uint32_t)(uintptr_t)buf;
		}
		strm->dma_blocks[i].next_block = (i + 1 < strm->k)
			? &strm->dma_blocks[i + 1]
			: NULL;
	}

	memset(&strm->dma_cfg, 0, sizeof(strm->dma_cfg));
	strm->dma_cfg.channel_direction = tx ? MEMORY_TO_PERIPHERAL
					    : PERIPHERAL_TO_MEMORY;
	strm->dma_cfg.dma_slot = strm->dma_dreq;
	strm->dma_cfg.complete_callback_en = 1;
	strm->dma_cfg.cyclic = 1;
	strm->dma_cfg.block_count = strm->k;
	strm->dma_cfg.head_block = &strm->dma_blocks[0];
	strm->dma_cfg.dma_callback = cb;
	strm->dma_cfg.user_data = (void *)dev;

	return dma_config(cfg->dma_dev, strm->dma_channel, &strm->dma_cfg);
}

/* TX DMA completion: free the slot the engine just played, advance
 * the consumer cursor, then decide whether to keep cycling, stop
 * cleanly (STOP / DRAIN), or declare an underrun.
 */
static void i2s_dma_tx_cb(const struct device *dma_dev, void *user_data,
			  uint32_t channel, int status)
{
	const struct device *dev = user_data;
	const struct i2s_bcm2835_config *cfg = DEV_CFG(dev);
	struct i2s_bcm2835_data *data = DEV_DATA(dev);
	struct i2s_bcm2835_stream *strm = &data->tx;
	bool was_empty;
	bool halt = false;

	ARG_UNUSED(dma_dev);
	ARG_UNUSED(channel);

	if (status != DMA_STATUS_COMPLETE) {
		LOG_ERR("TX DMA error %d", status);
		dma_suspend(cfg->dma_dev, strm->dma_channel);
		strm->dma_armed = false;
		strm->state = I2S_STATE_ERROR;
		return;
	}

	/* STOP / DRAIN paths take precedence over underrun so a clean
	 * stop with an empty ring does not register as error.
	 */
	was_empty = (strm->n_pending == 0U);
	strm->consumer_idx = (strm->consumer_idx + 1U) % strm->k;
	if (!was_empty) {
		strm->n_pending--;
	}
	k_sem_give(&strm->sem);

	if (strm->last_block) {
		/* STOP: halt now; any queued slots remain in the ring
		 * for the next START to resume.
		 */
		strm->last_block = false;
		halt = true;
		strm->state = I2S_STATE_READY;
	} else if (strm->state == I2S_STATE_STOPPING) {
		/* DRAIN: cycle until the ring is empty, then halt. */
		if (strm->n_pending == 0U) {
			halt = true;
			strm->state = I2S_STATE_READY;
			if (data->drain_both) {
				data->drain_both = false;
				data->rx.last_block = true;
			}
		}
	} else if (was_empty) {
		/* RUNNING with empty ring: underrun. PREPARE recovers. */
		LOG_DBG("TX underrun");
		halt = true;
		strm->state = I2S_STATE_ERROR;
	}

	if (halt) {
		dma_suspend(cfg->dma_dev, strm->dma_channel);
		strm->dma_armed = false;
	}
}

/* RX DMA completion: hand the just-filled slot to the consumer,
 * advance the producer cursor, then decide whether to keep cycling,
 * stop cleanly (STOP / DRAIN), or declare an overrun.
 */
static void i2s_dma_rx_cb(const struct device *dma_dev, void *user_data,
			  uint32_t channel, int status)
{
	const struct device *dev = user_data;
	const struct i2s_bcm2835_config *cfg = DEV_CFG(dev);
	struct i2s_bcm2835_stream *strm = &DEV_DATA(dev)->rx;
	bool halt = false;

	ARG_UNUSED(dma_dev);
	ARG_UNUSED(channel);

	if (status != DMA_STATUS_COMPLETE) {
		LOG_ERR("RX DMA error %d", status);
		dma_suspend(cfg->dma_dev, strm->dma_channel);
		strm->dma_armed = false;
		strm->state = I2S_STATE_ERROR;
		return;
	}

	strm->producer_idx = (strm->producer_idx + 1U) % strm->k;
	strm->n_pending++;
	k_sem_give(&strm->sem);

	if (strm->last_block) {
		strm->last_block = false;
		halt = true;
		strm->state = I2S_STATE_READY;
	} else if (strm->n_pending >= strm->k) {
		/* Ring full; the next cb would overwrite the oldest
		 * unread slot. Halt; captured slots remain readable
		 * until the consumer drains them and calls PREPARE.
		 */
		LOG_DBG("RX overrun");
		halt = true;
		strm->state = I2S_STATE_ERROR;
	}

	if (halt) {
		dma_suspend(cfg->dma_dev, strm->dma_channel);
		strm->dma_armed = false;
	}
}

/* (Re-)arm the TX DMA at the current consumer cursor. */
static int i2s_tx_arm(const struct device *dev)
{
	const struct i2s_bcm2835_config *cfg = DEV_CFG(dev);
	struct i2s_bcm2835_stream *strm = &DEV_DATA(dev)->tx;
	int ret;

	ret = i2s_build_chain(dev, strm, true, strm->consumer_idx,
			      i2s_dma_tx_cb);
	if (ret != 0) {
		LOG_ERR("TX dma_config failed: %d", ret);
		return ret;
	}

	ret = dma_start(cfg->dma_dev, strm->dma_channel);
	if (ret != 0) {
		LOG_ERR("TX dma_start failed: %d", ret);
		return ret;
	}

	strm->dma_armed = true;
	return 0;
}

/* (Re-)arm the RX DMA at the current producer cursor. */
static int i2s_rx_arm(const struct device *dev)
{
	const struct i2s_bcm2835_config *cfg = DEV_CFG(dev);
	struct i2s_bcm2835_stream *strm = &DEV_DATA(dev)->rx;
	int ret;

	ret = i2s_build_chain(dev, strm, false, strm->producer_idx,
			      i2s_dma_rx_cb);
	if (ret != 0) {
		LOG_ERR("RX dma_config failed: %d", ret);
		return ret;
	}

	ret = dma_start(cfg->dma_dev, strm->dma_channel);
	if (ret != 0) {
		LOG_ERR("RX dma_start failed: %d", ret);
		return ret;
	}

	strm->dma_armed = true;
	return 0;
}

static void i2s_stream_halt(const struct device *dev,
			    struct i2s_bcm2835_stream *strm)
{
	if (strm->dma_armed) {
		dma_suspend(DEV_CFG(dev)->dma_dev, strm->dma_channel);
		strm->dma_armed = false;
	}
}


static int i2s_bcm2835_configure(const struct device *dev, enum i2s_dir dir,
				 const struct i2s_config *cfg)
{
	struct i2s_bcm2835_data *data = DEV_DATA(dev);
	struct i2s_bcm2835_stream *streams[2];
	bool is_tx[2] = {false, false};
	uint8_t depths[2] = {0, 0};
	uint32_t bclk_hz, mode, chcfg;
	int n = 0;

	/* Which stream(s) this call configures. */
	if (dir == I2S_DIR_TX || dir == I2S_DIR_BOTH) {
		streams[n] = &data->tx;
		is_tx[n] = true;
		depths[n] = I2S_BCM2835_TX_K;
		n++;
	}
	if (dir == I2S_DIR_RX || dir == I2S_DIR_BOTH) {
		streams[n] = &data->rx;
		is_tx[n] = false;
		depths[n] = I2S_BCM2835_RX_K;
		n++;
	}
	if (n == 0) {
		return -EINVAL;
	}

	/* ERROR is reconfigurable (recovery path); RUNNING and STOPPING
	 * are rejected.
	 */
	for (int i = 0; i < n; i++) {
		struct i2s_bcm2835_stream *s = streams[i];

		if (s->state == I2S_STATE_ERROR) {
			i2s_stream_halt(dev, s);
		} else if (s->state != I2S_STATE_NOT_READY &&
			   s->state != I2S_STATE_READY) {
			LOG_ERR("configure: stream busy (state %d)", s->state);
			return -EINVAL;
		}
	}

	/* frame_clk_freq 0 tears the stream(s) down to NOT_READY. */
	if (cfg->frame_clk_freq == 0U) {
		for (int i = 0; i < n; i++) {
			i2s_stream_halt(dev, streams[i]);
			streams[i]->state = I2S_STATE_NOT_READY;
			if (is_tx[i]) {
				data->drain_both = false;
			}
		}
		if (data->tx.state == I2S_STATE_NOT_READY &&
		    data->rx.state == I2S_STATE_NOT_READY) {
			cm_pcm_stop(dev);
		}
		return 0;
	}

	if (cfg->word_size != I2S_WORD_BITS) {
		LOG_ERR("only %u-bit word size supported", I2S_WORD_BITS);
		return -EINVAL;
	}
	if (cfg->channels != 2U) {
		LOG_ERR("only 2 channels supported");
		return -EINVAL;
	}
	if ((cfg->format & I2S_FMT_DATA_FORMAT_MASK) !=
	    I2S_FMT_DATA_FORMAT_I2S) {
		LOG_ERR("only I2S (Philips) format supported");
		return -EINVAL;
	}
	if (cfg->options &
	    (I2S_OPT_BIT_CLK_TARGET | I2S_OPT_FRAME_CLK_TARGET)) {
		LOG_ERR("only controller (master) clocking supported");
		return -EINVAL;
	}
	if (cfg->options & (I2S_OPT_LOOPBACK | I2S_OPT_PINGPONG)) {
		LOG_ERR("loopback / ping-pong mode not supported");
		return -EINVAL;
	}
	if (cfg->mem_slab == NULL || cfg->block_size == 0U ||
	    (cfg->block_size % sizeof(uint32_t)) != 0U) {
		LOG_ERR("invalid mem_slab / block_size");
		return -EINVAL;
	}

	if (cfg->block_size > I2S_BCM2835_SLOT_STRIDE) {
		LOG_ERR("block_size %zu exceeds CONFIG_I2S_BCM2835_MAX_BLOCK_SIZE",
			cfg->block_size);
		return -EINVAL;
	}

	/* Each block must be at least one full FIFO worth of bytes. With
	 * smaller blocks the pre-TXON DMA burst crosses the CB[0]->CB[1]
	 * boundary before the application populates slot[1], leading to
	 * leading-zero glitches at every slot lap. Linux bcm2835-i2s
	 * enforces the same minimum via snd_pcm_hw_constraint_minmax.
	 */
	if (cfg->block_size < I2S_BCM2835_FIFO_BYTES) {
		LOG_ERR("block_size %zu below FIFO depth %zu bytes",
			cfg->block_size, (size_t)I2S_BCM2835_FIFO_BYTES);
		return -EINVAL;
	}
	for (int i = 0; i < n; i++) {
		streams[i]->k = depths[i];
	}

	/* Bit clock = frame_clk * 32 (two 16-bit slots per frame). */
	bclk_hz = cfg->frame_clk_freq * I2S_FRAME_BITS;
	cm_pcm_set_rate(dev, bclk_hz);

	/* 32-bit frame, 16-bit FS, frame-packed I2S, master mode. */
	mode = MODE_FLEN(I2S_FRAME_BITS - 1U) |
	       MODE_FSLEN(I2S_FRAME_BITS / 2U) | MODE_FTXP | MODE_FRXP |
	       MODE_CLKI | MODE_FSI;
	i2s_wr(dev, I2S_MODE_A, mode);

	chcfg = CH1(CHEN | CHWID(I2S_CHWID_VAL) | CHPOS(I2S_CH1_POS)) |
		CH2(CHEN | CHWID(I2S_CHWID_VAL) | CHPOS(I2S_CH2_POS));
	i2s_wr(dev, I2S_TXC_A, chcfg);
	i2s_wr(dev, I2S_RXC_A, chcfg);

	i2s_wr(dev, I2S_DREQ_A,
	       DREQ_TX_PANIC(I2S_TX_PANIC) | DREQ_RX_PANIC(I2S_RX_PANIC) |
		       DREQ_TX(I2S_TX_DREQ) | DREQ_RX(I2S_RX_DREQ));

	/* Enable + leave standby (>= 4 PCM cycles), clear FIFOs and any
	 * sticky error latches, then arm the DMA-request machinery.
	 */
	i2s_wr(dev, I2S_CS_A, CS_EN);
	i2s_wr(dev, I2S_CS_A, i2s_rd(dev, I2S_CS_A) | CS_STBY);
	k_busy_wait(DIV_ROUND_UP(4U * USEC_PER_SEC, bclk_hz) + 1U);

	i2s_bcm2835_clear_fifos(dev, true, true);
	i2s_wr(dev, I2S_CS_A, i2s_rd(dev, I2S_CS_A) | CS_TXERR | CS_RXERR);
	i2s_wr(dev, I2S_CS_A,
	       i2s_rd(dev, I2S_CS_A) | CS_TXTHR(1) | CS_RXTHR(1) | CS_DMAEN);

	for (int i = 0; i < n; i++) {
		streams[i]->cfg = *cfg;
		i2s_ring_reset(streams[i], is_tx[i]);
		streams[i]->state = I2S_STATE_READY;
		if (is_tx[i]) {
			data->drain_both = false;
		}
	}

	return 0;
}

static int i2s_bcm2835_trigger(const struct device *dev, enum i2s_dir dir,
			       enum i2s_trigger_cmd cmd)
{
	struct i2s_bcm2835_data *data = DEV_DATA(dev);
	bool do_tx = (dir == I2S_DIR_TX || dir == I2S_DIR_BOTH);
	bool do_rx = (dir == I2S_DIR_RX || dir == I2S_DIR_BOTH);
	unsigned int key;
	int ret = 0;

	if (!do_tx && !do_rx) {
		return -EINVAL;
	}

	key = irq_lock();

	switch (cmd) {
	case I2S_TRIGGER_START:
		if ((do_tx && data->tx.state != I2S_STATE_READY) ||
		    (do_rx && data->rx.state != I2S_STATE_READY)) {
			LOG_ERR("START: stream not in READY state");
			ret = -EIO;
			break;
		}
		if (do_tx && data->tx.n_pending == 0U) {
			LOG_ERR("START: TX has no block queued");
			ret = -EIO;
			break;
		}

		/* Clear any stale FIFO state and sticky error latches. */
		i2s_bcm2835_clear_fifos(dev, do_tx, do_rx);
		i2s_wr(dev, I2S_CS_A,
		       i2s_rd(dev, I2S_CS_A) | CS_TXERR | CS_RXERR);

		/* Arm DMA(s) BEFORE enabling PCM, so the TX FIFO carries
		 * valid samples by the first BCK after TXON. PCM-first
		 * clocks leading zeros onto DOUT before the DMA pre-fill
		 * lands. Matches Linux bcm2835_i2s_trigger ordering.
		 */
		if (do_tx) {
			ret = i2s_tx_arm(dev);
			if (ret != 0) {
				break;
			}
		}
		if (do_rx) {
			ret = i2s_rx_arm(dev);
			if (ret != 0) {
				if (do_tx) {
					i2s_stream_halt(dev, &data->tx);
				}
				break;
			}
		}

		/* Wait for the TX FIFO to cross TXTHR before enabling TXON.
		 * If TXON sees a near-empty FIFO, the first read underflows
		 * and the hardware drops out of FTXP interpretation
		 * permanently (MODE_A still reads FTXP=1 even though the
		 * wire emits the lower 16 bits in both channel slots).
		 */
		if (do_tx) {
			int preload_timeout = 1000;

			while (i2s_rd(dev, I2S_CS_A) & CS_TXW) {
				if (--preload_timeout == 0) {
					LOG_ERR("TX FIFO preload timeout");
					i2s_stream_halt(dev, &data->tx);
					if (do_rx) {
						i2s_stream_halt(dev,
								&data->rx);
					}
					ret = -EIO;
					break;
				}
				k_busy_wait(1U);
			}
			if (ret != 0) {
				break;
			}
		}

		i2s_wr(dev, I2S_CS_A,
		       i2s_rd(dev, I2S_CS_A) | (do_tx ? CS_TXON : 0U) |
			       (do_rx ? CS_RXON : 0U));

		if (do_tx) {
			data->tx.state = I2S_STATE_RUNNING;
		}
		if (do_rx) {
			data->rx.state = I2S_STATE_RUNNING;
		}
		break;

	case I2S_TRIGGER_STOP:
		if ((do_tx && data->tx.state != I2S_STATE_RUNNING) ||
		    (do_rx && data->rx.state != I2S_STATE_RUNNING)) {
			ret = -EIO;
			break;
		}
		if (do_tx) {
			data->tx.last_block = true;
		}
		if (do_rx) {
			data->rx.last_block = true;
		}
		break;

	case I2S_TRIGGER_DRAIN:
		if ((do_tx && data->tx.state != I2S_STATE_RUNNING) ||
		    (do_rx && data->rx.state != I2S_STATE_RUNNING)) {
			ret = -EIO;
			break;
		}
		/* TX drains its ring; RX-alone DRAIN equals STOP. For
		 * DIR_BOTH the two are coupled: RX is held running until
		 * the TX cb signals drain completion (see drain_both).
		 */
		if (do_tx) {
			data->tx.state = I2S_STATE_STOPPING;
		}
		if (do_rx) {
			if (do_tx) {
				data->drain_both = true;
			} else {
				data->rx.last_block = true;
			}
		}
		break;

	case I2S_TRIGGER_DROP:
		if ((do_tx && data->tx.state == I2S_STATE_NOT_READY) ||
		    (do_rx && data->rx.state == I2S_STATE_NOT_READY)) {
			ret = -EIO;
			break;
		}
		if (do_tx) {
			i2s_stream_halt(dev, &data->tx);
			i2s_ring_reset(&data->tx, true);
			data->tx.state = I2S_STATE_READY;
			data->drain_both = false;
		}
		if (do_rx) {
			i2s_stream_halt(dev, &data->rx);
			i2s_ring_reset(&data->rx, false);
			data->rx.state = I2S_STATE_READY;
		}
		break;

	case I2S_TRIGGER_PREPARE:
		if ((do_tx && data->tx.state != I2S_STATE_ERROR) ||
		    (do_rx && data->rx.state != I2S_STATE_ERROR)) {
			ret = -EIO;
			break;
		}
		if (do_tx) {
			i2s_stream_halt(dev, &data->tx);
			i2s_ring_reset(&data->tx, true);
			data->tx.state = I2S_STATE_READY;
			data->drain_both = false;
		}
		if (do_rx) {
			i2s_stream_halt(dev, &data->rx);
			i2s_ring_reset(&data->rx, false);
			data->rx.state = I2S_STATE_READY;
		}
		break;

	default:
		ret = -EINVAL;
		break;
	}

	irq_unlock(key);
	return ret;
}

static int i2s_bcm2835_read(const struct device *dev, void **mem_block,
			    size_t *size)
{
	struct i2s_bcm2835_stream *strm = &DEV_DATA(dev)->rx;
	void *out;
	unsigned int key;
	uint8_t *src;
	int ret;

	if (strm->state == I2S_STATE_NOT_READY) {
		LOG_ERR("read: RX stream not configured");
		return -EIO;
	}

	/* In ERROR, return any captured slots without blocking and
	 * -EIO once the ring is dry; PREPARE recovers.
	 */
	key = irq_lock();
	if (strm->state == I2S_STATE_ERROR && strm->n_pending == 0U) {
		irq_unlock(key);
		return -EIO;
	}
	irq_unlock(key);

	ret = k_sem_take(&strm->sem,
			 (strm->state == I2S_STATE_ERROR)
				 ? K_NO_WAIT
				 : SYS_TIMEOUT_MS(strm->cfg.timeout));
	if (ret != 0) {
		return (strm->state == I2S_STATE_ERROR) ? -EIO : -EAGAIN;
	}

	ret = k_mem_slab_alloc(strm->cfg.mem_slab, &out, K_NO_WAIT);
	if (ret != 0) {
		/* Slab pressure -- give the slot back to the queue so a
		 * later call can retry without losing data.
		 */
		k_sem_give(&strm->sem);
		LOG_ERR("read: slab alloc failed: %d", ret);
		return -ENOMEM;
	}

	key = irq_lock();
	src = slot_at(strm, strm->consumer_idx);
	strm->consumer_idx = (strm->consumer_idx + 1U) % strm->k;
	strm->n_pending--;
	irq_unlock(key);

	/* DMA wrote this slot bypassing the CPU caches. */
	sys_cache_data_invd_range(src, strm->cfg.block_size);
	memcpy(out, src, strm->cfg.block_size);

	*mem_block = out;
	*size = strm->cfg.block_size;
	return 0;
}

static int i2s_bcm2835_write(const struct device *dev, void *mem_block,
			     size_t size)
{
	struct i2s_bcm2835_stream *strm = &DEV_DATA(dev)->tx;
	unsigned int key;
	uint8_t *dst;
	int ret;

	if (strm->state != I2S_STATE_READY &&
	    strm->state != I2S_STATE_RUNNING) {
		LOG_ERR("write: TX stream not in READY/RUNNING (state %d)",
			strm->state);
		return -EIO;
	}
	if (size > strm->cfg.block_size) {
		LOG_ERR("write: size %zu exceeds block_size %zu", size,
			strm->cfg.block_size);
		return -EIO;
	}

	ret = k_sem_take(&strm->sem, SYS_TIMEOUT_MS(strm->cfg.timeout));
	if (ret != 0) {
		return -EAGAIN;
	}

	key = irq_lock();
	/* Re-check: the underrun cb could have transitioned to ERROR
	 * while sem_take was blocked.
	 */
	if (strm->state != I2S_STATE_READY &&
	    strm->state != I2S_STATE_RUNNING) {
		irq_unlock(key);
		k_sem_give(&strm->sem);
		return -EIO;
	}
	dst = slot_at(strm, strm->producer_idx);
	strm->producer_idx = (strm->producer_idx + 1U) % strm->k;
	strm->n_pending++;
	irq_unlock(key);

	memcpy(dst, mem_block, size);
	if (size < strm->cfg.block_size) {
		memset(dst + size, 0, strm->cfg.block_size - size);
	}
	/* Flush the whole stride so neighbouring cache lines don't carry
	 * dirty bytes that a later invd_range would wipe.
	 */
	sys_cache_data_flush_range(dst, I2S_BCM2835_SLOT_STRIDE);

	k_mem_slab_free(strm->cfg.mem_slab, mem_block);
	return 0;
}

static const struct i2s_config *
i2s_bcm2835_config_get(const struct device *dev, enum i2s_dir dir)
{
	struct i2s_bcm2835_data *data = DEV_DATA(dev);
	struct i2s_bcm2835_stream *strm =
		(dir == I2S_DIR_RX) ? &data->rx : &data->tx;

	if (strm->state == I2S_STATE_NOT_READY) {
		return NULL;
	}
	return &strm->cfg;
}

static int i2s_bcm2835_init(const struct device *dev)
{
	const struct i2s_bcm2835_config *cfg = DEV_CFG(dev);
	struct i2s_bcm2835_data *data = DEV_DATA(dev);
	int ret;

	DEVICE_MMIO_MAP(dev, K_MEM_CACHE_NONE);

	/* The PCM bit-clock divider lives in the clock manager. */
	device_map(&data->cm_base, CM_BASE, CM_SIZE, K_MEM_CACHE_NONE);

	if (!device_is_ready(cfg->dma_dev)) {
		LOG_ERR("DMA controller not ready");
		return -ENODEV;
	}

	if (cfg->pcfg != NULL) {
		ret = pinctrl_apply_state(cfg->pcfg, PINCTRL_STATE_DEFAULT);
		if (ret < 0) {
			LOG_ERR("pinctrl apply failed: %d", ret);
			return ret;
		}
	}

	ret = dma_request_channel(cfg->dma_dev, NULL);
	if (ret < 0) {
		LOG_ERR("no DMA channel available for TX: %d", ret);
		return ret;
	}
	data->tx.dma_channel = (uint32_t)ret;
	data->tx.dma_channel_valid = true;
	data->tx.dma_dreq = cfg->tx_dreq;

	ret = dma_request_channel(cfg->dma_dev, NULL);
	if (ret < 0) {
		LOG_ERR("no DMA channel available for RX: %d", ret);
		dma_release_channel(cfg->dma_dev, data->tx.dma_channel);
		data->tx.dma_channel_valid = false;
		return ret;
	}
	data->rx.dma_channel = (uint32_t)ret;
	data->rx.dma_channel_valid = true;
	data->rx.dma_dreq = cfg->rx_dreq;

	k_sem_init(&data->tx.sem, 0U, I2S_BCM2835_TX_K);
	k_sem_init(&data->rx.sem, 0U, I2S_BCM2835_RX_K);

	data->tx.state = I2S_STATE_NOT_READY;
	data->rx.state = I2S_STATE_NOT_READY;
	data->tx.slots = cfg->tx_slot_backing;
	data->rx.slots = cfg->rx_slot_backing;

	/* Park disabled; configure() brings it up. */
	i2s_wr(dev, I2S_CS_A, 0U);

	return 0;
}

static DEVICE_API(i2s, i2s_bcm2835_driver_api) = {
	.configure = i2s_bcm2835_configure,
	.config_get = i2s_bcm2835_config_get,
	.read = i2s_bcm2835_read,
	.write = i2s_bcm2835_write,
	.trigger = i2s_bcm2835_trigger,
};

#define I2S_BCM2835_INIT(n)                                                    \
	COND_CODE_1(DT_INST_NODE_HAS_PROP(n, pinctrl_0),                       \
		    (PINCTRL_DT_INST_DEFINE(n);), ())                          \
                                                                               \
	static struct i2s_bcm2835_data i2s_bcm2835_data_##n;                   \
	static uint8_t                                                          \
		i2s_bcm2835_tx_slots_##n[I2S_BCM2835_TX_K *                    \
					 I2S_BCM2835_SLOT_STRIDE]              \
		__aligned(I2S_BCM2835_CACHE_LINE);                             \
	static uint8_t                                                          \
		i2s_bcm2835_rx_slots_##n[I2S_BCM2835_RX_K *                    \
					 I2S_BCM2835_SLOT_STRIDE]              \
		__aligned(I2S_BCM2835_CACHE_LINE);                             \
                                                                               \
	static const struct i2s_bcm2835_config i2s_bcm2835_config_##n = {      \
		DEVICE_MMIO_ROM_INIT(DT_DRV_INST(n)),                          \
		.pcfg = COND_CODE_1(DT_INST_NODE_HAS_PROP(n, pinctrl_0),        \
				    (PINCTRL_DT_INST_DEV_CONFIG_GET(n)),        \
				    (NULL)),                                   \
		.dma_dev = DEVICE_DT_GET(DT_INST_DMAS_CTLR_BY_NAME(n, tx)),     \
		.fifo_phys = DT_INST_REG_ADDR(n) + I2S_FIFO_A,                  \
		.tx_dreq = DT_INST_DMAS_CELL_BY_NAME(n, tx, dreq),             \
		.rx_dreq = DT_INST_DMAS_CELL_BY_NAME(n, rx, dreq),             \
		.tx_slot_backing = i2s_bcm2835_tx_slots_##n,                   \
		.rx_slot_backing = i2s_bcm2835_rx_slots_##n,                   \
	};                                                                     \
                                                                               \
	DEVICE_DT_INST_DEFINE(n, i2s_bcm2835_init, NULL, &i2s_bcm2835_data_##n, \
			      &i2s_bcm2835_config_##n, POST_KERNEL,            \
			      CONFIG_I2S_INIT_PRIORITY,                        \
			      &i2s_bcm2835_driver_api);

DT_INST_FOREACH_STATUS_OKAY(I2S_BCM2835_INIT)
