## drivers/clock_control/Kconfig.acts_cmu
```kconfig
# Actions Semi Clock Kconfig

# Copyright (c) 2019 Manivannan Sadhasivam <mani@kernel.org>
# SPDX-License-Identifier: Apache-2.0

config CLOCK_CONTROL_ACTS_CMU
	bool "Actions Semi Clock Management Unit"
	depends on SOC_FAMILY_ACTIONS
	help
	  Enable support for Actions Semi Clock Management Unit driver.
```

## drivers/clock_control/Kconfig.agilex
```kconfig
# Copyright (C) 2023, Intel Corporation
# SPDX-License-Identifier: Apache-2.0

config CLOCK_CONTROL_AGILEX
	bool "Agilex SoCFPGA clock control driver"
	default y
	depends on DT_HAS_INTEL_AGILEX_CLOCK_ENABLED
	help
	  This option enables the clock driver for Intel Agilex SoCFPGA SOC.
```

## drivers/clock_control/Kconfig.agilex5
```kconfig
# Copyright (C) 2023, Intel Corporation
# SPDX-License-Identifier: Apache-2.0

config CLOCK_CONTROL_AGILEX5
	bool "Agilex5 SoCFPGA clock control driver"
	default y
	depends on DT_HAS_INTEL_AGILEX5_CLOCK_ENABLED
	help
	  This option enables the clock driver for Intel Agilex5 SoCFPGA SOC.
```

## drivers/clock_control/Kconfig.alif
```kconfig
# Copyright (c) 2025 Alif Semiconductor
# SPDX-License-Identifier: Apache-2.0

config CLOCK_CONTROL_ALIF
	bool "Alif Semiconductor clock control driver"
	default y
	depends on DT_HAS_ALIF_CLOCKCTRL_ENABLED
	help
	  Enable clock control driver for Alif Semiconductor SoCs.
```

## drivers/clock_control/Kconfig.ambiq
```kconfig
# Ambiq Clock Control Driver configuration options
#
# Copyright (c) 2023 Ambiq Micro Inc.
#
# SPDX-License-Identifier: Apache-2.0
#

config CLOCK_CONTROL_AMBIQ
	bool "AMBIQ clock control driver"
	default y
	depends on DT_HAS_AMBIQ_CLKCTRL_ENABLED
	select AMBIQ_HAL
	help
	  Enable driver for Ambiq clock control.
```

## drivers/clock_control/Kconfig.ameba
```kconfig
# Copyright (c) 2026 Realtek Semiconductor Corp.
# SPDX-License-Identifier: Apache-2.0

# Ameba clock controller driver config
config CLOCK_CONTROL_AMEBA
	bool "Ameba clock controller driver"
	default y
	depends on DT_HAS_REALTEK_AMEBA_RCC_ENABLED
	help
		Enable support for Ameba clock controller driver.
```

## drivers/clock_control/Kconfig.aspeed
```kconfig
# Copyright (c) 2022 ASPEED Technology Inc.
# SPDX-License-Identifier: Apache-2.0

config CLOCK_CONTROL_AST10X0
	bool "ASPEED clock control driver"
	default y
	depends on DT_HAS_ASPEED_AST10X0_CLOCK_ENABLED
	help
	  This option enables the clock driver for ASPEED AST10X0 series SOC.
```

## drivers/clock_control/Kconfig.at32
```kconfig
# Copyright (c) 2022 Teslabs Engineering S.L.
# SPDX-License-Identifier: Apache-2.0
config CLOCK_CONTROL_AT32
	bool "AT32 clock control"
	default y
	depends on DT_HAS_AT_AT32_CCTL_ENABLED
	help
	  Enable driver for AT32 Reset Clock Unit (CRM).
```

## drivers/clock_control/Kconfig.aurix
```kconfig
# Copyright (c) 2024 Infineon Technologies AG
# SPDX-License-Identifier: Apache-2.0

config CLOCK_CONTROL_TC3X_CCU
	bool "TC3x Clock Control Unit Driver"
	default y
	depends on DT_HAS_INFINEON_TC3X_CCU_ENABLED

config CLOCK_CONTROL_TC4X_CCU
	bool "TC4x Clock Control Unit Driver"
	default y
	depends on DT_HAS_INFINEON_TC4X_CCU_ENABLED
```

## drivers/clock_control/Kconfig.bee
```kconfig
# Copyright (c) 2026, Realtek Semiconductor Corporation
# SPDX-License-Identifier: Apache-2.0

config CLOCK_CONTROL_BEE
	bool "Realtek Bee series clock control driver"
	default y
	depends on DT_HAS_REALTEK_BEE_CCTL_ENABLED
	select HAL_REALTEK_BEE_RCC
	help
	  This option enables the clock controller driver for Realtek Bee SoCs.
```

## drivers/clock_control/Kconfig.beetle
```kconfig
# Beetle MCU clock control driver config

# Copyright (c) 2016 Linaro Limited.
# SPDX-License-Identifier: Apache-2.0

if SOC_FAMILY_ARM

menuconfig CLOCK_CONTROL_BEETLE
	bool "BEETLE Clock Control"
	default y
	depends on DT_HAS_ARM_BEETLE_SYSCON_ENABLED
	help
	  Enable driver for Reset & Clock Control subsystem found
	  in STM32F4 family of MCUs

if CLOCK_CONTROL_BEETLE

config CLOCK_CONTROL_BEETLE_ENABLE_PLL
	bool "PLL on Beetle"
	depends on SOC_SERIES_BEETLE
	help
	  Enable PLL on Beetle.

	  Select n if not sure.

endif # CLOCK_CONTROL_BEETLE

endif # SOC_FAMILY_ARM
```

## drivers/clock_control/Kconfig.bflb
```kconfig
# Copyright (c) 2025 MASSDRIVER EI (massdriver.space)
# SPDX-License-Identifier: Apache-2.0

config CLOCK_CONTROL_BOUFFALOLAB_BL60X
	bool "Bouffalolab BL60x Clock Control"
	default y
	depends on DT_HAS_BFLB_BL60X_CLOCK_CONTROLLER_ENABLED

config CLOCK_CONTROL_BOUFFALOLAB_BL61X
	bool "Bouffalolab BL61x Clock Control Driver"
	default y
	depends on DT_HAS_BFLB_BL61X_CLOCK_CONTROLLER_ENABLED

config CLOCK_CONTROL_BOUFFALOLAB_BL70X
	bool "Bouffalolab BL70x Clock Control"
	default y
	depends on DT_HAS_BFLB_BL70X_CLOCK_CONTROLLER_ENABLED
```

## drivers/clock_control/Kconfig.cavs
```kconfig
# Intel cAVS clock control driver

# Copyright (c) 2022 Intel Corporation
# SPDX-License-Idertifier: Apache-2.0

config CLOCK_CONTROL_ADSP
	bool "Intel CAVS clock control"
	default y
	depends on DT_HAS_INTEL_ADSP_SHIM_CLKCTL_ENABLED
	select ADSP_CLOCK
	help
	  Driver for the CAVS clocks. Allow type of clock (and
	  thus frequency) to be chosen.
```

## drivers/clock_control/Kconfig.ch32v
```kconfig
# Copyright (c) 2023-2024 Chen Xingyu <hi@xingrz.me>
# SPDX-License-Identifier: Apache-2.0

config CLOCK_CONTROL_CH56X_CLKMUX
	bool "WCH CH56x clock mux controller"
	default y
	depends on DT_HAS_WCH_CH56X_CLKMUX_ENABLED
	help
	  Enable WCH CH56x clock mux controller.
```

## drivers/clock_control/Kconfig.em32
```kconfig
# SPDX-FileCopyrightText: 2026 ELAN Microelectronics Corp.
#
# SPDX-License-Identifier: Apache-2.0

config CLOCK_CONTROL_EM32_AHB
	bool "Elan EM32 AHB clock control"
	default y
	depends on SOC_EM32F967
	depends on DT_HAS_ELAN_EM32_AHB_ENABLED
	select SYSCON
	help
	  This option enables the clock controller ahb driver for EM32FXXX.

config CLOCK_CONTROL_EM32_APB
	bool "Elan EM32 APB clock control"
	default y
	depends on SOC_EM32F967
	depends on DT_HAS_ELAN_EM32_APB_ENABLED
	depends on CLOCK_CONTROL_EM32_AHB
	help
	  This option enables the clock controller apb driver for EM32FXXX.

if CLOCK_CONTROL_EM32_AHB || CLOCK_CONTROL_EM32_APB

config EM32_DELAY_SWITCH_PRIORITY
	int "Delay switch init priority"
	default 1
	help
	  Initialization priority for switching the delay backend to k_busy_wait().
	  Must be greater than CONFIG_SYSTEM_CLOCK_INIT_PRIORITY, because the
	  system timer is initialized in PRE_KERNEL_2.

	  Default is 1 (CONFIG_SYSTEM_CLOCK_INIT_PRIORITY + 1 on this SoC).
	  A BUILD_ASSERT enforces ordering and will fail the build if the system
	  clock init priority changes.

endif # CLOCK_CONTROL_EM32_AHB || CLOCK_CONTROL_EM32_APB

if CLOCK_CONTROL_EM32_APB

config CLOCK_CONTROL_EM32_APB_INIT_PRIORITY
	int "EM32 APB clock control initialization priority"
	default 53
	depends on CLOCK_CONTROL_EM32_APB
	help
	  Initialization priority for the EM32 APB clock control driver.
	  This must be greater than CLOCK_CONTROL_EM32_AHB_INIT_PRIORITY
	  since the APB clock depends on the AHB clock.

endif # CLOCK_CONTROL_EM32_APB

if CLOCK_CONTROL_EM32_AHB

config CLOCK_CONTROL_EM32_AHB_INIT_PRIORITY
	int "EM32 AHB clock control initialization priority"
	default 52
	depends on CLOCK_CONTROL_EM32_AHB
	help
	  Initialization priority for the EM32 AHB clock control driver.
	  This driver must initialize after syscon.
	  Other EM32 drivers that depend on the AHB clock controller
	  (such as APB clock control and GPIO) must initialize after this driver.

endif # CLOCK_CONTROL_EM32_AHB
```

## drivers/clock_control/Kconfig.esp32
```kconfig
# ESP32 Clock Driver configuration options

# Copyright (c) 2020 Mohamed ElShahawi
# Copyright (c) 2026 Espressif Systems (Shanghai) Co., Ltd.
# SPDX-License-Identifier: Apache-2.0

config CLOCK_CONTROL_ESP32
	bool "ESP32 Clock driver"
	default y
	depends on DT_HAS_ESPRESSIF_ESP32_CLOCK_ENABLED
	help
	  Enable support for ESP32 clock driver.

if CLOCK_CONTROL_ESP32

ESP32_CLOCK_NODE_PATH := $(dt_nodelabel_path,clock)
ESP32_SLOW_CLK_SRC := $(dt_node_int_prop_int,$(ESP32_CLOCK_NODE_PATH),slow-clk-src)

choice CLOCK_CONTROL_ESP32_RTC_CLK_SRC
	prompt "RTC clock source"
	default CLOCK_CONTROL_ESP32_RTC_CLK_SRC_EXT_CRYS if \
		$(ESP32_SLOW_CLK_SRC) = 1 && !SOC_SERIES_ESP32C2
	default CLOCK_CONTROL_ESP32_RTC_CLK_SRC_EXT_OSC if $(ESP32_SLOW_CLK_SRC) = 1 && SOC_SERIES_ESP32C2
	default CLOCK_CONTROL_ESP32_RTC_CLK_SRC_INT_8MD256 if $(ESP32_SLOW_CLK_SRC) = 2 && \
		!SOC_SERIES_ESP32C5 && !SOC_SERIES_ESP32C6 && !SOC_SERIES_ESP32H2
	default CLOCK_CONTROL_ESP32_RTC_CLK_SRC_INT_RC
	help
	  Choose which clock is used as RTC clock source.
	  The default is derived from the devicetree slow-clk-src property
	  but can be overridden in prj.conf.

config CLOCK_CONTROL_ESP32_RTC_CLK_SRC_INT_RC
	bool "Internal RC oscillator"

config CLOCK_CONTROL_ESP32_RTC_CLK_SRC_EXT_CRYS
	bool "External 32 kHz crystal"
	depends on !SOC_SERIES_ESP32C2
	select CLOCK_CONTROL_ESP32_SYSTEM_RTC_EXT_XTAL

config CLOCK_CONTROL_ESP32_RTC_CLK_SRC_EXT_OSC
	bool "External 32 kHz oscillator"
	select CLOCK_CONTROL_ESP32_SYSTEM_RTC_EXT_OSC

config CLOCK_CONTROL_ESP32_RTC_CLK_SRC_INT_8MD256
	bool "Internal oscillator, divided by 256"
	depends on !SOC_SERIES_ESP32C5 && !SOC_SERIES_ESP32C6 && !SOC_SERIES_ESP32H2

endchoice

config CLOCK_CONTROL_ESP32_SYSTEM_RTC_EXT_XTAL
	bool

config CLOCK_CONTROL_ESP32_SYSTEM_RTC_EXT_OSC
	bool

config CLOCK_CONTROL_ESP32_RTC_CLK_CAL_CYCLES
	int "Number of cycles for RTC_SLOW_CLK calibration"
	default 3000 if CLOCK_CONTROL_ESP32_RTC_CLK_SRC_EXT_CRYS || \
		CLOCK_CONTROL_ESP32_RTC_CLK_SRC_EXT_OSC || \
		CLOCK_CONTROL_ESP32_RTC_CLK_SRC_INT_8MD256
	default 576 if CLOCK_CONTROL_ESP32_RTC_CLK_SRC_INT_RC && SOC_SERIES_ESP32S2
	default 1024
	range 0 27000 if SOC_SERIES_ESP32 && \
		(CLOCK_CONTROL_ESP32_RTC_CLK_SRC_EXT_CRYS || \
		CLOCK_CONTROL_ESP32_RTC_CLK_SRC_EXT_OSC || \
		CLOCK_CONTROL_ESP32_RTC_CLK_SRC_INT_8MD256)
	range 0 8190 if !SOC_SERIES_ESP32 && \
		(CLOCK_CONTROL_ESP32_RTC_CLK_SRC_EXT_CRYS || \
		CLOCK_CONTROL_ESP32_RTC_CLK_SRC_EXT_OSC || \
		CLOCK_CONTROL_ESP32_RTC_CLK_SRC_INT_8MD256)
	range 0 32766
	help
	  When the startup code initializes RTC_SLOW_CLK, it can perform
	  calibration by comparing the RTC_SLOW_CLK frequency with main XTAL
	  frequency. This option sets the number of RTC_SLOW_CLK cycles measured
	  by the calibration routine. Higher numbers increase calibration
	  precision, which may be important for applications which spend a lot of
	  time in deep sleep. Lower numbers reduce startup time.

	  When this option is set to 0, clock calibration will not be performed at
	  startup, and approximate clock frequencies will be assumed:

	  - 150000 Hz if internal RC oscillator is used as clock source.
	  - 32768 Hz if the 32k crystal oscillator is used.

	  Recommended values:
	  - 1024 for internal RC oscillator (576 for ESP32-S2).
	  - 3000 or more for 32k crystal oscillator. Higher values help improve
	    crystal startup detection. If the crystal fails to start, the driver
	    will fall back to internal RC.

config CLOCK_CONTROL_ESP32_RTC_XTAL_CAL_RETRY
	int "Number of attempts to repeat 32k XTAL calibration"
	default 3 if SOC_SERIES_ESP32S2
	default 1
	depends on CLOCK_CONTROL_ESP32_RTC_CLK_SRC_EXT_CRYS
	help
	  Number of attempts to repeat 32k XTAL calibration before giving
	  up and switching to the internal RC. Increase this option if the
	  32k crystal oscillator does not start and switches to internal RC.

endif # CLOCK_CONTROL_ESP32
```

## drivers/clock_control/Kconfig.esp32_cam
```kconfig
config CLOCK_CONTROL_ESP32_CAM
	bool "master clock for esp32 camera interface"
	help
	  This option enables the pheriphery and cam clock for the lcd_cam module.
```

## drivers/clock_control/Kconfig.esp32c3
```kconfig
# ESP32C3 Clock Driver configuration options

# Copyright (c) 2021 Espressif Systems (Shanghai) Co., Ltd.
# SPDX-License-Identifier: Apache-2.0

config CLOCK_CONTROL_ESP32C3
	bool "ESP32C3 Clock driver"
	depends on SOC_ESP32C3
	help
	  Enable support for ESP32C3 clock driver.
```

## drivers/clock_control/Kconfig.esp32s2
```kconfig
# ESP32S2 Clock Driver configuration options

# Copyright (c) 2021 Espressif Systems (Shanghai) Co., Ltd.
# SPDX-License-Identifier: Apache-2.0

config CLOCK_CONTROL_ESP32S2
	bool "ESP32S2 Clock driver"
	depends on SOC_ESP32S2
	help
	  Enable support for ESP32S2 clock driver.
```

## drivers/clock_control/Kconfig.fixed
```kconfig
# Fixed clock control driver config

# Copyright (c) 2022 Google, LLC
# SPDX-License-Identifier: Apache-2.0

config CLOCK_CONTROL_FIXED_RATE_CLOCK
	bool "Fixed Clock Clock Control"
	default n
	help
	  Enable driver for devicetree defined fixed clocks.
```

## drivers/clock_control/Kconfig.focaltech
```kconfig
# Copyright (c) 2025, FocalTech Systems CO.,Ltd
# SPDX-License-Identifier: Apache-2.0

config CLOCK_CONTROL_FOCALTECH_FT9001
	bool "FocalTech FT9001 Clock Power Module (CPM) driver"
	default y
	depends on DT_HAS_FOCALTECH_FT9001_CPM_ENABLED
	help
	  Enable clock control driver for FocalTech FT9001 SoC.
	  This driver provides support for controlling peripheral
	  clocks through the Clock Power Module (CPM) which manages
	  clock gating for various on-chip peripherals including
	  UART, SPI, I2C, CAN, USB, crypto engines, and memory
	  controllers.
```

## drivers/clock_control/Kconfig.gd32e1
```kconfig
# GD32E1 PLL configuration options

# Copyright (c) 2019 Linaro
# SPDX-License-Identifier: Apache-2.0


if SOC_SERIES_GD32E1X

config CLOCK_CONTROL_GD32_DEVICE_INIT_PRIORITY
	int "Clock Control Device Priority"
	default 1
	help
	  This option controls the priority of clock control
	  device initialization. Higher priority ensures that the device
	  is initialized earlier in the startup cycle. If unsure, leave
	  at default value 1

endif # SOC_SERIES_GD32E1X
```

## drivers/clock_control/Kconfig.hc32
```kconfig
# Copyright (C) 2024-2025, Xiaohua Semiconductor Co., Ltd.
# SPDX-License-Identifier: Apache-2.0

config CLOCK_CONTROL_HC32
	bool "HC32 Clock Control"
	default y
	depends on DT_HAS_XHSC_HC32_CLOCK_CONTROL_ENABLED
```

## drivers/clock_control/Kconfig.ifx_cat1
```kconfig
# Infineon CAT1 clock control driver

# Copyright (c) 2022 Cypress Semiconductor Corporation (an Infineon company) or
# an affiliate of Cypress Semiconductor Corporation
# SPDX-License-Identifier: Apache-2.0

config CLOCK_CONTROL_INFINEON_CAT1
	bool "Infineon CAT1 clock control driver"
	default y
	depends on SOC_FAMILY_INFINEON_CAT1
	depends on DT_HAS_FIXED_CLOCK_ENABLED
	help
	  This option enables the clock control driver for Infineon CAT1 family.

config CLOCK_CONTROL_IFX_FIXED_CLOCK
	bool "Infineon fixed clock driver"
	default y
	depends on DT_HAS_INFINEON_FIXED_CLOCK_ENABLED
	help
	  This option enables the Fixed clock driver for Infineon CAT1 family.

config CLOCK_CONTROL_IFX_FIXED_FACTOR_CLOCK
	bool "Infineon fixed factor clock driver"
	default y
	depends on DT_HAS_INFINEON_FIXED_FACTOR_CLOCK_ENABLED
	help
	  This option enables the Fixed clock driver for Infineon CAT1 family.

config CLOCK_CONTROL_IFX_PERI_CLOCK
	bool "Infineon peri div clock driver"
	default y
	depends on DT_HAS_INFINEON_PERI_DIV_ENABLED
	help
	  This option enables the Peripheral clock driver for Infineon CAT1 family.


if CLOCK_CONTROL_IFX_FIXED_FACTOR_CLOCK

config CLOCK_CONTROL_IFX_FIXED_FACTOR_CLOCK_INIT_PRIORITY
	int "Infineon fixed factor clock driver init priority"
	default 29
	help
	  Infineon fixed factor clock control driver initialization priority.
	  This should be lower than the priority of fixed factor clock driver
	  to ensure the clock paths are initialized before.

endif # CLOCK_CONTROL_IFX_FIXED_FACTOR_CLOCK
```
