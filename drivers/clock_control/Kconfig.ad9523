## drivers/clock_control/Kconfig.renesas_rx_cgc
```kconfig
# Copyright (c) 2024-2026 Renesas Electronics Corporation
# SPDX-License-Identifier: Apache-2.0

config CLOCK_CONTROL_RENESAS_RX_CGC
	bool "RX CGC driver"
	default y
	depends on SOC_FAMILY_RENESAS_RX
	help
	  Enable support for Renesas RX CGC driver.

if CLOCK_CONTROL_RENESAS_RX_CGC

config CLOCK_CONTROL_RENESAS_RX_ROOT
	bool "Renesas RX root clock source"
	depends on DT_HAS_RENESAS_RX_CGC_ROOT_CLOCK_ENABLED
	default y
	help
	  Enable Renesas RX root clock

config CLOCK_CONTROL_RENESAS_RX_PLL
	bool "Renesas RX PLL clock source"
	depends on DT_HAS_RENESAS_RX_CGC_PLL_ENABLED
	default y
	help
	  Enable Renesas RX PLL, only apply to RX MCUs
	  that have only one PLL circuit.

config CLOCK_CONTROL_RENESAS_RX_PLLCCR_TYPE
	bool "Renesas RX PLL clock source using FSP"
	depends on DT_HAS_RENESAS_RX_CGC_PLLCCR_TYPE_ENABLED
	default y
	help
	  Enable PLL support for RX MCUs whose PLL multiplier
	  settings are represented as PLLCCR indexed values.

config CLOCK_CONTROL_RENESAS_RX_PCLK
	bool "Renesas RX root clock source"
	default y
	help
	  Enable Renesas RX PCLK clock source

endif
```

## drivers/clock_control/Kconfig.rockchip
```kconfig
# Copyright (c) 2026 KylinSoft Corporation
# SPDX-License-Identifier: Apache-2.0

config CLOCK_CONTROL_ROCKCHIP_RK3588
	bool "Rockchip RK3588 CRU clock controller"
	default y
	depends on DT_HAS_ROCKCHIP_RK3588_CRU_CLK_ENABLED
	help
	  Enable clock gate control for the Rockchip RK3588 CRU.
```

## drivers/clock_control/Kconfig.sifive
```kconfig
# SiFive clock control drivers

# SPDX-FileCopyrightText: Copyright The Zephyr Project Contributors
# SPDX-License-Identifier: Apache-2.0

config CLOCK_CONTROL_SIFIVE_PRCI
	bool "SiFive FU540 PRCI clock controller driver"
	default y
	depends on DT_HAS_SIFIVE_FU540_C000_PRCI_ENABLED
	select CLOCK_CONTROL_FIXED_RATE_CLOCK if DT_HAS_FIXED_CLOCK_ENABLED
	help
	  Enable the driver for the clocks of the SiFive FU540 Power Reset
	  Clock Interrupt block (PRCI).
```

## drivers/clock_control/Kconfig.silabs
```kconfig
# Copyright (c) 2024 Silicon Laboratories Inc.
# SPDX-License-Identifier: Apache-2.0

config CLOCK_CONTROL_SILABS_SERIES
	bool "Silicon Labs Series 2+ clock control driver"
	default y
	depends on DT_HAS_SILABS_SERIES_CLOCK_ENABLED
	select SILABS_SISDK_CLOCK_MANAGER
	help
	  Enable Silicon Labs Series 2+ Clock Management Unit clock control driver.

config CLOCK_CONTROL_SILABS_SERIES_OUTPUT
	bool "Silicon Labs Series 2+ clock output driver"
	default y
	depends on DT_HAS_SILABS_SERIES_CLOCK_OUTPUT_ENABLED
	select SILABS_SISDK_CLOCK_MANAGER
	select PINCTRL
	help
	  Enable Silicon Labs Series 2+ Clock Management Unit clock output driver.
	  The driver supports on, off, get_rate and get_status actions to control the
	  export of a clock as configured in devicetree to a pin. The clock subsys
	  parameter represents the clock output to act upon.

if CLOCK_CONTROL_SILABS_SERIES_OUTPUT

config CLOCK_CONTROL_SILABS_SERIES_OUTPUT_INIT_PRIORITY
	int "Silicon Labs Series 2+ clock output init priority"
	default KERNEL_INIT_PRIORITY_DEFAULT
	help
	  Initialization priority for clock output. Must be greater than pinctrl/GPIO init,
	  and lower than any consumer of the clock.

endif
```

## drivers/clock_control/Kconfig.siwx91x
```kconfig
# Copyright (c) 2024 Silicon Laboratories Inc.
# SPDX-License-Identifier: Apache-2.0

config CLOCK_CONTROL_SILABS_SIWX91X
	bool "Silabs SiWx91x clock control driver"
	default y
	depends on DT_HAS_SILABS_SIWX91X_CMU_HP_ENABLED && \
		DT_HAS_SILABS_SIWX91X_CMU_ULP_ENABLED && \
		DT_HAS_SILABS_SIWX91X_CMU_AON_ENABLED
	help
	  Enable clock management on Silicon Labs SiWx91x chips. This driver
	  includes support for HP (High Performance), ULP (Ultra Low Power), and
	  AON (Always-On) clocks.

	  AON / ULP / HP init order is expressed in the device tree via clocks
	  phandles between the CMU nodes. All three managers use
	  CLOCK_CONTROL_INIT_PRIORITY; DT dependency ordinals order them.
```

## drivers/clock_control/Kconfig.ti_cdce9xx
```kconfig
# Copyright (c) 2026 Carl Zeiss Meditec AG
# SPDX-License-Identifier: Apache-2.0

config CLOCK_CONTROL_TI_CDCE9XX
	bool "TI Low Power Clock Generator CDCE9xx"
	depends on DT_HAS_TI_CDCE913_ENABLED || \
				DT_HAS_TI_CDCE925_ENABLED || \
				DT_HAS_TI_CDCE937_ENABLED || \
				DT_HAS_TI_CDCE949_ENABLED
	select I2C
	help
	  Driver for TI Low Power Clock Generator CDCE9xx.

config CLOCK_CONTROL_TI_CDCE9XX_PRIORITY
	int "TI Low Power Clock Generator CDCE9xx Init Priority"
	default 90
	depends on CLOCK_CONTROL_TI_CDCE9XX
	help
	  TI Low Power Clock Generator CDCE9xx initialization priority

if CLOCK_CONTROL_TI_CDCE9XX

module = CDCE9XX
module-str = CDCE9XX clock control
source "subsys/logging/Kconfig.template.log_config"

endif # CLOCK_CONTROL_TI_CDCE9XX
```

## drivers/clock_control/Kconfig.wch_ch570
```kconfig
# SPDX-FileCopyrightText: 2026 SMILE (smile.eu)
# SPDX-License-Identifier: Apache-2.0

config CLOCK_CONTROL_WCH_CH570
	bool "WCH CH570/CH572 Clock Control driver"
	default y
	depends on DT_HAS_WCH_CH570_CLKCTRL_ENABLED
	help
	  WCH CH570/CH572 Clock Control driver.
```

## drivers/clock_control/Kconfig.wch_rcc
```kconfig
# Copyright (c) 2024 Michael Hope
# SPDX-License-Identifier: Apache-2.0

config CLOCK_CONTROL_WCH_RCC
	bool "WCH CH32V00x Reset and Clock Control (RCC) driver"
	default y
	depends on DT_HAS_WCH_RCC_ENABLED

if CLOCK_CONTROL_WCH_RCC

# Micro-controller Clock Output (MCO) configuration options
config CLOCK_WCH_MCO
	bool "WCH CH32 MCO clock output driver"
	default y
	depends on DT_HAS_WCH_CH32V20X_30X_CLOCK_MCO_ENABLED \
			|| DT_HAS_WCH_CH32V00X_CLOCK_MCO_ENABLED \
			|| DT_HAS_WCH_CH32V305_7_V317_CLOCK_MCO_ENABLED \
			|| DT_HAS_WCH_CH32H417_CLOCK_MCO_ENABLED
	depends on PINCTRL
	help
	  Allows to output various different clock sources onto the MCO output pin.

endif # CLOCK_CONTROL_WCH_RCC
```

## drivers/clock_control/Kconfig.xlnx_zynq
```kconfig
# Xilinx Zynq clock controller drivers

# SPDX-FileCopyrightText: Copyright The Zephyr Project Contributors
# SPDX-License-Identifier: Apache-2.0

config CLOCK_CONTROL_XLNX_ZYNQ
	bool "Xilinx Zynq-7000 clock controller driver"
	default y
	depends on DT_HAS_XLNX_PS7_CLKC_ENABLED
	select SYSCON
	help
	  Enable the driver for the clock controller of the Xilinx Zynq-7000
	  processing system, the clock part of the SLCR.

config CLOCK_CONTROL_XLNX_ZYNQMP
	bool "Xilinx ZynqMP clock controller driver"
	default y
	depends on DT_HAS_XLNX_ZYNQMP_CLK_ENABLED
	select CLOCK_CONTROL_FIXED_RATE_CLOCK if DT_HAS_FIXED_CLOCK_ENABLED
	help
	  Enable the driver for the clock controller of the Xilinx ZynqMP,
	  accessing the CRL_APB and CRF_APB registers directly.
```

## drivers/clock_management/adi_max32/Kconfig
```kconfig
# Copyright 2026 Analog Devices, Inc.
# SPDX-License-Identifier: Apache-2.0

config CLOCK_MANAGEMENT_ADI_MAX32
	bool
	help
	  ADI MAX32 clock drivers

config CLOCK_MANAGEMENT_ADI_MAX32_SOURCE
	bool "ADI MAX32 clock source driver"
	default y
	depends on DT_HAS_ADI_MAX32_CLOCK_SOURCE_ENABLED
	select CLOCK_MANAGEMENT_ADI_MAX32
	help
	  ADI MAX32 clock source driver

config CLOCK_MANAGEMENT_ADI_MAX32_DIV
	bool "ADI MAX32 clock source divider"
	default y
	depends on DT_HAS_ADI_MAX32_CLOCK_DIV_ENABLED
	select CLOCK_MANAGEMENT_ADI_MAX32
	help
	  ADI MAX32 clock source divider/prescaler
```
