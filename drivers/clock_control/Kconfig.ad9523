## drivers/clock_control/Kconfig.ad9523
```kconfig
# Copyright (c) 2026 Analog Devices, Inc.
# SPDX-License-Identifier: Apache-2.0

config CLOCK_CONTROL_AD9523
	bool "AD9523(-1) dual-PLL clock generator"
	default y
	depends on DT_HAS_ADI_AD9523_1_ENABLED
	select SPI
	help
	  Enable the Analog Devices AD9523-1 driver: a 14-output, dual-PLL,
	  SPI-programmed clock generator and JESD204 SYSREF distributor.

if CLOCK_CONTROL_AD9523

config CLOCK_CONTROL_AD9523_INIT_PRIORITY
	int "AD9523 clock generator init priority"
	default 60
	help
	  Initialisation priority of the AD9523 clock_control driver, within
	  POST_KERNEL.

endif # CLOCK_CONTROL_AD9523
```

## drivers/clock_control/Kconfig.adi_axi_clkgen
```kconfig
# Copyright (c) 2026 Analog Devices, Inc.
# SPDX-License-Identifier: Apache-2.0

config CLOCK_CONTROL_ADI_AXI_CLKGEN
	bool "Analog Devices AXI Clock Generator driver"
	default y
	depends on DT_HAS_ADI_AXI_CLKGEN_ENABLED
	help
	  Driver for the Analog Devices AXI Clock Generator core.
	  Provides software-programmable clock output via Xilinx MMCM.
```

## drivers/clock_control/Kconfig.aesc
```kconfig
# SPDX-FileCopyrightText: 2026 Aesc Silicon
# SPDX-License-Identifier: Apache-2.0

config CLOCK_CONTROL_AESC
	bool "Aesc Silicon clock controller driver"
	default y
	depends on DT_HAS_AESC_CLOCK_CONTROLLER_ENABLED
	select SYSCON
	help
	  Enable the Aesc Silicon clock controller driver.
	  The reference clock frequency is read from the syscon device
	  referenced by the node's "syscon" property.
```

## drivers/clock_control/Kconfig.arm_scmi
```kconfig
# Copyright 2024 NXP

config CLOCK_CONTROL_ARM_SCMI
	bool "SCMI clock protocol clock controller driver"
	default y
	depends on ARM_SCMI_CLK_HELPERS
	help
	  Enable support for SCMI-based clock control.

if CLOCK_CONTROL_ARM_SCMI

config CLOCK_CONTROL_SCMI_INIT_PRIORITY
	int "SCMI clock controller driver initialization priority"
	default 60 if ARM_SCMI_OPTEE_TRANSPORT
	default CLOCK_CONTROL_INIT_PRIORITY

endif # CLOCK_CONTROL_ARM_SCMI
```

## drivers/clock_control/Kconfig.beken
```kconfig
# Copyright The Zephyr Project Contributors
# SPDX-License-Identifier: Apache-2.0

config CLOCK_CONTROL_BEKEN_BK7258
	bool "Beken BK7258 clock generation unit"
	default y
	depends on DT_HAS_BEKEN_BK7258_CGU_ENABLED
	help
	  This option enables the driver for the Beken BK7258 clock generation
	  unit.
```

## drivers/clock_control/Kconfig.emul
```kconfig
# SPDX-FileCopyrightText: Copyright (c) 2026 TOKITA Hiroshi
# SPDX-License-Identifier: Apache-2.0

config CLOCK_CONTROL_EMUL
	bool "Clock controller emulation driver"
	default y
	depends on DT_HAS_ZEPHYR_CLOCK_CONTROLLER_EMUL_ID_ENABLED || \
		DT_HAS_ZEPHYR_CLOCK_CONTROLLER_EMUL_CLKID_ENABLED || \
		DT_HAS_ZEPHYR_CLOCK_CONTROLLER_EMUL_CLK_ID_ENABLED || \
		DT_HAS_ZEPHYR_CLOCK_CONTROLLER_EMUL_RCAR_CPG_MSSR_ENABLED
	help
	  Enable clock controller emulation driver.
```

## drivers/clock_control/Kconfig.gd32
```kconfig
# Copyright (c) 2022 Teslabs Engineering S.L.
# Copyright (c) 2026 GigaDevice Semiconductor Inc.
# SPDX-License-Identifier: Apache-2.0

config CLOCK_CONTROL_GD32
	bool "GD32 clock control"
	default y
	depends on DT_HAS_GD_GD32_CCTL_ENABLED
	help
	  Enable driver for Gigadevice Reset Clock Unit (RCU).

config CLOCK_CONTROL_GD32_CKOUT
	bool "GD32 CKOUT clock output"
	default y
	depends on DT_HAS_GD_GD32_CLOCK_CKOUT_ENABLED
	help
	  Enable driver for GD32 CKOUT clock output configuration.

config CLOCK_CONTROL_GD32_PLL
	bool "GD32 PLL/system clock DTS configuration"
	default y
	depends on DT_HAS_GD_GD32F527_RCU_ENABLED
	help
	  Enable DTS-driven PLL and system clock tree configuration for the
	  GD32F527. When enabled, the HXTAL, main PLL, AHB/APB prescalers and
	  system clock source are configured from the devicetree during
	  PRE_KERNEL_1. When disabled, the fixed HAL SystemInit() setup is used.

config GD32_HXTAL_DT_FREQ
	int
	default $(dt_nodelabel_int_prop,hxtal,clock-frequency)
	depends on CLOCK_CONTROL_GD32_PLL
	depends on $(dt_nodelabel_enabled,hxtal)
	help
	  HXTAL frequency in Hz, taken from the clock-frequency property of
	  the hxtal devicetree node. It is passed to the HAL as HXTAL_VALUE.
```

## drivers/clock_control/Kconfig.hmc7044
```kconfig
# Analog Devices HMC7044 clock generator

# Copyright (c) 2026 Analog Devices, Inc.
#
# SPDX-License-Identifier: Apache-2.0

config CLOCK_CONTROL_HMC7044
	bool "HMC7044 dual-PLL clock generator"
	default y
	depends on DT_HAS_ADI_HMC7044_ENABLED
	select SPI
	help
	  Enable the Analog Devices HMC7044 driver: a 14-output, dual-PLL,
	  SPI-programmed jitter-attenuating clock generator and JESD204 SYSREF
	  distributor.

	  Output rates are programmed once from devicetree. set_rate(), async_on()
	  and configure() are not implemented, because retuning an output divider
	  under a live JESD204 link would break the link.

if CLOCK_CONTROL_HMC7044

config CLOCK_CONTROL_HMC7044_INIT_PRIORITY
	int "HMC7044 clock generator init priority"
	default 60
	help
	  Initialisation priority of the HMC7044 clock_control driver, within
	  POST_KERNEL.

	  Unlike most clock providers this driver cannot run at PRE_KERNEL_1: it
	  is SPI-attached, and Zephyr SPI controllers initialise at POST_KERNEL
	  (SPI_INIT_PRIORITY, default 50). This value must therefore stay
	  strictly greater than SPI_INIT_PRIORITY -- a build assertion in the
	  driver enforces that -- and every consumer of the HMC7044's rates must
	  itself initialise later still, or it will query an unprogrammed chip.

endif # CLOCK_CONTROL_HMC7044
```

## drivers/clock_control/Kconfig.hpmicro
```kconfig
# Copyright (c) 2024 HPMicro
# Copyright (c) 2026 Cody Gu <gujiaqi@iscas.ac.cn>
# SPDX-License-Identifier: Apache-2.0

config CLOCK_CONTROL_HPMICRO
	bool "HPMicro PLLv2 clock controller"
	default y
	depends on DT_HAS_HPMICRO_HPM_PLLV2_ENABLED
	depends on HAS_HPMSDK_PLLCTLV2
	select USE_HPMSDK_PLLCTLV2
	help
	  Enable the HPMicro PLLv2 clock controller driver.
```

## drivers/clock_control/Kconfig.infineon
```kconfig
# Infineon CAT1 clock control driver

# Copyright (c) 2022 Cypress Semiconductor Corporation (an Infineon company) or
# an affiliate of Cypress Semiconductor Corporation
# SPDX-License-Identifier: Apache-2.0

config CLOCK_CONTROL_INFINEON_CAT1
	bool "Infineon Legacy HAL CAT1 clock control driver"
	default y
	depends on SOC_FAMILY_INFINEON_CAT1
	depends on DT_HAS_FIXED_CLOCK_ENABLED
	depends on USE_INFINEON_LEGACY_HAL
	help
	  This option enables the clock control driver for Infineon CAT1 family.

config CLOCK_CONTROL_IFX_FIXED_CLOCK
	bool "Infineon fixed clock driver"
	default y
	depends on DT_HAS_INFINEON_FIXED_CLOCK_ENABLED
	help
	  This option enables the Fixed clock driver for Infineon CAT1 family.

config INFINEON_SYSCLK_LOCK_NONE
	bool
	default n if SOC_SERIES_PSOC4000T
	default y if SOC_FAMILY_INFINEON_PSOC4
	help
	  Hidden option enabled for SoC series whose IMO clock must be explicitly
	  unlocked from the WCO (Cy_SysClk_ImoLock(CY_SYSCLK_IMO_LOCK_NONE)) after
	  being reconfigured. Not all Infineon CAT1 SoCs have this capability.

config CLOCK_CONTROL_IFX_FIXED_FACTOR_CLOCK
	bool "Infineon fixed factor clock driver"
	default y
	depends on DT_HAS_INFINEON_FIXED_FACTOR_CLOCK_ENABLED
	help
	  This option enables the Fixed clock driver for Infineon CAT1 family.

config INFINEON_SYSCLK_HAS_CLK_PUMP
	bool
	default n if SOC_SERIES_PSOC4000T
	default y if SOC_FAMILY_INFINEON_PSOC4
	help
	  Hidden option enabled for SoC series that have a clk_pump (charge
	  pump) IP block. Not all Infineon CAT1 SoCs have this capability.

config CLOCK_CONTROL_IFX_PERI_CLOCK
	bool "Infineon peri div clock driver"
	default y
	depends on DT_HAS_INFINEON_PERI_DIV_ENABLED
	depends on !CLOCK_CONTROL_IFX_PERI_CLOCK_V2
	help
	  This option enables the Peripheral clock driver for Infineon CAT1 family.
	  It is force-disabled when the peripheral clock group driver
	  (CLOCK_CONTROL_IFX_PERI_CLOCK_V2, infineon,peri-clk) is selected, since
	  that driver manages the infineon,peri-div child nodes itself.

config CLOCK_CONTROL_IFX_CLOCK_V2
	bool "Infineon Traveo clock control driver"
	default y
	depends on DT_HAS_INFINEON_CLK_OSC_ENABLED
	depends on DT_HAS_INFINEON_CLK_PLL_ENABLED
	depends on DT_HAS_INFINEON_CAT1C_CLK_HF_ENABLED
	help
	  This option enables the clock control driver for Infineon Traveo family.

config CLOCK_CONTROL_IFX_PERI_CLOCK_V2
	bool "Infineon peripheral clock group driver"
	default y
	depends on DT_HAS_INFINEON_PERI_CLK_ENABLED
	help
	  This option enables the peripheral clock group driver (infineon,peri-clk)
	  for Infineon MCUs.

if CLOCK_CONTROL_IFX_FIXED_FACTOR_CLOCK
config CLOCK_CONTROL_IFX_FIXED_FACTOR_CLOCK_INIT_PRIORITY
	int "Infineon fixed factor clock driver init priority"
	default 29 if !SOC_FAMILY_INFINEON_PSOC4
	default 31 if SOC_FAMILY_INFINEON_PSOC4
	help
	  Infineon fixed factor clock control driver initialization priority.
	  This should be lower than the priority of fixed factor clock driver
	  to ensure the clock paths are initialized before.
endif # CLOCK_CONTROL_IFX_FIXED_FACTOR_CLOCK
```

## drivers/clock_control/Kconfig.infineon_aurix
```kconfig
# SPDX-FileCopyrightText: Copyright (c) 2024 Infineon Technologies AG,
# SPDX-FileCopyrightText: or an affiliate of Infineon Technologies AG. All rights reserved.
# SPDX-FileCopyrightText: Copyright (c) 2026 Linumiz
#
# SPDX-License-Identifier: Apache-2.0

config CLOCK_CONTROL_INFINEON_AURIX_TC4X
	bool "Infineon AURIX TC4x clock control driver"
	default y
	depends on DT_HAS_INFINEON_AURIX_TC4X_CCU_ENABLED
	help
	  Clock control driver for the CLOCK module of Infineon AURIX TC4x
	  devices: PLL, ramp oscillator and clock domain divider setup.

config CLOCK_CONTROL_INFINEON_AURIX_TC3X
	bool "Infineon AURIX TC3x clock control driver"
	default y
	depends on DT_HAS_INFINEON_AURIX_TC3X_CCU_ENABLED
	help
	  Clock control driver for the SCU clock registers of Infineon AURIX
	  TC3x devices: oscillator, PLL and clock domain divider setup.
```

## drivers/clock_control/Kconfig.mtk
```kconfig
# Copyright (c) 2026 MediaTek Inc.
# SPDX-License-Identifier: Apache-2.0

config CLOCK_CONTROL_MT8188_INFRA_AO
	bool "MediaTek MT8188 infra always-on clock controller"
	default y
	depends on DT_HAS_MEDIATEK_MT8188_INFRACFG_AO_ENABLED
	help
	  Enable the peripheral gate clocks in the MT8188 infra always-on
	  subsystem.
```

## drivers/clock_control/Kconfig.npcx
```kconfig
# NPCX Clock controller driver configuration options

# Copyright (c) 2020 Nuvoton Technology Corporation.
# SPDX-License-Identifier: Apache-2.0

config CLOCK_CONTROL_NPCX
	bool "NPCX clock controller driver"
	default y
	depends on DT_HAS_NUVOTON_NPCX_PCC_ENABLED
	help
	  Enable support for NPCX clock controller driver.

if CLOCK_CONTROL_NPCX

config CLOCK_CONTROL_NPCX_EXTERNAL_SRC
	bool "Generate LFCLK by on-chip Crystal Oscillator"
	help
	  When this option is enabled, the internal 32.768 KHz clock (LFCLK)
	  is generated by the on-chip Crystal Oscillator (XTOSC).
	  This includes an on-chip oscillator, to which an external crystal
	  and the related passive components are connected.

config CLOCK_CONTROL_NPCX_SUPP_APB4
	bool "Indicates that the clock controller supports APB4 bus"
	default y if !SOC_SERIES_NPCX7
	help
	  Selected if NPCX series supports APB4 bus.

config CLOCK_CONTROL_NPCX_SUPP_FIU1
	bool "Indicates that the clock controller supports FIU1 bus"
	default y if SOC_SERIES_NPCX4
	help
	  Selected if NPCX series supports FIU1 bus.

config CLOCK_CONTROL_NPCX_ESPI_FMCLK_IN_SLEEP
	bool "Keep the fast clock to the eSPI_SIF module in sleep states"
	default y
	depends on $(dt_nodelabel_bool_prop,pcc,fast-clk-to-espi-sleep-support)
	depends on ESPI_PERIPHERAL_UART && PM
	help
	  When this option is enabled, the fast clock (FMCLK) to the eSPI_SIF
	  module remains enabled while the chip is in the Sleep or Deep Sleep
	  power state. It is required by the eSPI virtual UART channel, which
	  cannot receive host traffic without FMCLK.

endif # CLOCK_CONTROL_NPCX
```

## drivers/clock_control/Kconfig.nxp
```kconfig
# Copyright 2026 NXP
# SPDX-License-Identifier: Apache-2.0

config CLOCK_CONTROL_MCUX_CCM
	bool "MCUX CCM driver"
	default y
	depends on DT_HAS_NXP_IMX_CCM_ENABLED
	help
	  Enable support for mcux ccm driver.

config CLOCK_CONTROL_MCUX_CCM_REV2
	bool "MCUX CCM Rev 2 driver"
	default y
	depends on DT_HAS_NXP_IMX_CCM_REV2_ENABLED
	help
	  Enable support for mcux ccm rev 2 driver.

config CLOCK_CONTROL_MCUX_MCG
	bool "MCUX MCG driver"
	default y
	depends on DT_HAS_NXP_KINETIS_MCG_ENABLED
	help
	  Enable support for mcux mcg driver.

config CLOCK_CONTROL_MCUX_PCC
	bool "MCUX PCC driver"
	default y
	depends on DT_HAS_NXP_KINETIS_PCC_ENABLED
	help
	  Enable support for MCUX PCC driver.

config CLOCK_CONTROL_MCUX_SCG
	bool "MCUX SCG driver"
	default y
	depends on DT_HAS_NXP_KINETIS_SCG_ENABLED
	help
	  Enable support for mcux scg driver.

config CLOCK_CONTROL_MCUX_SCG_K4
	bool "MCUX driver for K4 Generation SCG"
	default y
	depends on DT_HAS_NXP_SCG_K4_ENABLED
	help
	  Enable support for SCG K4 driver

config CLOCK_CONTROL_MCUX_SIM
	bool "MCUX SIM driver"
	default y
	depends on DT_HAS_NXP_KINETIS_SIM_ENABLED
	help
	  Enable support for mcux sim driver.

config CLOCK_CONTROL_MCUX_SYSCON
	bool "MCUX LPC clock driver"
	default y
	depends on DT_HAS_NXP_LPC_SYSCON_ENABLED
	select PINCTRL
	help
	  Enable support for mcux clock driver.

config CLOCK_CONTROL_NXP_MC_CGM
	bool "NXP MC_CGM clock driver"
	default y
	depends on DT_HAS_NXP_MC_CGM_ENABLED
	help
	  Enable support for NXP MC_CGM clock driver.

config CLOCK_CONTROL_NXP_MCG_LITE
	bool "NXP MCG-Lite driver"
	default y
	depends on DT_HAS_NXP_MCG_LITE_ENABLED
	help
	  Enable support for NXP MCG-Lite driver.

config CLOCK_CONTROL_NXP_S32
	bool "NXP S32 clock control driver"
	default y
	depends on DT_HAS_NXP_S32_CLOCK_ENABLED
	help
	  Enable support for NXP S32 clock control driver.

if CLOCK_CONTROL_NXP_S32

config CLOCK_CONTROL_NXP_S32_CLOCK_CONFIG_IDX
	int
	default 0
	help
	  This option specifies the zero-based index of the clock configuration
	  used to initialize the SoC clocks.

endif # CLOCK_CONTROL_NXP_S32

config CLOCK_CONTROL_NXP_MCXW7X
	bool "NXP MCXW7X clock control driver"
	default y
	depends on DT_HAS_NXP_MCXW7X_CLOCK_ENABLED
	select NVMEM if $(dt_compat_any_has_prop,$(DT_COMPAT_NXP_MCXW7X_CLOCK),nvmem-cells)
	help
	  Enable support for NXP MCXW7X clock control driver.

config CLOCK_CONTROL_NXP_MCXW7X_IFR_TRIM_INIT_PRIORITY
	int "MCXW7X OSC32K factory trim init priority"
	default 51
	depends on CLOCK_CONTROL_NXP_MCXW7X
	help
	  POST_KERNEL initialization priority of the step which applies the
	  factory OSC32K trim read from non-volatile memory. It must be higher
	  than the priority of the driver providing the NVMEM cell, for instance
	  FLASH_INIT_PRIORITY.

config CLOCK_CONTROL_MCUX_CCM_REV3
	bool "MCUX CCM rev3 driver"
	default y
	depends on DT_HAS_NXP_IMX_CCM_REV3_ENABLED
	help
	  Enable support for the NXP i.MX CCM rev3 clock control driver. The
	  peripheral clock specifier packs a gate and a clock-root identifier,
	  and configurable clock roots are described as devicetree child nodes
	  of the controller.
```

## drivers/clock_control/Kconfig.py32
```kconfig
# SPDX-FileCopyrightText: Copyright The Zephyr Project Contributors
# SPDX-License-Identifier: Apache-2.0

config CLOCK_CONTROL_PY32
	bool "Puya PY32 clock control driver"
	default y
	depends on DT_HAS_PUYA_PY32F0_RCC_ENABLED
	help
	  Enable the clock control driver for Puya PY32 microcontrollers.
```
