## drivers/clock_control/Kconfig.imx_scmi
```kconfig
# Copyright 2024 NXP
# SPDX-License-Identifier: Apache-2.0

config CLOCK_CONTROL_IMX_SCMI
	bool "i.MX SCMI-based clock driver"
	default y
	depends on DT_HAS_NXP_IMX_CLK_SCMI_ENABLED
	help
	  Enable SCMI-based clock driver for i.MX SoCs.
```

## drivers/clock_control/Kconfig.it51xxx
```kconfig
# Copyright (c) 2025 ITE Corporation. All Rights Reserved.
# SPDX-License-Identifier: Apache-2.0

config CLOCK_CONTROL_IT51XXX
	bool "ITE IT51XXX clock controller driver"
	default y
	depends on DT_HAS_ITE_IT51XXX_ECPM_ENABLED
	help
	  This option enables the clock controller driver for IT51XXX.

if CLOCK_CONTROL_IT51XXX

config IT51XXX_PLL_SEQUENCE_PRIORITY
	int
	default 1

endif # CLOCK_CONTROL_IT51XXX
```

## drivers/clock_control/Kconfig.it8xxx2
```kconfig
# Copyright (c) 2022 ITE Corporation. All Rights Reserved.
# SPDX-License-Identifier: Apache-2.0

config CLOCK_CONTROL_IT8XXX2
	bool "ITE IT8XXX2 Clock Control driver"
	default y
	depends on DT_HAS_ITE_IT8XXX2_ECPM_ENABLED
	help
	  Enable the ITE IT8XXX2 Clock Control Driver.
```

## drivers/clock_control/Kconfig.litex
```kconfig
# LiteX SoC Builder clock control driver

# Copyright (c) 2020 Antmicro <www.antmicro.com>
# SPDX-License-Identifier: Apache-2.0

config CLOCK_CONTROL_LITEX
	bool "LiteX MMCM clock control"
	default y
	depends on DT_HAS_LITEX_CLK_ENABLED
	help
	  This option enables LiteX clock control driver.
	  It gives ability to change clock parameters
	  such as phase, duty cycle, frequency for up to 7
	  clock outputs
```

## drivers/clock_control/Kconfig.lpc11u6x
```kconfig
# LPC11U6X MCU clock control driver config

# Copyright (c) 2020 Seagate
# SPDX-License-Identifier: Apache-2.0

menuconfig CLOCK_CONTROL_LPC11U6X
	bool "LPC11U6X Reset and clock control"
	default y
	depends on DT_HAS_NXP_LPC11U6X_SYSCON_ENABLED
	help
	  Enable driver for reset and clock control used in
	  LPC11U6X MCUs

if CLOCK_CONTROL_LPC11U6X

config CLOCK_CONTROL_LPC11U6X_ENABLE_SRAM1
	bool "SRAM1"
	help
	  Enable SRAM1

config CLOCK_CONTROL_LPC11U6X_ENABLE_USB_RAM
	bool "USB RAM"
	help
	  Enable USB RAM

choice CLOCK_CONTROL_LPC11U6X_PLL_SRC
	prompt "LPC11U6X PLL Clock source"

config CLOCK_CONTROL_LPC11U6X_PLL_SRC_IRC
	bool "IRC"
	help
	  Use the internal oscillator as the clock source for the PLL

config CLOCK_CONTROL_LPC11U6X_PLL_SRC_SYSOSC
	bool "SYSOSC"
	help
	  Use the system oscillator as the clock source for the PLL

endchoice # CLOCK_CONTROL_LPC11U6X_PLL_SRC

endif # CLOCK_CONTROL_LPC11U6X
```

## drivers/clock_control/Kconfig.lpc84x
```kconfig
# Copyright (c) 2026 Aerlync Labs Inc
# SPDX-License-Identifier: Apache-2.0

config CLOCK_CONTROL_LPC84X
	bool "LPC84X clock control driver"
	default y
	depends on DT_HAS_NXP_LPC84X_CLOCK_ENABLED
	help
	  Enable the LPC84x clock control driver.
```

## drivers/clock_control/Kconfig.max32
```kconfig
# Copyright (c) 2023-2024 Analog Devices, Inc.
# SPDX-License-Identifier: Apache-2.0

config CLOCK_CONTROL_MAX32
	bool "MAX32 Clock Control Driver"
	default y
	depends on DT_HAS_ADI_MAX32_GCR_ENABLED
	help
	  Enable clock control support for Analog Devices MAX32xxx/MAX78xxx SoC series.
```

## drivers/clock_control/Kconfig.mchp
```kconfig
# Copyright (c) 2025 Microchip Technology Inc.
# SPDX-License-Identifier: Apache-2.0

config CLOCK_CONTROL_MCHP_COMMON
	bool
	help
	  Common options for Microchip clock control drivers.

config CLOCK_CONTROL_MCHP_SAM_D5X_E5X
	bool
	depends on DT_HAS_MICROCHIP_SAM_D5X_E5X_CLOCK_ENABLED
	default y
	select CLOCK_CONTROL_MCHP_COMMON
	help
	  Enable clock controller driver for Microchip SAM D5X/E5X SoC family.

config CLOCK_CONTROL_MCHP_PIC32CM_JH
	bool
	default y
	depends on DT_HAS_MICROCHIP_PIC32CM_JH_CLOCK_ENABLED
	select CLOCK_CONTROL_MCHP_COMMON
	help
	  Enable clock controller driver for Microchip PIC32CM_JH family.

if CLOCK_CONTROL_MCHP_COMMON

config CLOCK_CONTROL_MCHP_CONFIG_BOOTUP
	bool "Bootup clock configuration"
	default y
	help
	  This option enables bootup clock configuration from device tree node.

config CLOCK_CONTROL_MCHP_CONFIG_RUNTIME
	bool "Runtime clock configuration"
	default y
	help
	  This option enables runtime clock configuration using API.

config CLOCK_CONTROL_MCHP_ASYNC_ON
	bool "Async clock on"
	default n
	help
	  This option enables async on API.

config CLOCK_CONTROL_MCHP_GET_RATE
	bool "Get clock rate"
	default y
	help
	  Enable support for retrieving the clock rate. This may increase
	  code size, depending on the depth of clock source hierarchy.

config CLOCK_CONTROL_MCHP_SET_RATE
	bool "Set clock rate"
	default n
	depends on CLOCK_CONTROL_MCHP_GET_RATE
	help
	  This option enables set rate API. This may increase
	  code size, depending on the depth of clock source hierarchy.

endif # CLOCK_CONTROL_MCHP_COMMON
```

## drivers/clock_control/Kconfig.mcux_ccm
```kconfig
# MCUXpresso SDK CCM

# Copyright (c) 2017, NXP
# SPDX-License-Identifier: Apache-2.0

config CLOCK_CONTROL_MCUX_CCM
	bool "MCUX CCM driver"
	default y
	depends on DT_HAS_NXP_IMX_CCM_ENABLED
	help
	  Enable support for mcux ccm driver.
```

## drivers/clock_control/Kconfig.mcux_ccm_rev2
```kconfig
# MCUXpresso SDK CCM

# Copyright (c) 2021, NXP
# SPDX-License-Identifier: Apache-2.0

config CLOCK_CONTROL_MCUX_CCM_REV2
	bool "MCUX CCM Rev 2 driver"
	depends on HAS_MCUX_CCM_REV2
	help
	  Enable support for mcux ccm rev 2 driver.
```

## drivers/clock_control/Kconfig.mcux_ccm_rev3
```kconfig
# Copyright 2023 NXP
# SPDX-License-Identifier: Apache-2.0

config CLOCK_CONTROL_MCUX_CCM_REV3
	bool "MCUX CCM Rev3 driver"
	default y
	depends on DT_HAS_NXP_IMX_CCM_REV3_ENABLED
	help
		Enable support for mcux ccm rev3 driver.
```

## drivers/clock_control/Kconfig.mcux_mcg
```kconfig
# MCUXpresso SDK MCG

# Copyright (c) 2019 Vestas Wind Systems A/S
# SPDX-License-Identifier: Apache-2.0

config CLOCK_CONTROL_MCUX_MCG
	bool "MCUX MCG driver"
	default y
	depends on DT_HAS_NXP_KINETIS_MCG_ENABLED
	help
	  Enable support for mcux mcg driver.
```

## drivers/clock_control/Kconfig.mcux_pcc
```kconfig
# MCUXpresso SDK PCC

# Copyright (c) 2019 Vestas Wind Systems A/S
# SPDX-License-Identifier: Apache-2.0

config CLOCK_CONTROL_MCUX_PCC
	bool "MCUX PCC driver"
	default y
	depends on DT_HAS_NXP_KINETIS_PCC_ENABLED
	help
	  Enable support for MCUX PCC driver.
```

## drivers/clock_control/Kconfig.mcux_scg
```kconfig
# MCUXpresso SDK SCG

# Copyright (c) 2019 Vestas Wind Systems A/S
# Copyright 2023 NXP
# SPDX-License-Identifier: Apache-2.0

config CLOCK_CONTROL_MCUX_SCG
	bool "MCUX SCG driver"
	default y
	depends on DT_HAS_NXP_KINETIS_SCG_ENABLED
	help
	  Enable support for mcux scg driver.

config CLOCK_CONTROL_MCUX_SCG_K4
	bool "MCUX driver for K4 Generation SCG"
	default y
	depends on DT_HAS_NXP_SCG_K4_ENABLED
	help
	  Enable support for SCG K4 driver
```

## drivers/clock_control/Kconfig.mcux_sim
```kconfig
# MCUXpresso SDK SIM

# Copyright (c) 2017, NXP
# SPDX-License-Identifier: Apache-2.0

config CLOCK_CONTROL_MCUX_SIM
	bool "MCUX SIM driver"
	default y
	depends on DT_HAS_NXP_KINETIS_SIM_ENABLED
	help
	  Enable support for mcux sim driver.
```

## drivers/clock_control/Kconfig.mcux_syscon
```kconfig
# MCUXpresso SDK SYSCON

# Copyright (c) 2020, NXP
# SPDX-License-Identifier: Apache-2.0

config CLOCK_CONTROL_MCUX_SYSCON
	bool "MCUX LPC clock driver"
	default y
	depends on DT_HAS_NXP_LPC_SYSCON_ENABLED
	help
	  Enable support for mcux clock driver.
```

## drivers/clock_control/Kconfig.mspm
```kconfig
# TI MSPM Family

# Copyright (c) 2025, Texas Instruments Inc.
# SPDX-License-Identifier: Apache-2.0

config CLOCK_CONTROL_MSPM
	bool "TI MSPM clock"
	default y
	depends on $(dt_nodelabel_enabled_with_compat,ckm,$(DT_COMPAT_TI_MSPM_CLK))
	help
	  This option enables TI MSPM Clock Control
```

## drivers/clock_control/Kconfig.mspm0
```kconfig
# TI MSPM0 Family

# Copyright (c) 2025, Texas Instruments Inc.
# SPDX-License-Identifier: Apache-2.0

config CLOCK_CONTROL_MSPM0
	bool "TI MSPM0 clock"
	default y
	depends on HAS_MSPM0_SDK
	help
	  This option enables the TI MSPM0 Clock Control Enabler
```

## drivers/clock_control/Kconfig.nct
```kconfig
# NCT Clock controller driver configuration options

# Copyright (c) 2025 Nuvoton Technology Corporation.
# SPDX-License-Identifier: Apache-2.0

config CLOCK_CONTROL_NCT
	bool "NCT clock controller driver"
	default y
	depends on DT_HAS_NUVOTON_NCT_PCC_ENABLED
	help
	  Enable support for NCT clock controller driver.
```

## drivers/clock_control/Kconfig.npcm
```kconfig
# NPCM Clock controller driver configuration options

# Copyright (c) 2024 Nuvoton Technology Corporation.
# SPDX-License-Identifier: Apache-2.0

config CLOCK_CONTROL_NPCM
	bool "NPCM clock controller driver"
	default y
	depends on DT_HAS_NUVOTON_NPCM_PCC_ENABLED
	help
	  Enable support for NPCM clock controller driver.
```
