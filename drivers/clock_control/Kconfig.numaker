## drivers/clock_control/Kconfig.numaker
```kconfig
# NuMaker clock controller driver configuration options

# Copyright (c) 2022 Nuvoton Technology Corporation
# SPDX-License-Identifier: Apache-2.0

config CLOCK_CONTROL_NUMAKER_SCC
	bool "NuMaker system clock controller driver"
	default y
	depends on DT_HAS_NUVOTON_NUMAKER_SCC_ENABLED
	help
	  Enable support for NuMaker system clock controller driver

config CLOCK_CONTROL_NUMICRO_M4_SCC
	bool "NuMicro system clock controller driver"
	default y
	depends on SOC_FAMILY_NUMICRO
	help
	  Enable driver for System Clock Controller subsystem found in NuMicro
	  M4 Series (currently tested for M487).
```

## drivers/clock_control/Kconfig.nxp_mc_cgm
```kconfig
# Copyright 2025 NXP
# SPDX-License-Identifier: Apache-2.0

config CLOCK_CONTROL_NXP_MC_CGM
	bool "NXP MC_CGM clock driver"
	default y
	depends on DT_HAS_NXP_MC_CGM_ENABLED
	help
	  Enable support for NXP MC_CGM clock driver.
```

## drivers/clock_control/Kconfig.nxp_s32
```kconfig
# Copyright 2023 NXP
# SPDX-License-Identifier: Apache-2.0

config CLOCK_CONTROL_NXP_S32
	bool "NXP S32 clock control driver"
	default y
	depends on DT_HAS_NXP_S32_CLOCK_ENABLED
	help
	  Enable support for NXP S32 clock control driver.

if CLOCK_CONTROL_NXP_S32

config CLOCK_CONTROL_NXP_S32_CLOCK_CONFIG_IDX
	int
	default 0
	help
	  This option specifies the zero-based index of the clock configuration
	  used to initialize the SoC clocks.

endif # CLOCK_CONTROL_NXP_S32
```

## drivers/clock_control/Kconfig.pwm
```kconfig
# Copyright (c) 2023 Andriy Gelman <andriy.gelman@gmail.com>
# SPDX-License-Identifier: Apache-2.0

config CLOCK_CONTROL_PWM
	bool "Generic PWM clock"
	default y
	depends on DT_HAS_PWM_CLOCK_ENABLED
	select PWM
	help
	  Enable generic PWM clock.

config CLOCK_CONTROL_PWM_INIT_PRIORITY
	int "Initialization priority of the pwm clock device"
	default 51
	depends on CLOCK_CONTROL_PWM
	help
	  Initialization priority of the PWM clock device. Must be
	  lower priority than PWM.
```

## drivers/clock_control/Kconfig.quark_se
```kconfig
# Kconfig - Clock controller driver configuration options

#
# Copyright (c) 2015-2016 Intel Corporation
#
# SPDX-License-Identifier: Apache-2.0
#

menuconfig CLOCK_CONTROL_QUARK_SE
	bool "Quark SE Clock controller support"
	help
	 Enable support for the Quark SE clock driver.

if CLOCK_CONTROL_QUARK_SE

config CLOCK_CONTROL_QUARK_SE_PERIPHERAL
	bool "Quark SE peripheral clock support"
	help
	 Enable support for Quark SE peripheral clock which controls the
	 clock of I2C, SPI, GPIO controllers and more.

config CLOCK_CONTROL_QUARK_SE_PERIPHERAL_DRV_NAME
	string "Quark SE peripheral clock device name"
	depends on CLOCK_CONTROL_QUARK_SE_PERIPHERAL
	default "clk_peripheral"

config CLOCK_CONTROL_QUARK_SE_EXTERNAL
	bool "Quark SE external clock support"
	help
	 Enable support for Quark SE external sub-system clock.

config CLOCK_CONTROL_QUARK_SE_EXTERNAL_DRV_NAME
	string "Quark SE external clock device name"
	depends on CLOCK_CONTROL_QUARK_SE_EXTERNAL
	default "clk_external"

config CLOCK_CONTROL_QUARK_SE_SENSOR
	bool "Quark SE sensor clock support"
	help
	 Enable support for Quark SE sensor sub-system clock.

config CLOCK_CONTROL_QUARK_SE_SENSOR_DRV_NAME
	string "Quark SE sensor clock device name"
	depends on CLOCK_CONTROL_QUARK_SE_SENSOR
	default "clk_sensor"

endif # CLOCK_CONTROL_QUARK_SE
```

## drivers/clock_control/Kconfig.rcar
```kconfig
# Copyright (c) 2021-2023 IoT.bzh
# SPDX-License-Identifier: Apache-2.0

config CLOCK_CONTROL_RCAR_CPG_MSSR
	bool "RCar CPG MSSR driver"
	default y
	depends on SOC_FAMILY_RENESAS_RCAR
	help
	  Enable support for Renesas RCar CPG MSSR driver.
```

## drivers/clock_control/Kconfig.renesas_ra
```kconfig
# Copyright (c) 2023 TOKITA Hiroshi <tokita.hiroshi@fujitsu.com>
# SPDX-License-Identifier: Apache-2.0

config CLOCK_CONTROL_RENESAS_RA
	bool "Renesas RA series clock generation circuit driver"
	default y
	depends on DT_HAS_RENESAS_RA_CLOCK_GENERATION_CIRCUIT_ENABLED
	help
	  Enable Renesas RA series clock generation circuit driver.
```

## drivers/clock_control/Kconfig.renesas_ra2
```kconfig
# Copyright (c) 2023-2024 MUNIC SA
# SPDX-License-Identifier: Apache-2.0

config CLOCK_CONTROL_RENESAS_RA2L1
	bool
	depends on SOC_SERIES_RA2L1
	default y
```

## drivers/clock_control/Kconfig.renesas_ra8
```kconfig
# Copyright (c) 2024 Renesas Electronics Corporation
# SPDX-License-Identifier: Apache-2.0

config CLOCK_CONTROL_RENESAS_RA_CGC
	bool "RA CGC driver"
	default y
	depends on SOC_FAMILY_RENESAS_RA
	depends on HAS_RENESAS_RA_FSP
	help
	  Enable support for Renesas RA CGC driver.
```

## drivers/clock_control/Kconfig.renesas_ra_cgc
```kconfig
# Copyright (c) 2024 Renesas Electronics Corporation
# SPDX-License-Identifier: Apache-2.0

config CLOCK_CONTROL_RENESAS_RA_CGC
	bool "RA CGC driver"
	default y
	depends on SOC_FAMILY_RENESAS_RA
	depends on HAS_RENESAS_RA_FSP
	help
	  Enable support for Renesas RA CGC driver.

if CLOCK_CONTROL_RENESAS_RA_CGC

config CLOCK_CONTROL_RENESAS_RA_SUBCLK
	bool "Renesas RA sub clock source"
	default y
	depends on DT_HAS_RENESAS_RA_CGC_SUBCLK_ENABLED
	help
	  Enable Renesas RA sub clock driver

endif
```

## drivers/clock_control/Kconfig.renesas_rz_cgc
```kconfig
# Copyright (c) 2025 Renesas Electronics Corporation
# SPDX-License-Identifier: Apache-2.0

config CLOCK_CONTROL_RENESAS_RZ_CGC
	bool "Renesas RZ Clock Control Driver"
	default y
	depends on DT_HAS_RENESAS_RZ_CGC_ENABLED
	select USE_RZ_FSP_CGC
	help
	  Enable support for Renesas RZ CGC Clock Generator Circuit (CGC) driver.
	  The CGC driver supports only module's clocks.
	  The PLLs and core clocks are not configured by the CGC driver.
```

## drivers/clock_control/Kconfig.renesas_rz_cpg
```kconfig
# Copyright (c) 2024 Renesas Electronics Corporation
# SPDX-License-Identifier: Apache-2.0

config CLOCK_CONTROL_RENESAS_RZ_CPG
	bool "Renesas RZ/G Clock Control Driver"
	default y
	depends on DT_HAS_RENESAS_RZ_CPG_ENABLED
	select USE_RZ_FSP_CPG
	help
	  Enable support for Renesas RZ CPG Clock Pulse Generator (CPG) driver.
	  The CPG driver supports only module's clocks.
	  The PLLs and core clocks are not configured by the CPG driver.
```

## drivers/clock_control/Kconfig.rpi_pico
```kconfig
# Raspberry Pi Pico Clock Controller Driver configuration options

# Copyright (c) 2022 Andrei-Edward Popa
# SPDX-License-Identifier: Apache-2.0

config CLOCK_CONTROL_RPI_PICO
	bool "Raspberry Pi Pico Clock Controller Driver"
	default y
	depends on DT_HAS_RASPBERRYPI_PICO_CLOCK_CONTROLLER_ENABLED
	select PINCTRL

if CLOCK_CONTROL_RPI_PICO

config RPI_PICO_ROSC_USE_MEASURED_FREQ
	bool "Use measured frequency for ring oscillator"
	help
	 Instead of the dts value, use the value measured by
	 the frequency counter as the rosc frequency.

endif # CLOCK_CONTROL_RPI_PICO
```

## drivers/clock_control/Kconfig.rts5817
```kconfig
# Copyright (c) 2024 Realtek Semiconductor, Inc.
# SPDX-License-Identifier: Apache-2.0

config CLOCK_CONTROL_RTS5817
	bool "RTS5817 clock control"
	depends on DT_HAS_REALTEK_RTS5817_CLOCK_ENABLED
	default y
	help
	  Enable driver for RTS5817 Clock Control.
```

## drivers/clock_control/Kconfig.rts5912
```kconfig
# SPDX-License-Identifier: Apache-2.0
#
# Copyright (c) 2024 Realtek Semiconductor Corporation, SIBG-SD7
#

config CLOCK_CONTROL_RTS5912_SCCON
	bool "Realtek RTS5912 system clock controller driver"
	depends on SOC_SERIES_RTS5912
	default y if DT_HAS_REALTEK_RTS5912_SCCON_ENABLED
	help
	  Enable support for RTS5912 system clock controller driver
```

## drivers/clock_control/Kconfig.rv32m1
```kconfig
# OpenISA RV32M1 PPC

# Copyright (c) 2018 Foundries.io
# SPDX-License-Identifier: Apache-2.0

config CLOCK_CONTROL_RV32M1_PCC
	bool "RV32M1 PCC driver"
	default y
	depends on DT_HAS_OPENISA_RV32M1_PCC_ENABLED
	help
	  Enable support for RV32M1 PCC driver.
```

## drivers/clock_control/Kconfig.sam
```kconfig
# Copyright (c) 2023 Gerson Fernando Budke <nandojve@gmail.com>
# SPDX-License-Identifier: Apache-2.0

config CLOCK_CONTROL_SAM
	bool "Atmel SAM clock control"
	default y
	depends on DT_HAS_ATMEL_SAM_PMC_ENABLED
	help
	  Enable driver for Atmel SAM Clock Control.

config CLOCK_CONTROL_SAMA7G5
	bool "Microchip SAMA7G5 Power Management Controller (PMC)"
	default y
	depends on DT_HAS_MICROCHIP_SAM_PMC_ENABLED || \
		   DT_HAS_MICROCHIP_SAMA7G5_SCKC_ENABLED
	help
	  Enable driver for Microchip SAMA7G5 Power Management Controller (PMC).
```

## drivers/clock_control/Kconfig.sam0
```kconfig
# Kconfig - Clock controller driver configuration options
#
# Copyright (c) 2019 Derek Hageman <hageman@inthat.cloud>
#
# SPDX-License-Identifier: Apache-2.0

if SOC_FAMILY_SAM0

config CLOCK_CONTROL_SAM0
	bool
	default y

endif # SOC_FAMILY_SAM0
```

## drivers/clock_control/Kconfig.sf32lb_hxt48
```kconfig
# Copyright (c) 2025 Core Devices LLC
# SPDX-License-Identifier: Apache-2.0

config CLOCK_CONTROL_SF32LB_HXT48
	bool "SF32LB HXT48 clock control driver"
	default y
	depends on DT_HAS_SIFLI_SF32LB_HXT48_ENABLED
	help
	  Enable driver for SiFli SF32LB HXT48.
```

## drivers/clock_control/Kconfig.sf32lb_lxt32
```kconfig
# Copyright (c) 2025 SiFli Technologies(Nanjing) Co., Ltd
# SPDX-License-Identifier: Apache-2.0

config CLOCK_CONTROL_SF32LB_LXT32
	bool "SF32LB LXT32 clock driver"
	default y
	depends on CLOCK_CONTROL
	depends on DT_HAS_SIFLI_SF32LB_LXT32_ENABLED
	help
	  Enable driver for the external 32.768 kHz crystal on SiFli SF32LB.
```

## drivers/clock_control/Kconfig.sf32lb_pmuc
```kconfig
# Copyright (c) 2025 Core Devices LLC
# Copyright (c) 2025 SiFli Technologies(Nanjing) Co., Ltd
# SPDX-License-Identifier: Apache-2.0

config CLOCK_CONTROL_SF32LB_PMUC
	bool "SF32LB PMUC low-speed clock controller"
	default y
	depends on CLOCK_CONTROL
	depends on DT_HAS_SIFLI_SF32LB_PMUC_CLK_ENABLED
	help
	  Enable driver for the PMUC-managed low-speed clocks (LRC10, LRC32, LXT32)
	  on SiFli SF32LB SoCs.

config CLOCK_CONTROL_SF32LB_PMUC_INIT_PRIORITY
	int "PMUC clock controller init priority"
	default 29
	depends on CLOCK_CONTROL_SF32LB_PMUC
	help
	  Initialization priority for the PMUC low-speed clock controller.
	  Must be lower (numerically) than the RCC clock controller init
	  priority so that PMUC clocks are available when RCC initializes.
```

## drivers/clock_control/Kconfig.sf32lb_rcc
```kconfig
# Copyright (c) 2025 Core Devices LLC
# SPDX-License-Identifier: Apache-2.0

config CLOCK_CONTROL_SF32LB_RCC
	bool "SF32LB clock control RCC driver"
	default y
	depends on DT_HAS_SIFLI_SF32LB_RCC_CLK_ENABLED
	help
	  Enable clock control driver for SiFli SF32LB RCC.
```

## drivers/clock_control/Kconfig.si32
```kconfig
# Copyright (c) 2024 GARDENA GmbH
#
# SPDX-License-Identifier: Apache-2.0

config CLOCK_CONTROL_SI32_PLL
	bool "SI32 PLL clock control"
	default y
	depends on DT_HAS_SILABS_SI32_PLL_ENABLED

config CLOCK_CONTROL_SI32_AHB
	bool "SI32 AHB clock control"
	default y
	depends on DT_HAS_SILABS_SI32_AHB_ENABLED

config CLOCK_CONTROL_SI32_APB
	bool "SI32 APB clock control"
	default y
	depends on DT_HAS_SILABS_SI32_APB_ENABLED
```

## drivers/clock_control/Kconfig.smartbond
```kconfig
# Smartbond clock control driver config

# Copyright (c) 2022 Renesas Electronics Corporation
# SPDX-License-Identifier: Apache-2.0

config CLOCK_CONTROL_SMARTBOND
	bool "Smartbond Clock Control"
	depends on SOC_FAMILY_RENESAS_SMARTBOND
	help
	  Enable driver for Clock Control subsystem found in SmartBond

if CLOCK_CONTROL_SMARTBOND

config SMARTBOND_LP_OSC_CALIBRATION_INTERVAL
	int "Low-power oscillators calibration interval"
	default 1
	range 1 10
	help
	  Time in seconds between calibration of low power clock RC32K and RCX.

endif # CLOCK_CONTROL_SMARTBOND
```

## drivers/clock_control/Kconfig.stellaris
```kconfig
# Kconfig - STELLARIS CCM
#
# Copyright (c) 2018, Zilogic Systems.
#
# SPDX-License-Identifier: Apache-2.0
#

menuconfig CLOCK_CONTROL_STELLARIS
	bool
	prompt "stellaris CCM driver"
	depends on SOC_TI_LM3S6965
	depends on CLOCK_CONTROL
	help
	  Enable support for stellaris ccm driver.
```
