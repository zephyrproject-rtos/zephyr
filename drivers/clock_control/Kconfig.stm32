## drivers/clock_control/Kconfig.stm32l4_wb
```kconfig
# Kconfig - STM32L4 and STM32WB PLL configuration options
#
# Copyright (c) 2019 Linaro
#
#  SPDX-License-Identifier: Apache-2.0
#

if SOC_SERIES_STM32L4X || SOC_SERIES_STM32WBX

config CLOCK_STM32_PLL_M_DIVISOR
	int "PLL divisor"
	depends on CLOCK_STM32_SYSCLK_SRC_PLL
	default 1
	range 1 8
	help
	  PLL divisor, allowed values: 1-8. With this ensure that the PLL
	  VCO input frequency ranges from 4 to 16MHz.

config CLOCK_STM32_PLL_N_MULTIPLIER
	int "PLL multiplier"
	depends on CLOCK_STM32_SYSCLK_SRC_PLL
	default 20
	range 8 86
	help
	  PLL multiplier, allowed values: 2-16. PLL output must not
	  exceed 344MHz.

config CLOCK_STM32_PLL_P_DIVISOR
	int "PLL P Divisor"
	depends on CLOCK_STM32_SYSCLK_SRC_PLL
	default 7
	range 0 17
	help
	  PLL P Output divisor, allowed values: 0, 7, 17.

config CLOCK_STM32_PLL_Q_DIVISOR
	int "PLL Q Divisor"
	depends on CLOCK_STM32_SYSCLK_SRC_PLL
	default 2
	range 0 8
	help
	  PLL Q Output divisor, allowed values: 0, 2, 4, 6, 8.

config CLOCK_STM32_PLL_R_DIVISOR
	int "PLL R Divisor"
	depends on CLOCK_STM32_SYSCLK_SRC_PLL
	default 4
	range 0 8
	help
	  PLL R Output divisor, allowed values: 0, 2, 4, 6, 8.

config CLOCK_STM32_LSE
	bool "Low-speed external clock"
	help
	  Enable the low-speed external (LSE) clock supplied with a 32.768 kHz
	  crystal resonator oscillator.

config CLOCK_STM32_MSI_PLL_MODE
	bool "MSI PLL MODE"
	depends on CLOCK_STM32_LSE
	help
	  Enable hardware auto-calibration with LSE.

endif # SOC_SERIES_STM32L4X || SOC_SERIES_STM32WBX
```

## drivers/clock_control/Kconfig.stm32l4x
```kconfig
# Kconfig - STM32L4 MCU clock control driver config
#
# Copyright (c) 2016 Open-RnD Sp. z o.o.
# Copyright (c) 2016 BayLibre, SAS
#
# SPDX-License-Identifier: Apache-2.0
#

if SOC_SERIES_STM32L4X

menuconfig CLOCK_CONTROL_STM32L4X
	bool
	prompt "STM32L4x Reset & Clock Control"
	depends on CLOCK_CONTROL && SOC_SERIES_STM32L4X
	default y if SOC_SERIES_STM32L4X
	help
	  Enable driver for Reset & Clock Control subsystem found
	  in STM32L4 family of MCUs

config CLOCK_CONTROL_STM32L4X_DEVICE_INIT_PRIORITY
	int "Clock Control Device Priority"
	default 1
	depends on CLOCK_CONTROL_STM32L4X
	help
	  This option controls the priority of clock control
	  device initialization. Higher priority ensures that the device
	  is initialized earlier in the startup cycle. If unsure, leave
	  at default value 1

choice
prompt "STM32L4X System Clock Source"
depends on CLOCK_CONTROL_STM32L4X
default CLOCK_STM32L4X_SYSCLK_SRC_PLL

config CLOCK_STM32L4X_SYSCLK_SRC_HSE
	bool "HSE"
	help
	  Use HSE as source of SYSCLK

config CLOCK_STM32L4X_SYSCLK_SRC_PLL
	bool "PLL"
	help
	  Use PLL as source of SYSCLK

endchoice

choice
prompt "STM32L4X PLL Clock Source"
depends on CLOCK_CONTROL_STM32L4X && CLOCK_STM32L4X_SYSCLK_SRC_PLL
default CLOCK_STM32L4X_PLL_SRC_HSI

config CLOCK_STM32L4X_PLL_SRC_MSI
	bool "MSI"
	help
	  Use MSI as source of PLL

config CLOCK_STM32L4X_PLL_SRC_HSI
	bool "HSI"
	help
	  Use HSI as source of PLL

endchoice

config CLOCK_STM32L4X_HSE_BYPASS
	bool "HSE bypass"
	depends on CLOCK_CONTROL_STM32L4X && CLOCK_STM32L4X_SYSCLK_SRC_HSE
	help
	  Enable this option to bypass external high-speed clock (HSE).

config CLOCK_STM32L4X_PLL_DIVISOR
	int "PLL divisor"
	depends on CLOCK_CONTROL_STM32L4X && CLOCK_STM32L4X_SYSCLK_SRC_PLL
	default 1
	range 1 8
	help
	  PLL divisor, allowed values: 1-8. With this ensure that the PLL
	  VCO input frequency ranges from 4 to 16MHz.

config CLOCK_STM32L4X_PLL_MULTIPLIER
	int "PLL multiplier"
	depends on CLOCK_CONTROL_STM32L4X && CLOCK_STM32L4X_SYSCLK_SRC_PLL
	default 20
	range 8 86
	help
	  PLL multiplier, allowed values: 2-16. PLL output must not
	  exceed 344MHz.

config CLOCK_STM32L4X_PLL_P_DIVISOR
	int "PLL P Divisor"
	depends on CLOCK_CONTROL_STM32L4X
	default 7
	range 0 17
	help
	  PLL P Output divisor, allowed values: 0, 7, 17.

config CLOCK_STM32L4X_PLL_Q_DIVISOR
	int "PLL Q Divisor"
	depends on CLOCK_CONTROL_STM32L4X
	default 2
	range 0 8
	help
	  PLL Q Output divisor, allowed values: 0, 2, 4, 6, 8.

config CLOCK_STM32L4X_PLL_R_DIVISOR
	int "PLL R Divisor"
	depends on CLOCK_CONTROL_STM32L4X
	default 4
	range 0 8
	help
	  PLL R Output divisor, allowed values: 0, 2, 4, 6, 8.

config CLOCK_STM32L4X_AHB_PRESCALER
	int "AHB prescaler"
	depends on CLOCK_CONTROL_STM32L4X
	default 0
	range 0 512
	help
	  AHB prescaler, allowed values: 0, 2, 4, 8, 16, 64, 128,
	  256, 512.

config CLOCK_STM32L4X_APB1_PRESCALER
	int "APB1 prescaler"
	depends on CLOCK_CONTROL_STM32L4X
	default 0
	range 0 16
	help
	  APB1 Low speed clock (PCLK1) prescaler, allowed values:
	  0, 2, 4, 8, 16

config CLOCK_STM32L4X_APB2_PRESCALER
	int "APB2 prescaler"
	depends on CLOCK_CONTROL_STM32L4X
	default 0
	range 0 16
	help
	  APB2 High speed clock (PCLK2) prescaler, allowed values:
	  0, 2, 4, 8, 16

endif
```

## drivers/clock_control/Kconfig.sunxi
```kconfig
# Copyright (c) 2026 Khai Do
# SPDX-License-Identifier: Apache-2.0

config CLOCK_CONTROL_SUNXI
	bool "Allwinner sunXi clock control driver"
	default y
	depends on DT_HAS_ALLWINNER_SUN50I_H618_CCU_ENABLED
	help
	  Enable support for the Allwinner sunXi clock control unit (CCU).
```

## drivers/clock_control/Kconfig.syna
```kconfig
# Copyright (c) 2025 Synaptics, Inc.
# SPDX-License-Identifier: Apache-2.0

config CLOCK_CONTROL_SYNA
	bool "Synaptics Clock Control Driver"
	default y
	depends on DT_HAS_SYNA_GCR_ENABLED
	help
	  Enable clock control support for Synaptics SR100 SoC series.
```

## drivers/clock_control/Kconfig.syna_sr100
```kconfig
# Copyright (c) 2025 Synaptics, Inc.
# SPDX-License-Identifier: Apache-2.0

config CLOCK_CONTROL_SYNA_SR100
	bool "Synaptics SR100 Clock Control Driver"
	default y
	depends on DT_HAS_SYNA_SR100_CLOCK_ENABLED
	help
	  Enable clock control support for Synaptics SR100 SoC series.
```

## drivers/clock_control/Kconfig.ti_syscon
```kconfig
# Copyright (c) 2025 Texas Instruments
# SPDX-License-Identifier: Apache-2.0

config CLOCK_CONTROL_TI_SYSCON
	bool "TI Syscon backed gate-clock driver"
	default y
	depends on DT_HAS_TI_AM654_EHRPWM_TBCLK_ENABLED || DT_HAS_TI_AM64_EPWM_TBCLK_ENABLED || DT_HAS_TI_AM62_EPWM_TBCLK_ENABLED
	select SYSCON
	help
	  Enable driver for TI Syscon backed gate-clock controller.
```

## drivers/clock_control/Kconfig.tisci
```kconfig
# Copyright 2024 Texas Instruments Incorporated.
# SPDX-License-Identifier: Apache-2.0

config CLOCK_CONTROL_TISCI
	bool "TI SCI Clock Control driver"
	default y
	depends on DT_HAS_TI_K2G_SCI_CLK_ENABLED
	help
	  Driver for TISCI based clock control.

config CLOCK_CONTROL_TISCI_PRIORITY
	int "TISCI Clock Controller Priority"
	default KERNEL_INIT_PRIORITY_DEFAULT
	help
		TISCI clock controller priority should always be equal or greater
		than the TISCI priority.
```

## drivers/clock_control/Kconfig.xclk_wiz
```kconfig
# Copyright (C) 2026 Advanced Micro Devices, Inc.
# SPDX-License-Identifier: Apache-2.0

config CLOCK_CONTROL_XCLK_WIZ
	bool "Xilinx Clock Wizard driver"
	default y
	depends on DT_HAS_XLNX_CLKX5_WIZ_1_0_ENABLED
	help
	  Enable the Xilinx Clocking Wizard (clkx5-wiz-1.0) clock
	  control driver for AMD Versal2 platforms.

	  Supports:
	    - Clock output rate set (dynamic MMCM reconfiguration)
	    - Clock output rate get (read current M/D/O divisors)
	    - Clock output enable/disable (per-output clock gating)
```

## drivers/clock_control/Kconfig.xec
```kconfig
# Microchip XEC

# Copyright (c) 2021 Microchip Technology Inc.
# SPDX-License-Identifier: Apache-2.0

config CLOCK_CONTROL_MCHP_XEC
	bool "MCHP XEC PCR clock control driver"
	default y
	depends on DT_HAS_MICROCHIP_XEC_PCR_ENABLED
	help
	  Enable support for Microchip XEC PCR clock driver.
```

## drivers/clock_control/Kconfig.xlnx_ps7_clkc
```kconfig
#
# Copyright (c) 2023 Immo Birnbaum
# SPDX-License-Identifier: Apache-2.0
#

config CLOCK_CONTROL_XLNX_PS7_CLKC
	bool "Xilinx Zynq-7000 (XC7Zxxx/XC7ZxxxS) PS7 clock control driver"
	default y
	depends on DT_HAS_XLNX_PS7_CLKC_ENABLED
	select SYSCON
	help
	  Enable the Xilinx Zynq-7000 (XC7Zxxx/XC7ZxxxS) PS7 clock control driver.
```

## drivers/clock_control/sf32lb58/Kconfig.sf32lb58
```kconfig
# Copyright (c) 2025 Qingdao IotPi Ltd.
# SPDX-License-Identifier: Apache-2.0

config CLOCK_CONTROL_SF32LB58
    bool "SF32LB58 clock control drivers"
    default y
    depends on DT_HAS_SIFLI_SF32LB58_XT_CLK_ENABLED || \
    DT_HAS_SIFLI_SF32LB58_RC_CLK_ENABLED

config CLOCK_CONTROL_SF32LB58_HPSYS
    bool "SF32LB58 clock control drivers in HPSYS"
    default y
    depends on DT_HAS_SIFLI_SF32LB58_HPSYS_RCC_ENABLED || \
    DT_HAS_SIFLI_SF32LB58_HPSYS_AON_ENABLED || \
    DT_HAS_SIFLI_SF32LB58_PERI_HPSYS_CLK_ENABLED
```

## drivers/clock_management/Kconfig
```kconfig
# Copyright 2024 NXP
# SPDX-License-Identifier: Apache-2.0

#
# Clock controller drivers
#
menuconfig CLOCK_MANAGEMENT
	bool "Clock management drivers"
	help
	  Enable support for clock management drivers. These drivers provide
	  clock configuration to the system via a series of setpoints, which
	  allow drivers to configure clocks based on their desired power
	  state

if CLOCK_MANAGEMENT

module = CLOCK_MANAGEMENT
module-str = clock management
source "subsys/logging/Kconfig.template.log_config"

config CLOCK_MANAGEMENT_SET_RATE
	bool "Support runtime rate setting"
	select CLOCK_MANAGEMENT_RUNTIME
	help
	  Allow clock consumers to request a given clock frequency via the
	  clock management framework. The framework will then configure the
	  clock tree so that the consumer is supplied with the closest
	  possible frequency to its request. Note that enabling this feature
	  will result in increased flash utilization

config CLOCK_MANAGEMENT_RUNTIME
	bool "Support runtime clock rate requests"
	help
	  Support runtime clock rate requests. When enabled, clock producers
	  will track the clock requests from each consumer, and reject
	  conflicting requests. This Kconfig also enables registering
	  for clock rate change notifications

config CLOCK_MANAGEMENT_CLK_NAME
	bool "Store names of each clock"
	help
	  Store names of each clock node. Uses additional ROM space. If
	  clock framework debug logging is enabled, traces will be printed
	  as the clock tree is reconfigured.

config CLOCK_MANAGEMENT_FIXED_SOURCE
	bool "Fixed clock source driver"
	default y
	depends on DT_HAS_FIXED_CLOCK_ENABLED
	help
	  Fixed clock source driver, for non configurable clock sources

config CLOCK_MANAGEMENT_SOURCE
	bool "Clock source driver"
	default y
	depends on DT_HAS_CLOCK_SOURCE_ENABLED
	help
	  Clock source driver, for fixed clock sources that may be gated/ungated

source "drivers/clock_management/nxp_syscon/Kconfig"

module = CLOCK_MANAGEMENT
module-str = clock-management
source "subsys/logging/Kconfig.template.log_config"

endif # CLOCK_MANAGEMENT
```
