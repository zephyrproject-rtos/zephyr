## drivers/clock_control/Kconfig.stm32f3x
```kconfig
# Kconfig - STM32F3 MCU clock control driver config
#
# Copyright (c) 2016 RnDity Sp. z o.o.
#
# SPDX-License-Identifier: Apache-2.0
#

if SOC_SERIES_STM32F3X

menuconfig CLOCK_CONTROL_STM32F3X
	bool
	prompt "STM32F3x Reset & Clock Control"
	depends on CLOCK_CONTROL && SOC_SERIES_STM32F3X
	default y if SOC_SERIES_STM32F3X
	help
	 Enable driver for Reset & Clock Control subsystem found
	 in STM32F3 family of MCUs

config CLOCK_CONTROL_STM32F3X_DEVICE_INIT_PRIORITY
	int "Clock Control Device Priority"
	default 1
	depends on CLOCK_CONTROL_STM32F3X
	help
	 This option controls the priority of clock control
	 device initialization. Higher priority ensures that the device
	 is initialized earlier in the startup cycle. If unsure, leave
	 at default value 1

choice
prompt "STM32F3x System Clock Source"
depends on CLOCK_CONTROL_STM32F3X

config CLOCK_STM32F3X_SYSCLK_SRC_HSI
	bool "HSI"
	help
	 Use HSI as source of SYSCLK

config CLOCK_STM32F3X_SYSCLK_SRC_HSE
	bool "HSE"
	help
	 Use HSE as source of SYSCLK

config CLOCK_STM32F3X_SYSCLK_SRC_PLL
	bool "PLL"
	help
	 Use PLL as source of SYSCLK

endchoice

choice
prompt "STM32F3x PLL Clock Source"
depends on CLOCK_CONTROL_STM32F3X && CLOCK_STM32F3X_SYSCLK_SRC_PLL

config CLOCK_STM32F3X_PLL_SRC_HSI
	bool "HSI"
	help
	 Use HSI/2 as source of PLL

config CLOCK_STM32F3X_PLL_SRC_HSE
	bool "HSE"
	help
	 Use HSE as source of PLL

endchoice

config CLOCK_STM32F3X_HSE_BYPASS
	bool "HSE bypass"
	depends on CLOCK_CONTROL_STM32F3X && (CLOCK_STM32F3X_PLL_SRC_HSE || CLOCK_STM32F3X_SYSCLK_SRC_HSE)
	help
	 Enable this option to bypass external high-speed clock (HSE).

config CLOCK_STM32F3X_PLL_PREDIV
	int "PREDIV1 Prescler"
	depends on CLOCK_CONTROL_STM32F3X && CLOCK_STM32F3X_PLL_SRC_HSE
	default 0
	range 0 16
	help
	 PREDIV is PLLSCR clock signal prescaler, allowed values: 0 - 16.

config CLOCK_STM32F3X_PLL_MULTIPLIER
	int "PLL multiplier"
	depends on CLOCK_CONTROL_STM32F3X && CLOCK_STM32F3X_SYSCLK_SRC_PLL
	default 9
	range 2 16
	help
	 PLL multiplier, allowed values: 2-16. PLL output must not exceed 72MHz.

config CLOCK_STM32F3X_AHB_PRESCALER
	int "AHB prescaler"
	depends on CLOCK_CONTROL_STM32F3X
	default 0
	range 0 512
	help
	 AHB prescaler, allowed values: 0, 2, 4, 8, 16, 64, 128,
	 256, 512.

config CLOCK_STM32F3X_APB1_PRESCALER
	int "APB1 prescaler"
	depends on CLOCK_CONTROL_STM32F3X
	default 0
	range 0 16
	help
	 APB1 Low speed clock (PCLK1) prescaler, allowed values:
	 0, 2, 4, 8, 16. The APB1 clock must not exceed 36MHz.

config CLOCK_STM32F3X_APB2_PRESCALER
	int "APB2 prescaler"
	depends on CLOCK_CONTROL_STM32F3X
	default 0
	range 0 16
	help
	 APB2 High speed clock (PCLK2) prescaler, allowed values:
	 0, 2, 4, 8, 16

endif
```

## drivers/clock_control/Kconfig.stm32f4x
```kconfig
# Kconfig - STM32F4 MCU clock control driver config
#
# Copyright (c) 2016 Open-RnD Sp. z o.o.
# Copyright (c) Linaro Limited.
#
# Licensed under the Apache License, Version 2.0 (the "License");
# you may not use this file except in compliance with the License.
# You may obtain a copy of the License at
#
#     http://www.apache.org/licenses/LICENSE-2.0
#
# Unless required by applicable law or agreed to in writing, software
# distributed under the License is distributed on an "AS IS" BASIS,
# WITHOUT WARRANTIES OR CONDITIONS OF ANY KIND, either express or implied.
# See the License for the specific language governing permissions and
# limitations under the License.
#

if SOC_SERIES_STM32F4X

menuconfig CLOCK_CONTROL_STM32F4X
	bool
	prompt "STM32F4X Reset & Clock Control"
	depends on CLOCK_CONTROL && SOC_SERIES_STM32F4X
	default y if SOC_SERIES_STM32F4X
	help
	 Enable driver for Reset & Clock Control subsystem found
	 in STM32F4 family of MCUs

config CLOCK_CONTROL_STM32F4X_DEVICE_INIT_PRIORITY
	int "Clock Control Device Priority"
	default 1
	depends on CLOCK_CONTROL_STM32F4X
	help
	 This option controls the priority of clock control
	 device initialization. Higher priority ensures that the device
	 is initialized earlier in the startup cycle. If unsure, leave
	 at default value 1

choice
prompt "STM32F4X System Clock Source"
depends on CLOCK_CONTROL_STM32F4X

config CLOCK_STM32F4X_SYSCLK_SRC_HSI
	bool "HSI"
	help
	 Use HSI as source of SYSCLK

config CLOCK_STM32F4X_SYSCLK_SRC_HSE
	bool "HSE"
	help
	 Use HSE as source of SYSCLK

config CLOCK_STM32F4X_SYSCLK_SRC_PLL
	bool "PLL"
	help
	 Use PLL as source of SYSCLK

endchoice

choice
prompt "STM32F4X PLL Clock Source"
depends on CLOCK_CONTROL_STM32F4X && CLOCK_STM32F4X_SYSCLK_SRC_PLL

config CLOCK_STM32F4X_PLL_SRC_HSI
	bool "HSI"
	help
	 Use HSI as source of PLL

config CLOCK_STM32F4X_PLL_SRC_HSE
	bool "HSE"
	help
	 Use HSE as source of PLL

endchoice

config CLOCK_STM32F4X_HSE_BYPASS
	bool "HSE bypass"
	depends on CLOCK_CONTROL_STM32F4X && (CLOCK_STM32F4X_PLL_SRC_HSE || CLOCK_STM32F4X_SYSCLK_SRC_HSE)
	help
	 Enable this option to bypass external high-speed clock (HSE).

config CLOCK_STM32F4X_PLLM_DIV_FACTOR
	int "Division factor for PLL VCO input clock"
	depends on CLOCK_CONTROL_STM32F4X && CLOCK_STM32F4X_SYSCLK_SRC_PLL
	default 8
	range 2 63
	help
	 PLLM division factor needs to be set correctly to ensure that the VCO
	 input frequency ranges from 1 to 2 MHz. It is recommended to select a
	 frequency of 2 MHz to limit PLL jitter.
	 Allowed values: 2-63

config CLOCK_STM32F4X_PLLN_MULTIPLIER
	int "Multiplier factor for PLL VCO output clock"
	depends on CLOCK_CONTROL_STM32F4X && CLOCK_STM32F4X_SYSCLK_SRC_PLL
	default 336
	range 192 432
	help
	 PLLN multiplier factor needs to be set correctly to ensure that the
	 VCO output frequency is between 192 and 432 MHz.
	 Allowed values: 192-432

config CLOCK_STM32F4X_PLLP_DIV_FACTOR
	int "PLL division factor for main system clock"
	depends on CLOCK_CONTROL_STM32F4X && CLOCK_STM32F4X_SYSCLK_SRC_PLL
	default 4
	range 2 8
	help
	 PLLP division factor needs to be set correctly to not exceed 84MHz.
	 Allowed values: 2, 4, 6, 8

config CLOCK_STM32F4X_PLLQ_DIV_FACTOR
	int "Division factor for OTG FS, SDIO and RNG clocks"
	depends on CLOCK_CONTROL_STM32F4X && CLOCK_STM32F4X_SYSCLK_SRC_PLL
	default 7
	range 2 15
	help
	 The USB OTG FS requires a 48MHz clock to work correctly. SDIO and RNG
	 need a frequency lower than or equal to 48 MHz to work correctly.
	 Allowed values: 2-15

config CLOCK_STM32F4X_AHB_PRESCALER
	int "AHB prescaler"
	depends on CLOCK_CONTROL_STM32F4X
	default 0
	range 0 512
	help
	 AHB prescaler, allowed values: 0, 2, 4, 8, 16, 64, 128,
	 256, 512.

config CLOCK_STM32F4X_APB1_PRESCALER
	int "APB1 low speed clock prescaler"
	depends on CLOCK_CONTROL_STM32F4X
	default 2
	range 0 16
	help
	 APB1 Low speed clock (PCLK1) prescaler, allowed values:
	 0, 2, 4, 8, 16. The APB1 clock must not exceed 42MHz.

config CLOCK_STM32F4X_APB2_PRESCALER
	int "APB2 high speed clock prescaler"
	depends on CLOCK_CONTROL_STM32F4X
	default 0
	range 0 16
	help
	 APB2 High speed clock (PCLK2) prescaler, allowed values:
	 0, 2, 4, 8, 16. The APB2 clock must not exceed 84MHz.

endif
```

## drivers/clock_control/Kconfig.stm32g0
```kconfig
# Kconfig - STM32G0 PLL configuration options
#
# Copyright (c) 2019 Linaro
#
#  SPDX-License-Identifier: Apache-2.0
#

if SOC_SERIES_STM32G0X

config CLOCK_STM32_PLL_N_MULTIPLIER
	int "PLL multiplier"
	depends on CLOCK_STM32_SYSCLK_SRC_PLL
	default 8
	range 8 86
	help
	 PLL multiplier, allowed values: 8-86
	 PLL output must not exceed 56MHz(1.8V)/26MHz(1.2V).

config CLOCK_STM32_PLL_M_DIVISOR
	int "PLL divisor"
	depends on CLOCK_STM32_SYSCLK_SRC_PLL
	default 1
	range 1 8
	help
	  PLL divisor, allowed values: 1-8.

config CLOCK_STM32_PLL_P_DIVISOR
	int "PLL P Divisor"
	depends on CLOCK_STM32_SYSCLK_SRC_PLL
	default 2
	range 2 32
	help
	  PLL P VCO divisor, allowed values: 2-32.

config CLOCK_STM32_PLL_Q_DIVISOR
	int "PLL Q Divisor"
	depends on CLOCK_STM32_SYSCLK_SRC_PLL
	default 2
	range 2 8
	help
	  PLL Q VCO divisor, allowed values: 2-8.

config CLOCK_STM32_PLL_R_DIVISOR
	int "PLL R Divisor"
	depends on CLOCK_STM32_SYSCLK_SRC_PLL
	default 2
	range 2 8
	help
	  PLL R VCO divisor, allowed values: 2-8.

endif # SOC_SERIES_STM32G0X
```

## drivers/clock_control/Kconfig.stm32g4
```kconfig
# Kconfig - STM32G4 PLL configuration options
#
# Copyright (c) 2019 Richard Osterloh <richard.osterloh@gmail.com>
#
#  SPDX-License-Identifier: Apache-2.0
#

if SOC_SERIES_STM32G4X

config CLOCK_STM32_PLL_M_DIVISOR
	int "PLL divisor"
	depends on CLOCK_STM32_SYSCLK_SRC_PLL
	default 4
	range 1 16
	help
	  PLL divisor, allowed values: 1-16.

config CLOCK_STM32_PLL_N_MULTIPLIER
	int "PLL multiplier"
	depends on CLOCK_STM32_SYSCLK_SRC_PLL
	default 75
	range 8 127
	help
	  PLL multiplier, allowed values: 8-127.

config CLOCK_STM32_PLL_P_DIVISOR
	int "PLL P Divisor"
	depends on CLOCK_STM32_SYSCLK_SRC_PLL
	default 7
	range 7 17
	help
	  PLL P Output divisor, allowed values: 7, 17.

config CLOCK_STM32_PLL_Q_DIVISOR
	int "PLL Q Divisor"
	depends on CLOCK_STM32_SYSCLK_SRC_PLL
	default 2
	range 2 8
	help
	  PLL Q Output divisor, allowed values: 2, 4, 6, 8.

config CLOCK_STM32_PLL_R_DIVISOR
	int "PLL R Divisor"
	depends on CLOCK_STM32_SYSCLK_SRC_PLL
	default 2
	range 2 8
	help
	  PLL R Output divisor, allowed values: 2, 4, 6, 8.

config CLOCK_STM32_LSE
	bool "Low-speed external clock"
	help
	  Enable the low-speed external (LSE) clock supplied with a 32.768 kHz
	  crystal resonator oscillator.

endif # SOC_SERIES_STM32L4X || SOC_SERIES_STM32WBX
```

## drivers/clock_control/Kconfig.stm32h7
```kconfig
# Kconfig - STM32H7 PLL configuration options
#
# Copyright (c) 2019 Linaro
#
#  SPDX-License-Identifier: Apache-2.0
#

if SOC_SERIES_STM32H7X

# Bus clocks configuration options

config CLOCK_STM32_D1CPRE
	int "D1 Domain, CPU1 clock prescaler"
	default 1
	range 1 512
	help
	  D1 Domain, CPU1 clock (sys_d1cpre_ck prescaler),
	  allowed values: 1, 2, 4, 8, 16, 64, 128, 256, 512.

config CLOCK_STM32_HPRE
	int "hclk prescaler, D2 domain (CPU2) Clock prescaler"
	default 1
	range 1 512
	help
	  hclk prescaler, allowed values: 1, 2, 4, 8, 16, 64, 128, 256, 512.

config CLOCK_STM32_D2PPRE1
	int "APB1 prescaler"
	default 1
	range 1 16
	help
	  APB1 clock (rcc_pclk1) prescaler, allowed values: 1, 2, 4, 8, 16

config CLOCK_STM32_D2PPRE2
	int "D2 DOMAIN, APB2 prescaler"
	default 1
	range 1 16
	help
	  APB2 clock (rcc_pclk2) prescaler, allowed values: 1, 2, 4, 8, 16

config CLOCK_STM32_D1PPRE
	int "D1 DOMAIN, APB3 prescaler"
	default 1
	range 1 16
	help
	  APB3 clock (rcc_pclk3) prescaler, allowed values: 1, 2, 4, 8, 16

config CLOCK_STM32_D3PPRE
	int "APB4 prescaler"
	default 1
	range 1 16
	help
	  APB4 clock (rcc_pclk4) prescaler, allowed values: 1, 2, 4, 8, 16


# PLL settings

config CLOCK_STM32_PLL_M_DIVISOR
	int "PLL divisor"
	depends on CLOCK_STM32_SYSCLK_SRC_PLL
	default 32
	range 0 63
	help
	  PLL divisor, allowed values: 0-63.

config CLOCK_STM32_PLL_N_MULTIPLIER
	int "PLL1 VCO multiplier"
	depends on CLOCK_STM32_SYSCLK_SRC_PLL
	default 129
	range 4 512
	help
	  PLL multiplier, allowed values: 4-512.

config CLOCK_STM32_PLL_P_DIVISOR
	int "PLL P Divisor"
	depends on CLOCK_STM32_SYSCLK_SRC_PLL
	default 2
	range 1 128
	help
	  PLL P Output divisor, allowed values: 1-128.

config CLOCK_STM32_PLL_Q_DIVISOR
	int "PLL Q Divisor"
	depends on CLOCK_STM32_SYSCLK_SRC_PLL
	default 2
	range 1 128
	help
	  PLL Q Output divisor, allowed values: 1-128.

config CLOCK_STM32_PLL_R_DIVISOR
	int "PLL R Divisor"
	depends on CLOCK_STM32_SYSCLK_SRC_PLL
	default 2
	range 1 128
	help
	  PLL R Output divisor, allowed values: 1-128.

endif # SOC_SERIES_STM32H7X
```

## drivers/clock_control/Kconfig.stm32l0_l1
```kconfig
# Kconfig - STM32L0 and STM32L1 PLL configuration options
#
# Copyright (c) 2019 Linaro
#
#  SPDX-License-Identifier: Apache-2.0
#

if SOC_SERIES_STM32L0X || SOC_SERIES_STM32L1X

config CLOCK_STM32_PLL_MULTIPLIER
	int "PLL multiplier"
	depends on CLOCK_STM32_SYSCLK_SRC_PLL
	default 4
	range 3 48
	help
	 PLL multiplier, allowed values: 3, 4, 6, 8, 12, 16, 24, 32, 48.
	 PLL output must not exceed 96MHz(1.8V)/48MHz(1.5V)/24MHz(1.2V).

config CLOCK_STM32_PLL_DIVISOR
	int "PLL divisor"
	depends on CLOCK_STM32_SYSCLK_SRC_PLL
	default 2
	range 2 4
	help
	  PLL divisor, allowed values: 2-4.

endif # SOC_SERIES_STM32L0X || SOC_SERIES_STM32L1X
```

## drivers/clock_control/Kconfig.stm32l4_l5_wb_wl
```kconfig
# STM32L4, STM32L5, STM32WB and STM32WL PLL configuration options

# Copyright (c) 2019 Linaro
# SPDX-License-Identifier: Apache-2.0

if SOC_SERIES_STM32L4X || SOC_SERIES_STM32L5X || SOC_SERIES_STM32WBX || SOC_SERIES_STM32WLX

config CLOCK_STM32_PLL_M_DIVISOR
	int "PLL divisor"
	depends on CLOCK_STM32_SYSCLK_SRC_PLL
	default 1
	range 1 8 if SOC_SERIES_STM32L4X || SOC_SERIES_STM32WBX || SOC_SERIES_STM32WLX
	range 1 16 if SOC_SERIES_STM32L5X
	help
	  PLL divisor,
	  L4: allowed values: 1-8. PLL VCO input ranges from 4 to 16MHz
	  L5: allowed values: 1-16. PLL VCO input ranges from 4 to 16MHz
	  WB: allowed values: 1-8. PLL VCO input ranges from 2.66 to 16MHz
	  WL: allowed values: 1-8. PLL VCO input ranges from 2.66 to 16MHz

config CLOCK_STM32_PLL_N_MULTIPLIER
	int "PLL multiplier"
	depends on CLOCK_STM32_SYSCLK_SRC_PLL
	default 20
	range 8 86 if SOC_SERIES_STM32L4X || SOC_SERIES_STM32L5X
	range 6 127 if SOC_SERIES_STM32WBX || SOC_SERIES_STM32WLX
	help
	  PLL multiplier,
	  L4: allowed values: 8-86. PLL VCO output ranges from 64 to 334MHz
	  L5: allowed values: 8-86. PLL VCO output ranges from 64 to 334MHz
	  WB: allowed values: 6-127. PLL VCO output ranges from 96 to 334MHz
	  WL: allowed values: 6-127. PLL VCO output ranges from 96 to 334MHz

config CLOCK_STM32_PLL_P_DIVISOR
	int "PLL P Divisor"
	depends on CLOCK_STM32_SYSCLK_SRC_PLL
	default 7
	range 0 17 if SOC_SERIES_STM32L4X || SOC_SERIES_STM32L5X
	range 0 32 if SOC_SERIES_STM32WBX || SOC_SERIES_STM32WLX
	help
	  PLL P Output divisor
	  L4: allowed values: 0, 7, 17. PLLP do not exceed 80MHz
	  L5: allowed values: 0, 7, 17. PLLP do not exceed 80MHz
	  WB: allowed values: 0, 2-32. PLLP do not exceed 64MHz
	  WL: allowed values: 0, 2-32. PLLP do not exceed 48MHz

config CLOCK_STM32_PLL_Q_DIVISOR
	int "PLL Q Divisor"
	depends on CLOCK_STM32_SYSCLK_SRC_PLL
	default 2
	range 0 8
	help
	  PLL Q Output divisor
	  L4: allowed values: 0, 2, 4, 6, 8. PLLQ do not exceed 80MHz
	  L5: allowed values: 0, 2, 4, 6, 8. PLLQ do not exceed 80MHz
	  WB: allowed values: 0, 2-8. PLLQ do not exceed 64MHz
	  WL: allowed values: 0, 2-8. PLLQ do not exceed 48MHz

config CLOCK_STM32_PLL_R_DIVISOR
	int "PLL R Divisor"
	depends on CLOCK_STM32_SYSCLK_SRC_PLL
	default 4
	range 0 8
	help
	  PLL R Output divisor
	  L4: allowed values: 0, 2, 4, 6, 8. PLLR do not exceed 80MHz
	  L5: allowed values: 0, 2, 4, 6, 8. PLLR do not exceed 110MHz
	  WB: allowed values: 0, 2-8. PLLR do not exceed 64MHz
	  WL: allowed values: 0, 2-8. PLLR do not exceed 48MHz

config CLOCK_STM32_LSE
	bool "Low-speed external clock"
	help
	  Enable the low-speed external (LSE) clock supplied with a 32.768 kHz
	  crystal resonator oscillator.

config CLOCK_STM32_MSI_PLL_MODE
	bool "MSI PLL MODE"
	depends on CLOCK_STM32_LSE
	help
	  Enable hardware auto-calibration with LSE.

endif # SOC_SERIES_STM32L4X || SOC_SERIES_STM32L5X || SOC_SERIES_STM32WBX || SOC_SERIES_STM32WLX
```
