## drivers/clock_control/Kconfig.stm32
```kconfig
# STM32 MCU clock control driver config

# Copyright (c) 2017 Linaro
# Copyright (c) 2017 RnDity Sp. z o.o.
# Copyright (C) 2025 Savoir-faire Linux, Inc.
# SPDX-License-Identifier: Apache-2.0

menuconfig CLOCK_CONTROL_STM32_CUBE
	bool "STM32 Reset & Clock Control"
	depends on SOC_FAMILY_STM32
	default y
	select USE_STM32_LL_UTILS
	select USE_STM32_LL_RCC if (SOC_SERIES_STM32MP1X || SOC_SERIES_STM32MP13X || \
		SOC_SERIES_STM32MP2X || SOC_SERIES_STM32H7X || SOC_SERIES_STM32H7RSX || \
		SOC_SERIES_STM32F4X || SOC_SERIES_STM32F7X || \
		SOC_SERIES_STM32N6X)
	select RUNTIME_NMI if ($(dt_nodelabel_enabled,clk_hse) && \
		$(dt_nodelabel_bool_prop,clk_hse,css-enabled))
	help
	  Enable driver for Reset & Clock Control subsystem found
	  in STM32 family of MCUs

if CLOCK_CONTROL_STM32_CUBE

config CLOCK_STM32_HSE_CLOCK
	int
	default $(dt_nodelabel_int_prop,clk_hse,clock-frequency)
	depends on $(dt_nodelabel_enabled,clk_hse)
	help
	  Frequency of external high-speed clock (HSE).

	  The value of this symbol is used to set the preprocessor
	  definition "HSE_VALUE" notably consumed by the HAL.

	  This symbol cannot be set externally: its value is directly
	  taken from the "clock-frequency" property of the "clk_hse"
	  Device Tree node when it is enabled.

	  This node would usually looks similar to:

	    &clk_hse {
	      clock-frequency = <DT_FREQ_M(25)>;
	      status = "okay";
	    };

	  If the "clk_hse" node does not exist or is not enabled
	  (status != "okay"), this symbol is not defined and the
	  HSE_VALUE preprocessor definition does not exist.

config CLOCK_STM32_MUX
	bool "STM32 clock mux driver"
	default y
	depends on DT_HAS_ST_STM32_CLOCK_MUX_ENABLED
	help
	  Enable driver for STM32 clock mux which don't match an
	  existing clock hardware block but allows to select a clock
	  for a specific domain. For instance per_ck clock on STM32H7 or
	  CLK48 clock

menu "STM32WB0 LSI options"
	depends on DT_HAS_ST_STM32WB0_LSI_CLOCK_ENABLED

config STM32WB0_LSI_MEASUREMENT_WINDOW
	int "Size of LSI measurement window (in periods)"
	default 32
	range 23 256
	help
	  Size of the LSI measurement window (# of LSI periods)

	  The measurement process involves waiting for a certain amount of LSI periods
	  to occur, in order to determine precisely the LSI period, and thus frequency.

	  This property controls how much LSI periods are required for each measure.
	  Bigger window sizes increase accuracy of the measure, but increase the time
	  needed to complete it. Since fLSI >= 24kHz, increasing the measurement window
	  size makes each measure roughly 42µs slower in the worst case.

	  Minimal value is a recommendation from RM0505 Rev.1 §25.8.2, and maximum
	  value is a hardware limitation.

config STM32WB0_LSI_RUNTIME_MEASUREMENT_INTERVAL
	int "LSI run-time measurement interval (ms)"
	default 0
	help
	  Interval at which runtime measurements should be performed, in milliseconds

	  Since the LSI RC frequency is affected by temperature, which is not stable
	  across time, it is recommended to perform measurements of the LSI frequency
	  at regular intervals to obtain better accuracy.

	  This property enables runtime LSI measurement if present. In this case,
	  a background thread is created and performs LSI measurements, sleeping
	  the amount of time specified in this property between each measure. This
	  thread is also tasked with updating the control registers of peripherals
	  affected by slow clock drift such as RTC or IWDG, in collaboration with
	  the peripherals' drivers. Note that this increases the memory footprint
	  of the clock control driver, and may increase power consumption.

	  Setting this option to the default value of "0" disables runtime frequency
	  measurements - the result of a single measure performed at boot will be
	  treated as LSI frequency for the lifetime of the application.

endmenu # DT_HAS_ST_STM32WB0_LSI_CLOCK_ENABLED

# Micro-controller Clock Output (MCO) configuration options
config CLOCK_STM32_MCO
	bool
	default y
	select PINCTRL
	depends on DT_HAS_ST_STM32_CLOCK_MCO_ENABLED || DT_HAS_ST_STM32F1_CLOCK_MCO_ENABLED
	help
	  Allows to output various different clock sources onto the MCO pin
	  using a configurable prescaler.

endif # CLOCK_CONTROL_STM32_CUBE
```

## drivers/clock_control/Kconfig.stm32f0_f3
```kconfig
# STM32F0 and STM32F3 PLL configuration options

# Copyright (c) 2019 Linaro
# SPDX-License-Identifier: Apache-2.0

if SOC_SERIES_STM32F0X || SOC_SERIES_STM32F3X

config CLOCK_STM32_PLL_PREDIV
	int "PREDIV Prescaler"
	depends on CLOCK_STM32_SYSCLK_SRC_PLL
	default 1
	range 1 16
	help
	  PREDIV is a PLL clock signal prescaler for the HSE output.
	  It is supported by those parts that do not support PREDIV1.
	  If configured on a non-supported part, this config will be ignored.
	  Allowed values: 1 - 16.

config CLOCK_STM32_PLL_PREDIV1
	int "PREDIV1 Prescaler"
	depends on CLOCK_STM32_SYSCLK_SRC_PLL
	default 1
	range 1 16
	help
	  PREDIV1 is a PLL clock signal prescaler for any PLL input.
	  It is supported by STM32F04xx, STM32F07xx, STM32F09xx, STM32F030xC,
	  STM32F302xE, STM32F303xE and STM32F39xx parts.
	  If configured on a non-supported part, this config will be ignored.
	  Allowed values: 1 - 16.

config CLOCK_STM32_PLL_MULTIPLIER
	int "PLL multiplier"
	depends on CLOCK_STM32_SYSCLK_SRC_PLL
	default 6
	range 2 16
	help
	  PLL multiplier, allowed values: 2-16.
	  PLL output must not exceed 48MHz for STM32F0 series
	  or 72MHz for STM32F3 series.

endif # SOC_SERIES_STM32F0X || SOC_SERIES_STM32F3X
```

## drivers/clock_control/Kconfig.stm32f1
```kconfig
# STM32F1 PLL configuration options

# Copyright (c) 2019 Linaro
# SPDX-License-Identifier: Apache-2.0

if SOC_SERIES_STM32F1X

config CLOCK_STM32_PLL_MULTIPLIER
	int "PLL multiplier"
	depends on CLOCK_STM32_SYSCLK_SRC_PLL
	default 9
	range 2 16 if SOC_STM32F10X_DENSITY_DEVICE
	range 4 9 if SOC_STM32F10X_CONNECTIVITY_LINE_DEVICE
	help
	  PLL multiplier, PLL output must not exceed 72MHz. Allowed values:
	  Density devices: 2-16
	  Connectivity devices:  4 - 9 and 13 ( used for multiplication factor 6.5).

config CLOCK_STM32_PLL_PREDIV1
	int "PREDIV1 Prescaler"
	depends on CLOCK_STM32_SYSCLK_SRC_PLL
	default 1
	range 1 16
	help
	  PREDIV1 is PLL clock signal prescaler, allowed values: 1 - 16.

endif # SOC_SERIES_STM32F1X
```

## drivers/clock_control/Kconfig.stm32f107xx
```kconfig
# Kconfig - STM32F1X Connectivity Line MCU clock control driver config
#
# Copyright (c) 2016 RnDity Sp. z o.o.
#
# SPDX-License-Identifier: Apache-2.0
#

if SOC_STM32F10X_CONNECTIVITY_LINE_DEVICE

menuconfig CLOCK_CONTROL_STM32F10X_CONN_LINE
	bool
	prompt "STM32F107x Reset & Clock Control"
	default y if SOC_STM32F10X_CONNECTIVITY_LINE_DEVICE
	help
	 Enable driver for Reset & Clock Control subsystem found
	 in STM32F105/STM32F107 family of MCUs

config CLOCK_CONTROL_STM32F10X_CONN_LINE_DEVICE_INIT_PRIORITY
	int "Clock Control Device Priority"
	default 1
	depends on CLOCK_CONTROL_STM32F10X_CONN_LINE
	help
	 This option controls the priority of clock control
	 device initialization. Higher priority ensures that the device
	 is initialized earlier in the startup cycle. If unsure, leave
	 at default value 1

choice
prompt "STM32F10x Connectivity Line System Clock Source"
depends on CLOCK_CONTROL_STM32F10X_CONN_LINE

config CLOCK_STM32F10X_CONN_LINE_SYSCLK_SRC_HSI
	bool "HSI"
	help
	 Use HSI as source of SYSCLK

config CLOCK_STM32F10X_CONN_LINE_SYSCLK_SRC_HSE
	bool "HSE"
	help
	 Use HSE as source of SYSCLK

config CLOCK_STM32F10X_CONN_LINE_SYSCLK_SRC_PLLCLK
	bool "PLLCLK"
	help
	 Use PLLCLK as source of SYSCLK

endchoice

choice
prompt "STM32F10x Connectivity Line PLL Clock Source"
depends on CLOCK_CONTROL_STM32F10X_CONN_LINE && CLOCK_STM32F10X_CONN_LINE_SYSCLK_SRC_PLLCLK

config CLOCK_STM32F10X_CONN_LINE_PLL_SRC_HSI
	bool "HSI"
	help
	 Use HSI divided by 2 as source of PLL

config CLOCK_STM32F10X_CONN_LINE_PLL_SRC_PREDIV1
	bool "PREDIV1"
	help
	 Use clock from PREDIV1 as source of PLL

endchoice

choice
prompt "STM32F10x Connectivity Line PREDIV1 entry clock source"
depends on CLOCK_CONTROL_STM32F10X_CONN_LINE && CLOCK_STM32F10X_CONN_LINE_PLL_SRC_PREDIV1

config CLOCK_STM32F10X_CONN_LINE_PREDIV1_SRC_HSE
	bool "HSE"
	help
	 Use HSE as source of PREDIV1

config CLOCK_STM32F10X_CONN_LINE_PREDIV1_SRC_PLL2CLK
	bool "PLL2CLK"
	help
	 Use clock from PLL2CLK as source of PLL

endchoice

config CLOCK_STM32F10X_CONN_LINE_HSE_BYPASS
	bool "HSE bypass"
	depends on CLOCK_CONTROL_STM32F10X_CONN_LINE && (CLOCK_STM32F10X_CONN_LINE_SYSCLK_SRC_HSE || CLOCK_STM32F10X_CONN_LINE_PREDIV1_SRC_HSE)
	help
	 Enable this option to bypass external high-speed clock (HSE).

config CLOCK_STM32F10X_CONN_LINE_PREDIV1
	int "PREDIV1 Prescler"
	depends on CLOCK_CONTROL_STM32F10X_CONN_LINE && CLOCK_STM32F10X_CONN_LINE_PLL_SRC_PREDIV1
	default 0
	range 0 16
	help
	 PREDIV1 is PREDIV1SCR clock signal prescaler, allowed values: 0 - 16.

config CLOCK_STM32F10X_CONN_LINE_PLL_MULTIPLIER
	int "PLL multiplier"
	depends on CLOCK_CONTROL_STM32F10X_CONN_LINE && CLOCK_STM32F10X_CONN_LINE_SYSCLK_SRC_PLLCLK
	default 9
	range 4 13
	help
	 PLL multiplier, allowed values: 4 - 9 and 13 (in fact the multiplication factor is 6.5).
	 Values in range 10-12 are reserved. PLL output must not exceed 72MHz.

config CLOCK_STM32F10X_CONN_LINE_PLL2_MULTIPLIER
	int "PLL2 multiplier"
	depends on CLOCK_CONTROL_STM32F10X_CONN_LINE && CLOCK_STM32F10X_CONN_LINE_PREDIV1_SRC_PLL2CLK
	default 8
	range 8 20
	help
	 PLL2 multiplier, allowed values: 8 - 20. PLL2 output must not exceed 72MHz.

config CLOCK_STM32F10X_CONN_LINE_PREDIV2
	int "PREDIV2 Prescler"
	depends on CLOCK_CONTROL_STM32F10X_CONN_LINE && CLOCK_STM32F10X_CONN_LINE_PREDIV1_SRC_PLL2CLK
	default 0
	range 0 16
	help
	 PREDIV2 is HSE prescaler, allowed values: 0 - 16.

config CLOCK_STM32F10X_CONN_LINE_AHB_PRESCALER
	int "AHB prescaler"
	depends on CLOCK_CONTROL_STM32F10X_CONN_LINE
	default 0
	range 0 512
	help
	 AHB prescaler, allowed values: 0, 2, 4, 8, 16, 64, 128,
	 256, 512.

config CLOCK_STM32F10X_CONN_LINE_APB1_PRESCALER
	int "APB1 prescaler"
	depends on CLOCK_CONTROL_STM32F10X_CONN_LINE
	default 0
	range 0 16
	help
	 APB1 Low speed clock (PCLK1) prescaler, allowed values:
	 0, 2, 4, 8, 16. The APB1 clock must not exceed 36MHz.

config CLOCK_STM32F10X_CONN_LINE_APB2_PRESCALER
	int "APB2 prescaler"
	depends on CLOCK_CONTROL_STM32F10X_CONN_LINE
	default 0
	range 0 16
	help
	 APB2 High speed clock (PCLK2) prescaler, allowed values:
	 0, 2, 4, 8, 16

endif
```

## drivers/clock_control/Kconfig.stm32f10x
```kconfig
# Kconfig - STM32F1 MCU clock control driver config
#
# Copyright (c) 2016 Open-RnD Sp. z o.o.
#
# Licensed under the Apache License, Version 2.0 (the "License");
# you may not use this file except in compliance with the License.
# You may obtain a copy of the License at
#
#     http://www.apache.org/licenses/LICENSE-2.0
#
# Unless required by applicable law or agreed to in writing, software
# distributed under the License is distributed on an "AS IS" BASIS,
# WITHOUT WARRANTIES OR CONDITIONS OF ANY KIND, either express or implied.
# See the License for the specific language governing permissions and
# limitations under the License.
#

if SOC_SERIES_STM32F1X

menuconfig CLOCK_CONTROL_STM32F10X
	bool
	prompt "STM32F10x Reset & Clock Control"
	depends on CLOCK_CONTROL && SOC_SERIES_STM32F1X
	default y if SOC_SERIES_STM32F1X
	help
	 Enable driver for Reset & Clock Control subsystem found
	 in STM32F1 family of MCUs

config CLOCK_CONTROL_STM32F10X_DEVICE_INIT_PRIORITY
	int "Clock Control Device Priority"
	default 1
	depends on CLOCK_CONTROL_STM32F10X
	help
	 This option controls the priority of clock control
	 device initialization. Higher priority ensures that the device
	 is initialized earlier in the startup cycle. If unsure, leave
	 at default value 1

choice
prompt "STM32F10x System Clock Source"
depends on CLOCK_CONTROL_STM32F10X

config CLOCK_STM32F10X_SYSCLK_SRC_HSI
	bool "HSI"
	help
	 Use HSI as source of SYSCLK

config CLOCK_STM32F10X_SYSCLK_SRC_HSE
	bool "HSE"
	help
	 Use HSE as source of SYSCLK

config CLOCK_STM32F10X_SYSCLK_SRC_PLL
	bool "PLL"
	help
	 Use PLL as source of SYSCLK

endchoice

choice
prompt "STM32F10x PLL Clock Source"
depends on CLOCK_CONTROL_STM32F10X && CLOCK_STM32F10X_SYSCLK_SRC_PLL

config CLOCK_STM32F10X_PLL_SRC_HSI
	bool "HSI"
	help
	 Use HSI as source of PLL

config CLOCK_STM32F10X_PLL_SRC_HSE
	bool "HSE"
	help
	 Use HSE as source of PLL

endchoice

config CLOCK_STM32F10X_HSE_BYPASS
	bool "HSE bypass"
	depends on CLOCK_CONTROL_STM32F10X && (CLOCK_STM32F10X_PLL_SRC_HSE || CLOCK_STM32F10X_SYSCLK_SRC_HSE)
	help
	 Enable this option to bypass external high-speed clock (HSE).

config CLOCK_STM32F10X_PLL_XTPRE
	bool "HSE to PLL /2 prescaler"
	depends on CLOCK_CONTROL_STM32F10X && CLOCK_STM32F10X_PLL_SRC_HSE
	help
	 Enable this option to enable /2 prescaler on HSE to PLL clock signal

config CLOCK_STM32F10X_PLL_MULTIPLIER
	int "PLL multiplier"
	depends on CLOCK_CONTROL_STM32F10X && CLOCK_STM32F10X_SYSCLK_SRC_PLL
	default 9
	range 2 16
	help
	 PLL multiplier, allowed values: 2-16. PLL output must not exceed 72MHz.

config CLOCK_STM32F10X_AHB_PRESCALER
	int "AHB prescaler"
	depends on CLOCK_CONTROL_STM32F10X
	default 0
	range 0 512
	help
	 AHB prescaler, allowed values: 0, 2, 4, 8, 16, 64, 128,
	 256, 512.

config CLOCK_STM32F10X_APB1_PRESCALER
	int "APB1 prescaler"
	depends on CLOCK_CONTROL_STM32F10X
	default 0
	range 0 16
	help
	 APB1 Low speed clock (PCLK1) prescaler, allowed values:
	 0, 2, 4, 8, 16. The APB1 clock must not exceed 36MHz.

config CLOCK_STM32F10X_APB2_PRESCALER
	int "APB2 prescaler"
	depends on CLOCK_CONTROL_STM32F10X
	default 0
	range 0 16
	help
	 APB2 High speed clock (PCLK2) prescaler, allowed values:
	 0, 2, 4, 8, 16

endif
```

## drivers/clock_control/Kconfig.stm32f2_f4_f7
```kconfig
# Kconfig - STM32F2, STM32F4 and STM32F7 PLL configuration options
#
# Copyright (c) 2019 Linaro
#
#  SPDX-License-Identifier: Apache-2.0
#

if SOC_SERIES_STM32F2X || SOC_SERIES_STM32F4X || SOC_SERIES_STM32F7X

config CLOCK_STM32_PLL_M_DIVISOR
	int "Division factor for PLL VCO input clock"
	depends on CLOCK_STM32_SYSCLK_SRC_PLL
	default 8
	range 2 63
	help
	 PLLM division factor needs to be set correctly to ensure that the VCO
	 input frequency ranges from 1 to 2 MHz. It is recommended to select a
	 frequency of 2 MHz to limit PLL jitter.
	 Allowed values: 2-63

config CLOCK_STM32_PLL_N_MULTIPLIER
	int "Multiplier factor for PLL VCO output clock"
	depends on CLOCK_STM32_SYSCLK_SRC_PLL
	default 336
	range 192 432 if SOC_STM32F401XE || SOC_SERIES_STM32F2X
	range 50 432
	help
	 PLLN multiplier factor needs to be set correctly to ensure that the
	 VCO output frequency is between 100 and 432 MHz, except on STM32F401
	 where the frequency must be between 192 and 432 MHz.
	 Allowed values: 50-432 (STM32F401: 192-432)

config CLOCK_STM32_PLL_P_DIVISOR
	int "PLL division factor for main system clock"
	depends on CLOCK_STM32_SYSCLK_SRC_PLL
	default 4
	range 2 8
	help
	 PLLP division factor needs to be set correctly to not exceed 84MHz.
	 Allowed values: 2, 4, 6, 8

config CLOCK_STM32_PLL_Q_DIVISOR
	int "Division factor for OTG FS, SDIO and RNG clocks"
	depends on CLOCK_STM32_SYSCLK_SRC_PLL
	default 7
	range 2 15
	help
	 The USB OTG FS requires a 48MHz clock to work correctly. SDIO and RNG
	 need a frequency lower than or equal to 48 MHz to work correctly.
	 Allowed values: 2-15

endif # SOC_SERIES_STM32F2X || SOC_SERIES_STM32F4X || SOC_SERIES_STM32F7X
```
