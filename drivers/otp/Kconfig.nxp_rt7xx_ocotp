## drivers/otp/Kconfig.nxp_rt7xx_ocotp
```kconfig
# Copyright (c) 2026 NXP
# SPDX-License-Identifier: Apache-2.0

config OTP_NXP_RT7XX_OCOTP
	bool "NXP RT7xx OCOTP driver"
	default y
	depends on DT_HAS_NXP_RT7XX_OCOTP_ENABLED
	help
	  Enable the OTP driver for the NXP RT7xx OCOTP controller.
```

## drivers/otp/Kconfig.rts5817
```kconfig
# Copyright (c) 2026 Realtek Semiconductor, Inc.
# SPDX-License-Identifier: Apache-2.0

config OTP_RTS5817
	bool "RTS5817 OCOTP driver"
	default y
	depends on DT_HAS_REALTEK_RTS5817_OCOTP_ENABLED
	depends on RESET_RTS5817 && CLOCK_CONTROL_RTS5817
	select SYSCON
	help
	  Enable support for RTS5817 OCOTP driver.
```

## drivers/otp/Kconfig.sifli
```kconfig
# Copyright (c) 2026 SiFli Technologies Co., Ltd.
# SPDX-License-Identifier: Apache-2.0

config OTP_SIFLI_EFUSE
	bool "SiFli SF32LB series eFuse OTP driver"
	default y
	depends on DT_HAS_SIFLI_SF32LB_EFUSE_ENABLED
	help
	  Enable the SiFli SF32LB series eFuse OTP driver.
	  This driver provides read-only access to the eFuse OTP memory.
	  The driver uses a cache mechanism to improve read performance
	  by loading all eFuse content into memory during initialization.
```

## drivers/otp/Kconfig.sunxi
```kconfig
# SPDX-FileCopyrightText: Copyright The Zephyr Project Contributors
# SPDX-FileCopyrightText: Copyright (c) 2026 Khai Do
# SPDX-License-Identifier: Apache-2.0

config OTP_SUNXI
	bool "Allwinner sunXi SID/eFuse driver"
	default y
	depends on DT_HAS_ALLWINNER_SUNXI_SID_ENABLED
	help
	  Enable Allwinner sunXi Security ID (SID) eFuse driver.
```

## drivers/pci/Kconfig
```kconfig
# Kconfig - PCI configuration options

#
# Copyright (c) 2015 Intel Corporation
#
# SPDX-License-Identifier: Apache-2.0
#


menuconfig PCI
	bool "PCI Settings"
	depends on X86
	help
	  This options enables support of PCI bus for device drivers.

if PCI

config PCI_SHELL
	bool "Enable PCI Shell"
	depends on SHELL
	select PCI_ENUMERATION
	help
	  Enable commands for debugging PCI using the built-in shell.

config PCI_ENUMERATION
	bool "Enable PCI device enumeration"
	help
	  This option enables the PCI enumeration for device drivers.
	  This might be useful to find out which are the PCI settings
	  of the devices. Once those are known and statically set in
	  every relevant driver's configuration, it might be wise to
	  disable this option to remove useless code.

module = PCI
module-str = PCI
source "subsys/logging/Kconfig.template.log_config"

endif # PCI
```

## drivers/pcie/Kconfig
```kconfig
# PCIe RC/EP drivers configuration options

ZEPHYR_PCIE_CONTROLLER := zephyr,pcie-controller

config PCIE_HOST_CONTROLLER_HAS_DRIVER
	bool

config PCIE_ENDPOINT_CONTROLLER_HAS_DRIVER
	bool

source "drivers/pcie/host/Kconfig"
source "drivers/pcie/endpoint/Kconfig"
source "drivers/pcie/controller/Kconfig"
```

## drivers/pcie/controller/Kconfig
```kconfig
# PCIe controller configuration options

# Copyright 2024 TSN Lab, Inc.
# SPDX-License-Identifier: Apache-2.0

config PCIE_CONTROLLER
	bool "PCIe Controller management"
	depends on $(dt_chosen_enabled,$(ZEPHYR_PCIE_CONTROLLER))
	depends on PCIE_HOST
	default y
	help
	  Add support for PCIe Controller management when not handled by a
	  system firmware like on x86 platforms.

# zephyr-keep-sorted-start
source "drivers/pcie/controller/Kconfig.brcmstb"
source "drivers/pcie/controller/Kconfig.ecam"
source "drivers/pcie/controller/Kconfig.iproc"
# zephyr-keep-sorted-stop
```

## drivers/pcie/controller/Kconfig.brcmstb
```kconfig
# Copyright (c) 2024 Junho Lee <junho@tsnlab.com>
# SPDX-License-Identifier: Apache-2.0

config PCIE_BRCMSTB
	bool "Broadcom Set-top box SoC PCIe Driver"
	default y
	depends on DT_HAS_BRCM_BRCMSTB_PCIE_ENABLED
	help
	  Enable Driver for Broadcom Set-top box SoC PCIe controllers.
```

## drivers/pcie/controller/Kconfig.ecam
```kconfig
# SPDX-FileCopyrightText: Copyright The Zephyr Project Contributors
# SPDX-License-Identifier: Apache-2.0

config PCIE_ECAM
	bool "Support for PCIe ECAM Controllers"
	depends on DT_HAS_PCI_HOST_ECAM_GENERIC_ENABLED
	default y
	help
	  Add support for Enhanced Configuration Address Mapping configured
	  PCIe Controllers allowing all outgoing I/O and MEM TLPs to be mapped
	  from memory space into any 256 MB region of the PCIe configuration space.
```

## drivers/pcie/controller/Kconfig.iproc
```kconfig
# iProc PCIe EP configuration options

# Copyright 2020 Broadcom
# SPDX-License-Identifier: Apache-2.0

menuconfig PCIE_EP_IPROC
	bool "Broadcom iProc PCIe EP driver"
	default y
	depends on DT_HAS_BRCM_IPROC_PCIE_EP_ENABLED
	select PCIE_ENDPOINT_CONTROLLER_HAS_DRIVER
	help
	  This option enables Broadcom iProc PCIe EP driver.

if PCIE_EP_IPROC

config PCIE_EP_IPROC_INIT_CFG
	bool "Re-initialize PCIe MSI/MSIX configurations"

endif # PCIE_EP_IPROC
```

## drivers/pcie/endpoint/Kconfig
```kconfig
# PCIe Endpoint configuration options

# Copyright 2020 Broadcom
# SPDX-License-Identifier: Apache-2.0

if PCIE_ENDPOINT

module = PCIE_EP
module-str = PCIE_EP
source "subsys/logging/Kconfig.template.log_config"

comment "PCIe Endpoint Drivers"

endif # PCIE_ENDPOINT
```

## drivers/pcie/endpoint/Kconfig.iproc
```kconfig
# iProc PCIe EP configuration options

# Copyright 2020 Broadcom
# SPDX-License-Identifier: Apache-2.0

menuconfig PCIE_EP_IPROC
	bool "Broadcom iProc PCIe EP driver"
	help
	  This option enables Broadcom iProc PCIe EP driver.

if PCIE_EP_IPROC

config PCIE_EP_IPROC_INIT_CFG
	bool "Re-initialize PCIe MSI/MSIX configurations"

endif # PCIE_EP_IPROC
```

## drivers/pcie/host/Kconfig
```kconfig
# PCIe/new PCI configuration options

# Copyright (c) 2019 Intel Corporation
# SPDX-License-Identifier: Apache-2.0

menuconfig PCIE
	bool "New PCI/PCIe Root Complex support"
	help
	  This option enables support for new PCI(e) drivers.

if PCIE

module = PCIE
module-str = pcie
source "subsys/logging/Kconfig.template.log_config"

config PCIE_INIT_PRIORITY
	int "PCIe initialization priority"
	default 41
	help
	  PCIe host drivers initialization priority.

config PCIE_CONTROLLER
	bool "PCIe Controller management"
	help
	  Add support for PCIe Controller management when not handled by a
	  system firmware like on x86 platforms.

if PCIE_CONTROLLER

config PCIE_ECAM
	bool "Support for PCIe ECAM Controllers"
	help
	  Add support for Enhanced Configuration Address Mapping configured
	  PCIe Controllers allowing all outgoing I/O and MEM TLPs to be mapped
	  from memory space into any 256 MB region of the PCIe configuration space.

endif # PCIE_CONTROLLER

config PCIE_MSI
	bool "Support for PCI(e) MSI"
	help
	  Use Message-Signaled Interrupts where possible. With this option
	  enabled, PCI(e) devices which support MSI will be configured (at
	  runtime) to use them. This is typically required for PCIe devices
	  to generate interrupts at all.

if PCIE_MSI

config PCIE_MSI_MULTI_VECTOR
	bool "MSI multi-vector support"
	help
	  MSI can support up to 32 different messages. This will enable the
	  support of such capability so each message can get a vector
	  assigned to it. This will require for the selected architecture
	  to provide the necessary logic to make it work. Disable this if
	  the vectors cannot be managed by the hardware or if none of the
	  peripheral require this.

config PCIE_MSI_X
	bool "MSI-X support"
	help
	  If one or more device support MSI-X, you'll need to enable this.
	  If a device exposes support for both MSI-X and MSI, MSI-X will be
	  used and MSI disabled on that device. Enable PCIE_MSI_MULTI_VECTOR
	  if you want to support multi-vector on MSI-X as well.

endif # PCIE_MSI

config PCIE_PTM
	bool "Support for PCI(e) Precision Time Management (PTM)"
	help
	  This will enable support both PTM root and PTM requester features.
	  Up to the PCIe device driver to enable its PTM requester capability.

config PCIE_PRT
	bool "Support for IRQ information retrieve via ACPI PRT (PCI Routing Table)"
	default y if ACPI_DSDT_SUPPORT
	help
	  This will enable retrieve interrupt routing information for PCI legacy
	  interrupt via ACPI PRT (PCI Routing Table)

config PCIE_SHELL
	bool "PCIe/new PCI Shell"
	default y
	depends on SHELL
	help
	  Enable commands for debugging PCI(e) using the built-in shell.

endif # PCIE
```

## drivers/peci/Kconfig
```kconfig
# PECI configuration options

# Copyright (c) 2020 Intel Corporation
# SPDX-License-Identifier: Apache-2.0

menuconfig PECI
	bool "Platform Environment Control Interface (PECI) drivers"
	help
	  Include PECI drivers in system config.

if PECI

source "drivers/peci/Kconfig.xec"
source "drivers/peci/Kconfig.it8xxx2"
source "drivers/peci/Kconfig.npcx"

module = PECI
module-str = peci
source "subsys/logging/Kconfig.template.log_config"

config PECI_INIT_PRIORITY
	int "PECI driver init priority"
	default 40
	help
	  PECI device driver initialization priority.
	  There isn't any critical component relying on this priority at
	  the moment.

config PECI_INTERRUPT_DRIVEN
	bool "PECI driver interrupt support"
	help
	  This is an option to be enabled by individual peci driver
	  to indicate that the driver and hardware supports interrupts.

endif # PECI
```

## drivers/peci/Kconfig.espi
```kconfig
# PECI over eSPI configuration options
#
# Copyright (c) 2026 Intel Corporation
# SPDX-License-Identifier: Apache-2.0

config ESPI_PECI
	bool "Support PECI over eSPI"
	depends on DT_HAS_INTEL_ESPI_PECI_ENABLED
	depends on ESPI_OOB_CHANNEL
	default y
	help
	  EC supports Platform Environment Control Interface (PECI) over eSPI
	  using OOB messages.

if ESPI_PECI

config ESPI_PECI_SHELL
	bool "Support PECI over eSPI shell"
	default y
	help
	  EC supports PECI over eSPI console command.

endif
```

## drivers/peci/Kconfig.it8xxx2
```kconfig
# ITE IT8XXX2 PECI configuration options

# Copyright (c) 2022 ITE Tech. Inc.
# SPDX-License-Identifier: Apache-2.0

config PECI_ITE_IT8XXX2
	bool "ITE IT8XXX2 PECI driver"
	default y
	depends on DT_HAS_ITE_IT8XXX2_PECI_ENABLED
	select PECI_INTERRUPT_DRIVEN
	help
	  Enable the ITE IT8XXX2 PECI IO driver.
```

## drivers/peci/Kconfig.kb1200
```kconfig
# ENE KB1200 PECI configuration options

# Copyright (c) 2023 ENE Technology

config PECI_KB1200
	bool "KB1200 PECI driver"
	depends on SOC_ENE_KB1200
	help
	  Enable the ENE KB1200 PECI IO driver.
```

## drivers/peci/Kconfig.nct
```kconfig
# NPCM4XX PECI driver configuration options

# Copyright (c) 2022 Nuvoton Technology Corporation.
# SPDX-License-Identifier: Apache-2.0

config PECI_NCT
	bool "NCT PECI driver"
	default y
	depends on SOC_FAMILY_NCT
	select PECI_INTERRUPT_DRIVEN
	help
	  Enable the NCT PECI IO driver.
```

## drivers/peci/Kconfig.npcx
```kconfig
# NPCX PECI driver configuration options

# Copyright (c) 2022 Nuvoton Technology Corporation.
# SPDX-License-Identifier: Apache-2.0

config PECI_NPCX
	bool "NPCX PECI driver"
	default y
	depends on DT_HAS_NUVOTON_NPCX_PECI_ENABLED
	select PECI_INTERRUPT_DRIVEN
	help
	  Enable the NPCX PECI IO driver.
```

## drivers/peci/Kconfig.xec
```kconfig
# Microchip XEC PECI configuration options

# Copyright (c) 2020 Intel Corporation
# SPDX-License-Identifier: Apache-2.0

config PECI_XEC
	bool "XEC Microchip PECI driver"
	default y
	depends on DT_HAS_MICROCHIP_XEC_PECI_ENABLED
	select PINCTRL
	help
	  Enable the Microchip XEC PECI IO driver.
```

## drivers/pinctrl/Kconfig
```kconfig
# Copyright (c) 2021 Nordic Semiconductor ASA
# Copyright 2025 Arm Limited and/or its affiliates <open-source-office@arm.com>
# SPDX-License-Identifier: Apache-2.0

menuconfig PINCTRL
	bool "Pin controller drivers"

if PINCTRL

module = PINCTRL
module-str = PINCTRL
source "subsys/logging/Kconfig.template.log_config"

config PINCTRL_STORE_REG
	bool
	help
	  This option must be selected by drivers that require access to the device
	  register address. This can happen, for example, if certain pin control
	  actions are device dependent or require access to device specific
	  registers

config PINCTRL_NON_STATIC
	bool
	help
	  This option can be selected if the pin control configuration defined by
	  a driver has to be accessed externally. This can happen, for example, when
	  dynamic pin control is enabled or in testing environments.

config PINCTRL_DYNAMIC
	bool "Dynamic configuration of pins"
	select PINCTRL_NON_STATIC
	help
	  When this option is enabled pin control configuration can be changed at
	  runtime. This can be useful, for example, to change the pins assigned to a
	  peripheral at early boot stages depending on a certain input.

config PINCTRL_KEEP_SLEEP_STATE
	bool "Keep sleep state"
	default y if PM || PM_DEVICE || DEVICE_DEINIT_SUPPORT

source "drivers/pinctrl/Kconfig.*"
source "drivers/pinctrl/*/Kconfig"

endif # PINCTRL
```

## drivers/pinctrl/Kconfig.aesc
```kconfig
# SPDX-FileCopyrightText: 2026 Aesc Silicon
# SPDX-License-Identifier: Apache-2.0

config PINCTRL_AESC
	bool "Aesc Silicon pinctrl driver"
	default y
	depends on DT_HAS_AESC_PINCTRL_ENABLED
	help
	  Enable pin controller driver for Aesc Silicon SoCs.
```

## drivers/pinctrl/Kconfig.alif
```kconfig
# Copyright (c) 2025 Alif Semiconductor
# SPDX-License-Identifier: Apache-2.0

config PINCTRL_ALIF
	bool "Alif pinctrl driver"
	default y
	depends on DT_HAS_ALIF_PINCTRL_ENABLED
	help
	  Enable pin controller driver for Alif SoCs.
```

## drivers/pinctrl/Kconfig.ambiq
```kconfig
# SPDX-License-Identifier: Apache-2.0
#
# Copyright (c) 2023 Antmicro <www.antmicro.com>

config PINCTRL_AMBIQ
	bool "Ambiq Apollo pin controller driver"
	default y
	depends on DT_HAS_AMBIQ_APOLLO5_PINCTRL_ENABLED || DT_HAS_AMBIQ_APOLLO4_PINCTRL_ENABLED || DT_HAS_AMBIQ_APOLLO3_PINCTRL_ENABLED
	select AMBIQ_HAL
	select AMBIQ_HAL_USE_GPIO
	help
	  Ambiq Apollo pinctrl driver
```

## drivers/pinctrl/Kconfig.ameba
```kconfig
# Copyright (c) 2024 Realtek Semiconductor Corp.
# SPDX-License-Identifier: Apache-2.0

config PINCTRL_AMEBA
	bool "Pin controller driver for Realtek Ameba series SoC"
	default y
	depends on DT_HAS_REALTEK_AMEBA_PINCTRL_ENABLED
	help
	  Enable pin controller driver for Realtek Ameba series SoC
```
