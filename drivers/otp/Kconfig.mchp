## drivers/otp/Kconfig.mchp
```kconfig
# Copyright (c) 2026 Microchip Technology Inc.
# SPDX-License-Identifier: Apache-2.0

config OTP_MCHP_OTPC_G1
	bool "Microchip OTPC support for G1 peripherals"
	depends on DT_HAS_MICROCHIP_OTPC_G1_OTP_ENABLED
	default y
	help
	  Enable support for the Microchip OTPC driver on G1 OTPC peripherals.
```

## drivers/otp/Kconfig.npm10xx
```kconfig
# Copyright (c) 2026 Nordic Semiconductor ASA
# SPDX-License-Identifier: Apache-2.0

config OTP_NPM10XX
	bool "Nordic nPM10xx UICR (User OTP) driver"
	default y
	depends on DT_HAS_NORDIC_NPM10XX_UICR_ENABLED
	select I2C
	help
	  Enable the Nordic nPM10xx UICR OTP driver.

if OTP_NPM10XX

config OTP_NPM10XX_INIT_PRIORITY
	int "nPM10xx UICR driver initialization priority"
	default 85
	help
	  Initialization priority for the nPM10xx UICR driver. It must be
	  greater than the I2C init priority.

config OTP_NPM10XX_DRY_RUN
	bool "nPM10xx UICR dry-run programming"
	depends on OTP_PROGRAM
	help
	  Do not actually burn UICR bits. The programming sequence is executed
	  up to (but excluding) the TASKS.PROG trigger and the intended bit
	  address is logged instead. Useful for safe testing, as UICR
	  programming is irreversible.

endif # OTP_NPM10XX
```

## drivers/otp/Kconfig.nxp_fsb
```kconfig
# Copyright 2026 NXP
# SPDX-License-Identifier: Apache-2.0

config OTP_NXP_FSB
	bool "NXP FSB OTP driver"
	default y
	depends on DT_HAS_NXP_FSB_ENABLED
	help
	  Enable the read-only OTP driver for the NXP Fuse Sense Block found on
	  i.MX RT266x SoCs.
```

## drivers/otp/Kconfig.nxp_rw6xx
```kconfig
# SPDX-FileCopyrightText: Copyright 2026 NXP
# SPDX-License-Identifier: Apache-2.0

config OTP_NXP_RW6XX
	bool "NXP RW6xx OCOTP driver"
	default y
	depends on DT_HAS_NXP_RW6XX_OCOTP_ENABLED
	help
	  Enable the NXP RW6xx OCOTP (On-Chip OTP) driver for RW610/RW612 SoCs.
	  Fuse programming requires CONFIG_OTP_PROGRAM.
```

## drivers/otp/Kconfig.stm32
```kconfig
# Copyright (c) 2026 STMicroelectronics
# SPDX-License-Identifier: Apache-2.0

config OTP_STM32_BSEC
	bool "STM32 BSEC driver"
	default y
	select USE_STM32_HAL_BSEC
	depends on DT_HAS_ST_STM32_BSEC_ENABLED
	help
	  Enable OTP fuse access for STM32 SoCs embedding a BSEC peripheral.

config OTP_STM32_NVM
	bool "STM32 embedded NVM OTP driver"
	default y
	depends on DT_HAS_ST_STM32_NVM_OTP_ENABLED
	help
	  Enable driver for OTP regions inside embedded non-volatile memory
	  found in STM32 SoCs.

	  Note: the "program" operation (CONFIG_OTP_PROGRAM) is not implemented
	  in this driver but in each STM32 series' flash driver instead. This
	  driver merely acts as a shim redirecting otp_program() to the proper
	  "backend" driver. It is possible that some series do not provide an
	  implementation for the program operation: in this case, otp_program()
	  will return -ENOTSUP. Check the appropriate flash driver to determine
	  if the program operation is implemented or not.

if OTP_STM32_NVM

config OTP_STM32_NVM_PROGRAMMING_SUPPORT
	bool "NVM OTP programming"
	default y
	depends on OTP_PROGRAM
	depends on SOC_FLASH_STM32
	help
	  Enable programming of the OTP area of STM32 NVM.

	  Note that the OTP programming logic is implemented in series-specific
	  flash drivers; this driver merely implements otp_program() as a shim
	  which calls the flash driver's implementation.

	  OTP programming is not supported by all flash drivers yet. Calling
	  otp_program() when the underlying flash driver does not support the
	  operation will return -ENOTSUP.

endif # OTP_STM32_NVM
```

## drivers/pcie/controller/Kconfig.dw
```kconfig
# Copyright (c) 2026 Process Mission
# SPDX-License-Identifier: Apache-2.0

config PCIE_DW
	bool
```

## drivers/pcie/controller/Kconfig.dw_rockchip
```kconfig
# Copyright (c) 2026 Process Mission
# SPDX-License-Identifier: Apache-2.0

config PCIE_DW_ROCKCHIP
	bool "Rockchip DesignWare PCIe host controller"
	default y
	depends on DT_HAS_ROCKCHIP_RK3588_PCIE_ENABLED
	depends on ARM64
	depends on CLOCK_CONTROL
	select RESET
	select PCIE_DW
	help
	  Enable the DesignWare PCIe Root Complex driver for Rockchip RK3588
	  SoCs. The driver handles configuration space access, outbound iATU
	  windows, BAR allocation, endpoint enumeration and MSI through the
	  GICv3 ITS; legacy INTx is not supported. Only the pcie2x1l2
	  controller is supported for direct power-on (clocks, resets,
	  ComboPHY0, PERST#); other controllers need firmware bring-up and the
	  rockchip,firmware-initialized devicetree property. pcie3x4 support is
	  a follow-up.
```

## drivers/pcie/endpoint/Kconfig.emul
```kconfig
# SPDX-FileCopyrightText: Copyright (c) 2026 Process Mission
#
# SPDX-License-Identifier: Apache-2.0

# Emulated PCIe EP configuration options

menuconfig PCIE_EP_EMUL
	bool "Emulated PCIe EP driver [EXPERIMENTAL]"
	depends on PCIE_ENDPOINT
	depends on ARCH_POSIX
	depends on IRQ_OFFLOAD
	depends on DT_HAS_ZEPHYR_PCIE_EP_EMUL_ENABLED
	select EXPERIMENTAL
	help
	  This option enables a process-local PCIe Endpoint emulator driver
	  implementing the PCIe EP driver API purely in software. The
	  emulated endpoint is not externally PCIe-enumerable. It is usable
	  on POSIX/native targets such as native_sim.

	  Reset callbacks are delivered in interrupt context through
	  irq_offload(), so this driver requires IRQ_OFFLOAD (enabled, for
	  example, by setting CONFIG_TEST and CONFIG_IRQ_OFFLOAD in a test
	  application).

if PCIE_EP_EMUL

config PCIE_EP_EMUL_MAX_APERTURES
	int "Maximum registered host apertures per emulated endpoint"
	range 1 32
	default 4
	help
	  Bounds the per-instance aperture table. Host apertures are
	  registered explicitly by the test host to model host memory; a
	  small fixed table keeps per-instance RAM use bounded and
	  deterministic.

config PCIE_EP_EMUL_MAX_MAPS
	int "Maximum concurrent outbound mappings per emulated endpoint"
	range 1 64
	default 8
	help
	  Bounds the per-instance mapping table. Each pcie_ep_map_addr()
	  call occupies one entry until pcie_ep_unmap_addr() releases it;
	  a small fixed table keeps per-instance RAM use bounded and
	  deterministic.

config PCIE_EP_EMUL_MAX_IRQ_EVENTS
	int "Maximum queued interrupt events per emulated endpoint"
	range 1 64
	default 8
	help
	  Bounds the per-instance interrupt event queue. Each successful
	  pcie_ep_raise_irq() call occupies one entry until the test host
	  consumes it; a small fixed queue keeps per-instance RAM use
	  bounded and surfaces unbounded producer/consumer drift in tests
	  as -ENOSPC instead of unbounded memory growth.

endif # PCIE_EP_EMUL
```

## drivers/pinctrl/Kconfig.abov32
```kconfig
# Copyright (c) 2026 ABOV Semiconductor Co., Ltd.
# SPDX-License-Identifier: Apache-2.0

config PINCTRL_ABOV32
	bool "ABOV32 pinctrl driver"
	default y
	depends on DT_HAS_ABOV_ABOV32_PINCTRL_ENABLED
	help
	  Enable pin controller driver for ABOV32 SoCs.
```

## drivers/pinctrl/Kconfig.arm_v2m_musca_b1
```kconfig
# Copyright 2026 Arm Limited and/or its affiliates <open-source-office@arm.com>
# SPDX-License-Identifier: Apache-2.0

config PINCTRL_ARM_V2M_MUSCA_B1
	bool "Arm Musca-B1 pin controller driver"
	default y
	depends on DT_HAS_ARM_V2M_MUSCA_B1_PINCTRL_ENABLED
	help
	  Arm Musca-B1 pinctrl driver
```

## drivers/pinctrl/Kconfig.beken
```kconfig
# Copyright The Zephyr Project Contributors
# SPDX-License-Identifier: Apache-2.0

config PINCTRL_BEKEN_BK7258
	bool "Beken BK7258 pin controller driver"
	default y
	depends on DT_HAS_BEKEN_BK7258_PINCTRL_ENABLED
	help
	  This option enables the Beken BK7258 pin controller driver.
```

## drivers/pinctrl/Kconfig.cc27xx
```kconfig
# Copyright (c) 2025 Texas Instruments Incorporated
# Copyright (c) 2024 BayLibre, SAS
#
# SPDX-License-Identifier: Apache-2.0

config PINCTRL_CC27XX
	bool "TI SimpleLink CC27XX pinctrl driver"
	default y
	depends on DT_HAS_TI_CC27XX_PINCTRL_ENABLED
	help
	  Enable the TI SimpleLink CC27XX pinctrl driver
```

## drivers/pinctrl/Kconfig.hogs
```kconfig
# SPDX-FileCopyrightText: Copyright (c) 2026 Axonne Inc.
# SPDX-License-Identifier: Apache-2.0

menuconfig PINCTRL_HOGS
	bool "Pin controller hogs"
	depends on PINCTRL && !PINCTRL_STORE_REG
	default $(dt_pinctrl_hogs_enabled)
	help
	  Apply the default state of pin controllers that reference their own
	  configuration nodes through pinctrl-N and pinctrl-names properties.
	  The backend must support configuring pins without a peripheral
	  register address.

if PINCTRL_HOGS

choice PINCTRL_HOGS_INIT_LEVEL
	prompt "Initialization level"
	default PINCTRL_HOGS_INIT_POST_KERNEL
	help
	  Select a level after the controller's dependencies are initialized
	  and before consumers of the pins. Use a pre-kernel level only if
	  the pin controller backend can run without kernel services.

config PINCTRL_HOGS_INIT_PRE_KERNEL_1
	bool "PRE_KERNEL_1"

config PINCTRL_HOGS_INIT_PRE_KERNEL_2
	bool "PRE_KERNEL_2"

config PINCTRL_HOGS_INIT_POST_KERNEL
	bool "POST_KERNEL"

endchoice

config PINCTRL_HOGS_INIT_PRIORITY
	int "Initialization priority"
	default 41
	help
	  Initialize pin controller hogs after the controller's dependencies,
	  including GPIO and clock drivers, and before consumers of the pins.
	  All pin controller hogs use the same initialization level and priority.
	  The default priority matches that of GPIO hogs. If GPIO hogs depend on
	  this configuration, select an earlier level or a lower priority within
	  the same level so pin controller hogs run first.

endif # PINCTRL_HOGS
```

## drivers/pinctrl/Kconfig.hpmicro
```kconfig
# Copyright (c) 2024 HPMicro
# Copyright (c) 2026 Cody Gu <gujiaqi@iscas.ac.cn>
# SPDX-License-Identifier: Apache-2.0

config PINCTRL_HPMICRO
	bool "HPMicro IOC pin controller"
	default y
	depends on DT_HAS_HPMICRO_HPM_PINCTRL_ENABLED
	depends on HAS_HPMSDK_IOC
	help
	  Enable the pin controller driver for the HPMicro IOC and PIOC
	  controllers.
```

## drivers/pinctrl/Kconfig.infineon
```kconfig
# Infineon CAT1 Pin controller configuration options

# Copyright (c) 2022 Cypress Semiconductor Corporation (an Infineon company) or
# an affiliate of Cypress Semiconductor Corporation
# SPDX-License-Identifier: Apache-2.0

config PINCTRL_INFINEON_CAT1
	bool "Pin controller driver for Infineon CAT1 MCUs"
	default y
	depends on DT_HAS_INFINEON_PINCTRL_ENABLED
	help
	  Enable Pin controller driver for Infineon CAT1 MCUs

config PINCTRL_INFINEON_IOSS
	bool "Infineon IOSS pin controller driver"
	default y
	depends on DT_HAS_INFINEON_IOSS_PINCTRL_ENABLED
	help
	  Enable the register level pin controller driver for the Infineon
	  IOSS block, which programs the HSIOM function selection and the
	  GPIO port drive mode of each pin.

config PINCTRL_INFINEON_IOSS_MXS40S
	bool
	default y if DT_HAS_INFINEON_MXS40S_IOSS_PINCTRL_ENABLED
	depends on PINCTRL_INFINEON_IOSS
	help
	  The IOSS is the MXS40SIOSS variant, which supports the full, half,
	  one-fourth and one-eighth drive strength levels.

config PINCTRL_INFINEON_IOSS_MXS22
	bool
	default y if DT_HAS_INFINEON_MXS22_IOSS_PINCTRL_ENABLED
	depends on PINCTRL_INFINEON_IOSS
	help
	  The IOSS is the MXS22IOSS variant, which supports eight drive
	  strength levels and has the CFG_OUT3 drive mode register.
```

## drivers/pinctrl/Kconfig.infineon_aurix
```kconfig
# SPDX-FileCopyrightText: Copyright (c) 2024 Infineon Technologies AG,
# SPDX-FileCopyrightText: or an affiliate of Infineon Technologies AG. All rights reserved.
# SPDX-FileCopyrightText: Copyright (c) 2026 Linumiz
#
# SPDX-License-Identifier: Apache-2.0

config PINCTRL_INFINEON_AURIX_TC3X
	bool "Infineon AURIX TC3x pin controller driver"
	default y
	depends on DT_HAS_INFINEON_AURIX_TC3X_PINCTRL_ENABLED
	help
	  Pin controller driver for the ports of Infineon AURIX TC3x devices.

config PINCTRL_INFINEON_AURIX_TC4X
	bool "Infineon AURIX TC4x pin controller driver"
	default y
	depends on DT_HAS_INFINEON_AURIX_TC4X_PINCTRL_ENABLED
	help
	  Pin controller driver for the ports of Infineon AURIX TC4x devices.
```

## drivers/pinctrl/Kconfig.mtk
```kconfig
# Copyright (c) 2026 MediaTek Inc.
# SPDX-License-Identifier: Apache-2.0

config PINCTRL_MT8188
	bool "MediaTek MT8188 pin controller"
	default y
	depends on DT_HAS_MEDIATEK_MT8188_PINCTRL_ENABLED
	help
	  Enable the pin controller driver for MediaTek MT8188.
```

## drivers/pinctrl/Kconfig.py32
```kconfig
# SPDX-FileCopyrightText: Copyright The Zephyr Project Contributors
# SPDX-License-Identifier: Apache-2.0

config PINCTRL_PY32
	bool "Puya PY32 pinctrl driver"
	default y
	depends on DT_HAS_PUYA_PY32_PINCTRL_ENABLED
	help
	  Enable the pinctrl driver for Puya PY32 microcontrollers.
```

## drivers/pinctrl/Kconfig.ti_cc35xx
```kconfig
# SPDX-License-Identifier: Apache-2.0

config PINCTRL_TI_CC35XX
	bool "TI CC35XX pinctrl driver"
	default y
	depends on DT_HAS_TI_CC35XX_PINCTRL_ENABLED
	help
	  Enable the TI CC35XX pinctrl driver
```

## drivers/pinctrl/Kconfig.tiva_c
```kconfig
# SPDX-License-Identifier: Apache-2.0
#
# Copyright (c) 2026 Linumiz
# Author: Sri Surya <srisurya@linumiz.com>

config PINCTRL_TIVA_C
	bool "TI Tiva C Series pinctrl driver"
	default y
	depends on DT_HAS_TI_TIVA_C_PINCTRL_ENABLED
	select USE_TIVAWARE_GPIO
	select USE_TIVAWARE_SYSCTL
	help
	  Enable pin controller support for TI Tiva C Series
	  (TM4C123G, TM4C129x) microcontrollers.
	  Uses TivaWare driverlib GPIOPinConfigure() and GPIOPinType*().
```

## drivers/pinctrl/renesas/rafw/Kconfig
```kconfig
# SPDX-FileCopyrightText: 2026 Renesas Electronics Corporation
# SPDX-License-Identifier: Apache-2.0

config PINCTRL_RENESAS_RAFW
	bool "Renesas RAFW series pin controller driver"
	default y
	depends on DT_HAS_RENESAS_RAFW_PINCTRL_ENABLED
	help
	  Enable Renesas RAFW series pin controller driver.
```

## drivers/pinctrl/renesas/rx/Kconfig
```kconfig
# Copyright (c) 2024 Renesas Electronics Corporation
# SPDX-License-Identifier: Apache-2.0

config PINCTRL_RENESAS_RX
	bool "Renesas RX series pin controller driver"
	default y
	depends on DT_HAS_RENESAS_RX_PINCTRL_ENABLED
	select USE_RX_RDP_MPC
	select USE_RX_RDP_GPIO
	help
	  Enable Renesas RX series pin controller driver.

config PINCTRL_RENESAS_RX_PFS
	bool "Renesas RX series pin controller driver with PFS support"
	default y
	depends on DT_HAS_RENESAS_RX_PINCTRL_PFS_ENABLED
	help
	  Enable Renesas RX series pin controller driver with PFS support.
	  This is required for devices that use the PFS (Pin Function Select) registers.
```

## drivers/ppc/Kconfig
```kconfig
# Peripheral Protection Controller (PPC) drivers
#
# SPDX-FileCopyrightText: Copyright (c) 2026 Infineon Technologies AG,
# SPDX-FileCopyrightText: or an affiliate of Infineon Technologies AG. All rights reserved.
#
# SPDX-License-Identifier: Apache-2.0

menu "Peripheral Protection Controller (PPC) drivers"

config PPC
	bool
	help
	  Set by any Peripheral Protection Controller (PPC) driver to indicate
	  that the ppc_configure_ns_all() API (<zephyr/drivers/ppc/ppc.h>) is
	  available.  Individual PPC drivers select this symbol; application and
	  Secure-image code can test CONFIG_PPC instead of naming a specific
	  driver.

# zephyr-keep-sorted-start
source "drivers/ppc/arm_sse200_spctrl/Kconfig"
source "drivers/ppc/infineon_mxs40_ppc/Kconfig"
# zephyr-keep-sorted-stop

endmenu
```

## drivers/ppc/arm_sse200_spctrl/Kconfig
```kconfig
# SPDX-FileCopyrightText: Copyright (c) 2026 Infineon Technologies AG,
# SPDX-FileCopyrightText: or an affiliate of Infineon Technologies AG. All rights reserved.
#
# SPDX-License-Identifier: Apache-2.0

config ARM_SSE200_SPCTRL
	bool "ARM SSE-200 SPCTRL driver"
	depends on ARM_SECURE_FIRMWARE
	default y if DT_HAS_ARM_SSE_200_SPCTRL_ENABLED
	select PPC
	help
	  Enables the driver for the ARM SSE-200 Secure Privilege Control
	  Register block.  At PRE_KERNEL_1 init it programs the NSCCFG
	  register according to the nsccfg DTS property, telling the IDAU
	  which SRAM banks are Non-Secure Callable.
```
