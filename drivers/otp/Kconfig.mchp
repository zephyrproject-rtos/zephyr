## drivers/ppc/infineon_mxs40_ppc/Kconfig
```kconfig
# SPDX-FileCopyrightText: <text>Copyright (c) 2026 Infineon Technologies AG,
# or an affiliate of Infineon Technologies AG. All rights reserved.</text>
#
# SPDX-License-Identifier: Apache-2.0

config INFINEON_MXS40_PPC
	bool "Infineon MXS40 Peripheral Protection Controller driver"
	depends on ARM_SECURE_FIRMWARE
	default y if DT_HAS_INFINEON_MXS40_PPC_ENABLED
	select PPC
	help
	  Enables the devicetree-driven driver for the Infineon MXS40 Peripheral
	  Protection Controller.  ppc_configure_ns_all() opens the peripheral
	  protection regions listed on each enabled "infineon,mxs40-ppc" node for
	  Non-Secure access.
```
