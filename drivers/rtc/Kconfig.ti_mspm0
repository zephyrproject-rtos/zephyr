## drivers/rtc/Kconfig.ti_mspm0
```kconfig
# Copyright (c) 2025 Linumiz GmbH
# SPDX-License-Identifier: Apache-2.0

config RTC_TI_MSPM0
	bool "Texas Instruments MSPM0 RTC driver"
	default y
	depends on DT_HAS_TI_MSPM0_RTC_ENABLED
	help
	  Texas Instruments Real-Time Clock (RTC) driver used on MSPM0 SoC series.

config RTC_TI_MSPM0_INTERVAL_TIMER
	bool "MSPM0 RTC interval timer"
	depends on RTC_TI_MSPM0
	help
	  Enable configurable interval timer (RTCTEV). Generates interrupts
	  once per minute, hour, at midnight, or at noon.

config RTC_TI_MSPM0_PS_TIMER
	bool "MSPM0 RTC prescaler timer"
	depends on RTC_TI_MSPM0
	help
	  Enable RT0PS and RT1PS prescaler timer periodic interrupts.
```

## drivers/sdhc/Kconfig.bcm2712
```kconfig
# SPDX-FileCopyrightText: Copyright (c) 2026 Process Mission
# SPDX-License-Identifier: Apache-2.0

menuconfig SDHC_BCM2712
	bool "Broadcom BCM2712 SD host controller"
	default y
	depends on DT_HAS_BRCM_BCM2712_SDHCI_ENABLED
	select SDHC_STANDARD_CORE
	select SDHC_SUPPORTS_UHS
	select SDHC_SUPPORTS_NATIVE_MODE
	select EVENTS
	select CLOCK_CONTROL
	select CLOCK_CONTROL_FIXED_RATE_CLOCK
	select PINCTRL
	select GPIO
	select REGULATOR
	help
	  Enable the BCM2712 SD host controller with PIO fallback, 3.3 V
	  legacy/HS and optional 1.8 V SDR50/SDR104 signalling up to 208 MHz.
	  Enable UHS modes through devicetree on boards with a switchable I/O supply.
	  SDR104 multi-block transfers require a card that supports CMD23.
	  Configure main-bank SDIO pins through pinctrl. Dedicated EMMC pads used
	  by the SD card slot must retain the boot firmware configuration.
	  Use interrupts when devicetree provides an interrupt specifier;
	  otherwise poll for completion. Support SD memory and SDIO requests.
	  Requests are limited to 512 bytes per block, including SDIO.
	  In tuning-required modes with retuning mode below 2, requests larger
	  than 4 MiB are rejected. Applications must use smaller transfers.
	  SDIO card interrupts require a devicetree interrupt specifier.
	  eMMC-specific modes are not implemented.
	  Power/voltage, clock-stability, Auto CMD23 and controller recovery failures
	  latch the host until the application calls sdhc_hw_reset() and
	  reinitializes the card. The SD stack does not reset the host itself.
	  Failed tuning can be retried after successful command/data line recovery.

if SDHC_BCM2712

menuconfig SDHC_BCM2712_DMA
	bool "BCM2712 ADMA2 transfers"
	default y
	select CACHE_MANAGEMENT if DCACHE
	help
	  Use ADMA2 when the controller advertises support for the selected format.
	  Otherwise, or when a buffer is unsuitable for DMA, use PIO.

if SDHC_BCM2712_DMA

config SDHC_BCM2712_DMA_64BIT
	bool "64-bit ADMA2 descriptors"
	default y
	help
	  Use the SDHCI v3-compatible 64-bit descriptor format when supported
	  by the controller. Disable this to use 32-bit descriptors and limit
	  DMA addresses to the lower 4 GiB.

config SDHC_BCM2712_DMA_DESC_COUNT
	int "BCM2712 ADMA2 descriptors"
	default 8
	range 1 128
	help
	  Each descriptor covers up to 64 KiB of contiguous memory. Requests
	  exceeding the table capacity use PIO.

config SDHC_BCM2712_DMA_BUFFER_SIZE
	int "BCM2712 ADMA2 bounce buffer size"
	default 4096
	range 64 65536
	help
	  Allocate this many bytes per host for DMA transfers that need an
	  aligned buffer. Round the allocation up to the cache-line alignment.
	  Transfers exceeding the buffer capacity use PIO when direct DMA
	  is unsuitable.

endif # SDHC_BCM2712_DMA

endif # SDHC_BCM2712
```

## drivers/sdhc/Kconfig.cdns
```kconfig
# Copyright (c) 2023 Intel Corporation
# SPDX-License-Identifier: Apache-2.0

config SDHC_CDNS
	bool "Cadence SDHC driver"
	default y
	depends on DT_HAS_CDNS_SDHC_ENABLED
	select SDHC_SUPPORTS_NATIVE_MODE
	select CACHE_MANAGEMENT if DCACHE
	select EVENTS
	help
	  Enable SD/EMMC host controller driver

if SDHC_CDNS

config SDHC_CDNS_DESC_SIZE
	int "Max descriptor SIZE"
	default 32
	help
	  Set max number of descriptors supported

# Cadence SDHC DMA buffers require cache-line alignment
config SDHC_BUFFER_ALIGNMENT
	default DCACHE_LINE_SIZE if DCACHE
	default 32

endif
```

## drivers/sdhc/Kconfig.ti_cc35xx_sdhc
```kconfig
# Copyright (c) 2026 Conclusive Engineering Sp. z o.o.
# SPDX-License-Identifier: Apache-2.0

# TI SDHC Controller node

config SDHC_TI_CC35XX_INTERRUPT_ENABLE
	bool "Support interrupt driven operation"
	default y
	help
		Selected between polling or interrupt based operation.

config SDHC_TI_CC35XX
	bool "TI CC35XX SDHC"
	default y
	depends on DT_HAS_TI_CC35XX_SDHC_ENABLED
	select EVENTS
	select SDHC_SUPPORTS_NATIVE_MODE
	help
		Enable TI CC35XX SDMMC Host Controller.
```

## drivers/sdhc/Kconfig.xlnx_zynq
```kconfig
# Copyright (c) 2026 David Paul-Beier
# SPDX-License-Identifier: Apache-2.0

config XLNX_ZYNQ_SDHC
	bool "Xilinx Zynq-7000 SDHC driver"
	default y
	depends on DT_HAS_XLNX_ZYNQ_8_9A_ENABLED
	select SDHC_SUPPORTS_NATIVE_MODE
	help
	  Enable the Xilinx Zynq-7000 PS SD/SDIO host controller driver.
	  Polling/PIO only in this initial version -- no DMA, no UHS or
	  tuning support (this controller generation predates the PHY/tap-
	  delay block used by ZynqMP and Versal).
```

## drivers/sensor/adi/ad5940/Kconfig
```kconfig
# Copyright (c) 2026 Analog Devices, Inc.
# SPDX-License-Identifier: Apache-2.0

menuconfig AD5940
	bool "Analog Devices AD5940/AD5941 impedance AFE sensor driver"
	default y
	depends on DT_HAS_ADI_AD5940_ENABLED
	select SPI
	select GPIO
	help
	  Enable driver for the Analog Devices AD5940/AD5941 high-precision
	  impedance and electrochemical analog front-end (AFE). The device
	  supports EIS, amperometry, cyclic voltammetry, and raw ADC streaming
	  via the Zephyr sensor API and RTIO interface.

if AD5940

choice AD5940_TRIGGER_MODE
	prompt "AD5940 interrupt trigger mode"
	default AD5940_TRIGGER_NONE
	help
	  Select how the AD5940 FIFO watermark interrupt is handled.

config AD5940_TRIGGER_NONE
	bool "No interrupt trigger"
	help
	  Disable interrupt-driven mode. Use polling only (sensor_sample_fetch).

config AD5940_TRIGGER_GLOBAL_THREAD
	bool "Global workqueue interrupt trigger"
	depends on GPIO
	select AD5940_TRIGGER
	help
	  Handle the AD5940 interrupt in the system workqueue using k_work.
	  Lower latency than own-thread but shares thread resources.

config AD5940_TRIGGER_OWN_THREAD
	bool "Dedicated interrupt thread"
	depends on GPIO
	select AD5940_TRIGGER
	help
	  Handle the AD5940 interrupt in a dedicated kernel thread.
	  Provides better isolation and allows blocking operations in the handler.

endchoice

config AD5940_TRIGGER
	bool
	help
	  Internal symbol set by trigger mode choice.

config AD5940_THREAD_STACK_SIZE
	int "AD5940 trigger thread stack size (bytes)"
	default 2048
	depends on AD5940_TRIGGER_OWN_THREAD
	help
	  Stack size in bytes for the dedicated AD5940 trigger thread.
	  Must be large enough for the trigger handler call depth.

config AD5940_THREAD_PRIORITY
	int "AD5940 trigger thread priority"
	default 10
	depends on AD5940_TRIGGER_OWN_THREAD
	help
	  Priority of the dedicated AD5940 interrupt handler thread.
	  Lower values indicate higher priority.

config AD5940_STREAM
	bool "AD5940 RTIO streaming support"
	depends on GPIO
	select SPI_RTIO
	select SENSOR_ASYNC_API
	select RTIO_WORKQ
	select AD5940_TRIGGER
	help
	  Enable RTIO-based async streaming for high-throughput data acquisition.
	  When enabled, use sensor_stream() and rtio_cqe_consume_block() to
	  receive FIFO data asynchronously.

config AD5940_FREQUENCY_SWEEP_ENABLE
	bool "AD5940 EIS frequency sweep support"
	help
	  Enable multi-point EIS frequency sweep mode. When enabled, the driver
	  automatically advances through a configured frequency table after each
	  impedance measurement, allowing broadband impedance spectroscopy.

config AD5940_MAX_SWEEP_POINTS
	int "Maximum EIS sweep frequency points"
	default 20
	range 2 500
	depends on AD5940_FREQUENCY_SWEEP_ENABLE
	help
	  Maximum number of frequency points in the EIS sweep table.
	  Each point requires an entry in the RTIA calibration table.
	  Increasing this value increases RAM usage.

config AD5940_RTIO_SQ_SZ
	int "AD5940 RTIO submission queue size"
	default 32
	depends on AD5940_STREAM
	help
	  Number of entries in the AD5940 RTIO submission queue.
	  Must be large enough to hold all SQEs in the FIFO burst read chain.
	  Minimum recommended value is 16.

config AD5940_RTIO_CQ_SZ
	int "AD5940 RTIO completion queue size"
	default 32
	depends on AD5940_STREAM
	help
	  Number of entries in the AD5940 RTIO completion queue.
	  Should match or exceed the submission queue size.

config AD5940_SEQGEN
	bool "AD5940 runtime sequencer opcode generator (SEQGen)"
	help
	  Generate the EIS measurement sequence at runtime instead of using
	  the static sequence.

config AD5940_SEQGEN_BUF_WORDS
	int "AD5940 SEQGen opcode buffer size (32-bit words)"
	default 256
	range 64 1024
	depends on AD5940_SEQGEN
	help
	  Size of the sequence generator buffer, in 32-bit words.

config AD5940_ADC_SELFCAL
	bool "AD5940 ADC/PGA offset-gain self-calibration"
	help
	  Run the ADC offset self-calibration at init.

endif # AD5940
```

## drivers/sensor/adi/adis16607/Kconfig
```kconfig
# ADIS16607 6-DoF IMU driver
#
# Copyright (c) 2026 Analog Devices Inc.
# SPDX-License-Identifier: Apache-2.0

config ADIS16607
	bool "ADIS16607 6-DoF IMU (accelerometer + gyroscope)"
	default y
	depends on DT_HAS_ADI_ADIS16607_2_ENABLED || \
		DT_HAS_ADI_ADIS16607_3_ENABLED
	select SPI
	help
	  Enable driver for the Analog Devices ADIS16607 family of
	  6-degrees-of-freedom IMUs (+/-40 g accelerometer, selectable
	  gyroscope full scale: +/-450 or +/-2000 deg/s).

	  The device uses an SPI half-duplex protocol that differs from
	  standard ADIS devices.

if ADIS16607

choice ADIS16607_TRIGGER_MODE
	prompt "Trigger mode"
	default ADIS16607_TRIGGER_NONE
	help
	  Select how the driver responds to data-ready interrupts.

config ADIS16607_TRIGGER_NONE
	bool "No trigger"
	help
	  Sensor data is fetched synchronously on demand via sensor_sample_fetch().

config ADIS16607_TRIGGER_GLOBAL_THREAD
	bool "Global system workqueue"
	depends on GPIO
	select ADIS16607_TRIGGER
	help
	  Data-ready interrupt handling runs in the global system workqueue.
	  Lower memory overhead than the own-thread option.

config ADIS16607_TRIGGER_OWN_THREAD
	bool "Dedicated driver thread"
	depends on GPIO
	select ADIS16607_TRIGGER
	help
	  Data-ready interrupt handling runs in a dedicated kernel thread.
	  Provides lower latency at the cost of a thread stack.

endchoice

config ADIS16607_TRIGGER
	bool

config ADIS16607_THREAD_PRIORITY
	int "Interrupt thread priority"
	depends on ADIS16607_TRIGGER_OWN_THREAD
	default 10
	help
	  Priority of the kernel thread used to handle data-ready interrupts.

config ADIS16607_THREAD_STACK_SIZE
	int "Interrupt thread stack size (bytes)"
	depends on ADIS16607_TRIGGER_OWN_THREAD
	default 1024
	help
	  Stack size for the dedicated interrupt-handling thread.

endif # ADIS16607
```

## drivers/sensor/adi/admt4000/Kconfig
```kconfig
# Copyright (c) 2026 Analog Devices, Inc.
#
# SPDX-License-Identifier: Apache-2.0

config ADMT4000
	bool "ADMT4000 True Power-On Multiturn Sensor"
	default y
	depends on DT_HAS_ADI_ADMT4000_ENABLED
	select SPI
	select RTIO_WORKQ if SENSOR_ASYNC_API
	help
	  Enable SPI-based driver for Analog Devices ADMT4000 True Power-On
	  Multiturn Sensor.
```

## drivers/sensor/adi/adt7604/Kconfig
```kconfig
# SPDX-FileCopyrightText: Copyright (c) 2026 Analog Devices, Inc.
# SPDX-License-Identifier: Apache-2.0

config ADT7604
	bool "ADT7604 20-Channel Digital Temperature Sensor"
	default y
	depends on DT_HAS_ADI_ADT7604_ENABLED
	select SPI
	select SPI_RTIO
	select RTIO_WORKQ
	select SENSOR_ASYNC_API
	help
	  Enable driver for Analog Devices ADT7604 20-Channel Digital
	  Temperature Measurement System.

	  The ADT7604 supports multiple sensor types including RTDs,
	  thermocouples, thermistors, diodes, copper trace sensing,
	  and leak detection across 20 configurable channels.
```

## drivers/sensor/adi/adxl313/Kconfig
```kconfig
# Copyright (c) 2026 RAKwireless Technology Limited
# SPDX-License-Identifier: Apache-2.0

config ADXL313
	bool "ADXL313 Three-Axis Accelerometer"
	default y
	depends on DT_HAS_ADI_ADXL313_ENABLED
	select I2C
	help
	  Enable driver for Analog Devices ADXL313 3-axis digital accelerometer.
```

## drivers/sensor/adi/adxl38x/Kconfig
```kconfig
# Copyright (c) 2026 Analog Devices Inc.
#
# SPDX-License-Identifier: Apache-2.0

menu "ADXL38X options"

config ADXL38X
	bool "ADXL380/ADXL382 SPI accelerometer"
	default y
	depends on DT_HAS_ADI_ADXL380_ENABLED || DT_HAS_ADI_ADXL382_ENABLED
	select SPI
	select RTIO_WORKQ if SENSOR_ASYNC_API
	help
	  Enable driver for ADXL380/ADXL382 accelerometers.

if ADXL38X

choice ADXL38X_TRIGGER_MODE
	prompt "Trigger mode"
	default ADXL38X_TRIGGER_NONE
	help
	  Specify the type of triggering used by the driver.

config ADXL38X_TRIGGER_NONE
	bool "No trigger"

config ADXL38X_TRIGGER_GLOBAL_THREAD
	bool "Use global thread"
	depends on GPIO
	select ADXL38X_TRIGGER

config ADXL38X_TRIGGER_OWN_THREAD
	bool "Use own thread"
	depends on GPIO
	select ADXL38X_TRIGGER

endchoice

config ADXL38X_TRIGGER
	bool

config ADXL38X_THREAD_PRIORITY
	int "Thread priority"
	depends on ADXL38X_TRIGGER_OWN_THREAD && ADXL38X_TRIGGER
	default 10
	help
	  Priority of thread used by the driver to handle interrupts.

config ADXL38X_THREAD_STACK_SIZE
	int "Thread stack size"
	depends on ADXL38X_TRIGGER_OWN_THREAD && ADXL38X_TRIGGER
	default 1024
	help
	  Stack size of thread used by the driver to handle interrupts.

config ADXL38X_INIT_PRIORITY
	int "Init priority"
	default SENSOR_INIT_PRIORITY
	help
	  Device initialization priority for ADXL38X.

config ADXL38X_STREAM
	bool "Use FIFO to stream data"
	select ADXL38X_TRIGGER
	depends on SPI_RTIO
	depends on SENSOR_ASYNC_API
	help
	  Use this configuration option to enable streaming sensor data via RTIO.

endif # ADXL38X

endmenu
```

## drivers/sensor/adi/max40109/Kconfig
```kconfig
# AFE to interface with resistive bridge-based pressure sensors

# Copyright (c) 2026 Analog Devices Inc.
# SPDX-License-Identifier: Apache-2.0

menuconfig MAX40109
	bool "MAX40109 Precision Signal Conditioning AFE"
	default y
	depends on DT_HAS_ADI_MAX40109_ENABLED
	select I2C
	help
	  Enable support for the MAX40109 Precision Signal Conditioning AFE.

if MAX40109

config MAX40109_CALIBRATION
	bool "MTP calibration coefficient support"
	default y
	select FPU if CPU_HAS_FPU
	help
	  Enable access to the 20 MTP calibration coefficients (K0-K3, H0-H3,
	  G0-G3, N0-N3 and M0-M3) through SENSOR_ATTR_CALIB_TARGET and the
	  matching devicetree properties, which are applied to the volatile MTP
	  shadow at init.

	  Disable this when the coefficients are already burned into MTP, to
	  drop the floating-point conversion code from the build. The
	  devicetree coefficient properties are then ignored and
	  SENSOR_ATTR_CALIB_TARGET returns -ENOTSUP.

endif # MAX40109
```
