## drivers/sensor/adi/maxm86161/Kconfig
```kconfig
# Copyright 2026 Analog Devices, Inc.
# SPDX-License-Identifier: Apache-2.0

menuconfig MAXM86161
	bool "MAXM86161 ultra-low-power, completely integrated, optical data-acquisition system."
	default y
	depends on DT_HAS_ADI_MAXM86161_ENABLED
	select I2C
	help
	  Enable driver for MAXM86161 optical sensor.

if MAXM86161

choice
	prompt "Trigger mode"
	default MAXM86161_TRIGGER_NONE
	help
	  Specify the type of trigger handling mode used by the driver.

config MAXM86161_TRIGGER_NONE
	bool "No trigger"

config MAXM86161_TRIGGER_GLOBAL_THREAD
	bool "Use global thread"
	depends on $(dt_compat_any_has_prop,$(DT_COMPAT_ADI_MAXM86161),interrupt-gpios)
	select MAXM86161_TRIGGER
	select GPIO

config MAXM86161_TRIGGER_OWN_THREAD
	bool "Use own thread"
	depends on $(dt_compat_any_has_prop,$(DT_COMPAT_ADI_MAXM86161),interrupt-gpios)
	select MAXM86161_TRIGGER
	select GPIO

endchoice

config MAXM86161_TRIGGER
	bool

config MAXM86161_STREAM
	bool "Use FIFO to stream data"
	depends on MAXM86161_TRIGGER_OWN_THREAD
	select SENSOR_ASYNC_API
	select I2C_RTIO
	help
	  Enable sensor streaming with RTIO.

if MAXM86161_STREAM

config MAXM86161_STREAM_CQE_SIZE
	int "Completion Queue size"
	default 128
	help
	  Completion Queue Entry pool allocated for RTIO

config MAXM86161_STREAM_SQE_SIZE
	int "Submission Queue size"
	default 128
	help
	  Submission Queue Entry pool allocated for RTIO

endif # MAXM86161_STREAM

if MAXM86161_TRIGGER_OWN_THREAD

config MAXM86161_THREAD_PRIORITY
	int "Thread priority"
	depends on MAXM86161_TRIGGER_OWN_THREAD && MAXM86161_TRIGGER
	default 10
	help
	  Priority of thread used by the driver to handle interrupts.

config MAXM86161_THREAD_STACK_SIZE
	int "Thread stack size"
	depends on MAXM86161_TRIGGER_OWN_THREAD && MAXM86161_TRIGGER
	default 1024
	help
	  Stack size of thread used by the driver to handle interrupts.

endif # MAXM86161_TRIGGER_OWN_THREAD

endif # MAXM86161
```

## drivers/sensor/ams/ams_as7341/Kconfig
```kconfig
# Copyright (c) 2026 Dotcom IoT LLP
# SPDX-License-Identifier: Apache-2.0

config AMS_AS7341
	bool "AMS AS7341 spectral color sensor driver"
	default y
	depends on DT_HAS_AMS_AS7341_ENABLED
	select I2C
	help
	  Enable driver for the AMS AS7341 11-channel spectral color sensor.
```

## drivers/sensor/ams/tcs34725/Kconfig
```kconfig
# Copyright (c) 2026 Dotcom IoT LLP
# SPDX-License-Identifier: Apache-2.0

config TCS34725
	bool "TCS34725 color sensor"
	depends on DT_HAS_AMS_TCS34725_ENABLED
	select I2C
	default y
	help
	  Enable TCS34725 driver.
```

## drivers/sensor/ams/tmf8801/Kconfig
```kconfig
# Copyright (c) 2026 Dotcom IoT LLP
# SPDX-License-Identifier: Apache-2.0

config TMF8801
	bool "TMF8801 ToF sensor"
	default y
	depends on DT_HAS_AMS_TMF8801_ENABLED
	select I2C
	help
	  Enable TMF8801 driver.
```

## drivers/sensor/ams/tsl2522/Kconfig
```kconfig
# Copyright (c) 2026 Carl Zeiss Meditec AG
# SPDX-License-Identifier: Apache-2.0

config TSL2522
	bool "ams OSRAM TSL2522 ambient light sensing and light flicker detection sensor"
	default y
	depends on DT_HAS_AMS_TSL2522_ENABLED
	select I2C
	select FPU if CPU_HAS_FPU
	help
	  Enable driver for ams OSRAM TSL2522 ambient light sensing and light flicker
	  detection sensor.

if TSL2522

config TSL2522_TRIGGER
	bool

choice
	prompt "Trigger mode"
	default TSL2522_TRIGGER_NONE
	help
	  Specify the type of triggering to be used by the driver.

config TSL2522_TRIGGER_NONE
	bool "No trigger"

config TSL2522_TRIGGER_GLOBAL_THREAD
	bool "Use global thread"
	depends on GPIO
	depends on $(dt_compat_any_has_prop,$(DT_COMPAT_AMS_TSL2522),int-gpios)
	select TSL2522_TRIGGER

config TSL2522_TRIGGER_OWN_THREAD
	bool "Use own thread"
	depends on GPIO
	depends on $(dt_compat_any_has_prop,$(DT_COMPAT_AMS_TSL2522),int-gpios)
	select TSL2522_TRIGGER

endchoice

config TSL2522_THREAD_PRIORITY
	int "Thread priority"
	depends on TSL2522_TRIGGER_OWN_THREAD
	default 10
	help
	  Priority of thread used by the driver to handle interrupts.

config TSL2522_THREAD_STACK_SIZE
	int "Thread stack size"
	depends on TSL2522_TRIGGER_OWN_THREAD
	default 1024
	help
	  Stack size of thread used by the driver to handle interrupts.

endif # TSL2522
```

## drivers/sensor/asahi_kasei/ak09940a/Kconfig
```kconfig
# SPDX-FileCopyrightText: Copyright The Zephyr Project Contributors
# SPDX-License-Identifier: Apache-2.0

config AK09940A
	bool "AK09940A magnetometer"
	default y
	depends on DT_HAS_ASAHI_KASEI_AK09940A_ENABLED
	select I2C if $(dt_compat_on_bus,$(DT_COMPAT_ASAHI_KASEI_AK09940A),i2c)
	select SPI if $(dt_compat_on_bus,$(DT_COMPAT_ASAHI_KASEI_AK09940A),spi)
	select GPIO if $(dt_compat_any_has_prop,$(DT_COMPAT_ASAHI_KASEI_AK09940A),reset-gpios)
	select I2C_RTIO if SENSOR_ASYNC_API && I2C
	select SPI_RTIO if SENSOR_ASYNC_API && SPI
	select RTIO_OP_DELAY if SENSOR_ASYNC_API
	help
	  Enable driver for the Asahi Kasei AK09940A 3-axis magnetometer.

config EMUL_AK09940A
	bool "Emulator for AK09940A"
	default y
	depends on AK09940A
	depends on EMUL
	help
	  Enable the hardware emulator for the AK09940A. Doing so allows exercising
	  sensor APIs for this magnetometer in native_sim and qemu.
```

## drivers/sensor/bosch/bma400/Kconfig
```kconfig
# BMA400 3-axis accelerometer config options
#
# Copyright (c) 2026 Luca Gessi
#
# SPDX-License-Identifier: Apache-2.0

menuconfig BMA400
	bool "BMA400 3-axis acceleration sensor"
	default y
	depends on DT_HAS_BOSCH_BMA400_ENABLED
	select SENSOR_ASYNC_API
	select SPI if $(dt_compat_on_bus,$(DT_COMPAT_BOSCH_BMA400),spi)
	select SPI_RTIO if $(dt_compat_on_bus,$(DT_COMPAT_BOSCH_BMA400),spi)
	help
	  Driver for Bosch BMA400

if BMA400

config BMA400_STREAM
	bool "Stream requests"
	depends on GPIO
	depends on $(dt_compat_any_has_prop,$(DT_COMPAT_BOSCH_BMA400),int1-gpios)
	help
	  Use this config option to enable streaming sensor data via RTIO subsystem.

config BMA400_WAKEUP
	bool "Auto wakeup and lowpower based on activity detection"
	depends on GPIO
	depends on $(dt_compat_any_has_prop,$(DT_COMPAT_BOSCH_BMA400),int1-gpios)
	help
	  Auto wakeup and auto lowpower based on activity detection.

endif # BMA400
```

## drivers/sensor/bosch/bmi260/Kconfig
```kconfig
# BMI260 6 Axis IMU configuration

# Copyright (c) 2021 Bosch Sensortec GmbH
# Copyright (c) 2022 Nordic Semiconductor ASA
# Copyright (c) 2026 Shreyas Acharya
# SPDX-License-Identifier: Apache-2.0

menuconfig BMI260
	bool "BMI260 Inertial measurement unit"
	default y
	depends on DT_HAS_BOSCH_BMI260_ENABLED
	select I2C if $(dt_compat_on_bus,$(DT_COMPAT_BOSCH_BMI260),i2c)
	select SPI if $(dt_compat_on_bus,$(DT_COMPAT_BOSCH_BMI260),spi)
	help
	  Enable driver for the BMI260 I2C or SPI based IMU sensor.

if BMI260

config BMI260_BUS_I2C
	bool
	default y
	depends on $(dt_compat_on_bus,$(DT_COMPAT_BOSCH_BMI260),i2c)

config BMI260_BUS_SPI
	bool
	default y
	depends on $(dt_compat_on_bus,$(DT_COMPAT_BOSCH_BMI260),spi)

config BMI260_LOW_POWER_MODE
	bool "Force low-power (power-optimized) filter mode at all ODRs"
	help
	  When set, the accelerometer and gyroscope always use the
	  power-optimized filter mode (acc_filter_perf=0, gyr_filter_perf=0,
	  gyr_noise_perf=0) regardless of ODR. By default the driver switches
	  to performance mode at ODR >= 100 Hz. Enabling this saves power at
	  the cost of higher noise (no digital filtering / OSR).

endif # BMI260
```

## drivers/sensor/cfsensor/Kconfig
```kconfig
# Copyright (c) 2026 Kristian Angelov
# SPDX-License-Identifier: Apache-2.0

# zephyr-keep-sorted-start
source "drivers/sensor/cfsensor/xgzp68xxd/Kconfig"
# zephyr-keep-sorted-stop
```

## drivers/sensor/diodes/Kconfig
```kconfig
# Copyright The Zephyr Project Contributors
# SPDX-License-Identifier: Apache-2.0

# zephyr-keep-sorted-start
source "drivers/sensor/diodes/ap33772s/Kconfig"
# zephyr-keep-sorted-stop
```

## drivers/sensor/diodes/ap33772s/Kconfig
```kconfig
# Copyright The Zephyr Project Contributors
# SPDX-License-Identifier: Apache-2.0

config AP33772S
	bool "Diodes AP33772S USB PD3.1 EPR sink controller sensor driver"
	default y
	depends on DT_HAS_DIODES_AP33772S_ENABLED
	select I2C
	select GPIO
	help
	  Enable driver for the Diodes Incorporated AP33772S I2C USB PD3.1
	  EPR sink controller. Exposes output voltage, current, and die
	  temperature via the sensor API, and allows PDO negotiation via
	  sensor attributes.
```
