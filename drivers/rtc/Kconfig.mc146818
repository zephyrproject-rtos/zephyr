## drivers/rtc/Kconfig.mc146818
```kconfig
# Intel SoC RTC configuration options

# Copyright (c) 2023 Intel Corporation
# SPDX-License-Identifier: Apache-2.0

config RTC_MOTOROLA_MC146818
	bool "RTC driver for x86 CMOS/RTC clock"
	default y if !COUNTER
	select MFD
	depends on DT_HAS_MOTOROLA_MC146818_ENABLED
```

## drivers/rtc/Kconfig.mchp
```kconfig
# Copyright (c) 2025-2026 Microchip Technology Inc.
# SPDX-License-Identifier: Apache-2.0

config RTC_MCHP_G1
	bool "Microchip RTC G1 driver"
	default y
	depends on DT_HAS_MICROCHIP_RTC_G1_ENABLED
	help
	  Enable RTC driver for Microchip G1.

config RTC_MCHP_G2
	bool "Microchip RTC G2 driver"
	default y
	depends on DT_HAS_MICROCHIP_RTC_G2_ENABLED
	select SYSCON
	help
	  Microchip Real-Time Clock (RTC) G2 driver used on SAM SoC series.

config RTC_MCHP_MSS
	bool "Microchip RTC MSS driver"
	default y
	depends on DT_HAS_MICROCHIP_RTC_MSS_ENABLED
	help
	  Enable RTC driver for Microchip MSS.

config RTC_MCHP_SUPPORTS_DUAL_ALARM
	bool
	default y
	depends on RTC_MCHP_G1 && !SOC_FAMILY_MICROCHIP_PIC32CM_JH
	help
	  RTC supports two alarms. PIC32CM JH only supports one alarm.
```

## drivers/rtc/Kconfig.mchp_xec
```kconfig
# Microchip XEC PWM configuration options

# Copyright (c) 2026 Microchip Technology Inc.
# SPDX-License-Identifier: Apache-2.0

config RTC_XEC
	bool "Microchip XEC RTC"
	default y
	depends on DT_HAS_MICROCHIP_XEC_RTC_ENABLED
	help
		Enable driver to utilize RTC on the Microchip XEC IP block

config RTC_XEC_DATA_MODE_BCD
	bool "Select data mode"
	default n
	depends on DT_HAS_MICROCHIP_XEC_RTC_ENABLED
	help
		Select binary or BCD representation of time

config RTC_XEC_HOUR_FORMAT_24
	bool "Select hour format"
	default y
	depends on DT_HAS_MICROCHIP_XEC_RTC_ENABLED
	help
		Select hour format 24/12 representation of time
```

## drivers/rtc/Kconfig.mcp7940n
```kconfig
# Copyright (c) 2026 Plentify (Pty) Ltd
# SPDX-License-Identifier: Apache-2.0

config RTC_MICROCHIP_MCP7940N
	bool "Microchip MCP7940N RTC"
	default y
	depends on DT_HAS_MICROCHIP_MCP7940N_ENABLED
	select I2C
	help
	  Enable RTC driver based on Microchip MCP7940N I2C device.
```

## drivers/rtc/Kconfig.mcux_rtc
```kconfig
# Kconfig - MCUXpresso SDK RTC
#
# Copyright (c) 2018, blik GmbH
#
# SPDX-License-Identifier: Apache-2.0
#

menuconfig RTC_MCUX
	bool "MCUX RTC driver"
	depends on RTC && HAS_MCUX_RTC
	help
	  Enable support for mcux rtc driver.
```

## drivers/rtc/Kconfig.nct
```kconfig
# NCT RTC Driver configuration options

# Copyright (c) 2024 Nuvoton Technology Corporation.
# SPDX-License-Identifier: Apache-2.0

config RTC_NCT
	bool "Nuvoton NCT RTC driver"
	depends on DT_HAS_NUVOTON_NCT_RTC_ENABLED
	help
	  This option enables the RTC driver for Nuvoton NCT family of
	  processors.
	  Say y if you wish to enable NCT RTC.
```

## drivers/rtc/Kconfig.npcm
```kconfig
# NPCM RTC Driver configuration options

# Copyright (c) 2024 Nuvoton Technology Corporation.
# SPDX-License-Identifier: Apache-2.0

config RTC_NPCM
	bool "Nuvoton NPCM RTC driver"
	depends on DT_HAS_NUVOTON_NPCM_RTC_ENABLED
	help
	  This option enables the RTC driver for Nuvoton NPCM family of
	  processors.
	  Say y if you wish to enable NPCM RTC.
```

## drivers/rtc/Kconfig.numaker
```kconfig
# NUMAKER RTC Driver configuration options

# Copyright (c) 2024 Nuvoton Technology Corporation.
# SPDX-License-Identifier: Apache-2.0

config RTC_NUMAKER
	bool "Nuvoton NuMaker MCU RTC driver"
	default y
	select HAS_NUMAKER_RTC
	depends on DT_HAS_NUVOTON_NUMAKER_RTC_ENABLED
	help
	  This option enables the RTC driver for Nuvoton NuMaker family of
	  processors.
	  Say y if you wish to enable NuMaker RTC.
```

## drivers/rtc/Kconfig.nxp_irtc
```kconfig
# Copyright 2024 NXP
# SPDX-License-Identifier: Apache-2.0

config RTC_NXP_IRTC
	bool "NXP Independent Real Time Clock driver"
	default y
	depends on DT_HAS_NXP_IRTC_ENABLED
```

## drivers/rtc/Kconfig.nxp_rtc
```kconfig
# Copyright 2025 NXP
# SPDX-License-Identifier: Apache-2.0

config RTC_NXP_RTC
	bool "NXP Real Time Clock driver"
	default y
	depends on DT_HAS_NXP_RTC_ENABLED
```

## drivers/rtc/Kconfig.nxp_rtc_analog
```kconfig
# Copyright 2026 NXP
# SPDX-License-Identifier: Apache-2.0

config RTC_NXP_RTC_ANALOG
	bool "NXP RTC Analog driver"
	default y
	depends on DT_HAS_NXP_RTC_ANALOG_ENABLED
	help
	  Enable the NXP RTC Analog driver.
	  This RTC module supports 3 independent alarms,
	  BCD time/date mode, and hundredths-of-second resolution.
```

## drivers/rtc/Kconfig.pcf2123
```kconfig
# Copyright (c) 2025 Lukas Gunnarsson <lukasgunnarsson@protonmail.com>
# SPDX-License-Identifier: Apache-2.0

config RTC_PCF2123
	bool "NXP PCF2123 Real-Time Clock driver"
	default y
	depends on DT_HAS_NXP_PCF2123_ENABLED
	select SPI
	help
	  Enable NXP PCF2123 SPI RTC driver.
```

## drivers/rtc/Kconfig.pcf85063a
```kconfig
# Copyright (c) 2025 Fabian Blatz <fabianblatz@gmail.com>
# SPDX-License-Identifier: Apache-2.0

config RTC_PCF85063A
	bool "NXP PCF85063A Real-Time Clock driver"
	default y
	depends on DT_HAS_NXP_PCF85063A_ENABLED
	select I2C
	help
	  Enable NXP PCF85063A I2C driver.
```

## drivers/rtc/Kconfig.pcf8523
```kconfig
# NXP PCF8523 RTC

# Copyright (c) 2019-2023 Henrik Brix Andersen <henrik@brixandersen.dk>
# SPDX-License-Identifier: Apache-2.0

config RTC_PCF8523
	bool "NXP PCF8523 RTC driver"
	default y
	depends on DT_HAS_NXP_PCF8523_ENABLED
	select I2C
	help
	  Enable the NXP PCF8523 RTC driver.

if RTC_PCF8523

choice RTC_PCF8523_OFFSET_MODE
	prompt "Offset mode"
	default RTC_PCF8523_OFFSET_MODE_SLOW
	depends on RTC_CALIBRATION
	help
	  Offset register mode selection.

config RTC_PCF8523_OFFSET_MODE_SLOW
	bool "Slow"
	help
	  Offset correction is made once per two hours and then correction pulses are applied once
	  per minute until the programmed correction values have been implemented (MODE = 0).

config RTC_PCF8523_OFFSET_MODE_FAST
	bool "Fast"
	help
	  Offset correction is made once per minute and then correction pulses are applied once per
	  second up to a maximum of 60 pulses. When correction values greater than 60 pulses are
	  used, additional correction pulses are made in the 59th second (MODE = 1).

endchoice

if RTC_ALARM || RTC_UPDATE

config RTC_PCF8523_THREAD_STACK_SIZE
	int "Stack size for the PCF8523 interrupt thread"
	default 512
	help
	  Size of the stack used for the thread handling interrupts and dispatching callbacks.

config RTC_PCF8523_THREAD_PRIO
	int "Priority for the PCF8523 interrupt thread"
	default 0
	help
	  Priority level for the thread handling interrupts and dispatching callbacks.

endif # RTC_ALARM || RTC_UPDATE

endif # RTC_PCF8523
```

## drivers/rtc/Kconfig.pcf85363a
```kconfig
# NXP PCF85363A RTC

# Copyright (c) 2025 Byteflies

config RTC_PCF85363A
    bool "NXP PCF85363A RTC driver"
    default y
    depends on DT_HAS_NXP_PCF85363A_ENABLED
    select I2C
    help
      Enable the NXP PCF85363A RTC driver.
```

## drivers/rtc/Kconfig.pcf8563
```kconfig
# NXP PCF8523 RTC

# Copyright (c) 2023 Alvaro Garcia Gomez <maxpowel@gmail.com>
# SPDX-License-Identifier: Apache-2.0

config RTC_PCF8563
	bool "NXP PCF8563 RTC driver"
	default y
	depends on DT_HAS_NXP_PCF8563_ENABLED
	select I2C
	help
	  Enable the NXP PCF8563 RTC driver.
```

## drivers/rtc/Kconfig.qmsi
```kconfig
config RTC_QMSI
	bool "QMSI RTC Driver"
	depends on QMSI
	help
	  Build QMSI RTC driver.

if RTC_QMSI

config RTC_QMSI_API_REENTRANCY
	bool "RTC shim driver API reentrancy"
	help
	  Enable support for RTC shim driver API reentrancy.

config RTC_PRESCALER
	int "Prescaler size"
	default 1
	help
	  RTC prescaler used to determine ticks per second

endif
```

## drivers/rtc/Kconfig.renesas_ra
```kconfig
# Renesas RA Family

# Copyright (c) 2025 Renesas Electronics Corporation
# SPDX-License-Identifier: Apache-2.0

config RTC_RENESAS_RA
	bool "Renesas RA RTC"
	default y
	depends on DT_HAS_RENESAS_RA_RTC_ENABLED
	select USE_RA_FSP_RTC
	help
	  Enable Renesas RA RTC Driver.

config RTC_RENESAS_RA_ALWAYS_SET_CLOCK_SOURCE
	bool "Force RTC clock source setup during init"
	depends on RTC_RENESAS_RA
	default y if TEST
	help
	  Always configure the RTC clock source during initialization, regardless of reset type.
	  This is intended for testing only where warm‑start detection is unreliable.
	  Do not use in production, as it may unnecessarily reinitialize the RTC.
```

## drivers/rtc/Kconfig.rpi_pico
```kconfig
# Copyright (c) 2023 Andrew Featherstone
# SPDX-License-Identifier: Apache-2.0

config RTC_RPI_PICO
	bool "Raspberry Pi Pico RTC driver"
	default y
	depends on DT_HAS_RASPBERRYPI_PICO_RTC_ENABLED
	select PICOSDK_USE_RTC
	depends on RESET
```

## drivers/rtc/Kconfig.rtc_stm32
```kconfig
# Copyright (c) 2020 Paratronic
# SPDX-License-Identifier: Apache-2.0

menuconfig RTC_STM32
	bool "STM32 RTC Driver"
	depends on SOC_FAMILY_STM32 && !COUNTER_RTC_STM32
	select USE_STM32_LL_RTC
	help
	  Build RTC driver for STM32 SoCs

choice RTC_STM32_CLOCK_SRC
	bool "RTC clock source"
	depends on RTC_STM32

config RTC_STM32_CLOCK_LSI
	bool "LSI"
	help
	  Use LSI as RTC clock

config RTC_STM32_CLOCK_LSE
	bool "LSE"
	help
	  Use LSE as RTC clock

endchoice #RTC_STM32_CLOCK_SRC
```

## drivers/rtc/Kconfig.rts5912
```kconfig
# Copyright (c) 2025, Realtek, SIBG-SD7
# SPDX-License-Identifier: Apache-2.0

config RTC_RTS5912
	bool "Realtek RTS5912 rtc driver"
	default y
	depends on CLOCK_CONTROL
	depends on DT_HAS_REALTEK_RTS5912_RTC_ENABLED
	help
	  Enable support for Realtek RTC driver.
```

## drivers/rtc/Kconfig.rv3028
```kconfig
# Copyright (c) 2024 ANITRA system s.r.o.
# Copyright (c) 2026 Janez Ugovsek <janez@ugovsek.info>
# SPDX-License-Identifier: Apache-2.0

config RTC_RV3028
	bool "Micro Crystal RV3028 I2C extreme low power RTC driver"
	default y
	depends on DT_HAS_MICROCRYSTAL_RV3028_RTC_ENABLED
	depends on DT_HAS_MICROCRYSTAL_RV3028_ENABLED
	select MFD
	help
	  Enable the Micro Crystal RV3028 I2C RTC driver.
	  This provides time, alarm, update event, and calibration support
	  through the RTC API, depending on the enabled RTC API options.
```

## drivers/rtc/Kconfig.rv3032
```kconfig
# Copyright (c) 2025 Dipak Shetty
# SPDX-License-Identifier: Apache-2.0

config RTC_RV3032
	bool "Micro Crystal RV3032 Real-Time Clock Module"
	default y
	depends on DT_HAS_MICROCRYSTAL_RV3032_ENABLED
	select MFD_RV3032
	help
	  Enable the Micro Crystal RV3032 I2C RTC driver.
```

## drivers/rtc/Kconfig.rv8263
```kconfig
# SPDX-License-Identifier: Apache-2.0
# Copyright (c) 2024 Daniel Kampert
# Author: Daniel Kampert <DanielKampert@Kampis-Elektroecke.de>

config RTC_RV8263
	bool "Micro Crystal RV-8263-C8 RTC driver"
	default y
	depends on DT_HAS_MICROCRYSTAL_RV_8263_C8_ENABLED
	select I2C
	help
		Micro Crystal RV-8263-C8 RTC driver.
```

## drivers/rtc/Kconfig.rv8803
```kconfig
# Copyright (c) 2024 Marcin Lyda <elektromarcin@gmail.com>
# SPDX-License-Identifier: Apache-2.0

config RTC_RV8803
	bool "Micro Crystal RV8803 Extreme Low Power Real-Time Clock Module driver"
	default y
	depends on DT_HAS_MICROCRYSTAL_RV8803_ENABLED
	select I2C
	help
	    Enable Micro Crystal RV8803 I2C RTC driver.
```
