## drivers/rtc/Kconfig.rx8130ce
```kconfig
#Copyright (c) 2025 Måns Ansgariusson <mansgariusson@gmail.com>
#
#SPDX-License-Identifier: Apache-2.0

config RTC_RX8130CE
	bool "EPSON rx8130ce rtc driver"
	default y
	depends on DT_HAS_EPSON_RX8130CE_RTC_ENABLED
	select I2C
	help
	  Enable RTC driver for the Epson rx8130ce rtc
```

## drivers/rtc/Kconfig.sam
```kconfig
# Copyright (c) 2023 Bjarki Arge Andreasen
# SPDX-License-Identifier: Apache-2.0

config RTC_ATMEL_SAM
	bool "Atmel SAM RTC driver"
	default y
	depends on DT_HAS_ATMEL_SAM_RTC_ENABLED
	help
	  Atmel Real-Time Clock (RTC) driver used on SAM SoC series.
```

## drivers/rtc/Kconfig.sam0
```kconfig
# Copyright (c) 2024-2025 Gerson Fernando Budke <nandojve@gmail.com>
# SPDX-License-Identifier: Apache-2.0

config RTC_ATMEL_SAM0
	bool "Atmel SAM RTC driver"
	default y
	depends on DT_HAS_ATMEL_SAM0_RTC_ENABLED \
		&& !$(dt_nodelabel_bool_prop,rtc,systimer)
	help
	  Atmel Real-Time Clock (RTC) driver used on SAM0 SoC series.
```

## drivers/rtc/Kconfig.sf32lb
```kconfig
# Copyright (c) 2025 Qingsong Gou <gouqs@hotmail.com>
# SPDX-License-Identifier: Apache-2.0

config RTC_SF32LB
	bool "RTC driver for SF32LB family of MCUs"
	default y
	depends on DT_HAS_SIFLI_SF32LB_RTC_ENABLED
	help
	  Enable RTC driver for SF32LB series of MCUs
```

## drivers/rtc/Kconfig.siwx91x
```kconfig
# Copyright (c) 2025 Silicon Laboratories Inc.
# SPDX-License-Identifier: Apache-2.0

config RTC_SILABS_SIWX91X
	bool "Silabs siwx91x RTC driver"
	default y
	depends on DT_HAS_SILABS_SIWX91X_RTC_ENABLED
	depends on CLOCK_CONTROL
	help
	  Build the RTC driver for the Silabs SIWX91X SoC (Calendar
	  hardware block as described in the reference manual).
```

## drivers/rtc/Kconfig.smartbond
```kconfig
# Copyright (c) 2023 Renesas Electronics Corporation
# SPDX-License-Identifier: Apache-2.0

config RTC_SMARTBOND
	bool "Smartbond RTC driver"
	depends on DT_HAS_RENESAS_SMARTBOND_RTC_ENABLED
	default y
	help
	  Build RTC driver for Smartbond SoCs.
```

## drivers/rtc/Kconfig.stm32
```kconfig
# Copyright 2023 Prevas A/S
# SPDX-License-Identifier: Apache-2.0

config RTC_STM32
	bool "STM32 RTC driver"
	default y if !COUNTER
	depends on DT_HAS_ST_STM32_RTC_ENABLED && !SOC_SERIES_STM32F1X
	select USE_STM32_LL_RTC
	help
	  Build RTC driver for STM32 SoCs, excluding STM32F1 series.
```

## drivers/rtc/Kconfig.stm32_rtc
```kconfig
# Kconfig - STM32 RTC configuration options
#
# Copyright (c) 2018 Workaround GmbH
# Copyright (c) 2018 Allterco Robotics
#
# SPDX-License-Identifier: Apache-2.0
#

config RTC_STM32
	bool "STM32 RTC Driver"
	depends on SOC_FAMILY_STM32
	select USE_STM32_LL_RTC
	select USE_STM32_LL_PWR
	select USE_STM32_LL_RCC
	select USE_STM32_LL_EXTI
	select NEWLIB_LIBC
	help
	  Build RTC driver for STM32 SoCs. Tested on STM32 F3, F4, L4 series.

choice RTC_STM32_CLOCK_SRC
	bool "RTC clock source"
	depends on RTC_STM32

config RTC_STM32_CLOCK_LSI
	bool "LSI"
	help
	  Use LSI as RTC clock

config RTC_STM32_CLOCK_LSE
	bool "LSE"
	help
	  Use LSE as RTC clock

endchoice #RTC_STM32_CLOCK_SRC

choice RTC_STM32_LSE_DRIVE
	prompt "LSE oscillator drive capability"
	depends on RTC_STM32_CLOCK_LSE

config RTC_STM32_LSE_DRIVE_LOW
	bool "Low"
	help
	  Xtal mode lower driving capability

config RTC_STM32_LSE_DRIVE_MEDIUMLOW
	bool "Medium Low"
	help
	  Xtal mode medium low driving capability

config RTC_STM32_LSE_DRIVE_MEDIUMHIGH
	bool "Medium High"
	help
	  Xtal mode medium high driving capability

config RTC_STM32_LSE_DRIVE_HIGH
	bool "High"
	help
	  Xtal mode higher driving capability

endchoice

config RTC_STM32_LSE_DRIVE_STRENGTH
	hex
	default 0x00000000 if RTC_STM32_LSE_DRIVE_LOW
	default 0x00000008 if RTC_STM32_LSE_DRIVE_MEDIUMLOW
	default 0x00000010 if RTC_STM32_LSE_DRIVE_MEDIUMHIGH
	default 0x00000018 if RTC_STM32_LSE_DRIVE_HIGH
```

## drivers/rtc/Kconfig.ti
```kconfig
# Copyright 2024 Linumiz
# SPDX-License-Identifier: Apache-2.0

config RTC_TI
	bool "Texas Instruments Real Time Clock driver"
	default y
	depends on DT_HAS_TI_RTC_ENABLED
```

## drivers/rtc/Kconfig.xlnx
```kconfig
# Copyright (c) 2025 Advanced Micro Devices, Inc. (AMD)
# SPDX-License-Identifier: Apache-2.0

config RTC_XLNX
	bool "XLNX RTC driver"
	default y
	depends on DT_HAS_XLNX_ZYNQMP_RTC_ENABLED
	help
	  Enable the XILINX RTC driver
```

## drivers/rtc/Kconfig.xmc4xxx
```kconfig
# Copyright 2023 Andriy Gelman
# SPDX-License-Identifier: Apache-2.0

config RTC_XMC4XXX
	bool "XMC4xxx RTC driver"
	default y
	depends on DT_HAS_INFINEON_XMC4XXX_RTC_ENABLED
	help
	  Build RTC driver for XMC4xxx SoCs.
```

## drivers/rtio/Kconfig
```kconfig
# Kconfig - rtio configuration options

#
# Copyright (c) 2019 Tom Burdick <tom.burdick@electromatic.us>
#
# SPDX-License-Identifier: Apache-2.0
#

menuconfig RTIO
	bool "RTIO Drivers"
	select NET_BUF
	help
	  Include rtio drivers in system config

if RTIO

module = RTIO
module-str = rtio
source "subsys/logging/Kconfig.template.log_config"

config RTIO_INIT_PRIORITY
	int "RTIO init priority"
	default 90
	help
	  RTIO initialization priority.

config RTIO_CONTEXT
	# Private option; will be selected by the drivers if
	# this feature is required.
	bool

config RTIO_RAMP
	bool "RTIO ramp driver"
	select RTIO_CONTEXT
	help
	  RTIO ramp driver

endif # RTIO
```

## drivers/saej2716/Kconfig
```kconfig
# Copyright 2025 NXP
# SPDX-License-Identifier: Apache-2.0

menuconfig SAEJ2716
	bool "SAEJ2716 Single Edge Nibble Transmission (SENT)"
	help
	  Enable SAEJ2716 Driver Configuration

if SAEJ2716

module = SAEJ2716
module-str = saej2716
source "subsys/logging/Kconfig.template.log_config"

config SAEJ2716_INIT_PRIORITY
	int "SAEJ2716 driver init priority"
	default KERNEL_INIT_PRIORITY_DEVICE
	help
	  SAEJ2716 driver device initialization priority.

source "drivers/saej2716/Kconfig.nxp_s32"

endif # SAEJ2716
```

## drivers/saej2716/Kconfig.nxp_s32
```kconfig
# Copyright 2025 NXP
# SPDX-License-Identifier: Apache-2.0

config SAEJ2716_NXP_S32
	bool "NXP S32 SAEJ2716 driver"
	default y
	depends on DT_HAS_NXP_S32_SAEJ2716_ENABLED
	help
	  Enable support for NXP S32 SAEJ2716 driver.
```

## drivers/satellite/Kconfig
```kconfig
# Satellite drivers configuration options

# Copyright (c) 2022 Kickmaker
# SPDX-License-Identifier: Apache-2.0

menuconfig SATELLITE
	bool "Satellite Drivers"
	select EXPERIMENTAL

if SATELLITE

module = SATELLITE
module-dep = LOG
module-str = Log level for Satellite driver
module-help = Sets log level for Satellite Device Drivers.
source "subsys/logging/Kconfig.template.log_config"

config SATELLITE_INIT_PRIORITY
	int "Satellite driver init priority"
	default 90
	help
	  Satellite device driver initialization priority.

source "drivers/satellite/Kconfig.kineis-kim1"

endif # SATELLITE
```

## drivers/satellite/Kconfig.kineis-kim1
```kconfig
# Copyright (c) 2022 Kickmaker
# SPDX-License-Identifier: Apache-2.0

menuconfig SATELLITE_KIM1
	bool "Kineis KIM1 module support"
	select MODEM
	select MODEM_CONTEXT
	select MODEM_CMD_HANDLER
	select MODEM_IFACE_UART
	select REQUIRES_FULL_LIBC
	help
	  Enable Kineis KIM1 module driver. It supports module
	  KIM1.3 revision based on UART communication with fixed
	  baudrate support (9600bps).

if SATELLITE_KIM1

config SATELLITE_KINEIS_KIM1_RX_STACK_SIZE
	int "Stack size for the Kineis driver RX thread"
	default 512
	help
	  This stack is used by the Kineis KIM1 RX thread.

config SATELLITE_KINEIS_KIM1_RX_THREAD_PRIORITY
	int "Priority of RX thread"
	default 6
	help
	  Priority of thread used for processing RX data.

config SATELLITE_KINEIS_KIM1_WORKQ_STACK_SIZE
	int "Stack size for the KIM1 driver work queue"
	default 1024
	help
	  This stack is used by the work queue to send pool of data
	  on with custom retries, letting the rx thread continue
	  processing data.

config SATELLITE_KINEIS_KIM1_WORKQ_THREAD_PRIORITY
	int "Priority of work queue thread"
	default 7
	help
	  Priority of thread used for processing driver work queue items.

config SATELLITE_KINEIS_KIM1_MDM_RING_BUF_SIZE
	int "Modem ring buffer size"
	default 80
	help
	  Ring buffer size used by modem UART interface handler.

config SATELLITE_KINEIS_KIM1_MDM_RX_BUF_COUNT
	int "Modem RX buffer count"
	default 4
	help
	  Number of preallocated RX buffers used by modem command handler.

config SATELLITE_KINEIS_KIM1_MDM_RX_BUF_SIZE
	int "Modem RX buffer size"
	default 32
	help
	  Size of preallocated RX buffers used by modem command handler.

config SATELLITE_KINEIS_KIM1_RESET_TIMEOUT
	int "Reset timeout"
	default 3000
	help
	  How long to wait for device to become ready after start or reset has been
	  sent. If PGOOD pin has been enabled, it waits for it with the same timeout value.

endif # SATELLITE_KINEIS_KIM1
```

## drivers/sd_dev/Kconfig
```kconfig
# SPDX-FileCopyrightText: 2026 NXP
# SPDX-License-Identifier: Apache-2.0

menuconfig SD_DEV_DRIVERS
	bool "SD Device Drivers"
	default y
	depends on SD_DEV
	help
	Enable SDIO/MMC device-side driver implementations.

if SD_DEV_DRIVERS

source "drivers/sd_dev/rw6xx/Kconfig"

endif # SD_DEV_DRIVERS
```

## drivers/sd_dev/rw6xx/Kconfig
```kconfig
# SPDX-FileCopyrightText: 2026 NXP
# SPDX-License-Identifier: Apache-2.0

config SD_DEV_RW6XX_SDIO
	bool "NXP RW6xx SDIO Device HAL"
	depends on SD_DEV
	select SDIO_DEV
	help
	Enable SDIO Device-side HAL for NXP RW6xx.
```

## drivers/sdhc/Kconfig
```kconfig
# Copyright 2022 NXP
# SPDX-License-Identifier: Apache-2.0

menuconfig SDHC
	bool "Secure Digital High Capacity (SDHC) drivers"
	help
	  Include drivers for SD host controller

if SDHC

source "drivers/sdhc/Kconfig.imx"
source "drivers/sdhc/Kconfig.spi"
source "drivers/sdhc/Kconfig.mcux_sdif"

config SDHC_INIT_PRIORITY
	int "SDHC driver init priority"
	default 85
	help
	  SDHC driver system init priority

config SDHC_BUFFER_ALIGNMENT
	int
	default 1
	help
	  Some SD host controllers require alignment of their data buffers
	  in order to DMA to work correctly. Devices should change default of
	  this value if they require alignment. This represents the alignment
	  of buffers required in bytes

config SDHC_SUPPORTS_UHS
	bool
	help
	  Selected by host controller driver if UHS support is present. required
	  to enable UHS portion of protocol stack.

config SDHC_SUPPORTS_SPI_MODE
	bool
	help
	  Selected by host controller driver if SPI mode support is required.
	  Enables SPI protocol in SD protocol stack

config SDHC_SUPPORTS_NATIVE_MODE
	bool
	help
	  Selected by host controller driver if native SD mode support is
	  required. Enables native protocol in SD protocol stack.

module = SDHC
module-str = sdhc
source "subsys/logging/Kconfig.template.log_config"


endif # SDHC
```

## drivers/sdhc/Kconfig.ambiq
```kconfig
# Copyright (c) 2025 Ambiq Micro Inc.
# SPDX-License-Identifier: Apache-2.0

config SDHC_AMBIQ
	bool "Ambiq SDHC driver"
	default y
	depends on DT_HAS_AMBIQ_SDIO_ENABLED
	select AMBIQ_HAL
	select AMBIQ_HAL_USE_SDIO
	select PINCTRL
	select GPIO
	select SDHC_SUPPORTS_NATIVE_MODE
	help
	  This option enables the SDHC driver for Ambiq Apollo family.

if SDHC_AMBIQ

config AMBIQ_SDIO_ASYNC
	bool "Ambiq SDIO Async Mode"
	default y
	depends on DT_HAS_AMBIQ_SDIO_ENABLED
	help
	  This option enables Ambiq SDIO Async Mode.

config SDHC_BUFFER_ALIGNMENT
	default 32 if DCACHE
	default 16
	help
	  SDHC buffer should be 32bytes aligned when placed in cachable region.

endif
```

## drivers/sdhc/Kconfig.ameba
```kconfig
# Copyright (c) 2026 Realtek Semiconductor Corp.
# SPDX-License-Identifier: Apache-2.0

config SDHC_AMEBA
	bool "AMEBA SD Host Controller"
	default y
	depends on DT_HAS_REALTEK_AMEBA_SDHOST_ENABLED
	select PINCTRL
	select GPIO
	select SDHC_SUPPORTS_NATIVE_MODE
	help
	  Enables the Realtek Ameba SD Host controller driver

if SDHC_AMEBA

config SDHC_BUFFER_ALIGNMENT
	default 32 if DCACHE
	default 4
endif
```

## drivers/sdhc/Kconfig.bcm2835
```kconfig
# Copyright (c) 2026 Jonathan Elliot Peace <jep@alphabetiq.com>
# SPDX-License-Identifier: Apache-2.0

config BCM2835_SDHC
	bool "BCM283x Arasan SDHCI host controller"
	default y
	depends on DT_HAS_BRCM_BCM2835_SDHCI_ENABLED
	select SDHC_SUPPORTS_NATIVE_MODE
	# Data path runs through the external BCM2835 DMA engine via DREQ;
	# the Arasan core's CAPABILITIES register reads zero on this silicon
	# so SDMA / ADMA2 are not available. DMA pulls CACHE_MANAGEMENT for
	# buffer maintenance around transfers.
	select DMA
	select CACHE_MANAGEMENT
	help
	  Enable the Broadcom BCM283x Arasan SDHCI host controller driver.
	  IRQ-driven control path, DMA data path via DREQ. R1b/R5b
	  responses are not supported.
```

## drivers/sdhc/Kconfig.bcm2835_sdhost
```kconfig
# Copyright (c) 2026 Jonathan Elliot Peace <jep@alphabetiq.com>
# SPDX-License-Identifier: Apache-2.0

config BCM2835_SDHOST
	bool "BCM283x legacy SDHost host controller"
	default y
	depends on DT_HAS_BRCM_BCM2835_SDHOST_ENABLED
	select SDHC_SUPPORTS_NATIVE_MODE
	help
	  Enable the Broadcom BCM283x legacy SDHost host controller
	  driver. Drives the external microSD slot via GPIO 48..53 at
	  ALT0. Polled implementation of the sdhc.h device API; no IRQ
	  support yet, no DMA yet.
```

## drivers/sdhc/Kconfig.bflb
```kconfig
# Copyright The Zephyr Project Contributors
# SPDX-License-Identifier: Apache-2.0

config SDHC_BFLB
	bool "Bouffalo Lab SDHC driver"
	default y
	depends on DT_HAS_BFLB_SDHC_ENABLED
	select SDHC_SUPPORTS_NATIVE_MODE
	select PINCTRL
	help
	  Enable the Bouffalo Lab SD Host Controller driver.

if SDHC_BFLB

config SDHC_BFLB_DMA
	bool "Use DMA for Bouffalo lab SDHC"
	default y
	help
	  Use ADMA2 (DMA system specific to the SDHC controller) instead of polling
	  to transfer data faster.

endif
```

## drivers/sdhc/Kconfig.cdnsmmc
```kconfig
# Copyright (c) 2016-2023 Intel Corporation
# SPDX-License-Identifier: Apache-2.0

DT_COMPAT_CDNS_SDHC := cdns,sdhc

config CDNS_SDHC
	bool "CDNS SDHC"
	default y
	depends on DT_HAS_CDNS_SDHC_ENABLED
	select SDHC_SUPPORTS_NATIVE_MODE
	help
		Enable Cadence SDMMC Host Controller.

config CDNS_DESC_COUNT
	int "Allocate number of descriptors"
	default 8
	help
	  SD host controllers require DMA preparation for read and write operation.
	  Creates static descriptors which can be used by ADMA. Devices should
	  configure this flag if they require to transfer more than 8*64Kb of data.

# Cadence SDHC DMA needs 64 bit aligned buffers
config SDHC_BUFFER_ALIGNMENT
	default 8
```
