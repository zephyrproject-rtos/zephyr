## drivers/mbox/Kconfig.gen_sw_mbox
```kconfig
# Copyright 2025 NXP
# SPDX-License-Identifier: Apache-2.0

config MBOX_GEN_SW
	bool "Generic Software Mailbox driver"
	depends on DT_HAS_NXP_GENERIC_SOFTWARE_MBOX_ENABLED
	depends on GIC
	help
	  Driver for Generic Software Mailbox based on shared memory.

if MBOX_GEN_SW

config MBOX_GEN_SW_CHAN
	int "Channel number of Generic Software Mailbox"
	default 4
	help
          Number of channels in the Generic Software Mailbox, it must
	  be the same as the peer side Generic Software Mailbox.

endif
```

## drivers/mbox/Kconfig.infineon_cat1
```kconfig
# Infineon CAT1 MBOX configuration options

# Copyright (c) 2026 Linumiz
# SPDX-License-Identifier: Apache-2.0

config MBOX_PDL_INFINEON_CAT1
	bool "Infineon CAT1 I2C driver (PDL)"
	default y
	depends on DT_HAS_INFINEON_CAT1_MBOX_PDL_ENABLED
	help
	  This option enables the MBOX driver for the Infineon CAT1 family.
```

## drivers/mbox/Kconfig.ipm
```kconfig
# Copyright (c) 2025 Dmitrii Sharshakov <d3dx12.xx@gmail.com>
# SPDX-License-Identifier: Apache-2.0

config MBOX_IPM
	bool "MBOX over IPM"
	depends on DT_HAS_ZEPHYR_IPM_MBOX_ENABLED
	default y
	# FIXME: select IPM
	help
	  Adapter driver to use an IPM device as a mailbox.
```

## drivers/mbox/Kconfig.ivshmem
```kconfig
# Copyright (c) 2024, Felipe Neves
# SPDX-License-Identifier: Apache-2.0

config MBOX_IVSHMEM
	bool "MBOX driver based on IVSHMEM-Doorbell"
	default y
	depends on DT_HAS_LINARO_IVSHMEM_MBOX_ENABLED
	depends on IVSHMEM
	depends on IVSHMEM_DOORBELL
	help
	  Mailbox driver using IVSHMEM Doorbell mechanism.

if MBOX_IVSHMEM

config MBOX_IVSHMEM_EVENT_LOOP_STACK_SIZE
	int "Stack size in bytes of IVSHMEM MBOX Event loop task"
	default 8192
	help
	  Adjust the stack size, in bytes of the ivshmem event loop task.

config MBOX_IVSHMEM_EVENT_LOOP_PRIO
	int "Priority of IVSHMEM MBOX Event loop task"
	default 2
	help
	  Adjust the priority of the ivshmem event loop task.

endif
```

## drivers/mbox/Kconfig.mhuv2
```kconfig
# Copyright (c) 2026, Xsight Labs
# SPDX-License-Identifier: Apache-2.0

config MBOX_MHUV2
	bool "ARM MHUv2 mailbox driver"
	depends on DT_HAS_ARM_MHUV2_ENABLED
	default y
	help
	  Driver for Arm MHUv2 (Message Handling Unit v2).
	  Provides doorbell signalling via the Zephyr mbox API.

if MBOX_MHUV2

config MBOX_MHUV2_NUM_CHANS
	int "ARM MHUv2 mailbox number of channels"
	range 1 124
	default 1
	help
	  Maximum number of hardware channel windows supported.
	  Must be less than or equal to MSG_NO_CAP reported by hardware.
	  MHUv2 allows up to 124 channel windows, each with 32 doorbell slots.
	  This configuration parameter is needed to avoid dynamic memory
	  allocation of per-doorbell data structures.

endif
```

## drivers/mbox/Kconfig.mhuv3
```kconfig
#
# SPDX-FileCopyrightText: <text>Copyright 2024-2025 Arm Limited and/or its
# affiliates <open-source-office@arm.com></text>
#
# SPDX-License-Identifier: Apache-2.0

config MBOX_MHUV3
	bool "ARM MHUv3 mailbox driver"
	depends on DT_HAS_ARM_MHUV3_ENABLED
	default y
	help
	  Driver for Arm MHUv3 (Message Handling Unit v3)

if MBOX_MHUV3

config MBOX_MHUV3_NUM_DBCH
	int "ARM MHUv3 mailbox doorbell number of channels"
	default 0
	help
	  Maximum number of doorbell channels allowed in the Postbox/Mailbox.
	  This number has to be less than or equal to (NUM_DBCH + 1) in PBX_DBCH_CFG0/MBX_DBCH_CFG0 registers.
	  If the doorbell extension is supported then this number has to be bigger than zero.
	  MHUv3 allows up to 128 doorbell channels.
	  This configuration parameter is needed to avoid the dynamic memory allocation of doorbell channels
	  data structures.

endif
```

## drivers/mbox/Kconfig.nrf_bellboard
```kconfig
# Copyright (c) 2024 Nordic Semiconductor ASA
# SPDX-License-Identifier: Apache-2.0

config MBOX_NRF_BELLBOARD_RX
	bool "nRF BELLBOARD RX driver"
	depends on DT_HAS_NORDIC_NRF_BELLBOARD_RX_ENABLED
	default y
	help
	  Mailbox driver for RX Nordic nRF BELLBOARD

config MBOX_NRF_BELLBOARD_TX
	bool "nRF BELLBOARD TX driver"
	depends on DT_HAS_NORDIC_NRF_BELLBOARD_TX_ENABLED
	default y
	help
	  Mailbox driver for TX Nordic nRF BELLBOARD
```

## drivers/mbox/Kconfig.nrf_vevif
```kconfig
# Copyright (c) 2024 Nordic Semiconductor ASA
# SPDX-License-Identifier: Apache-2.0

config MBOX_NRF_VEVIF_LOCAL
	bool "nRF VEVIF local driver"
	depends on DT_HAS_NORDIC_NRF_VEVIF_LOCAL_ENABLED
	default y
	help
	  Mailbox driver for local Nordic nRF VEVIF (VPR Event Interface)

config MBOX_NRF_VEVIF_REMOTE
	bool "nRF VEVIF remote driver"
	depends on DT_HAS_NORDIC_NRF_VEVIF_REMOTE_ENABLED
	default y
	help
	  Mailbox driver for remote Nordic nRF VEVIF (VPR Event Interface)
```

## drivers/mbox/Kconfig.nrf_vevif_event
```kconfig
# Copyright (c) 2024 Nordic Semiconductor ASA
# SPDX-License-Identifier: Apache-2.0

config MBOX_NRF_VEVIF_EVENT_RX
	bool "nRF VEVIF event RX driver"
	depends on DT_HAS_NORDIC_NRF_VEVIF_EVENT_RX_ENABLED
	default y
	help
	  Mailbox driver for receiving events triggered by VPR

config MBOX_NRF_VEVIF_EVENT_TX
	bool "nRF VEVIF event TX driver"
	depends on DT_HAS_NORDIC_NRF_VEVIF_EVENT_TX_ENABLED
	default y
	help
	  Mailbox driver for transmitting events from VPR to a remote core

config MBOX_NRF_VEVIF_EVENT_USE_54L_ERRATA_16
	bool "Apply errata 16 for nRF54L series"
	depends on SOC_SERIES_NRF54LX
	default y
```

## drivers/mbox/Kconfig.nrf_vevif_task
```kconfig
# Copyright (c) 2024 Nordic Semiconductor ASA
# SPDX-License-Identifier: Apache-2.0

config MBOX_NRF_VEVIF_TASK_RX
	bool "nRF VEVIF task RX driver"
	depends on DT_HAS_NORDIC_NRF_VEVIF_TASK_RX_ENABLED
	default y
	help
	  Mailbox driver for receiving VEVIF tasks on VPR as CLIC interrupts

config MBOX_NRF_VEVIF_TASK_TX
	bool "nRF VEVIF task TX driver"
	depends on DT_HAS_NORDIC_NRF_VEVIF_TASK_TX_ENABLED
	default y
	help
	  Mailbox driver for transmitting VEVIF tasks to VPR as CLIC interrupts
```

## drivers/mbox/Kconfig.nrfx
```kconfig
# Copyright (c) 2021 Carlo Caione <ccaione@baylibre.com>
# SPDX-License-Identifier: Apache-2.0

config MBOX_NRFX_IPC
	bool "MBOX NRF IPC driver"
	depends on DT_HAS_NORDIC_MBOX_NRF_IPC_ENABLED
	default y
	select NRFX_IPC
	help
	  Driver for Nordic nRF messaging unit, based
	  on nRF IPC peripheral HW.
```

## drivers/mbox/Kconfig.nxp_imx
```kconfig
# Copyright 2022 NXP
# SPDX-License-Identifier: Apache-2.0

config MBOX_NXP_IMX_MU
	bool "NXP i.MX Message Unit (MU) driver"
	default y
	depends on DT_HAS_NXP_MBOX_IMX_MU_ENABLED
	help
	  Driver for NXP i.MX Message Unit.
```

## drivers/mbox/Kconfig.nxp_mailbox
```kconfig
# Copyright 2024 NXP
# SPDX-License-Identifier: Apache-2.0

config MBOX_NXP_MAILBOX
	bool "NXP Mailbox driver for MBOX"
	default y
	depends on DT_HAS_NXP_MBOX_MAILBOX_ENABLED
	help
	  Driver for NXP Mailbox Unit around MBOX.
```

## drivers/mbox/Kconfig.nxp_s32
```kconfig
# Copyright 2022 NXP
# SPDX-License-Identifier: Apache-2.0

config MBOX_NXP_S32_MRU
	bool "NXP S32 Message Receive Unit (MRU) driver"
	default y
	depends on DT_HAS_NXP_S32_MRU_ENABLED
	select NOCACHE_MEMORY if ARCH_HAS_NOCACHE_MEMORY_SUPPORT
	help
	  Driver for NXP S32 Message Receive Unit (MRU).
```

## drivers/mbox/Kconfig.renesas_ra
```kconfig
# Copyright (c) 2025 Renesas Electronics Corporation
# SPDX-License-Identifier: Apache-2.0

config MBOX_RENESAS_RA_IPC
	bool "Renesas RA IPC mailbox driver"
	default y
	depends on DT_HAS_RENESAS_RA_IPC_MBOX_ENABLED
	select USE_RA_FSP_IPC
	help
	  Enable the RA IPC driver.
```

## drivers/mbox/Kconfig.renesas_rcar
```kconfig
# Copyright (c) 2026 BayLibre, SAS
# SPDX-License-Identifier: Apache-2.0

config MBOX_RENESAS_RCAR_MFIS
	bool "Renesas R-Car MFIS Driver"
	default y
	depends on DT_HAS_RENESAS_RCAR_MFIS_MBOX_ENABLED
	help
	  R-Car MFIS driver
```

## drivers/mbox/Kconfig.renesas_rz
```kconfig
# Copyright (c) 2025 Renesas Electronics Corporation
# SPDX-License-Identifier: Apache-2.0

config MBOX_RENESAS_RZ_MHU
	bool "Renesas RZ MHU Driver"
	default y
	depends on DT_HAS_RENESAS_RZ_MHU_MBOX_ENABLED
	select USE_RZ_FSP_MHU
	help
	  Enable the RZ MHU driver.

if MBOX_RENESAS_RZ_MHU

config MBOX_BUSY_WAIT_TIMEOUT_US
	int "MBOX send api timeout in microseconds"
	default 10
	help
	  This option specifies the timeout duration for the `mbox_send` API to busy-wait for the
	  remote processor to consume the previous message before sending a new one. If the
	  message is not consumed within this time, `mbox_send` will return an error.
	  Setting this value to 0 or a negative number will cause `mbox_send` to wait indefinitely
	  until the previous message is consumed before sending a new one.

endif
```

## drivers/mbox/Kconfig.rpi_pico
```kconfig
# Copyright (c) 2025 Igalia S.L.
# SPDX-License-Identifier: Apache-2.0

config MBOX_RPI_PICO
	bool "Inter-processor mailbox driver for the RP2350/RP2040 SoCs"
	default y
	depends on ARM && DT_HAS_RASPBERRYPI_PICO_MBOX_ENABLED
	help
	  Raspberry Pi Pico mailbox driver based on the RP2350/RP2040
	  inter-processor FIFOs.
```

## drivers/mbox/Kconfig.sophgo
```kconfig
# Copyright (c) 2024 honglin leng <a909204013@gmail.com>
# SPDX-License-Identifier: Apache-2.0

config MBOX_SOPHGO_CVI
	bool "SOPHGO CVI series Mailbox controller"
	default y
	depends on DT_HAS_SOPHGO_CVI_MAILBOX_ENABLED
	help
	  Enable driver for the SOPHGO CVI series Mailbox.
```

## drivers/mbox/Kconfig.stm32_hsem
```kconfig
# Copyright (c) 2024 Celina Sophie Kalus <hello@celinakalus.de>
# SPDX-License-Identifier: Apache-2.0

config MBOX_STM32_HSEM
	bool "MBOX STM32 HSEM driver"
	default y
	depends on DT_HAS_ST_MBOX_STM32_HSEM_ENABLED
	help
	  MBOX Driver for STM32 hardware semaphore
```

## drivers/mbox/Kconfig.telink_w91
```kconfig
# Copyright (c) 2024 Telink Semiconductor
# SPDX-License-Identifier: Apache-2.0

config MBOX_TELINK_W91_IPC
	bool "Telink W91 Message Receive Unit (MRU) driver"
	default y
	depends on DT_HAS_TELINK_MBOX_IPC_W91_ENABLED
	help
		Driver for Telink W91 Message Receive Unit (MRU).
```

## drivers/mbox/Kconfig.ti_am26x
```kconfig
# Copyright (c) 2025 Texas Instruments Incorporated
# SPDX-License-Identifier: Apache-2.0

config MBOX_TI_AM26X
	bool "TI AM26x Family Mailbox driver"
	default y
	depends on DT_HAS_TI_AM26X_MAILBOX_ENABLED
	help
	  Driver for TI AM26x Family Mailbox hardware. This driver supports
	  inter-processor communication on AM26x family SoCs via the
	  MSS-integrated mailbox controller.
```

## drivers/mbox/Kconfig.ti_omap
```kconfig
# Copyright 2024 Texas Instruments Incorporated.
# SPDX-License-Identifier: Apache-2.0

config MBOX_TI_OMAP_MAILBOX
	bool "TI OMAP Mailbox driver"
	default y
	depends on DT_HAS_TI_OMAP_MAILBOX_ENABLED
	help
	  Driver for TI OMAP Mailbox.
```

## drivers/mbox/Kconfig.ti_secproxy
```kconfig
# Copyright 2025 Texas Instruments Incorporated.
# SPDX-License-Identifier: Apache-2.0

config MBOX_TI_SECURE_PROXY
	bool "TI Secureproxy Mailbox driver"
	default y
	depends on DT_HAS_TI_SECURE_PROXY_ENABLED
	help
	  Driver for TI Secure Proxy Mailbox.
```

## drivers/mbox/Kconfig.xlnx
```kconfig
# Copyright 2025 Advanced Micro Devices, Inc.
#
# SPDX-License-Identifier: Apache-2.0

config MBOX_XLNX_IPI_MAILBOX
	bool "MBOX XLNX IPI MAILBOX driver"
	default y
	depends on DT_HAS_XLNX_MBOX_VERSAL_IPI_MAILBOX_ENABLED
	help
	  Enables the MBOX Driver for AMD-Xilinx IPI Mailbox peripheral.
```
