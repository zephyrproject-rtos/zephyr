## drivers/spi/Kconfig.cc13xx_cc26xx
```kconfig
# TI CC13xx / CC26xx SPI configuration options

# Copyright (c) 2019 Brett Witherspoon
# SPDX-License-Identifier: Apache-2.0

config SPI_CC13XX_CC26XX
	bool "TI SimpleLink CC13xx / CC26xx SPI driver"
	default y
	depends on DT_HAS_TI_CC13XX_CC26XX_SPI_ENABLED
	help
	  Enable support for the TI SimpleLink CC13xx / CC26xx SPI peripheral
```

## drivers/spi/Kconfig.cc23x0
```kconfig
# TI CC23x0 SPI configuration options

# Copyright (c) 2024 BayLibre, SAS
# SPDX-License-Identifier: Apache-2.0

config SPI_CC23X0
	bool "TI SimpleLink CC23x0 SPI driver"
	default y
	depends on DT_HAS_TI_CC23X0_SPI_ENABLED
	select PINCTRL
	help
	  Enable support for the TI SimpleLink CC23x0 SPI peripheral

config SPI_CC23X0_DMA_DRIVEN
	bool "DMA support for TI CC23X0 SPI devices"
	depends on SPI_CC23X0
	select DMA
	help
	  DMA driven transactions for the SPI.
	  DMA driven mode offloads data transfer tasks from the CPU
	  and requires fewer interrupts to handle the SPI transfers.
```

## drivers/spi/Kconfig.cdns
```kconfig
# Copyright (c) 2024 Meta Platforms
# SPDX-License-Identifier: Apache-2.0

config SPI_CDNS
	bool "Cadence SPI controller driver"
	depends on DT_HAS_CDNS_SPI_ENABLED
	help
	  Enable the SPI peripherals based on Cadence IP6524
```

## drivers/spi/Kconfig.cdns_spi
```kconfig
# Copyright 2025 Advanced Micro Devices, Inc.
#
# SPDX-License-Identifier: Apache-2.0

config SPI_CDNS_SPI
	bool "CADENCE SPI driver"
	default y
	depends on DT_HAS_CDNS_SPI_R1P6_ENABLED
	help
	  Enable Cadence SPI driver.

if SPI_CDNS_SPI

config CDNS_SPI_INTR
	bool "Cadence SPI interrupt mode"
	help
	  Enable Interrupt support for the Cadence SPI Driver.

endif
```

## drivers/spi/Kconfig.dw
```kconfig
# DesignWare SPI driver configuration options

# Copyright (c) 2015-2016 Intel Corporation
# Copyright (c) 2023 Meta Platforms
# SPDX-License-Identifier: Apache-2.0

menuconfig SPI_DW
	bool "DesignWare SPI controller driver"
	default y
	depends on DT_HAS_SNPS_DESIGNWARE_SPI_ENABLED
	select PINCTRL if $(dt_compat_any_has_prop,$(DT_COMPAT_SNPS_DESIGNWARE_SPI),pinctrl-0)
	help
	  Enable support for DesignWare SPI controllers.

if SPI_DW

config SPI_DW_ACCESS_WORD_ONLY
	bool "DesignWare SPI only allows word access"
	help
	  In some case, e.g. ARC HS Development kit, the peripheral space of
	  DesignWare SPI only allows word access, byte access will raise
	  exception.

config SPI_DW_HSSI
	bool "DesignWare SPI HSSI variant"
	help
	  Use register layout compatible with the SPI DW HSSI variant of the
	  peripheral.

endif # SPI_DW
```

## drivers/spi/Kconfig.egis_et171
```kconfig
# Kconfig Egis ET171 SPI configuration options
#
# Copyright (c) 2022 Andes Technology Corporation.
# Copyright (c) 2025 Egis Technology Inc.
#
# SPDX-License-Identifier: Apache-2.0
#

config SPI_EGIS_ET171
	bool "Andes ATCSPI200-based Egis ET171 SPI driver"
	default y
	depends on DT_HAS_EGIS_ET171_SPI_ENABLED
	help
	  Enable driver for Andes ATCSPI200-based Egis ET171 SPI controller

if SPI_EGIS_ET171

config EGIS_SPI_DMA_MODE
	bool "Using DMA mode for SPI driver"
	default y
	depends on DMA

endif # SPI_EGIS_ET171
```

## drivers/spi/Kconfig.ene
```kconfig
# Copyright (c) 2024 ENE Technology Inc.
# SPDX-License-Identifier: Apache-2.0

config SPI_ENE_KB1200
	bool "ENE KB1200 spi driver"
	default y
	depends on DT_HAS_ENE_KB1200_SPI_ENABLED
	select PINCTRL
	help
	  This option enables the KB1200 spi driver.
```

## drivers/spi/Kconfig.eos_s3
```kconfig
menuconfig SPI_EOS_S3
	bool "QuickLogic EOS S3 SPI driver"
	default y
	depends on DT_HAS_QUICKLOGIC_EOS_S3_SPI_ENABLED
	help
	  Enable support for the EOS S3 SPI driver.
```

## drivers/spi/Kconfig.esp32
```kconfig
# ESP32 SPI configuration

# Copyright (c) 2020 Espressif Systems (Shanghai) Co., Ltd.
# SPDX-License-Identifier: Apache-2.0

menuconfig ESP32_SPIM
	bool "ESP32 SPI Master driver"
	default y
	depends on DT_HAS_ESPRESSIF_ESP32_SPI_ENABLED
	help
	  Enables support for ESP32 SPI Master driver.

if ESP32_SPIM

config SPI_ESP32_INTERRUPT
	bool "ESP32 SPI interrupt mode"
	help
	  Enables interrupt support for ESP32 SPI driver.

config ESP32_SPI_TARGET
	bool "ESP32 SPI target mode"
	select SPI_SLAVE
	select SPI_ESP32_INTERRUPT
	help
	  Enables target mode for the ESP32 SPI driver. Target
	  transactions are clocked by an external controller, so this
	  mode is interrupt driven and runs the SPI peripheral through
	  the dedicated target HAL.

if ESP32_SPI_TARGET

config SPI_ESP32_TARGET_MAX_BUFS
	int "Maximum scatter/gather buffers per target transaction"
	default 8
	help
	  Number of separate spi_buf segments that can be coalesced into a
	  single target transaction. A target frame is clocked by the
	  controller within one chip-select assertion, so the scattered
	  buffers are gathered into one contiguous FIFO transfer.

endif # ESP32_SPI_TARGET

endif # ESP32_SPIM
```
