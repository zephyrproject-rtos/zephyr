## drivers/slcd/Kconfig
```kconfig
# Copyright 2026 NXP
# SPDX-License-Identifier: Apache-2.0

menuconfig SLCD
	bool "SLCD (Segmented LCD) Drivers"
	help
	  Enable drivers for Segmented LCD (SLCD).

if SLCD

module = SLCD
module-str = slcd
source "subsys/logging/Kconfig.template.log_config"

config SLCD_CONTROLLER_INIT_PRIORITY
	int "Controller initialization priority"
	default 85
	help
	  SLCD Bus Controllers initialization priority.

# zephyr-keep-sorted-start
source "drivers/slcd/Kconfig.nxp_slcd"
# zephyr-keep-sorted-stop

endif # SLCD
```

## drivers/slcd/Kconfig.nxp_slcd
```kconfig
# Copyright 2026 NXP
# SPDX-License-Identifier: Apache-2.0

config SLCD_NXP_MCUX
	bool "NXP MCUX SLCD driver"
	default y
	depends on DT_HAS_NXP_SLCD_ENABLED
	help
	  Enable NXP MCUX SLCD (Segmented LCD) controller driver.
	  This driver provides support for NXP's SLCD IP block found
	  in MCX microcontrollers.
```

## drivers/slcd/Kconfig.segment7
```kconfig
# Copyright 2026 NXP
# SPDX-License-Identifier: Apache-2.0

config SLCD_PANEL_SEGMENT7
	bool "7-Segment SLCD Panel Device Driver"
	help
	  Enable the 7-segment SLCD panel device driver. This driver supports
	  segmented LCD panels with 7-segment displays (segments A through G),
	  typically used for numeric and alphanumeric display units.

	  The driver provides APIs to display:
	  - Numbers (0-9) at specific positions
	  - Letters (A-Z, a-z) at specific positions
	  - Special icons at designated locations

	  The driver reads the segment-mux and icon-mux properties from the
	  device tree to determine which pin and COM lines correspond to
	  each segment and icon, then uses the parent SLCD controller's
	  to control the display.
```

## drivers/slip/Kconfig
```kconfig
# Kconfig - SLIP driver configuration options

#
# Copyright (c) 2016 Intel Corporation
#
# Redistribution and use in source and binary forms, with or without
# modification, are permitted provided that the following conditions are met:
#
# 1) Redistributions of source code must retain the above copyright notice,
# this list of conditions and the following disclaimer.
#
# 2) Redistributions in binary form must reproduce the above copyright notice,
# this list of conditions and the following disclaimer in the documentation
# and/or other materials provided with the distribution.
#
# 3) Neither the name of Intel Corporation nor the names of its contributors
# may be used to endorse or promote products derived from this software without
# specific prior written permission.
#
# THIS SOFTWARE IS PROVIDED BY THE COPYRIGHT HOLDERS AND CONTRIBUTORS "AS IS"
# AND ANY EXPRESS OR IMPLIED WARRANTIES, INCLUDING, BUT NOT LIMITED TO, THE
# IMPLIED WARRANTIES OF MERCHANTABILITY AND FITNESS FOR A PARTICULAR PURPOSE
# ARE DISCLAIMED. IN NO EVENT SHALL THE COPYRIGHT HOLDER OR CONTRIBUTORS BE
# LIABLE FOR ANY DIRECT, INDIRECT, INCIDENTAL, SPECIAL, EXEMPLARY, OR
# CONSEQUENTIAL DAMAGES (INCLUDING, BUT NOT LIMITED TO, PROCUREMENT OF
# SUBSTITUTE GOODS OR SERVICES; LOSS OF USE, DATA, OR PROFITS; OR BUSINESS
# INTERRUPTION) HOWEVER CAUSED AND ON ANY THEORY OF LIABILITY, WHETHER IN
# CONTRACT, STRICT LIABILITY, OR TORT (INCLUDING NEGLIGENCE OR OTHERWISE)
# ARISING IN ANY WAY OUT OF THE USE OF THIS SOFTWARE, EVEN IF ADVISED OF THE
# POSSIBILITY OF SUCH DAMAGE.
#

#
# SLIP options
#
menuconfig SLIP
	bool
	prompt "SLIP driver"
	depends on NET_SLIP
	select UART_PIPE
	select UART_INTERRUPT_DRIVEN

if SLIP

config	SLIP_DRV_NAME
	string "SLIP Driver name"
	default "slip"
	help
	  This option sets the driver name

config	SLIP_MTU
	int "SLIP MTU"
	default 1500
	range 80 1500
	help
	  This option sets the MTU for the SLIP connection.
	  The value is only used when fragmenting the network
	  data into net_buf's. The actual SLIP connection
	  does not use this value.

config	SLIP_DEBUG
	bool "SLIP driver debug"
	default n
	help
	  This option enables debug support for SLIP driver.

config	SLIP_STATISTICS
	bool "SLIP network connection statistics"
	default n
	help
	  This option enables statistics support for SLIP driver.

config  SLIP_TAP
	bool "Use TAP interface to host"
	default n
	help
	  By default TUN is used. In TAP the Ethernet frames
	  are transferred over SLIP.

endif
```

## drivers/smbus/Kconfig
```kconfig
# SMBus configuration options

# Copyright (c) 2022 Intel Corporation
# SPDX-License-Identifier: Apache-2.0

menuconfig SMBUS
	bool "System Management Bus (SMBus) drivers"
	imply CRC
	help
	  Enable SMBus Driver Configuration

if SMBUS

config SMBUS_SHELL
	bool "SMBus Shell"
	depends on SHELL
	help
	  Enable SMBus Shell.

config SMBUS_STATS
	bool "SMBus device Stats"
	depends on STATS
	help
	  Enable SMBus Stats.

config SMBUS_INIT_PRIORITY
	int "Init priority"
	default KERNEL_INIT_PRIORITY_DEFAULT
	help
	  SMBus device driver initialization priority.


module = SMBUS
module-str = smbus
source "subsys/logging/Kconfig.template.log_config"

config SMBUS_INTEL_PCH
	bool "SMBus Intel PCH driver"
	default y
	depends on DT_HAS_INTEL_PCH_SMBUS_ENABLED
	select PCIE
	select DYNAMIC_INTERRUPTS
	help
	  Enable Intel Platform Controller Hub (PCH) SMBus driver.

if SMBUS_INTEL_PCH

choice SMBUS_INTEL_PCH_ACCESS
	bool "SMBus register access mode"
	default SMBUS_INTEL_PCH_ACCESS_IO
	help
	  Default PCH register access mode. Set default access IO so
	  that both Qemu Q35 and Intel hardware are supported.

config SMBUS_INTEL_PCH_ACCESS_IO
	bool "I/O PCH SMBus Register Access Mode"
	help
	  Access PCH SMBus registers through I/O space.

config SMBUS_INTEL_PCH_ACCESS_MMIO
	bool "MMIO PCH SMBus Register Access Mode"
	help
	  Access PCH SMBus registers though MMIO space.

endchoice

config SMBUS_INTEL_PCH_HOST_NOTIFY
	bool "SMBus Intel PCH Host Notify support"
	default y
	help
	  Support Host Notify from peripheral devices.

config SMBUS_INTEL_PCH_SMBALERT
	bool "SMBus Intel PCH SMBALERT signal support"
	default y
	help
	  Support SMBALERT signal from peripheral devices.

endif # SMBUS_INTEL_PCH

menuconfig SMBUS_STM32
	bool "STM32 SMBus driver"
	default y
	depends on DT_HAS_ST_STM32_SMBUS_ENABLED
	depends on I2C_STM32
	select PINCTRL
	help
	  Enable STM32 SMBus driver.

if SMBUS_STM32

config SMBUS_STM32_SMBALERT
	bool "SMBus STM32 SMBALERT signal support"
	default y
	help
	  Support SMBALERT signal from peripheral devices.

endif # SMBUS_STM32

endif # SMBUS
```

## drivers/smmu/Kconfig
```kconfig
# Copyright (c) 2023 Arm Limited (or its affiliates). All rights reserved.
# SPDX-License-Identifier: Apache-2.0

menuconfig ARM_SMMU
	bool "Support for arm smmu"
	select IOMMU
	help
	  Enable support for arm smmu

config SMMU_CTX_ALLOCATOR_SIZE
	int "SMMU ctx allocator size"
	default 4
	help
	  Maximum number of smmu ctx that can be allocated from ctx allocator.
	  SMMU ctx is the data structure represent the child device managed by
	  SMMU.

choice SMMU_DEFAULT_TYPE
	bool "SMMU default type"
	default SMMU_TYPE_DMA_TRANSLATE

config SMMU_TYPE_DMA_TRANSLATE
	bool "Translate-strict"

config SMMU_TYPE_GLOBAL_BYPASS
	bool "Global bypass"

endchoice
```

## drivers/spi/Kconfig
```kconfig
# SPI driver configuration options

# Copyright (c) 2015-2016 Intel Corporation
# SPDX-License-Identifier: Apache-2.0

#
# SPI Drivers
#
menuconfig SPI
	bool "Serial Peripheral Interface (SPI) bus drivers"
	help
	  Enable support for the SPI hardware bus.

if SPI

config SPI_SHELL
	bool "SPI Shell"
	depends on SHELL
	help
	  Enable SPI Shell.

	  The currently SPI shell supports simple SPI write/read (transceive)
	  operation.

config SPI_ASYNC
	bool "Asynchronous call support"
	depends on MULTITHREADING
	select POLL
	help
	  This option enables the asynchronous API calls.

config SPI_RTIO
	bool "RTIO support [EXPERIMENTAL]"
	select EXPERIMENTAL
	select RTIO
	select RTIO_WORKQ
	help
	  This option enables the RTIO API calls. RTIO support is
	  experimental as the API itself is unstable.

if SPI_RTIO

config SPI_RTIO_FALLBACK_MSGS
	int "Number of available spi_buf structs for the default handler to use"
	default 4
	help
		When RTIO is used with a driver that does not yet implement the submit API
		natively the submissions are converted back to struct spi_buf values that
		are given to spi_transfer. This requires some number of msgs be available to convert
		the submissions into on the stack. MISRA rules dictate we must know this in
		advance.

		In all likelihood 4 is going to work for everyone, but in case you do end up with
		an issue where you are using RTIO, your driver does not implement submit natively,
		and get an error relating to not enough spi msgs this is the Kconfig to manipulate.

endif # SPI_RTIO

config SPI_SLAVE
	bool "Slave support [EXPERIMENTAL]"
	select EXPERIMENTAL
	help
	  Enables Driver SPI slave operations. Slave support depends
	  on the driver and the hardware it runs on.

config SPI_EXTENDED_MODES
	bool "Extended modes [EXPERIMENTAL]"
	select EXPERIMENTAL
	help
	  Enables extended operations in the SPI API. Currently, this
	  enables the possibility to select the line mode (single/dual/
	  quad/octal), though none of these mode are really supported as
	  it would require more features exposed into the SPI buffer.

config SPI_INIT_PRIORITY
	int "Init priority"
	default KERNEL_INIT_PRIORITY_DEVICE
	help
	  Device driver initialization priority.

config SPI_COMPLETION_TIMEOUT_TOLERANCE
	int "Completion timeout tolerance (ms)"
	default 200
	help
	  The tolerance value in ms for the SPI completion timeout logic.

config SPI_STATS
	bool "SPI device statistics"
	depends on STATS
	help
	  Enable SPI device statistics.

config SPI_SHELL_MAX_DEVICE_SLOTS
	int "Number of empty device slots in the SPI shell"
	depends on SPI_SHELL
	default 16
	help
	  The number of empty device slots in the SPI shell. Increase it, if you
	  are using many SPI devices and see "ERROR: not enough space" error
	  messages when using SPI shell.

module = SPI
module-str = spi
source "subsys/logging/Kconfig.template.log_config"

source "drivers/spi/Kconfig.*"
source "drivers/spi/*/Kconfig"

endif # SPI
```

## drivers/spi/Kconfig.ambiq
```kconfig
# Ambiq SDK SPI
#
# Copyright (c) 2023 Antmicro <www.antmicro.com>
# Copyright (c) 2024 Ambiq Micro Inc. <www.ambiq.com>
#
# SPDX-License-Identifier: Apache-2.0
#

menuconfig SPI_AMBIQ_SPIC
	bool "AMBIQ SPI Controller driver"
	default y
	depends on DT_HAS_AMBIQ_SPI_ENABLED
	select GPIO
	select AMBIQ_HAL
	select AMBIQ_HAL_USE_SPIC
	help
	  Enable driver for Ambiq SPI in Controller mode.

if SPI_AMBIQ_SPIC

config SPI_AMBIQ_HANDLE_CACHE
	bool "Turn on cache handling in spi driver"
	default y
	depends on CACHE_MANAGEMENT && DCACHE
	help
	  Disable this if cache has been handled in upper layers.

endif # SPI_AMBIQ_SPIC

config SPI_AMBIQ_SPID
	bool "AMBIQ SPI Device driver"
	default y
	depends on DT_HAS_AMBIQ_SPID_ENABLED
	select GPIO
	select AMBIQ_HAL
	select AMBIQ_HAL_USE_SPID
	help
	  Enable driver for Ambiq SPI in Device mode.

config SPI_AMBIQ_BLEIF
	bool "AMBIQ SPI-BLEIF driver"
	default y
	depends on DT_HAS_AMBIQ_SPI_BLEIF_ENABLED
	select AMBIQ_HAL
	select AMBIQ_HAL_USE_BLEIF
	help
	  Enable driver for Ambiq Apollox Blue SOC (e.g. Apollo3 Blue)
	  which uses internal designed BLEIF module (different from the
	  general IOM module) for SPI transceiver. It is always used for
	  the Bluetooth HCI communication.

if SPI_AMBIQ_BLEIF

config SPI_AMBIQ_BLEIF_TIMING_TRACE
	bool "Ambiq SPI-BLEIF timing trace"
	help
	  The pins for the SPI transceiver are not exposed from the chips
	  and no need for user to configure them. But the chips design the
	  configurable BLEIF timing observation functions on other exposed
	  pins. The user can enable it to configure the pins for timing
	  trace purpose.

endif # SPI_AMBIQ_BLEIF
```

## drivers/spi/Kconfig.ameba
```kconfig
# AMEBA SPI configuration

# Copyright (c) 2026 Realtek Semiconductor Corp.
# SPDX-License-Identifier: Apache-2.0

menuconfig SPI_AMEBA
	bool "AMEBA SPI driver"
	default y
	depends on DT_HAS_REALTEK_AMEBA_SPI_ENABLED
	select PINCTRL
	help
		Enables support for AMEBA SPI driver.

if SPI_AMEBA

choice SPI_AMEBA_OPERATION_MODE
	prompt "AMEBA SPI Operation Mode"
	default SPI_AMEBA_POLLING
	help
	  Select the operation mode for AMEBA SPI driver.

	config SPI_AMEBA_INTERRUPT
		bool "AMEBA SPI interrupt mode"
		help
			Enables interrupt support for AMEBA SPI driver.

	config SPI_AMEBA_DMA
		bool "AMEBA SPI DMA Support"
		select DMA
		help
			Enable the SPI DMA mode.

	config SPI_AMEBA_POLLING
		bool "AMEBA SPI polling mode"
		help
			Enable the SPI polling mode.

endchoice

endif # SPI_AMEBA
```

## drivers/spi/Kconfig.andes_atcspi200
```kconfig
# Kconfig Andes ATCSPI200 SPI configuration options
#
# Copyright (c) 2022 Andes Technology Corporation.
#
# SPDX-License-Identifier: Apache-2.0
#

config SPI_ANDES_ATCSPI200
	bool "Andes ATCSPI200 SPI driver"
	default y
	depends on DT_HAS_ANDESTECH_ATCSPI200_ENABLED
	help
	  Enable driver for Andes ATCSPI200 SPI controller
```

## drivers/spi/Kconfig.atm
```kconfig
# ATM SPI configuration options

# Copyright (c) 2021-2023 Atmosic
# SPDX-License-Identifier: Apache-2.0

menuconfig SPI_ATM
	bool "Atmosic SPI driver"
	default y
	depends on DT_HAS_ATMOSIC_ATM_SPI_ENABLED
	help
	  Enables the ATM SPI driver

if SPI_ATM

config SPI_ATM_TIMEOUT
	int "SPI IO timeout in usec"
	default 100000

endif # SPI_ATM
```

## drivers/spi/Kconfig.b91
```kconfig
# Copyright (c) 2021 Telink Semiconductor
# SPDX-License-Identifier: Apache-2.0

config SPI_TELINK_B91
	bool "Telink Semiconductor B91 SPI driver"
	default y
	depends on DT_HAS_TELINK_B91_SPI_ENABLED
	help
	  Enables Telink B91 SPI driver.
```

## drivers/spi/Kconfig.b9x
```kconfig
# Copyright (c) 2023-2024 Telink Semiconductor
# SPDX-License-Identifier: Apache-2.0

config SPI_TELINK_B9X
	bool "Telink Semiconductor B9x SPI driver"
	default y
	depends on DT_HAS_TELINK_B91_SPI_ENABLED || DT_HAS_TELINK_B92_SPI_ENABLED
	help
	  Enables Telink B9x SPI driver.
```

## drivers/spi/Kconfig.bee
```kconfig
# Copyright (c) 2026, Realtek Semiconductor Corporation
# SPDX-License-Identifier: Apache-2.0

config SPI_BEE
	bool "Realtek Bee series SPI driver"
	default y
	depends on DT_HAS_REALTEK_BEE_SPI_ENABLED
	select HAL_REALTEK_BEE_SPI
	select PINCTRL
	help
	  This option enables the SPI driver for Realtek Bee SoCs.

if SPI_BEE
config SPI_BEE_INTERRUPT
	bool "BEE MCU SPI Interrupt Support"
	default y if SPI_ASYNC
	help
	  Enable the interrupt driven mode for SPI.

config SPI_BEE_DMA
	bool "BEE MCU SPI DMA Support"
	select DMA
	select SPI_BEE_INTERRUPT
	select HAL_REALTEK_BEE_DMA
	help
	  Enable the DMA driven mode for SPI.

if SPI_BEE_DMA
config SPI_BEE_DMA_BUF_SIZE
	int "Size of the DMA buffer slab block"
	default 512
	depends on SPI_BEE_DMA
	help
	  Size in bytes of each block in the memory slab used for DMA
	  dummy buffers (when user buffer is NULL).

config SPI_BEE_DMA_BUF_COUNT
	int "Number of DMA buffer slab blocks"
	default 4
	depends on SPI_BEE_DMA
	help
	  Number of blocks in the memory slab. Should be enough for
	  concurrent TX/RX operations across enabled SPI instances.

endif # SPI_BEE_DMA

endif # SPI_BEE
```

## drivers/spi/Kconfig.bflb
```kconfig
# Copyright (c) 2024-2025 MASSDRIVER EI (massdriver.space)
# SPDX-License-Identifier: Apache-2.0

config SPI_BFLB
	bool "Bouffalolab SPI driver"
	default y
	depends on DT_HAS_BFLB_SPI_ENABLED
	help
	  Enable support for Bouffalolab SPI driver.
```

## drivers/spi/Kconfig.bitbang
```kconfig
# Copyright (c) 2021, Marc Reilly, Creative Product Design
# SPDX-License-Identifier: Apache-2.0

config SPI_BITBANG
	bool "Bitbang SPI controller driver"
	default y
	depends on DT_HAS_ZEPHYR_SPI_BITBANG_ENABLED
	help
	  Enable the Bitbang SPI controller
```
