## drivers/spi/Kconfig.mcux_lpspi
```kconfig
# MCUXpresso SDK SPI

# Copyright (c) 2018, NXP
# SPDX-License-Identifier: Apache-2.0

config SPI_MCUX_LPSPI
	bool "MCUX LPSPI driver"
	default y
	depends on DT_HAS_NXP_LPSPI_ENABLED
	depends on CLOCK_CONTROL
	select PINCTRL
	help
	  Enable support for MCUX LPSPI driver.

if SPI_MCUX_LPSPI
config SPI_MCUX_LPSPI_DMA
	bool "MCUX LPSPI SPI DMA Support"
	select DMA
	help
	  Enable the SPI DMA mode for SPI instances
	  that enable dma channels in their device tree node.

if SPI_RTIO
config SPI_MCUX_RTIO_SQ_SIZE
	int "number of available submission queue entries"
	default 8 # sensible default that covers most common spi transactions
	help
	  when rtio is use with spi each driver holds a context with which blocking
	  api calls use to perform spi transactions. this queue needs to be as deep
	  as the longest set of spi_buf_sets used, where normal spi operations are
	  used (equal length buffers). it may need to be slightly deeper where the
	  spi buffer sets for transmit/receive are not always matched equally in
	  length as these are transformed into normal transceives.
endif # SPI_RTIO

endif # SPI_MCUX_LPSPI
```

## drivers/spi/Kconfig.mec5
```kconfig
# Microchip MEC5 QSPI

# Copyright (c) 2025 Microchip Technology Inc.
# SPDX-License-Identifier: Apache-2.0

config SPI_MEC5_QSPI
	bool "Microchip MEC5 QSPI driver"
	default y
	depends on DT_HAS_MICROCHIP_MEC5_QSPI_ENABLED
	select PINCTRL
	help
	  Enable support for Microchip MEC5 QSPI driver.
```

## drivers/spi/Kconfig.mspm0
```kconfig
# Copyright (c) 2026 Linumiz
# SPDX-License-Identifier: Apache-2.0

config SPI_MSPM0
	bool "TI MSPM0 SPI"
	default y
	depends on DT_HAS_TI_MSPM0_SPI_ENABLED
	select USE_MSPM0_DL_SPI
	select PINCTRL
	select GPIO
	help
	 Enable support for TI MSPM0 SPI peripheral.
```

## drivers/spi/Kconfig.nct
```kconfig
# Nuvoton NCT SPI Driver configuration options

# Copyright (c) 2024 Nuvoton Technology Corporation.
# SPDX-License-Identifier: Apache-2.0

menuconfig SPI_NCT_SPIP
	bool "Nuvoton NCT Enhanced Super I/O (eSIO) SPI driver"
	default y
	depends on DT_HAS_NUVOTON_NCT_SPIP_ENABLED
	help
	  Enable the SPI peripherals on NCT MCU.
```

## drivers/spi/Kconfig.npcm
```kconfig
# Nuvoton NPCM SPI Driver configuration options

# Copyright (c) 2024 Nuvoton Technology Corporation.
# SPDX-License-Identifier: Apache-2.0

menuconfig SPI_NPCM_SPIP
	bool "Nuvoton NPCM Enhanced Super I/O (eSIO) SPI driver"
	default y
	depends on DT_HAS_NUVOTON_NPCM_SPIP_ENABLED
	help
	  Enable the SPI peripherals on NPCM MCU.
```

## drivers/spi/Kconfig.npcx
```kconfig
# Nuvoton NPCX SPI Driver configuration options

# Copyright (c) 2024 Nuvoton Technology Corporation.
# SPDX-License-Identifier: Apache-2.0

menuconfig SPI_NPCX_SPIP
	bool "Nuvoton NPCX embedded controller (EC) SPI driver"
	default y
	depends on DT_HAS_NUVOTON_NPCX_SPIP_ENABLED
	select PINCTRL
	help
	  Enable the SPI peripherals on NPCX MCU.

config SPI_NPCX_SPIP_INTERRUPT
	bool "NPCX SPIP Interrupt Support"
	depends on SPI_NPCX_SPIP
	help
	  Enable Interrupt support for the SPI Driver of NPCX chip.
```

## drivers/spi/Kconfig.npcx_fiu
```kconfig
# NPCX SPI Driver configuration options

# Copyright (c) 2021 Nuvoton Technology Corporation.
# SPDX-License-Identifier: Apache-2.0

config SPI_NPCX_FIU
	bool "Nuvoton NPCX embedded controller (EC) SPI driver for NOR flash"
	default y
	depends on DT_HAS_NUVOTON_NPCX_SPI_FIU_ENABLED
	help
	  Enable the SPI driver for NPCX family of processors. This driver is
	  for the dedicated SPI controller (FIU) to access the NOR flash.
```

## drivers/spi/Kconfig.nrf5
```kconfig
# Kconfig - nrf5 series MDK SPI support
#
# Copyright (c) 2017, dXplore
# Copyright (c) 2017, Intel Corp.
# Copyright (c) 2016-2017, Linaro Limited.
#
# SPDX-License-Identifier: Apache-2.0
#

# TODO add nrf51 master and nrf5 slaves

menuconfig SPI_NRF5
	bool "nRF5 SPI drivers"
	depends on SPI && SOC_FAMILY_NRF5 && GPIO_NRF5_P0
	default n
	help
	  Enable support for nRF5 MCU series SPI drivers. Peripherals
	  with the same instance id can not be used together, e.g., SPIM0 and I2C_0
	  (TWIM0) and SPIS0. You may need to disable I2C_0 or I2C_1.

if SPI_NRF5

if SPI_0 && !I2C_0

choice
	prompt "SPI0 Driver type"

config SPI0_NRF52_MASTER
	bool "Master"
	depends on SOC_SERIES_NRF52X
	help
	  nRF52 SPI0 Master with EasyDMA

endchoice

config SPI0_NRF52_SCK_PIN
	int "SPI0 SCK pin number"
	range 0 31
	help
	  GPIO pin number for SCK

config SPI0_NRF52_MOSI_PIN
	int "SPI0 MOSI pin number"
	range 0 31
	help
	  GPIO pin number to use for MOSI

config SPI0_NRF52_MISO_PIN
	int "SPI0 MISO pin number"
	range 0 31
	help
	  GPIO pin number for MISO

config SPI0_NRF52_ORC
	hex "SPI0 Over Read Character"
	default 0x00
	range 0x00 0xff
	help
	  This option configures what value to send when the TX char count is
	  less than the RX count.

endif # SPI_0 && !I2C_0

if SPI_1 && !I2C_1

choice
	prompt "SPI1 Driver type"

config SPI1_NRF52_MASTER
	bool "Master"
	depends on SOC_SERIES_NRF52X
	help
	  nRF52 SPI1 Master with EasyDMA

endchoice

config SPI1_NRF52_SCK_PIN
	int "SPI1 SCK pin number"
	range 0 31
	help
	  Pin number for SCK

config SPI1_NRF52_MOSI_PIN
	int "SPI1 MOSI pin number"
	range 0 31
	help
	  Pin number to use for MOSI

config SPI1_NRF52_MISO_PIN
	int "SPI1 MISO pin number"
	range 0 31
	help
	  Pin number for MISO

config SPI1_NRF52_ORC
	hex "SPI1 Over Read Character"
	default 0x00
	range 0x00 0xff
	help
	  This option configures the value to send when the TX char count is
	  less than the RX count.

endif # SPI_1 && !I2C_1

if SPI_2

choice
	prompt "SPI2 Driver type"

config SPI2_NRF52_MASTER
	bool "Master"
	depends on SOC_SERIES_NRF52X
	help
	  nRF52 SPI2 Master with EasyDMA

endchoice

config SPI2_NRF52_SCK_PIN
	int "SPI2 SCK pin number"
	range 0 31
	help
	  Pin number for SCK

config SPI2_NRF52_MOSI_PIN
	int "SPI2 MOSI pin number"
	range 0 31
	help
	  Pin number to use for MOSI

config SPI2_NRF52_MISO_PIN
	int "SPI2 MISO pin number"
	range 0 31
	help
	  Pin number for MISO

config SPI2_NRF52_ORC
	hex "SPI2 Over Read Character"
	default 0x00
	range 0x00 0xff
	help
	  This option configures the value to send when the TX char count is
	  less than the RX count.

endif # SPI_2

if SPI_3

choice
	prompt "SPI3 Driver type"

config SPI3_NRF52_MASTER
	bool "Master"
	depends on SOC_NRF52840
	help
	  nRF52 SPI3 Master with EasyDMA

endchoice

config SPI3_NRF52_SCK_PIN
	int "SPI3 SCK pin number"
	range 0 31
	help
	  Pin number for SCK

config SPI3_NRF52_MOSI_PIN
	int "SPI3 MOSI pin number"
	range 0 31
	help
	  Pin number to use for MOSI

config SPI3_NRF52_MISO_PIN
	int "SPI3 MISO pin number"
	range 0 31
	help
	  Pin number for MISO

config SPI3_NRF52_CS_PIN
	int "SPI3 CS pin number"
	range 0 255
	default 255
	help
	  HW Chip Select pin number.
	  Not used value is 255 (0xff).

config SPI3_NRF52_ORC
	hex "SPI3 Over Read Character"
	default 0x00
	range 0x00 0xff
	help
	  This option configures the value to send when the TX char count is
	  less than the RX count.

endif # SPI_3

# hidden compile options
config SPI_NRF52_MASTER
	bool
	default y if (SPI0_NRF52_MASTER || SPI1_NRF52_MASTER || SPI2_NRF52_MASTER || SPI3_NRF52_MASTER)

endif # SPI_NRF5
```

## drivers/spi/Kconfig.nrfx
```kconfig
# Copyright (c) 2017 - 2018, Nordic Semiconductor ASA
# SPDX-License-Identifier: Apache-2.0

menuconfig SPI_NRFX
	bool "nRF SPI nrfx drivers"
	default y
	depends on SOC_FAMILY_NORDIC_NRF
	select GPIO
	select PINCTRL
	help
	  Enable support for nrfx SPI drivers for nRF MCU series.

if SPI_NRFX

config SPI_NRFX_SPI
	def_bool y
	depends on DT_HAS_NORDIC_NRF_SPI_ENABLED
	select NRFX_SPI

config SPI_NRFX_SPIM
	def_bool y
	depends on DT_HAS_NORDIC_NRF_SPIM_ENABLED
	select NRFX_SPIM

config SPI_NRFX_SPIS
	def_bool y
	depends on DT_HAS_NORDIC_NRF_SPIS_ENABLED
	select SPI_SLAVE
	select NRFX_SPIS

config SPI_NRFX_RAM_BUFFER_SIZE
	int "Size of RAM buffers for SPIM peripherals"
	default 8
	depends on SPI_NRFX_SPIM
	help
	  Because of using EasyDMA, SPIM peripherals cannot use transmit and
	  receive buffers from all memory locations. They are restricted to
	  buffers located in certain RAM memories only. Therefore, each SPIM
	  driver instance needs to use an intermediate local RAM buffer,
	  to transfer data in chunks not exceeding the size of that buffer,
	  and to copy those chunks between the local buffer and the one
	  specified in the transfer request if the latter is not accessible
	  by EasyDMA.

	  This option specifies the size in bytes of such local RAM buffers
	  for both TX and RX paths. A size of 0 means that this feature should
	  be disabled and the driver user must take care of not making transfer
	  requests with buffers not accessible by EasyDMA since such transfers
	  will fail.

config SPI_NRFX_WAKE_TIMEOUT_US
	int "Maximum time to wait for SPI slave to wake up"
	default 200
	help
	  Maximum amount of time (in microseconds) that SPI master should wait
	  for SPI slave to wake up after the WAKE line is asserted. Used only
	  by instances that have the WAKE line configured (see the wake-gpios
	  devicetree property).

endif # SPI_NRFX
```

## drivers/spi/Kconfig.numaker
```kconfig
# NUMAKER SPI Driver configuration options

# Copyright (c) 2023 Nuvoton Technology Corporation.
# SPDX-License-Identifier: Apache-2.0

config SPI_NUMAKER
	bool "Nuvoton NuMaker MCU SPI driver"
	default y
	select HAS_NUMAKER_SPI
	select PINCTRL
	depends on DT_HAS_NUVOTON_NUMAKER_SPI_ENABLED
	help
	  This option enables the SPI driver for Nuvoton NuMaker family of
	  processors.
	  Say y if you wish to enable NuMaker SPI.

config SPI_NUMAKER_USCI
	bool "Nuvoton NuMaker MCU USCI SPI driver"
	default y
	select HAS_NUMAKER_SPI
	select PINCTRL
	depends on DT_HAS_NUVOTON_NUMAKER_USCI_SPI_ENABLED
	help
	  This option enables the USCI SPI driver for Nuvoton NuMaker family of
	  processors.
	  Say y if you wish to enable NuMaker USCI SPI.
```

## drivers/spi/Kconfig.nxp_s32
```kconfig
# Copyright 2022 NXP
# SPDX-License-Identifier: Apache-2.0

config NXP_S32_SPI
	bool "NXP S32 SPI driver"
	default y
	depends on DT_HAS_NXP_S32_SPI_ENABLED
	select NOCACHE_MEMORY if ARCH_HAS_NOCACHE_MEMORY_SUPPORT
	help
	  Enable support for NXP S32 SPI driver.

if NXP_S32_SPI

config NXP_S32_SPI_INTERRUPT
	bool "NXP S32 SPI Interrupt Support"
	default y
	help
	  Enable Interrupt support for SPI communication.

endif # NXP_S32_SPI
```

## drivers/spi/Kconfig.oc_simple
```kconfig
# Simple SPI Driver configuration options

# Copyright (c) 2019 Western Digital Corporation or its affiliates
# SPDX-License-Identifier: Apache-2.0

menuconfig SPI_OC_SIMPLE
	bool "OpenCores Simple SPI controller driver"
	default y
	depends on DT_HAS_OPENCORES_SPI_SIMPLE_ENABLED
	help
	  Enable the Simple SPI controller

config SPI_OC_SIMPLE_BUS_WIDTH
	def_int 8
	depends on SPI_OC_SIMPLE
```

## drivers/spi/Kconfig.omap
```kconfig
# Copyright 2025 Texas Instruments
# SPDX-License-Identifier: Apache-2.0

config SPI_OMAP_MCSPI
	bool "MCSPI driver for OMAP and K3 devices"
	default y
	depends on DT_HAS_TI_OMAP_MCSPI_ENABLED
	select PINCTRL
	help
	  Enable support for TI OMAP MCSPI driver.
```

## drivers/spi/Kconfig.opentitan
```kconfig
# Copyright (c) 2023 Rivos Inc.
# SPDX-License-Identifier: Apache-2.0

config SPI_OPENTITAN
	bool "OpenTitan SPI controller driver"
	default y
	depends on DT_HAS_LOWRISC_OPENTITAN_SPI_ENABLED
	help
	  Enable the SPI peripherals on OpenTitan
```

## drivers/spi/Kconfig.pic32cxsg
```kconfig
# Microchip PIC32CXSG SERCOM SPI

# Copyright (c) 2024 Microchip
# SPDX-License-Identifier: Apache-2.0

config SPI_SAM0
	bool "Microchip PIC32CXSG series SERCOM SPI driver"
	default y
	depends on DT_HAS_PIC32CXSG_SPI_ENABLED
	select DMA if SPI_ASYNC
	help
	  Enable support for the Microchip PIC32CXSG SERCOM SPI driver.
```

## drivers/spi/Kconfig.pl022
```kconfig
# Copyright (c) 2022 TOKITA Hiroshi <tokita.hiroshi@fujitsu.com>
# SPDX-License-Identifier: Apache-2.0

config SPI_PL022
	default y
	depends on DT_HAS_ARM_PL022_ENABLED
	bool "ARM PL022 SPI driver"

if SPI_PL022

config SPI_PL022_INTERRUPT
	bool "PL022 interrupt mode"
	help
	  Enables interrupt support for PL022 SPI driver.

config SPI_PL022_DMA
	bool "PL022 DMA mode"
	select DMA
	help
	  Enables DMA support for PL022 SPI driver.

endif
```

## drivers/spi/Kconfig.psoc6
```kconfig
# Cypress SCB[SPI] configuration

# Copyright (c) 2021 ATL Electronics
# SPDX-License-Identifier: Apache-2.0

config SPI_PSOC6
	bool "PSOC 6 MCU SCB spi driver"
	default y
	depends on DT_HAS_CYPRESS_PSOC6_SPI_ENABLED
	select USE_INFINEON_SPI
	select PINCTRL
	help
	  This option enables the SCB[SPI] driver for PSOC 6 SoC family.
```

## drivers/spi/Kconfig.pw
```kconfig
# Copyright (c) 2023 Intel Corporation
# SPDX-License-Identifier: Apache-2.0

menuconfig SPI_PW
	bool "Penwell SPI driver"
	default y
	depends on DT_HAS_INTEL_PENWELL_SPI_ENABLED
	help
	  Enable the Penwell SPI driver.

if SPI_PW

config SPI_PW_INTERRUPT
	bool "Penwell SPI Interrupt mode Support"
	help
	  Enable Interrupt support for the SPI Driver.

config SPI_PW_LPSS_DMA
	bool "USE SPI DMA for synchronous Transfers"
	select DMA
	select DMA_INTEL_LPSS
	depends on SPI_PW_INTERRUPT
	help
	  This option enables SPI DMA feature to be used for synchrounous
	  data transfers. All Tx operaton are done using dma channel 0 and
	  all Rx operations are done using dma channel 1.

endif # SPI_PW
```

## drivers/spi/Kconfig.qmsi
```kconfig
# Kconfig.qmsi - QMSI SPI shim driver configuration options

#
# Copyright (c) 2017 Intel Corporation
#
# SPDX-License-Identifier: Apache-2.0
#

menuconfig SPI_QMSI
	bool "QMSI driver for SPI controller"
	depends on QMSI
	default n
	help
	SPI driver implementation using QMSI library. QMSI is the
	Quark Microcontroller Software Interface, providing a common
	interface to the Quark family of microcontrollers.

config SPI_QMSI_SS
	bool "QMSI driver for SPI controller on Sensor Subsystem"
	depends on QMSI
	default n
	help
	SPI driver implementation using QMSI library. This instance is
	for the Sensor Subsystem.

if QMSI_SS

config SPI_SS_INIT_PRIORITY
	int "Init priority"
	default 70
	help
	Device driver initialization priority.

config SPI_SS_CS_GPIO
	bool "SPI port CS pin is controlled via a GPIO port"
	select GPIO
	default n

config	SPI_SS_0
	bool "SPI SS port 0"
	default n
	help
	Enable SPI controller port 0.

if SPI_SS_0

config SPI_SS_0_NAME
	string "SPI SS port 0 device name"
	default "SPI_SS_0"

config SPI_SS_0_IRQ_PRI
	int "Port 0 interrupt priority"

config SPI_SS_0_CS_GPIO_PORT
	string "The GPIO port which is used to control CS"
	depends on SPI_SS_CS_GPIO
	default "GPIO_0"

config SPI_SS_0_CS_GPIO_PIN
	int "The GPIO PIN which is used to act as a CS pin"
	depends on SPI_SS_CS_GPIO
	default 0

endif # SPI_SS_0

config SPI_SS_1
	bool  "SPI SS port 1"
	default n
	help
	Enable SPI controller port 1.

if SPI_SS_1

config SPI_SS_1_NAME
	string "SPI port 1 device name"
	default "SPI_SS_1"

config SPI_SS_1_IRQ_PRI
	int "Port 0 interrupt priority"

config SPI_SS_1_CS_GPIO_PORT
	string "The GPIO port which is used to control CS"
	depends on SPI_SS_CS_GPIO
	default "GPIO_0"

config SPI_SS_1_CS_GPIO_PIN
	int "The GPIO PIN which is used to act as a CS pin"
	depends on SPI_SS_CS_GPIO
	default 0

endif # SPI_SS_1
endif # QMSI_SS
```
