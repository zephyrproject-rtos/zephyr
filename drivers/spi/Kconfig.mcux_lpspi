## drivers/spi/Kconfig.renesas_ra
```kconfig
# Renesas RA Family

# Copyright (c) 2024-2025 Renesas Electronics Corporation
# SPDX-License-Identifier: Apache-2.0

config SPI_RENESAS_RA
	bool "Renesas RA SPI"
	default y
	depends on DT_HAS_RENESAS_RA_SPI_ENABLED
	select USE_RA_FSP_SPI
	select PINCTRL
	help
	  Enable Renesas RA SPI Driver.

if SPI_RENESAS_RA

config SPI_INTERRUPT
	bool "RA MCU SPI Interrupt Support"
	help
	  Enable Interrupt support for the SPI Driver of RA family.

config SPI_RA_DTC
	bool "RA MCU SPI DTC Support"
	select USE_RA_FSP_DTC
	help
	  Enable the SPI DTC mode for SPI instances

config SPI_USE_HW_SS
	bool "RA MCU SPI Hardware Peripheral Select support"
	default y
	depends on !(SOC_SERIES_RA2A1 || SOC_SERIES_RA2L1 || SOC_SERIES_RA4M1)
	help
	  Use Hardware Peripheral Select instead of Software Peripheral Select.

endif # SPI_RENESAS_RA

config SPI_RENESAS_RA_SCI_B
	bool "Renesas RA SCI B SPI"
	default y
	depends on DT_HAS_RENESAS_RA_SPI_SCI_B_ENABLED
	select USE_RA_FSP_SCI_B_SPI
	select PINCTRL
	help
	  Enable Renesas RA SCI B SPI Driver.

if SPI_RENESAS_RA_SCI_B

config SPI_RENESAS_RA_SCI_B_INTERRUPT
	bool
	depends on SPI_ASYNC
	default y
	help
	  Enable Interrupt support for the SCI B SPI Driver of RA family.

config SPI_RENESAS_RA_SCI_B_DTC
	bool
	default y
	depends on SPI_RENESAS_RA_SCI_B_INTERRUPT
	select USE_RA_FSP_DTC
	help
	  Enable DTC (Data Transfer Control) support for the SCI B SPI Driver of RA family.

endif # SPI_RENESAS_RA_SCI_B
```

## drivers/spi/Kconfig.renesas_ra8
```kconfig
# Renesas RA Family

# Copyright (c) 2024 Renesas Electronics Corporation
# SPDX-License-Identifier: Apache-2.0

config SPI_RENESAS_RA8
	bool "Renesas RA SPI B"
	default y
	depends on DT_HAS_RENESAS_RA8_SPI_B_ENABLED
	select USE_RA_FSP_SPI_B
	select PINCTRL
	help
	  Enable Renesas RA RA SPI B Driver.

if SPI_RENESAS_RA8

config SPI_B_INTERRUPT
	bool "RA MCU SPI B Interrupt Support"
	help
	  Enable Interrupt support for the SPI B Driver of RA family.

config SPI_B_DMAC
	bool "RA MCU SPI DMAC Support"
	default $(dt_compat_any_has_prop,$(DT_COMPAT_RENESAS_RA8_SPI_B),dmas)
	select SPI_B_INTERRUPT
	select USE_RA_FSP_DMA
	help
	  Enable DMAC (Direct Memory Access Controller) support for the SPI B Driver
	  of RA8 family. Uses the FSP transfer module (g_transfer_on_dmac) to perform
	  SPI data transfers.

config SPI_B_RA_DTC
	bool "RA MCU SPI DTC Support"
	default $(dt_compat_any_has_prop,$(DT_COMPAT_RENESAS_RA8_SPI_B),rx-dtc,True) || \
		$(dt_compat_any_has_prop,$(DT_COMPAT_RENESAS_RA8_SPI_B),tx-dtc,True)
	select SPI_B_INTERRUPT
	select USE_RA_FSP_DTC
	help
	  Enable the SPI DTC mode for SPI instances

config SPI_B_USE_HW_SS
	bool "RA MCU SPI B Hardware Slave Select support"
	default y
	help
	  Use Slave Select pin instead of software Slave Select.

endif # RA_SPI_B
```

## drivers/spi/Kconfig.renesas_rx
```kconfig
# Copyright (c) 2025 Renesas Electronics Corporation
# SPDX-License-Identifier: Apache-2.0

config SPI_RENESAS_RX
	bool "Renesas RX Series SPI Driver"
	default y
	depends on DT_HAS_RENESAS_RX_RSPI_ENABLED
	select USE_RX_RDP_RSPI
	help
	  Enable Renesas RX series SPI driver.

if SPI_RENESAS_RX

config SPI_RENESAS_RX_INTERRUPT
	bool "RX MCU RSPI Interrupt Support"
	default y
	help
	  Enable Interrupt Support for the RSPI Driver of RX family.

config SPI_RENESAS_RX_USE_HW_SS
	bool "RX MCU RSPI Hardware Slave Select support"
	default y
	help
	  Use Slave Select pin instead of software Slave Select.

config SPI_RENESAS_RX_HIGH_SPEED_READ
	bool "RX MCU RSPI high speed read mode"
	default y
	help
	  Enable high speed read mode of RX RSPI Driver

config SPI_RENESAS_RX_DTC
	bool "RSPI DTC activate"
	default y
	depends on DT_HAS_RENESAS_RX_DTC_ENABLED
	select RENESAS_RX_DTC
	help
	  Use DTC in RX RSPI transfer

config SPI_RENESAS_RX_16BITS_FRAME
	bool "Test loopback: 16 bits"

endif # SPI_RENESAS_RX
```

## drivers/spi/Kconfig.renesas_rz
```kconfig
# Copyright (c) 2024-2025 Renesas Electronics Corporation
# SPDX-License-Identifier: Apache-2.0

config SPI_RENESAS_RZ_RSPI
	bool "Renesas RZ RSPI SPI"
	default y
	depends on DT_HAS_RENESAS_RZ_RSPI_ENABLED
	select USE_RZ_FSP_RSPI_SPI
	select PINCTRL
	help
	  Enable Renesas RZ RSPI SPI Driver.

if SPI_RENESAS_RZ_RSPI

config SPI_RENESAS_RZ_RSPI_INTERRUPT
	bool "RZ RSPI Interrupt Support"
	help
	  Enable Interrupt support for the RSPI.

config SPI_RENESAS_RZ_RSPI_DMAC
	bool "RZ SPI DMA Support"
	select USE_RZ_FSP_DMAC_B
	help
	  Enable the SPI DMA mode for SPI instances

endif # SPI_RENESAS_RZ_RSPI

config SPI_RENESAS_RZ
	bool "Renesas RZ SPI"
	default y
	depends on DT_HAS_RENESAS_RZ_SPI_ENABLED
	select USE_RZ_FSP_SPI
	select PINCTRL
	help
	  Enable Renesas RZ SPI Driver.

config SPI_RENESAS_RZ_SPI_B
	bool "Renesas RZ SPI B"
	default y
	depends on DT_HAS_RENESAS_RZ_SPI_B_ENABLED
	select USE_RZ_FSP_SPI_B
	select PINCTRL
	help
	  Enable Renesas RZ SPI B Driver.

if SPI_RENESAS_RZ || SPI_RENESAS_RZ_SPI_B

config SPI_RENESAS_RZ_USE_INTERRUPT_SELECT
	bool "RZ SPI support interrupt select"
	default y
	depends on SOC_SERIES_RZV2N \
		|| SOC_SERIES_RZV2H
	help
	  Support interrupt select for the SPI.

config SPI_RENESAS_RZ_INTERRUPT
	bool "RZ SPI Interrupt Support"
	help
	  Enable Interrupt support for the SPI.

config SPI_USE_HW_SS
	bool "RZ SPI Hardware Peripheral Select support"
	default y
	help
	  Use Hardware Peripheral Select instead of Software Peripheral Select.

config SPI_RENESAS_RZ_DMA
	bool "RZ SPI DMA Support"
	default n
	select SPI_RENESAS_RZ_INTERRUPT
	select USE_RZ_FSP_DMAC if SOC_SERIES_RZT2L \
			       || SOC_SERIES_RZT2M \
			       || SOC_SERIES_RZN2L

	select USE_RZ_FSP_DMAC_B if SOC_SERIES_RZV2N \
			         || SOC_SERIES_RZV2H
	help
	  Enable the SPI DMA mode for SPI instances

endif # SPI_RENESAS_RZ

if SPI_RTIO
config SPI_RTIO_SQ_SIZE
	int "Number of available submission queue entries"
	default 8 # Sensible default that covers most common spi transactions
	help
	  When RTIO is use with SPI each driver holds a context with which blocking
	  API calls use to perform SPI transactions. This queue needs to be as deep
	  as the longest set of spi_buf_sets used, where normal SPI operations are
	  used (equal length buffers). It may need to be slightly deeper where the
	  spi buffer sets for transmit/receive are not always matched equally in
	  length as these are transformed into normal transceives.

config SPI_RTIO_CQ_SIZE
	int "Number of available completion queue entries"
	default 8 # Sensible default that covers most common spi transactions

endif # SPI_RTIO
```

## drivers/spi/Kconfig.rpi_pico
```kconfig
# Copyright (c) 2023 Stephen Boylan <stephen.boylan@beechwoods.com>
# SPDX-License-Identifier: Apache-2.0

config SPI_RPI_PICO_PIO
	bool "Raspberry Pi Pico PIO SPI controller driver"
	default y
	depends on DT_HAS_RASPBERRYPI_PICO_SPI_PIO_ENABLED
	select PICOSDK_USE_PIO
	select PICOSDK_USE_CLAIM
	select PINCTRL
	help
	  Enable driving SPI via PIO on the Raspberry Pi Pico

if SPI_RPI_PICO_PIO

config SPI_RPI_PICO_PIO_DMA
	bool "Raspberry Pi Pico PIO SPI DMA mode"
	select DMA
	help
	  Enables DMA support for Raspberry Pi Pico PIO SPI driver.
endif
```

## drivers/spi/Kconfig.rts5817
```kconfig
# Copyright (c) 2026 Realtek Semiconductor, Inc.
# SPDX-License-Identifier: Apache-2.0

config SPI_RTS5817
	bool "RTS5817 SPI Controller Driver"
	depends on DT_HAS_REALTEK_RTS5817_SPI_ENABLED
	select PINCTRL
	select SPI_DW
	default y
	help
	  This option enables the SPI controller wrapper driver for RTS5817.
	  The wrapper sits on top of the DesignWare SSI core (spi_dw) and
	  drives DMA-based transfers via the master control register block.

if SPI_RTS5817

config SPI_RTS5817_INTERRUPT
	bool "RTS5817 SPI interrupt mode"
	default y
	help
	  Enables interrupt support for RTS5817 SPI controller wrapper driver.

config HEAP_MEM_POOL_ADD_SIZE_SPI_RTS5817
	int "The heap that RTS5817 SPI controller drivers need"
	default 4096
	help
	  The RTS5817 SPI controller driver uses dynamic memory allocation with
	  k_aligned_alloc(), so the value should >= maximum spi buffer size
	  according to your application.

config SPI_RTS5817_INIT_PRIORITY
	int "RTS5817 SPI wrapper init priority"
	default 51
	help
	  Initialization priority for the RTS5817 SPI wrapper. Must be greater
	  than CONFIG_SPI_INIT_PRIORITY so the underlying snps,designware-spi
	  device is ready (clocks enabled, MMIO mapped) before the wrapper
	  accesses the DW register block.

endif
```
