## drivers/spi/Kconfig.xec_qmspi_ldma
```kconfig
# Microchip XEC QMSPI with LDMA

# Copyright (c) 2021 Microchip Technology Inc.
# SPDX-License-Identifier: Apache-2.0

config SPI_XEC_QMSPI_LDMA
	bool "Microchip XEC QMSPI LDMA driver"
	default y
	depends on DT_HAS_MICROCHIP_XEC_QMSPI_LDMA_ENABLED
	help
	  Enable support for the Microchip XEC QMSPI with local DMA driver.
```

## drivers/spi/Kconfig.xec_qmspi_v2
```kconfig
# Microchip XEC QMSPI V2

# Copyright (c) 2021 Microchip Technology Inc.
# SPDX-License-Identifier: Apache-2.0

config SPI_XEC_QMSPI_V2
	bool "Microchip XEC QMSPI driver"
	default y
	depends on SOC_SERIES_MEC172X
	select DMA if SPI_ASYNC
	help
	  Enable support for the Microchip XEC QMSPI V2 driver.
```

## drivers/spi/Kconfig.xlnx
```kconfig
# Xilinx SPI

# Copyright (c) 2020 Henrik Brix Andersen <henrik@brixandersen.dk>
# SPDX-License-Identifier: Apache-2.0

config SPI_XLNX_AXI_QUADSPI
	bool "Xilinx AXI Quad SPI driver"
	help
	  Enable Xilinx AXI Quad SPI v3.2 driver.
```

## drivers/spi/Kconfig.xlnx_zynq_qspi
```kconfig
# Copyright (c) 2026 Simon Maurer <mail@maurer.systems>
# SPDX-License-Identifier: Apache-2.0

config SPI_XLNX_ZYNQ_QSPI
	bool "Xilinx Zynq Quad SPI driver"
	default y
	depends on DT_HAS_XLNX_ZYNQ_QSPI_ENABLED
	help
	  Enable Xilinx Zynq Quad SPI driver for accessing flash.
```

## drivers/spi/Kconfig.xmc4xxx
```kconfig
# Copyright (c) 2022 Schlumberger
# SPDX-License-Identifier: Apache-2.0

menuconfig SPI_XMC4XXX
	bool "XMC4XX SPI driver"
	default y
	depends on DT_HAS_INFINEON_XMC4XXX_SPI_ENABLED
	select GPIO
	select PINCTRL
	help
	  Enable XMC4XXX SPI driver.


if SPI_XMC4XXX

config SPI_XMC4XXX_INTERRUPT
	bool "XMC4XXX SPI interrupt mode"
	help
	  Enables interrupt support for XMC4XXX SPI driver.

config SPI_XMC4XXX_DMA
	bool "XMC4XXX SPI DMA support"
	select DMA
	help
	  Enables DMA for SPI transfers.

if SPI_XMC4XXX_DMA

config SPI_XMC4XXX_DMA_TIMEOUT_MSEC
	int "Timeout in milliseconds for an SPI transaction to complete if using DMA"
	default 1000
	help
	  Sets timeout in milliseconds for an SPI transaction to complete when using DMA.

endif # SPI_XMC4XXX_DMA

endif # SPI_XMC4XXX
```

## drivers/spi/aps6404l/Kconfig
```kconfig
# Copyright (c) 2025, Ambiq Micro Inc. <www.ambiq.com>
# SPDX-License-Identifier: Apache-2.0

config APS6404L
	bool "APS6404L PSRAM"
	default y
	depends on DT_HAS_APM_APS6404L_ENABLED
	help
	  Enable driver for PSRAM
```

## drivers/spi/spi_nxp_lpspi/Kconfig
```kconfig
# Copyright 2018, 2024-2025 NXP
# SPDX-License-Identifier: Apache-2.0

config SPI_NXP_LPSPI
	bool "NXP LPSPI peripheral"
	default y
	depends on DT_HAS_NXP_LPSPI_ENABLED
	depends on CLOCK_CONTROL
	select PINCTRL
	help
	  Enable driver support for NXP LPSPI.

if SPI_NXP_LPSPI

config SPI_NXP_LPSPI_DMA
	bool "NXP LPSPI DMA-based Driver"
	default y
	select DMA
	depends on $(dt_compat_any_has_prop,$(DT_COMPAT_NXP_LPSPI),dmas)
	help
	  Enable DMA-based transfers for LPSPI peripherals
	  that have a dmas property specified in their DT node.
	  The DMA based driver prioritizes bandwidth over latency, due to
	  DMA being more efficient for larger data transfers, to avoid CPU
	  having to be utilized to do the work. However, setting up a DMA
	  transfer is more complicated setup than just starting the transfer
	  immediately with CPU, so there could be more latency between
	  the point of requesting a transfer and when it actually starts.

config SPI_NXP_LPSPI_CPU
	bool "NXP LPSPI CPU-based driver"
	default y
	depends on $(dt_compat_any_not_has_prop,$(DT_COMPAT_NXP_LPSPI),dmas) || !SPI_NXP_LPSPI_DMA
	depends on !SPI_NXP_LPSPI_CPU_RTIO
	help
	  Enable "normal" CPU based SPI driver for LPSPI.
	  This has lower latency than DMA-based driver but over the
	  longer transfers will likely have less bandwidth and use more CPU time.

config SPI_NXP_LPSPI_CPU_RTIO
	bool "NXP LPSPI RTIO-based driver"
	default y
	depends on $(dt_compat_any_not_has_prop,$(DT_COMPAT_NXP_LPSPI),dmas) || !SPI_NXP_LPSPI_DMA
	depends on SPI_RTIO
	help
	  Enable native RTIO-based driver for LPSPI.
	  This driver optimizes latency by starting/resuming transfers directly
	  from the ISR context in a non-blocking and asynchronous fashion. However,
	  it does not include DMA usage.

config SPI_NXP_LPSPI_TXFIFO_WAIT_CYCLES
	int "Number of CPU cycles to wait on TX fifo empty"
	default 0 if DEBUG
	default 10000
	help
	  This option most likely does not need changed.
	  The drivers tend to need to wait on confirming the transmit command
	  is consumed by the hardware by checking of the TX fifo is emptied.
	  This option gives a maximum number of CPU cycles to wait on that check.
	  The special value of 0 means infinite, which can be useful for debugging
	  for if there is some programming error that causes TX fifo not to empty.
	  The default of 10000 is arbitrary.

if SPI_NXP_LPSPI_CPU_RTIO

config SPI_NXP_RTIO_SQ_SIZE
	int "Number of available submission queue entries"
	default 8 # Sensible default that covers most common spi transactions
	help
	  When RTIO is use with SPI each driver holds a context with which blocking
	  API calls use to perform SPI transactions. This queue needs to be as deep
	  as the longest set of spi_buf_sets used, where normal SPI operations are
	  used (equal length buffers). It may need to be slightly deeper where the
	  spi buffer sets for transmit/receive are not always matched equally in
	  length as these are transformed into normal transceives.

endif # SPI_NXP_LPSPI_CPU_RTIO

endif # SPI_NXP_LPSPI
```

## drivers/stepper/Kconfig
```kconfig
# SPDX-FileCopyrightText: Copyright (c) 2023 Carl Zeiss Meditec AG
# SPDX-License-Identifier: Apache-2.0

menuconfig STEPPER
	bool "Stepper Controller"
	help
	  Enable stepper controller

if STEPPER

module = STEPPER
module-str = stepper
source "subsys/logging/Kconfig.template.log_config"

config STEPPER_INIT_PRIORITY
	int "Stepper Motor Controller init priority"
	default 90
	help
	  Stepper motor controller initialization priority.

config STEPPER_SHELL
	bool "Stepper shell"
	depends on SHELL
	help
	  Enable stepper shell for testing.

comment "Stepper Driver Common"

rsource "step_dir/Kconfig"

comment "Stepper Drivers"

# zephyr-keep-sorted-start
rsource "Kconfig.fake"
rsource "Kconfig.gpio"
rsource "adi_tmc/Kconfig"
rsource "ti/Kconfig"
# zephyr-keep-sorted-stop

endif
```

## drivers/stepper/Kconfig.a4988
```kconfig
# Copyright (c) 2024 Armin Kessler
# SPDX-License-Identifier: Apache-2.0

menu "A4988 stepper driver"

config A4988_STEPPER
	bool "Activate driver for A4988 stepper motor driver"
	depends on DT_HAS_ALLEGRO_A4988_ENABLED
	select POLL
	default y
	help
	  Microstepping motor driver for stepper motors.

endmenu
```

## drivers/stepper/Kconfig.fake
```kconfig
# Fake stepper configuration options

# Copyright (c) 2024 Fabian Blatz <fabianblatz@gmail.com>
# SPDX-License-Identifier: Apache-2.0

config FAKE_STEPPER
	bool "Fake stepper"
	default y
	depends on DT_HAS_ZEPHYR_FAKE_STEPPER_DRIVER_ENABLED || DT_HAS_ZEPHYR_FAKE_STEPPER_CONTROLLER_ENABLED
	help
	  Enable support for the FFF-based fake stepper controller & driver.
```

## drivers/stepper/Kconfig.gpio
```kconfig
# SPDX-FileCopyrightText: Copyright (c) 2024 Carl Zeiss Meditec AG
# SPDX-FileCopyrightText: Copyright (c) 2024 Jilay Sandeep Pandya
# SPDX-License-Identifier: Apache-2.0

config GPIO_STEPPER
	bool "Activate driver for gpio stepper control"
	depends on DT_HAS_ZEPHYR_GPIO_STEPPER_ENABLED
	default y
```

## drivers/stepper/Kconfig.stepper_event_template
```kconfig
# Copyright (c) 2024 Fabian Blatz <fabianblatz@gmail.com>
# SPDX-License-Identifier: Apache-2.0

config STEPPER_$(module)_GENERATE_ISR_SAFE_EVENTS
	bool "$(module-str) guarantee non ISR callbacks upon stepper events"
	help
	  Enable the dispatch of stepper generated events via
	  a message queue to guarantee that the event handler
	  code is not run inside of an ISR. Can be disabled, but
	  then registered stepper event callback must be ISR safe.

config STEPPER_$(module)_EVENT_QUEUE_LEN
	int "$(module-str) maximum number of pending stepper events"
	default 4
	depends on STEPPER_$(module)_GENERATE_ISR_SAFE_EVENTS
	help
	  The maximum number of stepper events that can be pending before new events
	  are dropped.
```

## drivers/stepper/Kconfig.stm32
```kconfig
# Copyright (c) 2020 Teslabs Engineering S.L.
# SPDX-License-Identifier: Apache-2.0

config STEPPER_STM32
	bool "STM32 stepper controller driver"
	depends on SOC_FAMILY_STM32
	select USE_STM32_LL_TIM
	select USE_STM32_LL_RCC
	help
	  Enable stepper controller driver for STM32 SoCs
```

## drivers/stepper/Kconfig.zephyr_stepper_motion_controller
```kconfig
# SPDX-FileCopyrightText: Copyright (c) 2025 Jilay Sandeep Pandya
# SPDX-License-Identifier: Apache-2.0

config ZEPHYR_STEPPER_MOTION_CONTROL
	bool "Zephyr CPU based Stepper motion control"
	depends on DT_HAS_ZEPHYR_STEPPER_MOTION_CONTROL_ENABLED
	select STEPPER_TIMING_SOURCES
	default y

config ZEPHYR_STEPPER_MOTION_CONTROL_GENERATE_ISR_SAFE_EVENTS
	bool "Guarantee non ISR callbacks upon stepper events"
	help
	  Enable the dispatch of stepper generated events via
	  a message queue to guarantee that the event handler
	  code is not run inside of an ISR. Can be disabled, but
	  then registered stepper event callback must be ISR safe.

config ZEPHYR_STEPPER_MOTION_CONTROL_EVENT_QUEUE_LEN
	int "Maximum number of pending stepper events"
	default 4
	depends on ZEPHYR_STEPPER_MOTION_CONTROL_GENERATE_ISR_SAFE_EVENTS
	help
	  The maximum number of stepper events that can be pending before new events
	  are dropped.
```

## drivers/stepper/adi_tmc/Kconfig
```kconfig
# SPDX-FileCopyrightText: Copyright (c) 2024 Carl Zeiss Meditec AG
# SPDX-License-Identifier: Apache-2.0

comment "ADI Trinamic Stepper Drivers"

rsource "bus/Kconfig"

rsource "tmc22xx/Kconfig.tmc22xx"
rsource "tmc50xx/Kconfig.tmc50xx"
rsource "tmc51xx/Kconfig.tmc51xx"
```

## drivers/stepper/adi_tmc/Kconfig.tmc2130
```kconfig
# SPDX-FileCopyrightText: Copyright (c) 2025 Navimatix GmbH
# SPDX-License-Identifier: Apache-2.0

config STEPPER_ADI_TMC2130
	bool "Activate trinamic tmc2209 stepper driver"
	depends on DT_HAS_ADI_TMC2130_ENABLED
	select STEP_DIR_STEPPER
	select STEPPER_ADI_TMC_SPI
	default y
	help
	  Stepper driver for TMC2130, using the step-dir interface with spi configuration.
```

## drivers/stepper/adi_tmc/Kconfig.tmc2130_spi_step_dir
```kconfig
# SPDX-FileCopyrightText: Copyright (c) 2025 Navimatix GmbH
# SPDX-License-Identifier: Apache-2.0

config STEPPER_ADI_TMC2130_SPI_STEP_DIR
	bool "Activate trinamic tmc2209 stepper driver"
	depends on DT_HAS_ADI_TMC2130_SPI_STEP_DIR_ENABLED
	select STEP_DIR_STEPPER
	select STEPPER_ADI_TMC_SPI
	default y
	help
	  Stepper driver for TMC2130, using the spi-step-dir interface.
```

## drivers/stepper/adi_tmc/Kconfig.tmc5041
```kconfig
# SPDX-FileCopyrightText: Copyright (c) 2024 Fabian Blatz <fabianblatz@gmail.com>
# SPDX-License-Identifier: Apache-2.0

config STEPPER_ADI_TMC5041
	bool "Activate trinamic tmc5041 stepper driver"
	depends on DT_HAS_ADI_TMC5041_ENABLED && STEPPER_ADI_TMC
	select STEPPER_ADI_TMC_SPI
	default y
	help
	  Stepper driver for TMC5041.

module = TMC5041
module-str = tmc5041
rsource "Kconfig.tmc_rampgen_template"
```

## drivers/stepper/adi_tmc/Kconfig.tmc50xx
```kconfig
# SPDX-FileCopyrightText: Copyright (c) 2024 Fabian Blatz <fabianblatz@gmail.com>
# SPDX-FileCopyrightText: Copyright (c) 2025 Jilay Sandeep Pandya
# SPDX-License-Identifier: Apache-2.0

config STEPPER_ADI_TMC50XX
	bool "Activate trinamic tmc50xx stepper driver"
	depends on DT_HAS_ADI_TMC50XX_ENABLED && STEPPER_ADI_TMC
	select STEPPER_ADI_TMC_SPI if $(dt_compat_on_bus,$(DT_COMPAT_ADI_TMC50XX),spi)
	default y

module = TMC50XX
module-str = tmc50xx
rsource "Kconfig.tmc_rampgen_template"
```

## drivers/stepper/adi_tmc/Kconfig.tmc51xx
```kconfig
# SPDX-FileCopyrightText: Copyright (c) 2025 Prevas A/S
# SPDX-License-Identifier: Apache-2.0

config STEPPER_ADI_TMC51XX
	bool "Activate trinamic tmc51xx stepper driver"
	depends on DT_HAS_ADI_TMC51XX_ENABLED && STEPPER_ADI_TMC
	select STEPPER_ADI_TMC_SPI
	default y

module = TMC51XX
module-str = tmc51xx
rsource "Kconfig.tmc_rampgen_template"
```

## drivers/stepper/adi_tmc/Kconfig.tmc5xxx
```kconfig
# SPDX-FileCopyrightText: Copyright (c) 2025 Jilay Sandeep Pandya
# SPDX-License-Identifier: Apache-2.0

config ADI_TMC5XXX_STEPPER_DRIVER
	bool "Activate trinamic tmc5xxx stepper driver"
	depends on DT_HAS_ADI_TMC5XXX_STEPPER_DRIVER_ENABLED
	select STEPPER_ADI_TMC_SPI
	default y
```

## drivers/stepper/adi_tmc/Kconfig.tmc_rampgen_template
```kconfig
# SPDX-FileCopyrightText: Copyright (c) 2024 Jilay Sandeep Pandya
# SPDX-License-Identifier: Apache-2.0

config STEPPER_ADI_$(module)_RAMPSTAT_POLL_INTERVAL_IN_MSEC
	int "$(module-str) poll ramp status interval in ms"
	default 100
	help
	  When DIAG0 pin is not available, the driver automatically falls back to
	  polling. This setting controls how frequently (in milliseconds) the driver
	  polls the ramp status register to detect events like position reached, stall
	  or end stop triggered.

config STEPPER_ADI_$(module)_RAMPSTAT_POLL_STALLGUARD_LOG
	bool "log $(module-str) stallguard"
	default n
	help
	  Enable stallguard log while polling rampstat.

config STEPPER_ADI_$(module)_RAMP_GEN
	bool "Use $(module-str) with Ramp Generator"
	depends on STEPPER_ADI_$(module)
	default y
	help
	  Enable ramp generator for trinamic stepper controller.
```

## drivers/stepper/adi_tmc/bus/Kconfig
```kconfig
# SPDX-FileCopyrightText: Copyright (c) 2025 Jilay Sandeep Pandya
# SPDX-License-Identifier: Apache-2.0

config STEPPER_ADI_TMC_SPI
	bool "Use Trinamic Stepper Controller with SPI"
	select SPI
	help
	  A Trinamic Stepper Controller with SPI is enabled

config STEPPER_ADI_TMC_UART
	bool "Use Trinamic Stepper Controller with single wire UART"
	select UART
	help
	  A Trinamic Stepper Controller with single wire UART is enabled
```

## drivers/stepper/adi_tmc/tmc22xx/Kconfig.tmc22xx
```kconfig
# SPDX-FileCopyrightText: Copyright (c) 2024 Fabian Blatz <fabianblatz@gmail.com>
# SPDX-License-Identifier: Apache-2.0

config TMC2209
	bool "ADI Trinamic TMC2209 stepper_drv driver"
	depends on DT_HAS_ADI_TMC2209_ENABLED
	select STEP_DIR_STEPPER
	default y
```

## drivers/stepper/adi_tmc/tmc50xx/Kconfig.tmc50xx
```kconfig
# SPDX-FileCopyrightText: Copyright (c) 2024 Fabian Blatz <fabianblatz@gmail.com>
# SPDX-FileCopyrightText: Copyright (c) 2025 Jilay Sandeep Pandya
# SPDX-License-Identifier: Apache-2.0

config STEPPER_ADI_TMC50XX
	bool "Activate trinamic tmc50xx"
	depends on DT_HAS_ADI_TMC50XX_ENABLED
	select STEPPER_ADI_TMC_SPI
	default y

if STEPPER_ADI_TMC50XX

config STEPPER_ADI_TMC50XX_STEPPER_CTRL
	bool "Activate trinamic tmc50xx motion controller"
	depends on DT_HAS_ADI_TMC50XX_STEPPER_CTRL_ENABLED
	depends on DT_HAS_ADI_TMC50XX_STEPPER_DRIVER_ENABLED
	default y

config STEPPER_ADI_TMC50XX_STEPPER_DRIVER
	bool "Activate trinamic tmc50xx stepper driver"
	depends on DT_HAS_ADI_TMC50XX_STEPPER_DRIVER_ENABLED
	default y

module = TMC50XX
module-str = tmc50xx
source "drivers/stepper/adi_tmc/Kconfig.tmc_rampgen_template"

endif # STEPPER_ADI_TMC50XX
```
