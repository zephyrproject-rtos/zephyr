## drivers/spi/Kconfig.et171
```kconfig
# Kconfig ET171 SPI configuration options
#
# Copyright (c) 2022 Andes Technology Corporation.
# Copyright (c) 2025 Egis Technology Inc.
#
# SPDX-License-Identifier: Apache-2.0
#

config SPI_ET171
	bool "Andes ATCSPI200-based ET171 SPI driver"
	default y
	depends on DT_HAS_ANDESTECH_ET171_ENABLED
	help
	  Enable driver for Andes ATCSPI200-based ET171 SPI controller

if SPI_ET171

	config ANDES_SPI_DMA_MODE
	bool "Enable DMA mode for SPI driver"
	default y
	depends on DMA

endif # SPI_ET171
```

## drivers/spi/Kconfig.flexio
```kconfig
# NXP FlexIO SPI driver configuration options

menuconfig SPI_MCUX_FLEXIO
	bool "NXP FlexIO SPI controller driver"
	depends on HAS_MCUX_FLEXIO && CLOCK_CONTROL
	help
	  Enable FlexIO SPI support.
```

## drivers/spi/Kconfig.gd32
```kconfig
# Copyright (c) 2021 BrainCo Inc.
# SPDX-License-Identifier: Apache-2.0

config SPI_GD32
	bool "Gigadevice GD32 SPI driver"
	default y
	depends on DT_HAS_GD_GD32_SPI_ENABLED
	help
	  Enables Gigadevice GD32 SPI driver.

if SPI_GD32

config SPI_GD32_INTERRUPT
	bool "GD32 MCU SPI Interrupt Support"
	default y if SPI_ASYNC
	default y if SPI_GD32_DMA
	help
	  Enable the interrupt driven mode for SPI instances

config SPI_GD32_DMA
	bool "GD32 MCU SPI DMA Support"
	select DMA
	select SPI_GD32_INTERRUPT
	help
	  Use the DMA for SPI transfer
	  that enable dma channels in their device tree node.

endif # SPI_GD32
```

## drivers/spi/Kconfig.gecko
```kconfig
# Gecko SPI configuration option

# Copyright (c) 2019 Christian Taedcke <hacking@taedcke.com>
# SPDX-License-Identifier: Apache-2.0

config SPI_GECKO
	bool "Gecko SPI controller driver"
	default y
	depends on DT_HAS_SILABS_GECKO_SPI_USART_ENABLED
	depends on GPIO
	select SOC_GECKO_USART
	help
	  Enable the SPI peripherals on Gecko
```

## drivers/spi/Kconfig.gecko_eusart
```kconfig
# Gecko SPI configuration option

# Copyright (c) 2024 Daikin Comfort Technologies North America, Inc.
# SPDX-License-Identifier: Apache-2.0

config SPI_GECKO_EUSART
	bool "Gecko EUSART SPI controller driver"
	default y
	depends on DT_HAS_SILABS_GECKO_SPI_EUSART_ENABLED
	depends on GPIO
	select SOC_GECKO_EUSART
	help
	  Enable the EUSART SPI peripherals on Gecko
```

## drivers/spi/Kconfig.grlib_spictrl
```kconfig
# Copyright (c) 2025 Frontgrade Gaisler AB
# SPDX-License-Identifier: Apache-2.0

config SPI_GRLIB_SPICTRL
	bool "GRLIB SPI controller"
	default y
	depends on DT_HAS_GAISLER_SPICTRL_ENABLED
	help
	  Enable the GRLIB SPICTRL
```

## drivers/spi/Kconfig.grlib_spimctrl
```kconfig
# Copyright (c) 2023 Frontgrade Gaisler AB
# SPDX-License-Identifier: Apache-2.0

config SPI_GRLIB_SPIMCTRL
	bool "GRLIB SPI memory controller"
	depends on SOC_SPARC_LEON
	help
	  Enable the GRLIB SPIMCTRL
```

## drivers/spi/Kconfig.ifx_cat1
```kconfig
# Infineon CAT1 SPI configuration options

# Copyright (c) 2022 Cypress Semiconductor Corporation.
# SPDX-License-Identifier: Apache-2.0

config SPI_INFINEON_CAT1_HAL
	bool "Infineon CAT1 SPI driver"
	default y
	depends on DT_HAS_INFINEON_CAT1_SPI_ENABLED
	depends on USE_INFINEON_LEGACY_HAL
	select USE_INFINEON_SPI
	select PINCTRL
	select GPIO
	help
	  This option enables the Legacy HAL based SPI driver for Infineon CAT1 family.

config SPI_INFINEON_CAT1_PDL
	bool "Infineon CAT1 SPI driver"
	default y
	depends on DT_HAS_INFINEON_CAT1_SPI_ENABLED
	depends on !USE_INFINEON_LEGACY_HAL
	select USE_INFINEON_SPI
	select PINCTRL
	select GPIO
	help
	  This option enables the PDL based SPI driver for Infineon CAT1 family.

if USE_INFINEON_SPI

config IFX_CAT1_SPI_DMA
	bool "Infineon CAT1 SPI Interrupt Support"
	select DMA
	help
		Enable DMA during usage of SPI driver.

config IFX_CAT1_SPI_DMA_TX_AUTO_TRIGGER
	bool "Infineon CAT1 SPI Tx DMA channel trigger mechanism"
	default y
	depends on IFX_CAT1_SPI_DMA
	select DMA
	help
		Automatically trigger SPI Tx DMA after config

endif # USE_INFINEON_SPI
```

## drivers/spi/Kconfig.infineon
```kconfig
# Infineon SPI configuration options

# Copyright (c) 2022 Cypress Semiconductor Corporation.
# SPDX-License-Identifier: Apache-2.0

config SPI_INFINEON_HAL
	bool "Infineon SPI driver"
	default y
	depends on DT_HAS_INFINEON_SPI_ENABLED
	depends on USE_INFINEON_LEGACY_HAL
	select USE_INFINEON_SPI
	select PINCTRL
	select GPIO
	help
	  This option enables the Legacy HAL based SPI driver for Infineon family.

config SPI_INFINEON_PDL
	bool "Infineon SPI driver"
	default y
	depends on DT_HAS_INFINEON_SPI_ENABLED
	depends on !USE_INFINEON_LEGACY_HAL
	select USE_INFINEON_SPI
	select PINCTRL
	select GPIO
	help
	  This option enables the PDL based SPI driver for Infineon family.

if USE_INFINEON_SPI

config SPI_INFINEON_DMA
	bool "Infineon SPI DMA Support"
	select DMA
	help
		Enable DMA during usage of SPI driver.

config IFX_SPI_OVERSAMPLE_DEFAULT
	int "Default SPI oversample value"
	default 16 if SOC_FAMILY_INFINEON_PSOC4
	default 4
	range 1 32
	help
	  Default oversample value for SPI clock generation.
	  Higher values provide better clock accuracy but lower maximum frequency.

config IFX_SPI_MIN_DATA_WIDTH
	int "Minimum SPI data width (bits)"
	default 4 if SOC_FAMILY_INFINEON_EDGE || SOC_FAMILY_INFINEON_PSOC4
	default 8
	range 1 32
	help
	  Minimum supported data width for SPI transactions.
	  Some devices have hardware limitations on minimum data width.

config IFX_SPI_MAX_DATA_WIDTH
	int "Maximum SPI data width (bits)"
	default 16 if SOC_FAMILY_INFINEON_PSOC4
	default 32
	range 4 32
	help
	  Maximum supported data width for SPI transactions.
	  PSoC4 devices typically support up to 16 bits, while others support 32 bits.

endif # USE_INFINEON_SPI
```

## drivers/spi/Kconfig.intel
```kconfig
# Kconfig.intel - Intel SPI driver configuration options
#
#
# Copyright (c) 2015-2016 Intel Corporation
#
# Licensed under the Apache License, Version 2.0 (the "License");
# you may not use this file except in compliance with the License.
# You may obtain a copy of the License at
#
#     http://www.apache.org/licenses/LICENSE-2.0
#
# Unless required by applicable law or agreed to in writing, software
# distributed under the License is distributed on an "AS IS" BASIS,
# WITHOUT WARRANTIES OR CONDITIONS OF ANY KIND, either express or implied.
# See the License for the specific language governing permissions and
# limitations under the License.
#

menuconfig SPI_INTEL
	bool
	prompt "Intel SPI controller driver"
	depends on SPI && CPU_MINUTEIA
	default n
	help
	  Enable support for Intel's SPI controllers. Such controller
	  was formelly found on XScale chips. It can be found nowadays
	  on CEXXXX Intel media controller and Quark CPU (2 of them).

if SPI_INTEL

choice
depends on SPI_INTEL
prompt "Intel SPI interrupt trigger condition"
default SPI_INTEL_RISING_EDGE

config SPI_INTEL_FALLING_EDGE
	bool "Falling edge"
	help
	  "Intel SPI uses falling edge interrupt"

config SPI_INTEL_RISING_EDGE
	bool "Rising edge"
	help
	  "Intel SPI uses rising edge interrupt"

config SPI_INTEL_LEVEL_HIGH
	bool "Level high"
	help
	  "Intel SPI uses level high interrupt"

config SPI_INTEL_LEVEL_LOW
	bool "Level low"
	help
	  "Intel SPI uses level low interrupt"
endchoice


config  SPI_INTEL_CS_GPIO
	bool "SPI port CS pin is controlled via a GPIO port"
	depends on SPI_INTEL && GPIO
	default n

config	SPI_INTEL_PORT_0
	bool
	prompt "Intel SPI port 0"
	depends on SPI_INTEL
	default n
	help
	  Enable Intel's SPI controller port 0.

config  SPI_INTEL_PORT_0_DRV_NAME
	string
	prompt "Intel SPI port 0 device name"
	depends on SPI_INTEL_PORT_0
	default "SPI_0"

config  SPI_INTEL_PORT_0_PRI
	int
	prompt "Port 0 interrupt priority"
	depends on SPI_INTEL_PORT_0

config  SPI_INTEL_PORT_0_CS_GPIO_PORT
	string
	prompt "The GPIO port which is used to control CS"
	depends on SPI_INTEL_PORT_0 && SPI_INTEL_CS_GPIO
	default GPIO_DW_0_NAME

config  SPI_INTEL_PORT_0_CS_GPIO_PIN
	int "The GPIO PIN which is used to act as a CS pin"
	depends on SPI_INTEL_PORT_0 && SPI_INTEL_CS_GPIO
	default 0

config  SPI_INTEL_PORT_1
	bool
	prompt "Intel SPI port 1"
	depends on SPI_INTEL
	default n
	help
	  Enable Intel's SPI controller port 1.

config  SPI_INTEL_PORT_1_DRV_NAME
	string
	prompt "Intel SPI port 1 device name"
	depends on SPI_INTEL_PORT_1
	default "SPI_1"

config  SPI_INTEL_PORT_1_PRI
	int
	prompt "Port 0 interrupt priority"
	depends on SPI_INTEL_PORT_1

config  SPI_INTEL_PORT_1_CS_GPIO_PORT
	string
	prompt "The GPIO port which is used to control CS"
	depends on SPI_INTEL_PORT_1 && SPI_INTEL_CS_GPIO
	default GPIO_DW_0_NAME

config  SPI_INTEL_PORT_1_CS_GPIO_PIN
	int "The GPIO PIN which is used to act as a CS pin"
	depends on SPI_INTEL_PORT_1 && SPI_INTEL_CS_GPIO
	default 0

endif # SPI_INTEL
```

## drivers/spi/Kconfig.iproc
```kconfig
# Copyright (c) 2020, Broadcom
# Copyright (c) 2024, Meta Platforms
# SPDX-License-Identifier: Apache-2.0

config SPI_IPROC_QSPI
	bool "Broadcom iProc QSPI driver"
	default y
	depends on DT_HAS_BRCM_IPROC_QSPI_ENABLED
	help
	  Enable support for Broadcom iProc QSPI driver.
```

## drivers/spi/Kconfig.it51xxx
```kconfig
# Copyright (c) 2025 ITE Corporation.
# SPDX-License-Identifier: Apache-2.0

config SPI_ITE_IT51XXX
	bool "ITE IT51XXX SPI Driver"
	default y
	depends on DT_HAS_ITE_IT51XXX_SPI_ENABLED
	select PINCTRL
	help
	  Enable support for the ITE IT51XXX SPI host (SSPI) driver.

if SPI_ITE_IT51XXX

config SPI_ITE_IT51XXX_FIFO_MODE
	bool "ITE IT51XXX Shared/Group FIFO Mode Support"
	select SOC_IT51XXX_CPU_IDLE_GATING
	default y
	help
	  Enable ITE IT51XXX shared and group FIFO mode. Due to hardware
	  limitations, FIFO mode is only supported under the following
	  conditions: (1) SPI mode 0 (CPOL = 0, CPHA = 0) (2) chip select
	  0 is used (3) the number of bytes in both TX and RX transactions
	  is even and less than SPI_ITE_IT51XXX_FIFO_SIZE (the FIFO size
	  setting) (4) the clock source is set to the PLL frequency for
	  group fifo mode. If the transaction doesn't meet these
	  requirements, the driver automatically switches to PIO mode for
	  the transfer.

config SPI_ITE_IT51XXX_FIFO_SIZE
	int "ITE IT51XXX Shared/Group FIFO Size"
	depends on SPI_ITE_IT51XXX_FIFO_MODE
	range 2 2046
	default 128
	help
	  Set IT51XXX FIFO size. The maximum settable value, as per the
	  hardware design, is 2046.

endif # SPI_ITE_IT51XXX
```

## drivers/spi/Kconfig.it8xxx2
```kconfig
# Copyright (c) 2024 ITE Corporation.
# SPDX-License-Identifier: Apache-2.0

config SPI_ITE_IT8XXX2
	bool "ITE IT8XXX2 SPI Driver"
	default y
	depends on DT_HAS_ITE_IT8XXX2_SPI_ENABLED
	select PINCTRL
	select SOC_IT8XXX2_CPU_IDLE_GATING
	help
	  Enable support for the ITE IT8XXX2 SPI host(SSPI) driver.
```

## drivers/spi/Kconfig.k64
```kconfig
# Kconfig.k64 - K64 SPI driver configuration options
#
#
# Copyright (c) 2016 Intel Corporation
# Copyright (c) 2016 Wind River Systems, Inc.
#
# Licensed under the Apache License, Version 2.0 (the "License");
# you may not use this file except in compliance with the License.
# You may obtain a copy of the License at
#
#     http://www.apache.org/licenses/LICENSE-2.0
#
# Unless required by applicable law or agreed to in writing, software
# distributed under the License is distributed on an "AS IS" BASIS,
# WITHOUT WARRANTIES OR CONDITIONS OF ANY KIND, either express or implied.
# See the License for the specific language governing permissions and
# limitations under the License.
#

menuconfig SPI_K64
	bool
	prompt "Freescale K64-based SPI controller driver"
	depends on SPI && SOC_MK64F12
	default n
	help
	  Enable support for Freescale K64-based SPI controllers.

if SPI_K64

config SPI_K64_0
	bool "Freescale K64-based SPI Module 0"
	depends on SPI_K64
	default n
	help
	  Enable config options for Freescale K64-based SPI Module 0.

config SPI_K64_0_DEV_NAME
	string "Freescale K64-based SPI Module 0 device name"
	depends on SPI_K64_0
	default "SPI_K64_0"
	help
	  Specify the device name.

config SPI_K64_0_PRI
	int "Freescale K64-based SPI Module 0 interrupt priority"
	depends on SPI_K64_0
	default 2
	help
	  K64 SPI Module 0 IRQ priority

config SPI_K64_1
	bool "Freescale K64-based SPI Module 1"
	depends on SPI_K64
	default n
	help
	  Enable config options for Freescale K64-based SPI Module 1.

config SPI_K64_1_DEV_NAME
	string "Freescale K64-based SPI Module 1 device name"
	depends on SPI_K64_1
	default "SPI_K64_1"
	help
	  Specify the device name.

config SPI_K64_1_PRI
	int "Freescale K64-based SPI Module 1 interrupt priority"
	depends on SPI_K64_1
	default 2
	help
	  K64 SPI Module 1 IRQ priority

config SPI_K64_2
	bool "Freescale K64-based SPI Module 2"
	depends on SPI_K64
	default n
	help
	  Enable config options for Freescale K64-based SPI Module 2.

config SPI_K64_2_DEV_NAME
	string "Freescale K64-based SPI Module 2 device name"
	depends on SPI_K64_2
	default "SPI_K64_2"
	help
	  Specify the device name.

config SPI_K64_2_PRI
	int "Freescale K64-based SPI Module 2 interrupt priority"
	depends on SPI_K64_2
	default 2
	help
	  K64 SPI Module 0 IRQ priority

endif # SPI_K64
```

## drivers/spi/Kconfig.kb1200
```kconfig
# SPI driver configuration options

# Copyright (c) 2023 ENE Technology

config SPI_KB1200
	bool "KB1200 spi driver"
	depends on SOC_ENE_KB1200
	help
	  This option enables the KB1200 spi driver.
```

## drivers/spi/Kconfig.litex
```kconfig
# LiteX SPI (LiteSPI) configuration option

# Copyright (c) 2019 Antmicro <www.antmicro.com>
# SPDX-License-Identifier: Apache-2.0

config SPI_LITEX
	bool "LiteX SPI controller driver"
	default y
	depends on DT_HAS_LITEX_SPI_ENABLED
	help
	  Enable the SPI peripherals on LiteX

config SPI_LITEX_LITESPI
	bool "LiteX SPI LiteSPI controller driver"
	default y
	depends on DT_HAS_LITEX_SPI_LITESPI_ENABLED
	help
	  Enable the SPI peripherals on LiteX
```

## drivers/spi/Kconfig.max32
```kconfig
# Copyright (c) 2024 Analog Devices, Inc.
# SPDX-License-Identifier: Apache-2.0

config SPI_MAX32
	bool "MAX32 MCU SPI controller driver"
	default y
	depends on DT_HAS_ADI_MAX32_SPI_ENABLED
	help
	  Enable SPI support on the MAX32 family of processors.

if SPI_MAX32

config SPI_MAX32_INTERRUPT
	bool "MAX32 MCU SPI Interrupt Support"
	help
	  Enable interrupt support for MAX32 MCU SPI driver.

endif # SPI_MAX32
```

## drivers/spi/Kconfig.mchp
```kconfig
# Copyright (c) 2026 Microchip Technology Inc.
# SPDX-License-Identifier: Apache-2.0

config SPI_MCHP_SERCOM
	bool
	help
	  Common options for Microchip SPI SERCOM drivers.

config SPI_MCHP_SERCOM_G1
	bool
	default y
	depends on DT_HAS_MICROCHIP_SERCOM_G1_SPI_ENABLED
	select PINCTRL
	select GPIO
	select SPI_MCHP_SERCOM
	help
	  Enable support for the Microchip SERCOM SPI driver.

if SPI_MCHP_SERCOM

config SPI_MCHP_INTER_CHARACTER_SPACE
	int "Microchip SERCOM SPI Inter-Character Spacing (in clock cycles)"
	default 63 if SPI_SLAVE
	default 0
	range 0 63
	depends on SOC_FAMILY_MICROCHIP_SAM_D5X_E5X
	help
	  Number of clock cycles to delay between characters on SPI bus.

config SPI_MCHP_DMA_DRIVEN
	bool "Microchip SPI DMA Mode"
	default y
	depends on DMA
	depends on $(dt_compat_all_has_prop,$(DT_COMPAT_MICROCHIP_SERCOM_G1_SPI),dmas)
	help
	  This enables DMA driven transfers for the SPI peripheral.
	  Requires DMA controller and dmas property in device tree.

endif # SPI_MCHP_SERCOM
```

## drivers/spi/Kconfig.mchp_mss
```kconfig
# Microchip Polarfire SOC SPI

# Copyright (c) 2022 Microchip Technology Inc.
# SPDX-License-Identifier: Apache-2.0

config SPI_MCHP_MSS
	bool "Microchip Polarfire SOC SPI driver"
	default y
	depends on DT_HAS_MICROCHIP_MPFS_SPI_ENABLED
	help
	  Enable support for the Polarfire SOC SPI driver.
```

## drivers/spi/Kconfig.mchp_mss_qspi
```kconfig
# Microchip Polarfire SOC QSPI

# Copyright (c) 2022 Microchip Technology Inc.
# SPDX-License-Identifier: Apache-2.0

config SPI_MCHP_QSPI
	bool "Microchip Polarfire SOC QSPI driver"
	default y
	depends on DT_HAS_MICROCHIP_MPFS_QSPI_ENABLED
	help
	  Enable support for the Polarfire SOC QSPI driver.
```
