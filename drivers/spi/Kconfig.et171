## drivers/spi/Kconfig.mcux
```kconfig
# Kconfig - MCUXpresso SDK SPI
#
# Copyright (c) 2016, Freescale Semiconductor, Inc.
# Copyright (c) 2017, NXP
#
# SPDX-License-Identifier: Apache-2.0
#

menuconfig SPI_MCUX
	bool
	prompt "MCUX SPI driver"
	depends on SPI && HAS_MCUX
	default n
	help
	Enable support for mcux spi driver.

if SPI_MCUX

config SPI_MCUX_BUF_SIZE
	int "Number of bytes in the local buffer"
	default 16
	help
	The mcux driver requires that the rx and tx buffers are the same
	length, however the Zephyr spi interface allows them to be different.
	When they are different, the mcux shim driver uses a local buffer. This
	option defines the size of the local buffer.

config SPI_MCUX_DUMMY_CHAR
	hex "Dummy character"
	default 0x00
	range 0x00 0xff
	help
	This option configures what value to send when the tx buffer length is
	less than the rx buffer length.

endif # SPI_MCUX
```

## drivers/spi/Kconfig.mcux_dspi
```kconfig
# MCUXpresso SDK SPI

# Copyright (c) 2016, Freescale Semiconductor, Inc.
# Copyright (c) 2017, 2021, NXP
# SPDX-License-Identifier: Apache-2.0

config SPI_MCUX_DSPI
	bool "MCUX SPI driver"
	depends on HAS_MCUX && CLOCK_CONTROL
	select PINCTRL
	help
	  Enable support for mcux spi driver.

if SPI_MCUX_DSPI

config DSPI_MCUX_EDMA
	bool "ENABLE EDMA for DSPI driver"
	depends on HAS_MCUX && HAS_MCUX_EDMA
	help
	  Enable the MCUX DSPI driver.

if DSPI_MCUX_EDMA

config MCUX_DSPI_BUFFER_SIZE
	int "buffer size"
	default 144
	help
	  data buffer size

config MCUX_DSPI_EDMA_SHUFFLE_DATA
	bool "use the internal data process"
	default y
	help
	  TX data need pre-fix with command, user can choose not to use it

endif # DSPI_MCUX_EDMA

endif # SPI_MCUX_DSPI
```

## drivers/spi/Kconfig.mcux_flexcomm
```kconfig
# Copyright (c) 2016, Freescale Semiconductor, Inc.
# Copyright (c) 2017-2020, NXP
# SPDX-License-Identifier: Apache-2.0

config SPI_MCUX_FLEXCOMM
	bool "MCUX FLEXCOMM SPI driver"
	default y
	depends on DT_HAS_NXP_LPC_SPI_ENABLED
	select PINCTRL
	select RESET
	help
	  Enable support for mcux flexcomm spi driver.

if SPI_MCUX_FLEXCOMM
config SPI_MCUX_FLEXCOMM_DMA
	bool "MCUX FLEXCOMM SPI DMA Support"
	select DMA
	help
	  Enable the SPI DMA mode for SPI instances
	  that enable dma channels in their device tree node.

config SPI_MCUX_FLEXCOMM_DMA_MAX_BLOCKS
	int "MCUX FLEXCOMM SPI DMA Blocks Available"
	range 2 100
	depends on SPI_MCUX_FLEXCOMM_DMA
	default 6
	help
	  Specifies the number of DMA blocks available for SPI transfer. Enough
	  DMA blocks must be configured to handle all of the buffers in the
	  transfer buffer set. If tx and rx buffers are not the same size, an
	  additional block is needed for each set. A separate block is needed
	  for the last word so that a final one word buffer can be used to set the
	  end of transfer bit which will release the CS.

endif # SPI_MCUX_FLEXCOMM
```

## drivers/spi/Kconfig.mcux_flexcomm_nb
```kconfig
# Copyright (c) 2016, Freescale Semiconductor, Inc.
# Copyright (c) 2017-2020, NXP
# SPDX-License-Identifier: Apache-2.0

config SPI_MCUX_FLEXCOMM_NB
	bool "MCUX FLEXCOMM SPI driver"
	default y
	depends on DT_HAS_NXP_LPC_SPI_ENABLED
	select PINCTRL
	select RESET
	help
	  Enable support for mcux flexcomm spi driver.

if SPI_MCUX_FLEXCOMM_NB
	config SPI_MCUX_FLEXCOMM_DMA
		bool "MCUX FLEXCOMM SPI DMA Support"
		select DMA
		help
		  Enable the SPI DMA mode for SPI instances
		  that enable dma channels in their device tree node.

	if SPI_MCUX_FLEXCOMM_DMA && SPI_ASYNC
		config DMA_NO_WAIT
			bool "Don't wait for DMA transfer to finish"
			default n
			help
				By default the SPI_MCUX_FLEXCOMM driver waits for the
				DMA transfer to be done and the SPI TX FIFO to be empty.
				When this option is enabled, the driver will not wait
				to finish and will return immediately.
	endif # SPI_MCUX_FLEXCOMM_DMA && SPI_ASYNC

endif # SPI_MCUX_FLEXCOMM
```

## drivers/spi/Kconfig.mcux_flexio
```kconfig
# Copyright (c) 2024, STRIM, ALC
# SPDX-License-Identifier: Apache-2.0

config SPI_MCUX_FLEXIO
	bool "MCUX FlexIO SPI driver"
	default y
	depends on DT_HAS_NXP_FLEXIO_SPI_ENABLED
	depends on CLOCK_CONTROL
	select MCUX_FLEXIO
	select PINCTRL
	help
	  Enable support for MCUX FlexIO SPI driver.
```
