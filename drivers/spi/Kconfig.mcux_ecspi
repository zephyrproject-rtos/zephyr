## drivers/spi/Kconfig.mcux_ecspi
```kconfig
# Copyright (c) 2024, Basalte bv
# SPDX-License-Identifier: Apache-2.0

config SPI_MCUX_ECSPI
	bool "MCUX ECSPI driver"
	default y
	depends on DT_HAS_NXP_IMX_ECSPI_ENABLED
	depends on CLOCK_CONTROL
	select PINCTRL
	help
	  Enable support for NXP's mcux ecspi driver.

config SPI_MCUX_ECSPI_FIFO_WORDS
	int "FIFO words per HAL transfer"
	depends on SPI_MCUX_ECSPI
	range 1 64
	default 1
	help
	  FIFO words handed to the MCUX driver at once, each carrying a burst of up to 32 bits. With
	  more words, its interrupt handler keeps the FIFOs filled and a transfer takes fewer
	  interrupts, at the cost of two buffers of this many 32-bit words per instance. With more
	  than one word in flight, an RX FIFO overflow fails the transfer with -EIO.
```

## drivers/spi/Kconfig.nxp_kinetis_l
```kconfig
# Copyright (c) 2026 Gabriel Ivo <gabriel.bozi@usp.br>
# SPDX-License-Identifier: Apache-2.0

config SPI_NXP_KINETIS
	bool "NXP Kinetis SPI driver"
	default y
	depends on DT_HAS_NXP_KINETIS_L_SPI_ENABLED
	help
	  Enable support for the NXP Kinetis SPI peripheral.
```

## drivers/spi/Kconfig.sc18is60x
```kconfig
# Copyright (c) 2026 tinyvision.ai
# SPDX-License-Identifier: Apache-2.0

config SPI_SC18IS60X
	bool "NXP SC18IS602/SC18IS606 SPI controller driver"
	default y
	select MFD
	depends on DT_HAS_NXP_SC18IS60X_SPI_ENABLED || DT_HAS_NXP_SC18IS606_SPI_ENABLED
	help
	  Enable the SPI controller child of an NXP SC18IS60x I2C-to-SPI
	  bridge (SC18IS602/SC18IS602B or SC18IS606).

if SPI_SC18IS60X

config SPI_SC18IS60X_INIT_PRIORITY
	int "SC18IS60x SPI init priority"
	default 99
	help
	  SC18IS60x SPI controller initialization priority

	  Note: Has to be greater than the parent SC18IS60x bridge init
	  priority.

endif
```

## drivers/spi/Kconfig.spinalhdl_xdr
```kconfig
# Copyright (c) 2026 Arkadiusz Grzelka
# SPDX-FileCopyrightText: Copyright The Zephyr Project Contributors
# SPDX-License-Identifier: Apache-2.0

config SPI_SPINALHDL_XDR
	bool "SpinalHDL SpiXdrMasterCtrl SPI controller driver"
	default y
	depends on DT_HAS_SPINALHDL_SPI_XDR_MASTER_CTRL_ENABLED
	help
	  Enable the polled driver for the SpinalHDL SpiXdrMasterCtrl SPI
	  controller found in the Efinix Sapphire RISC-V SoC.
```

## drivers/spi/Kconfig.stm32
```kconfig
# STM32 SPI driver configuration options

# Copyright (c) 2015-2016 Intel Corporation
# SPDX-License-Identifier: Apache-2.0

menuconfig SPI_STM32
	bool "STM32 MCU SPI controller driver"
	default y
	depends on DT_HAS_ST_STM32_SPI_ENABLED
	select PINCTRL
	select GPIO if $(dt_compat_any_has_prop,$(DT_COMPAT_ST_STM32_SPI),cs-gpios)
	help
	  Enable SPI support on the STM32 family of processors.

if SPI_STM32

config SPI_STM32_INTERRUPT
	bool "STM32 MCU SPI Interrupt Support"
	default y if SPI_RTIO
	help
	  Enable Interrupt support for the SPI Driver of STM32 family.

config SPI_STM32_DMA
	bool "STM32 MCU SPI DMA Support"
	select DMA
	select CACHE_MANAGEMENT if DCACHE
	help
	  Enable the SPI DMA mode for SPI instances
	  that enable dma channels in their device tree node.
	  This can be used with the SPI_RTIO config to have SPI
	  transactions using DMA + RTIO

config SPI_STM32_DMA_CACHED_MEMORY
	bool "DMA transfers with buffers in cacheable memory (STM32U5)"
	depends on SPI_STM32_DMA && DCACHE && !SPI_RTIO
	depends on SOC_SERIES_STM32U5X
	help
	  Let the DMA move buffers placed in cacheable memory, for example
	  external PSRAM behind the DCACHE, instead of falling back to the
	  interrupt or polling mode for them. The driver cleans and invalidates
	  the data cache over the bytes the DMA moves. An RX buffer in cacheable
	  memory goes to the DMA only if its start and length are multiples of
	  the data cache line size; other RX buffers still use the fallback.

	  STM32U5 only: tested there.

	  Several transfers under one held chip select (SPI_HOLD_ON_CS) with a
	  transfer through interrupts or polling after the first one need the
	  st,gpio-control devicetree property (AFCNTR, the HAL's
	  MasterKeepIOState): the driver turns the SPI off between them to set
	  the transfer size, and the released pins can shift the data.

config SPI_STM32_ERRATA_BUSY
	bool
	default y
	depends on SOC_SERIES_STM32F7X || SOC_SERIES_STM32L4X
	help
	  Handles erratum "BSY bit may stay high at the end of a data
	  transfer in slave mode".
	  Seen for instance in Errata Sheet 0290 §2.11.2

if SPI_STM32_ERRATA_BUSY

config SPI_STM32_BUSY_FLAG_TIMEOUT
	int "timeout in us for the STM32 busy flag workaround"
	default 10000
	help
	  Maximum time in microseconds to wait for the SPI BSY (busy) flag
	  to clear after a DMA transfer, as a workaround for the errata on
	  STM32F7 and STM32L4 devices where BSY may remain set after the
	  last byte is transmitted in peripheral mode.
	  The driver polls the BSY and TXE flags using k_yield() between
	  iterations. If the flag does not clear within this time the
	  driver continues regardless; increase this value on heavily
	  loaded systems or when operating at low SPI clock rates.

endif # SPI_STM32_ERRATA_BUSY

if SPI_RTIO

config SPI_STM32_RTIO_SQ_SIZE
	int "Number of available submission queue entries"
	default 8 # Sensible default that covers most common SPI transactions
	help
	  When RTIO is used with SPI, each driver holds a context whose blocking API
	  calls are used to perform SPI transactions. This queue needs to be as deep
	  as the longest set of spi_buf_set used, where normal SPI operations are
	  used (equal length buffers). It may need to be slightly deeper where the
	  SPI buffers set for transmit/receive do not always matched equally in
	  length as these are transformed into normal transceives.

config SPI_STM32_RTIO_CQ_SIZE
	int "Number of available completion queue entries"
	default 8 # Sensible default that covers most common SPI transactions
	help
	  When RTIO is used with SPI, each driver holds a context whose blocking API
	  calls are used to perform SPI transactions. This queue needs to be as deep
	  as the longest set of spi_buf_set used, where normal SPI operations are
	  used (equal length buffers). It may need to be slightly deeper where the
	  SPI buffers set for transmit/receive do not always matched equally in
	  length as these are transformed into normal transceives.

endif # SPI_RTIO

endif # SPI_STM32
```

## drivers/spi/Kconfig.virtio
```kconfig
# SPDX-FileCopyrightText: Copyright The Zephyr Project Contributors
# SPDX-License-Identifier: Apache-2.0

config SPI_VIRTIO
	bool "VIRTIO SPI driver"
	default y
	depends on DT_HAS_VIRTIO_SPI_ENABLED
	select VIRTIO
	help
	  Enable driver for VIRTIO SPI devices.
```

## drivers/spi/Kconfig.wch
```kconfig
# Copyright (c) 2025 MASSDRIVER EI (massdriver.space)
# SPDX-License-Identifier: Apache-2.0

config SPI_WCH
	bool "WCH SPI Controller"
	select SPI_ASYNC_NOT_SUPPORTED
	default y
	depends on DT_HAS_WCH_SPI_ENABLED
	help
	  Enable the SPI peripherals on CH32s
```

## drivers/spi/Kconfig.xlnx_zynqmp_gqspi
```kconfig
# Xilinx SPI

# Copyright (c) 2020 Henrik Brix Andersen <henrik@brixandersen.dk>
# SPDX-License-Identifier: Apache-2.0

config SPI_XLNX_ZYNQMP_GQSPI
	bool "AMD Xilinx ZynqMP/Versal GQSPI driver"
	default y
	depends on DT_HAS_XLNX_ZYNQMP_QSPI_1_0_ENABLED || DT_HAS_XLNX_VERSAL_QSPI_1_0_ENABLED
	select EVENTS
	help
	  Enable AMD Xilinx ZynqMP and Versal Generic Quad SPI driver.
	  This is normally used with QSPI flash devices but can also be used
	  with other SPI devices. Single, dual, and quad line transfers are
	  supported when SPI_EXTENDED_MODES is enabled.
```

## drivers/stepper/adi_tmc/tmc2300/Kconfig.tmc2300
```kconfig
# SPDX-FileCopyrightText: Copyright (c) 2026 Swarovski Optik AG & Co. KG
# SPDX-License-Identifier: Apache-2.0

config STEPPER_ADI_TMC2300
	bool "Activate trinamic tmc2300 stepper driver"
	depends on DT_HAS_ADI_TMC2300_ENABLED
	select STEP_DIR_STEPPER
	select STEPPER_ADI_TMC_UART
	default y
	help
	  Stepper driver for TMC2300, configured via single wire UART.
```

## drivers/stepper/adi_tmc/tmc522x/Kconfig.tmc522x
```kconfig
# SPDX-FileCopyrightText: Copyright (c) 2026 Cherrence Sarip <Cherrence.sarip@analog.com>
# SPDX-License-Identifier: Apache-2.0

config STEPPER_ADI_TMC522X
	bool "Activate trinamic TMC522x stepper driver"
	depends on DT_HAS_ADI_TMC522X_ENABLED
	select GPIO
	select I2C if $(dt_compat_on_bus,$(DT_COMPAT_ADI_TMC522X),i2c)
	select SPI if $(dt_compat_on_bus,$(DT_COMPAT_ADI_TMC522X),spi)
	select STEPPER_ADI_TMC_I2C if $(dt_compat_on_bus,$(DT_COMPAT_ADI_TMC522X),i2c)
	select STEPPER_ADI_TMC_SPI if $(dt_compat_on_bus,$(DT_COMPAT_ADI_TMC522X),spi)
	default y
	help
	  Driver for TMC522x family stepper motor controllers:
	  - TMC5221 (SPI variant)
	  - TMC5222 (I2C variant)
	  Automatically selects the appropriate bus driver based on devicetree
	  configuration. Provides register read/write access via SPI or I2C interface.
	  Uses the common Trinamic bus abstraction layer.

if STEPPER_ADI_TMC522X

config STEPPER_ADI_TMC522X_STEPPER_CTRL
	bool "Activate trinamic TMC522x motion controller"
	depends on DT_HAS_ADI_TMC522X_STEPPER_CTRL_ENABLED
	default y

config STEPPER_ADI_TMC522X_STEPPER_DRIVER
	bool "Activate trinamic TMC522x stepper driver"
	depends on DT_HAS_ADI_TMC522X_STEPPER_DRIVER_ENABLED
	default y

config TMC522X_BUS_SPI
	bool
	default y
	depends on $(dt_compat_on_bus,$(DT_COMPAT_ADI_TMC522X),spi)

config TMC522X_BUS_I2C
	bool
	default y
	depends on $(dt_compat_on_bus,$(DT_COMPAT_ADI_TMC522X),i2c)

module = TMC522X
module-str = tmc522x
source "drivers/stepper/adi_tmc/Kconfig.tmc_rampgen_template"

endif # STEPPER_ADI_TMC522X
```

## drivers/stepper/adi_tmc/tmc5241/Kconfig.tmc5241
```kconfig
# Copyright (c) 2026
# SPDX-License-Identifier: Apache-2.0

config STEPPER_ADI_TMC5241
	bool "TMC5241/TMC2241 stepper driver"
	default y
	depends on DT_HAS_ADI_TMC5241_ENABLED || DT_HAS_ADI_TMC2241_ENABLED
	select STEPPER_ADI_TMC_SPI if $(dt_compat_on_bus,$(DT_COMPAT_ADI_TMC5241),spi) || \
					$(dt_compat_on_bus,$(DT_COMPAT_ADI_TMC2241),spi)
	select STEPPER_ADI_TMC_UART if $(dt_compat_on_bus,$(DT_COMPAT_ADI_TMC5241),uart) || \
					$(dt_compat_on_bus,$(DT_COMPAT_ADI_TMC2241),uart)
	help
	  Enable support for the ADI/Trinamic TMC5241 (controller+driver) and
	  TMC2241 (driver-only) stepper ICs. One driver source tree serves
	  both compatibles - non-ramp registers are identical between the two
	  chips and the ramp-generator block is purely additive on TMC5241.

if STEPPER_ADI_TMC5241

config STEPPER_ADI_TMC5241_STEPPER_DRIVER
	bool "Activate trinamic tmc5241/tmc2241 stepper driver"
	default y
	depends on DT_HAS_ADI_TMC5241_STEPPER_DRIVER_ENABLED
	help
	  stepper.h child device. Present for both TMC5241 and TMC2241 parents.

config STEPPER_ADI_TMC5241_STEPPER_CTRL
	bool "Activate trinamic tmc5241 motion controller"
	default y
	depends on DT_HAS_ADI_TMC5241_STEPPER_CTRL_ENABLED
	depends on DT_HAS_ADI_TMC5241_STEPPER_DRIVER_ENABLED
	help
	  stepper_ctrl.h child device. Only ever instantiated under an
	  adi,tmc5241 parent - TMC2241 boards simply have no such DT child,
	  so this symbol is never enabled for TMC2241-only builds. Also
	  requires the stepper-driver child (motion control alone can't
	  enable/disable the coils or set microstep resolution).

module = TMC5241
module-str = tmc5241
source "drivers/stepper/adi_tmc/Kconfig.tmc_rampgen_template"

endif # STEPPER_ADI_TMC5241
```

## drivers/timer/Kconfig.amd_acp_timer
```kconfig
# SPDX-FileCopyrightText: Copyright (c) 2026 AMD
# SPDX-License-Identifier: Apache-2.0

config AMD_ACP_TIMER
	bool "AMD ACP External Timer"
	default y
	depends on DT_HAS_AMD_ACP_TIMER_ENABLED
	depends on XTENSA
	depends on !XTENSA_TIMER
	select TICKLESS_CAPABLE
	select TIMER_HAS_64BIT_CYCLE_COUNTER
	select SYSTEM_CLOCK_LOCK_FREE_COUNT
	help
	  System timer driver for the AMD ACP DSP external timer. The timer
	  runs in periodic mode from the ACP reference clock and raises the
	  kernel tick interrupt.
```

## drivers/timer/Kconfig.arm_sp804
```kconfig
# Copyright (c) 2026 Takayuki Goto
# SPDX-License-Identifier: Apache-2.0

config ARM_SP804_TIMER
	bool "ARM SP804 dual timer"
	default y
	depends on DT_HAS_ARM_SP804_ENABLED
	help
	  Kernel tick source built on the ARM SP804 dual timer block.
```

## drivers/timer/Kconfig.aspeed
```kconfig
# Copyright (c) 2026 ASPEED Technology Inc.
# SPDX-License-Identifier: Apache-2.0

config ASPEED_AST2700_BOOTMCU_TIMER
	bool "ASPEED AST2700 BootMCU system timer"
	default y
	depends on RISCV_M_MODE
	depends on DT_HAS_ASPEED_AST2700_BOOTMCU_TIMER_ENABLED
	select TICKLESS_CAPABLE
	select TIMER_HAS_64BIT_CYCLE_COUNTER
	help
	  Enable the system timer driver for the ASPEED AST2700 BootMCU.
	  The timer provides a 64-bit counter running at 1 MHz and an alarm
	  connected to the RISC-V machine timer interrupt.
```

## drivers/timer/Kconfig.cc23x0
```kconfig
# Copyright (c) 2025 Texas Instruments Incorporated
# Copyright (c) 2024 BayLibre, SAS
#
# SPDX-License-Identifier: Apache-2.0

config CC23X0_SYSTIM_TIMER
	bool "SYSTIM timer"
	default y
	depends on HAS_CC23X0_SDK
	select TICKLESS_CAPABLE
	help
	  This module provides SYSTIM as "system clock driver" interfaces
	  for the TI Simplelink CC23X0 devices.
```

## drivers/timer/Kconfig.cc27xx
```kconfig
# Copyright (c) 2025 Texas Instruments Incorporated
# Copyright (c) 2024 BayLibre, SAS
#
# SPDX-License-Identifier: Apache-2.0

config CC27XX_SYSTIM_TIMER
	bool "SYSTIM timer"
	default y
	select TICKLESS_CAPABLE
	depends on HAS_CC27XX_SDK
	help
	  This module provides SYSTIM as "system clock driver" interfaces
	  for the TI Simplelink CC27XX devices.
```

## drivers/timer/Kconfig.cc35xx_rtc
```kconfig
# Copyright (c) 2026 Conclusive Engineering Sp. z o.o.
#
# SPDX-License-Identifier: Apache-2.0

config CC35XX_RTC_TIMER
	bool "TI SimpleLink CC35XX RTC system clock timer"
	default n
	depends on HAS_CC35XX_SDK
	select TICKLESS_CAPABLE
	help
	  This module provides the RTC as "system clock driver" interface
	  for the TI SimpleLink CC35XX devices. The RTC runs at 1us
	  resolution (1 MHz effective rate).
```

## drivers/timer/Kconfig.esp32
```kconfig
# Copyright (c) 2014-2015 Wind River Systems, Inc.
# Copyright (c) 2016 Cadence Design Systems, Inc.
# Copyright (c) 2019 Intel Corp.
# Copyright (c) 2025 Espressif Systems (Shanghai) Co., Ltd.
# SPDX-License-Identifier: Apache-2.0

config ESP32_SYS_TIMER
	bool "ESP32 sys-timer support (ESP32Cx series)"
	depends on SOC_SERIES_ESP32C2 || SOC_SERIES_ESP32C3 || \
		(SOC_SERIES_ESP32C5 && !SOC_ESP32C5_LPCORE) || SOC_SERIES_ESP32C61 || \
		(SOC_SERIES_ESP32C6 && !SOC_ESP32C6_LPCORE) || SOC_SERIES_ESP32H2 || \
		(SOC_SERIES_ESP32P4 && !SOC_ESP32P4_LPCORE)
	default y
	select TICKLESS_CAPABLE
	select TIMER_HAS_64BIT_CYCLE_COUNTER
	select SYSTEM_TIMER_HAS_DISABLE_SUPPORT if MCUBOOT
	help
	  This option enables the system timer driver for the Espressif ESP32Cx
	  and provides the standard "system clock driver" interface.

	  With CONFIG_SMP, each CPU arms and acknowledges its own alarm
	  channel (TARGET0 for CPU0, TARGET1 for CPU1) on the shared
	  counter, and the systimer devicetree node must describe the
	  interrupt of both channels. No SoC in the tree enables this
	  driver together with CONFIG_SMP yet.
```

## drivers/timer/Kconfig.goldfish_rtc
```kconfig
# Copyright (c) 2026 Dimitri Varpusvuori
# SPDX-License-Identifier: Apache-2.0

DT_CHOSEN_ZEPHYR_SYSTEM_TIMER := zephyr,system-timer
DT_CHOSEN_ZEPHYR_SYSTEM_TIMER_PATH := $(dt_chosen_path,$(DT_CHOSEN_ZEPHYR_SYSTEM_TIMER))
DT_COMPAT_GOOGLE_GOLDFISH_RTC := google,goldfish-rtc

config GOLDFISH_RTC_TIMER
	bool "Google Goldfish RTC system timer"
	default y
	depends on $(dt_chosen_enabled,$(DT_CHOSEN_ZEPHYR_SYSTEM_TIMER))
	depends on $(dt_node_has_compat,$(DT_CHOSEN_ZEPHYR_SYSTEM_TIMER_PATH),$(DT_COMPAT_GOOGLE_GOLDFISH_RTC))
	select TIMER_HAS_64BIT_CYCLE_COUNTER
	help
	  Use the Goldfish RTC counter and alarm as the system timer.
	  The instance is selected by zephyr,system-timer.
```
