## drivers/timer/Kconfig.hexagon
```kconfig
# SPDX-License-Identifier: Apache-2.0
# Copyright (c) Qualcomm Technologies, Inc. and/or its subsidiaries.

config HEXAGON_TIMER
	bool "Hexagon VM timer driver"
	depends on HEXAGON
	default y
	select TICKLESS_CAPABLE
	select TIMER_HAS_64BIT_CYCLE_COUNTER
	select TIMER_READS_ITS_FREQUENCY_AT_RUNTIME
	help
	  This option enables the Hexagon VM timer driver for system clock and
	  timing services. The driver is tickless: it arms an absolute deadline
	  through the H2 vmtimerop interface and drives the tick accounting with
	  the generic system-timer core. Its counter rate is queried from the
	  hypervisor at boot.

if HEXAGON_TIMER

config HEXAGON_TIMER_IRQ
	int "Timer interrupt number"
	default 12
	help
	  The interrupt number for the Hexagon system timer.
	  Under H2, the timer posts virtual interrupt 12
	  (H2K_TIME_GUESTINT) to the guest.

config HEXAGON_TIMER_PRIORITY
	int "Timer interrupt priority"
	default 0
	help
	  The interrupt priority for the Hexagon system timer.
	  Lower values indicate higher priority.

endif # HEXAGON_TIMER
```

## drivers/timer/Kconfig.hi3861
```kconfig
# SPDX-FileCopyrightText: Copyright The Zephyr Project Contributors
# SPDX-License-Identifier: Apache-2.0

config HI3861_TIMER
	bool
	default y
	depends on DT_HAS_HISILICON_HI3861_TIMER_ENABLED
	select TICKLESS_CAPABLE
	help
	  Hi3861 system timer using an APB timer for alarms and a second
	  APB timer as the free-running cycle counter.
```

## drivers/timer/Kconfig.infineon_tcpwm
```kconfig
# SPDX-FileCopyrightText: Copyright (c) 2026 Linumiz
#
# SPDX-License-Identifier: Apache-2.0

config INFINEON_TCPWM_TIMER
	bool "Infineon TCPWM system timer"
	default y
	depends on DT_HAS_INFINEON_TCPWM_SYSTEM_TIMER_ENABLED
	select USE_INFINEON_TIMER
	select TIMER_READS_ITS_FREQUENCY_AT_RUNTIME
	help
	  Use a 32-bit TCPWM counter as the system timer.
```

## drivers/timer/Kconfig.lpf3
```kconfig
# Copyright (c) 2026 Texas Instruments Incorporated
# Copyright (c) 2024 BayLibre, SAS
#
# SPDX-License-Identifier: Apache-2.0

config LPF3_CLOCKP_TIMER
	bool "SYSTIM timer"
	default y
	depends on SOC_SERIES_CC27XX || SOC_SERIES_CC23X0
	select TICKLESS_CAPABLE
	select TIMER_HAS_64BIT_CYCLE_COUNTER if SOC_SERIES_CC27XX
	help
	  This module provides ClockP DPL as "system clock driver" interfaces
	  for the TI Simplelink CC23X0 and CC27XX devices.
```

## drivers/timer/Kconfig.mchp_sam
```kconfig
# Copyright (C) 2025-2026 Microchip Technology Inc. and its subsidiaries
#
# SPDX-License-Identifier: Apache-2.0
#

DT_CHOSEN_ZEPHYR_SYSTEM_TIMER := zephyr,system-timer
DT_CHOSEN_ZEPHYR_SYSTEM_TIMER_PATH := $(dt_chosen_path,$(DT_CHOSEN_ZEPHYR_SYSTEM_TIMER))

config MCHP_PIT_G1_TIMER
	bool "Microchip Periodic Interval Timer (PIT)"
	default y
	depends on DT_HAS_MICROCHIP_PIT_G1_TIMER_ENABLED && \
		$(dt_chosen_enabled,$(DT_CHOSEN_ZEPHYR_SYSTEM_TIMER)) && \
		$(dt_node_has_compat,$(DT_CHOSEN_ZEPHYR_SYSTEM_TIMER_PATH),$(DT_COMPAT_MICROCHIP_PIT_G1_TIMER))
	help
	  This module implements a kernel device driver for the Microchip
	  SAMA5D2 series PIT timer and provides the standard "system clock
	  driver" interfaces.

config MCHP_SAM_PIT64B_TIMER
	bool "Microchip SAM 64-bit Periodic Interval Timer (PIT64B)"
	default y
	depends on DT_HAS_MICROCHIP_SAM_PIT64B_ENABLED
	select TICKLESS_CAPABLE
	help
	  This module implements a kernel device driver for the Microchip
	  SAMA7G5 series PIT64B timer and provides the standard "system clock
	  driver" interfaces.
```

## drivers/timer/Kconfig.mcux_stm
```kconfig
# Copyright 2026 NXP
# SPDX-License-Identifier: Apache-2.0

config MCUX_STM_TIMER
	bool "MCUX STM system timer"
	default y
	depends on $(dt_chosen_enabled,$(DT_CHOSEN_Z_SYSTEM_TIMER))
	depends on $(dt_node_has_compat,$(DT_CHOSEN_Z_SYSTEM_TIMER_PATH),$(DT_COMPAT_NXP_STM))
	select TICKLESS_CAPABLE
	select TIMER_READS_ITS_FREQUENCY_AT_RUNTIME
	select SYSTEM_TIMER_HAS_DISABLE_SUPPORT
	help
	  Use the NXP System Timer Module (STM) peripheral as Zephyr's system timer.

	  This driver uses the MCUXpresso SDK STM driver (fsl_stm) directly.
	  It supports both tickful and tickless kernel operation.
```
