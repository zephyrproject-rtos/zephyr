## drivers/spi/Kconfig.rts5912
```kconfig
# Copyright (c) 2025, Realtek, SIBG-SD7
# SPDX-License-Identifier: Apache-2.0

config SPI_REALTEK_RTS5912
	bool "REALTEK RTS5912 SPI Driver"
	default y
	depends on DT_HAS_REALTEK_RTS5912_SPI_ENABLED
	select PINCTRL
	help
	  Enable support for the Realtek RTS5912 SPI controller driver.
```

## drivers/spi/Kconfig.rv32m1_lpspi
```kconfig
# RV32M1 SPI

# Copyright (c) 2019, Karsten Koenig <karsten.koenig.030@gmail.com>
# SPDX-License-Identifier: Apache-2.0

config SPI_RV32M1_LPSPI
	bool "RV32M1 LPSPI driver"
	default y
	depends on DT_HAS_OPENISA_RV32M1_LPSPI_ENABLED
	depends on CLOCK_CONTROL
	select PINCTRL
	help
	  Enable the RV32M1 LPSPI driver.
```

## drivers/spi/Kconfig.sam
```kconfig
# Atmel SAM SPI

# Copyright (c) 2019 Gerson Fernando Budke
# Copyright (c) 2018 qianfan Zhao
# SPDX-License-Identifier: Apache-2.0

config SPI_SAM
	bool "Atmel SAM series SPI driver"
	default y
	depends on DT_HAS_ATMEL_SAM_SPI_ENABLED
	select GPIO
	help
	  Enable support for the SAM SPI driver.

if SPI_SAM
config SPI_SAM_DMA
	bool "SPI SAM DMA Support"
	select DMA
	help
	  Enable using DMA with SPI for SPI instances that enable dma channels in
	  their device tree node.

if SPI_RTIO
config SPI_SAM_RTIO_SQ_SIZE
	int "Number of available submission queue entries"
	default 8 # Sensible default that covers most common spi transactions
	help
	  When RTIO is use with SPI each driver holds a context with which blocking
	  API calls use to perform SPI transactions. This queue needs to be as deep
	  as the longest set of spi_buf_sets used, where normal SPI operations are
	  used (equal length buffers). It may need to be slightly deeper where the
	  spi buffer sets for transmit/receive are not always matched equally in
	  length as these are transformed into normal transceives.

endif # SPI_RTIO

endif # SPI_SAM
```

## drivers/spi/Kconfig.sam0
```kconfig
# Atmel SAM0 SERCOM SPI

# Copyright (c) 2017 Google LLC.
# SPDX-License-Identifier: Apache-2.0

config SPI_SAM0
	bool "Atmel SAM0 series SERCOM SPI driver"
	default y
	depends on DT_HAS_ATMEL_SAM0_SPI_ENABLED
	select PINCTRL
	help
	  Enable support for the SAM0 SERCOM SPI driver.

config SPI_SAM0_DMA
	bool "Atmel SAM0 dma support"
	default y
	depends on SPI_SAM0
	depends on $(dt_compat_any_has_prop,$(DT_COMPAT_ATMEL_SAM0_SPI),dmas)
	select DMA
	help
	  Enable DMA-based data transfers for the Atmel SAM0 SPI driver.
```

## drivers/spi/Kconfig.sam_qspi
```kconfig
# Atmel SAM SPI

# Copyright (c) 2019 Gerson Fernando Budke
# Copyright (c) 2018 qianfan Zhao
# SPDX-License-Identifier: Apache-2.0

config QSPI_SAM
	bool "Atmel SAM series QSPI driver"
	default y
	#depends on DT_HAS_ATMEL_SAM_QSPI_ENABLED
	select PINCTRL
	select GPIO
	help
	  Enable support for the SAM SPI driver.
```

## drivers/spi/Kconfig.sc18is606
```kconfig
# Copyright (c) 2025, tinyvision.ai
# SPDX-License-Identifier: Apache-2.0

config SPI_SC18IS606
	bool  "NXP SC18IS606 SPI controller driver"
	default y
	select I2C
	depends on DT_HAS_NXP_SC18IS606_SPI_ENABLED
	help
	  Enable driver for the NXP SC18IS606 SPI controller driver

if SPI_SC18IS606

config SPI_SC18IS606_INIT_PRIORITY
	int "SC18IS606 SPI init priority"
	default 59
	help
	  SC18IS606 SPI controller initialization priority

	  Note: Has to be greater than the I2C initialization priority.

endif
```

## drivers/spi/Kconfig.sedi
```kconfig
#
# Copyright (c) 2023 Intel Corporation
#
# SPDX-License-Identifier: Apache-2.0
#

config SPI_SEDI
	bool "Intel SEDI SPI driver"
	default y
	depends on DT_HAS_INTEL_SEDI_SPI_ENABLED
	help
	  This option enables the Intel SEDI SPI driver.
	  This driver is simply a shim driver built upon the SEDI
	  bare metal SPI driver in the hal-intel module
```

## drivers/spi/Kconfig.sf32lb
```kconfig
# Copyright (c) 2025, Qingsong Gou <gouqs@hotmail.com>
# SPDX-License-Identifier: Apache-2.0

config SPI_SF32LB
	bool "SPI Driver for SF32LB family of MCUs"
	default y
	depends on DT_HAS_SIFLI_SF32LB_SPI_ENABLED
	select DMA if $(dt_compat_any_has_prop,$(DT_COMPAT_SIFLI_SF32LB_SPI),dmas)
	help
	  Enable SPI driver for SF32LB MCUs
```

## drivers/spi/Kconfig.shakti
```kconfig
# Shakti SPI Driver configuration options

# Copyright (c) 2024 Shakti Inc.
# SPDX-License-Identifier: Apache-2.0

config SPI_SHAKTI
	bool "Shakti SPI controller driver"
	default y
	help
	  This option enables the Shakti spi driver.

config SPI_INIT_PRIORITY
	int "SPI init priority"
	default KERNEL_INIT_PRIORITY_DEFAULT
	help
	  SPI driver device initialization priority.
```

## drivers/spi/Kconfig.si32
```kconfig
# Copyright (c) 2024 GARDENA GmbH
#
# SPDX-License-Identifier: Apache-2.0

config SPI_SI32
	bool "Si32 SPI controller driver"
	default y
	depends on DT_HAS_SILABS_SI32_SPI_ENABLED
	help
	  Currently, the SPI driver is limited to master mode only.
```

## drivers/spi/Kconfig.sifive
```kconfig
# SiFive SPI Driver configuration options

# Copyright (c) 2018 SiFive Inc.
# SPDX-License-Identifier: Apache-2.0

config SPI_SIFIVE
	bool "SiFive SPI controller driver"
	default y
	depends on DT_HAS_SIFIVE_SPI0_ENABLED
	select PINCTRL if SOC_SERIES_SIFIVE_FREEDOM_FE300
	help
	  Enable the SPI peripherals on SiFive Freedom processors
```

## drivers/spi/Kconfig.silabs_eusart
```kconfig
# Silabs EUSART SPI configuration option

# Copyright (c) 2024 Daikin Comfort Technologies North America, Inc.
# Copyright (c) 2025 Silicon Laboratories Inc.
# SPDX-License-Identifier: Apache-2.0

config SPI_SILABS_EUSART
	bool "Silabs EUSART SPI controller driver"
	default y
	depends on DT_HAS_SILABS_EUSART_SPI_ENABLED
	depends on GPIO
	select SOC_GECKO_EUSART
	select PINCTRL if SOC_FAMILY_SILABS_S2
	help
	  Enable the EUSART SPI driver

config SPI_SILABS_EUSART_DMA
	bool "Silabs EUSART SPI controller driver DMA enabled transfer"
	depends on SPI_SILABS_EUSART
	select DMA
	default y if SPI_ASYNC

config SPI_SILABS_EUSART_DMA_MAX_BLOCKS
	int "Silabs EUSART SPI controller driver maximum DMA transfer block per channel for a transaction."
	depends on SPI_SILABS_EUSART_DMA
	default 8
	help
	  One block is needed for every chunk found in the SPI transaction and every 2048 bytes
```

## drivers/spi/Kconfig.silabs_siwx91x_gspi
```kconfig
# Copyright (c) 2025 Silicon Laboratories Inc.
# SPDX-License-Identifier: Apache-2.0

config SPI_SILABS_SIWX91X_GSPI
	bool "Silabs GSPI SPI Primary controller driver"
	default y
	depends on DT_HAS_SILABS_GSPI_ENABLED
	depends on CLOCK_CONTROL
	select GPIO
	select PINCTRL
	help
	  Enable the GSPI SPI primary driver for the Silabs SiWx91x SoC series.

if SPI_SILABS_SIWX91X_GSPI

config SPI_SILABS_SIWX91X_GSPI_DMA_DESCR_COUNT
	int "Maxmimum number of DMA descriptor (per channel)"
	default 3 if DMA
	default 0
	help
	  One descriptor is needed for every SPI buffer in the transaction plus one
	  for padding.

	  Set to 0 to disable support for DMA.

endif
```

## drivers/spi/Kconfig.silabs_usart
```kconfig
# Silabs USART SPI configuration option

# Copyright (c) 2019 Christian Taedcke <hacking@taedcke.com>
# SPDX-License-Identifier: Apache-2.0

config SPI_SILABS_USART
	bool "Silabs USART SPI controller driver"
	default y
	depends on DT_HAS_SILABS_USART_SPI_ENABLED
	depends on GPIO
	select SOC_GECKO_USART
	select CLOCK_CONTROL_SILABS_SERIES if SOC_FAMILY_SILABS_S2
	select PINCTRL if SOC_FAMILY_SILABS_S2
	help
	  Enable the USART SPI driver
```

## drivers/spi/Kconfig.smartbond
```kconfig
# Copyright (c) 2022 Renesas Electronics Corporation
# SPDX-License-Identifier: Apache-2.0

config SPI_SMARTBOND
	bool "Renesas SmartBond(tm) SPI driver"
	default y
	depends on DT_HAS_RENESAS_SMARTBOND_SPI_ENABLED
	select PINCTRL
	help
	  Enables SPI driver for Renesas SmartBond(tm) DA1469x series MCU.

config SPI_SMARTBOND_DMA
	bool "Renesas Smartbond(tm) SPI with DMA acceleration"
	default y
	depends on SPI_SMARTBOND
	select DMA
	help
	  Enables using the DMA engine instead of interrupt-driven
	  approach. This acceleration is available only for
	  asynchronous transfers.
```

## drivers/spi/Kconfig.spi_emul
```kconfig
# Copyright 2020 Google LLC
# SPDX-License-Identifier: Apache-2.0

config SPI_EMUL
	bool "SPI emulator"
	help
	  Enable the SPI emulator driver. This is a fake driver in that it
	  does not talk to real hardware. Instead it talks to emulation
	  drivers that pretend to be devices on the emulated SPI bus. It is
	  used for testing drivers for SPI devices.
```

## drivers/spi/Kconfig.stellaris
```kconfig
# Kconfig - Stellaris SPI Driver
#
# Copyright (c) 2018 Zilogic Systems.
# SPDX-License-Identifier: Apache-2.0

menuconfig SPI_STELLARIS
	bool "Stellaris SPI driver"
	depends on SOC_TI_LM3S6965
	select HAS_DTS_SPI
	help
	  Enable support for the LM3S6965 SPI driver.

if SPI_STELLARIS

config SPI_PL022
	bool "Enable Pl022 Driver"
	default y
endif
```

## drivers/spi/Kconfig.stm32_ospi
```kconfig
# STM32 SPI driver configuration options

# Copyright (c) 2015-2016 Intel Corporation
# SPDX-License-Identifier: Apache-2.0

menuconfig OSPI_STM32
	bool "STM32 MCU OSPI controller driver"
	default y
	depends on SOC_FAMILY_STM32
	select USE_STM32_LL_OSPI
	help
	  Enable OSPI support on the STM32 family of processors.

config SPI_EXTENDED_MODES
	bool "STM32 Hardware Slave Select support"
	default y

#if SPI_STM32

#config SPI_STM32_INTERRUPT
#	bool "STM32 MCU SPI Interrupt Support"
#	help
#	  Enable Interrupt support for the SPI Driver of STM32 family.

#config SPI_STM32_DMA
#	bool "STM32 MCU SPI DMA Support"
#	select DMA
#	help
#	  Enable the SPI DMA mode for SPI instances
#	  that enable dma channels in their device tree node.

#config SPI_STM32_USE_HW_SS
#	bool "STM32 Hardware Slave Select support"
#	default y
#	help
#	  Use Slave Select pin instead of software Slave Select.


#endif # SPI_STM32
```

## drivers/spi/Kconfig.sy1xx
```kconfig
# Copyright (c) 2024 sensry.io
# SPDX-License-Identifier: Apache-2.0

config SPI_SY1XX
	bool "Sensry SY1xx SPI driver"
	default y
	depends on DT_HAS_SENSRY_SY1XX_SPI_ENABLED
	help
	  Driver for Sensry SY1xx series spi.

config SPI_SY1XX_BUFFER_SIZE
	int "SY1XX SPI buffer size"
	default 128
	depends on SPI_SY1XX
	help
	  Default buffer size in bytes for the SY1XX SPI driver used for chunked transfers.
	  It is required to be a multiple of 4.
```

## drivers/spi/Kconfig.test
```kconfig
# Copyright (c) 2021, Nordic Semiconductor ASA
# SPDX-License-Identifier: Apache-2.0

# Hidden option for turning on the dummy driver for vnd,spi devices
# used in testing.
config SPI_TEST
	def_bool DT_HAS_VND_SPI_ENABLED
	depends on DT_HAS_VND_SPI_ENABLED
```

## drivers/spi/Kconfig.ti_unicomm
```kconfig
# Copyright (c) 2026 Texas Instruments Incorporated
# SPDX-License-Identifier: Apache-2.0

config SPI_TI_UNICOMM
	bool "TI Unicomm SPI Driver"
	default y
	depends on DT_HAS_TI_UNICOMM_SPI_ENABLED
	help
		Enable SPI on TI devices with the Unicomm peripheral.
```

## drivers/spi/Kconfig.tlx
```kconfig
# Copyright (c) 2024 Telink Semiconductor
# SPDX-License-Identifier: Apache-2.0

config SPI_TELINK_TLX
	bool "Telink Semiconductor TLx SPI driver"
	default y
	depends on DT_HAS_TELINK_TL321X_SPI_ENABLED || DT_HAS_TELINK_TL721X_SPI_ENABLED
	help
	  Enables Telink TLx SPI driver.
```

## drivers/spi/Kconfig.w91
```kconfig
# Copyright (c) 2024 Telink Semiconductor
# SPDX-License-Identifier: Apache-2.0

config SPI_TELINK_W91
	bool "Telink Semiconductor W91 SPI driver"
	default y
	depends on DT_HAS_TELINK_W91_SPI_ENABLED
	help
	  Enables Telink W91 SPI driver.
```

## drivers/spi/Kconfig.xec_gpspi
```kconfig
# Microchip XEC GPSPI

# Copyright (c) 2022 Microchip Technology Inc.
# SPDX-License-Identifier: Apache-2.0

config SPI_XEC_GPSPI
	bool "Microchip MEC15x/MEC172x XEC GPSPI driver"
	default y
	depends on DT_HAS_MICROCHIP_XEC_GPSPI_ENABLED
	help
	  Enable support for Microchip MEC15xx/MEC172x XEC GPSPI driver.
	  The GPSPI controller is a simple, byte-by-byte GPI controller
	  using GPIO's as chip select.

if SPI_XEC_GPSPI

config SPI_XEC_GPSPI_DMA
	bool "Microchip XEC GPSPI DMA Support"
	select DMA
	help
	  Enable the SPI DMA mode for GPSPI instances
	  that enable dma channels in their device tree node.
	  Enables Microchip XEC DMA driver.

endif # SPI_XEC_GPSPI
```

## drivers/spi/Kconfig.xec_qmspi
```kconfig
# Microchip XEC QMSPI

# Copyright (c) 2019 Microchip Technology Inc.
# SPDX-License-Identifier: Apache-2.0

config SPI_XEC_QMSPI
	bool "Microchip MEC15xx XEC QMSPI driver"
	default y
	depends on DT_HAS_MICROCHIP_XEC_QMSPI_ENABLED
	select DMA if SPI_ASYNC
	help
	  Enable support for Microchip MEC15xx XEC QMSPI driver.

config SPI_XEC_QMSPI_LDMA
	bool "Microchip XEC MEC17xx QMSPI LDMA driver"
	default y
	depends on DT_HAS_MICROCHIP_XEC_QMSPI_LDMA_ENABLED
	help
	  Enable support for Microchip MEC17xx QMSPI with local DMA driver.
```
