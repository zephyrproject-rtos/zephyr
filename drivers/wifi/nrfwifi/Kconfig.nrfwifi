## drivers/wifi/rs9116w/Kconfig.rs9116w
```kconfig
# RS9116W WiFi driver options

# Copyright (c) 2022 T-Mobile USA, Inc.
# SPDX-License-Identifier: Apache-2.0

config WIFI_RS9116W
	bool "RS9116W WiFi driver support"
	select WISECONNECT
	select WISECONNECT_WIFI
	select NET_L2_WIFI_MGMT
	select WIFI_OFFLOAD
	select NET_OFFLOAD
	select NET_SOCKETS
	imply NET_SOCKETS_OFFLOAD
	help
	  Enables WiFi support for the Redpine Signals RS9116W combined
	  WiFi Bluetooth module utilizing the the WiSeConnect SAPI

if WIFI_RS9116W

config RSI_WIFI_DEBUG
	bool "WiFi driver debug"
	default y
	help
	  WiFi driver debug

config RS9116W_OVERRIDE_DEFAULT_PRIO
	bool "Override default socket priority"
	depends on NET_SOCKETS_OFFLOAD
	default n

if RS9116W_OVERRIDE_DEFAULT_PRIO

config RS9116W_SOCKET_PRIO
	int "RS9116W Sockets Priority"
	default 50

endif # RS9116W_OVERRIDE_DEFAULT_PRIO

if  NET_SOCKETS_OFFLOAD
config RS9116W_TLS_OFFLOAD
	bool "Allow the builtin TLS stack on the RS9116W to be utilized"
	select BASE64
	default n

if RS9116W_TLS_OFFLOAD

config RS9116W_TLS_PEM_BUF_SZ
	int "Buffer size to allocate for PEM conversion"
	default 2000

endif # RS9116W_TLS_OFFLOAD

config RS9116_DNS_SERVER_IP_ADDRESSES
	bool "Manually set DNS server to be used by the RS9116W"
	default n

if RS9116_DNS_SERVER_IP_ADDRESSES

config RS9116_IPV4_DNS_SERVER1
	string "RS9116W IPV4 DNS server 1"
	default ""

config RS9116_IPV4_DNS_SERVER2
	string "RS9116W IPV4 DNS server 2"
	default ""

config RS9116_IPV6_DNS_SERVER1
	string "RS9116W IPV6 DNS server 1"
	default ""

config RS9116_IPV6_DNS_SERVER2
	string "RS9116W IPV6 DNS server 2"
	default ""

endif # RS9116_DNS_SERVER_IP_ADDRESSES

endif # NET_SOCKETS_OFFLOAD

config RS9116W_ICMP
	bool
	select WISECONNECT_ICMP
	default y if PING

endif # WIFI_RS9116W
```

## drivers/wifi/simplelink/Kconfig.simplelink
```kconfig
# SimpleLink WiFi driver options

# Copyright (c) 2018 Texas Instruments, Incorporated
# Copyright (c) 2022 T-Mobile USA, Inc.
# SPDX-License-Identifier: Apache-2.0

menuconfig WIFI_SIMPLELINK
	bool "SimpleLink Wi-Fi driver support"
	select SIMPLELINK_HOST_DRIVER
	select WIFI_OFFLOAD
	select NET_L2_WIFI_MGMT

if WIFI_SIMPLELINK

config WIFI_SIMPLELINK_NAME
	string "Driver name"
	default "SimpleLink"

config WIFI_SIMPLELINK_MAX_PACKET_SIZE
	int "Maximum size of a packet, in bytes"
	# MTU (ipv4) per: http://www.ti.com/lit/ug/swru455d/swru455d.pdf:
	default 1472
	help
	  Set the maximum size of a network packet going through the chip.
	  This sets the size of each buffer, in each buffer pool.
	  Do not modify it unless you know what you are doing.

config WIFI_SIMPLELINK_SCAN_COUNT
	int "Number of entries in network scan table: Max: 30"
	default 20
	help
	  The number of results to request on a Wi-Fi scan operation.
	  Actual number returned may be less.  Maximum is 30.

config WIFI_SIMPLELINK_MAX_SCAN_RETRIES
	int "Number of retries to get network scan table"
	default 10
	help
	  The number of times, separated by a one second interval, to retry
	  a request for the network list.

config WIFI_SIMPLELINK_WLAN_POLICY_AUTO_CONNECT
	bool "Use the SimpleLink Auto Connection Policy"
	default y
	help
	  The device tries to connect to an AP from the stored profiles
	  based on priority. Up to seven profiles are supported.

config WIFI_SIMPLELINK_WLAN_POLICY_FAST_CONNECT
	bool "Use the SimpleLink Fast Connection Policy"
	default y
	help
	  The device will try to connect to the last connected AP.

config WIFI_SIMPLELINK_WLAN_POLICY_ANYP2P
	bool "Use the SimpleLink AnyP2P Connection Policy"
	help
	  Relevant for Wi-Fi-Direct mode only. The device immediately tries
	  to connect to the first Wi-Fi direct device available, supporting
	  push-button only.

config WIFI_SIMPLELINK_WLAN_POLICY_AUTO_PROVISIONING
	bool "Use the SimpleLink Auto Provisioning Connection Policy"
	help
	  The device automatically starts the provisioning process if 2
	  seconds have passed since reset without receiving any command from
	  the host, while no saved profiles exist. Or the device
	  automatically starts the provisioning process after 2 minutes of
	  disconnection, while saved profiles exist.

config WIFI_SIMPLELINK_FAST_CONNECT_TIMEOUT
	int "Time (in seconds) to wait for fast connect on startup"
	default 7
	help
	  SimpleLink uses the "FastConnect" feature to reconnect to the
	  previously connected AP on startup. Should the Wi-Fi connection
	  timeout, the SimpleLink driver will fail to initialize,
	  and LOG an error.

endif # WIFI_SIMPLELINK
```

## drivers/wifi/siwx91x/Kconfig.siwx91x
```kconfig
# Copyright (c) 2024 Silicon Laboratories Inc.
# SPDX-License-Identifier: Apache-2.0

config WIFI_SILABS_SIWX91X
	bool "Silabs SiWx91x SoC series WiFi driver"
	default y
	depends on DT_HAS_SILABS_SIWX91X_WIFI_ENABLED
	depends on NETWORKING
	select SILABS_SIWX91X_NWP
	select NET_L2_WIFI_MGMT
	help
	  Enable WiFi driver for the Silabs SiWx91x SoC series.

if WIFI_SILABS_SIWX91X

config NET_MGMT_EVENT_STACK_SIZE
	default 1024

config WIFI_MGMT_SCAN_SSID_FILT_MAX
	default 1

choice
	prompt "Network stack"
	default WIFI_SILABS_SIWX91X_NET_STACK_NATIVE
	help
	  Choose "Native" stack if you want a better compatibility with Zephyr
	  features. "Offloaded" stack may provide better resource (power and
	  memory) consumption.

config WIFI_SILABS_SIWX91X_NET_STACK_NATIVE
	bool "Native"
	select WIFI_USE_NATIVE_NETWORKING
	select NET_L2_ETHERNET_RESERVE_HEADER
	select NET_L2_ETHERNET

config WIFI_SILABS_SIWX91X_NET_STACK_OFFLOAD
	bool "Offloaded"
	select WIFI_OFFLOAD

endchoice

config WIFI_SILABS_SIWX91X_ENHANCED_MAX_PSP
	bool "Enhanced Max PSP Support"
	default y
	help
	  Enable this option to allow the device to configure
	  Enhanced Maximum Power Save (PSP) support during
	  device initialization.

	  **Advantages:**
	  - Reduces power consumption during low traffic periods.
	  - Automatically transitions to Fast PSP for improved responsiveness
	    when traffic is high.

	  **Limitations:**
	  - Initially uses PS-Poll frames for power management, even if the
	    user configures NULL frame-based.
	  - Switches to NULL frame-based only when traffic increases.

config WIFI_SILABS_SIWX91X_MFP
	bool "802.11w Management Frame Protection (MFP) support"
	default y
	help
	  Enable IEEE 802.11w Management Frame Protection (MFP) for secure
	  handling of management frames.

	  Note:
	    - Required for WPA3-Personal and WPA3-Transition modes.
	    - Disabling this frees memory used by MFP, improving TCP throughput
	      by about 10–12% (≈1–2 Mbps).

config WIFI_SILABS_SIWX91X_FEAT_SECURITY_PSK
	bool "WPA/WPA2 (PSK) Security Support"
	default y
	help
	  Enable WPA/WPA2 (PSK-based) security in client mode.
	  Recommended for configurations requiring WPA, WPA2, or mixed security modes.
	  Disabling this feature can reduce data buffer usage, potentially improving throughput.

config WIFI_SILABS_SIWX91X_LIMIT_PACKET_BUF_PER_STA
	bool "Limits the number of packets buffered per STA in AP mode"
	default y
	help
	  In AP mode, if the bit is set, only two packets per Station (STA)
	  would be buffered when the STA is in Power Save (PS) mode.
	  This helps manage buffer usage and ensures efficient packet handling.

endif
```

## drivers/wifi/st67w611m1/Kconfig.st67w611m1
```kconfig
# Copyright (c) 2026 STMicroelectronics
# SPDX-License-Identifier: Apache-2.0

DT_STM32_SPI_HAS_DMA := $(dt_compat_any_has_prop,$(DT_COMPAT_ST_STM32_SPI),dmas)

menuconfig WIFI_ST67W611M1
	bool "ST67W611M1 Wi-Fi driver"
	default y
	depends on DT_HAS_ST_ST67W611M1_ENABLED
	select EVENTS
	select MODEM
	select MODEM_CONTEXT
	select MODEM_CMD_HANDLER
	select GPIO
	select SPI
	select SPI_STM32_DMA if SOC_FAMILY_STM32 && $(DT_STM32_SPI_HAS_DMA)
	select NET_L2_ETHERNET # Wifi driver is defined as an Ethernet interface
	select NET_L2_WIFI_MGMT
	select WIFI_USE_NATIVE_NETWORKING # Set net_wifi_mgmt_offload as an ethernet_api

if WIFI_ST67W611M1

config ST67W611M1_SCAN_RESULT_MAX_NUMBER
	int "Max number of scan results"
	default 12

config ST67W611M1_WORKQ_THREAD_PRIORITY
	int "Priority of the work queue thread"
	default 7

config ST67W611M1_WORKQ_STACK_SIZE
	int "Stack size of the driver work queue"
	default 1024

config ST67W611M1_RX_THREAD_PRIORITY
	int "Priority of the RX thread"
	default 7

config ST67W611M1_RX_THREAD_STACK_SIZE
	int "Stack size of the RX thread"
	default 1024

config ST67W611M1_SPI_PROCESSOR_THREAD_PRIORITY
	int "Priority of the thread processing the SPI TX and RX transfers"
	default 8

config ST67W611M1_SPI_PROCESSOR_THREAD_STACK_SIZE
	int "Stack size of the SPI TX RX transfer thread"
	default 1024

config ST67W611M1_TX_AT_CMD_NET_BUF_POOL_COUNT
	int "Number of buffers in the AT command net buf pool"
	default 12

config ST67W611M1_TX_AT_CMD_NET_BUF_POOL_SIZE
	int "Size of buffers in the AT command net buf pool"
	default 256

config ST67W611M1_TX_AT_CMD_NET_PKT_SLAB_COUNT
	int "Number of AT command net_pkt that can be allocated at the same time"
	default 10

config ST67W611M1_RX_AT_CMD_RING_BUF_SIZE
	int "Size of the RX AT command ring buffer"
	default 768

config ST67W611M1_SPI_PKT_MEM_SLAB_COUNT
	int "Max number of SPI pkts"
	default 12

configdefault NET_MGMT_EVENT_STACK_SIZE
	default 2048

endif # WIFI_ST67W611M1
```

## drivers/wifi/telink/Kconfig.w91
```kconfig
# Copyright (c) 2024 Telink Semiconductor
# SPDX-License-Identifier: Apache-2.0

config WIFI_W91
	bool "W91 SoC WiFi support"
	default y if DT_HAS_TELINK_W91_WIFI_ENABLED
	select NET_SOCKETS
	select NET_CONFIG_SETTINGS
	select NET_MGMT
	select NET_MGMT_EVENT
	select NET_L2_WIFI_MGMT
	help
		Enable Telink SoC WiFi support.

if WIFI_W91

config NET_MGMT_EVENT_STACK_SIZE
	default 1024

config TELINK_W91_WIFI_EVENT_THREAD_STACK_SIZE
	int "WIFI event thread stack size"
	default 2048
	help
	  WIFI event thread stack size.

config TELINK_W91_WIFI_EVENT_THREAD_PRIORITY
	int "WIFI event thread priority"
	default 10
	help
	  WIFI event thread priority.

config TELINK_W91_WIFI_EVENT_MAX_MSG
	int "WIFI event max messages"
	default 16
	help
	  WIFI event max messages.

config WIFI_TELINK_W91_IPV6_ADDR_CNT
	int "Telink IPv6 address count"
	default 8
	help
	  This option sets Telink IPv6 addresses count transferred via IPC.

endif # WIFI_W91
```

## drivers/wifi/uwp/Kconfig.uwp
```kconfig
#
# Copyright (c) 2018, UNISOC Incorporated
#
# SPDX-License-Identifier: Apache-2.0
#


menuconfig WIFI_UWP
	bool "Unisoc uwp wifi driver support"
	default n
	depends on WIFI
	select NETWORKING
	select NET_BUF
	select NET_L2_ETHERNET
	select NET_IPV4

if WIFI_UWP

config WIFI_STA_DRV_NAME
	string "STA driver name"
	default "WIFI_STA"

config WIFI_AP_DRV_NAME
	string "SoftAP driver name"
	default "WIFI_AP"

config WIFI_UWP_MAX_RX_ADDR_COUNT
	int "Max rx addr count each time"
	default 32
	help
	  Max count CP can receive each time.

config WIFI_UWP_NET_BUF_START_ADDR
	hex "Net buffer start address"
	default 0x1A0000
	help
	  Share buffer start address. Be careful to tweak this value.
	  This address can't cover Zephyr's ram.

config WIFI_UWP_TX_BUF_COUNT
	int "TX buffer count"
	default 30
	range 10 30
	help
	  TX buffer count. Be careful to tweak this value.

config WIFI_UWP_RX_BUF_COUNT
	int "RX buffer count"
	default 70
	range 10 70
	help
	  RX buffer count. Be careful to tweak this value.

config WIFI_UWP_NET_BUF_SIZE
	int "Net buffer size"
	default 1800
	range 1700 1800
	help
	  Do not tweak this value if you are not sure how many
	  bytes TX/RX buffer needs.

endif
```

## drivers/wifi/wfx200/Kconfig.wfx200
```kconfig
# Copyright (c) 2023 grandcentrix GmbH
#
# SPDX-License-Identifier: Apache-2.0

menuconfig WIFI_WFX200
	bool "SiLabs WFX200 support"
	default y
	depends on DT_HAS_SILABS_WFX200_ENABLED
	depends on SPI
	select NET_L2_WIFI_MGMT
	select WIFI_USE_NATIVE_NETWORKING
	select HAS_SILABS_WFX_FMAC
	help
	  SiLabs WFX200 WiFi Module with SPI Interface

if WIFI_WFX200

config NET_IF_MAX_IPV6_COUNT
	default 2

config NET_IF_MAX_IPV4_COUNT
	default 2

config WIFI_WFX200_VERBOSE_LOGGING
	bool "Verbose logging"
	depends on LOG_PRINTK

config WIFI_WFX200_LOG_BUFFER_SIZE
	int "Static log buffer size"
	default 128

config WIFI_WFX200_STACK_SIZE
	int "Driver task stack size"
	default 768

config WIFI_WFX200_EVENT_STACK_SIZE
	int "Driver event task stack size"
	default 768

config WIFI_WFX200_HEAP_SIZE
	int "Driver heap size"
	default 2048

config WIFI_WFX200_PRIORITY
	int "Driver task priority"
	default 2

endif # WIFI_WFX200
```

## drivers/wifi/winc1500/Kconfig
```kconfig
# Kconfig - Atmel WINC1500 BSP and BUS configuration options
#
# WINC1500 options
#

menuconfig WIFI_WINC1500
	bool
	prompt "WINC1500 driver HAL Configuration"
	default n
	depends on WIFI

if WIFI_WINC1500

config	WINC1500_SPI_DRV_NAME
	string "SPI device where WINC1500 is connected"
	depends on WIFI_WINC1500
	default "SPI_1"
	help
	 Specify the device name of the SPI device to which WINC1500 is
	 connected.

config WINC1500_SPI_SLAVE
	int "SPI Slave Select where WINC1500 is connected"
	depends on WIFI_WINC1500
	default 1
	help
	 Specify the slave select pin of the SPI to which WINC1500 is
	 connected.

config WINC1500_SPI_FREQ
	int "SPI frequency to use with WINC1500"
	depends on WIFI_WINC1500
	default 4
	help
	 SPI frequency to use with WINC1500

# TODO GPIO

endif # WIFI_WINC1500
```

## drivers/wifi/winc1500/Kconfig.winc1500
```kconfig
# Atmel WINC1500 WiFi driver options

# Copyright (c) 2015 Intel Corporation
# SPDX-License-Identifier: Apache-2.0

menuconfig WIFI_WINC1500
	bool "WINC1500 driver support"
	default y
	depends on DT_HAS_ATMEL_WINC1500_ENABLED
	select SPI
	select ATMEL_WINC1500
	select WIFI_OFFLOAD
	select NET_L2_WIFI_MGMT

if WIFI_WINC1500

config WIFI_WINC1500_NAME
	string "Driver name"
	default "WINC1500"

config WINC1500_DRV_USE_OLD_SPI_SW
	bool "Use old SPI access method in the vendor HAL"
	help
	  This option, when enabled, causes USE_OLD_SPI_SW
	  setting to be passed to vendor HAL.

config WIFI_WINC1500_THREAD_STACK_SIZE
	int "HAL callback handler thread stack size"
	default 2048
	help
	  This option sets the size of the stack used by the thread handling
	  WINC1500 HAL callbacks. Do not touch it unless you know what you are
	  doing.

config WIFI_WINC1500_THREAD_PRIO
	int "HAL callback handler thread priority"
	default 2
	help
	  This option sets the priority of the thread handling WINC1500 HAL
	  callbacks. Do not touch it unless you know what you are doing.

config WIFI_WINC1500_BUF_CTR
	int "Number of buffer per-buffer pool"
	default 1
	help
	  Set the number of buffer the driver will have access to in each of
	  its buffer pools.

config WIFI_WINC1500_MAX_PACKET_SIZE
	int "Maximum size of a packet, in bytes"
	default 1500
	help
	  Set the maximum size of a network packet going through the chip.
	  This sets the size of each buffer, in each buffer pools.
	  Do not modify it unless you know what you are doing.

config WIFI_WINC1500_OFFLOAD_MAX_SOCKETS
	int "Maximum number of sockets that can be managed"
	default 2
	help
	  Set the number of sockets that can be managed through the driver
	  and the chip.

choice
	bool "In which region is the chip running?"
	default WIFI_WINC1500_REGION_NORTH_AMERICA

config WIFI_WINC1500_REGION_NORTH_AMERICA
	bool "Region North America"

config WIFI_WINC1500_REGION_EUROPE
	bool "Region Europe"

config WIFI_WINC1500_REGION_ASIA
	bool "Region Asia"

endchoice

endif # WIFI_WINC1500
```

## drivers/wuc/Kconfig
```kconfig
# Copyright 2025 NXP
# SPDX-License-Identifier: Apache-2.0

menuconfig WUC
	bool "Wakeup Controller drivers"
	help
	  Enable wakeup controller driver configuration

if WUC

module = WUC
module-str = WUC
source "subsys/logging/Kconfig.template.log_config"

config WUC_INIT_PRIORITY
	int "Wakeup controller init priority"
	default KERNEL_INIT_PRIORITY_DEVICE
	help
	  Wakeup controller device driver initialization priority.


# zephyr-keep-sorted-start
rsource "Kconfig.mcux_wuc"
# zephyr-keep-sorted-stop

endif # WAKEUP_CONTROL
```
