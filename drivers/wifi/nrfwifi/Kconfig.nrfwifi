## drivers/wuc/Kconfig.ite_wuc
```kconfig
# Copyright 2026 ITE Corporation
# SPDX-License-Identifier: Apache-2.0

config WUC_ITE
	bool "ITE Wakeup Controller"
	default y
	depends on (DT_HAS_ITE_IT8XXX2_WUC_ENABLED || DT_HAS_ITE_IT51XXX_WUC_ENABLED)
	help
	  Enable support for ITE WUC (it8xxx2/it51xxx) wakeup controller driver.
```

## drivers/wuc/Kconfig.mcux_wuc
```kconfig
# Copyright 2026 NXP
# SPDX-License-Identifier: Apache-2.0

config WUC_MCUX_LLWU
	bool "NXP Low Leakage Wakeup Unit"
	default y
	depends on DT_HAS_NXP_LLWU_ENABLED
	help
	  Enable support for NXP LLWU(Low Leakage Wakeup Unit) wakeup controller driver.

config WUC_MCUX_SLEEPCON
	bool "NXP SLEEPCON wakeup control"
	default y
	depends on DT_HAS_NXP_SLEEPCON_WUC_ENABLED
	help
	  Enable support for the NXP SLEEPCON (Sleep Controller) acting as a
	  wakeup controller driver. The SLEEPCON WAKEUPEN registers select which
	  peripheral interrupts may wake the CPU from low-power modes.

config WUC_MCUX_WUU
	bool "NXP WUU wakeup control"
	default y
	depends on DT_HAS_NXP_WUC_WUU_ENABLED
	help
		Enable support for NXP WUU (Wakeup Unit) wakeup controller driver.
```

## drivers/wuc/Kconfig.renesas_wuc
```kconfig
# Copyright (c) 2026 Renesas Electronics Corporation
# SPDX-License-Identifier: Apache-2.0

config WUC_RENESAS_RA_LPM
	bool "Renesas RA LPM Wakeup controller"
	default y
	depends on DT_HAS_RENESAS_RA_LPM_WUC_ENABLED
	select USE_RA_FSP_LPM
	help
	  Enable support for Renesas RA LPM Wakeup controller
```

## drivers/xen/Kconfig
```kconfig
# SPDX-License-Identifier: Apache-2.0
# Copyright (c) 2022-2024 EPAM Systems

if XEN

menu "Xen drivers"

config XEN_GRANT_TABLE
	bool "Xen grant table driver"
	depends on HEAP_MEM_POOL_SIZE > 0
	default y
	help
	  Xen grant table driver. Please note that driver uses dynamic memory
	  allocation with k_malloc(), so CONFIG_HEAP_MEM_POOL_SIZE should be
	  >= number of pages, that you want to alloc and grant or foreign frames
	  that you want to map.

config XEN_GRANT_TABLE_INIT_PRIORITY
	int "Grant table driver init priority"
	depends on XEN_GRANT_TABLE
	default 50

config NR_GRANT_FRAMES
	int "Number of grant frames mapped to Zephyr"
	depends on XEN_GRANT_TABLE
	default 1
	help
	  This value configures how much grant frames will be supported by Zephyr
	  grant table driver in runtime. This value should be <= max_grant_frames
	  configured for domain in Xen hypervisor.

endmenu

endif # XEN
```

## drivers/zio/Kconfig
```kconfig
# Kconfig - zio configuration options

#
# Copyright (c) 2019 Thomas Burdick <thomas.burdick@gmail.com>
#
# SPDX-License-Identifier: Apache-2.0
#

menuconfig ZIO
	bool "ZIO Drivers"
	help
	  Include zio drivers in system config

if ZIO

module = ZIO
module-str = zio
source "subsys/logging/Kconfig.template.log_config"

config ZIO_INIT_PRIORITY
	int "Zio init priority"
	default 90
	help
	  Zio initialization priority.

comment "Device Drivers"

source "drivers/zio/synth/Kconfig"

endif # ZIO
```

## drivers/zio/ft5336/Kconfig
```kconfig
#
# Copyright (c) 2019, NXP
#
# SPDX-License-Identifier: Apache-2.0
#

menuconfig FT5336
	bool "FT5336 capacitive touch panel"
	depends on I2C && HAS_DTS_I2C && HAS_DTS_GPIO
	help
	  Enable driver for the FT5336 capacitive touch panel controller.

if FT5336

config FT5336_FIFO_SIZE
	int "FIFO power of 2 size, pow(2,FT5336_FIFO_SIZE)"
	default 9
	help
	  The size of the internal FIFO for synthesized samples

endif # FT5336
```

## drivers/zio/hts221/Kconfig
```kconfig
#
# Copyright (c) 2019 STMicroelectronics
#
# SPDX-License-Identifier: Apache-2.0
#

menuconfig HTS221
	bool "HTS221 temperature and humidity sensor"
	depends on I2C && HAS_DTS_I2C && HAS_DTS_GPIO
	select HAS_STMEMSC
	select USE_STDC_HTS221
	help
	  Enable driver for HTS221 I2C-based temperature and humidity sensor.

if HTS221

choice HTS221_TRIGGER_MODE
	prompt "Trigger mode"
	default HTS221_TRIGGER_GLOBAL_THREAD
	help
	  Specify the type of triggering to be used by the driver.

config HTS221_TRIGGER_NONE
	bool "No trigger"

config HTS221_TRIGGER_GLOBAL_THREAD
	bool "Use global thread"
	depends on GPIO
	select HTS221_TRIGGER

config HTS221_TRIGGER_OWN_THREAD
	bool "Use own thread"
	depends on GPIO
	select HTS221_TRIGGER

endchoice # HTS221_TRIGGER_MODE

config HTS221_TRIGGER
	bool

config HTS221_THREAD_PRIORITY
	int "Thread priority"
	depends on HTS221_TRIGGER_OWN_THREAD
	default 10
	help
	  Priority of thread used by the driver to handle interrupts.

config HTS221_THREAD_STACK_SIZE
	int "Thread stack size"
	depends on HTS221_TRIGGER_OWN_THREAD
	default 1024
	help
	  Stack size of thread used by the driver to handle interrupts.

config HTS221_SAMPLING_RATE
	int "Output data rate"
	range 0 3
	default 0
	help
	  Sensor output data rate expressed in samples per second.
	  Data rates supported by the chip are:
	  0: ODR selected at runtime
	  1: 1Hz
	  2: 7Hz
	  3: 12.5Hz

endif # HTS221
```

## drivers/zio/synth/Kconfig
```kconfig
# Copyright (c) 2019 Thomas Burdick <thomas.burdick@gmail.com>
#
# SPDX-License-Identifier: Apache-2.0
#

menuconfig SYNTH
	bool "Synthesized Signal Generator"
	help
	  Enable zio driver for signal generator.

if SYNTH

config SYNTH_FIFO_SIZE
	int "FIFO power of 2 size, pow(2,SYNTH_FIFO_SIZE), defaults to pow(2,9)=512"
	default 9
	depends on SYNTH
	help
	  The size of the internal FIFO for synthesized samples

config SYNTH_SAMPLE_RATE
	int "Samples to generate per second, defaults to 44.100kHz (CD sample rate)"
	default 44100
	depends on SYNTH
	help
	  Number of samples to generate per second.

config SYNTH_0_FREQ
	int "Frequency of first channel"
	default 440
	depends on SYNTH
	help
	  The signal frequency in hertz of the zeroth channel

config SYNTH_0_PHASE
	int "Phase of first channel in degrees"
	default 0
	depends on SYNTH
	help
	  The signal phase in degress of the zeroth channel

config SYNTH_1_FREQ
	int "Frequency of second channel"
	default 880
	depends on SYNTH
	help
	  The signal frequency in hertz of the first channel

config SYNTH_1_PHASE
	int "Phase of second channel in degrees"
	default 45
	depends on SYNTH
	help
	  The signal phase in degrees of the first channel

endif # SYNTH
```

## drivers/zsai/Kconfig
```kconfig
# ZSAI devices configuration options

# Copyright (c) 2023 Nordic Semiconductor ASA
# SPDX-License-Identifier: Apache-2.0

#
# Zepyr Storage Access Interface
#
config ZSAI_HAS_DRIVER_ENABLED
	bool
	help
	  This option is enabled when any ZSAI enabled device is present in system.

config ZSAI_DEVICE_REQUIRES_ERASE
	bool
	help
	  Device requires erase before write.

config ZSAI_DEVICE_HAS_ERASE
	bool
	default y if ZSAI_DEVICE_REQUIRES_ERASE
	help
	  Device has erase function. It does not mean that erase is required
	  by a device, it just means that it provides erase functionality.

config ZSAI_DEVICE_HAS_NO_ERASE
	bool
	help
	  Device does not require erase.

if ZSAI_DEVICE_REQUIRES_ERASE

config ZSAI_DEVICE_HAS_UNIFORM_PAGES
	bool
	help
	  Device has uniform page layout, all pages are of the same size.

config ZSAI_DEVICE_HAS_NON_UNIFORM_PAGES
	bool
	help
	  Device has non-uniform page layout, sizes of pages are different.

config ZSAI_DEVICE_HAS_PAGE_HOLES
	bool
	help
	  Device has non linear address space where non-accessible areas appear
	  between accessible pages.

config ZSAI_DEVICE_ERASES_TO_1
	bool
	help
	  Device erase bit value is 1, so byte erases to 0xff and so on.

config ZSAI_DEVICE_ERASES_TO_0
	bool
	help
	  Device erase bit value is 0, so byte erases to 0x00 and so on.

endif # ZSAI_DEVICE_REQUIRES_ERASE

menuconfig ZSAI
	bool "Zephyr Storage Access Interface"
	default n if !DT_HAS_ZEPHYR_ZSAI_SIMULATOR_ENABLED
	help
	  Enable support for various devices that can be used for code and data storage

if ZSAI

module = ZSAI
module-str = zsai
source "subsys/logging/Kconfig.template.log_config"

config ZSAI_INIT_PRIORITY
	int "Zephyr Storage Access Interface init priority"
	default KERNEL_INIT_PRIORITY_DEVICE
	help
	  Default priority for ZSAI device drivers initialization. Driver may provide own
	  initialization priority konfiguration option.

config ZSAI_INIT_PRIORITY
	int "Zephyr Storage Access Interface init priority"
	default KERNEL_INIT_PRIORITY_DEVICE
	help
	  Default priority for ZSAI device drivers initialization. Driver may provide own
	  initialization priority konfiguration option.

if DT_HAS_ZEPHYR_ZSAI_SIMULATOR_ENABLED

config ZSAI_SIMULATED_DEVICE_WITH_ERASE
	bool
	def_bool $(dt_any_compat_enabled_with_prop,$(DT_COMPAT_ZEPHYR_ZSAI_SIMULATOR),erase-value)
	help
	  There is simulated device defined with erase required.

config ZSAI_SIMULATED_DEVICE_WITHOUT_ERASE
	bool
	def_bool $(dt_any_compat_enabled_without_prop,$(DT_COMPAT_ZEPHYR_ZSAI_SIMULATOR),erase-value)
	help
	  There is simulated device without erase defined.

if ZSAI_SIMULATED_DEVICE_WITH_ERASE

config ZSAI_SIMULATED_DEVICE_WITH_ERASE_TO_1
	bool
	def_bool $(dt_any_compat_enabled_with_prop,$(DT_COMPAT_ZEPHYR_ZSAI_SIMULATOR),erase-value,0xff)
	help
	  There is simulated device that erases to 1 (0xff in byte).

config ZSAI_SIMULATED_DEVICE_WITH_ERASE_TO_0
	bool
	def_bool $(dt_any_compat_enabled_with_prop,$(DT_COMPAT_ZEPHYR_ZSAI_SIMULATOR),erase-value,0x00)
	help
	  There is simulated device that erases to 0 (0x00 in byte).

endif

config ZSAI_SIMULATED_DEVICE_DRIVER
	bool "Add simulated device driver"
	select ZSAI_HAS_DRIVER_ENABLED
	select ZSAI_DEVICE_REQUIRES_ERASE if ZSAI_SIMULATED_DEVICE_WITH_ERASE
	select ZSAI_DEVICE_HAS_NO_ERASE if ZSAI_SIMULATED_DEVICE_WITHOUT_ERASE
	select ZSAI_DEVICE_ERASES_TO_0 if ZSAI_SIMULATED_DEVICE_WITH_ERASE_TO_0
	select ZSAI_DEVICE_ERASES_TO_1 if ZSAI_SIMULATED_DEVICE_WITH_ERASE_TO_1
	help
	  Enabled driver for ZSAI device simulator. The driver covers flash and non-flash
	  device simulation.

if ZSAI_SIMULATED_DEVICE_DRIVER

module = ZSAI_SIM
module-str = zsai_sim
source "subsys/logging/Kconfig.template.log_config"

endif # ZSAI_SIMULATED_DEVICE_DRIVER

endif # DT_HAS_ZEPHYR_ZSAI_SIMULATOR_ENABLED

endif # ZSAI
```

## dts/Kconfig
```kconfig
# SPDX-License-Identifier: Apache-2.0

menu "Devicetree Info"

osource "$(KCONFIG_BINARY_DIR)/Kconfig.dts"

endmenu
```

## dts/bindings/acpi/acpi.yaml
```yaml
# Copyright (c) 2023 Intel Corporation
# SPDX-License-Identifier: Apache-2.0

# Common fields for ACPI informed based devices

properties:
  acpi-hid:
    type: string
    description: Used to supply OSPM with the device’s PNP ID or ACPI ID.
        A node is consder as acpi based or not based on whether this property
        is present or not.

  acpi-uid:
    type: string
    description: |
        Provides OSPM with a logical device ID that does not change
        across reboots. This object is optional, but is required when the device
        has no other way to report a persistent unique device ID. The _UID must be
        unique across all devices with either a common _HID or _CID.

  acpi-comp-id:
    type: string-array
    description: Used to supply OSPM with a device’s Plug and Play-Compatible Device ID
```

## dts/bindings/actuator/actuator-device.yaml
```yaml
# Copyright (c) 2025 Nordic Semiconductor ASA
# SPDX-License-Identifier: Apache-2.0

include: base.yaml

properties:
  actuator-invert:
    type: boolean
    description: Invert the direction of the actuator
```

## dts/bindings/actuator/zephyr,actuator-fake.yaml
```yaml
# Copyright (c) 2025 Nordic Semiconductor ASA
# SPDX-License-Identifier: Apache-2.0

description: Fake actuator device

compatible: zephyr,actuator-fake

include: actuator-device.yaml
```
