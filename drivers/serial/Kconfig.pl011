## drivers/serial/Kconfig.serial_shell
```kconfig
# Copyright (C) 2024 Bang & Olufsen A/S, Denmark
# SPDX-License-Identifier: Apache-2.0

config SERIAL_SHELL
	bool "Serial shell"
	depends on SHELL
	depends on UART_INTERRUPT_DRIVEN
	help
	  Enable serial shell.
	  The serial shell supports writing and receiving data to/from a serial device.

	  The serial shell works by enabling a serial device for the shell.
	  This device will be registered to transfer the input from 'serial write'
	  and log the received data from the serial device.

	  Currently only supports serial interrupt API.

if SERIAL_SHELL

config SERIAL_SHELL_RX_BUFFER_SIZE
	int "Serial shell RX buffer size"
	default 32
	help
	  Size of the RX buffer.
	  The shell will dump received messages when
	  RX buffer is full or when FIFO is empty.

config SERIAL_SHELL_TX_BUFFER_SIZE
	int "Serial shell TX buffer size"
	default 32
	help
	  Size of the TX buffer.
	  An attempt at transmitting more data will fail.

endif #  SERIAL_SHELL
```

## drivers/serial/Kconfig.sf32lb
```kconfig
# Copyright (c) Core Devices LLC
# SPDX-License-Identifier: Apache-2.0

config UART_SF32LB
	bool "SiFli SF32LB UART driver"
	default y
	depends on DT_HAS_SIFLI_SF32LB_USART_ENABLED
	select SERIAL_HAS_DRIVER
	select PINCTRL
	select CLOCK_CONTROL
	help
	  This option enables the SiFli SF32LB UART driver.
```

## drivers/serial/Kconfig.shakti
```kconfig
# Copyright (c) 2026 RISE Lab, IIT Madras
# SPDX-License-Identifier: Apache-2.0

config UART_SHAKTI
	bool "Shakti UART driver"
	default y
	depends on DT_HAS_SHAKTI_UART_ENABLED
	select SERIAL_HAS_DRIVER
	select SERIAL_SUPPORT_INTERRUPT
	help
	  Enable the Shakti UART driver.
```

## drivers/serial/Kconfig.si32
```kconfig
# Copyright (c) 2024 GARDENA GmbH
#
# SPDX-License-Identifier: Apache-2.0

config UART_SI32_USART
	bool "SI32 USART MCU serial driver"
	default y
	depends on DT_HAS_SILABS_SI32_USART_ENABLED
	select SERIAL_HAS_DRIVER
	select SERIAL_SUPPORT_INTERRUPT
```

## drivers/serial/Kconfig.silabs_eusart
```kconfig
# Copyright (c) 2024, Yishai Jaffe
# Copyright (c) 2025, Silicon Laboratories Inc.
# SPDX-License-Identifier: Apache-2.0

config UART_SILABS_EUSART
	bool "Silabs EUSART UART driver"
	default y
	depends on DT_HAS_SILABS_EUSART_UART_ENABLED
	select SERIAL_HAS_DRIVER
	select SERIAL_SUPPORT_INTERRUPT
	select SOC_GECKO_EUSART
	select SERIAL_SUPPORT_ASYNC \
		if DT_HAS_SILABS_LDMA_ENABLED
	select DMA if UART_ASYNC_API
	select PINCTRL
	select CLOCK_CONTROL
	help
	  Enable the eusart uart driver.

if UART_SILABS_EUSART

config UART_SILABS_EUSART_ASYNC
	bool
	depends on DMA_SILABS_LDMA
	depends on UART_ASYNC_API
	default y
	help
	  If 'y', Silabs eusart driver will compile with support for UART async API.

endif
```
