## drivers/serial/Kconfig.pl011
```kconfig
# Copyright (c) 2018 Linaro Limited
# SPDX-License-Identifier: Apache-2.0

menuconfig UART_PL011
	bool "ARM PL011 UART Driver"
	default y
	depends on DT_HAS_ARM_PL011_ENABLED || DT_HAS_ARM_SBSA_UART_ENABLED
	select SERIAL_HAS_DRIVER
	select SERIAL_SUPPORT_INTERRUPT
	select PINCTRL if SOC_EOS_S3
	select PINCTRL if DT_HAS_AMBIQ_UART_ENABLED
	select PINCTRL if DT_HAS_RASPBERRYPI_PICO_UART_ENABLED
	help
	  This option enables the UART driver for the PL011

if UART_PL011

config UART_PL011_SBSA
	bool "SBSA UART"
	default y if DT_HAS_ARM_SBSA_UART_ENABLED
	help
	  Enable SBSA mode for PL011 driver. SBSA stands for
	  Server Based System Architecture. This specification
	  among other things defines simplified UART interface
	  which is subset of PL011 interface.

endif # UART_PL011
```

## drivers/serial/Kconfig.psoc6
```kconfig
# Cypress SCB[UART] configuration

# Copyright (c) 2018 Cypress
# Copyright (c) 2020 ATL Electronics
# SPDX-License-Identifier: Apache-2.0

config UART_PSOC6
	bool "PSOC 6 MCU SCB serial driver"
	default y
	depends on DT_HAS_CYPRESS_PSOC6_UART_ENABLED
	select SERIAL_HAS_DRIVER
	select SERIAL_SUPPORT_INTERRUPT
	select USE_INFINEON_UART
	select PINCTRL
	help
	  This option enables the SCB[UART] driver for PSOC 6 SoC family.
```

## drivers/serial/Kconfig.ql_usbserialport_s3b
```kconfig
# QuickLogic USBserialport_S3B configuration option

# Copyright (c) 2022 Antmicro <www.antmicro.com>
# SPDX-License-Identifier: Apache-2.0

config UART_QUICKLOGIC_USBSERIALPORT_S3B
	bool "QuickLogic USBserialport_S3B serial driver"
	default y
	depends on DT_HAS_QUICKLOGIC_USBSERIALPORT_S3B_ENABLED
	select SERIAL_HAS_DRIVER
	select PINCTRL
	help
	  This option enables the QuickLogic USBserialport_S3B serial driver.
```

## drivers/serial/Kconfig.qmsi
```kconfig
menuconfig UART_QMSI
	depends on QMSI
	bool "QMSI UART driver"
	select SERIAL_HAS_DRIVER
	select SERIAL_SUPPORT_INTERRUPT
	help
	  This option enables the QMSI UART driver.

	  This driver is simply a shim driver based on the UART driver
	  provided by the QMSI BSP.

config UART_QMSI_0
	depends on UART_QMSI
	bool "Enable UART 0 controller"

config UART_QMSI_0_HW_FC
	depends on UART_QMSI_0
	bool "HW flow control for UART_0 controller"


config UART_QMSI_1
	depends on UART_QMSI
	bool "Enable UART 1 controller"

config UART_QMSI_1_HW_FC
	depends on UART_QMSI_1
	bool "HW flow control for UART_1 controller"
```

## drivers/serial/Kconfig.raspberrypi
```kconfig
# Copyright (c) 2021 Yonatan Schachter
# SPDX-License-Identifier: Apache-2.0

config UART_RASPBERRYPI
	bool "Raspberry Pi UART driver"
	select SERIAL_HAS_DRIVER
```

## drivers/serial/Kconfig.rcar
```kconfig
# Renesas R-Car UART configuration options

# Copyright (c) 2021 IoT.bzh
# SPDX-License-Identifier: Apache-2.0

config UART_RCAR
	bool "Renesas R-Car UART Driver"
	default y
	depends on DT_HAS_RENESAS_RCAR_SCIF_ENABLED || DT_HAS_RENESAS_RCAR_HSCIF_ENABLED
	select SERIAL_HAS_DRIVER
	select SERIAL_SUPPORT_INTERRUPT
	select PINCTRL
	help
	  Enable Renesas R-Car UART Driver.

config UART_RCAR_BUS_CLK_RATE_BY_DT
	bool "Use the DT to set the Renesas R-Car UART bus clock rate"
	depends on UART_RCAR
	help
	  If enabled, the bus clock rate must be configured through the device-tree
	  clock-frequency property, instead of using the bus clock ID. This may be
	  needed, for instance, when a SCMI platform is not able to return a clock
	  rate for some clock ID.
```

## drivers/serial/Kconfig.rda5981a
```kconfig
#
# Copyright (c) 2017 RDA
# Copyright (c) 2016-2017 Linaro Limited
#
# SPDX-License-Identifier: Apache-2.0
#

menuconfig UART_RDA5981A
	bool "RDA5981 MCU serial driver"
	default n
	select SERIAL_HAS_DRIVER
	depends on SOC_FAMILY_RDA5981
	help
	  This option enables the UART driver for RDA5981 family of
	  processors. Say y if you wish to use serial port on RDA5981
	  MCU.

config UART_RDA5981A_PORT_N
	int "RDA5981 default uart number"
	default 0
	depends on UART_RDA5981A
	help

# --- port 0 ---

config UART_RDA5981A_PORT_0
	bool "Enable RDA5981A USART0 Port"
	default n
	depends on UART_RDA5981A
	help
	  Enable support for USART0 port in the driver. Say y here
	  if you want to use USART0 device.

config UART_RDA5981A_PORT_0_NAME
	string "Device Name for RDA5981A USART0 Port"
	default "UART_0"
	depends on UART_RDA5981A_PORT_0
	help
	  This is the device name for USART0 port, and is
	  included in the device struct.

if !HAS_DTS
config UART_RDA5981A_PORT_0_BAUD_RATE
	int "RDA5981A USART0 Baud Rate"
	default 115200
	depends on UART_RDA5981A_PORT_0
	help
	  The baud rate for USART0 port to be set to at boot.

config UART_RDA5981A_PORT_0_IRQ_PRI
	int "RDA5981A USART0 Interrupt Priority"
	default 0
	depends on UART_RDA5981A_PORT_0 && UART_INTERRUPT_DRIVEN
	help
	  The interrupt priority for USART0 port.
endif

# --- port 1---

config UART_RDA5981A_PORT_1
	bool "Enable RDA5981A USART1 Port"
	default n
	depends on UART_RDA5981A
	help
	 Enable support for USART1 port in the driver. Say y here
	  if you want to use USART1 device.

config UART_RDA5981A_PORT_1_NAME
	string "Device Name for RDA5981A USART1 Port"
	default "UART_1"
	depends on UART_RDA5981A_PORT_1
	help
	  This is the device name for USART1 port, and is
	  included in the device struct.
if !HAS_DTS
config UART_RDA5981A_PORT_1_BAUD_RATE
	int "RDA5981A USART1 Baud Rate"
	default 115200
	depends on UART_RDA5981A_PORT_1
	help
	  The baud rate for USART1 port to be set to at boot.

config UART_RDA5981A_PORT_1_IRQ_PRI
	int "RDA5981A USART1 Interrupt Priority"
	default 0
	depends on UART_RDA5981_PORT_1 && UART_INTERRUPT_DRIVEN
	help
	  The interrupt priority for USART1 port.
endif
```

## drivers/serial/Kconfig.realtek_rts5912
```kconfig
# SPDX-License-Identifier: Apache-2.0
#
# Copyright (c) 2024 Realtek Semiconductor Corporation, SIBG-SD7
#

config UART_RTS5912
	bool "UART driver for Realtek RTS5912 EC"
	default y if DT_HAS_REALTEK_RTS5912_UART_ENABLED
	select PINCTRL
	select CLOCK_CONTROL
	help
	  This option enables the RTS5912 UART wrapper driver.

config UART_RTS5912_INIT_PRIORITY
	int "RTS5912 UART wrapper init priority"
	default 49
	depends on UART_RTS5912
	help
	  Initialization priority for Realtek RTS5912 UART wrapper driver.
```

## drivers/serial/Kconfig.renesas_ra
```kconfig
# Copyright (c) 2023 TOKITA Hiroshi <tokita.hiroshi@fujitsu.com>
# Copyright (c) 2024 Renesas Electronics Corporation
# SPDX-License-Identifier: Apache-2.0

config UART_RENESAS_RA
	bool "Renesas RA Series UART Driver"
	default y
	depends on DT_HAS_RENESAS_RA_UART_SCI_ENABLED
	select SERIAL_HAS_DRIVER
	select SERIAL_SUPPORT_INTERRUPT
	help
	  Enable Renesas RA series UART driver.

config UART_SCI_RA
	bool "Renesas RA SCI UART"
	default y
	depends on DT_HAS_RENESAS_RA_SCI_UART_ENABLED
	select SERIAL_HAS_DRIVER
	select SERIAL_SUPPORT_INTERRUPT
	select SERIAL_SUPPORT_ASYNC
	select USE_RA_FSP_SCI_UART
	select USE_RA_FSP_DTC if UART_ASYNC_API
	help
	  Enable Renesas RA SCI UART Driver.

if UART_SCI_RA

config UART_RA_SCI_UART_FIFO_ENABLE
	bool "RA SCI UART FIFO usage enable"
	default y
	help
	  Enable RA SCI FIFO

endif
```

## drivers/serial/Kconfig.renesas_ra2
```kconfig
# Copyright (c) 2022-2024 MUNIC SA
# SPDX-License-Identifier: Apache-2.0

config UART_RENESAS_RA2_SCI
	bool "RA2 SOC SCI based serial driver"
	default y
	depends on DT_HAS_RENESAS_RA2_SCI_UART_ENABLED
	select SERIAL_HAS_DRIVER
	select SERIAL_SUPPORT_INTERRUPT
	help
	  This option enables the UART driver for RA2 family of
	  processors.
	  Say y if you wish to use serial port on RA2 MCU.
```

## drivers/serial/Kconfig.renesas_ra8
```kconfig
# Copyright (c) 2024 Renesas Electronics Corporation
# SPDX-License-Identifier: Apache-2.0

config UART_RA8_SCI_B
	bool "Renesas RA SCI_B UART"
	default y
	depends on DT_HAS_RENESAS_RA8_UART_SCI_B_ENABLED
	select SERIAL_HAS_DRIVER
	select SERIAL_SUPPORT_INTERRUPT
	select SERIAL_SUPPORT_ASYNC
	select USE_RA_FSP_SCI_B_UART
	select PINCTRL
	help
	  Enable Renesas RA SCI_B UART Driver.

config UART_RA8_SCI_B_UART_DTC
	bool "Renesas RA SCI_B UART DTC"
	default ($(dt_compat_any_has_prop,$(DT_COMPAT_RENESAS_RA8_UART_SCI_B),rx-dtc,True) || \
		$(dt_compat_any_has_prop,$(DT_COMPAT_RENESAS_RA8_UART_SCI_B),tx-dtc,True))
	depends on UART_RA8_SCI_B && UART_ASYNC_API
	select USE_RA_FSP_DTC
	help
	  Enable DTC (Data Transfer Controller) support for the SCI-B UART Driver of RA family.

config UART_RA8_SCI_B_UART_DMAC
	bool "Renesas RA SCI_B UART DMAC"
	default $(dt_compat_any_has_prop,$(DT_COMPAT_RENESAS_RA8_UART_SCI_B),dmas)
	depends on UART_RA8_SCI_B && UART_ASYNC_API
	select USE_RA_FSP_DMA
	help
	  Enable DMAC (Direct Memory Access Controller) support for the
	  SCI-B UART Driver of RA family.

if UART_RA8_SCI_B && (UART_INTERRUPT_DRIVEN || UART_ASYNC_API)

config UART_RA_SCI_B_UART_FIFO_ENABLE
	bool "RA SCI_B UART FIFO usage enable"
	default y if UART_INTERRUPT_DRIVEN
	default n if UART_ASYNC_API
	help
	  Enable RA SCI_B FIFO

endif
```

## drivers/serial/Kconfig.renesas_rx_qemu
```kconfig
# Copyright (c) 2024 Renesas Electronics Corporation
# SPDX-License-Identifier: Apache-2.0

config UART_RENESAS_RX_QEMU
	bool "Renesas RX Series UART Driver"
	default y
	depends on DT_HAS_RENESAS_RX_UART_SCI_QEMU_ENABLED
	select SERIAL_HAS_DRIVER
	help
	  Enable Renesas RX series UART driver.
```

## drivers/serial/Kconfig.renesas_rz
```kconfig
# Copyright (c) 2024-2025 Renesas Electronics Corporation
# SPDX-License-Identifier: Apache-2.0

config UART_RENESAS_RZ_SCIF
	bool "Renesas RZ SCIF UART"
	default y
	depends on DT_HAS_RENESAS_RZ_SCIF_UART_ENABLED
	select SERIAL_HAS_DRIVER
	select SERIAL_SUPPORT_INTERRUPT
	select USE_RZ_FSP_SCIF_UART
	select PINCTRL
	help
	  Enable Renesas RZ SCIF UART Driver.

config UART_RENESAS_RZ_SCI
	bool "Renesas RZ SCI UART"
	default y
	depends on DT_HAS_RENESAS_RZ_SCI_UART_ENABLED
	select PINCTRL
	select SERIAL_HAS_DRIVER
	select SERIAL_SUPPORT_INTERRUPT
	select USE_RZ_FSP_SCI_UART
	help
	  Enable Renesas RZ SCI UART Driver.

if UART_RENESAS_RZ_SCIF

config UART_RENESAS_RZG_INIT_DELAY_MS
	int "UART initialization delay in milliseconds"
	default 8000
	help
	  This option is to make a delay to wait for the A55 to complete its setting first
	  before UART initialization of M33.

endif

config UART_RENESAS_RZA2M_SCIF
	bool "Renesas A2M SCIF UART Driver"
	default y
	depends on DT_HAS_RENESAS_RZA2M_SCIF_UART_ENABLED
	select SERIAL_HAS_DRIVER
	select SERIAL_SUPPORT_INTERRUPT
	select PINCTRL
	help
	  Enable Renesas SCIF UART Driver.
```

## drivers/serial/Kconfig.riscv_qemu
```kconfig
# Kconfig.riscv_qemu - riscv-qemu UART configuration option
#
# Copyright (c) 2016 Jean-Paul Etienne <fractalclone@gmail.com>
#
# SPDX-License-Identifier: Apache-2.0
#

menuconfig UART_RISCV_QEMU
	bool "riscv-qemu UART driver"
	depends on SOC_RISCV32_QEMU
	select SERIAL_HAS_DRIVER
	help
	  Enable the riscv-qemu UART driver.
```

## drivers/serial/Kconfig.rpmsg
```kconfig
# Copyright (c) 2025 Ayush Singh, BeagleBoard.org
# SPDX-License-Identifier: Apache-2.0

config UART_RPMSG
	bool "Use RPMSG uart"
	depends on RPMSG_SERVICE
	depends on DT_HAS_RPMSG_UART_ENABLED
	help
	  Enable uart using RPMSG.

	  This can be used when the application is loaded onto the co-processor
	  using remoteproc.

if UART_RPMSG

config UART_RPMSG_RX_BUF_SIZE
	int "Size of internal rx buffer"
	default 64
	help
	  This option can be used to set the size of receive buffer.

endif # UART_RPMSG
```

## drivers/serial/Kconfig.rtt
```kconfig
# Virtual UART RTT driver option

# Copyright (c) 2019 omSquare s.r.o.
# SPDX-License-Identifier: Apache-2.0

menuconfig UART_RTT
	bool "UART RTT driver"
	default y
	depends on DT_HAS_SEGGER_RTT_UART_ENABLED
	depends on USE_SEGGER_RTT
	select SEGGER_RTT_CUSTOM_LOCKING
	help
	  This option enables access RTT channel as UART device.

if UART_RTT

# Workaround for not being able to have commas in macro arguments
DT_COMPAT_SEGGER_RTT_UART  := segger,rtt-uart

config UART_RTT_0
	def_bool $(dt_nodelabel_enabled_with_compat,rtt0,$(DT_COMPAT_SEGGER_RTT_UART))
	depends on SEGGER_RTT_MAX_NUM_UP_BUFFERS >= 1 && SEGGER_RTT_MAX_NUM_DOWN_BUFFERS >= 1
	depends on SEGGER_RTT_MODE_NO_BLOCK_SKIP
	select SERIAL_HAS_DRIVER
	select UART_RTT_DRIVER
	help
	  Enable UART on (default) RTT channel 0. Default channel has to be configured in non-blocking skip mode.

config UART_RTT_1
	def_bool $(dt_nodelabel_enabled_with_compat,rtt1,$(DT_COMPAT_SEGGER_RTT_UART))
	depends on SEGGER_RTT_MAX_NUM_UP_BUFFERS >= 2 && SEGGER_RTT_MAX_NUM_DOWN_BUFFERS >= 2
	select SERIAL_HAS_DRIVER
	select UART_RTT_DRIVER
	help
	  Enable UART on RTT channel 1

config UART_RTT_2
	def_bool $(dt_nodelabel_enabled_with_compat,rtt2,$(DT_COMPAT_SEGGER_RTT_UART))
	depends on SEGGER_RTT_MAX_NUM_UP_BUFFERS >= 3 && SEGGER_RTT_MAX_NUM_DOWN_BUFFERS >= 3
	select SERIAL_HAS_DRIVER
	select UART_RTT_DRIVER
	help
	  Enable UART on RTT channel 2

config UART_RTT_3
	def_bool $(dt_nodelabel_enabled_with_compat,rtt3,$(DT_COMPAT_SEGGER_RTT_UART))
	depends on SEGGER_RTT_MAX_NUM_UP_BUFFERS >= 4 && SEGGER_RTT_MAX_NUM_DOWN_BUFFERS >= 4
	select SERIAL_HAS_DRIVER
	select UART_RTT_DRIVER
	help
	  Enable UART on RTT channel 3

config UART_RTT_DRIVER
	bool

endif
```

## drivers/serial/Kconfig.rv32m1_lpuart
```kconfig
# RV32M1 SDK LPUART

# Copyright (c) 2018 Foundries.io
# SPDX-License-Identifier: Apache-2.0

config UART_RV32M1_LPUART
	bool "RV32M1 LPUART driver"
	default y
	depends on DT_HAS_OPENISA_RV32M1_LPUART_ENABLED
	depends on CLOCK_CONTROL
	select SERIAL_HAS_DRIVER
	select SERIAL_SUPPORT_INTERRUPT
	select PINCTRL
	help
	  Enable the RV32M1 LPUART driver.
```

## drivers/serial/Kconfig.rzt2m
```kconfig
# Copyright (c) 2023 Antmicro <www.antmicro.com>
# SPDX-License-Identifier: Apache-2.0

config UART_RZT2M
	bool "Renesas RZ/T2M UART Driver"
	default y
	depends on DT_HAS_RENESAS_RZT2M_UART_ENABLED
	select SERIAL_HAS_DRIVER
	select SERIAL_SUPPORT_INTERRUPT
	select PINCTRL
	help
	  Enable Renesas RZ/T2M UART Driver.
```

## drivers/serial/Kconfig.sam0
```kconfig
# Atmel SAM SERCOM configuration options

# Copyright (c) 2017 Google LLC.
# SPDX-License-Identifier: Apache-2.0

config UART_SAM0
	bool "Atmel SAM0 series SERCOM USART driver"
	default y
	depends on DT_HAS_ATMEL_SAM0_UART_ENABLED
	select PINCTRL
	select SERIAL_HAS_DRIVER
	select SERIAL_SUPPORT_INTERRUPT
	select SERIAL_SUPPORT_ASYNC if DT_HAS_ATMEL_SAM0_DMAC_ENABLED
	help
	  This option enables the SERCOMx USART driver for Atmel SAM0 MCUs.

config UART_SAM0_ASYNC
	bool "Async UART support for Atmel SAM0 series."
	depends on DMA_SAM0
	depends on UART_SAM0
	depends on UART_ASYNC_API
```

## drivers/serial/Kconfig.sedi
```kconfig
# Copyright (c) 2023 Intel Corporation
#
# SPDX-License-Identifier: Apache-2.0
#

config UART_SEDI
	bool "Intel SEDI UART driver"
	default y
	depends on DT_HAS_INTEL_SEDI_UART_ENABLED
	select SERIAL_HAS_DRIVER
	select SERIAL_SUPPORT_INTERRUPT
	help
	  This option enables the Intel SEDI UART driver.
	  This driver is simply a shim driver built upon the SEDI
	  bare metal UART driver in the hal-intel module
```
