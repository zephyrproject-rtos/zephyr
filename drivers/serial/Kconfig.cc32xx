## drivers/serial/Kconfig.cc32xx
```kconfig
# SPDX-License-Identifier: Apache-2.0

config UART_CC32XX
	bool "CC32XX UART driver"
	default y
	depends on DT_HAS_TI_CC32XX_UART_ENABLED
	select SERIAL_HAS_DRIVER
	select SERIAL_SUPPORT_INTERRUPT
	select PINCTRL
	help
	  This option enables the CC32XX UART driver, for UART_0.
```

## drivers/serial/Kconfig.cdns
```kconfig
#Copyright 2022 Meta Platforms, Inc.and its affiliates.
#SPDX-License-Identifier: Apache-2.0

config UART_CDNS
	bool "Serial driver for Cadence UART IP6528"
	default y
	depends on DT_HAS_CDNS_UART_ENABLED
	select SERIAL_HAS_DRIVER
	select SERIAL_SUPPORT_INTERRUPT
	select PINCTRL if $(dt_compat_any_has_prop,$(DT_COMPAT_CDNS_UART),pinctrl-0)
	help
	  This option enables the serial driver for Cadence UART IP6528.
```

## drivers/serial/Kconfig.ch32v
```kconfig
# Copyright (c) 2023-2024 Chen Xingyu <hi@xingrz.me>
# SPDX-License-Identifier: Apache-2.0

config UART_CH5XX
	bool "WCH CH5xx UART driver"
	default y
	depends on DT_HAS_WCH_CH5XX_UART_ENABLED
	select SERIAL_HAS_DRIVER
	select SERIAL_SUPPORT_INTERRUPT
	select PINCTRL
	help
	  Enable WCH CH5xx UART driver.
```

## drivers/serial/Kconfig.cloudbear
```kconfig
# Kconfig.cloudbear - CloudBEAR UART configuration option
#
# Copyright (c) 2018 Vitaly Gaiduk <vitaly.gaiduk@cloudbear.ru>
#
# SPDX-License-Identifier: Apache-2.0
#

menuconfig UART_CLOUDBEAR
	bool "CloudBEAR serial driver"
	depends on SOC_RISCV32_CLOUDBEAR_BM310
	select SERIAL_HAS_DRIVER
	select SERIAL_SUPPORT_INTERRUPT
	help
	  This option enables the CloudBEAR serial driver.
```

## drivers/serial/Kconfig.cmsdk_apb
```kconfig
# ARM CMSDK APB SoC UART configuration options

# Copyright (c) 2016 Linaro Limited
# SPDX-License-Identifier: Apache-2.0

config UART_CMSDK_APB
	bool "ARM CMSDK APB UART driver"
	default y
	depends on DT_HAS_ARM_CMSDK_UART_ENABLED
	select SERIAL_HAS_DRIVER
	select SERIAL_SUPPORT_INTERRUPT
	help
	  This option enables the UART driver for ARM CMSDK APB UART.
```

## drivers/serial/Kconfig.dspic_uart
```kconfig
# Copyright (c) 2025, Microchip Technology Inc.
# SPDX-License-Identifier: Apache-2.0


config UART_DSPIC
	bool "dsPIC33A UART driver"
	default y
	select SERIAL_HAS_DRIVER
	help
	  Enable support for the dsPIC33A UART driver.
```

## drivers/serial/Kconfig.dtr
```kconfig
# DTR wrapper UART configuration options

# Copyright (c) 2025 Nordic Semiconductor ASA
# SPDX-License-Identifier: Apache-2.0

config UART_DTR
	bool "UART DTR wrapper driver"
	default y
	depends on DT_HAS_ZEPHYR_UART_DTR_ENABLED
	depends on GPIO
	depends on PM_DEVICE_RUNTIME
	help
	  Enable UART DTR wrapper driver. This driver wraps an existing UART
	  device and adds DTR (Data Terminal Ready) functionality for runtime
	  power management. When UART is powered, the DTR signal is asserted,
	  and when the UART is powered down, the DTR signal is de-asserted.
	  The driver acts as a child node of the actual UART.

config UART_DTR_INIT_PRIORITY
	int "UART DTR driver init priority"
	default 60
	depends on UART_DTR
	help
	  UART DTR wrapper driver initialization priority. This should be
	  higher than the underlying UART driver but lower than devices
	  that depend on it. Generally set higher than CONFIG_UART_INIT_PRIORITY.
```

## drivers/serial/Kconfig.earlyprint
```kconfig
# Copyright (c) 2023 Arm Limited (or its affiliates). All rights reserved.
# SPDX-License-Identifier: Apache-2.0
#
# Configs list here will be included into EARLY_PRINT, see subsys/debug/Kconfig,
# to support early print mode choices.

config EARLY_PRINT_USE_UART_PL011
	bool "Use UART PL011"
	depends on UART_PL011
	help
	  Use UART PL011 to do early print
```

## drivers/serial/Kconfig.efinix_sapphire
```kconfig
# Copyright (c) 2023 Efinix Inc.
# SPDX-License-Identifier: Apache-2.0

config UART_EFINIX_SAPPIHIRE
	bool "EFINIX_SAPPIHIRE serial driver"
	default y
	depends on DT_HAS_EFINIX_SAPPHIRE_UART0_ENABLED
	select SERIAL_HAS_DRIVER
	help
	  This option enables Efinix sapphire serial driver.
```

## drivers/serial/Kconfig.em32
```kconfig
# SPDX-FileCopyrightText: 2026 ELAN Microelectronics Corp.
# SPDX-License-Identifier: Apache-2.0

config UART_EM32
	bool "ELAN EM32 serial driver"
	default y
	depends on SOC_EM32F967
	depends on DT_HAS_ELAN_EM32_UART_ENABLED
	depends on CLOCK_CONTROL_EM32_APB
	depends on GPIO_EM32
	select SERIAL_HAS_DRIVER
	select PINCTRL
	help
	  This option enables the elan em32 serial driver.

config UART_EM32_INIT_PRIORITY
	int "EM32 UART initialization priority"
	default 56
	depends on UART_EM32
	help
	  Initialization priority for the EM32 UART driver.
	  This must be greater than GPIO_EM32_INIT_PRIORITY and
	  CLOCK_CONTROL_EM32_APB_INIT_PRIORITY since UART depends on the GPIO,
	  clock, and pinctrl drivers. When UART is used for the console, it
	  must also be less than CONSOLE_INIT_PRIORITY.
```

## drivers/serial/Kconfig.emul
```kconfig
# Emulated UART configuration options

# Copyright (c) 2023 Fabian Blatz
# SPDX-License-Identifier: Apache-2.0

config UART_EMUL
	bool "Emulated UART driver [EXPERIMENTAL]"
	default y
	depends on DT_HAS_ZEPHYR_UART_EMUL_ENABLED
	depends on EMUL
	select SERIAL_HAS_DRIVER
	select SERIAL_SUPPORT_INTERRUPT
	select SERIAL_SUPPORT_ASYNC
	select RING_BUFFER
	select EXPERIMENTAL
	help
	  Enable the emulated UART driver.

if UART_EMUL

config UART_EMUL_DEVICE_INIT_PRIORITY
	int "UART emulated devices' init priority"
	default 0
	help
	  The init priority of emulated driver on the UART bus.

config UART_EMUL_WORK_Q_STACK_SIZE
	int "UART emulator work queue stack size"
	default 2048

config UART_EMUL_WORK_Q_PRIORITY
	int "UART emulator work queue thread priority"
	default 1

endif # UART_EMUL
```

## drivers/serial/Kconfig.ene
```kconfig
# Copyright (c) 2023 ENE Technology Inc.
# SPDX-License-Identifier: Apache-2.0

config UART_ENE_KB1200
	bool "ENE KB1200 serial driver"
	default y
	depends on DT_HAS_ENE_KB1200_UART_ENABLED
	select SERIAL_HAS_DRIVER
	select SERIAL_SUPPORT_INTERRUPT
	select PINCTRL
	help
	  This option enables the KB1200 serial driver.
```

## drivers/serial/Kconfig.esp32
```kconfig
# SPDX-License-Identifier: Apache-2.0


config UART_ESP32
	bool "ESP32 UART driver"
	default y
	depends on DT_HAS_ESPRESSIF_ESP32_UART_ENABLED
	select SERIAL_HAS_DRIVER
	select SERIAL_SUPPORT_INTERRUPT
	select SERIAL_SUPPORT_ASYNC if (SOC_SERIES_ESP32C3 || SOC_SERIES_ESP32C6 || SOC_SERIES_ESP32S3)
	select GPIO_ESP32
	help
	  Enable the ESP32 UART.

config SERIAL_ESP32_USB
	bool "ESP32 built-in USB serial driver"
	default y
	depends on DT_HAS_ESPRESSIF_ESP32_USB_SERIAL_ENABLED
	select SERIAL_HAS_DRIVER
	select SERIAL_SUPPORT_INTERRUPT
	help
	  Enable the built-in USB serial interface present in some Espressif
	  MCUs like ESP32-Cx.

	  This driver uses the peripheral called USB Serial/JTAG Controller
	  (USB_SERIAL_JTAG), which acts as a CDC-ACM interface towards the
	  USB host. The USB stack is built into the chip and accessed
	  by the firmware through a simplified API similar to a "normal"
	  UART peripheral.

config UART_ESP32_TX_FIFO_THRESH
	hex "ESP32 UART TX FIFO Threshold"
	depends on UART_ESP32
	default 0x1
	range 1 127
	help
	  Configure the TX FIFO threshold for ESP32 UART driver.

config UART_ESP32_RX_FIFO_THRESH
	hex "ESP32 UART RX FIFO Threshold"
	depends on UART_ESP32
	default 0x16
	range 1 127
	help
	  Configure the RX FIFO threshold for ESP32 UART driver.

config LPUART_ESP32
	bool "ESP32 LP UART driver"
	default y
	depends on DT_HAS_ESPRESSIF_ESP32_LPUART_ENABLED
	select SERIAL_HAS_DRIVER
	help
	  Enable the ESP32 LP UART.
```

## drivers/serial/Kconfig.esp32c3_rom
```kconfig
# Copyright (c) 2021 Espressif Systems (Shanghai) Co., Ltd.
# SPDX-License-Identifier: Apache-2.0

DT_COMPAT_ESP32_UART := espressif,esp32-uart
DT_COMPAT_ESP32_UART_ROM := espressif,esp32c3-uart

config UART_ROM_ESP32C3
	bool "ESP32C3 ROM UART driver"
	default ($(dt_compat_enabled,$(DT_COMPAT_ESP32_UART_ROM))\
			&& !$(dt_compat_enabled,$(DT_COMPAT_ESP32_UART)))
	select SERIAL_HAS_DRIVER
	depends on SOC_ESP32C3
	help
	  Enable the ESP32C3 UART using ROM routines.
```

## drivers/serial/Kconfig.esp32s2_rom
```kconfig
# Copyright (c) 2021 Espressif Systems (Shanghai) Co., Ltd.
# SPDX-License-Identifier: Apache-2.0


DT_COMPAT_ESP32_UART := espressif,esp32-uart
DT_COMPAT_ESP32_UART_ROM := espressif,esp32s2-uart

config UART_ROM_ESP32S2
	bool "ESP32S2 ROM UART driver"
	default ($(dt_compat_enabled,$(DT_COMPAT_ESP32_UART_ROM))\
			&& !$(dt_compat_enabled,$(DT_COMPAT_ESP32_UART)))
	select SERIAL_HAS_DRIVER
	depends on SOC_ESP32S2
	help
	  Enable the ESP32S2 UART using ROM routines.
```

## drivers/serial/Kconfig.eusart_gecko
```kconfig
# Gecko SDK EUSART

# Copyright (c) 2024, Yishai Jaffe
# SPDX-License-Identifier: Apache-2.0

config EUSART_GECKO
	bool "Gecko EUSART driver"
	default y
	depends on DT_HAS_SILABS_GECKO_EUSART_ENABLED
	select SERIAL_HAS_DRIVER
	select SERIAL_SUPPORT_INTERRUPT
	select SOC_GECKO_EUSART
	select PINCTRL if (SOC_FAMILY_SILABS_S1 || SOC_FAMILY_SILABS_S2)
	select CLOCK_CONTROL if SOC_FAMILY_SILABS_S2
	select PM_DEVICE if PM && SOC_FAMILY_SILABS_S2
	help
	  Enable the Gecko eusart driver.
```

## drivers/serial/Kconfig.fe310
```kconfig
# Kconfig.fe310 - SiFive Freedom E310 UART configuration option
#
# Copyright (c) 2017 Jean-Paul Etienne <fractalclone@gmail.com>
#
# SPDX-License-Identifier: Apache-2.0
#

menuconfig UART_FE310
	bool "SiFive Freedom E310 serial driver"
	depends on SOC_RISCV32_FE310
	default n
	select SERIAL_HAS_DRIVER
	select SERIAL_SUPPORT_INTERRUPT
	help
	  This option enables the SiFive Freedom E310 serial driver.

# ---------- Port 0 ----------

menuconfig UART_FE310_PORT_0
	bool "Enable FE310 Port 0"
	default n
	depends on UART_FE310
	help
	  This tells the driver to configure the UART port at boot, depending on
	  the additional configure options below.

config UART_FE310_PORT_0_NAME
	string "Port 0 Device Name"
	default "uart0"
	depends on UART_FE310_PORT_0
	help
	  This is the device name for UART, and is included in the device
	  struct.

config UART_FE310_PORT_0_BAUD_RATE
	int "Port 0 Baud Rate"
	default 0
	depends on UART_FE310_PORT_0
	help
	  The baud rate for UART port to be set to at boot.

	  Leave at 0 to skip initialization.

config UART_FE310_PORT_0_IRQ_PRIORITY
	int "Port 0 Interrupt Priority"
	default 1
	depends on UART_FE310_PORT_0
	help
	  Port 0 Interrupt Priority

config UART_FE310_PORT_0_RXCNT_IRQ
	int "Port 0 RX Interrupt Threshold Count"
	default 0
	depends on UART_FE310_PORT_0
	help
	  Port 0 RX Threshold at which the RX FIFO interrupt triggers.

config UART_FE310_PORT_0_TXCNT_IRQ
	int "Port 0 TX Interrupt Threshold Count"
	default 0
	depends on UART_FE310_PORT_0
	help
	  Port 0 TX Threshold at which the TX FIFO interrupt triggers.

# ---------- Port 1 ----------

menuconfig UART_FE310_PORT_1
	bool "Enable FE310 Port 1"
	default n
	depends on UART_FE310
	help
	  This tells the driver to configure the UART port at boot, depending on
	  the additional configure options below.

config UART_FE310_PORT_1_NAME
	string "Port 1 Device Name"
	default "uart1"
	depends on UART_FE310_PORT_1
	help
	  This is the device name for UART, and is included in the device
	  struct.

config UART_FE310_PORT_1_BAUD_RATE
	int "Port 1 Baud Rate"
	default 0
	depends on UART_FE310_PORT_1
	help
	  The baud rate for UART port to be set to at boot.

	  Leave at 0 to skip initialization.

config UART_FE310_PORT_1_IRQ_PRIORITY
	int "Port 1 Interrupt Priority"
	default 1
	depends on UART_FE310_PORT_1
	help
	  Port 1 Interrupt Priority

config UART_FE310_PORT_1_RXCNT_IRQ
	int "Port 0 RX Interrupt Threshold Count"
	default 0
	depends on UART_FE310_PORT_1
	help
	  Port 1 RX Threshold at which the RX FIFO interrupt triggers.

config UART_FE310_PORT_1_TXCNT_IRQ
	int "Port 1 TX Interrupt Threshold Count"
	default 0
	depends on UART_FE310_PORT_1
	help
	  Port 1 TX Threshold at which the TX FIFO interrupt triggers.
```

## drivers/serial/Kconfig.focaltech
```kconfig
# Copyright (c) 2025, FocalTech Systems CO.,Ltd
# SPDX-License-Identifier: Apache-2.0

config UART_FOCALTECH
	bool "FocalTech FT9001 MCU serial driver"
	default y
	depends on DT_HAS_FOCALTECH_FT9001_USART_ENABLED
	select SERIAL_HAS_DRIVER
	select SERIAL_SUPPORT_INTERRUPT
	select RESET
	select CLOCK_CONTROL
	help
	  Enable UART driver for FocalTech FT9001 SoC.
```

## drivers/serial/Kconfig.ft201x
```kconfig
# Copyright (c) 2023 Bjarki Arge Andreasen
# SPDX-License-Identifier: Apache-2.0

config SERIAL_FT201X
	bool "FTDI FT201X I2C to USB bridge"
	default y
	depends on DT_HAS_FTDI_FT201X_ENABLED
	depends on I2C
	select SERIAL_HAS_DRIVER
	help
	  This option enables the FTDI I2C to USB bridge driver
```

## drivers/serial/Kconfig.gd32
```kconfig
# Copyright (c) 2021 ATL Electronics
# SPDX-License-Identifier: Apache-2.0

config USART_GD32
	bool "GD32 serial driver"
	default y
	depends on DT_HAS_GD_GD32_USART_ENABLED
	select PINCTRL
	select SERIAL_HAS_DRIVER
	select SERIAL_SUPPORT_INTERRUPT
	select SERIAL_SUPPORT_ASYNC if DT_HAS_GD_GD32_DMA_ENABLED || \
				       DT_HAS_GD_GD32_DMA_V1_ENABLED
	select DMA if UART_ASYNC_API
	select USE_GD32_USART
	help
	  This option enables the USART driver for GD32 SoC family.
```

## drivers/serial/Kconfig.gecko
```kconfig
# Gecko SDK UART

# Copyright (c) 2017, Christian Taedcke
# SPDX-License-Identifier: Apache-2.0

config UART_GECKO
	bool "Gecko UART/USART driver"
	default y
	depends on DT_HAS_SILABS_GECKO_UART_ENABLED || DT_HAS_SILABS_GECKO_USART_ENABLED
	select SERIAL_HAS_DRIVER
	select SERIAL_SUPPORT_INTERRUPT
	select SOC_GECKO_USART
	help
	  Enable the Gecko uart driver.
```

## drivers/serial/Kconfig.gecko_usart
```kconfig
# Kconfig - Gecko SDK UART
#
# Copyright (c) 2017, Christian Taedcke
#
# SPDX-License-Identifier: Apache-2.0
#

menuconfig USART_GECKO
	bool "Gecko usart driver"
	depends on HAS_SILABS_GECKO
	depends on GPIO_GECKO
	default n
	select SERIAL_HAS_DRIVER
	select SERIAL_SUPPORT_INTERRUPT
	help
	  Enable the Gecko usart driver.

if USART_GECKO

menuconfig USART_GECKO_0
	bool "USART 0"
	default n
	help
	  Enable USART 0.

if USART_GECKO_0

config USART_GECKO_0_GPIO_LOC
	int "Pin Locations"
	range 0 31
	depends on USART_GECKO
	help
	  The GPIO pins to use.

endif # USART_GECKO_0

menuconfig USART_GECKO_1
	bool "USART 1"
	default n
	help
	  Enable USART 1.

if USART_GECKO_1

config USART_GECKO_1_GPIO_LOC
	int "Pin Locations"
	range 0 31
	depends on USART_GECKO
	help
	  The GPIO pins to use.

endif # USART_GECKO_1

endif # USART_GECKO
```

## drivers/serial/Kconfig.gotham
```kconfig
# Kconfig.gotham - Gotham SoC UART configuration option
#
#
# SPDX-License-Identifier: Apache-2.0
#

menuconfig UART_GOTHAM
        bool "GOTHAM SoC serial driver"
        depends on SOC_RISCV32_GOTHAM
        default n
        select SERIAL_HAS_DRIVER
        help
          This option enables the Gotham SoC serial driver.
```

## drivers/serial/Kconfig.hc32
```kconfig
# Copyright (c) 2026 Liu Changjie <liucj1228@outlook.com>
# SPDX-License-Identifier: Apache-2.0

config UART_HC32
	bool "XHSC HC32 USART driver"
	default y
	depends on DT_HAS_XHSC_HC32_USART_ENABLED
	depends on HAS_HC32_DDL
	select PINCTRL
	select HC32_LL_FCG
	select HC32_LL_GPIO
	select HC32_LL_USART
	select SERIAL_HAS_DRIVER
	help
	  Enable polling UART support for XHSC HC32 USART peripherals.
```

## drivers/serial/Kconfig.hostlink
```kconfig
# Copyright (c) 2023 Synopsys Inc. All rights reserved.
# SPDX-License-Identifier: Apache-2.0

# Virtual UART HOSTLINK driver option

config UART_HOSTLINK
	bool "ARC HOSTLINK UART driver"
	default y
	depends on ARC
	depends on DT_HAS_SNPS_HOSTLINK_UART_ENABLED
	select SERIAL_HAS_DRIVER
	help
	  This option enables access to HOSTLINK channel as UART device.
```
