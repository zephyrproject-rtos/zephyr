## drivers/serial/Kconfig.miv
```kconfig
# Mi-V UART configuration option

# Copyright (c) 2018 Antmicro <www.antmicro.com>
# SPDX-License-Identifier: Apache-2.0

config UART_MIV
	bool "Mi-V serial driver"
	default y
	depends on DT_HAS_MICROCHIP_COREUART_ENABLED
	select SERIAL_HAS_DRIVER
	help
	  This option enables the Mi-V serial driver.
```

## drivers/serial/Kconfig.mmio8
```kconfig
# Kconfig.mmio8 - mmio8 UART configuration option
#
# Copyright (c) 2019 Western Digital Corporation or its affiliates
#
# SPDX-License-Identifier: Apache-2.0
#

menuconfig UART_MMIO8
	bool "mmio8 serial driver"
	select SERIAL_HAS_DRIVER
	help
	  This option enables an transmit-only serial driver with
 	  a single memory-mapped address for writing data

config UART_MMIO8_BASE
       	hex "UART mmio8 base address"
	default 0x0
	depends on UART_MMIO8
	help
	  Set mmio8 base address
```

## drivers/serial/Kconfig.msp432p4xx
```kconfig
# SPDX-License-Identifier: Apache-2.0

config UART_MSP432P4XX
	bool "MSP432P4XX UART driver"
	default y
	depends on DT_HAS_TI_MSP432P4XX_UART_ENABLED
	select SERIAL_HAS_DRIVER
	select SERIAL_SUPPORT_INTERRUPT
	help
	  This option enables the MSP432P4XX UART driver, for UART_0.
```

## drivers/serial/Kconfig.native_posix
```kconfig
# SPDX-License-Identifier: Apache-2.0

config UART_NATIVE_POSIX
	bool "UART driver for native_sim/posix"
	default y
	depends on DT_HAS_ZEPHYR_NATIVE_POSIX_UART_ENABLED
	select SERIAL_HAS_DRIVER
	help
	  This enables a UART driver for the POSIX ARCH with up to 2 UARTs.
	  For the first UART port, the driver can be configured
	  to either connect to the terminal from which the executable was run, or into
	  one dedicated pseudoterminal for that UART.

if UART_NATIVE_POSIX

choice NATIVE_UART_0
	prompt "Native UART Port 0 connection"
	default NATIVE_UART_0_ON_OWN_PTY

config NATIVE_UART_0_ON_OWN_PTY
	bool "Connect the UART to its own pseudo terminal"
	help
	  Connect this UART to its own pseudoterminal. This is the preferred
	  option for users who want to use Zephyr's shell.
	  Moreover this option does not conflict with any other native
	  backend which may use the invoking shell standard input/output.

config NATIVE_UART_0_ON_STDINOUT
	bool "Connect the UART to the invoking shell stdin/stdout"
	help
	  Connect this UART to the stdin & stdout of the calling shell/terminal
	  which invoked the native executable. This is good enough for
	  automated testing, or when feeding from a file/pipe.
	  Note that other, non UART messages, will also be printed to the
	  terminal.
	  It is strongly discouraged to try to use this option with the new
	  shell interactively, as the default terminal configuration is NOT
	  appropriate for interactive use.

endchoice

config UART_NATIVE_WAIT_PTS_READY_ENABLE
	bool "Support waiting for pseudo terminal client readiness"
	depends on NATIVE_UART_0_ON_OWN_PTY || UART_NATIVE_POSIX_PORT_1_ENABLE
	help
	  When this option is selected a new command line switch is provided:
	  ``--wait_uart``
	  When ``--wait_uart`` is used, writes to the UART will be held until a
	  client has connected to the slave side of the pseudoterminal.
	  Otherwise writes are sent irrespectively.

config UART_NATIVE_POSIX_PORT_1_ENABLE
	bool "Second UART port"
	help
	  Useful if you need to have another serial connection to host.
	  This is used for example in PPP (Point-to-Point Protocol)
	  implementation.

config NATIVE_UART_AUTOATTACH_DEFAULT_CMD
	string "Default command to attach the UART to a new terminal"
	default "xterm -e screen %s &"
	help
	  If the native executable is called with the --attach_uart
	  command line option, this will be the default command which will be
	  run to attach a new terminal to the 1st UART.
	  Note that this command must have one, and only one, '%s' as
	  placeholder for the pseudoterminal device name (e.g. /dev/pts/35)
	  This is only applicable if the UART_0 is configured to use its own
	  PTY with NATIVE_UART_0_ON_OWN_PTY.
	  The 2nd UART will not be affected by this option.
	  If you are using GNOME, then you can use this command string
	  'gnome-terminal -- screen %s'

endif # UART_NATIVE_POSIX
```

## drivers/serial/Kconfig.native_pty
```kconfig
# Copyright (c) 2025, Nordic Semiconductor ASA
# SPDX-License-Identifier: Apache-2.0

config UART_NATIVE_PTY
	bool "PTY based UART driver for native_sim"
	default y
	depends on DT_HAS_ZEPHYR_NATIVE_PTY_UART_ENABLED
	select SERIAL_HAS_DRIVER
	select SERIAL_SUPPORT_ASYNC
	select SERIAL_SUPPORT_INTERRUPT
	help
	  This enables a PTY based UART driver for the POSIX ARCH with up to 2 UARTs.
	  For the first UART port, the driver can be configured
	  to either connect to the terminal from which the executable was run, or into
	  one dedicated pseudoterminal for that UART.


if UART_NATIVE_PTY

choice UART_NATIVE_PTY_0
	prompt "Native PTY Port 0 connection"
	default UART_NATIVE_PTY_0_ON_OWN_PTY

config UART_NATIVE_PTY_0_ON_OWN_PTY
	bool "Connect the first PTY UART to its own pseudo terminal"
	help
	  Connect this UART to its own pseudoterminal. This is the preferred
	  option for users who want to use Zephyr's shell.
	  Moreover this option does not conflict with any other native
	  backend which may use the invoking shell standard input/output.
	  Note it can be overridden from command line

config UART_NATIVE_PTY_0_ON_STDINOUT
	bool "Connect the first PTY UART to the invoking shell stdin/stdout"
	help
	  Connect this UART to the stdin & stdout of the calling shell/terminal
	  which invoked the native executable. This is good enough for
	  automated testing, or when feeding from a file/pipe.
	  Note that other, non UART messages, will also be printed to the
	  terminal.
	  It is strongly discouraged to try to use this option with the new
	  shell interactively, as the default terminal configuration is NOT
	  appropriate for interactive use.

endchoice

config UART_NATIVE_PTY_AUTOATTACH_DEFAULT_CMD
	string "Default command to attach a PTY UART to a new terminal"
	default "xterm -e screen %s &"
	help
	  If the native executable is called with the --attach_uart
	  command line option, this will be the default command which will be
	  run to attach a new terminal to the 1st UART.
	  Note that this command must have one, and only one, '%s' as
	  placeholder for the pseudoterminal device name (e.g. /dev/pts/35)
	  This is only applicable if the UART_0 is configured to use its own
	  PTY with UART_NATIVE_PTY_0_ON_OWN_PTY.
	  The 2nd UART will not be affected by this option.
	  If you are using GNOME, then you can use this command string
	  'gnome-terminal -- screen %s'

endif # UART_NATIVE_PTY
```

## drivers/serial/Kconfig.native_tty
```kconfig
# Copyright (c) 2023 Marko Sagadin
# SPDX-License-Identifier: Apache-2.0
config UART_NATIVE_TTY
	bool "UART driver for interacting with host serial ports"
	default y
	depends on DT_HAS_ZEPHYR_NATIVE_TTY_UART_ENABLED
	select SERIAL_HAS_DRIVER
```

## drivers/serial/Kconfig.nct
```kconfig
# Copyright (c) 2024 Nuvoton Technology Corporation.
#
# SPDX-License-Identifier: Apache-2.0

config UART_NCT
	bool "NUVOTON NCT serial driver"
	default y
	depends on DT_HAS_NUVOTON_NCT_UART_ENABLED
	select SERIAL_HAS_DRIVER
	select SERIAL_SUPPORT_INTERRUPT
	help
	  This option enables the UART driver for Nuvoton NCT
	  family of processors.
	  Say y to use serial port on Nuvoton MCU.
```

## drivers/serial/Kconfig.neorv32
```kconfig
# NEORV32 UART configuration

# Copyright (c) 2021 Henrik Brix Andersen <henrik@brixandersen.dk>
# SPDX-License-Identifier: Apache-2.0

config UART_NEORV32
	bool "NEORV32 UART"
	default y
	depends on DT_HAS_NEORV32_UART_ENABLED
	depends on SYSCON
	select SERIAL_HAS_DRIVER
	select SERIAL_SUPPORT_INTERRUPT
	help
	  This option enables the UART driver for the NEORV32.
```

## drivers/serial/Kconfig.npcm
```kconfig
# Copyright (c) 2024 Nuvoton Technology Corporation.
#
# SPDX-License-Identifier: Apache-2.0

config UART_NPCM
	bool "NUVOTON NPCM serial driver"
	default y
	depends on DT_HAS_NUVOTON_NPCM_UART_ENABLED
	select SERIAL_HAS_DRIVER
	select SERIAL_SUPPORT_INTERRUPT
	help
	  This option enables the UART driver for Nuvoton NPCM
	  family of processors.
	  Say y to use serial port on Nuvoton MCU.
```

## drivers/serial/Kconfig.npcx
```kconfig
# NPCX UART driver configuration options

# Copyright (c) 2020 Nuvoton Technology Corporation.
# SPDX-License-Identifier: Apache-2.0

DT_UART_NPCX:=$(dt_nodelabel_path,uart1)

config UART_NPCX
	bool "Nuvoton NPCX embedded controller (EC) serial driver"
	default y
	depends on DT_HAS_NUVOTON_NPCX_UART_ENABLED
	select SERIAL_HAS_DRIVER
	select SERIAL_SUPPORT_INTERRUPT
	select PINCTRL
	help
	  This option enables the UART driver for NPCX family of
	  processors.
	  Say y if you wish to use serial port on NPCX MCU.

# Expose this option when the reg property has two register base addresses.
# i.e. One UART register base address and one MDMA register base address.
config UART_NPCX_USE_MDMA
	bool "Nuvoton NPCX embedded controller (EC) serial driver DMA support"
	depends on UART_NPCX && "$(dt_node_reg_addr_hex,$(DT_UART_NPCX),1)" != 0
	select SERIAL_SUPPORT_ASYNC
	help
	  Enable support for npcx UART DMA mode.

config UART_NPCX_FIFO_EX
	bool "Extended NPCX UART FIFO driver support"
	default y if DT_HAS_NUVOTON_NPCX_UART_NPCKN_ENABLED
	help
	  This option enables the extended UART FIFO driver for NPCKN variant
	  of processors.
```

## drivers/serial/Kconfig.nrf5
```kconfig
# Kconfig.nrf5 - NRF5 UART configuration
#
# Copyright (c) 2016 - 2018, Nordic Semiconductor ASA
#
# SPDX-License-Identifier: Apache-2.0
#

menuconfig UART_NRF5
	bool "Nordic Semiconductor NRF5 family processor UART driver"
	select SERIAL_HAS_DRIVER
	select SERIAL_SUPPORT_INTERRUPT
	select GPIO
	depends on SOC_FAMILY_NRF
	help
	  This option enables the UART driver for Nordic Semiconductor nRF5
	  family processors. Note that there is only one
	  UART controller on nRF5 ICs.

if UART_NRF5

config UART_NRF5_PARITY_BIT
        bool "Enable parity bit"
        help
          Enable parity bit.

config UART_NRF5_FLOW_CONTROL
	bool "Enable flow control"
	help
	  Enable flow control. If selected, additionally two pins, RTS and CTS
	  have to be configured.

config UART_NRF5_GPIO_TX_PIN
	int "TX Pin Number"
	range 0 47 if SOC_NRF52840_QIAA
	range 0 31
	help
	  The GPIO pin to use for TX.

config UART_NRF5_GPIO_RX_PIN
	int "RX Pin Number"
	range 0 47 if SOC_NRF52840_QIAA
	range 0 31
	help
	  The GPIO pin to use for RX.

config UART_NRF5_GPIO_RTS_PIN
	int "RTS Pin Number"
	range 0 47 if SOC_NRF52840_QIAA
	range 0 31
	depends on UART_NRF5_FLOW_CONTROL
	help
	  The GPIO pin to use for RTS.

config UART_NRF5_GPIO_CTS_PIN
	int "CTS Pin Number"
	range 0 47 if SOC_NRF52840_QIAA
	range 0 31
	depends on UART_NRF5_FLOW_CONTROL
	help
	  The GPIO pin to use for CTS.

endif # UART_NRF5
```

## drivers/serial/Kconfig.nrf5e
```kconfig
# Kconfig.nrf5e - NRF5 UARTE configuration
#
# Copyright (c) 2017 Byteflies, Inc. (Bertold Van den Bergh)
# Copyright (c) 2016 Nordic Semiconductor ASA
#
# SPDX-License-Identifier: Apache-2.0
#

menuconfig UART_NRF5E
	bool "Nordic Semiconductor NRF5 family processor UARTE driver"
	default n
	select SERIAL_HAS_DRIVER
	select SERIAL_SUPPORT_INTERRUPT
	depends on SOC_FAMILY_NRF5
	select GPIO_NRF5
	help
	  This option enables the UART driver for Nordic Semiconductor nRF5
	  family processors. Note that there is only one
	  UART controller on nRF5 ICs.

config UART_NRF5E_CLK_FREQ
	int
	default 16000000
	depends on UART_NRF5E

config UART_NRF5E_TX_DMA_BUFSIZE
	int "Transmit buffer size"
	range 0 255
	default 128
	depends on UART_NRF5E
	depends on UART_INTERRUPT_DRIVEN
	help
	  The transmit FIFO size.

config UART_NRF5E_RX_DMA_BUFSIZE
	int "Receive buffer size"
	range 0 255
	default 128
	depends on UART_NRF5E
	depends on UART_INTERRUPT_DRIVEN
	help
	  The receive FIFO size.

config UART_NRF5E_TX_DMA_MAXBLOCK
	int "Transmit maximum block size"
	range 0 255
	default 64
	depends on UART_NRF5E
	depends on UART_INTERRUPT_DRIVEN
	help
	  The maximum DMA block size on the transmit chain.

config UART_NRF5E_RX_DMA_MAXBLOCK
	int "Receive maximum block size"
	range 0 255
	default 1
	depends on UART_NRF5E
	depends on UART_INTERRUPT_DRIVEN
	help
	  The maximum DMA block size on the receive chain.
	  Leave this set to one unless you know what you are doing.

config UART_NRF5E_FLOW_CONTROL
	bool "Enable Flow Control"
	default n
	depends on UART_NRF5E
	help
	  Enable Flow Control. If selected, additionally two pins, RTS and CTS
	  has to be configured.

config UART_NRF5E_GPIO_TX_PIN
	int "TX Pin Number"
	range 0 31
	depends on UART_NRF5E
	depends on GPIO_NRF5
	help
	  The GPIO pin to use for TX.

config UART_NRF5E_GPIO_RX_PIN
	int "RX Pin Number"
	range 0 31
	depends on UART_NRF5E
	depends on GPIO_NRF5
	help
	  The GPIO pin to use for RX.

config UART_NRF5E_GPIO_RTS_PIN
	int "RTS Pin Number"
	range 0 31
	depends on UART_NRF5E
	depends on GPIO_NRF5
	depends on UART_NRF5E_FLOW_CONTROL
	help
	  The GPIO pin to use for RTS.

config UART_NRF5E_GPIO_CTS_PIN
	int "CTS Pin Number"
	range 0 31
	depends on UART_NRF5E
	depends on GPIO_NRF5
	depends on UART_NRF5E_FLOW_CONTROL
	help
	  The GPIO pin to use for CTS.
```
