## drivers/serial/Kconfig.nrfx
```kconfig
# nrfx UART configuration

# Copyright (c) 2016 - 2018, Nordic Semiconductor ASA
# SPDX-License-Identifier: Apache-2.0

menuconfig UART_NRFX
	bool "nRF UART nrfx drivers"
	default y
	select SERIAL_HAS_DRIVER
	select SERIAL_SUPPORT_INTERRUPT
	select SERIAL_SUPPORT_ASYNC
	select PINCTRL
	depends on DT_HAS_NORDIC_NRF_UART_ENABLED || DT_HAS_NORDIC_NRF_UARTE_ENABLED
	help
	  Enable support for nrfx UART drivers for nRF MCU series.
	  Peripherals with the same instance ID cannot be used together,
	  e.g. UART_0 and UARTE_0.

if UART_NRFX

config UART_NRFX_UART
	def_bool y
	depends on DT_HAS_NORDIC_NRF_UART_ENABLED

config UART_NRFX_UARTE
	def_bool y
	depends on DT_HAS_NORDIC_NRF_UARTE_ENABLED
	imply NRFX_UARTE_CONFIG_SKIP_PSEL_CONFIG if !UART_NRFX_UARTE_LEGACY_SHIM
	imply NRFX_UARTE_CONFIG_SKIP_GPIO_CONFIG if !UART_NRFX_UARTE_LEGACY_SHIM

config UART_NRFX_UARTE_LEGACY_SHIM
	bool "Legacy UARTE shim"
	depends on UART_NRFX_UARTE
	default y

config UART_NRFX_UARTE_ENHANCED_RX
	bool "Enhanced RX handling"
	depends on UART_ASYNC_API
	depends on UART_NRFX_UARTE_LEGACY_SHIM
	default y if !(UART_0_NRF_HW_ASYNC || UART_1_NRF_HW_ASYNC || UART_2_NRF_HW_ASYNC)
	help
	  Enable RX handling mode which is switching buffers on timeout. This is an
	  enhancement compared to other two modes (default and hardware assisted).
	  Default mode could miscount bytes when interrupt was not handled on time
	  and hardware assisted required TIMER peripheral instance and PPI channel
	  for accurate byte counting.

config UART_ASYNC_TX_CACHE_SIZE
	int "TX cache buffer size"
	depends on UART_ASYNC_API
	depends on UART_NRFX_UARTE_LEGACY_SHIM
	default 8
	help
	  For UARTE, TX cache buffer is used when provided TX buffer is not located
	  in RAM, because EasyDMA in UARTE peripherals can only transfer data
	  from RAM.

if HAS_HW_NRF_UART0 || HAS_HW_NRF_UARTE0
nrfx_uart_num = 0
rsource "Kconfig.nrfx_uart_instance"
endif

if HAS_HW_NRF_UARTE1
nrfx_uart_num = 1
rsource "Kconfig.nrfx_uart_instance"
endif

if HAS_HW_NRF_UARTE2
nrfx_uart_num = 2
rsource "Kconfig.nrfx_uart_instance"
endif

if HAS_HW_NRF_UARTE3
nrfx_uart_num = 3
rsource "Kconfig.nrfx_uart_instance"
endif

if HAS_HW_NRF_UARTE00
nrfx_uart_num = 00
rsource "Kconfig.nrfx_uart_instance"
endif

if HAS_HW_NRF_UARTE20
nrfx_uart_num = 20
rsource "Kconfig.nrfx_uart_instance"
endif

if HAS_HW_NRF_UARTE21
nrfx_uart_num = 21
rsource "Kconfig.nrfx_uart_instance"
endif

if HAS_HW_NRF_UARTE22
nrfx_uart_num = 22
rsource "Kconfig.nrfx_uart_instance"
endif

if HAS_HW_NRF_UARTE30
nrfx_uart_num = 30
rsource "Kconfig.nrfx_uart_instance"
endif

if HAS_HW_NRF_UARTE120

config UART_NRFX_UARTE_USE_CLOCK_CONTROL
	def_bool y
	select CLOCK_CONTROL

nrfx_uart_num = 120
rsource "Kconfig.nrfx_uart_instance"
endif

if HAS_HW_NRF_UARTE130
nrfx_uart_num = 130
rsource "Kconfig.nrfx_uart_instance"
endif

if HAS_HW_NRF_UARTE131
nrfx_uart_num = 131
rsource "Kconfig.nrfx_uart_instance"
endif

if HAS_HW_NRF_UARTE132
nrfx_uart_num = 132
rsource "Kconfig.nrfx_uart_instance"
endif

if HAS_HW_NRF_UARTE133
nrfx_uart_num = 133
rsource "Kconfig.nrfx_uart_instance"
endif

if HAS_HW_NRF_UARTE134
nrfx_uart_num = 134
rsource "Kconfig.nrfx_uart_instance"
endif

if HAS_HW_NRF_UARTE135
nrfx_uart_num = 135
rsource "Kconfig.nrfx_uart_instance"
endif

if HAS_HW_NRF_UARTE136
nrfx_uart_num = 136
rsource "Kconfig.nrfx_uart_instance"
endif

if HAS_HW_NRF_UARTE137
nrfx_uart_num = 137
rsource "Kconfig.nrfx_uart_instance"
endif

config NRFX_TIMER0
	default y
	depends on UART_0_NRF_HW_ASYNC_TIMER = 0 \
		|| UART_1_NRF_HW_ASYNC_TIMER = 0 \
		|| UART_2_NRF_HW_ASYNC_TIMER = 0 \
		|| UART_3_NRF_HW_ASYNC_TIMER = 0

config NRFX_TIMER1
	default y
	depends on UART_0_NRF_HW_ASYNC_TIMER = 1 \
		|| UART_1_NRF_HW_ASYNC_TIMER = 1 \
		|| UART_2_NRF_HW_ASYNC_TIMER = 1 \
		|| UART_3_NRF_HW_ASYNC_TIMER = 1

config NRFX_TIMER2
	default y
	depends on UART_0_NRF_HW_ASYNC_TIMER = 2 \
		|| UART_1_NRF_HW_ASYNC_TIMER = 2 \
		|| UART_2_NRF_HW_ASYNC_TIMER = 2 \
		|| UART_3_NRF_HW_ASYNC_TIMER = 2

config NRFX_TIMER3
	default y
	depends on UART_0_NRF_HW_ASYNC_TIMER = 3 \
		|| UART_1_NRF_HW_ASYNC_TIMER = 3 \
		|| UART_2_NRF_HW_ASYNC_TIMER = 3 \
		|| UART_3_NRF_HW_ASYNC_TIMER = 3

config NRFX_TIMER4
	default y
	depends on UART_0_NRF_HW_ASYNC_TIMER = 4 \
		|| UART_1_NRF_HW_ASYNC_TIMER = 4 \
		|| UART_2_NRF_HW_ASYNC_TIMER = 4 \
		|| UART_3_NRF_HW_ASYNC_TIMER = 4

endif # UART_NRFX
```

## drivers/serial/Kconfig.nrfx_uart_instance
```kconfig
#nRF UART(E) instance configuration

# Copyright (c) 2023 Nordic Semiconductor ASA
# SPDX-License-Identifier: Apache-2.0

config UART_$(nrfx_uart_num)_INTERRUPT_DRIVEN
	bool "Interrupt support on port $(nrfx_uart_num)"
	depends on UART_INTERRUPT_DRIVEN
	default y
	help
	  This option enables UART interrupt support on port $(nrfx_uart_num).

config UART_$(nrfx_uart_num)_ASYNC
	bool "Asynchronous API support on port $(nrfx_uart_num)"
	depends on UART_ASYNC_API && !UART_$(nrfx_uart_num)_INTERRUPT_DRIVEN
	default y
	help
	  This option enables UART Asynchronous API support on port $(nrfx_uart_num).

config UART_$(nrfx_uart_num)_NRF_USE_TIMER
	bool
	depends on UART_ASYNC_API
	depends on $(dt_nodelabel_has_prop,uart$(nrfx_uart_num),timer)
	depends on HAS_HW_NRF_UARTE$(nrfx_uart_num)
	default y
	help
	  Indicates that TIMER peripheral for RX byte counting is assigned to that instance
	  in the Device Tree.

config UART_$(nrfx_uart_num)_COUNT_BYTES_WITH_TIMER
	bool
	depends on UART_$(nrfx_uart_num)_NRF_USE_TIMER
	depends on $(dt_nodelabel_bool_prop,uart$(nrfx_uart_num),frame-timeout-supported)
	default y
	imply UARTE_NRFX_UARTE_COUNT_BYTES_WITH_TIMER
	help
	  Indicates that TIMER peripheral for RX byte counting is assigned to that instance
	  in the Device Tree. UARTE revision used in the newer targets like nRF54x Series.

config UART_$(nrfx_uart_num)_COUNT_BYTES_WITH_TIMER_LEGACY
	bool
	depends on UART_$(nrfx_uart_num)_NRF_USE_TIMER || UART_$(nrfx_uart_num)_NRF_HW_ASYNC
	depends on !$(dt_nodelabel_bool_prop,uart$(nrfx_uart_num),frame-timeout-supported)
	default y
	imply UARTE_NRFX_UARTE_COUNT_BYTES_WITH_TIMER_LEGACY
	help
	  Indicates that TIMER peripheral for RX byte counting is assigned to that instance
	  in the Device Tree. UARTE revision used in the legacy targets (nRF52x, nRF53x and nRF91x).

config UART_$(nrfx_uart_num)_ENHANCED_POLL_OUT
	bool "Efficient poll out on port $(nrfx_uart_num)"
	depends on !$(dt_nodelabel_bool_prop,uart$(nrfx_uart_num),endtx-stoptx-supported)
	default y
	depends on HAS_HW_NRF_UARTE$(nrfx_uart_num)
	depends on HAS_HW_NRF_PPI || HAS_HW_NRF_DPPIC
	select NRFX_GPPI
	help
	  When enabled, polling out does not trigger interrupt which stops TX.
	  Feature uses a PPI channel.

config UART_$(nrfx_uart_num)_NRF_PARITY_BIT
	bool "Parity bit"
	help
	  Enable parity bit.

config UART_$(nrfx_uart_num)_NRF_TX_BUFFER_SIZE
	int "Size of RAM buffer"
	depends on HAS_HW_NRF_UARTE$(nrfx_uart_num)
	range 1 $(UINT16_MAX)
	default 32
	help
	  Size of the transmit buffer for API function: fifo_fill.
	  This value is limited by range of TXD.MAXCNT register for
	  particular SoC.

config UART_$(nrfx_uart_num)_NRF_HW_ASYNC
	bool "Use hardware RX byte counting"
	depends on UART_ASYNC_API
	depends on HAS_HW_NRF_UARTE$(nrfx_uart_num)
	depends on !($(dt_nodelabel_bool_prop,uart$(nrfx_uart_num),frame-timeout-supported))
	select DEPRECATED
	help
	  Option is deprecated. Use Device Tree "timer" property to assign a TIMER peripheral
	  for reliable reception without HWFC.

config UART_$(nrfx_uart_num)_NRF_ASYNC_LOW_POWER
	bool "Low power mode"
	depends on HAS_HW_NRF_UARTE$(nrfx_uart_num)
	depends on UART_ASYNC_API
	default y if !PM_DEVICE
	help
	  When enabled, UARTE is enabled before each TX or RX usage and disabled
	  when not used. Disabling UARTE while in idle allows to achieve lowest
	  power consumption. It is only feasible if receiver is not always on.
	  This option is irrelevant when device power management (PM) is enabled
	  because then device state is controlled by the PM actions.


config UART_$(nrfx_uart_num)_NRF_HW_ASYNC_TIMER
	int "Timer instance"
	depends on !UART_$(nrfx_uart_num)_NRF_USE_TIMER
	depends on UART_$(nrfx_uart_num)_NRF_HW_ASYNC
	help
	  Option is deprecated. Use Device Tree "timer" property to assign a TIMER peripheral
	  for reliable reception without HWFC.
```

## drivers/serial/Kconfig.ns16550
```kconfig
# SPDX-License-Identifier: Apache-2.0

menuconfig UART_NS16550
	bool "NS16550 serial driver"
	default y
	depends on DT_HAS_NS16550_ENABLED
	select SERIAL_HAS_DRIVER
	select SERIAL_SUPPORT_INTERRUPT
	select PINCTRL if $(dt_compat_any_has_prop,$(DT_COMPAT_NS16550),pinctrl-0)
	help
	  This option enables the NS16550 serial driver.
	  This driver can be used for the serial hardware
	  available on x86 boards.

if UART_NS16550

config UART_NS16550_LINE_CTRL
	bool "Serial Line Control for Apps"
	depends on UART_LINE_CTRL
	help
	  This enables the API for apps to control the serial line,
	  such as CTS and RTS.

	  Says n if not sure.

config UART_NS16550_DRV_CMD
	bool "Driver Commands"
	depends on UART_DRV_CMD
	help
	  This enables the API for apps to send commands to driver.

	  Says n if not sure.

config UART_NS16550_INTEL_LPSS_DMA
	bool "INTEL LPSS support for NS16550"
	select SERIAL_SUPPORT_ASYNC
	select DMA if UART_ASYNC_API
	help
	  This enables the usage of INTEL LPSS internal DMA for Async operations.

choice UART_NS16550_VARIANT
	prompt "UART variant"
	default UART_NS16550_VARIANT_NS16550
	help
	  Select UART device variant

config UART_NS16550_VARIANT_NS16550
	bool "UART 16550 (16-bytes FIFO)"
	help
	  This enables support for 16-bytes FIFO if UART controller is 16550.

config UART_NS16550_VARIANT_NS16750
	bool "UART 16750 (64-bytes FIFO and auto flow control)"
	help
	  This enables support for 64-bytes FIFO and automatic hardware
	  flow control if UART controller is 16750.

config UART_NS16550_VARIANT_NS16950
	bool "UART 16950 (128-bytes FIFO and auto flow control)"
	help
	  This enables support for 128-bytes FIFO and automatic hardware flow control.
endchoice

config UART_NS16550_ACCESS_WORD_ONLY
	bool "NS16550 only allows word access"
	help
	  In some case, e.g. ARC HS Development kit, the peripheral space of ns
	  16550 (DesignWare UART) only allows word access, byte access will raise
	  exception.

config UART_NS16550_TI_K3
	bool "Add support for NS16550 variant specific to TI K3 SoCs"
	select PINCTRL
	help
	  Enabling this configuration allows the users to use the UART port in
	  Texas Instruments K3 SoCs by enabling a vendor specific extended register
	  set.

config UART_NS16550_DW8250_DW_APB
	bool "Synopsys DesignWare 8250"
	help
	  This enables support for Synopsys DesignWare 8250 UART controller.

config UART_NS16550_ITE_HIGH_SPEED_BAUDRATE
	bool "IT8XXX2 specific baud rate configuration"
	help
	  Enable IT8XXX2 specific baud rate configuration.
	  This applies to high-speed baud rate configuration.

menu "NS16550 Workarounds"

config UART_NS16550_WA_ISR_REENABLE_INTERRUPT
	bool "Re-enable interrupts by toggling IER at end of ISR"
	depends on UART_INTERRUPT_DRIVEN
	help
	  In some configurations (e.g. edge interrupt triggers),
	  an interruptible event occurs during ISR and the host interrupt
	  controller does not see the new event due to IIR is constantly
	  asserting interrupts. For example, the callback handles RX and
	  then TX. If another character comes in before end of TX processing
	  (TX interrupt still asserts while raising RX interrupt), the host
	  interrupt controller may not see this new event. So if needed,
	  the IER is being toggled to re-assert interrupts at the end of ISR
	  to nudge the host interrupt controller to fire the ISR again.

endmenu

endif # UART_NS16550
```

## drivers/serial/Kconfig.nsim
```kconfig
# SPDX-License-Identifier: Apache-2.0

config UART_NSIM
	bool "UART driver for MetaWare nSim"
	select SERIAL_HAS_DRIVER
	help
	  This enables the UART driver for the MetaWare nSim simulator.
```

## drivers/serial/Kconfig.numaker
```kconfig
# NPCX UART driver configuration options

# Copyright (c) 2023 Nuvoton Technology Corporation.
# SPDX-License-Identifier: Apache-2.0

config UART_NUMAKER
	bool "Nuvoton NUMAKER MCU serial driver"
	default y
	select SERIAL_HAS_DRIVER
	select HAS_NUMAKER_UART
	select SERIAL_SUPPORT_INTERRUPT
	depends on DT_HAS_NUVOTON_NUMAKER_UART_ENABLED
	help
	  This option enables the UART driver for Nuvoton Numaker family of
	  processors.
	  Say y if you wish to use serial port on Nuvoton Numaker MCU.
```

## drivers/serial/Kconfig.numicro
```kconfig
# SPDX-License-Identifier: Apache-2.0
#
# NUVOTON UART configuration
#
# Copyright (c) 2020 Linumiz
# Author: Saravanan Sekar <saravanan@linumiz.com>

config UART_NUMICRO
	bool "NUVOTON MCU serial driver"
	default y
	depends on DT_HAS_NUVOTON_NUMICRO_UART_ENABLED
	select SERIAL_HAS_DRIVER
	select HAS_NUMICRO_UART
	select PINCTRL
	help
	  This option enables the UART driver for Nuvoton Numicro
	  family of processors.
	  Say y to use serial port on Nuvoton MCU.
```

## drivers/serial/Kconfig.nuvoton
```kconfig
# SPDX-License-Identifier: Apache-2.0
#
# NUVOTON UART configuration
#
# Copyright (c) 2020 Linumiz
# Author: Saravanan Sekar <saravanan@linumiz.com>

config UART_NUVOTON
	bool "NUVOTON MCU serial driver"
	select SERIAL_HAS_DRIVER
	select HAS_NUMICRO_UART
	depends on SOC_FAMILY_NUMICRO
	help
	  This option enables the UART driver for Nuvoton Numicro
	  family of processors.
	  Say y to use serial port on Nuvoton MCU.
```

## drivers/serial/Kconfig.nxp_flexcomm
```kconfig
# NXP Flexcomm USART
# Copyright 2026
# SPDX-License-Identifier: Apache-2.0

config UART_NXP_FLEXCOMM
	bool "NXP FLEXCOMM UART driver"
	default y
	depends on DT_HAS_NXP_FLEXCOMM_UART_ENABLED
	select SERIAL_HAS_DRIVER
	select SERIAL_SUPPORT_INTERRUPT
	select SERIAL_SUPPORT_ASYNC if \
		DT_HAS_NXP_LPC_DMA_ENABLED
	select PM_POLICY_DEVICE_CONSTRAINTS if PM
	select DMA if UART_ASYNC_API
	select PINCTRL
	help
	  Enable the NXP Flexcomm UART driver.

config UART_NXP_FLEXCOMM_ISR_SUPPORT
	bool
	depends on UART_NXP_FLEXCOMM
	default y if UART_INTERRUPT_DRIVEN || UART_ASYNC_API
	help
	  Enable UART interrupt service routine.
```

## drivers/serial/Kconfig.nxp_s32
```kconfig
# Copyright 2022 NXP
# SPDX-License-Identifier: Apache-2.0

config UART_NXP_S32_LINFLEXD
	bool "LINFlexD UART driver for NXP S32 family processors"
	default y
	depends on DT_HAS_NXP_S32_LINFLEXD_ENABLED
	select SERIAL_HAS_DRIVER
	select SERIAL_SUPPORT_INTERRUPT
	select NOCACHE_MEMORY if ARCH_HAS_NOCACHE_MEMORY_SUPPORT
	help
	  Enable the LINFlexD UART driver for NXP S32 family processors.

if UART_NXP_S32_LINFLEXD

config UART_NXP_S32_POLL_OUT_TIMEOUT
	int "The maximum duration to transfer a byte data in blocking mode"
	default 10000
	help
	  Maximum duration in micro-seconds to transfer a byte data in blocking mode.

config UART_NXP_S32_POLL_IN_TIMEOUT
	int "The maximum duration to receive a byte data in blocking mode"
	default 10000
	help
	  Maximum duration in micro-seconds to receive a byte data in blocking mode.

endif # UART_NXP_S32_LINFLEXD
```

## drivers/serial/Kconfig.nxp_sc28c94
```kconfig
# Copyright (c) 2022, Trackuit.
# SPDX-License-Identifier: Apache-2.0

config NXP_SC28C94
	bool "NXP SC28C94 driver"
	help
	  Include drivers for NXP SC28C94 driver
```

## drivers/serial/Kconfig.opensbi_console
```kconfig
# openSBI Console UART driver configuration options

# Copyright (c) 2024 sensry.io
# SPDX-License-Identifier: Apache-2.0


if RISCV_OPENSBI

config UART_OPENSBI_CONSOLE
	bool "openSBI console serial driver"
	default y
	select SERIAL_HAS_DRIVER
	help
	  This option enables the console driver for openSBI based RISCV family of
	  processors.

endif # RISCV_OPENSBI
```
