## drivers/serial/Kconfig.silabs_usart
```kconfig
# Copyright (c) 2025, Silicon Laboratories Inc.
# SPDX-License-Identifier: Apache-2.0

config UART_SILABS_USART
	bool "Silabs USART UART driver"
	default y
	depends on DT_HAS_SILABS_USART_UART_ENABLED
	select SERIAL_HAS_DRIVER
	select SERIAL_SUPPORT_INTERRUPT
	select SOC_GECKO_USART
	select SERIAL_SUPPORT_ASYNC \
		if DT_HAS_SILABS_LDMA_ENABLED
	select DMA if UART_ASYNC_API
	select PINCTRL
	select CLOCK_CONTROL
	help
	  Enable the Silicon Labs usart driver.

if UART_SILABS_USART

config UART_SILABS_USART_ASYNC
	bool
	default y
	depends on DMA_SILABS_LDMA
	depends on UART_ASYNC_API
	help
	  If 'y', Silabs usart driver will compile with support for UART async API.

endif
```

## drivers/serial/Kconfig.silabs_vcom
```kconfig
# Copyright (c) 2025, Silicon Laboratories Inc.
# SPDX-License-Identifier: Apache-2.0

config UART_SILABS_VCOM
	bool "Silabs VCOM auto config"
	default y
	select GPIO
	select SOC_GECKO_DBG
	depends on DT_HAS_SILABS_VCOM_UART_ENABLED
	help
	  Enable Virtual COM port configuration over ITM.
```

## drivers/serial/Kconfig.smartbond
```kconfig
# Copyright (c) 2022 Renesas Electronics Corporation
# SPDX-License-Identifier: Apache-2.0

config UART_SMARTBOND
	bool "Renesas SmartBond(tm) UART driver"
	default y
	depends on DT_HAS_RENESAS_SMARTBOND_UART_ENABLED
	select SERIAL_HAS_DRIVER
	select SERIAL_SUPPORT_INTERRUPT
	select UART_INTERRUPT_DRIVEN if PM_DEVICE
	select PINCTRL
	help
	  Enable UART driver for Renesas SmartBond(tm) DA1469x series MCU.
```

## drivers/serial/Kconfig.stm32
```kconfig
# STM32 UART configuration

# Copyright (c) 2016 Open-RnD Sp. z o.o.
# SPDX-License-Identifier: Apache-2.0

config UART_STM32
	bool "STM32 MCU serial driver"
	default y
	depends on DT_HAS_ST_STM32_UART_ENABLED
	select SERIAL_HAS_DRIVER
	select SERIAL_SUPPORT_INTERRUPT
	# the ASYNC implementation requires a DMA controller
	select SERIAL_SUPPORT_ASYNC \
		if DT_HAS_ST_STM32_DMA_V1_ENABLED || \
		   DT_HAS_ST_STM32_DMA_V2_ENABLED || \
		   DT_HAS_ST_STM32_DMA_V2BIS_ENABLED || \
		   DT_HAS_ST_STM32U5_DMA_ENABLED
	select DMA if UART_ASYNC_API
	select RESET
	select PINCTRL
	help
	  This option enables the UART driver for STM32 family of
	  processors.
	  Say y if you wish to use serial port on STM32 MCU.

if UART_STM32

config UART_STM32U5_ERRATA_DMAT_AFFECTED
	bool
	default y
	depends on SOC_STM32H503XX || \
		SOC_STM32H523XX || SOC_STM32H533XX || \
		SOC_STM32H562XX || SOC_STM32H563XX || SOC_STM32H573XX || \
		SOC_STM32U575XX || SOC_STM32U585XX
	help
	  Affected by the DMAT errata. See UART_STM32U5_ERRATA_DMAT.

if UART_STM32U5_ERRATA_DMAT_AFFECTED

choice UART_STM32U5_ERRATA_DMAT
	prompt "Workaround for DMAT errata on selected devices"
	default UART_STM32U5_ERRATA_DMAT_LOWPOWER if PM
	default UART_STM32U5_ERRATA_DMAT_NOCLEAR if !PM
	help
	  Handles erratum "USART does not generate DMA requests after
	  setting/clearing DMAT bit" as described in the errata sheets:

	  - STM32H503xx: ES0561 rev. 4, sections 2.11.2 and 2.12.1
	  - STM32H523xx/H533xx: ES0621 rev. 2, sections 2.14.2 and 2.15.1
	  - STM32H562xx/H563xx/H573xx: ES0565 rev. 7, sections 2.16.2 and 2.17.1
	  - STM32U575xx/U585xx: ES0499 rev. 10, sections 2.21.2 and 2.22.1

config UART_STM32U5_ERRATA_DMAT_LOWPOWER
	bool "Send first byte by polling"
	help
	  This option sends first byte via software polling and
	  rest of the buffer is sent via DMA. This option is suitable
	  for STOP low-power modes.

config UART_STM32U5_ERRATA_DMAT_NOCLEAR
	bool "Do not clear DMAT"
	help
	  This option keeps DMAT bit set. This may cause additional power
	  consumption in STOP low-power modes.

endchoice # UART_STM32U5_ERRATA_DMAT

endif # UART_STM32U5_ERRATA_DMAT_AFFECTED

endif # UART_STM32
```

## drivers/serial/Kconfig.sy1xx
```kconfig
# SPDX-License-Identifier: Apache-2.0
# Copyright (c) 2024 sensry.io

config UART_SY1XX
	bool "Sensry SY1xx driver"
	default y
	depends on DT_HAS_SENSRY_SY1XX_UART_ENABLED
	select SERIAL_HAS_DRIVER
	select PINCTRL
	help
	  Driver for Sensry Sy1xx series uart.
```

## drivers/serial/Kconfig.tccvcp
```kconfig
# Copyright 2024 Hounjoung Rim <hounjoung@tsnlab.com>
# SPDX-License-Identifier: Apache-2.0

config UART_TCCVCP
	bool "Telechips TCC VCP serial driver"
	default y
	depends on DT_HAS_TCC_TCCVCP_UART_ENABLED
	select SERIAL_HAS_DRIVER
	select SERIAL_SUPPORT_INTERRUPT
	help
	  This option enables the UART driver for Telechips VCP platforms.
```

## drivers/serial/Kconfig.test
```kconfig
# Copyright (c) 2021, Thomas Stranger
# SPDX-License-Identifier: Apache-2.0

# Hidden option to enable the vnd,serial dummy driver used in testing.
config SERIAL_TEST
	def_bool DT_HAS_VND_SERIAL_ENABLED
	depends on DT_HAS_VND_SERIAL_ENABLED
	select SERIAL_HAS_DRIVER
	select SERIAL_SUPPORT_INTERRUPT
	select SERIAL_SUPPORT_ASYNC
	select RING_BUFFER if (UART_INTERRUPT_DRIVEN || UART_ASYNC_API)
```

## drivers/serial/Kconfig.tiva_c
```kconfig
# SPDX-License-Identifier: Apache-2.0
#
# Copyright (c) 2026 Linumiz
# Author: Sri Surya <srisurya@linumiz.com>

config UART_TIVA_C
	bool "TI Tiva C Series UART driver"
	default y
	depends on DT_HAS_TI_TIVA_C_UART_ENABLED
	select SERIAL_HAS_DRIVER
	select USE_TIVAWARE_UART
	select USE_TIVAWARE_SYSCTL
	select USE_TIVAWARE_GPIO
	select PINCTRL
	help
	  Enable the UART driver for the TI Tiva C Series
	  (TM4C123G, TM4C129x) microcontrollers.
	  Uses TivaWare HAL (driverlib/uart.c) for configuration.
```

## drivers/serial/Kconfig.tlx
```kconfig
# Copyright (c) 2024 Telink Semiconductor
# SPDX-License-Identifier: Apache-2.0

# Telink TLX UART configuration options

config UART_TELINK_TLX
	bool "Telink TLx UART driver"
	default y
	depends on DT_HAS_TELINK_TLX_UART_ENABLED
	select SERIAL_HAS_DRIVER
	select SERIAL_SUPPORT_INTERRUPT
	help
	  This option enables the TLx serial driver.
```

## drivers/serial/Kconfig.tms570
```kconfig
# Copyright (c) 2025 ispace, inc.
# SPDX-License-Identifier: Apache-2.0

config UART_TMS570
	bool "TI TMS570 series SCI USART driver"
	default y
	depends on DT_HAS_TI_TMS570_UART_ENABLED
	select SERIAL_HAS_DRIVER
	select PINCTRL
	help
	  This option enables the TMS570 UART driver.
```

## drivers/serial/Kconfig.uart_sam
```kconfig
# Atmel SAM UART configuration options

# Copyright (c) 2017 Piotr Mienkowski
# Copyright (c) 2018 Justin Watson
# SPDX-License-Identifier: Apache-2.0

config UART_SAM
	bool "Atmel SAM MCU family UART driver"
	default y
	depends on DT_HAS_ATMEL_SAM_UART_ENABLED
	select SERIAL_HAS_DRIVER
	select SERIAL_SUPPORT_INTERRUPT
	help
	  This option enables the UARTx driver for Atmel SAM MCUs.
```

## drivers/serial/Kconfig.uwp
```kconfig
# UNISOC UWP UART configuration

# Copyright (c) 2018, UNISOC Incorporated
# SPDX-License-Identifier: Apache-2.0

config UART_UWP
	depends on SOC_SERIES_UWP566X
	bool "UWP UART driver"
	default n
	select SERIAL_HAS_DRIVER
	select SERIAL_SUPPORT_INTERRUPT
	depends on SOC_FAMILY_UWP
	help
	  This option enables the UWP UART driver, for UART_0.

config UART1_UWP
	depends on SOC_SERIES_UWP566X
	bool "UWP UART1 driver"
	default n
	select SERIAL_HAS_DRIVER
	select SERIAL_SUPPORT_INTERRUPT
	depends on SOC_FAMILY_UWP
	help
	  This option enables the UWP UART driver, for UART_1.

config AON_UART_UWP
	depends on SOC_SERIES_UWP566X
	bool "UWP AON UART driver"
	default n
	select SERIAL_HAS_DRIVER
	select SERIAL_SUPPORT_INTERRUPT
	depends on SOC_FAMILY_UWP
	help
	  This option enables the UWP AON UART driver.
```

## drivers/serial/Kconfig.virtio_console
```kconfig
# Copyright (c) 2025 Antmicro <www.antmicro.com>
# SPDX-License-Identifier: Apache-2.0

menuconfig UART_VIRTIO_CONSOLE
	bool "VIRTIO console paravirtualization device driver"
	default y
	depends on VIRTIO && DT_HAS_VIRTIO_CONSOLE_ENABLED && \
		!(X86_VERY_EARLY_CONSOLE || EARLY_CONSOLE || BOOT_BANNER)

if UART_VIRTIO_CONSOLE

config UART_VIRTIO_CONSOLE_RX_BUFSIZE
	int "VIRTIO console receive buffer length"
	default 1

config UART_VIRTIO_CONSOLE_TX_BUFSIZE
	int "VIRTIO console transmit buffer length"
	default 2

config UART_VIRTIO_CONSOLE_F_MULTIPORT
	bool "Support multiple VIRTIO console ports"
	default n
	help
	  The VIRTIO console device can support multiple i/o ports simultaneously
	  (up to 31 in the case of QEMU). Select to enable this feature. Otherwise
	  only one will be used.

if UART_VIRTIO_CONSOLE_F_MULTIPORT

config UART_VIRTIO_CONSOLE_RX_CONTROL_BUFSIZE
	int "VIRTIO console receive buffer length (for control messages)"
	default 16
	help
	  This will set the size of the control receive buffer and its corresponding
	  virtqueue. Keep in mind that control messages are sent in quick succession
	  and thus some may never be received if this value is too low. Try increasing
	  this value if you're experiencing issues with the multiport feature.

config UART_VIRTIO_CONSOLE_TX_CONTROL_BUFSIZE
	int "VIRTIO console transmit buffer length (for control messages)"
	default 8
	help
	  This will set the size of the control transmit buffer and its corresponding
	  virtqueue. Keep in mind that control messages are sent in quick succession
	  and this buffer may fill up fast if this value is too low. Try increasing
	  this value if you're experiencing issues with the multiport feature.

endif

config UART_VIRTIO_CONSOLE_NAME_BUFSIZE
	int "VIRTIO console maximum port name length"
	default 0 if UART_LOG_LEVEL < 3
	default 16
	help
	  Ports can be assigned human-readable names, which are then printed in logs.

endif
```

## drivers/serial/Kconfig.w91
```kconfig
# Copyright (c) 2024 Telink Semiconductor
# SPDX-License-Identifier: Apache-2.0

# Telink W91 UART configuration options

config UART_TELINK_W91
	bool "Telink W91 UART driver"
	default y
	depends on DT_HAS_TELINK_W91_UART_ENABLED
	select SERIAL_HAS_DRIVER
	select SERIAL_SUPPORT_INTERRUPT
	help
	  This option enables the W91 serial driver.


if UART_TELINK_W91

config TELINK_W91_UART_IRQ_THREAD_STACK_SIZE
	int "UART IRQ thread stack size"
	default 1024
	help
	  UART IRQ stack size.

config TELINK_W91_UART_IRQ_THREAD_PRIORITY
	int "UART IRQ thread priority"
	default 0
	help
	  UART IRQ thread priority.

endif # UART_TELINK_W91
```

## drivers/serial/Kconfig.wch_ch5xx
```kconfig
# SPDX-FileCopyrightText: 2026 SMILE (smile.eu)
# SPDX-License-Identifier: Apache-2.0

config UART_WCH_CH5XX
	bool "WCH CH5xx UART driver"
	default y
	depends on DT_HAS_WCH_CH5XX_UART_ENABLED
	select SERIAL_HAS_DRIVER
	select SERIAL_SUPPORT_INTERRUPT
	select PINCTRL
	help
	  This option enables the UART driver for CH5xx SoC family.
```

## drivers/serial/Kconfig.xec
```kconfig
# Microchip XEC UART configuration options

# Copyright (c) 2021 Microchip Technology Inc.
# SPDX-License-Identifier: Apache-2.0

config UART_XEC
	bool "Microchip XEC family UART driver"
	default y
	depends on DT_HAS_MICROCHIP_XEC_UART_ENABLED
	select SERIAL_HAS_DRIVER
	select SERIAL_SUPPORT_INTERRUPT
	help
	  This option enables the UARTx driver for Microchip XEC MCUs.

if UART_XEC

config UART_XEC_LINE_CTRL
	bool "Serial Line Control for Apps"
	depends on UART_LINE_CTRL
	help
	  This enables the API for apps to control the serial line,
	  such as CTS and RTS.

	  Says n if not sure.

endif # UART_XEC
```

## drivers/serial/Kconfig.xen
```kconfig
# Xen hypervisor console via UART setup
#
# Copyright (c) 2021-2023 EPAM Systems
# SPDX-License-Identifier: Apache-2.0
#

config UART_XEN_HVC
	bool "Xen hypervisor DomU console UART driver"
	default y
	depends on DT_HAS_XEN_HVC_UART_ENABLED
	select SERIAL_HAS_DRIVER
	select SERIAL_SUPPORT_INTERRUPT
	depends on XEN && !XEN_DOM0 && !XEN_DOM0LESS
	help
	  Enable Xen ring buffer based hypervisor console driver. Used
	  for Zephyr as unprivileged domain.

config UART_XEN_HVC_CONSOLEIO
	bool "Xen hypervisor consoleio UART driver"
	select SERIAL_HAS_DRIVER
	depends on DT_HAS_XEN_HVC_CONSOLEIO_ENABLED && (XEN_DOM0 || XEN_DOM0LESS)
	default y
	help
	  Enable Xen hypervisor console driver. Used for Zephyr as
	  privileged domain (Dom0) or for Zephyr DomU in Dom0less
	  configuration. Dom0less configuration does not have
	  privileged domain. Thus, there is no console daemon and Xen
	  manages all domain outputs through the consoleio interface.

config XEN_HVC_INIT_PRIORITY
	int "Xen hypervisor console init priority"
	depends on UART_XEN_HVC || UART_XEN_HVC_CONSOLEIO
	default 55
	help
	  Set init priority for Xen HVC, should be inited before UART
	  console driver (HVC gets inited on PRE_KERNEL_1 stage).

config XEN_EARLY_CONSOLEIO
	bool "Early printk/stdout through console_io Xen interface"
	depends on UART_XEN_HVC
	help
	  Enable setting of console_io symbol hook for stdout and printk.
	  Log output will become available on PRE_KERNEL_1 stage. Requires
	  Xen, compiled with CONFIG_DEBUG flag.
```

## drivers/serial/Kconfig.xlnx
```kconfig
# Xilinx UART configuration

# Copyright (c) 2018 Xilinx Inc.
# SPDX-License-Identifier: Apache-2.0

config UART_XLNX_PS
	bool "Xilinx Zynq 7000/ZynqMP serial driver"
	default y
	depends on DT_HAS_XLNX_XUARTPS_ENABLED
	select SERIAL_HAS_DRIVER
	select SERIAL_SUPPORT_INTERRUPT
	help
	  This option enables the UART driver for Xilinx MPSoC platforms.

config UART_XLNX_UARTLITE
	bool "Xilinx UART Lite"
	default y
	depends on DT_HAS_XLNX_XPS_UARTLITE_1_00_A_ENABLED
	select SERIAL_HAS_DRIVER
	select SERIAL_SUPPORT_INTERRUPT
	help
	  This option enables the UART driver for Xilinx UART Lite IP.
```

## drivers/serial/Kconfig.xmc
```kconfig
# Copyright (c) 2020 Linumiz
#
# Author: Parthiban Nallathambi <parthiban@linumiz.com>
# SPDX-License-Identifier: Apache-2.0

config UART_XMC
	depends on SOC_SERIES_XMC_1XXX || SOC_SERIES_XMC_4XXX
	bool "XMC UART driver"
	select SERIAL_HAS_DRIVER
	depends on SOC_FAMILY_XMC && HAS_XMCLIB_UART
	help
	  This option enables the XMC UART driver, for UART_0.
```

## drivers/serial/Kconfig.xmc4xxx
```kconfig
# Copyright (c) 2020 Linumiz
#
# Author: Parthiban Nallathambi <parthiban@linumiz.com>
# SPDX-License-Identifier: Apache-2.0

config UART_XMC4XXX
	bool "XMC4XX UART driver"
	default y
	depends on DT_HAS_INFINEON_XMC4XXX_UART_ENABLED
	select SERIAL_HAS_DRIVER
	select SERIAL_SUPPORT_INTERRUPT
	select SERIAL_SUPPORT_ASYNC if DT_HAS_INFINEON_XMC4XXX_DMA_ENABLED
	select DMA if UART_ASYNC_API
	help
	  This option enables the XMC4XX UART driver.

if UART_XMC4XXX

config UART_XMC4XXX_RX_FIFO_INT_TRIGGER
	bool "Continue to trigger fifo rx interrupt"
	default n
	help
	  When this option is enabled, an interrupt will continue to trigger
	  if there is data in the receive fifo. Otherwise, an interrupt will
	  trigger only once on the first received byte. The receive fifo will
	  need to be fully flushed so that the interrupt will trigger again.

endif
```

## drivers/serial/Kconfig.xuantie
```kconfig
# XUANTIE xiaohui&smartl UART configuration option

# Copyright (C) 2017-2024 Alibaba Group Holding Limited
# SPDX-License-Identifier: Apache-2.0

menuconfig UART_XUANTIE
	bool "XuanTie Freedom serial driver"
	default y
	depends on DT_HAS_XUANTIE_UART0_ENABLED
	select SERIAL_HAS_DRIVER
	select SERIAL_SUPPORT_INTERRUPT
	help
	  This option enables the XuanTie xiaohui&smartl serial driver.

if UART_XUANTIE

config UART_XUANTIE_PORT_0
	bool "XUANTIE Port 0"
	depends on UART_XUANTIE
	help
	  This tells the driver to configure the UART port at boot, depending on
	  the additional configure options below.

endif # UART_XUANTIE
```

## drivers/seu/Kconfig
```kconfig
# Copyright (c) 2023 Intel Corporation.
# SPDX-License-Identifier: Apache-2.0
# Single Event Upset(SEU) configuration options

menuconfig SEU
	bool "Single Event Upset"
	depends on ARM_SIP_SVC_SUBSYS
	help
	  SEU is the change in state of a storage element inside a device or system.

if SEU

module = SEU
module-str = seu
source "subsys/logging/Kconfig.template.log_config"

config SEU_INIT_PRIORITY
	int "SEU Initialization priority"
	default 55
	help
	  Set the priority for the SEU driver initialization

source "drivers/seu/Kconfig.seu_intel_socfpga"

endif # SEU
```
