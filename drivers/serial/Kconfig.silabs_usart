## drivers/shared_irq/Kconfig
```kconfig
# Kconfig - shared_irq configuration options

#
# Copyright (c) 2015 Intel Corporation
#
# Licensed under the Apache License, Version 2.0 (the "License");
# you may not use this file except in compliance with the License.
# You may obtain a copy of the License at
#
#     http://www.apache.org/licenses/LICENSE-2.0
#
# Unless required by applicable law or agreed to in writing, software
# distributed under the License is distributed on an "AS IS" BASIS,
# WITHOUT WARRANTIES OR CONDITIONS OF ANY KIND, either express or implied.
# See the License for the specific language governing permissions and
# limitations under the License.
#

menuconfig SHARED_IRQ
	bool
	prompt "Shared interrupt driver"
	default n
	help
	 Include shared interrupt support in system. Shared interrupt
	 support is NOT required in most systems. If in doubt answer no.

config SHARED_IRQ_NUM_CLIENTS
	int
	depends on SHARED_IRQ
	prompt "The number of clients per instance"
	default 5
	help
	 Configures the maximum nuber of clients allowed per shared
	 instance of the shared interrupt driver. To conserve RAM set
	 this value to the lowest practical value.

config SHARED_IRQ_INIT_PRIORITY
	int
	depends on SHARED_IRQ
	default 45
	prompt "Shared IRQ init priority"
	help
	 Shared IRQ are initialized on POST_KERNEL init level. They
	 have to be initialized before any device that uses them.

config SHARED_IRQ_0
	bool "Shared interrupt instance 0"
	depends on SHARED_IRQ
	help
	 Provide an instance of the shared interrupt driver when system
	 configuration requires that multiple devices share an interrupt.

config SHARED_IRQ_0_NAME
	string "Select a name for the device"
	depends on SHARED_IRQ_0
	default "SHARED_IRQ0"

config SHARED_IRQ_0_IRQ
	int "instance 0 interrupt"
	depends on SHARED_IRQ_0
	help
	 System interrupt number to be handled by this instance of the driver.

config SHARED_IRQ_0_PRI
	int "instance 0 interrupt priority"
	default 2
	depends on SHARED_IRQ_0
	help
	 Prioity of shared interrupt handler for the configured interrupt

choice
	depends on SHARED_IRQ_0
	prompt "Shared IRQ #0 Trigger Condition"
	default SHARED_IRQ_0_RISING_EDGE

config SHARED_IRQ_0_FALLING_EDGE
	bool "Falling Edge"
	help
	  Interrupt triggers on falling edge.

config SHARED_IRQ_0_RISING_EDGE
	bool "Rising Edge"
	help
	  Interrupt triggers on rising edge.

config SHARED_IRQ_0_LEVEL_HIGH
	bool "Level High"
	help
	  Interrupt triggers when level is high.

config SHARED_IRQ_0_LEVEL_LOW
	bool "Level Low"
	help
	  Interrupt triggers when level is low.

endchoice

config SHARED_IRQ_1
	bool "Shared interrupt instance 1"
	depends on SHARED_IRQ
	help
	 Provide an instance of the shared interrupt driver when system
	 configuration requires that multiple devices share an interrupt.

config SHARED_IRQ_1_NAME
	string "Select a name for the device"
	depends on SHARED_IRQ_1
	default "SHARED_IRQ1"

config SHARED_IRQ_1_IRQ
	int "instance 1 interrupt"
	depends on SHARED_IRQ_1
	help
	 System interrupt number to be handled by this instance of the driver.

config SHARED_IRQ_1_PRI
	int "instance 1 interrupt priority"
	default 2
	depends on SHARED_IRQ_1
	help
	 Prioity of shared interrupt handler for the configured interrupt

choice
	depends on SHARED_IRQ_1
	prompt "Shared IRQ #1 Trigger Condition"
	default SHARED_IRQ_1_RISING_EDGE

config SHARED_IRQ_1_FALLING_EDGE
	bool "Falling Edge"
	help
	  Interrupt triggers on falling edge.

config SHARED_IRQ_1_RISING_EDGE
	bool "Rising Edge"
	help
	  Interrupt triggers on rising edge.

config SHARED_IRQ_1_LEVEL_HIGH
	bool "Level High"
	help
	  Interrupt triggers when level is high.

config SHARED_IRQ_1_LEVEL_LOW
	bool "Level Low"
	help
	  Interrupt triggers when level is low.

endchoice
```

## drivers/sip_svc/Kconfig
```kconfig
# Silicon vendor Provided Supervisory call driver for sip_svc subsystem

# Copyright (c) 2023 Intel Corporation
# SPDX-License-Identifier: Apache-2.0

menuconfig ARM_SIP_SVC_DRIVER
	bool "ARM SIP SVC driver"
	depends on ARM64
	help
	  ARM supervisory call driver for communicating with EL2 or EL3 firmware

if ARM_SIP_SVC_DRIVER

module = ARM_SIP_SVC_DRIVER
module-str = arm_sip_svc_driver
source "subsys/logging/Kconfig.template.log_config"

config ARM_SIP_SVC_DRIVER_INIT_PRIORITY
	int "Initialization priority"
	default 50

config ARM_SIP_SVC_HAS_DRIVER
	bool
	help
	   This is an option to be enabled by individual sip svc driver
	   to signal that there is a sip svc driver. This is used by other
	   modules which depends on sip svc driver.

source "drivers/sip_svc/Kconfig.sip_smc_agilex"

endif # ARM_SIP_SVC_DRIVER
```

## drivers/sip_svc/Kconfig.sip_smc_agilex
```kconfig
# Copyright (c) 2023 Intel Corporation
# SPDX-License-Identifier: Apache-2.0

config ARM_SIP_SVC_HAS_INTEL_SDM_MAILBOX_FIFO
	bool
	default y
	depends on DT_HAS_INTEL_AGILEX_SOCFPGA_SIP_SMC_ENABLED
	imply ARM_SIP_SVC_HAS_DRIVER
	help
	  Support for SDM mailbox fifo in Intel SoC FPGA Agilex via SMC calls.

config ARM_SIP_SVC_EL3_MAILBOX_RESPONSE_SIZE
	int "Size of response buffer used for ASYNC transactions."
	default 4096
	depends on ARM_SIP_SVC_HAS_INTEL_SDM_MAILBOX_FIFO
	help
	  Size of response buffer used for ASYNC transactions.For Intel Agilex platform
	  the maximum size of response buffer size is 4096 and minimum is 4 bytes.
	  Also it should be multiple of 4 bytes.

config ARM_SIP_SVC_EL3_MAX_ALLOWED_TRANSACTIONS
	int "Maximum allowable ongoing transactions."
	default 16
	depends on ARM_SIP_SVC_HAS_INTEL_SDM_MAILBOX_FIFO
	help
	  Allowed number of active transactions in sip_svc subsystem for this driver.
```
