## drivers/spi/Kconfig.adi_axi_spi_engine
```kconfig
# Copyright (c) 2026 Analog Devices, Inc.
# SPDX-License-Identifier: Apache-2.0

config SPI_ADI_AXI_SPI_ENGINE
	bool "Analog Devices AXI SPI Engine controller"
	default y
	depends on DT_HAS_ADI_AXI_SPI_ENGINE_ENABLED
	help
	  SPI controller driver for the Analog Devices AXI SPI Engine core.
	  Register-mode transfers use the standard Zephyr SPI API; the
	  autonomous offload path (DMA-driven MS/s streaming) is exposed as a
	  vendor extension in <zephyr/drivers/spi/spi_adi_axi_spi_engine.h>.
```

## drivers/spi/Kconfig.bcm2835
```kconfig
# Broadcom BCM2835 SPI controller
#
# Copyright (c) 2026 Jonathan Elliot Peace <jep@alphabetiq.com>
# SPDX-License-Identifier: Apache-2.0

config SPI_BCM2835
	bool "Broadcom BCM2835 SPI controller driver"
	default y
	depends on DT_HAS_BRCM_BCM2835_SPI_ENABLED
	select PINCTRL
	help
	  Enable the polled driver for the Broadcom BCM2835-family SPI
	  controller: SPI0 on the Raspberry Pi 40-pin header, and the
	  same IP behind SPI3..SPI6 on the BCM2711. Chip select is
	  driven via cs-gpios.
```

## drivers/spi/Kconfig.cc23x0_cc27xx
```kconfig
# TI CC23x0_CC27xx SPI configuration options

# Copyright (c) 2024 BayLibre, SAS
# SPDX-License-Identifier: Apache-2.0

config SPI_CC23X0_CC27XX
	bool "TI SimpleLink CC23x0_CC27XX SPI driver"
	default y
	depends on DT_HAS_TI_CC23X0_CC27XX_SPI_ENABLED
	select PINCTRL
	help
	  Enable support for the TI SimpleLink CC23x0_CC27xx SPI peripheral

config SPI_CC23X0_CC27XX_DMA_DRIVEN
	bool "DMA support for TI CC23X0_CC27XX SPI devices"
	depends on SPI_CC23X0_CC27XX
	select DMA
	help
	  DMA driven mode offloads data transfer tasks from the CPU
```

## drivers/spi/Kconfig.cc35xx
```kconfig
# Copyright (c) 2025-2026 Conclusive Engineering
# SPDX-License-Identifier: Apache-2.0

config SPI_CC35XX
	bool "TI SimpleLink CC35xx SPI driver"
	default y
	depends on DT_HAS_TI_CC35XX_SPI_ENABLED
	select PINCTRL
	help
	  Enable support for the TI SimpleLink CC35xx SPI peripheral

if SPI_CC35XX

config SPI_CC35XX_DMA_DRIVEN
	bool "CC35XX SPI DMA support"
	default n
	select DMA
	help
	  Enables DMA for SPI transfers.

config SPI_CC35XX_DMA_SCRATCH_BUFFER_SIZE
	int "CC35XX SPI DMA scratch buffer size"
	default 256
	depends on SPI_CC35XX_DMA_DRIVEN
	help
	  Size of the per-instance SRAM scratch buffer used when TX data
	  for a DMA transfer is not directly accessible by the DMA engine.

endif # SPI_CC35XX
```

## drivers/spi/Kconfig.efinix_sapphire
```kconfig
# Copyright (c) 2026 Arkadiusz Grzelka
# SPDX-FileCopyrightText: Copyright The Zephyr Project Contributors
# SPDX-License-Identifier: Apache-2.0

config SPI_EFINIX_SAPPHIRE
	bool "Efinix Sapphire SoC SPI controller driver"
	default y
	depends on DT_HAS_EFINIX_SAPPHIRE_SPI_ENABLED
	help
	  Enable the polled driver for the SpinalHDL SpiXdrMasterCtrl SPI
	  controller found in the Efinix Sapphire RISC-V SoC.
```

## drivers/spi/Kconfig.lpc84x
```kconfig
# Copyright (c) 2026, Aerlync Labs Inc.
# SPDX-License-Identifier: Apache-2.0

config SPI_LPC84X
	bool "LPC84x SPI driver"
	default y
	depends on DT_HAS_NXP_LPC84X_SPI_ENABLED && CLOCK_CONTROL
	select PINCTRL
	help
	  Enable the LPC84x SPI driver.

config SPI_LPC84X_INTERRUPT
	bool "Use interrupt-driven transfers for LPC84x SPI"
	default n
	depends on SPI_LPC84X
	help
	  When enabled, transfers use SPI_MasterTransferNonBlocking and
	  the hardware IRQ instead of SPI_MasterTransferBlocking.
	  The calling thread blocks on a semaphore until the ISR signals
	  completion, so the Zephyr synchronous SPI API contract is preserved.
```
