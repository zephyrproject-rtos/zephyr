## drivers/serial/Kconfig.infineon
```kconfig
# Infineon CAT1 UART configuration options

# Copyright (c) 2022 Cypress Semiconductor Corporation (an Infineon company) or
# an affiliate of Cypress Semiconductor Corporation
# SPDX-License-Identifier: Apache-2.0

config UART_INFINEON_CAT1_HAL
	bool "Infineon CAT1 UART driver"
	default y
	depends on DT_HAS_INFINEON_UART_ENABLED
	depends on USE_INFINEON_LEGACY_HAL
	select SERIAL_HAS_DRIVER
	select SERIAL_SUPPORT_INTERRUPT
	select SERIAL_SUPPORT_ASYNC if !(SOC_FAMILY_INFINEON_CAT1C || SOC_CY8C6244LQI_S4D92)
	select USE_INFINEON_UART
	select PINCTRL
	select DMA if UART_ASYNC_API
	help
	  This option enables the Legacy HAL based UART driver for Infineon CAT1 family.

config UART_INFINEON_CAT1_PDL
	bool "Infineon CAT1 UART driver (PDL)"
	default y
	depends on DT_HAS_INFINEON_UART_ENABLED
	depends on !USE_INFINEON_LEGACY_HAL
	select SERIAL_HAS_DRIVER
	select SERIAL_SUPPORT_INTERRUPT
	select SERIAL_SUPPORT_ASYNC if !SOC_FAMILY_INFINEON_CAT1C
	select USE_INFINEON_UART
	select PINCTRL
	select DMA if UART_ASYNC_API
	select USE_INFINEON_DMA if UART_ASYNC_API
	help
	  This option enables the PDL based UART driver for Infineon CAT1 family.

config UART_INFINEON_PDL_MP_FIELD_QUIRK
	bool
	default y if SOC_DIE_PSC3M6 || SOC_SERIES_PSE84
	help
	  Enabled for SoCs whose PDL fixed the SCB UART config field name
	  "enableMultiProcessorMode". Older PDL revisions misspell it as
	  "enableMutliProcessorMode"; the driver picks the field name from
	  this symbol.

config UART_INFINEON_PDL_BYTE_WIDTH_ONLY
	bool
	default y if SOC_SERIES_PSOC4HVMS64K || SOC_SERIES_PSOC4HVMS128K
	help
	  Hidden option enabled for SoC series whose SCB is the v2 (M0S8) IP
	  block, which has no MEM_WIDTH field in the control register and
	  only supports byte-width transfers.
```

## drivers/serial/Kconfig.infineon_aurix
```kconfig
# SPDX-FileCopyrightText: Copyright (c) 2024 Infineon Technologies AG,
# SPDX-FileCopyrightText: or an affiliate of Infineon Technologies AG. All rights reserved.
# SPDX-FileCopyrightText: Copyright (c) 2026 Linumiz
#
# SPDX-License-Identifier: Apache-2.0

config UART_ASCLIN
	bool "ASCLIN serial driver"
	default y
	depends on DT_HAS_INFINEON_ASCLIN_UART_ENABLED
	select SERIAL_HAS_DRIVER
	help
	  This option enables the ASCLIN driver for AURIX processors.
```

## drivers/serial/Kconfig.lpf3
```kconfig
# Copyright (c) 2024 - 2026 Texas Instruments Incorporated
# Copyright (c) 2024 BayLibre, SAS
#
# SPDX-License-Identifier: Apache-2.0

config UART_LPF3
	bool "TI SimpleLink LPF3 UART driver"
	default y
	depends on DT_HAS_TI_LPF3_UART_ENABLED
	select SERIAL_HAS_DRIVER
	select SERIAL_SUPPORT_INTERRUPT
	select SERIAL_SUPPORT_ASYNC
	select PINCTRL
	help
	  Enable the TI SimpleLink LPF3 UART driver (CC23x0 and CC27xx).

config UART_LPF3_DMA_DRIVEN
	bool "DMA support for TI LPF3 UART devices"
	default y if UART_ASYNC_API
	depends on UART_LPF3
	depends on UART_ASYNC_API
	select DMA
	help
	  DMA driven mode offloads data transfer tasks from the CPU.
```

## drivers/serial/Kconfig.mcux_lpuart
```kconfig
# Copyright 2017, 2025 NXP
# SPDX-License-Identifier: Apache-2.0

config UART_MCUX_LPUART
	bool "MCUX LPUART driver"
	default y
	depends on DT_HAS_NXP_LPUART_ENABLED
	depends on CLOCK_CONTROL
	select SERIAL_HAS_DRIVER
	select SERIAL_SUPPORT_INTERRUPT
	select PINCTRL
	help
	  Enable the MCUX LPUART driver.

if UART_MCUX_LPUART

config UART_MCUX_LPUART_ISR_SUPPORT
	bool
	default y if UART_INTERRUPT_DRIVEN || PM || UART_ASYNC_API
	help
	  Enable UART interrupt service routine.

config UART_NXP_LPUART_ASYNC_API_SUPPORT
	bool
	default y if $(dt_compat_any_has_prop,$(DT_COMPAT_NXP_LPUART),dmas)
	select SERIAL_SUPPORT_ASYNC
	select DMA if UART_ASYNC_API
	help
	  Indicates if LPUART has async api support by having dmas enabled for it

config UART_MCUX_LPUART_ASYNC_RX_STOP_ON_ERROR
	bool "Stop async reception on RX line errors"
	default y
	depends on UART_ASYNC_API && UART_NXP_LPUART_ASYNC_API_SUPPORT
	help
	  When enabled, an overrun, framing, noise or parity error during
	  async reception is reported with UART_RX_STOPPED and reception is
	  disabled. The application has to call uart_rx_enable() again.

	  When disabled, the driver clears the error flags and keeps
	  receiving. A character received with a framing, noise or parity
	  error is still delivered, an overrun loses the character that was
	  in the shift register. The errors are reported by uart_err_check().

endif
```

## drivers/serial/Kconfig.mspm0
```kconfig
# SPDX-License-Identifier: Apache-2.0
# Copyright (c) 2025 Texas Instruments
# Copyright (c) 2025 Linumiz

config UART_MSPM0
	bool "MSPM0 UART driver"
	default y
	depends on DT_HAS_TI_MSPM0_UART_ENABLED
	select SERIAL_HAS_DRIVER
	select SERIAL_SUPPORT_INTERRUPT
	select USE_MSPM0_DL_UART
	select PINCTRL
	help
	  This option enables the TI MSPM0 UART driver.

config UART_MSPM0_DRV_CMD
	bool "Driver Commands"
	depends on UART_MSPM0
	depends on UART_DRV_CMD
	help
	  This enables the API for applications to send extra commands to the
	  MSPM0 UART driver.
```

## drivers/serial/Kconfig.mtk
```kconfig
# Copyright (c) 2026 MediaTek Inc.
# SPDX-License-Identifier: Apache-2.0

config UART_MT8188
	bool "MediaTek MT8188 UART driver"
	default y
	depends on DT_HAS_MEDIATEK_MT8188_UART_ENABLED
	select PINCTRL
	select SERIAL_HAS_DRIVER
	select SERIAL_SUPPORT_INTERRUPT
	help
	  Enable the UART driver for MediaTek MT8188.
```

## drivers/serial/Kconfig.py32
```kconfig
# SPDX-FileCopyrightText: Copyright The Zephyr Project Contributors
# SPDX-License-Identifier: Apache-2.0

config UART_PY32
	bool "Puya PY32 UART driver"
	default y
	depends on DT_HAS_PUYA_PY32_UART_ENABLED
	select SERIAL_HAS_DRIVER
	select SERIAL_SUPPORT_INTERRUPT
	select RESET
	select PINCTRL
	help
	  Enable the UART driver for Puya PY32 microcontrollers.
```

## drivers/serial/Kconfig.renesas_ra6b1
```kconfig
# SPDX-FileCopyrightText: 2026 Renesas Electronics Corporation
# SPDX-License-Identifier: Apache-2.0

config UART_RA6B1
	bool "Renesas RA6B1 UART"
	default y
	depends on DT_HAS_RENESAS_RA6B1_UART_ENABLED
	select SERIAL_HAS_DRIVER
	select SERIAL_SUPPORT_INTERRUPT
	select PINCTRL
	help
	  Enable Renesas RA6B1 UART Driver.

if UART_RA6B1

config UART_RA6B1_UART_FIFO_ENABLE
	bool "RA6B1 UART FIFO usage enable"
	default y
	help
	  Enable RA6B1 UART FIFO

endif
```

## drivers/serial/Kconfig.renesas_rh850
```kconfig
# SPDX-FileCopyrightText: Copyright (c) 2026 Linumiz
#
# SPDX-License-Identifier: Apache-2.0

config UART_RENESAS_RH850_RLIN3
	bool "Renesas RH850 RLIN3 UART driver"
	default y
	depends on DT_HAS_RENESAS_RH850_RLIN3_UART_ENABLED
	select SERIAL_HAS_DRIVER
	help
	  Polled UART driver for the RLIN3 units of Renesas RH850 SoCs.
```

## drivers/serial/Kconfig.renesas_rx
```kconfig
# Copyright (c) 2024-2025 Renesas Electronics Corporation
# SPDX-License-Identifier: Apache-2.0

config UART_RENESAS_RX
	bool "Renesas RX Series UART Driver"
	default y
	depends on DT_HAS_RENESAS_RX_UART_SCI_ENABLED
	select SERIAL_HAS_DRIVER
	select SERIAL_SUPPORT_INTERRUPT
	select SERIAL_SUPPORT_ASYNC
	select USE_RX_RDP_SCI_UART
	select RENESAS_RX_DTC if UART_ASYNC_API
	select PINCTRL
	help
	  Enable Renesas RX series UART driver.

config UART_RENESAS_RX_SCI_B
	bool "Renesas RX Series UART Driver"
	default y
	depends on DT_HAS_RENESAS_RX_UART_SCI_B_ENABLED
	select SERIAL_HAS_DRIVER
	select USE_RX_FSP_SCI_B_UART
	select PINCTRL
	help
	  Enable Renesas RX series UART on SCI B HW driver.
```

## drivers/serial/Kconfig.rpi_pico
```kconfig
# Copyright (c) 2021 Yonatan Schachter
# SPDX-License-Identifier: Apache-2.0

config UART_RPI_PICO_PIO
	bool "Raspberry Pi PIO UART driver"
	default y
	depends on DT_HAS_RASPBERRYPI_PICO_UART_PIO_ENABLED
	depends on PIO_RPI_PICO
	select SERIAL_HAS_DRIVER
	select SERIAL_SUPPORT_INTERRUPT
	select PICOSDK_USE_PIO
	select PICOSDK_USE_CLAIM
	select PINCTRL
	select SERIAL_HAS_POST_KERNEL_INIT
	select DMA if UART_INTERRUPT_DRIVEN
	select DMA_RPI_PICO if UART_INTERRUPT_DRIVEN
	depends on RESET

if UART_RPI_PICO_PIO && UART_INTERRUPT_DRIVEN

config UART_RPI_PICO_PIO_POLL_STACK_SIZE
	int "Stack size of the PIO UART service thread"
	default 512
	help
	  RX is captured by a self-reloading DMA ring buffer. A dedicated
	  thread per instance periodically invokes the registered
	  uart_irq_callback to service it.

config UART_RPI_PICO_PIO_POLL_THREAD_PRIORITY
	int "Priority of the PIO UART service thread"
	default 1
	help
	  RX bytes are already held in the DMA ring when this thread runs,
	  so it tolerates scheduling latency. Higher priorities can starve
	  other low-priority threads under sustained traffic.

config UART_RPI_PICO_PIO_POLL_PERIOD_US
	int "Poll period, in microseconds, of the PIO UART service thread"
	default 2000
	help
	  Shorter periods raise the CPU load of every PIO UART instance.
	  Longer periods deliver RX bytes to the callback in larger bursts.

config UART_RPI_PICO_PIO_RX_RING_BUF_SIZE
	int "Size, in bytes, of the RX DMA ring buffer"
	default 256
	range 2 32768
	help
	  Must be a power of two, as required by the DMA address wrapping.
	  Bounds how far the service thread can fall behind before RX bytes
	  are lost. Size it for the longest expected stall at the configured
	  baudrate.

endif # UART_RPI_PICO_PIO && UART_INTERRUPT_DRIVEN
```

## drivers/serial/Kconfig.shakti_nekko
```kconfig
# Copyright (c) 2025 AIFoundry
# SPDX-License-Identifier: Apache-2.0

config UART_SHAKTI_NEKKO
	bool "Nekko Shakti UART (original Erbium revision)"
	default y
	depends on DT_HAS_AIFOUNDRY_SHAKTI_UART_V1_ENABLED
	select SERIAL_HAS_DRIVER
	help
	  Enable polling support for the original Erbium integration of the
	  Shakti UART. Registers use 32-bit accesses at eight-byte intervals.
```

## drivers/serial/Kconfig.sifive
```kconfig
# SiFive Freedom UART configuration option

# Copyright (c) 2017 Jean-Paul Etienne <fractalclone@gmail.com>
# SPDX-License-Identifier: Apache-2.0

config UART_SIFIVE
	bool "SiFive Freedom serial driver"
	default y
	depends on DT_HAS_SIFIVE_UART0_ENABLED
	select SERIAL_HAS_DRIVER
	select SERIAL_SUPPORT_INTERRUPT
	select PINCTRL if SOC_SERIES_FE300
	help
	  This option enables the SiFive Freedom serial driver.
```

## drivers/serial/Kconfig.stellaris
```kconfig
# SPDX-License-Identifier: Apache-2.0

config UART_STELLARIS
	bool "Stellaris serial driver"
	default y
	depends on DT_HAS_TI_STELLARIS_UART_ENABLED
	select SERIAL_HAS_DRIVER
	select SERIAL_SUPPORT_INTERRUPT
	help
	  This option enables the Stellaris serial driver.
	  This specific driver can be used for the serial hardware
	  available at the Texas Instruments LM3S6965 board.
```

## drivers/serial/Kconfig.usart_sam
```kconfig
# Atmel SAM USART configuration options

# Copyright (c) 2016 Piotr Mienkowski
# SPDX-License-Identifier: Apache-2.0

config USART_SAM
	bool "Atmel SAM MCU family USART driver"
	default y
	depends on DT_HAS_ATMEL_SAM_USART_ENABLED
	select PINCTRL
	select SERIAL_HAS_DRIVER
	select SERIAL_SUPPORT_INTERRUPT
	select SERIAL_SUPPORT_ASYNC if USART_SAM_HAS_PDC
	select MFD if SOC_SERIES_SAMA7G5
	help
	  This option enables the USARTx driver for Atmel SAM MCUs.

config USART_SAM_HAS_PDC
	def_bool SOC_SERIES_SAM3X || SOC_SERIES_SAM4E || SOC_SERIES_SAM4S
	depends on USART_SAM
	help
	  The USART has a Peripheral DMA Controller (PDC) channel, used to implement the
	  asynchronous API.

config USART_SAM_ASYNC_TX_CACHE_SIZE
	int "Asynchronous TX cache size"
	default 8
	range 1 $(UINT16_MAX)
	depends on USART_SAM_HAS_PDC && UART_ASYNC_API
	help
	  The PDC can't read the internal flash. A TX buffer outside the SRAM is sent in chunks
	  through a cache of this size.
```

## drivers/serial/Kconfig.wch_usart
```kconfig
# Copyright (c) 2024 Google LLC.
# SPDX-License-Identifier: Apache-2.0

config UART_WCH_USART
	bool "CH32V00x USART driver"
	default y
	depends on DT_HAS_WCH_USART_ENABLED
	select SERIAL_HAS_DRIVER
	select SERIAL_SUPPORT_INTERRUPT
	select PINCTRL
	help
	  This option enables the USART driver for CH32V00x SoC family.

if UART_WCH_USART

config UART_WCH_USART_RESET
	bool "Reset USART peripheral before use"
	depends on RESET
	default y
	help
	  Reset the USART peripheral before use using the reset subsystem.

endif
```

## drivers/seu/Kconfig.seu_intel_socfpga
```kconfig
# Copyright (c) 2023 Intel Corporation
# SPDX-License-Identifier: Apache-2.0

config SEU_INTEL_SOCFPGA
	bool
	default y
	depends on DT_HAS_INTEL_SOCFPGA_SEU_ENABLED
	help
	  To enable Intel SoC FPGA specific SEU driver

if SEU_INTEL_SOCFPGA

config SEU_MAX_CLIENT
	int "SEU maximum client count"
	default 5
	help
	  To set SEU maximum client count.

config SEU_MAX_TIMEOUT_MSECS
	int "Maximum timeout in milliseconds"
	default 1000
	help
	  Set maximum SiP SVC client connection timeout in milliseconds.

config HEAP_MEM_POOL_ADD_SIZE_SEU
	int
	default 256
	help
	  Additional heap size reserved for SEU mailbox command and response
	  buffers and error reporting allocations.

endif # SEU_INTEL_SOCFPGA
```

## drivers/sfp/Kconfig
```kconfig
# Copyright The Zephyr Project Contributors
#
# SPDX-License-Identifier: Apache-2.0

menuconfig SFP
	bool "SFP pluggable module drivers"
	help
	  Enable drivers for SFP/SFP+ pluggable transceiver modules and their
	  management interfaces.

if SFP

module = SFP
module-str = sfp
source "subsys/logging/Kconfig.template.log_config"

config SFP_INIT_PRIORITY
	int "SFP module driver init priority"
	default 90
	help
	  Initialization priority for SFP module drivers. Must be greater than
	  the I2C controller init priority.

config SFP_SFF8472
	bool "SFF-8472 (SFP/SFP+) cage driver"
	default y
	depends on DT_HAS_SFF_SFP_ENABLED
	select I2C
	select GPIO if $(dt_compat_any_has_prop,$(DT_COMPAT_SFF_SFP),mod-def0-gpios)
	select SFF8472
	help
	  Enable the driver for SFP/SFP+ cages holding SFF-8472 managed
	  modules. It reads the serial ID (A0h) and digital diagnostic
	  monitoring (A2h) pages over I2C, decodes them through the SFF-8472
	  library and checks module presence on MOD_DEF0 when it is wired.

config EMUL_SFF8472
	bool "Emulate an SFF-8472 (SFP/SFP+) module"
	default y
	depends on EMUL
	depends on DT_HAS_ZEPHYR_SFP_MODULE_EMUL_ENABLED
	help
	  Provide an emulator that serves a canned SFF-8472 module image over
	  the I2C emulation bus, so the driver can be exercised without
	  hardware.

config SFP_SHELL
	bool "SFP module shell"
	depends on SFP_SFF8472
	depends on SHELL
	help
	  Enable a shell module providing "sfp info" and "sfp ddm" commands to
	  inspect SFP modules.

config SFP_CMIS
	bool "CMIS (QSFP-DD/OSFP) cage driver"
	default y
	depends on DT_HAS_SFF_CMIS_ENABLED
	select I2C
	select GPIO if $(dt_compat_any_has_prop,$(DT_COMPAT_SFF_CMIS),modprsl-gpios)
	select CMIS
	help
	  Enable the I2C driver for CMIS managed pluggable modules such as
	  QSFP-DD, OSFP, SFP-DD and DSFP. It reads Page 00h (the module-level
	  monitors and administrative information) and decodes it through the
	  CMIS library.

config EMUL_CMIS
	bool "Emulate a CMIS (QSFP-DD/OSFP) module"
	default y
	depends on EMUL
	depends on DT_HAS_ZEPHYR_CMIS_MODULE_EMUL_ENABLED
	help
	  Provide an emulator that serves a canned CMIS Page 00h image over the
	  I2C emulation bus, so the driver can be exercised without hardware.

config SFP_CMIS_SHELL
	bool "CMIS module shell"
	depends on SFP_CMIS
	depends on SHELL
	help
	  Enable a shell module providing "cmis info" and "cmis mon" commands to
	  inspect CMIS modules.

endif # SFP
```

## drivers/smbus/Kconfig.it51xxx
```kconfig
# Copyright (c) 2026 ITE Corporation. All Rights Reserved.
# SPDX-License-Identifier: Apache-2.0

config SMBUS_ITE_IT51XXX
	bool "ITE SMBus driver"
	default y
	select CRC
	depends on DT_HAS_ITE_IT51XXX_SMBUS_ENABLED
	help
	  Enable ITE SMBus driver.
	  Supports nine controllers, performs SMBus messages with packet
	  error checking (PEC) either enabled or disabled.
	  Supported speeds: 50kHz, 100kHz, 400kHz and 1MHz.
	  Supports host notify command.
```
