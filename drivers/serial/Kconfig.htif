## drivers/serial/Kconfig.htif
```kconfig
menuconfig UART_HTIF
    bool "Enable HTIF UART driver"
    select SERIAL_HAS_DRIVER
    depends on RISCV
    help
      Enable the HTIF (Host-Target Interface) UART driver for RISC-V Spike simulation.

if UART_HTIF

config UART_HTIF_USE_YIELD_SLEEP
    bool "Use yield/sleep in HTIF polling"
    default n
    depends on UART_HTIF
    help
      Enable yielding (or sleeping) in wait loops for the HTIF driver. This
      optimization inserts a call to k_yield() if CONFIG_COOP_ENABLED is set;
      otherwise, it sleeps for 1ms. Disabling this option results in tight polling,
      which might be preferred in fast simulation environments such as RTL simulation.

config UART_HTIF_SYSCALL_PRINT
    bool "Enable syscall-based full-string printing"
    default n
    depends on UART_HTIF
    help
      When enabled, the driver will use an HTIF command to send a pointer to a
      null-terminated string (instead of sending characters one at a time). This
      may reduce overhead for printing longer strings, if the host-side FESVR supports it.

config UART_HTIF_BUFFERED_OUTPUT
    bool "Buffer UART output until newline"
    default n
    depends on UART_HTIF
    help
      If enabled, characters are buffered until a newline or the buffer becomes full.
      At that point, the entire buffer is flushed in one syscall (using the syscall-based
      print command if available). If disabled, characters are transmitted immediately.

#ifdef CONFIG_MULTITHREADING
config UART_HTIF_BUFFERED_OUTPUT_SIZE
    int "UART HTIF output buffer size"
    default 64
    depends on UART_HTIF && MULTITHREADING
    help
      Specifies the size (in bytes) of the output buffer for buffered UART output.
      When the buffer is full or a newline is encountered, the buffered string is
      transmitted in one operation.
#endif

endif # UART_HTIF
```

## drivers/serial/Kconfig.hummingbird
```kconfig
# Copyright (c) 2021 Tokita Hiroshi
# SPDX-License-Identifier: Apache-2.0

DT_COMPAT_HUMMINGBIRD_UART := nuclei,hummingbird-uart

config UART_HUMMINGBIRD
	bool "Nuclei HummingBird serial driver"
	default $(dt_compat_enabled,$(DT_COMPAT_HUMMINGBIRD_UART))
	depends on SOC_SERIES_HUMMINGBIRD
	select SERIAL_HAS_DRIVER
	help
	  This option enables the UART driver for Nuclei HummingBird core.
```

## drivers/serial/Kconfig.ifx_cat1
```kconfig
# Infineon CAT1 UART configuration options

# Copyright (c) 2022 Cypress Semiconductor Corporation (an Infineon company) or
# an affiliate of Cypress Semiconductor Corporation
# SPDX-License-Identifier: Apache-2.0

config UART_INFINEON_CAT1
	bool "Infineon CAT1 UART driver"
	default y
	depends on DT_HAS_INFINEON_CAT1_UART_ENABLED
	select SERIAL_HAS_DRIVER
	select SERIAL_SUPPORT_INTERRUPT
	select SERIAL_SUPPORT_ASYNC if !SOC_FAMILY_INFINEON_CAT1C
	select USE_INFINEON_UART
	select PINCTRL
	select DMA if UART_ASYNC_API
	help
	  This option enables the UART driver for Infineon CAT1 family.

config UART_PDL_INFINEON_CAT1
	bool "Infineon CAT1 UART driver (PDL)"
	default y
	depends on DT_HAS_INFINEON_CAT1_UART_PDL_ENABLED
	select SERIAL_HAS_DRIVER
	select SERIAL_SUPPORT_INTERRUPT
	select USE_INFINEON_UART
	select PINCTRL
	help
	  This option enables the UART driver for Infineon CAT1 family.
```

## drivers/serial/Kconfig.ifx_cat2
```kconfig
# Copyright (c) 2025 Infineon Technologies AG,
# or an affiliate of Infineon Technologies AG.
#
# SPDX-License-Identifier: Apache-2.0

config UART_PDL_INFINEON_CAT2
	bool "Infineon CAT2 UART driver (PDL)"
	default y
	depends on DT_HAS_INFINEON_CAT2_UART_ENABLED
	select SERIAL_HAS_DRIVER
	select SERIAL_SUPPORT_INTERRUPT
	select USE_INFINEON_UART
	select PINCTRL
	help
	This option enables the UART driver for Infineon CAT2 PDL family.
```

## drivers/serial/Kconfig.imx
```kconfig
# iMX7 M4 UART

# Copyright (c) 2018, NXP
# SPDX-License-Identifier: Apache-2.0

config UART_IMX
	bool "NXP i.MX7 family processor UART driver"
	default y
	depends on DT_HAS_NXP_IMX_UART_ENABLED
	select SERIAL_HAS_DRIVER
	select SERIAL_SUPPORT_INTERRUPT
	help
	  This option enables the UART driver for NXP i.MX7
	  family processors.
```

## drivers/serial/Kconfig.imx8m
```kconfig
# MCUXpresso SDK IUART

# Copyright (c) 2020, Manivannan Sadhasivam <mani@kernel.org>
# SPDX-License-Identifier: Apache-2.0

config UART_IMX8M
	bool "i.MX8M UART driver"
	select SERIAL_HAS_DRIVER
	select SERIAL_SUPPORT_INTERRUPT
	help
	  Enable the MCUX IUART driver.
```

## drivers/serial/Kconfig.infineon_cat1
```kconfig
# Copyright (c) 2021 Cypress Semiconductor Corporation.
# SPDX-License-Identifier: Apache-2.0

config UART_CAT1
	bool "Infineon CAT1 UART driver"
		default y
	depends on SOC_FAMILY_CAT1
	select SERIAL_HAS_DRIVER
	select SERIAL_SUPPORT_INTERRUPT
	help
	  This option enables the UART driver for Infineon CAT1 family.
```

## drivers/serial/Kconfig.intel_lw
```kconfig
# Copyright (c) 2023 Intel Corporation
# SPDX-License-Identifier: Apache-2.0

menuconfig UART_INTEL_LW
	bool "Intel Lightweight UART driver"
	depends on DT_HAS_INTEL_LW_UART_ENABLED
	select SERIAL_HAS_DRIVER
	select SERIAL_SUPPORT_INTERRUPT
	help
	  Enable the Intel Lightweight UART driver, that can be built into Intel NiosV CPU designs.

if UART_INTEL_LW

config UART_INTEL_LW_EOP
	bool "Include end of packet register"
	depends on UART_DRV_CMD && UART_INTERRUPT_DRIVEN
	help
	  Use driver command CMD_ENABLE_EOP and CMD_DISABLE_EOP to use the feature.

config UART_INTEL_LW_AUTO_LINE_CTRL_POLL
	bool "Auto set RTS signal during poll out"
	depends on UART_LINE_CTRL
	help
	  Assert RTS before polling out a character,
	  and deassert RTS after the character is polled out.
	  Please note that this is not suitable, when polling out several characters.
	  Please use uart_drv_cmd with CMD_POLL_ASSERT_RTS before polling out.
	  Then use CMD_POLL_DEASSERT_RTS to resume normal operation after polling.

endif # UART_INTEL_LW
```

## drivers/serial/Kconfig.it51xxx
```kconfig
# Copyright (c) 2025 ITE Corporation. All Rights Reserved.
# SPDX-License-Identifier: Apache-2.0

config UART_ITE_IT51XXX
	bool "ITE IT51XXX UART driver"
	default y
	select UART_NS16550_ITE_HIGH_SPEED_BAUDRATE
	depends on DT_HAS_ITE_IT51XXX_UART_ENABLED
	select PINCTRL
	help
	  IT51XXX uses shared ns16550.c driver. This wrapper primarily
	  registers an interrupt to wake up the EC from doze or deep
	  doze mode back to active state.
```

## drivers/serial/Kconfig.it8xxx2
```kconfig
# Copyright (c) 2021 ITE Corporation. All Rights Reserved.
# SPDX-License-Identifier: Apache-2.0

config UART_ITE_IT8XXX2
	bool "ITE IT8XXX2 UART driver"
	default y
	depends on DT_HAS_ITE_IT8XXX2_UART_ENABLED
	help
	  IT8XXX2 uses shared ns16550.c driver which does not
	  provide a power management callback, so create driver
	  to handle IT8XXX2 specific UART features. In addition
	  to use pm_action_cb, we also need to make some setting
	  at uart_it8xxx2_init.

config UART_ITE_IT8XXX2_INIT_PRIORITY
	int "ITE IT8XXX2 UART wrapper init priority"
	default 51
	depends on UART_ITE_IT8XXX2
	help
	  Initialization priority for the UART wrapper driver on ITE IT8XXX2,
	  must be set to a lower priority than the matching ns16550 device
	  (CONFIG_SERIAL_INIT_PRIORITY).
```

## drivers/serial/Kconfig.k20
```kconfig
menuconfig UART_K20
	bool "K20 serial driver"
	default n
	select SERIAL_HAS_DRIVER
	help
	This option enables the K20 serial driver.
	This specific driver can be used for the serial hardware
	available at the Freescale FRDM K64F board.

# ---------- Port 0 ----------

menuconfig UART_K20_PORT_0
	bool "Enable K20 UART Port 0"
	default n
	depends on UART_K20
	help
	  This tells the driver to configure the UART port at boot, depending on
	  the additional configure options below.

config UART_K20_PORT_0_NAME
	string "Port 0 Device Name"
	default "UART_0"
	depends on UART_K20_PORT_0
	help
	  This is the device name for UART, and is included in the device
	  struct.

config UART_K20_PORT_0_IRQ_PRI
	int "Port 0 Interrupt Priority"
	default 0
	depends on UART_K20_PORT_0
	help
	  The interrupt priority for UART port.

config UART_K20_PORT_0_BAUD_RATE
	int "Port 0 Baud Rate"
	default 0
	depends on UART_K20_PORT_0
	help
	  The baud rate for UART port to be set to at boot.

	  Leave at 0 to skip initialization.

# ---------- Port 1 ----------

menuconfig UART_K20_PORT_1
	bool "Enable K20 UART Port 1"
	default n
	depends on UART_K20
	help
	  This tells the driver to configure the UART port at boot, depending on
	  the additional configure options below.

config UART_K20_PORT_1_NAME
	string "Port 1 Device Name"
	default "UART_1"
	depends on UART_K20_PORT_1
	help
	  This is the device name for UART, and is included in the device
	  struct.

config UART_K20_PORT_1_IRQ_PRI
	int "Port 1 Interrupt Priority"
	default 0
	depends on UART_K20_PORT_1
	help
	  The interrupt priority for UART port.

config UART_K20_PORT_1_BAUD_RATE
	int "Port 1 Baud Rate"
	default 0
	depends on UART_K20_PORT_1
	help
	  The baud rate for UART port to be set to at boot.

	  Leave at 0 to skip initialization.

# ---------- Port 2 ----------

menuconfig UART_K20_PORT_2
	bool "Enable K20 UART Port 2"
	default n
	depends on UART_K20
	help
	  This tells the driver to configure the UART port at boot, depending on
	  the additional configure options below.

config UART_K20_PORT_2_NAME
	string "Port 2 Device Name"
	default "UART_2"
	depends on UART_K20_PORT_2
	help
	  This is the device name for UART, and is included in the device
	  struct.

config UART_K20_PORT_2_IRQ_PRI
	int "Port 2 Interrupt Priority"
	default 0
	depends on UART_K20_PORT_2
	help
	  The interrupt priority for UART port.

config UART_K20_PORT_2_BAUD_RATE
	int "Port 2 Baud Rate"
	default 0
	depends on UART_K20_PORT_2
	help
	  The baud rate for UART port to be set to at boot.

	  Leave at 0 to skip initialization.

# ---------- Port 3 ----------

menuconfig UART_K20_PORT_3
	bool "Enable K20 UART Port 3"
	default n
	depends on UART_K20
	help
	  This tells the driver to configure the UART port at boot, depending on
	  the additional configure options below.

config UART_K20_PORT_3_NAME
	string "Port 3 Device Name"
	default "UART_3"
	depends on UART_K20_PORT_3
	help
	  This is the device name for UART, and is included in the device
	  struct.

config UART_K20_PORT_3_IRQ_PRI
	int "Port 3 Interrupt Priority"
	default 0
	depends on UART_K20_PORT_3
	help
	  The interrupt priority for UART port.

config UART_K20_PORT_3_BAUD_RATE
	int "Port 3 Baud Rate"
	default 0
	depends on UART_K20_PORT_3
	help
	  The baud rate for UART port to be set to at boot.

	  Leave at 0 to skip initialization.

# ---------- Port 4 ----------

menuconfig UART_K20_PORT_4
	bool "Enable K20 UART Port 4"
	default n
	depends on UART_K20
	help
	  This tells the driver to configure the UART port at boot, depending on
	  the additional configure options below.

config UART_K20_PORT_4_NAME
	string "Port 4 Device Name"
	default "UART_4"
	depends on UART_K20_PORT_4
	help
	  This is the device name for UART, and is included in the device
	  struct.

config UART_K20_PORT_4_IRQ_PRI
	int "Port 4 Interrupt Priority"
	default 0
	depends on UART_K20_PORT_4
	help
	  The interrupt priority for UART port.

config UART_K20_PORT_4_BAUD_RATE
	int "Port 4 Baud Rate"
	default 0
	depends on UART_K20_PORT_4
	help
	  The baud rate for UART port to be set to at boot.

	  Leave at 0 to skip initialization.
```

## drivers/serial/Kconfig.kb1200
```kconfig
# Serial driver configuration options

# Copyright (c) 2023 ENE Technology

config UART_KB1200
	bool "KB1200 serial driver"
	select SERIAL_HAS_DRIVER
	select SERIAL_SUPPORT_INTERRUPT
	help
	  This option enables the KB1200 serial driver.

#	depends on SOC_ENE_KB1200
```

## drivers/serial/Kconfig.leon2
```kconfig
# Kconfig.leon2 - LEON2 UART configuration option
#
# Copyright (c) 2018 ispace, inc.
#
# SPDX-License-Identifier: Apache-2.0
#

menuconfig UART_LEON2
	bool "LEON2 UART driver"
	depends on SOC_AT697
	default y
	select SERIAL_HAS_DRIVER
	help
	  Enable the LEON2 UART driver.

config UART_LEON2_DEV_NAME
	string "Port 0 Device Name"
	default "uart0"
	depends on UART_LEON2
	help
	  This is the device name for LEON2 UART
```

## drivers/serial/Kconfig.leuart_gecko
```kconfig
# Gecko SDK LEUART

# Copyright (c) 2018, Diego Sueiro
# SPDX-License-Identifier: Apache-2.0

config LEUART_GECKO
	bool "Gecko leuart driver"
	default y
	depends on DT_HAS_SILABS_GECKO_LEUART_ENABLED
	select SERIAL_HAS_DRIVER
	select SERIAL_SUPPORT_INTERRUPT
	select SOC_GECKO_LEUART
	help
	  Enable the Gecko leuart driver.
```

## drivers/serial/Kconfig.litex
```kconfig
# LiteX UART configuration option

# Copyright (c) 2018 - 2019 Antmicro <www.antmicro.com>
# SPDX-License-Identifier: Apache-2.0

config UART_LITEX
	bool "LiteX serial driver"
	default y
	depends on DT_HAS_LITEX_UART_ENABLED
	select SERIAL_HAS_DRIVER
	select SERIAL_SUPPORT_INTERRUPT
	help
	  This option enables LiteX UART serial driver.
```

## drivers/serial/Kconfig.lpc11u6x
```kconfig
# LPC11U6X UART configuration

# Copyright (c) 2020 Seagate Technology
# SPDX-License-Identifier: Apache-2.0

config UART_LPC11U6X
	bool "LPC11U6X serial driver"
	default y
	depends on DT_HAS_NXP_LPC11U6X_UART_ENABLED
	select SERIAL_HAS_DRIVER
	select SERIAL_SUPPORT_INTERRUPT
	select PINCTRL
	help
	  Enable UART driver for LPC11U6X series
```

## drivers/serial/Kconfig.lpc84x
```kconfig
# Copyright (c) 2026 Aerlync Labs Inc.
# SPDX-License-Identifier: Apache-2.0

config UART_LPC84X
	bool "LPC84x UART driver"
	default y
	depends on DT_HAS_NXP_LPC84X_UART_ENABLED
	select SERIAL_HAS_DRIVER
	select SERIAL_SUPPORT_INTERRUPT
	select UART_USE_RUNTIME_CONFIGURE
	help
	 Enable the LPC84x UART driver.
```

## drivers/serial/Kconfig.max32
```kconfig
# MAX32 UART configuration

# Copyright (c) 2023-2024 Analog Devices, Inc.
# SPDX-License-Identifier: Apache-2.0

config UART_MAX32
	bool "MAX32 MCU serial driver"
	default y
	depends on DT_HAS_ADI_MAX32_UART_ENABLED
	select SERIAL_HAS_DRIVER
	select SERIAL_SUPPORT_INTERRUPT
	select PINCTRL
	select SERIAL_SUPPORT_ASYNC if DT_HAS_ADI_MAX32_DMA_ENABLED && !SOC_FAMILY_MAX32_RV32
	select DMA if UART_ASYNC_API
	help
	  This option enables the UART driver for MAX32 family of
	  processors.
	  Say y if you wish to use serial port on MAX32 MCU.

config UART_MAX32_TX_IRQ_WORKAROUND
	bool
	default y if SOC_MAX32690 || SOC_MAX32655 || SOC_MAX32657 || \
		SOC_MAX32666 || SOC_MAX32670 || SOC_MAX32672 || SOC_MAX32675
	depends on UART_MAX32 && UART_INTERRUPT_DRIVEN
	help
		Workaround for the subset of MAX32 MCUs that have errata regarding
		failing to consistently raise interrupts for TX half/almost empty
		flags.

if UART_MAX32_TX_IRQ_WORKAROUND

config UART_MAX32_TX_IRQ_WORKAROUND_POLL_US
	int "Interval for checking for TX completion"
	default 500
	help
		Timer interval for checking the TX FIFO status, for platforms where
		the TX half/almost empty interrupts may sometimes fail to raise.

endif

config UART_MAX32_TX_AE_WORKAROUND
	bool
	select DEPRECATED
	depends on UART_MAX32 && UART_INTERRUPT_DRIVEN
	help
		This option enables a small workaround for almost-empty interrupts
		not firing on TX of small amounts. This option is deprecated, in favor
		of more complete interrupt workaround for the necessary platforms.

if UART_MAX32

config UART_TX_CACHE_LEN
	int "TX cache buffer size"
	range 8 64
	default 8
	help
	  Size of UART transmit buffer that is used when source buffer
	  is not located in a DMA-able region.

endif # UART_MAX32
```
