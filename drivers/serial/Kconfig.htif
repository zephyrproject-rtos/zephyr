## drivers/serial/Kconfig.mchp
```kconfig
# Copyright (c) 2025-2026 Microchip Technology Inc.
# SPDX-License-Identifier: Apache-2.0

config UART_MCHP_SERCOM_G1
	bool
	default y
	depends on DT_HAS_MICROCHIP_SERCOM_G1_UART_ENABLED
	select SERIAL_HAS_DRIVER
	select SERIAL_SUPPORT_INTERRUPT
	select SERIAL_SUPPORT_ASYNC
	select PINCTRL
	help
	  This option enables UART driver for group (g1) of SERCOM peripherals.

if UART_MCHP_SERCOM_G1

config UART_MCHP_ASYNC
	bool
	default y
	depends on UART_ASYNC_API
	depends on DMA
	depends on $(dt_compat_any_has_prop,$(DT_COMPAT_MICROCHIP_SERCOM_G1_UART),dmas)
	help
	  Enable async/DMA support for UART instances that have dmas property.
	  Instances without dmas property will return -ENOTSUP for async operations.

endif # UART_MCHP_SERCOM_G1

config UART_MCHP_DBGU_G1
	bool "Microchip SAM Debug Unit (DBGU) driver"
	default y
	depends on DT_HAS_MICROCHIP_DBGU_G1_UART_ENABLED
	select SERIAL_HAS_DRIVER
	help
	  This option enables UART driver for group (g1) of DBGU peripherals.
```

## drivers/serial/Kconfig.mcux
```kconfig
# MCUXpresso SDK UART

# Copyright (c) 2017, NXP
# SPDX-License-Identifier: Apache-2.0

config UART_MCUX
	bool "MCUX uart driver"
	default y
	depends on DT_HAS_NXP_KINETIS_UART_ENABLED
	depends on CLOCK_CONTROL
	select SERIAL_HAS_DRIVER
	select SERIAL_SUPPORT_INTERRUPT
	select PINCTRL
	help
	  Enable the MCUX uart driver.
```

## drivers/serial/Kconfig.mcux_flexcomm
```kconfig
# MCUXpresso SDK USART
# Copyright 2017, NXP
# SPDX-License-Identifier: Apache-2.0

config UART_MCUX_FLEXCOMM
	bool "MCUX FLEXCOMM UART driver"
	default y
	depends on DT_HAS_NXP_LPC_USART_ENABLED
	select SERIAL_HAS_DRIVER
	select SERIAL_SUPPORT_INTERRUPT
	select SERIAL_SUPPORT_ASYNC if \
		DT_HAS_NXP_LPC_DMA_ENABLED
	select PM_POLICY_DEVICE_CONSTRAINTS if PM
	select DMA if UART_ASYNC_API
	select PINCTRL
	help
	  Enable the MCUX USART driver.

config UART_MCUX_FLEXCOMM_ISR_SUPPORT
	bool
	depends on UART_MCUX_FLEXCOMM
	default y if UART_INTERRUPT_DRIVEN || UART_ASYNC_API
	help
	  Enable UART interrupt service routine.

config UART_MCUX_FLEXCOMM_MODE32K_WAKE
	bool
	depends on UART_MCUX_FLEXCOMM
	help
	  Selected by SoCs whose Flexcomm USART stays wake-capable in a
	  clock-gating low-power state by reclocking from the 32 kHz
	  oscillator (MODE32K), instead of switching to a divided main clock.
```

## drivers/serial/Kconfig.mcux_iuart
```kconfig
# MCUXpresso SDK IUART

# Copyright (c) 2020, Manivannan Sadhasivam <mani@kernel.org>
# SPDX-License-Identifier: Apache-2.0

config UART_MCUX_IUART
	bool "MCUX IUART driver"
	default y
	depends on DT_HAS_NXP_IMX_IUART_ENABLED
	depends on CLOCK_CONTROL
	select SERIAL_HAS_DRIVER
	select SERIAL_SUPPORT_INTERRUPT
	help
	  Enable the MCUX IUART driver.
```

## drivers/serial/Kconfig.mcux_lpc_usart
```kconfig
# Kconfig - MCUXpresso SDK USART
#
# Copyright 2017, NXP
#
# SPDX-License-Identifier: Apache-2.0

menuconfig USART_MCUX_LPC
	bool "MCUX USART driver"
	depends on HAS_MCUX
	select SERIAL_HAS_DRIVER
	select SERIAL_SUPPORT_INTERRUPT
	help
	  Enable the MCUX USART driver.

if USART_MCUX_LPC

config USART_MCUX_LPC_0
	bool "USART 0"
	help
	  Enable USART 0.

endif # USART_MCUX_LPC
```

## drivers/serial/Kconfig.mcux_lpsci
```kconfig
# MCUXpresso SDK LPSCI

# Copyright (c) 2017, NXP
# SPDX-License-Identifier: Apache-2.0

config UART_MCUX_LPSCI
	bool "MCUX LPSCI driver"
	default y
	depends on DT_HAS_NXP_KINETIS_LPSCI_ENABLED
	depends on CLOCK_CONTROL
	select SERIAL_HAS_DRIVER
	select SERIAL_SUPPORT_INTERRUPT
	select PINCTRL
	help
	  Enable the MCUX LPSCI driver.
```

## drivers/serial/Kconfig.mec5
```kconfig
# Microchip MEC5 UART

# Copyright (c) 2024 Microchip Technology Inc.
# SPDX-License-Identifier: Apache-2.0

config UART_MCHP_MEC5
	bool "Microchip MEC5 family ns16550 compatible UART driver"
	default y
	depends on DT_HAS_MICROCHIP_MEC5_UART_ENABLED
	select SERIAL_HAS_DRIVER
	select SERIAL_SUPPORT_INTERRUPT
	help
	  This option enables the UART driver for Microchip MEC5
	  family processors.

if UART_MCHP_MEC5

config UART_MCHP_MEC5_LINE_CTRL
	bool "Serial Line Control for Apps"
	depends on UART_LINE_CTRL
	help
	  This enables the API for apps to control the serial line,
	  such as CTS and RTS.

	  Says n if not sure.

endif # UART_MCHP_MEC5
```
