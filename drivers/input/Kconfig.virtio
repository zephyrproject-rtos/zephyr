## drivers/input/Kconfig.virtio
```kconfig
# Copyright (c) 2026 Carlo Caione <ccaione@baylibre.com>
# SPDX-License-Identifier: Apache-2.0

config INPUT_VIRTIO
	bool "VIRTIO input device driver"
	default y
	depends on DT_HAS_VIRTIO_INPUT_ENABLED
	select VIRTIO
	help
	  Enable driver for VIRTIO input devices.

if INPUT_VIRTIO

config INPUT_VIRTIO_EVENT_BUF_COUNT
	int "Number of queued event buffers"
	default 16
	range 1 256
	help
	  Number of event buffers queued on the event virtqueue. Each buffer
	  holds a single input event.

choice INPUT_VIRTIO_DEVICE_TYPE
	prompt "VIRTIO input device type"
	default INPUT_VIRTIO_DEVICE_TYPE_TABLET
	help
	  Type of VIRTIO input device to emulate/probe.

config INPUT_VIRTIO_DEVICE_TYPE_TABLET
	bool "Tablet"

config INPUT_VIRTIO_DEVICE_TYPE_KEYBOARD
	bool "Keyboard"

endchoice # INPUT_VIRTIO_DEVICE_TYPE

endif # INPUT_VIRTIO
```

## drivers/interrupt_controller/Kconfig.brcm
```kconfig
# Copyright (c) 2026 Jonathan Elliot Peace <jep@alphabetiq.com>
# SPDX-License-Identifier: Apache-2.0

config BCM2836_L1_INTC
	bool "BCM2836 ARM-local interrupt controller"
	default y
	depends on DT_HAS_BRCM_BCM2836_L1_INTC_ENABLED
	help
	  Driver for the BCM2836 ARM-local interrupt controller (also
	  present on BCM2710 / Pi Zero 2 W). Routes per-core ARM
	  generic timer IRQs, four mailbox IRQs per core, the per-core
	  PMU IRQ, and the cascaded GPU IRQ to the parent controller of
	  the ARM CPU IRQ line.

config BCM2835_ARMCTRL_IC
	bool "BCM2835 ARMC peripheral interrupt controller"
	default y
	depends on DT_HAS_BRCM_BCM2835_ARMCTRL_IC_ENABLED
	help
	  Driver for the BCM2835 ARMC peripheral interrupt controller --
	  the "GPU IRQ" side of the BCM283x family. On BCM2710 (Pi Zero
	  2 W) it cascades under the BCM2836 ARM-local intc; on BCM2835
	  (Pi 1 / Pi Zero W) it is the root controller wired directly to
	  the ARM core IRQ line.

config BCM2712_MIP
	bool "BCM2712 MSI interrupt proxy"
	default y
	depends on DT_HAS_BRCM_BCM2712_MIP_ENABLED
	select MSI_PROXY
	help
	  Driver for the BCM2712 MSI interrupt proxy (MIP). The MIP
	  converts endpoint MSI writes into host interrupts and is
	  consumed through the generic MSI proxy API.

config BCM2712_MIP_INIT_PRIORITY
	int "BCM2712 MIP init priority"
	default 40
	depends on BCM2712_MIP
	help
	  Initialisation priority of the BCM2712 MSI interrupt proxy.
	  It must run before the RP1 interrupt controller.

config RP1_IRQ
	bool "Raspberry Pi RP1 MSI-X interrupt controller"
	default y
	depends on DT_HAS_RASPBERRYPI_RP1_INTC_ENABLED
	depends on ARM64
	depends on PCIE
	depends on PCIE_CONTROLLER
	depends on MSI_PROXY
	help
	  Driver for the interrupt controller of the RP1 PCIe south
	  bridge found on the Raspberry Pi 5. The RP1 raises one MSI-X
	  vector per internal interrupt source; the BCM2712 MSI
	  interrupt proxy converts each vector into a GIC SPI. The
	  driver programs the MSI-X table, unmasks the host side of the
	  proxy and uses the corresponding GIC INTIDs for the RP1 sources.

config RP1_IRQ_INIT_PRIORITY
	int "RP1 interrupt controller init priority"
	default 42
	depends on RP1_IRQ
	help
	  Initialisation priority of the RP1 interrupt controller. It
	  must run after the PCIe root complex (CONFIG_PCIE_INIT_PRIORITY)
	  because it reads the RP1 configuration space, and before the
	  serial drivers that enable RP1 UART interrupts.
```

## drivers/interrupt_controller/Kconfig.esp32
```kconfig
# Espressif interrupt matrix driver

# Copyright (c) 2021 Espressif Systems (Shanghai) Co., Ltd.
# SPDX-License-Identifier: Apache-2.0

config INTC_ESP32
	bool "Interrupt matrix driver for Espressif SoCs"
	default y if !SOC_ESP32C5_LPCORE && !SOC_ESP32C6_LPCORE && !SOC_ESP32P4_LPCORE
	depends on SOC_FAMILY_ESPRESSIF_ESP32
	help
	  Interrupt matrix driver for Espressif SoCs, modelled as a multi-level
	  interrupt aggregator.
```

## drivers/interrupt_controller/Kconfig.goldfish
```kconfig
# Copyright (c) 2026 Dimitri Varpusvuori
# SPDX-License-Identifier: Apache-2.0

config GOLDFISH_PIC
	bool "Google Goldfish programmable interrupt controller"
	default y
	depends on DT_HAS_GOOGLE_GOLDFISH_PIC_ENABLED
	select MULTI_LEVEL_INTERRUPTS
	select 2ND_LEVEL_INTERRUPTS
	help
	  Second-level interrupt aggregator used by the QEMU m68k virt
	  machine. Each instance demultiplexes up to 32 device interrupt
	  sources onto one autovectored CPU interrupt level.

if GOLDFISH_PIC

# Each PIC owns a 32-entry _sw_isr_table slice.
config MAX_IRQ_PER_AGGREGATOR
	default 32

endif # GOLDFISH_PIC
```

## drivers/interrupt_controller/Kconfig.infineon_aurix
```kconfig
# SPDX-FileCopyrightText: Copyright (c) 2024 Infineon Technologies AG,
# SPDX-FileCopyrightText: or an affiliate of Infineon Technologies AG. All rights reserved.
# SPDX-FileCopyrightText: Copyright (c) 2026 Linumiz
#
# SPDX-License-Identifier: Apache-2.0

config AURIX_IR
	bool "Infineon AURIX Interrupt Router"
	default y
	depends on DT_HAS_INFINEON_AURIX_IR_ENABLED
	help
	  Enable driver for Infineon AURIX interrupt router.
```

## drivers/interrupt_controller/Kconfig.mchp
```kconfig
# Copyright (c) 2025-2026 Microchip Technology Inc.
# SPDX-License-Identifier: Apache-2.0

config INTC_MCHP_AIC_G1
	bool "Microchip AIC G1 interrupt-controller driver"
	default y
	depends on DT_HAS_MICROCHIP_AIC_G1_INTC_ENABLED
	help
	  This option enables interrupt-controller driver for group (g1) of
	  AIC (Advanced Interrupt Controller) peripherals.

config INTC_MCHP_EIC_G1
	bool "External Interrupt Controller (EIC) Driver for Microchip devices"
	default y
	depends on DT_HAS_MICROCHIP_EIC_G1_INTC_ENABLED
	help
	  Enable EIC driver for Microchip EIC G1 peripherals. This is required for
	  GPIO interrupt support.

config INTC_MCHP_EIC_G1_TRUSTZONE
	bool "TrustZone-aware EIC driver (secure/non-secure partitioning)"
	depends on INTC_MCHP_EIC_G1
	depends on ARM_TRUSTZONE_M
	help
	  Enables secure/non-secure line partitioning (EIC_NONSEC),
	  mismatch detection (EIC_NSCHK), and IRQ target-state routing
	  for TrustZone-capable Microchip SoCs whose EIC peripheral
	  provides the NONSEC/NSCHK registers.

config INTC_MCHP_EIC_G1_NMI
	bool "NMI support for EIC pins"
	depends on INTC_MCHP_EIC_G1
	select RUNTIME_NMI
	help
	  Support GPIO pins that are routed to EIC NMI instead of
	  regular EXTINT lines. For example, on PIC32CK, PD2 is connected to NMI.
	  This requires CONFIG_RUNTIME_NMI to allow custom NMI handlers.
```

## drivers/interrupt_controller/Kconfig.mtk_adsp
```kconfig
# Copyright 2023 The ChromiumOS Authors
# SPDX-License-Identifier: Apache-2.0

config INTC_MTK_ADSP
	bool "MediaTek Audio DSP Interrupt Controller"
	depends on DT_HAS_MEDIATEK_ADSP_INTC_ENABLED
	help
	  Very simple cascaded interrupt controller consisting of two
	  bitfield registers (status and enable) and one mask value
	  defining valid interrupts.
```

## drivers/interrupt_controller/Kconfig.mtk_eint
```kconfig
# Copyright (c) 2026 MediaTek Inc.
# SPDX-License-Identifier: Apache-2.0

config INTC_MT8188_EINT
	bool "MediaTek MT8188 external interrupt controller"
	default y
	depends on DT_HAS_MEDIATEK_MT8188_EINT_ENABLED
	help
	  Enable the external interrupt controller driver for MediaTek MT8188.

	  The controller multiplexes the per-pin external interrupt lines onto
	  one parent interrupt and hands events to whichever driver registered
	  for the line.  On this SoC the GPIO driver is the only consumer.
```

## drivers/interrupt_controller/Kconfig.multilevel
```kconfig
# Multilevel interrupt configuration

# Copyright (c) 2017 Intel Corporation
# Copyright (c) 2018 Foundries.io
# SPDX-License-Identifier: Apache-2.0

config MULTI_LEVEL_INTERRUPTS
	bool "Multi-level interrupt support"
	depends on GEN_SW_ISR_TABLE
	help
	  Multiple levels of interrupts are normally used to increase the
	  number of addressable interrupts in a system. For example, if two
	  levels are used, a second level interrupt aggregator would combine
	  all interrupts routed to it into one IRQ line in the first level
	  interrupt controller. If three levels are used, a third level
	  aggregator combines its input interrupts into one IRQ line at the
	  second level. The number of interrupt levels is usually determined
	  by the hardware. (The term "aggregator" here means "interrupt
	  controller".)

if MULTI_LEVEL_INTERRUPTS
config 1ST_LEVEL_INTERRUPT_BITS
	int "Total number of first level interrupt bits"
	range 1 32
	default 8
	help
	  The number of bits to use of the 32 bit interrupt mask for first
	  tier interrupts.

config MAX_IRQ_PER_AGGREGATOR
	int "Max IRQs per interrupt aggregator"
	default 0

	help
	  The maximum number of interrupt inputs to any aggregator in the
	  system. This is the common fallback value: the per-level symbols
	  MAX_IRQ_PER_2ND_LEVEL_AGGREGATOR and MAX_IRQ_PER_3RD_LEVEL_AGGREGATOR
	  default to it, and can be overridden individually when aggregators
	  at different levels have different input counts.

config 2ND_LEVEL_INTERRUPTS
	bool "Second-level interrupt support"
	help
	  Second level interrupts are used to increase the number of
	  addressable interrupts in a system.

config 2ND_LVL_ISR_TBL_OFFSET
	int "Offset in _sw_isr_table for level 2 interrupts"
	default 0
	depends on 2ND_LEVEL_INTERRUPTS
	help
	  This is the offset in _sw_isr_table, the generated ISR handler table,
	  where storage for 2nd level interrupt ISRs begins. This is
	  typically allocated after ISRs for level 1 interrupts.

config NUM_2ND_LEVEL_AGGREGATORS
	int "Total number of second level interrupt aggregators"
	range 1 8
	default 1
	depends on 2ND_LEVEL_INTERRUPTS
	help
	  The number of level 2 interrupt aggregators to support. Each
	  aggregator can manage at most MAX_IRQ_PER_AGGREGATOR level 2
	  interrupts.

config MAX_IRQ_PER_2ND_LEVEL_AGGREGATOR
	int "Max IRQs per second level interrupt aggregator"
	default MAX_IRQ_PER_AGGREGATOR
	depends on 2ND_LEVEL_INTERRUPTS
	help
	  The maximum number of interrupt inputs to any level 2 aggregator.
	  Sizes each level 2 aggregator's window in _sw_isr_table. Defaults
	  to MAX_IRQ_PER_AGGREGATOR.

config 2ND_LEVEL_INTERRUPT_BITS
	int "Total number of second level interrupt bits"
	range 0 31
	default 8
	help
	  The number of bits to use of the 32 bit interrupt mask for second
	  tier interrupts.

prev-level-num = 1
cur-level-num = 2
cur-level = 2ND
aggregator = 0
rsource "Kconfig.multilevel.aggregator_template"
aggregator = 1
rsource "Kconfig.multilevel.aggregator_template"
aggregator = 2
rsource "Kconfig.multilevel.aggregator_template"
aggregator = 3
rsource "Kconfig.multilevel.aggregator_template"
aggregator = 4
rsource "Kconfig.multilevel.aggregator_template"
aggregator = 5
rsource "Kconfig.multilevel.aggregator_template"
aggregator = 6
rsource "Kconfig.multilevel.aggregator_template"
aggregator = 7
rsource "Kconfig.multilevel.aggregator_template"

config 3RD_LEVEL_INTERRUPTS
	bool "Third-level interrupt support"
	depends on 2ND_LEVEL_INTERRUPTS
	help
	  Third level interrupts are used to increase the number of
	  addressable interrupts in a system.

config NUM_3RD_LEVEL_AGGREGATORS
	int "Total number of third level interrupt aggregators"
	range 1 8
	default 1
	depends on 3RD_LEVEL_INTERRUPTS
	help
	  The number of level 3 interrupt aggregators to support. Each
	  aggregator can manage at most MAX_IRQ_PER_AGGREGATOR level 3
	  interrupts.

config 3RD_LVL_ISR_TBL_OFFSET
	int "Offset in _sw_isr_table for level 3 interrupts"
	default 0
	depends on 3RD_LEVEL_INTERRUPTS
	help
	  This is the offset in _sw_isr_table, the generated ISR handler table,
	  where storage for 3rd level interrupt ISRs begins. This is
	  typically allocated after ISRs for level 2 interrupts.

config MAX_IRQ_PER_3RD_LEVEL_AGGREGATOR
	int "Max IRQs per third level interrupt aggregator"
	default MAX_IRQ_PER_AGGREGATOR
	depends on 3RD_LEVEL_INTERRUPTS
	help
	  The maximum number of interrupt inputs to any level 3 aggregator.
	  Sizes each level 3 aggregator's window in _sw_isr_table. Defaults
	  to MAX_IRQ_PER_AGGREGATOR.

config 3RD_LEVEL_INTERRUPT_BITS
	int "Total number of third level interrupt bits"
	range 0 30
	default 8
	help
	  The number of bits to use of the 32 bit interrupt mask for third
	  tier interrupts.

prev-level-num = 2
cur-level-num = 3
cur-level = 3RD
aggregator = 0
rsource "Kconfig.multilevel.aggregator_template"
aggregator = 1
rsource "Kconfig.multilevel.aggregator_template"
aggregator = 2
rsource "Kconfig.multilevel.aggregator_template"
aggregator = 3
rsource "Kconfig.multilevel.aggregator_template"
aggregator = 4
rsource "Kconfig.multilevel.aggregator_template"
aggregator = 5
rsource "Kconfig.multilevel.aggregator_template"
aggregator = 6
rsource "Kconfig.multilevel.aggregator_template"
aggregator = 7
rsource "Kconfig.multilevel.aggregator_template"

endif
```

## drivers/interrupt_controller/Kconfig.py32
```kconfig
# SPDX-FileCopyrightText: Copyright The Zephyr Project Contributors
# SPDX-License-Identifier: Apache-2.0

config EXTI_PY32
	bool "Puya PY32 external interrupt driver"
	default y
	depends on DT_HAS_PUYA_PY32_EXTI_ENABLED
	help
	  Enable the external interrupt driver for Puya PY32 microcontrollers.
```

## drivers/interrupt_controller/Kconfig.renesas_rh850
```kconfig
# SPDX-FileCopyrightText: Copyright (c) 2026 Linumiz
#
# SPDX-License-Identifier: Apache-2.0

config RENESAS_RH850_INTC
	bool "Renesas RH850 interrupt controller"
	default y
	depends on DT_HAS_RENESAS_RH850_INTC_ENABLED
	help
	  Driver for the INTC1 and INTC2 interrupt controllers of Renesas
	  RH850 SoCs, used by the architecture interrupt code.
```

## drivers/interrupt_controller/Kconfig.renesas_rx
```kconfig
# Copyright (c) 2025-2026 Renesas Electronics Corporation
# SPDX-License-Identifier: Apache-2.0

config RENESAS_RX_ICU
	bool "Renesas RX series interrupt controller unit"
	default y
	depends on DT_HAS_RENESAS_RX_ICU_ENABLED
	help
	  Renesas RX series interrupt controller unit

config RENESAS_RX_GRP_INTC
	bool "Renesas RX series group interrupt"
	default y
	depends on DT_HAS_RENESAS_RX_GRP_INTC_ENABLED
	help
	  Renesas RX series group interrupt feature

config RENESAS_RX_GRP_INTC_FSP
	bool "Renesas RX series group interrupt using FSP"
	default y
	depends on DT_HAS_RENESAS_RX_GRP_INTC_FSP_ENABLED
	help
	  Renesas RX series group interrupt feature using FSP
```

## drivers/interrupt_controller/Kconfig.ti_k3_intr_router
```kconfig
# Copyright (c) Dhruv Menon <dhruvmenon1104@gmail.com>
# SPDX-License-Identifier: Apache-2.0

config TI_K3_INTR_ROUTER
	bool "Texas Instruments K3 Interrupt Router"
	default y
	depends on DT_HAS_TI_K3_INTR_ROUTER_ENABLED
	help
	  Enable support for Texas Instruments K3 Interrupt Router hardware block
	  found on TI K3 SoCs (e.g. J722S / AM67A, AM62x, AM64x).
```

## drivers/interrupt_controller/Kconfig.ti_sci_intr
```kconfig
# Copyright (c) 2026 Dhruv Menon <dhruvmenon1104@gmail.com>
# SPDX-License-Identifier: Apache-2.0

config TI_SCI_INTR
	bool "TI K3 TISCI Interrupt Router"
	default y
	depends on DT_HAS_TI_SCI_INTR_ENABLED
	depends on DT_HAS_TI_SCI_INTR_OUT_ENABLED
	depends on TISCI
	select MULTI_LEVEL_INTERRUPTS
	select 2ND_LEVEL_INTERRUPTS
	help
	  Enable support for Texas Instruments K3 Interrupt Router blocks that
	  are programmed through TISCI (for example MAIN/MCU GPIOMUX INTROUTER
	  on J722S). With ti,sci-intr-out children, peripherals use ordinary
	  IRQ_CONNECT / irq_enable; the parent programs the TISCI route.

	  The SoC or board must configure the multilevel IRQ layout before
	  using this driver: NUM_IRQS, 1ST_LEVEL_INTERRUPT_BITS (wide enough
	  for native parent IRQs such as VIM), NUM_2ND_LEVEL_AGGREGATORS,
	  MAX_IRQ_PER_AGGREGATOR, 2ND_LVL_ISR_TBL_OFFSET, and one
	  2ND_LVL_INTR_*_OFFSET per ti,sci-intr-out parent IRQ.
```

## drivers/led/Kconfig.aw9523b
```kconfig
# Copyright 2026 Smartbox Assistive Technology Ltd
# SPDX-License-Identifier: Apache-2.0

config LED_AW9523B
	bool "AW9523B LED driver"
	default y
	depends on DT_HAS_AWINIC_AW9523B_LED_ENABLED
	select I2C
	select MFD
	help
	  Enable the AW9523B LED controller.
```
