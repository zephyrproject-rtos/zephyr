## drivers/led/Kconfig.is31fl3743b
```kconfig
# Copyright (c) 2026 Open Device Partnership and Contributors
#
# SPDX-License-Identifier: Apache-2.0

config IS31FL3743B
	bool "IS31FL3743B LED driver"
	default y
	depends on DT_HAS_ISSI_IS31FL3743B_ENABLED
	select SPI
	help
	  Enable LED driver for IS31FL3743B.
```

## drivers/led/Kconfig.ktd2052
```kconfig
# SPDX-License-Identifier: Apache-2.0
# SPDX-FileCopyrightText: Copyright (c) 2026 sevenlab engineering GmbH

config LED_KTD2052
	bool "Kinetic KTD2052 LED driver"
	default y
	depends on DT_HAS_KINETIC_KTD2052_ENABLED
	select I2C
	help
	  Enable the driver for the Kinetic KTD2052.
```

## drivers/led/Kconfig.led-strip-cache
```kconfig
# Copyright (c) 2026 Simon Guinot <simon.guinot@sequanux.org>
# SPDX-License-Identifier: Apache-2.0

config LED_STRIP_CACHE
	bool "LED strip cache driver"
	default y
	depends on DT_HAS_ZEPHYR_LED_STRIP_CACHE_ENABLED
	help
	  Enable this driver to support a virtual LED device bridging the LED
	  and LED strip APIs. The driver provides a cache for one or more LED
	  strip devices.

config LED_STRIP_CACHE_UPDATE_ALL
	bool "Update all LEDs on each update"
	default n
	depends on LED_STRIP_CACHE
	help
	  Always update all LEDs of a strip instead of stopping at the targeted
	  LED.

	  By default, the LED strip cache driver updates a strip only up to the
	  targeted LED. But some backend controllers may be unable to keep the
	  signal low after a transmission. A high signal at the end of the
	  transmission may be interpreted as an additional bit by the next LED,
	  which can affect its state. In that case you may try to enable this
	  option.
```

## drivers/led/Kconfig.lp50xx
```kconfig
# Copyright (c) 2020 Seagate Technology LLC
# Copyright (c) 2022 Grinn
# SPDX-License-Identifier: Apache-2.0

config LP50XX
	bool "LP50XX LED controller"
	default y
	depends on DT_HAS_TI_LP5009_ENABLED || DT_HAS_TI_LP5012_ENABLED || \
		DT_HAS_TI_LP5018_ENABLED || DT_HAS_TI_LP5024_ENABLED || \
		DT_HAS_TI_LP5030_ENABLED || DT_HAS_TI_LP5036_ENABLED || \
		DT_HAS_DIODES_AL5887_ENABLED
	select I2C
	help
	  Enable driver for the Texas Instruments LP50XX I2C LED
	  controllers and compatible devices. It supports: LP5009, LP5012,
	  LP5018, LP5024, LP5030, LP5036 and Diodes AL5887.
```

## drivers/led/Kconfig.lp5814
```kconfig
# SPDX-FileCopyrightText: Copyright The Zephyr Project Contributors
# SPDX-License-Identifier: Apache-2.0

config LED_LP5814
	bool "LP5814 LED driver"
	default y
	depends on DT_HAS_TI_LP5814_ENABLED
	select I2C
	help
	  Enable manual brightness control for the four constant-current
	  outputs of the Texas Instruments LP5814 LED driver.
```

## drivers/led/Kconfig.matrix
```kconfig
# Copyright (c) 2026 Hubert Miś
# SPDX-License-Identifier: Apache-2.0

menuconfig LED_MATRIX
	bool "LED Matrix driver"
	default y
	depends on DT_HAS_LED_MATRIX_ENABLED
	help
	  Enable LED Matrix driver.

	  This driver is designed to control an LED matrix using two separate LED
	  driver instances: one for the matrix columns and another for the matrix rows.

	  The columns controller is responsible for managing the power sources
	  or sinks for the LEDs, while the rows controller handles the complementary
	  power control to complete the circuit.

	  The current driver revision is limited to monochromatic LEDs.

if LED_MATRIX

config LED_MATRIX_ROWS
	int "Number of rows in the LED Matrix"
	default 8
	help
	  Define the maximal number of rows in the LED Matrix.
	  This setting directly impacts the memory consumption of each driver instance.

config LED_MATRIX_COLS
	int "Number of columns in the LED Matrix"
	default 8
	help
	  Define the maximal number of columns in the LED Matrix.
	  This setting directly impacts the memory consumption of each driver instance.

choice LED_MATRIX_REFRESH_METHOD
	bool "Refresh method of the LED Matrix"
	default LED_MATRIX_REFRESH_METHOD_THREAD
	help
	  The LED Matrix driver supports the following refresh methods:
	  - thread: Uses a dedicated thread to refresh the LED Matrix.
	  - ktimer: Uses timer interrupts to refresh the LED Matrix.
	  - external: Uses an external event to trigger LED Matrix refresh.

config LED_MATRIX_REFRESH_METHOD_THREAD
	bool "Thread"
	help
	  Uses a dedicated thread to refresh the LED Matrix.
	  This is the safest and most reliable method. It supports LED drivers using
	  blocking calls (e.g. SPI or I2C based). However, it increases memory
	  footprint and may introduce latency resulting in visible LED flicker.

config LED_MATRIX_REFRESH_METHOD_KTIMER
	bool "ktimer"
	help
	  Uses a ktimer to refresh the LED Matrix.
	  This option is the least resource-intensive. It refreshes the LED matrix
	  immediately, directly from the timer interrupt. Because of this, make sure
	  that the LED drivers used by the matrix driver can be safely used from an
	  interrupt context. Also, make sure that the functions to set LEDs (on/off,
	  brightness) do not preempt each other.

config LED_MATRIX_REFRESH_METHOD_EXTERNAL
	bool "External"
	help
	  Uses an external event to trigger LED Matrix refresh.
	  You have to call the refresh function periodically to refresh a matrix row.

endchoice

config LED_MATRIX_USE_LED_WRITE_CHANNELS
	bool "Use led_write_channels API for columns driver"
	help
	  Enable the use of the led_write_channels() API for the columns driver.
	  This approach is more efficient than falling back to a loop that calls
	  led_set_brightness() for each column.

if LED_MATRIX_REFRESH_METHOD_THREAD

config LED_MATRIX_THREAD_STACK_SIZE
	int "LED Matrix thread stack size"
	default 1024
	help
	  Configure the stack size for the thread used by the LED Matrix driver.

config LED_MATRIX_THREAD_PRIORITY
	int "LED Matrix thread priority"
	default 5
	help
	  Define the priority of the thread used by the LED Matrix driver.

endif # LED_MATRIX_REFRESH_METHOD_THREAD

config LED_MATRIX_INIT_PRIORITY
	int "LED Matrix initialization priority"
	default 90
	help
	  Set the initialization priority for the LED Matrix driver.

endif # LED_MATRIX
```

## drivers/led_strip/Kconfig.ameba
```kconfig
# Copyright (c) 2026 Realtek Semiconductor Corp.
# SPDX-License-Identifier: Apache-2.0

# Ameba led controller driver config
config LEDC_AMEBA
	bool "Ameba led controller driver"
	default y
	depends on DT_HAS_REALTEK_AMEBA_LEDC_ENABLED
	select PINCTRL
	select LED_STRIP_RGB_SCRATCH
	help
	  Enable support for Ameba led controller driver.
```

## drivers/lin/Kconfig
```kconfig
# LIN configuration options

# Copyright (c) 2025 Renesas Electronics Corporation
# SPDX-License-Identifier: Apache-2.0

menuconfig LIN
	bool "Local Interconnect Network (LIN) drivers"
	help
	  LIN (Local Interconnect Network) driver subsystem.

if LIN

module = LIN
module-str = LIN
source "subsys/logging/Kconfig.template.log_config"

config LIN_INIT_PRIORITY
	int "LIN driver init priority"
	default 80
	help
	  LIN driver device initialization priority.

config LIN_AUTO_SYNCHRONIZATION
	bool "LIN auto synchronization"
	default y
	help
	  Enable automatic synchronization of LIN frames. If disabled, the driver will not handle
	  frame synchronization.

# zephyr-keep-sorted-start
source "drivers/lin/renesas/ra/Kconfig.renesas_ra"
# zephyr-keep-sorted-stop

config LIN_TRANSCEIVER
	bool "LIN transceiver drivers"
	default y
	depends on DT_HAS_LIN_TRANSCEIVER_GPIO_ENABLED

if LIN_TRANSCEIVER

source "drivers/lin/transceiver/Kconfig"

endif # LIN_TRANSCEIVER

endif # LIN
```
