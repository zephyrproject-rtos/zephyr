## drivers/input/Kconfig.npcx
```kconfig
# NPCX Keyboard scan driver configuration options

# Copyright (c) 2022 Nuvoton Technology Corporation.
# SPDX-License-Identifier: Apache-2.0

config INPUT_NPCX_KBD
	bool "Nuvoton NPCX embedded controller (EC) keyboard scan driver"
	default y
	depends on DT_HAS_NUVOTON_NPCX_KBD_ENABLED
	select INPUT_KBD_MATRIX
	help
	  This option enables the keyboard scan driver for NPCX family of
	  processors.

config INPUT_NPCX_KBD_KSO_HIGH_DRIVE
	bool "Select quasi-bidirectional buffers for KSO pins"
	default y
	depends on INPUT_NPCX_KBD
	help
	  Select quasi-bidirectional buffers for KSO pins to reduce the
	  low-to-high transition time.
```

## drivers/input/Kconfig.nunchuk
```kconfig
# Copyright (c) 2024 Bootlin
# SPDX-License-Identifier: Apache-2.0

config INPUT_NUNCHUK
	bool "Nintendo Nunchuk joystick"
	default y
	depends on DT_HAS_NINTENDO_NUNCHUK_ENABLED
	select I2C
	help
	  This option enables the driver for the Nintendo Nunchuk joystick.

config INPUT_NUNCHUK_ACCELERATION
	bool "Nintendo Nunchuk joystick acceleration sensor data"
	default n
	depends on INPUT_NUNCHUK
	help
	  This option enables the acceleration data reading for the Nintendo Nunchuk joystick.
```

## drivers/input/Kconfig.pat912x
```kconfig
# Copyright 2024 Google LLC
# SPDX-License-Identifier: Apache-2.0

config INPUT_PAT912X
	bool "PAT912X miniature optical navigation chip input driver"
	default y
	depends on DT_HAS_PIXART_PAT912X_ENABLED
	select I2C
	help
	  PAT912X miniature optical navigation chip input driver
```

## drivers/input/Kconfig.paw32xx
```kconfig
# Copyright 2024 Google LLC
# SPDX-License-Identifier: Apache-2.0

config INPUT_PAW32XX
	bool "PAW32xx ultra low power wireless mouse chip"
	default y
	depends on DT_HAS_PIXART_PAW32XX_ENABLED
	select SPI
	help
	  PAW32XX low power laser mouse sensor input driver
```

## drivers/input/Kconfig.pinnacle
```kconfig
# Cirque Pinnacle 1CA027 touch controller based device configuration options
#
# Copyright (c) 2024 Ilia Kharin
# SPDX-License-Identifier: Apache-2.0

config INPUT_PINNACLE
	bool "Cirque Pinnacle 1CA027 Touch Controller Based Device"
	default y
	depends on DT_HAS_CIRQUE_PINNACLE_ENABLED
	select GPIO
	select I2C if $(dt_compat_on_bus,$(DT_COMPAT_CIRQUE_PINNACLE),i2c)
	select SPI if $(dt_compat_on_bus,$(DT_COMPAT_CIRQUE_PINNACLE),spi)
	help
	  Enable driver for Cirque Pinnacle 1CA027 tracked input device.
```

## drivers/input/Kconfig.pmw3610
```kconfig
# Copyright 2024 Google LLC
# SPDX-License-Identifier: Apache-2.0

config INPUT_PMW3610
	bool "PMW3610 low power laser mouse sensor input driver"
	default y
	depends on DT_HAS_PIXART_PMW3610_ENABLED
	select SPI
	help
	  PMW3610 low power laser mouse sensor input driver
```

## drivers/input/Kconfig.renesas_ra
```kconfig
# Copyright (c) 2025 Renesas Electronics Corporation
# SPDX-License-Identifier: Apache-2.0

config INPUT_RENESAS_RA_CTSU
	bool "Renesas RA Capacitive Touch driver"
	default y
	depends on DT_HAS_RENESAS_RA_CTSU_ENABLED
	select USE_RA_FSP_CTSU
	select USE_RA_FSP_TOUCH
	select SYS_MEM_BLOCKS
	select GPIO
	select PINCTRL
	help
	  Enable Renesas RA Touch Sensing driver.

if INPUT_RENESAS_RA_CTSU

config INPUT_RENESAS_RA_DEVICE_VCC
	int "SoC VCC input in minivolt"
	default 3300
	help
	  SoC VCC input in milivolt.

config INPUT_RENESAS_RA_QE_TOUCH_CFG
	bool "Using QE Touch Workflow to config this driver"
	help
	  If this config was enabled, setting for CTSU and Cap
	  Touch driver will be reflected the setting that generated
	  from QE Touch Workflow.
	  Please add the generated C source files into the app CMakeLists
	  to make the driver can using it.

if !INPUT_RENESAS_RA_QE_TOUCH_CFG

config INPUT_RENESAS_RA_CTSU_NUM_SELF_ELEMENTS
	int "Number of self-capacitance elements"
	default 0
	help
	  Number of self-capacitance elements in the CTSU.

config INPUT_RENESAS_RA_CTSU_NUM_MUTUAL_ELEMENTS
	int "Number of mutual-capacitance elements"
	default 0
	help
	  Number of mutual-capacitance elements in the CTSU.

choice INPUT_RENESAS_RA_CTSU_CHATTERING_SUPPRESSION_TYPE
	prompt "Type of chattering suppression"
	default INPUT_RENESAS_RA_CTSU_CHATTERING_SUPPRESSION_TYPE_A

config INPUT_RENESAS_RA_CTSU_CHATTERING_SUPPRESSION_TYPE_A
	bool "Counter of exceed threshold is hold within hysteresis range"
	help
	  Counter of exceed threshold is hold within hysteresis range.

config INPUT_RENESAS_RA_CTSU_CHATTERING_SUPPRESSION_TYPE_B
	bool "Counter of exceed threshold is reset within hysteresis range"
	help
	  Counter of exceed threshold is reset within hysteresis range.

endchoice # INPUT_RENESAS_RA_CTSU_CHATTERING_SUPPRESSION_TYPE

endif # !INPUT_RENESAS_RA_QE_TOUCH_CFG

config INPUT_RENESAS_RA_CTSU_POLLING_INTERVAL_MS
	int "CTSU debounce interval time"
	range 20 500
	default 100
	help
	  Debouncing interval time in milliseconds.

config INPUT_RENESAS_RA_CTSU_STABILIZATION_TIME_US
	int "CTSU stabilization time"
	default 20
	help
	  Stabilization time required to wait between 2 scans in microseconds.

config INPUT_RENESAS_RA_CTSU_DRV_STACK_SIZE
	int "CTSU internal thread stack size"
	default 512
	help
	  CTSU driver internal thread stack size.

config INPUT_RENESAS_RA_CTSU_DRV_PRIORITY
	int "CTSU internal thread priority"
	default 8
	help
	  CTSU driver internal thread priority.

config INPUT_RENESAS_RA_CTSU_MSG_MEM_BLOCK_SIZE
	int "CTSU internal sys_mem_blocks allocator size"
	default 10
	help
	  CTSU driver internal sys_mem_blocks allocator maximum num blocks.

endif # INPUT_RENESAS_RA_CTSU
```

## drivers/input/Kconfig.renesas_rx
```kconfig
# Copyright (c) 2025 Renesas Electronics Corporation
# SPDX-License-Identifier: Apache-2.0

config INPUT_RENESAS_RX_CTSU
	bool "Renesas Capacitive Touch Sensing Unit"
	default y
	depends on DT_HAS_RENESAS_RX_CTSU_ENABLED
	select USE_RX_RDP_CTSU
	select PINCTRL
	help
	  Enable RX series CTSU driver

if INPUT_RENESAS_RX_CTSU

config INPUT_RENESAS_RX_QE_TOUCH_CFG
	bool "Using QE Touch Workflow to config this driver"
	help
	  If this config was enabled, setting for CTSU and Cap
	  Touch driver will be reflected the setting that generated
	  from QE Touch Workflow.
	  Please add the generated C source files into the app CMakeLists
	  to make the driver can using it.

config INPUT_RENESAS_RX_CTSU_SCAN_INTERVAL_MS
	int "CTSU channels scan interval"
	default 5
	help
	  Interval time (milliseconds) between two scans.

if !INPUT_RENESAS_RX_QE_TOUCH_CFG

config INPUT_RENESAS_RX_CTSU_ON_FREQ
	int "CTSU On Frequency"
	default 3
	help
	  Number of Debouncing count of touch-on filtering

config INPUT_RENESAS_RX_CTSU_OFF_FREQ
	int "CTSU Off Frequency"
	default 3
	help
	  Number of Debouncing count of touch-off filtering

config INPUT_RENESAS_RX_CTSU_DRIFT_FREQ
	int "CTSU drift frequency"
	default 255
	help
	  Sample count for drift correction (0 mean no use).

config INPUT_RENESAS_RX_CTSU_CANCEL_FREQ
	int "CTSU Cancel Frequency"
	default 0
	help
	  Continuous Touch Cancel Count (0 mean no use).

config INPUT_RENESAS_RX_CTSU_NUM_MOVING_AVERAGE
	int "CTSU Moving average"
	default 4
	help
	  Number of moving average for measurement data

config INPUT_RENESAS_RX_CTSU_POWER_SUPPLY_CAPACITY
	int "CTSU Power supply capacity"
	default 0
	range 0 1
	help
	  Power Supply Capacity Adjustment
	  - 0: Normal (40uA)
	  - 1: High-current output (80uA)

config INPUT_RENESAS_RX_CTSU_TRANSMISSION_POWER_SUPPLY
	int "CTSU transmission power supply"
	default 0
	range 0 1
	help
	  Transmission Power Supply Select
	  - 0: VCC selected
	  - 1: Internal logic power supply selected

config INPUT_RENESAS_RX_CTSU_PCLK_DIVISION
	int "CTSU: Division of PCLK"
	default 0
	range 0 2
	help
	  Division of PCLK
	  - 0: PCLK/1
	  - 1: PCLK/2
	  - 2: PCLK/4

endif #!INPUT_RENESAS_RX_QE_TOUCH_CFG

endif #INPUT_CTSU
```

## drivers/input/Kconfig.rts5912
```kconfig
# Copyright (c) 2025 Realtek Corporation.
# SPDX-License-Identifier: Apache-2.0

config INPUT_REALTEK_RTS5912_KBD
	bool "Realtek RTS5912 keyboard scanning driver"
	default y
	depends on DT_HAS_REALTEK_RTS5912_KBD_ENABLED
	select INPUT_KBD_MATRIX
	help
	  This option enables the Realtek keyboard scan driver.
```

## drivers/input/Kconfig.sbus
```kconfig
# Copyright (c) 2024 NXP Semiconductors
# SPDX-License-Identifier: Apache-2.0

config INPUT_SBUS
	bool "SBUS driver"
	default y
	depends on DT_HAS_FUTABA_SBUS_ENABLED
	depends on UART_INTERRUPT_DRIVEN
	select UART_USE_RUNTIME_CONFIGURE
	help
	  Enable driver for SBUS Remote controller.

if INPUT_SBUS

config INPUT_SBUS_THREAD_STACK_SIZE
	int "Stack size for the sbus thread"
	default 1024
	help
	  Size of the stack used for the sbus thread.

config INPUT_SBUS_THREAD_PRIORITY
	int "Priority for the sbus thread"
	default 0
	help
	  Priority level of the sbus thread.

config INPUT_SBUS_REPORT_FILTER
	int "Minimal change in signal to report"
	default 1
	help
	  SBUS tends to be a bit noisy you can increase the threshold to
	  lower the amounts of input events. Set to 0 for no filtering

config INPUT_SBUS_SEND_SYNC
	bool "Send Sync to input subsys on each SBUS frame"
	default y
	help
	  Sends sync message to input subsys with sync bit.

config INPUT_SBUS_CHANNEL_VALUE_ONE
	int "Threshold value > for INPUT_EV_KEY value 1"
	default 1800
	help
	  SBUS sends analogue values for digital switches. This config value
	  sets the threshold to interperted the analogue value as an logic 1

config INPUT_SBUS_CHANNEL_VALUE_ZERO
	int "Threshold value < for INPUT_EV_KEY value 0"
	default 1200
	help
	  SBUS sends analogue values for digital switches. This config value
	  sets the threshold to interperted the analogue value as an logic 0

endif # INPUT_SBUS
```

## drivers/input/Kconfig.sdl
```kconfig
# Copyright (c) 2020 Jabil Inc.
# SPDX-License-Identifier: Apache-2.0

config INPUT_SDL_TOUCH
	bool "SDL event filter for touch panel emulation"
	default y
	depends on DT_HAS_ZEPHYR_INPUT_SDL_TOUCH_ENABLED
	depends on HAS_SDL
	help
	  Enable driver for the SDL mouse event filter.
```

## drivers/input/Kconfig.stmpe811
```kconfig
# Copyright (c) 2023 Antmicro <www.antmicro.com>
# SPDX-License-Identifier: Apache-2.0

config INPUT_STMPE811
	bool "STMPE811 touch driver"
	default y
	depends on DT_HAS_ST_STMPE811_ENABLED
	select I2C
	select INPUT_TOUCH
	help
	  Enable driver for STMPE811 touch panel.
```

## drivers/input/Kconfig.tma525b
```kconfig
# Copyright (c) 2025 NXP
# SPDX-License-Identifier: Apache-2.0

menuconfig INPUT_TMA525B
	bool "TMA525B capacitive touch controller"
	default y
	depends on DT_HAS_PARADE_TMA525B_ENABLED
	select I2C
	select INPUT_TOUCH
	help
	  Enable support for Parade Tech TMA525B capacitive touch controller.

if INPUT_TMA525B

config INPUT_TMA525B_INTERRUPT
	bool "Interrupt mode"
	default y if $(dt_compat_any_has_prop,$(DT_COMPAT_PARADE_TMA525B),int-gpios)
	help
	  Enable interrupt mode for TMA525B touch controller. If disabled,
	  the driver will use polling mode.

config INPUT_TMA525B_PERIOD_MS
	int "Polling period (ms)"
	default 10
	depends on !INPUT_TMA525B_INTERRUPT
	help
	  Polling period in milliseconds when the controller is in polling mode.

config INPUT_TMA525B_MAX_TOUCH_POINTS
	int "Maximum number of touch points"
	default 1
	range 1 4
	help
	  Maximum number of touch points supported by the controller.

config INPUT_TMA525B_RETRY_TIMES
	int "Retry times for controller to enter application mode"
	default 10
	help
	  Retry times for controller to enter application mode after power up.

endif # INPUT_TMA525B
```

## drivers/input/Kconfig.touch
```kconfig
# Copyright (c) 2024 Antmicro Ltd <www.antmicro.com>
# SPDX-License-Identifier: Apache-2.0

config INPUT_TOUCH
	bool
	help
	  Enable library used for touchscreen drivers.

config INPUT_TOUCHSCREEN_COMMON_CALIBRATION
	bool "Enable touchscreen calibration support"
	default n
	help
	  Enable raw coordinate calibration (raw_x_min/max, raw_y_min/max).
```

## drivers/input/Kconfig.tsc2007
```kconfig
#Copyright(c) 2026, Institute of Embedded Systems ZHAW
# SPDX-License-Identifier: Apache-2.0

config INPUT_TSC2007
	bool "TSC2007 touch panel driver"
	default y
	depends on DT_HAS_TI_TSC2007_ENABLED
	select I2C
	select INPUT_TOUCH
	select INPUT_TOUCHSCREEN_COMMON_CALIBRATION
	depends on GPIO
	help
	  Enable driver for TSC2007 touch panel controller.
```

## drivers/input/Kconfig.tsc_keys
```kconfig
# Copyright (c) 2024 Arif Balik <arifbalik@outlook.com>
# SPDX-License-Identifier: Apache-2.0

config INPUT_STM32_TSC_KEYS
	bool "STM32 TSC touch library"
	default y
	depends on DT_HAS_ST_STM32_TSC_ENABLED
	select RING_BUFFER
	help
	  Enable support for STM32 TSC touch library.

config INPUT_STM32_TSC_KEYS_BUFFER_WORD_SIZE
	int "STM32 TSC touch buffer size in words"
	default 10
	depends on INPUT_STM32_TSC_KEYS
	help
	  Size of the ring buffer for the STM32 TSC touch library. The size of this
	  buffer together with the sampling-interval property in the tsc-keys
	  device tree node determines the time window of interest. A slope value is
	  calculated between the oldest and the newest value in the buffer to
	  generate a press or release input event.
```

## drivers/input/Kconfig.vs1838b
```kconfig
# Copyright (c) 2025 Bastien Jauny <bastien.jauny@smile.fr>
# SPDX-License-Identifier: Apache-2.0

config INPUT_VS1838B
	bool "Vishay VS1838B infrared receiver"
	default y
	depends on DT_HAS_VISHAY_VS1838B_ENABLED
	select GPIO
	help
	  This option enables the driver for the VS1838B infrared receiver.
```

## drivers/input/Kconfig.xec
```kconfig
# Microchip XEC Keyboard Scan Matrix configuration options

# Copyright (c) 2019 Intel Corporation
# SPDX-License-Identifier: Apache-2.0

config INPUT_XEC_KBD
	bool "Microchip XEC series keyboard matrix driver"
	default y
	depends on DT_HAS_MICROCHIP_XEC_KBD_ENABLED
	select INPUT_KBD_MATRIX
	select MULTITHREADING
	select PINCTRL
	help
	  Enable the Microchip XEC Kscan IO driver.
```

## drivers/input/keyboard/Kconfig
```kconfig
# Input keyboard configuration options

# Copyright (c) 2022 tangchunhui2022@gmail.com
# SPDX-License-Identifier: Apache-2.0

menuconfig KEYBOARD
	bool "Keyboard Drivers"
	depends on INPUT
	help
	  Include keyboard drivers in system config.

if KEYBOARD

config KEYBOARD_EVENT_MAX_NUMBERS
	int "Keyboard event max numbers"
	default 20

source "drivers/input/keyboard/Kconfig.gpio"

endif # KEYBOARD
```

## drivers/input/keyboard/Kconfig.gpio
```kconfig
# Input keyboard configuration options

# Copyright (c) 2022, tangchunhui@coros.com
# SPDX-License-Identifier: Apache-2.0

menuconfig KEYBOARD_GPIO
	bool "Keyboard GPIO Drivers"
	help
	  Include keyboard gpio drivers in system config.

if KEYBOARD_GPIO

config KEYBOARD_GPIO_SCAN_INTERVAL
	int "scan interval"
	default 10

config KEYBOARD_GPIO_TIME_DEBOUNCE
	int "debounce time"
	default 30

config KEYBOARD_GPIO_TIME_LONGPRESS
	int "long press time"
	default 0

config KEYBOARD_GPIO_TIME_HOLDPRESS
	int "hold press time"
	default 0

endif # KEYBOARD_GPIO
```

## drivers/intc/Kconfig
```kconfig
# Copyright (c) 2023 Bjarki Arge Andreasen
# SPDX-License-Identifier: Apache-2.0

menuconfig INTC
	bool "Interrupt controller (INTC) device drivers"
	select SYS_IRQ

if INTC

rsource "intc_arm_v8m_nvic/Kconfig"
rsource "intc_nrf_clic/Kconfig"

endif # INTC
```

## drivers/intc/intc_arm_v7m_nvic/Kconfig
```kconfig
# Copyright (c) 2024 Nordic Semiconductor
# SPDX-License-Identifier: Apache-2.0

config INTC_ARM_V7M_NVIC
	bool "Arm V7M Nested Vector Interrupt Controller"
	default y
	depends on DT_HAS_ARM_V7M_NVIC_ENABLED
```

## drivers/intc/intc_arm_v8m_nvic/Kconfig
```kconfig
# Copyright (c) 2023 Bjarki Arge Andreasen
# SPDX-License-Identifier: Apache-2.0

config INTC_ARM_V8M_NVIC
	bool "Arm V8M Nested Vector Interrupt Controller"
	default y
	depends on DT_HAS_ARM_V8M_NVIC_ENABLED
```

## drivers/intc/intc_nrf_clic/Kconfig
```kconfig
# Copyright (c) 2025 Nordic Semiconductor ASA
# SPDX-License-Identifier: Apache-2.0

config INTC_NRF_CLIC
	bool "Nordic nRF CPU Local Interrupt Controller"
	default y
	depends on DT_HAS_NORDIC_NRF_CLIC_ENABLED
	select USE_ISR_WRAPPER
	select RISCV_SOC_HAS_CUSTOM_ISR_PREP
```
