## drivers/input/Kconfig.ch9350l
```kconfig
# Copyright (c) 2026 MASSDRIVER EI (massdriver.space)
# SPDX-License-Identifier: Apache-2.0

config INPUT_CH9350L
	bool "WinChipHead CH9350L USB HID to UART control chip"
	default y
	depends on DT_HAS_WCH_CH9350L_ENABLED
	depends on SERIAL_SUPPORT_INTERRUPT
	select UART
	select UART_INTERRUPT_DRIVEN
	help
	  This option enables the driver for WinChipHead CH9350L USB HID to UART control chips.

if INPUT_CH9350L

config INPUT_CH9350L_FRAME_COUNT
	int "Number of frames allocatable"
	range 1 128
	default 2
	help
	  Number of input frames queueable at once.

endif # INPUT_CH9350L
```

## drivers/input/Kconfig.chsc5x
```kconfig
# Copyright (c) 2025 Basalte bv
# SPDX-License-Identifier: Apache-2.0

config INPUT_CHSC5X
	bool "CHSC5X capacitive touch panel driver"
	default y
	depends on DT_HAS_CHIPSEMI_CHSC5X_ENABLED
	select GPIO
	select I2C
	select INPUT_TOUCH
	help
	  Enable CHSC5X driver for Chipsemi capacitive touch panel controller.

config INPUT_CHSC5X_VERIFY_IC_TYPE
	bool "IC type verification"
	default y
	depends on INPUT_CHSC5X
	help
	  This option enables the verification of the IC type which implies an
	  additional delay of 100ms during initialization.
```

## drivers/input/Kconfig.chsc6x
```kconfig
# Copyright (c) 2024 Nicolas Goualard <nicolas.goualard@sfr.fr>
# SPDX-License-Identifier: Apache-2.0

config INPUT_CHSC6X
	bool "Use CHSC6X capacitive touch panel driver"
	default y
	depends on DT_HAS_CHIPSEMI_CHSC6X_ENABLED
	select GPIO
	select I2C
	help
	  Enable out of tree driver for CHSC6X touch panel.
```

## drivers/input/Kconfig.crsf
```kconfig
# Copyright (c) 2026 NXP Semiconductors
# SPDX-License-Identifier: Apache-2.0

config INPUT_CRSF
	bool "CRSF driver"
	default y
	depends on DT_HAS_TBS_CRSF_ENABLED
	depends on UART_INTERRUPT_DRIVEN
	select CRC
	select UART_USE_RUNTIME_CONFIGURE
	help
	  Enable driver for CRSF Remote controller.

if INPUT_CRSF

config INPUT_CRSF_THREAD_STACK_SIZE
	int "Stack size for the crsf thread"
	default 1024
	help
	  Size of the stack used for the crsf thread.

config INPUT_CRSF_THREAD_PRIORITY
	int "Priority for the crsf thread"
	default 0
	help
	  Priority level of the crsf thread.

config INPUT_CRSF_REPORT_FILTER
	int "Minimal change in signal to report"
	default 1
	help
	  CRSF tends to be a bit noisy you can increase the threshold to
	  lower the amounts of input events. Set to 0 for no filtering

config INPUT_CRSF_SEND_SYNC
	bool "Send Sync to input subsys on each CRSF frame"
	default y
	help
	  Sends sync message to input subsys with sync bit.

config INPUT_CRSF_CHANNEL_VALUE_ONE
	int "Threshold value > for INPUT_EV_KEY value 1"
	default 1800
	help
	  CRSF sends analogue values for digital switches. This config value
	  sets the threshold to interpret the analogue value as a logic 1

config INPUT_CRSF_CHANNEL_VALUE_ZERO
	int "Threshold value < for INPUT_EV_KEY value 0"
	default 1200
	help
	  CRSF sends analogue values for digital switches. This config value
	  sets the threshold to interpret the analogue value as a logic 0

DT_CHOSEN_Z_DTCM := zephyr,dtcm

config INPUT_CRSF_USE_DTCM_FOR_DMA_BUFFER
	bool "Use DTCM for hardware DMA buffers"
	depends on $(dt_chosen_enabled,$(DT_CHOSEN_Z_DTCM))
	help
	  Place the hardware DMA buffers into DTCM for lower
	  latency.

endif # INPUT_CRSF
```

## drivers/input/Kconfig.cst816s
```kconfig
# Copyright (c) 2020 Qingsong Gou <gouqs@hotmail.com>
# SPDX-License-Identifier: Apache-2.0

menuconfig INPUT_CST816S
	bool "CST816S capacitive touch panel driver"
	default y
	depends on DT_HAS_HYNITRON_CST816S_ENABLED
	select I2C
	help
	  Enable driver for hynitron cst816s touch panel.

if INPUT_CST816S

config INPUT_CST816S_PERIOD
	int "Sample period"
	depends on !INPUT_CST816S_INTERRUPT
	default 20
	help
	  Sample period in milliseconds when in polling mode.

config INPUT_CST816S_INTERRUPT
	bool "Interrupt support"
	default y
	depends on GPIO
	help
	  Enable interrupt support (requires GPIO).

config INPUT_CST816S_EV_DEVICE
	bool "Device specific event support"
	help
	  Enable device specific event support.

endif # INPUT_CST816S
```

## drivers/input/Kconfig.cst8xx
```kconfig
# Copyright (c) 2020 Qingsong Gou <gouqs@hotmail.com>
# SPDX-License-Identifier: Apache-2.0

menuconfig INPUT_CST8XX
	bool "CST8XX capacitive touch panel driver"
	default y
	depends on DT_HAS_HYNITRON_CST8XX_ENABLED
	select I2C
	help
	  Enable driver for hynitron cst8xx touch panel.

if INPUT_CST8XX

config INPUT_CST8XX_PERIOD
	int "Sample period"
	depends on !INPUT_CST8XX_INTERRUPT
	default 20
	help
	  Sample period in milliseconds when in polling mode.

config INPUT_CST8XX_INTERRUPT
	bool "Interrupt support"
	default y if $(dt_compat_any_has_prop,$(DT_COMPAT_HYNITRON_CST8XX),irq-gpios)
	depends on GPIO
	help
	  Enable interrupt support (requires GPIO).

config INPUT_CST8XX_EV_DEVICE
	bool "Device specific event support"
	help
	  Enable device specific event support.

endif # INPUT_CST8XX
```

## drivers/input/Kconfig.cy8cmbr3xxx
```kconfig
# Copyright (c) 2025 Basalte bv
# SPDX-License-Identifier: Apache-2.0

config INPUT_CY8CMBR3XXX
	bool "CY8CMBR3XXX capacitive touch sensor driver"
	default y
	depends on DT_HAS_CYPRESS_CY8CMBR3XXX_ENABLED
	select I2C
	help
	  Enable driver for cypress CY8CMBR3XXX capacitive
	  touch sensor.
```

## drivers/input/Kconfig.ene
```kconfig
# Copyright (c) 2026 ENE Technology Inc.
# SPDX-License-Identifier: Apache-2.0

config INPUT_ENE_KB106X_KBD
	bool "ENE kb106x keyboard matrix driver"
	default y
	depends on DT_HAS_ENE_KB106X_KBD_ENABLED
	select INPUT_KBD_MATRIX
	select PINCTRL
	help
	  Enable the ENE kb106x keyboard scan driver.
```

## drivers/input/Kconfig.esp32
```kconfig
# Copyright (c) 2023 Espressif Systems (Shanghai) Co., Ltd.
# SPDX-License-Identifier: Apache-2.0

config INPUT_ESP32_TOUCH_SENSOR
	bool "Espressif Touch Sensor input driver"
	default n
	depends on DT_HAS_ESPRESSIF_ESP32_TOUCH_ENABLED
	help
	  Enable support for Espressif Touch Sensor input driver.
```

## drivers/input/Kconfig.evdev
```kconfig
# Copyright 2023 Google LLC
# SPDX-License-Identifier: Apache-2.0

config NATIVE_LINUX_EVDEV
	bool "Native Linux evdev based input device"
	default y
	depends on DT_HAS_ZEPHYR_NATIVE_LINUX_EVDEV_ENABLED
	depends on ARCH_POSIX
	depends on MULTITHREADING
	help
	  Enable reading input from a Linux evdev device, requires specifying
	  an evdev device path in the --evdev command line argument.

if NATIVE_LINUX_EVDEV

config NATIVE_LINUX_EVDEV_THREAD_PRIORITY
	int "Priority for the Linux evdev thread"
	default 0
	help
	  Priority level of the internal thread handling Linux input events.

config NATIVE_LINUX_THREAD_SLEEP_MS
	int "Sleep period for the Linux evdev thread"
	default 10
	help
	  How long to sleep between checking for new events in the Linux input
	  events thread.

endif
```

## drivers/input/Kconfig.ft5336
```kconfig
# Copyright (c) 2020 NXP
# Copyright (c) 2020 Teslabs Engineering S.L.
# SPDX-License-Identifier: Apache-2.0

menuconfig INPUT_FT5336
	bool "FT5XX6/FT6XX6 capacitive touch panel driver"
	default y
	depends on DT_HAS_FOCALTECH_FT5336_ENABLED
	select I2C
	help
	  Enable driver for multiple Focaltech capacitive touch panel
	  controllers. This driver should support FT5x06, FT5606, FT5x16,
	  FT6x06, Ft6x36, FT5x06i, FT5336, FT3316, FT5436i, FT5336i and FT5x46.

if INPUT_FT5336

config INPUT_FT5336_PERIOD
	int "Sample period"
	depends on !INPUT_FT5336_INTERRUPT
	default 10
	help
	  Sample period in milliseconds when in polling mode.

config INPUT_FT5336_INTERRUPT
	bool "Interrupt"
	help
	  Enable interrupt support (requires GPIO).

endif # INPUT_FT5336
```

## drivers/input/Kconfig.ft6146
```kconfig
# Copyright (c) 2025 Qingsong Gou <gouqs@hotmail.com>
# SPDX-License-Identifier: Apache-2.0

menuconfig INPUT_FT6146
	bool "FT6146 touch controller"
	default y
	depends on DT_HAS_FOCALTECH_FT6146_ENABLED
	select I2C
	select INPUT_TOUCH
	help
	  Enable driver for FT6146 capacitive touch controller.

if INPUT_FT6146

config INPUT_FT6146_PERIOD
	int "Sample period"
	depends on !INPUT_FT6146_INTERRUPT
	default 10
	help
	  Sample period in milliseconds when in polling mode.

config INPUT_FT6146_INTERRUPT
	bool "FT6146 interrupt support"
	default y if $(dt_compat_any_has_prop,$(DT_COMPAT_FOCALTECH_FT6146),int-gpios)
	help
	  Enable interrupt support for the FT6146 touch controller.

endif # INPUT_FT6146
```

## drivers/input/Kconfig.gpio_kbd_matrix
```kconfig
# Copyright 2023 Google LLC
# SPDX-License-Identifier: Apache-2.0

config INPUT_GPIO_KBD_MATRIX
	bool "GPIO based keyboard matrix input driver"
	default y
	depends on DT_HAS_GPIO_KBD_MATRIX_ENABLED
	select INPUT_KBD_MATRIX
	help
	  GPIO keyboard matrix input driver.
```

## drivers/input/Kconfig.gpio_keys
```kconfig
# Copyright (c) 2022 Google LLC
# SPDX-License-Identifier: Apache-2.0

config INPUT_GPIO_KEYS
	bool "GPIO Keys input driver"
	default y
	depends on DT_HAS_GPIO_KEYS_ENABLED
	depends on GPIO
	help
	  Enable support for GPIO Keys input driver.
```

## drivers/input/Kconfig.gpio_qdec
```kconfig
# Copyright 2023 Google LLC
# SPDX-License-Identifier: Apache-2.0

config INPUT_GPIO_QDEC
	bool "GPIO based QDEC input driver"
	default y
	depends on DT_HAS_GPIO_QDEC_ENABLED
	help
	  GPIO Quadrature Decoder input driver.
```

## drivers/input/Kconfig.gt911
```kconfig
# Copyright (c) 2020 NXP
# Copyright (c) 2020 Teslabs Engineering S.L.
# SPDX-License-Identifier: Apache-2.0

menuconfig INPUT_GT911
	bool "GT9xx / GT9xxx capacitive touch panel driver"
	default y
	depends on DT_HAS_GOODIX_GT911_ENABLED
	select I2C
	help
	  Enable driver for multiple Goodix capacitive touch panel controllers.
	  This driver should support gt9110, gt912, gt927, gt9271, gt928,
	  gt967.

if INPUT_GT911

config INPUT_GT911_PERIOD_MS
	int "Sample period"
	depends on !INPUT_GT911_INTERRUPT
	default 10
	help
	  Sample period in milliseconds when in polling mode.

config INPUT_GT911_INTERRUPT
	bool "Interrupt"
	help
	  Enable interrupt support (requires GPIO).

config INPUT_GT911_MAX_TOUCH_POINTS
	int "Touch Number"
	default 1
	range 1 5
	help
	  Maximum number of touch points to be handled.
	  Multitouch is ignored if equal to 1.
endif # INPUT_GT911
```

## drivers/input/Kconfig.ili2132a
```kconfig
# Copyright (c) 2024 Joel Jaldemark
# SPDX-License-Identifier: Apache-2.0

config INPUT_ILI2132A
	bool "ILI2132A capacitive touch controller driver"
	default y
	depends on DT_HAS_ILITEK_ILI2132A_ENABLED
	select I2C
	help
	  Enable driver for ilitek ili2132a touch controller
```

## drivers/input/Kconfig.it51xxx
```kconfig
# Copyright (c) 2025 ITE Corporation. All Rights Reserved.
# SPDX-License-Identifier: Apache-2.0

config INPUT_ITE_IT51XXX_KBD
	bool "ITE keyboard scanning driver"
	default y
	depends on DT_HAS_ITE_IT51XXX_KBD_ENABLED
	select INPUT_KBD_MATRIX
	select PINCTRL
	help
	  This option enables the ITE keyboard scan driver.
```

## drivers/input/Kconfig.it8801
```kconfig
# Copyright (c) 2024 ITE Corporation. All Rights Reserved.
# SPDX-License-Identifier: Apache-2.0

config INPUT_ITE_IT8801_KBD
	bool "ITE IT8801 keyboard matrix scan controller"
	default y
	depends on DT_HAS_ITE_IT8801_KBD_ENABLED
	select I2C
	select INPUT_KBD_MATRIX
	select MFD
	help
	  Enable driver for ITE IT8801 I2C-based keyboard matrix scan.
	  IT8801 support 8 KSI pins and 19 KSO pins [22:11] [6:0],
	  KSO[22:18]can be configured to GPIO mode.
```

## drivers/input/Kconfig.it8xxx2
```kconfig
# Copyright (c) 2021 ITE Corporation. All Rights Reserved.
# SPDX-License-Identifier: Apache-2.0

config INPUT_ITE_IT8XXX2_KBD
	bool "ITE keyboard scanning driver"
	default y
	depends on DT_HAS_ITE_IT8XXX2_KBD_ENABLED
	select INPUT_KBD_MATRIX
	help
	  This option enables the ITE keyboard scan driver.
```

## drivers/input/Kconfig.kbd_matrix
```kconfig
# Copyright 2023 Google LLC
# SPDX-License-Identifier: Apache-2.0

config INPUT_KBD_MATRIX
	bool
	depends on MULTITHREADING
	help
	  Enable library used for keyboard matrix drivers.

if INPUT_KBD_MATRIX

config INPUT_KBD_MATRIX_THREAD_STACK_SIZE
	int "Stack size for the keyboard matrix thread"
	default 1024
	help
	  Size of the stack used for the keyboard matrix thread.


config INPUT_KBD_MATRIX_THREAD_PRIORITY
	int "Priority for the keyboard matrix thread"
	default 0
	help
	  Priority level of the keyboard matrix thread.

config INPUT_KBD_MATRIX_16_BIT_ROW
	bool "16 bit row size support"
	help
	  Use a 16 bit type for the internal structure, allow using a matrix
	  with up to 16 rows if the driver supports it.

config INPUT_KBD_ACTUAL_KEY_MASK_DYNAMIC
	bool "Allow runtime changes to the actual key mask"
	help
	  If enabled, the actual-key-mask devicetree property data is stored in
	  RAM, and a input_kbd_matrix_actual_key_mask_set() function is
	  available to change the content at runtime.

config INPUT_SHELL_KBD_MATRIX_STATE
	bool "Input kbd_matrix_state shell command"
	depends on INPUT_SHELL
	help
	  Enable an input kbd_matrix_state shell command to log the state of a
	  keyboard matrix device.

config INPUT_SHELL_KBD_MATRIX_STATE_MAX_COLS
	int "Maximum column count for the kbd_matrix_state command"
	default 32
	depends on INPUT_SHELL_KBD_MATRIX_STATE
	help
	  Maximum column count for a device processed by the input
	  kbd_matrix_state shell command.

config INPUT_KBD_DRIVE_COLUMN_HOOK
	bool
	help
	  Call an application specific hook after the driver specific
	  drive_column implementation. The application must implement the
	  input_kbd_matrix_drive_column_hook function.

endif # INPUT_KBD_MATRIX
```

## drivers/input/Kconfig.mcux_gpt_ppm
```kconfig
# NPCX Keyboard scan driver configuration options

# Copyright (c) 2023 NXP Semiconductors
# SPDX-License-Identifier: Apache-2.0

menuconfig INPUT_MCUX_GPT_PPM
	bool "MCUX GPT PPM input driver"
	default y
	depends on DT_HAS_NXP_GPT_PPM_INPUT_ENABLED
	select MULTITHREADING
	help
	  This option enables the keyboard scan driver for NPCX family of
	  processors.

if INPUT_MCUX_GPT_PPM

config INPUT_MCUX_GPT_PPM_THREAD_STACK_SIZE
	int "Stack size for the ppm thread"
	default 1024
	help
	  Size of the stack used for the ppm thread.

config INPUT_MCUX_GPT_INPUT_REPORT_FILTER
	int "Minimal change in signal to report"
	default 1
	help
	  PPM tends to be a bit noisy you can increase the threshold to
	  to lower the amounts of input events. Set to 0 for no filtering

endif # INPUT_MCUX_GPT_PPM
```

## drivers/input/Kconfig.mcux_kpp
```kconfig
# Copyright 2025 NXP
# SPDX-License-Identifier: Apache-2.0

config INPUT_MCUX_KPP
	bool "KPP driver"
	default y
	depends on DT_HAS_NXP_MCUX_KPP_ENABLED
	help
	  Enable the driver of keypad port.

config INPUT_KPP_PERIOD_MS
	int "Sample period"
	default 10
	depends on INPUT_MCUX_KPP
	help
	  Sample period in milliseconds when the key is pressed.
```

## drivers/input/Kconfig.mcux_tsi
```kconfig
# Copyright 2026 NXP
# SPDX-License-Identifier: Apache-2.0

config INPUT_MCUX_TSI
	bool "NXP MCUX TSI input driver"
	default y
	depends on DT_HAS_NXP_TSI_INPUT_ENABLED
	help
	  Enable input driver for NXP MCUX TSI (Touch Sensing Input).
	  This driver reports touch events through the input subsystem.
```

## drivers/input/Kconfig.modulino
```kconfig
# Copyright (c) 2025 Google, LLC
# SPDX-License-Identifier: Apache-2.0

config INPUT_MODULINO_BUTTONS
	bool "Arduino Modulino buttons"
	default y
	depends on DT_HAS_ARDUINO_MODULINO_BUTTONS_ENABLED
	select I2C
	help
	  Enable driver Arduino Modulino Buttons.
```
