## drivers/w1/Kconfig.ds2484
```kconfig
# Copyright (c) 2022, Caspar Friedrich <c.s.w.friedrich@gmail.com>
# SPDX-License-Identifier: Apache-2.0

config W1_DS2484
	bool "DS2484 Single-Channel 1-Wire Master"
	select I2C
	depends on DT_HAS_MAXIM_DS2484_ENABLED
	default y
```

## drivers/w1/Kconfig.gpio
```kconfig
#
# Copyright (c) 2018 Roman Tataurov <diytronic@yandex.ru>
#
# SPDX-License-Identifier: Apache-2.0
#

config W1_GPIO
	bool "GPIO bit banging 1-Wire support"
	depends on W1
	select W1_MASTER_GPIO
	default n
	help
	  Enable software driven (bit banging) 1-Wire support using GPIO pins

# ---------- Port 0 ----------

config W1_GPIO_0
	bool "Enable GPIO 1-Wire device 0"
	default n
	depends on W1_GPIO
	help
	  This tells the driver to configure the 1-Wire device at boot, depending
	  on the additional configuration options below.

config W1_GPIO_0_NAME
	string "GPIO Bit Bang 1-Wire device 0 device name"
	default "W1_0"
	depends on W1_GPIO_0
	help
	  This is the device name for the 1-Wire device, and is included in the
	  device struct.

config W1_GPIO_0_GPIO
	string "Bit Bang 1-Wire device 0 GPIO name"
	default "GPIO_0"
	depends on W1_GPIO_0
	help
	  This is the name of the GPIO device that controls the 1-Wire lines.

config W1_GPIO_0_DQ_PIN
	int "Bit Bang 1-Wire device 0 GPIO pin number for DQ"
	depends on W1_GPIO_0
	help
	  This is the GPIO pin number for the W1 DQ line
```

## drivers/w1/Kconfig.max32
```kconfig
# Copyright (c) 2023-2024 Analog Devices, Inc.
# SPDX-License-Identifier: Apache-2.0

config W1_MAX32
	bool "MAX32xxx MCUs 1-Wire master driver"
	default y
	depends on DT_HAS_ADI_MAX32_W1_ENABLED
	select PINCTRL
	help
	  This option enables the 1-Wire master driver for MAX32xxx MCUs
```

## drivers/w1/Kconfig.test
```kconfig
# Copyright (c) 2022, Thomas Stranger
# SPDX-License-Identifier: Apache-2.0

# Hidden option to enable the vnd,w1 1-Wire host driver used in testing.
config W1_TEST
	def_bool DT_HAS_VND_W1_ENABLED
	depends on DT_HAS_VND_W1_ENABLED
```

## drivers/w1/Kconfig.zephyr_gpio
```kconfig
# Configuration options for the Zephyr GPIO 1-Wire Master driver

# Copyright (c) 2023 Hudson C. Dalpra
# SPDX-License-Identifier: Apache-2.0

config W1_ZEPHYR_GPIO
	bool "1-wire GPIO"
	default y
	depends on DT_HAS_ZEPHYR_W1_GPIO_ENABLED
	help
	  This option enables the Zephyr GPIO 1-Wire master driver.

	  The bus reset, and bit read and write operations are executed
	  via byte read and write operations on top of the Zephyr
	  GPIO driver interface.

if W1_ZEPHYR_GPIO

config W1_ZEPHYR_GPIO_TIME_CRITICAL
	bool "Force time critical operations"
	default y
	help
	  This option forces the 1-Wire GPIO driver to use time critical
	  operations for bus reset, and bit read and write operations.
	  Time critical communications operations are not interrupted while
	  being generated.

endif # W1_ZEPHYR_GPIO
```

## drivers/w1/Kconfig.zephyr_serial
```kconfig
# Configuration options for the Zephyr serial 1-Wire Master driver

# Copyright (c) 2022 Thomas Stranger
# SPDX-License-Identifier: Apache-2.0

config W1_ZEPHYR_SERIAL
	bool "1-wire Serial"
	select SERIAL
	default y
	depends on DT_HAS_ZEPHYR_W1_SERIAL_ENABLED
	help
	  This option enables the Zephyr serial 1-Wire master driver.

	  The bus reset, and bit read and write operations are executed
	  via bytes read and write operations on top of the Zephyr
	  serial driver interface.

if W1_ZEPHYR_SERIAL

config W1_ZEPHYR_SERIAL_BIT_TIMEOUT
	int "Bit read timeout in us"
	default 380
	help
	  The bit read timeout specifies how long the driver tries to read the
	  uart byte (1-wire standard speed data bit).
	  For serial drivers where poll_out does not block until the transfer is
	  complete, it must at least be greater than 87us (10bits / 115.2 kBd).

endif # W1_ZEPHYR_SERIAL
```

## drivers/watchdog/Kconfig
```kconfig
# Watchdog configuration options

# Copyright (c) 2015 Intel Corporation
# Copyright (c) 2017 Nordic Semiconductor ASA
# SPDX-License-Identifier: Apache-2.0

menuconfig WATCHDOG
	bool "Watchdog drivers"
	help
	  Include support for watchdogs.

if WATCHDOG

config HAS_WDT_DISABLE_AT_BOOT
	bool

config WDT_DISABLE_AT_BOOT
	bool "Disable at boot"
	depends on HAS_WDT_DISABLE_AT_BOOT
	help
	  Disable watchdog at Zephyr system startup.

config HAS_WDT_NO_CALLBACKS
	bool
	help
	  Watchdog driver does not support callbacks.

module = WDT
module-str = watchdog
source "subsys/logging/Kconfig.template.log_config"

config HAS_WDT_MULTISTAGE
	bool

config WDT_MULTISTAGE
	bool "Multistage timeouts"
	depends on HAS_WDT_MULTISTAGE
	help
	  Enable multistage operation of watchdog timeouts.

config WDT_COUNTER
	bool "Counter based watchdog"
	default y
	depends on DT_HAS_ZEPHYR_COUNTER_WATCHDOG_ENABLED
	select COUNTER
	help
	  Watchdog emulated with counter device. If counter device supports using
	  zero latency interrupts (ZLI) then expiration callback can be called from
	  that context. This watchdog can be used along hardware watchdog to
	  overcome hardware  watchdog limitations, e.g. Nordic devices reset
	  unconditionally at fixed time after hitting watchdog interrupt, leaving
	  no time to print debug information. Watchdog has limitations since it
	  cannot interrupt same or higher priorities so it cannot fully replace
	  hardware based watchdog.

if WDT_COUNTER

config WDT_COUNTER_CH_COUNT
	int "Maximum number of supported channel"
	default 4
	range 1 $(UINT8_MAX)
	help
	  Note that actual channel count will be limited to number of channels
	  supported by the counter device which is used for watchdog.

endif # WDT_COUNTER

source "drivers/watchdog/Kconfig.*"

endif # WATCHDOG
```
