## drivers/video/Kconfig.stm32_jpeg
```kconfig
# STM32 JPEG HW codec driver configuration options

# Copyright (c) 2025 STMicroelectronics.
# SPDX-License-Identifier: Apache-2.0

config VIDEO_STM32_JPEG
	bool "STM32 JPEG HW codec driver"
	default y
	depends on DT_HAS_ST_STM32_JPEG_ENABLED
	depends on VIDEO_ENCODER_JPEG
	select RESET
	select USE_STM32_HAL_JPEG
	select USE_STM32_HAL_DMA if !SOC_SERIES_STM32H7X
	select USE_STM32_HAL_MDMA if SOC_SERIES_STM32H7X
	select USE_STM32_HAL_DMA_EX if !(SOC_SERIES_STM32F7X || SOC_SERIES_STM32H7X)
	help
	  Enable driver for STM32 JPEG HW Codec peripheral
```

## drivers/video/Kconfig.stm32_venc
```kconfig
# STM32 VENC driver configuration options

# Copyright (c) 2025 STMicroelectronics.
# SPDX-License-Identifier: Apache-2.0

config VIDEO_STM32_VENC
	bool "STM32 video encoder (VENC) driver"
	default y
	depends on DT_HAS_ST_STM32_VENC_ENABLED
	depends on VIDEO_ENCODER_H264
	select HAS_STM32LIB
	select USE_STM32_LL_VENC
	select RESET
	help
	  Enable driver for STM32 video encoder peripheral.

if VIDEO_STM32_VENC

# See hal_stm32/lib/vc8000nanoe/inc/encdebug.h
module = VC8000NANOE
module-str = vc8000nanoe
source "subsys/logging/Kconfig.template.log_config"

choice VIDEO_STM32_VENC_MEM_ALLOC
	prompt "Select allocator for VENC internal memory"

config VIDEO_STM32_VENC_SMH_ALLOC
	bool "Shared-Multi-Heap"

config VIDEO_STM32_VENC_HEAP_ALLOC
	bool "Heap"

endchoice

config VIDEO_STM32_VENC_HEAP_SIZE
	int "VENC internal memory pool size in byte"
	depends on VIDEO_STM32_VENC_HEAP_ALLOC
	default 7340032

config VIDEO_STM32_VENC_HEAP_ZEPHYR_REGION
	bool "Place VENC internal memory pool in a Zephyr memory-region"
	depends on VIDEO_STM32_VENC_HEAP_ALLOC

config VIDEO_STM32_VENC_HEAP_ZEPHYR_REGION_NAME
	string "Name of the zephyr memory-region for memory pool"
	depends on VIDEO_STM32_VENC_HEAP_ZEPHYR_REGION

endif
```

## drivers/video/Kconfig.sw_generator
```kconfig
# Copyright (c) 2016 Linaro Limited
# SPDX-License-Identifier: Apache-2.0

config VIDEO_SW_GENERATOR
	bool "Video Software Generator"
	depends on DT_HAS_ZEPHYR_VIDEO_SW_GENERATOR_ENABLED
	default y
	help
	  Enable video pattern generator (for testing purposes).

if VIDEO_SW_GENERATOR

config VIDEO_SW_GENERATOR_JPEG_WIDTH
	int "The width of the JPEG frame generated by Video Software Generator"
	default 320
	help
	  Update the width of the JPEG frame if using out-of-tree JPEG file.

config VIDEO_SW_GENERATOR_JPEG_HEIGHT
	int "The height of the JPEG frame generated by Video Software Generator"
	default 160
	help
	  Update the height of the JPEG frame if using out-of-tree JPEG file.

config VIDEO_SW_GENERATOR_PNG_WIDTH
	int "The width of the PNG frame generated by Video Software Generator"
	default 320
	help
	  Update the width of the PNG frame if using out-of-tree PNG file.

config VIDEO_SW_GENERATOR_PNG_HEIGHT
	int "The height of the PNG frame generated by Video Software Generator"
	default 160
	help
	  Update the height of the PNG frame if using out-of-tree PNG file.

config VIDEO_SW_GENERATOR_H264
	bool "H.264 stream generated by Video Software Generator"
	help
	  Enable an H.264 test stream generated at build time with ffmpeg.
	  This option requires ffmpeg with H.264 encoding and the
	  h264_metadata bitstream filter available on the build host.

if VIDEO_SW_GENERATOR_H264

config VIDEO_SW_GENERATOR_H264_WIDTH
	int "The width of the H.264 frame generated by Video Software Generator"
	default 320
	help
	  Width of the generated H.264 test stream.

config VIDEO_SW_GENERATOR_H264_HEIGHT
	int "The height of the H.264 frame generated by Video Software Generator"
	default 240
	help
	  Height of the generated H.264 test stream.

config VIDEO_SW_GENERATOR_H264_FPS
	int "The frame rate of the H.264 stream generated by Video Software Generator"
	default 30
	help
	  Frame rate of the generated H.264 test stream.

config VIDEO_SW_GENERATOR_H264_NUM_FRAMES
	int "The number of H.264 frames generated by Video Software Generator"
	default 1
	help
	  Number of frames in the generated H.264 test stream.

config VIDEO_SW_GENERATOR_H264_BITRATE_KBPS
	int "The bitrate of the H.264 stream generated by Video Software Generator"
	default 250
	help
	  Bitrate in kilobits per second of the generated H.264 test stream.

choice VIDEO_SW_GENERATOR_H264_PROFILE
	prompt "H.264 profile used by Video Software Generator"
	default VIDEO_SW_GENERATOR_H264_PROFILE_MAIN
	help
	  Select the H.264 profile used for the generated test stream.
	  The selected profile must be supported by the ffmpeg H.264 encoder
	  available on the build host.

config VIDEO_SW_GENERATOR_H264_PROFILE_CONSTRAINED_BASELINE
	bool "Constrained baseline"

config VIDEO_SW_GENERATOR_H264_PROFILE_BASELINE
	bool "Baseline"

config VIDEO_SW_GENERATOR_H264_PROFILE_MAIN
	bool "Main"

config VIDEO_SW_GENERATOR_H264_PROFILE_HIGH
	bool "High"

endchoice

config VIDEO_SW_GENERATOR_H264_FFMPEG_PROFILE
	string
	default "constrained_baseline" if VIDEO_SW_GENERATOR_H264_PROFILE_CONSTRAINED_BASELINE
	default "66" if VIDEO_SW_GENERATOR_H264_PROFILE_BASELINE
	default "main" if VIDEO_SW_GENERATOR_H264_PROFILE_MAIN
	default "high" if VIDEO_SW_GENERATOR_H264_PROFILE_HIGH

endif # VIDEO_SW_GENERATOR_H264

config VIDEO_SW_GENERATOR_JPEG_NAME
	string "The name of the file used to generate JPEG frames"
	default "color_bar"
	help
	  Update the name of the JPEG file if using out-of-tree JPEG file.

config VIDEO_SW_GENERATOR_JPEG_HFLIP_NAME
	string "The name of the file used to generate h-fliped JPEG frames"
	default "color_bar_hflip"
	help
	  Update the name of the JPEG file if using out-of-tree JPEG file.

config VIDEO_SW_GENERATOR_PNG_NAME
	string "The name of the file used to generate PNG frames"
	default "color_bar"
	help
	  Update the name of the PNG file if using out-of-tree PNG file.

config VIDEO_SW_GENERATOR_PNG_HFLIP_NAME
	string "The name of the file used to generate h-fliped PNG frames"
	default "color_bar_hflip"
	help
	  Update the name of the PNG file if using out-of-tree PNG file.

endif # VIDEO_SW_GENERATOR
```

## drivers/video/Kconfig.sw_isp
```kconfig
# Copyright (c) 2025 tinyVision.ai Inc.
# SPDX-License-Identifier: Apache-2.0

config VIDEO_SW_ISP
	bool "Video Software Image Signal Processor (ISP)"
	imply PIXEL
	help
	  Enable a software-based image processing pipeline, providing the essential components
	  of an Image Signal Processsor (ISP) exposing the essential features of the "pixel"
	  library as a native Video API.

config VIDEO_SW_ISP_STACK_SIZE
	int "Stack size for the thread executing the pipelne"
	default 1024
	help
	  Stack size for the thread executing the pipeline. All of the processing elements are not
	  allocated on the stack but use global variables instead. The default value is therefore
	  planning only for the temporary variables.

config VIDEO_SW_ISP_THREAD_PRIORITY
	int "Stack size for the thread executing the pipelne"
	default 5
	help
	  Priority for the thread executing the pipeline. The default value is an intermediate
	  starting point to be tuned arbitrarily to fit the application.

config VIDEO_SW_ISP_INPUT_WIDTH
	int "Width of the input of the pipeline in pixels, used for buffer allocation purposees."
	default 640
	help
	  The default value is VGA width, a widespread default resolution supported broadly.

config VIDEO_SW_ISP_INPUT_HEIGHT
	int "Height of the input of the pipeline in pixels, used for buffer allocation purposees."
	default 480
	help
	  The default value is VGA height, a widespread default resolution supported broadly.
```

## drivers/video/Kconfig.sw_pipeline
```kconfig
# Copyright (c) 2025 tinyVision.ai
# SPDX-License-Identifier: Apache-2.0

config VIDEO_SW_PIPELINE
	bool "Video Software Pipeline"
	depends on DT_HAS_ZEPHYR_VIDEO_SW_PIPELINE_ENABLED
	default y
	help
	  Enable the video stream processing based on the lib/pixel.

config VIDEO_SW_PIPELINE_THREAD_PRIORITY
	int "Video Software Pipeline thread priority"
	default 2
	depends on VIDEO_SW_PIPELINE
	help
	  The Video Software Pipeline has a thread in which video frames are processed.
	  This options sets the priority of that thread.
	  The default is some arbitrary value above 0.
```

## drivers/video/Kconfig.sw_stats
```kconfig
# Copyright (c) 2025 tinyVision.ai Inc.
# SPDX-License-Identifier: Apache-2.0

config VIDEO_SW_STATS
	bool "Video Software Statistics"
	select PIXEL
	help
	  Enable a software-based frame statistics video device, providing information that can be
	  by an Image Processing Algorithm (IPA) via the video stats API. This allows applications
	  to tune the image colors through the video control API.

config VIDEO_SW_STATS_NUM_SAMPLES
	int "Number of pixels to sample on every frame"
	default 400
	range 0 65535
	help
	  The more pixels are sample, the most accurate the statistics may be, but the slowest they
	  would be collected. The default value is estimated good enough not to slow-down most
	  systems. Note that the performance of statistics collection does not depend on the frame
	  size and only the number of samples, but accuracy does.
```

## drivers/video/Kconfig.vd56g3
```kconfig
# SPDX-FileCopyrightText: Copyright The Zephyr Project Contributors
# SPDX-FileCopyrightText: Copyright (c) 2026 LANDROVAL
# SPDX-License-Identifier: Apache-2.0

config VIDEO_VD56G3
	bool "STMicroelectronics VD56G3 / VB56G3 monochrome image sensor"
	depends on DT_HAS_ST_VD56G3_ENABLED
	select I2C
	select GPIO if $(dt_compat_any_has_prop,$(DT_COMPAT_ST_VD56G3),reset-gpios)
	default y
	help
	  Enable driver for the STMicroelectronics VD56G3 / VB56G3 1.5 MP
	  monochrome global shutter CMOS image sensor with MIPI CSI-2
	  D-PHY output and I2C (CCI) control interface.
```

## drivers/video/Kconfig.video_pio_dma
```kconfig
# Copyright (c) 2025 The Zephyr Project Contributors
# SPDX-License-Identifier: Apache-2.0
config VIDEO_PIO_DMA
	bool "Raspberrypi PIO DMA video receiver"
	depends on DT_HAS_RASPBERRYPI_VIDEO_PIO_DMA_ENABLED
	select PICOSDK_USE_PIO
	select PICOSDK_USE_CLAIM
	select DMA
	default y
	help
	  Enable driver for the receiver video pio dma.
```

## drivers/video/i2c/Kconfig
```kconfig
# VIDEO drivers on I2C bus configuration options

# Copyright (c) 2019 Linaro Limited
# Copyright (c) 2024 tinyVision.ai Inc.
# SPDX-License-Identifier: Apache-2.0

# zephyr-keep-sorted-start
source "drivers/video/i2c/Kconfig.mt9m114"
source "drivers/video/i2c/Kconfig.ov2640"
source "drivers/video/i2c/Kconfig.ov5640"
source "drivers/video/i2c/Kconfig.ov7670"
source "drivers/video/i2c/Kconfig.ov7725"
# zephyr-keep-sorted-stop
```

## drivers/video/i2c/Kconfig.mt9m114
```kconfig
# MT9m114

# Copyright (c) 2016 Linaro Limited
# SPDX-License-Identifier: Apache-2.0

config VIDEO_MT9M114
	bool "MT9M114 Aptina CMOS digital image sensor"
	select I2C
	depends on DT_HAS_APTINA_MT9M114_ENABLED
	default y
	help
	  Enable driver for MT9M114 CMOS digital image sensor device.
```

## drivers/video/phy/Kconfig
```kconfig
# Copyright 2026 NXP
# SPDX-License-Identifier: Apache-2.0

menuconfig VIDEO_PHY
	bool "Video PHY drivers"
	help
	  Enable support for Video PHY drivers.

if VIDEO_PHY

module = VIDEO_PHY
module-str = video_phy
source "subsys/logging/Kconfig.template.log_config"

source "drivers/video/phy/Kconfig.imx_dphy"

endif # VIDEO_PHY
```

## drivers/video/phy/Kconfig.imx_dphy
```kconfig
# Copyright 2026 NXP
# SPDX-License-Identifier: Apache-2.0

config VIDEO_IMX_DPHY_RX
	bool "i.MX MIPI DPHY RX driver"
	default y
	depends on DT_HAS_NXP_IMX95_DPHY_RX_ENABLED
	help
	  Enable support for i.MX95 MIPI DPHY RX driver.
	  This driver provides PHY support for MIPI CSI-2 receivers.

if VIDEO_IMX_DPHY_RX

config IMX_DPHY_INIT_PRIORITY
	int "i.MX DPHY initialization priority"
	default 80
	help
	  Initialization priority for i.MX DPHY driver.
	  Must be initialized after clock control driver.

endif # VIDEO_IMX_DPHY_RX
```

## drivers/video/sensor/Kconfig
```kconfig
# Kconfig - VIDEO driver configuration options

#
# Copyright (c) 2019 Linaro Limited
#
# SPDX-License-Identifier: Apache-2.0
#

#
# VIDEO Sensor Drivers
#

source "drivers/video/sensor/Kconfig.mt9m114"
```

## drivers/video/video_hm_htpa/Kconfig
```kconfig
# Copyright (c) 2026 sensry.io
# SPDX-License-Identifier: Apache-2.0

config VIDEO_HEIMANN_HTPA
	bool "Heimann HTPA IR camera"
	depends on DT_HAS_HEIMANN_HTPA_160X120_ENABLED || DT_HAS_HEIMANN_HTPA_120X84_ENABLED
	select SPI
	select FLASH
	default y
	help
	  Enable the driver for Heimann HTPA thermopile infrared array sensors with
	  integrated flash memory that holds temperature calibration and compensation data.

if VIDEO_HEIMANN_HTPA

config VIDEO_HM_HTPA_WORKER_STACK_SIZE
	int "HTPA worker thread stack size"
	default 1024
	help
	  Stack size for the background worker that produces mock frames.

config VIDEO_HM_HTPA_WORKER_PRIORITY
	int "HTPA worker thread priority"
	default 5
	help
	  Priority for the background worker thread.

config VIDEO_HM_HTPA_GRAB_STACK_SIZE
	int "HTPA sensor grab thread stack size"
	default 1024
	help
	  Stack size for the thread that continuously acquires sensor frames.

config VIDEO_HM_HTPA_GRAB_PRIORITY
	int "HTPA sensor grab thread priority"
	default 4
	help
	  Priority for the sensor acquisition thread.

choice VIDEO_HM_HTPA_AUTOSCALE_MODE
	prompt "HTPA automatic scaling mode"
	default VIDEO_HM_HTPA_AUTOSCALE_HISTOGRAM
	help
	  Select how raw sensor values are mapped to the output pixel range.

config VIDEO_HM_HTPA_AUTOSCALE_HISTOGRAM
	bool "Histogram percentile scaling"
	help
	  Scale using the first and 99th percentiles to reject isolated outliers.

config VIDEO_HM_HTPA_AUTOSCALE_LEGACY
	bool "Legacy minimum and maximum scaling"
	help
	  Scale using the original sequential minimum and maximum heuristic.

endchoice

endif # VIDEO_HEIMANN_HTPA
```

## drivers/w1/Kconfig
```kconfig
# 1-Wire configuration options

# Copyright (c) 2022 Thomas Stranger
# SPDX-License-Identifier: Apache-2.0

menuconfig W1
	bool
	prompt "1-Wire bus drivers"
	select CRC
	help
	  Enable 1-Wire Drivers

if W1

module = W1
module-str = W1
source "subsys/logging/Kconfig.template.log_config"

config W1_INIT_PRIORITY
	int
	default 65
	prompt "Init priority"
	help
	  1-Wire device driver initialization priority.

config W1_SHELL
	bool "1-Wire Shell"
	depends on SHELL
	default y if !SHELL_MINIMAL
	help
	  Enable 1-Wire Shell for testing.

config W1_SHELL_BUFFER_SIZE
	int
	default 16
	depends on W1_SHELL
	prompt "1-Wire Shell buffer size"
	help
	  Size of the send and receive buffer in bytes.
	  To be able to write more than 8 bytes make
	  sure to also increase SHELL_ARGC_MAX accordingly.

rsource "Kconfig.ds2482-800"
rsource "Kconfig.ds2484"
rsource "Kconfig.ds2477_85"
rsource "Kconfig.ds2485"
rsource "Kconfig.test"
rsource "Kconfig.zephyr_serial"

config W1_NET
	bool "1-Wire network layer"
	default y
	help
	  Enable 1-wire network layer

config W1_NET_FORCE_MULTIDROP_ADDRESSING
	bool "Force 1-Wire multidrop addressing"
	depends on W1_NET
	help
	  This option will ignore the number of 1-Wire
	  slave devices defined in the DTS. Specifically,
	  this option avoids the SKIP ROM command,
	  which is otherwise used in case of a single
	  1-Wire slave on the bus. In most cases, enabling
	  this option is not needed, yet it is essential
	  if multiple 1-Wire devices unspecified in the
	  DTS are interfaced.

endif # W1
```

## drivers/w1/Kconfig.ds2477_85
```kconfig
# Common configuration options for DS2477 and DS2485 1-Wire master drivers

# Copyright (c) 2022 Thomas Stranger
# SPDX-License-Identifier: Apache-2.0

config W1_DS2477_85_COMMON
	bool
	help
	  This enables support for the shared ds2477/85 1-Wire driver.
```

## drivers/w1/Kconfig.ds2482-800
```kconfig
# Copyright (c) 2022, Caspar Friedrich <c.s.w.friedrich@gmail.com>
# SPDX-License-Identifier: Apache-2.0

config W1_DS2482_800
	bool "DS2482-800, 8-Channel 1-Wire Master"
	select I2C
	depends on DT_HAS_MAXIM_DS2482_800_ENABLED
	default y
```
