## drivers/video/Kconfig.hm0360
```kconfig
# Copyright The Zephyr Project Contributors
# SPDX-License-Identifier: Apache-2.0

config VIDEO_HM0360
	bool "HM0360 CMOS digital image sensor"
	select I2C
	select GPIO if $(dt_compat_any_has_prop,$(DT_COMPAT_HIMAX_HM0360),pwdn-gpios) || \
			$(dt_compat_any_has_prop,$(DT_COMPAT_HIMAX_HM0360),reset-gpios)
	depends on DT_HAS_HIMAX_HM0360_ENABLED
	default y
	help
	  Enable driver for HM0360 CMOS digital image sensor device.
```

## drivers/video/Kconfig.imx335
```kconfig
# IMX335

# Copyright (c) 2025 STMicroelectronics.
# SPDX-License-Identifier: Apache-2.0

config VIDEO_IMX335
	bool "IMX335 CMOS digital image sensor"
	select I2C
	select GPIO if $(dt_compat_any_has_prop,$(DT_COMPAT_SONY_IMX335),reset-gpios)
	depends on DT_HAS_SONY_IMX335_ENABLED
	default y
	help
	  Enable driver for IMX335 CMOS digital image sensor device
```

## drivers/video/Kconfig.imx_mipi_csi
```kconfig
# Copyright 2026 NXP
# SPDX-License-Identifier: Apache-2.0

config VIDEO_IMX_MIPI_CSI
	bool "NXP i.MX95 MIPI CSI-2 RX (with integrated DPHY control)"
	default y
	depends on DT_HAS_NXP_IMX_MIPI_CSI_ENABLED
	help
	  Enable driver for i.MX95 CSI-2 receiver.
	  The CSI-2 receiver controls the associated DPHY as an implementation detail
	  (DPHY is still represented as a separate devicetree node for clarity).

if VIDEO_IMX_MIPI_CSI

config VIDEO_IMX_MIPI_CSI_INIT_PRIORITY
	int "i.MX MIPI CSI initialization priority"
	default 80
	help
	  Initialization priority for IMX MIPI CSI driver.

endif # VIDEO_IMX_MIPI_CSI
```

## drivers/video/Kconfig.max96717
```kconfig
# Copyright (c) 2026 Charles Dias
# SPDX-License-Identifier: Apache-2.0

config VIDEO_MAX96717
	bool "ADI MAX96717 GMSL2 serializer"
	select I2C
	depends on DT_HAS_ADI_MAX96717_ENABLED
	default y
	help
	  Enable driver for the ADI MAX96717 GMSL2 serializer.
	  The MAX96717 receives MIPI CSI-2 data from a camera sensor
	  and transmits it over a coaxial GMSL2 link.

if VIDEO_MAX96717

config VIDEO_MAX96717_INIT_PRIORITY
	int "MAX96717 init priority"
	default 58
	help
	  Initialization priority for the MAX96717 serializer. Must run
	  after the MAX96724 deserializer (default 56) — so that its I2C
	  proxy is live and can reach the serializer over the GMSL reverse
	  channel — and before any camera sensor (VIDEO_INIT_PRIORITY,
	  default 60). Slot 59 is intentionally left free for any future
	  driver that needs to sit between the serializer and the sensor.

config VIDEO_MAX96717_VPG_ENABLE
	bool "MAX96717 internal Video Pattern Generator (VPG)"
	default n
	help
	  Configure the MAX96717's internal pattern generator at probe time
	  to emit a synthetic RGB888 frame over GMSL. Used to validate the full
	  SerDes path when no real image sensor is wired to the serializer.

choice VIDEO_MAX96717_VPG_PATTERN
	prompt "MAX96717 VPG test pattern"
	depends on VIDEO_MAX96717_VPG_ENABLE
	default VIDEO_MAX96717_VPG_PATTERN_GRADIENT

config VIDEO_MAX96717_VPG_PATTERN_GRADIENT
	bool "Color gradient"

config VIDEO_MAX96717_VPG_PATTERN_CHECKERBOARD
	bool "Checkerboard"

endchoice

endif
```

## drivers/video/Kconfig.mcux_elcdif
```kconfig
# NXP MCUX CSI driver configuration options

# Copyright (c) 2019, Linaro Limited
# SPDX-License-Identifier: Apache-2.0

config VIDEO_MCUX_ELCDIF
	bool "NXP MCUX Enhanced LCD Interface (ELCDIF) driver"
	depends on HAS_MCUX_ELCDIF
```

## drivers/video/Kconfig.mcux_flexio_camera
```kconfig
# Copyright 2026 NXP
# SPDX-License-Identifier: Apache-2.0

config VIDEO_MCUX_FLEXIO_CAMERA
	bool "NXP MCUX FlexIO Parallel Camera driver"
	default y
	depends on DT_HAS_NXP_FLEXIO_CAMERA_ENABLED
	select DMA
	select MCUX_FLEXIO
	select GPIO
	help
	  Enable driver for the NXP FlexIO-based parallel camera interface.
	  Pixel data is captured via FlexIO shifters (8-bit parallel bus,
	  PCLK-gated, HREF-enabled) and transferred to memory using eDMA.
	  A VSYNC GPIO interrupt synchronises frame boundaries. An optional
	  XCLK output can be generated by a second FlexIO timer.

config VIDEO_MCUX_FLEXIO_CAMERA_INIT_PRIORITY
	int "NXP MCUX FlexIO camera initialization priority"
	depends on VIDEO_MCUX_FLEXIO_CAMERA
	default 59
	help
	  Initialization priority for the FlexIO camera driver. Must be lower
	  than VIDEO_INIT_PRIORITY (default 60) so that XCLK is running on the
	  FlexIO output pin before attached image sensor drivers attempt I2C
	  communication during their own initialization.
```

## drivers/video/Kconfig.mcux_isi
```kconfig
# Copyright 2026 NXP
# SPDX-License-Identifier: Apache-2.0

config VIDEO_MCUX_ISI
	bool "MCUX ISI driver"
	default y
	depends on DT_HAS_NXP_IMX_ISI_ENABLED
	help
	  Enable support for MCUX Image Sensing Interface (ISI) driver.

config VIDEO_MCUX_ISI_CORE_INIT_PRIORITY
	int "NXP MCUX ISI Core init priority"
	default 59
	depends on VIDEO_MCUX_ISI
	help
	  Initialization priority for the MCUX ISI Core device.
```

## drivers/video/Kconfig.mcux_jpegdec
```kconfig
# NXP JPEG decoder driver configuration option

# Copyright 2026 NXP
# SPDX-License-Identifier: Apache-2.0

config VIDEO_MCUX_JPEGDEC
	bool "NXP JPEG decoder driver"
	default y
	depends on DT_HAS_NXP_JPEGDEC_ENABLED
```

## drivers/video/Kconfig.mcux_mipi_csi2rx
```kconfig
# NXP MIPI CSI-2 Rx driver configuration option

# Copyright 2024 NXP
# SPDX-License-Identifier: Apache-2.0

config VIDEO_MCUX_MIPI_CSI2RX
	bool "NXP MIPI CSI-2 Rx driver"
	default y
	depends on DT_HAS_NXP_MIPI_CSI2RX_ENABLED
	select VIDEO_MCUX_CSI
```

## drivers/video/Kconfig.mcux_pxp
```kconfig
# NXP PxP driver configuration option

# Copyright 2025 NXP
# SPDX-License-Identifier: Apache-2.0

config VIDEO_MCUX_PXP
	bool "NXP MCUX PxP driver"
	default y
	depends on DT_HAS_NXP_PXP_ENABLED
```

## drivers/video/Kconfig.mcux_sdma
```kconfig
# NXP MCUX SDMA driver configuration options

# Copyright 2024 NXP
# SPDX-License-Identifier: Apache-2.0

config VIDEO_MCUX_SDMA
	bool "NXP MCUX Video SMARTDMA driver"
	default y
	select DMA
	depends on DT_HAS_NXP_VIDEO_SMARTDMA_ENABLED
```

## drivers/video/Kconfig.mt9m114
```kconfig
# Kconfig - MT9m114

#
# Copyright (c) 2016 Linaro Limited
#
# SPDX-License-Identifier: Apache-2.0
#

menuconfig VIDEO_MT9M114
        bool "MT9M114 Aptina CMOS digital image sensor"
        depends on I2C
        help
          Enable driver for MT9M114 CMOS digital image sensor device.
```

## drivers/video/Kconfig.ov2640
```kconfig
# OV2640

# Copyright (c) 2021 Antmicro <www.antmicro.com>
# SPDX-License-Identifier: Apache-2.0

config VIDEO_OV2640
	bool "OV2640 CMOS digital image sensor"
	select I2C
	select GPIO if $(dt_compat_any_has_prop,$(DT_COMPAT_OVTI_OV2640),pwdn-gpios) || \
			$(dt_compat_any_has_prop,$(DT_COMPAT_OVTI_OV2640),reset-gpios)
	depends on DT_HAS_OVTI_OV2640_ENABLED
	default y
	help
	  Enable driver for OV2640 CMOS digital image sensor device.
```

## drivers/video/Kconfig.ov5640
```kconfig
# OV5640

# Copyright 2024 NXP
# SPDX-License-Identifier: Apache-2.0

config VIDEO_OV5640
	bool "OV5640 CMOS digital image sensor"
	select I2C
	select GPIO if $(dt_compat_any_has_prop,$(DT_COMPAT_OVTI_OV5640),powerdown-gpios) || \
			$(dt_compat_any_has_prop,$(DT_COMPAT_OVTI_OV5640),reset-gpios)
	depends on DT_HAS_OVTI_OV5640_ENABLED
	default y
	help
	  Enable driver for OV5640 CMOS digital image sensor device
```

## drivers/video/Kconfig.ov5642
```kconfig
# Copyright (c) 2025 Silicon Signals Pvt. Ltd.
# SPDX-License-Identifier: Apache-2.0

config VIDEO_OV5642
	bool "OV5642 CMOS digital image sensor"
	select I2C
	depends on DT_HAS_OVTI_OV5642_ENABLED
	default y
	help
	  Enable driver for OV5642 CMOS digital image sensor device
```

## drivers/video/Kconfig.ov7670
```kconfig
# Copyright 2024 NXP
# Copyright (c) 2025 Renesas Electronics Corporation
# SPDX-License-Identifier: Apache-2.0

config VIDEO_OV7670
	bool "OV7670 CMOS digital image sensor"
	select I2C
	depends on DT_HAS_OVTI_OV7670_ENABLED
	default y
	help
	  Enable driver for OV7670 CMOS digital image sensor device.

if VIDEO_OV7670

config VIDEO_OV7670_PCLK_FREE_RUN
	bool "OV7670 PCLK free-run mode"
	help
	  Clear COM10 bit 5 to allow the pixel clock (PCLK) to free-run continuously,
	  even during horizontal blanking. By default, PCLK is gated during H-blank.

endif
```

## drivers/video/Kconfig.ov7675
```kconfig
# Copyright 2024 NXP
# SPDX-License-Identifier: Apache-2.0

config VIDEO_OV7675
	bool "OV7675 CMOS digital image sensor"
	select I2C
	depends on DT_HAS_OVTI_OV7675_ENABLED
	default y
	help
	  Enable driver for OV7675 CMOS digital image sensor device.
```

## drivers/video/Kconfig.ov767x
```kconfig
# OV767X CMOS digital image sensor configuration options

# Copyright (c) 2025 Michael Smorto <CyberMerln@gmail.com>
# SPDX-License-Identifier: Apache-2.0

config VIDEO_OV767X
	bool "OV767X CMOS digital image sensor"
	select I2C
	select GPIO if $(dt_compat_any_has_prop,$(DT_COMPAT_OVTI_OV7670),pwdn-gpios) || \
			$(dt_compat_any_has_prop,$(DT_COMPAT_OVTI_OV7670),reset-gpios) || \
			$(dt_compat_any_has_prop,$(DT_COMPAT_OVTI_OV7675),pwdn-gpios) || \
			$(dt_compat_any_has_prop,$(DT_COMPAT_OVTI_OV7675),reset-gpios)
	depends on DT_HAS_OVTI_OV7670_ENABLED || DT_HAS_OVTI_OV7675_ENABLED
	default y
	help
	  Enable driver for OV7670 / OV7675 CMOS digital image sensor.
```

## drivers/video/Kconfig.ov7725
```kconfig
# OV7725

# Copyright (c) 2020 FrankLi Limited
# SPDX-License-Identifier: Apache-2.0

config VIDEO_OV7725
	bool "OV7725 CMOS digital image sensor"
	select I2C
	select GPIO if $(dt_compat_any_has_prop,$(DT_COMPAT_OVTI_OV7725),reset-gpios)
	depends on DT_HAS_OVTI_OV7725_ENABLED
	default y
	help
	  Enable driver for OV7725 CMOS digital image sensor device.
```

## drivers/video/Kconfig.ov9655
```kconfig
# Copyright 2025 ST Microelectronics
# SPDX-License-Identifier: Apache-2.0

config VIDEO_OV9655
	bool "OV9655 CMOS digital image sensor"
	select I2C
	select GPIO if $(dt_compat_any_has_prop,$(DT_COMPAT_OVTI_OV9655),pwdn-gpios) || \
			$(dt_compat_any_has_prop,$(DT_COMPAT_OVTI_OV9655),reset-gpios)
	depends on DT_HAS_OVTI_OV9655_ENABLED
	default y
	help
	  Enable driver for OV9655 CMOS digital image sensor device.
```

## drivers/video/Kconfig.renesas_ra_ceu
```kconfig
# Copyright (c) 2025 Renesas Electronics Corporation
# SPDX-License-Identifier: Apache-2.0

config VIDEO_RENESAS_RA_CEU
	bool
	default y
	depends on DT_HAS_RENESAS_RA_CEU_ENABLED
	select PINCTRL
	select CLOCK_CONTROL_PWM
	select USE_RA_FSP_CEU
	help
	  Enable driver for Renesas RA CEU.
```

## drivers/video/Kconfig.rk043fn02h
```kconfig
# RK043FN02H

# Copyright (c) 2016 Linaro Limited
# SPDX-License-Identifier: Apache-2.0

config VIDEO_RK043FN02H
	bool "RK043FN02H 4.3 inch TFT 480*272 panel"
	help
	  Enable driver for RK043FN02H 4.3 inch RGB565 TFT 480*272 panel.
```

## drivers/video/Kconfig.shell
```kconfig
# Copyright The Zephyr Project Contributors
# SPDX-License-Identifier: Apache-2.0

config VIDEO_SHELL
	bool "Video shell"
	depends on SHELL
	help
	  This shell provides control and query commands for video drivers.

if VIDEO_SHELL

config VIDEO_SHELL_CTRL_NAME_SIZE
	int "Maximum size for the control string identifier"
	default 40
	help
	  Video controls have a human-friendly name that is converted into a string identifier.
	  This Kconfig controls the maximum size of the string identifier after which the name
	  would be truncated. The default value is enough for all standard control names.

endif
```

## drivers/video/Kconfig.st_mipid02
```kconfig
# Copyright (c) 2025 ST Microelectronics
# SPDX-License-Identifier: Apache-2.0

menuconfig VIDEO_ST_MIPID02
	bool "ST Microelectronics MIPID02 CSI to DVP bridge"
	select I2C
	depends on DT_HAS_ST_MIPID02_ENABLED
	default y
	help
	  Enable driver for ST MIPID02 CSI to DVP bridge.
	  The ST MIPID02 is a dual lane CSI-2 deserializer allowing
	  to output up to 200MHz 12-bit parallel.

if VIDEO_ST_MIPID02

config VIDEO_ST_MIPID02_CAPS_HEAP_SIZE
	int "Size of a heap reserved to handle caps"
	default 512
	help
	  Heap size reserved in order to handle caps. This could be
	  reduced or increased depending on the amount of formats
	  supported by the ST_MIPID02 source device.

endif # VIDEO_ST_MIPID02
```

## drivers/video/Kconfig.stm32_dcmipp
```kconfig
# STM32 DCMIPP driver configuration options

# Copyright (c) 2025 STMicroelectronics.
# SPDX-License-Identifier: Apache-2.0

config VIDEO_STM32_DCMIPP
	bool "STM32 Digital Camera Memory Interface Pixel Processor (DCMIPP) driver"
	default y
	depends on DT_HAS_ST_STM32_DCMIPP_ENABLED
	select USE_STM32_HAL_DCMIPP
	select RESET
	select PINCTRL
	help
	  Enable driver for STM32 Digital Camera Memory Interface Pixel Processor
	  (DCMIPP) peripheral

if VIDEO_STM32_DCMIPP

config VIDEO_STM32_DCMIPP_INIT_PRIORITY
	int "STM32 DCMIPP initialization priority"
	default 61
	help
	  System initialization priority for DCMIPP drivers.
	  This priority needs to be lower than VIDEO_INIT_PRIORITY
	  to ensure that the source device (sensor) initializes first.

config VIDEO_STM32_DCMIPP_SENSOR_WIDTH
	int "Width of the sensor frame"
	default 2592
	help
	  Width of the sensor video frame.

config VIDEO_STM32_DCMIPP_SENSOR_HEIGHT
	int "Height of the sensor frame"
	default 1944
	help
	  Height of the sensor video frame.

config VIDEO_STM32_DCMIPP_SENSOR_PIXEL_FORMAT
	string "Pixel format of the sensor frame"
	default "RG12"
	help
	  Pixel format of the sensor video frame.

config VIDEO_STM32_DCMIPP_CSI_ENABLE_IRQ
	bool "CSI Interrupt"
	depends on $(dt_compat_any_has_prop,$(DT_COMPAT_ST_STM32_DCMIPP),interrupt-names,dcmipp_csi)
	help
	  Enable the secondary DCMIPP interrupt dedicated to the CSI host. HAL callbacks
	  HAL_DCMIPP_CSI_*Callback will be invoked and can be implemented by applications.

endif
```
