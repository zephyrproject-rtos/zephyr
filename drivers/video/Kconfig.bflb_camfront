## drivers/virtio/Kconfig
```kconfig
# Copyright (c) 2024 Antmicro <www.antmicro.com>
# SPDX-License-Identifier: Apache-2.0

menuconfig VIRTIO
	bool "Support for VIRTIO"
	help
	  Enable options for VIRTIO

if VIRTIO

module = VIRTIO
module-str = VIRTIO
source "subsys/logging/Kconfig.template.log_config"

config VIRTIO_WAKE_QUEUE_STACK_SIZE
	int "Virtio wake workqueue stack size"
	default 4096 if COVERAGE_GCOV
	default 1024
	help
	  Stack size of the shared workqueue thread that wakes threads blocked
	  waiting for free virtqueue descriptors. Its handler only takes the
	  virtqueue waiter mutex and broadcasts a condition variable.

config VIRTIO_WAKE_QUEUE_PRIORITY
	int "Virtio wake workqueue priority"
	default 0 if !COOP_ENABLED
	default -2 if !PREEMPT_ENABLED && NUM_COOP_PRIORITIES > 1
	default -1
	help
	  Priority of the shared workqueue thread that wakes threads blocked
	  waiting for free virtqueue descriptors. Defaults follow the system
	  workqueue. A priority outside the configured non-idle priorities is
	  rejected at build time.

config VIRTIO_PCI
	bool "Support for VIRTIO over PCI"
	default y
	depends on DT_HAS_VIRTIO_PCI_ENABLED
	select PCIE
	help
	  Enable options for VIRTIO over PCI

config VIRTIO_MMIO
	bool "Support for VIRTIO over MMIO"
	default y
	depends on DT_HAS_VIRTIO_MMIO_ENABLED
	help
	  Enable options for VIRTIO over MMIO

config HEAP_MEM_POOL_ADD_SIZE_VIRTIO
	int "Heap memory pool size for VIRTIO"
	default 32768
	help
	  Set the size of the heap memory pool for VIRTIO.

endif # VIRTIO
```

## drivers/virtualization/Kconfig
```kconfig
# Virtualization drivers configuration options

# Copyright (c) 2015-2020 Intel Corporation
# SPDX-License-Identifier: Apache-2.0

menuconfig VIRTUALIZATION
	bool "Virtualization guest drivers"
	help
	  This contains various drivers meant to support and expose features
	  when Zephyr is running as a guest in a virtualized or emulated
	  environment.

if VIRTUALIZATION

config IVSHMEM
	bool "Inter-VM shared memory device (ivshmem)"
	depends on PCIE
	help
	  This will enable support of qemu's ivshmem device, which is also
	  present in ACRN hypervisor, and lets VM sharing memory with each
	  other.

config IVSHMEM_FLAT
	bool "QEMU ivshmem-flat driver"
	depends on DT_HAS_QEMU_IVSHMEM_FLAT_ENABLED
	depends on !IVSHMEM_V2
	help
	  Enable the memory-mapped ivshmem device for machines without PCI.
	  Register and shared memory addresses are supplied by devicetree.
	  Sending notifications requires IVSHMEM_DOORBELL. Receiving them
	  also requires a devicetree interrupt.
	  Only vector zero is supported; configure the server with one vector.
	  This device does not implement the ivshmem-v2 protocol.

if IVSHMEM || IVSHMEM_FLAT

module = IVSHMEM
module-str = ivshmem
source "subsys/logging/Kconfig.template.log_config"

config IVSHMEM_DOORBELL
	bool "Support interrupt based ivshmem (doorbell version)"
	select POLL
	help
	  This will enable support of ivshmem-doorbell, i.e. the interrupt
	  based ivshmem. For ivshmem-v2 INTx interrupts are also supported.
	  For ivshmem-flat, sending notifications does not require a local IRQ.
	  Receiving notifications requires a single interrupt in devicetree.

config IVSHMEM_MSI_X_VECTORS
	int "How many notification vectors should be pre-allocated?"
	default 2
	depends on IVSHMEM && IVSHMEM_DOORBELL
	help
	  MSI-X vector holders must be pre-allocated. One can pre-allocate
	  more or less than necessary. Depends on how many VMs will connect
	  with each other. These are know to be the notification vectors in
	  ivshmem.

config IVSHMEM_INT_PRIORITY
	int "MSI-X interrupt priority"
	default 2
	depends on IVSHMEM && IVSHMEM_DOORBELL
	help
	  Interrupt priority used for the MSI-X generated interrupts.
	  INTx interrupt priority is configured in the device tree.

config IVSHMEM_SHELL
	bool "IVshmem shell module"
	depends on SHELL
	help
	  This is mostly a module to help getting info the ivshmem and/or
	  quickly testing your ivshmem client application (from another VM).
	  The shell uses the first PCI ivshmem device, or the first flat device
	  when no PCI ivshmem device is present.

endif # IVSHMEM || IVSHMEM_FLAT

config IVSHMEM_V2
	bool "Inter-VM shared memory v2 (ivshmem-v2)"
	depends on PCIE
	select IVSHMEM
	help
	  Enable ivshmem-v2 support.
	  ivshmem-v2 is primarily used for IPC in the Jailhouse hypervisor.

config IVSHMEM_V2_MAX_PEERS
	int "Maximum number of ivshmem-v2 peers"
	depends on IVSHMEM_V2
	default 2
	range 2 65536

endif # VIRTUALIZATION
```

## drivers/watchdog/Kconfig.cc35xx
```kconfig
# Copyright (c) 2025 Conclusive Engineering Sp. z o.o.
# SPDX-License-Identifier: Apache-2.0

config WDT_CC35XX
	bool "Watchdog Driver for cc35xx family of MCUs"
	default y
	depends on DT_HAS_TI_CC35XX_WATCHDOG_ENABLED
	select HAS_WDT_DISABLE_AT_BOOT
	help
	  Watchdog for cc35xx family of MCUs
```

## drivers/watchdog/Kconfig.cdns
```kconfig
# Copyright (c) 2026 David Paul-Beier
# SPDX-License-Identifier: Apache-2.0

config WDT_CDNS
	bool "Cadence watchdog timer driver"
	default y
	depends on DT_HAS_CDNS_WDT_R1P2_ENABLED
	select HAS_WDT_DISABLE_AT_BOOT
	select HAS_WDT_NO_CALLBACKS
	help
	  Enable the driver for the Cadence watchdog timer (r1p2), used as
	  the System Watchdog Timer of the Zynq-7000.
```

## drivers/watchdog/Kconfig.esp32
```kconfig
# ESP32 WDT configuration

# Copyright (C) 2017 Intel Corporation
# SPDX-License-Identifier: Apache-2.0

config WDT_ESP32
	bool "ESP32 Watchdog (WDT) Driver"
	default y
	depends on DT_HAS_ESPRESSIF_ESP32_WATCHDOG_ENABLED
	help
	  Enable WDT driver for ESP32.

config WDT_XT_ESP32
	bool "ESP32 Watchdog for External 32K Crystal Driver"
	default y
	depends on DT_HAS_ESPRESSIF_ESP32_XT_WDT_ENABLED
	help
	  Enable WDT driver for ESP32.

config WDT_RTC_ESP32
	bool "ESP32 RTC Watchdog (RWDT) Driver"
	default y
	depends on DT_HAS_ESPRESSIF_ESP32_RTC_WDT_ENABLED
	help
	  Enable the driver for the ESP32 RTC watchdog timer, which runs
	  from the RTC slow clock in the low-power domain.
```

## drivers/watchdog/Kconfig.infineon
```kconfig
# Infineon CAT1 Watchdog configuration options

# Copyright (c) 2023 Cypress Semiconductor Corporation (an Infineon company) or
# an affiliate of Cypress Semiconductor Corporation
#
# SPDX-License-Identifier: Apache-2.0

config WDT_INFINEON_CAT1
	bool "Infineon CAT1 Watchdog Driver"
	default y
	depends on DT_HAS_INFINEON_WATCHDOG_ENABLED
	select USE_INFINEON_WDT
	help
	  Enable Watchdog driver for Infineon CAT1 devices.

config WDT_INFINEON_WINDOW
	bool "Infineon window watchdog driver"
	default y
	depends on DT_HAS_INFINEON_WINDOW_WDT_ENABLED
	select CLOCK_CONTROL
	select CLOCK_CONTROL_FIXED_RATE_CLOCK if DT_HAS_FIXED_CLOCK_ENABLED
	select HAS_WDT_MULTISTAGE
	help
	  Enable the native driver for the window watchdog of Infineon
	  TRAVEO T2G devices.
```
