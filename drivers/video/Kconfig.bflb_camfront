## drivers/video/Kconfig.bflb_camfront
```kconfig
# SPDX-FileCopyrightText: Copyright Panoramix Labs
# SPDX-License-Identifier: Apache-2.0

config VIDEO_BFLB_CAMFRONT
	bool "BouffaloLab Camrea Front-end (CAMFRONT) receiver for DVP (parallel) cameras"
	default y
	depends on DT_HAS_BFLB_CAMFRONT_ENABLED
	select PINCTRL
	help
	  Enable driver for Bouffalo Lab CAMFRONT parallel camera (CAMFRONT) video receiver.

if VIDEO_BFLB_CAMFRONT

config VIDEO_BFLB_CAMFRONT_INIT_PRIORITY
	int "Bouffalo Lab CAMFRONT initialization priority"
	default 59
	help
	  System initialization priority for the BouffaloLab DVP2AXI drivers.
	  This priority needs to be lower (earlier) than VIDEO_INIT_PRIORITY (60) so that image
	  sensors can have their MCLK/XCLK clock signal configured.

config VIDEO_BFLB_CAMFRONT_MAX_FORMATS
	int "Maximum number of formats listed"
	default 32
	help
	  Configure the maximum number of formats in the format capabilities table.

endif
```

## drivers/video/Kconfig.bflb_dvp2axi
```kconfig
# SPDX-FileCopyrightText: Copyright Panoramix Labs
# SPDX-License-Identifier: Apache-2.0

config VIDEO_BFLB_DVP2AXI
	bool "BouffaloLab DVP to AXI (DVP2AXI) video stream output"
	default y
	depends on DT_HAS_BFLB_DVP2AXI_ENABLED
	help
	  Enable Bouffalo Lab DVP2AXI parallel camera (DVP2AXI) video stream conversion
	  and DMA engine.

if VIDEO_BFLB_DVP2AXI

config VIDEO_BFLB_DVP2AXI_INIT_PRIORITY
	int "Bouffalo Lab DVP2AXI initialization priority"
	default 61
	help
	  System initialization priority for the BouffaloLab CAMFRONT drivers.
	  This priority needs to be higher (later) than VIDEO_BFLB_DVP2AXI_INIT_PRIORITY (59) so
	  that CANFRONT is initiialized before.

config VIDEO_BFLB_DVP2AXI_MAX_FORMATS
	int "Maximum number of formats listed"
	default 32
	help
	  Configure the maximum number of formats in the format capabilities table.

endif
```

## drivers/video/Kconfig.esp32_csi
```kconfig
# Copyright (c) 2026 Espressif Systems (Shanghai) Co., Ltd.
# SPDX-License-Identifier: Apache-2.0

config VIDEO_ESP32_CSI
	bool "ESP32 MIPI CSI camera interface"
	depends on DT_HAS_ESPRESSIF_ESP32_CSI_ENABLED
	default y
	select SOC_ESP32P4_DW_GDMA
	help
	  Enable the MIPI CSI-2 camera interface of the ESP32-P4. Raw Bayer
	  frames from the sensor are converted to RGB565 by the image signal
	  processor and written to memory by the DW-GDMA.

config VIDEO_ESP32_CSI_INIT_PRIORITY
	int "ESP32 MIPI CSI camera interface init priority"
	default 61
	depends on VIDEO_ESP32_CSI
	help
	  Initialization priority of the camera interface. It must be lower
	  than VIDEO_INIT_PRIORITY so that the sensor initializes first.
```

## drivers/video/Kconfig.esp32_i2s_cam
```kconfig
# SPDX-FileCopyrightText: 2026 Muhammad Waleed Badar
# SPDX-License-Identifier: Apache-2.0

config VIDEO_ESP32_I2S_CAM
	bool "ESP32 I2S camera interface driver"
	default y
	depends on DT_HAS_ESPRESSIF_ESP32_I2S_CAM_ENABLED
	help
	  Enable the parallel camera interface driver for the ESP32, using the
	  I2S0 peripheral in camera slave mode.

	  The interrupt handler copies each DMA chunk into the video buffer,
	  which limits the sustained input rate to about 4.5 MB/s with the
	  buffers in PSRAM. Frames arriving faster are dropped and the buffer
	  is kept. 640x480 RGB565 needs an XCLK of 10 MHz or lower; 320x240
	  works at 20 MHz.

if VIDEO_ESP32_I2S_CAM

config VIDEO_ESP32_I2S_CAM_DMA_CHUNKS
	int "Number of DMA chunks"
	default 4
	range 2 16
	help
	  Number of 4092 byte DMA chunks allocated in internal RAM. Each chunk
	  holds 1023 bytes of camera data, which the interrupt handler copies
	  into the video buffer. More chunks tolerate a longer interrupt
	  latency but do not raise the sustained input rate.

endif # VIDEO_ESP32_I2S_CAM
```

## drivers/video/Kconfig.gc0308
```kconfig
# SPDX-FileCopyrightText: Copyright The Zephyr Project Contributors
# SPDX-FileCopyrightText: Copyright (c) 2024 Felipe Neves
# SPDX-FileCopyrightText: Copyright (c) 2026 Victor Hogeweij
#
# SPDX-License-Identifier: Apache-2.0

config VIDEO_GC0308
	bool "GC0308 CMOS digital image sensor"
	select I2C
	select GPIO if $(dt_compat_any_has_prop,$(DT_COMPAT_GALAXYCORE_GC0308),pwdn-gpios) || \
			$(dt_compat_any_has_prop,$(DT_COMPAT_GALAXYCORE_GC0308),reset-gpios)
	depends on DT_HAS_GALAXYCORE_GC0308_ENABLED
	default y
	help
	  Enable driver for GC0308 CMOS digital image sensor device.
```

## drivers/video/Kconfig.htpa_cam
```kconfig
# Copyright (c) 2026 sensry.io
# SPDX-License-Identifier: Apache-2.0

menuconfig VIDEO_HTPA_CAM
	bool "Heimann HTPA IR camera"
	depends on DT_HAS_HEIMANN_HTPA_160X120_CAMERA_ENABLED || \
		DT_HAS_HEIMANN_HTPA_120X84_CAMERA_ENABLED
	select SPI
	select FLASH
	select CACHE_MANAGEMENT if DCACHE
	default y
	help
	  Enable the driver for Heimann HTPA thermopile infrared array sensors with
	  integrated flash memory that holds temperature calibration and compensation data.

if VIDEO_HTPA_CAM

config VIDEO_HTPA_CAM_MAX_FPS
	int "HTPA maximum acquisition frame rate"
	range 1 1000
	default 7
	help
	  Limit the frame acquisition rate and advertise this rate to video
	  clients. The actual rate depends on sensor conversion, readout,
	  processing and buffer availability.

config VIDEO_HTPA_CAM_OFFSET_INTERVAL
	int "HTPA electrical offset acquisition interval"
	range 1 65535
	default 1
	help
	  Acquire electrical offsets for the first frame and every N successful
	  frames thereafter. Reuse the last offsets for intermediate frames.
	  Set to 1 to acquire offsets for every frame.

config VIDEO_HTPA_CAM_BLOCK_MARKERS
	bool "Show HTPA block acquisition markers"
	help
	  Replace pixels at the left and right edges of each block with its block
	  number and a frame counter, respectively, encoded as eight bits. The
	  counter advances once per frame acquisition and wraps at 256. This is
	  intended for debugging and changes the raw pixel data.

config VIDEO_HTPA_CAM_WORKER_STACK_SIZE
	int "HTPA worker thread stack size"
	default 1024
	help
	  Stack size for the background worker that acquires frames.

config VIDEO_HTPA_CAM_WORKER_THREAD_PRIORITY
	int "HTPA worker thread priority"
	default 3
	help
	  Priority for the background worker thread.

endif # VIDEO_HTPA_CAM
```

## drivers/video/Kconfig.htpa_processor
```kconfig
# SPDX-FileCopyrightText: Copyright The Zephyr Project Contributors
# SPDX-License-Identifier: Apache-2.0

menuconfig VIDEO_HTPA_PROCESSOR
	bool "HTPA frame processing video device"
	depends on DT_HAS_HEIMANN_HTPA_PROCESSOR_ENABLED
	default y
	help
	  Capture raw HTPA frames from a video source and correct electrical
	  offsets and pixel ordering.

if VIDEO_HTPA_PROCESSOR

config VIDEO_HTPA_PROCESSOR_MIN_GREY_RANGE
	int "Minimum HTPA grayscale input range"
	default 256
	range 1 65535
	help
	  Minimum span between the grayscale scaling bounds, in corrected
	  sensor levels. Smaller spans are expanded around their midpoint.

config VIDEO_HTPA_PROCESSOR_RAW_BUFFER_SIZE
	int "Maximum raw HTPA frame size"
	default 41756
	range 1 2147483647
	help
	  Size in bytes of each of the processor's source frame buffers.
	  The source frame format must fit in each buffer.

config VIDEO_HTPA_PROCESSOR_RAW_BUFFER_COUNT
	int "Number of HTPA source frame buffers"
	default 3
	range 2 32
	help
	  Number of raw frame buffers queued to the source. Increasing this
	  allows more frames to be buffered while processing, at the cost of
	  additional memory and potentially increased frame latency.

config VIDEO_HTPA_PROCESSOR_INIT_PRIORITY
	int "HTPA processor initialization priority"
	default 61
	help
	  Initialization priority after the source video device.

config VIDEO_HTPA_PROCESSOR_STACK_SIZE
	int "HTPA processor worker stack size"
	default 1024
	help
	  Stack size of the frame processing worker.

config VIDEO_HTPA_PROCESSOR_THREAD_PRIORITY
	int "HTPA processor worker priority"
	default 5
	help
	  Scheduling priority of the frame processing worker.

endif # VIDEO_HTPA_PROCESSOR
```

## drivers/video/Kconfig.imx219
```kconfig
# Copyright (c) 2024 tinyVision.ai Inc.
# SPDX-License-Identifier: Apache-2.0

config VIDEO_IMX219
	bool "IMX219 8 Mega-Pixel CMOS image sensor"
	select I2C
	select GPIO if $(dt_compat_any_has_prop,$(DT_COMPAT_SONY_IMX219),reset-gpios)
	depends on DT_HAS_SONY_IMX219_ENABLED
	default y
	help
	  Enable driver for IMX219 8 Mega-Pixel CMOS image sensor
```

## drivers/video/Kconfig.max96724
```kconfig
# Copyright (c) 2026 Charles Dias
# SPDX-License-Identifier: Apache-2.0

config VIDEO_MAX96724
	bool "ADI MAX96724 GMSL2 deserializer"
	select I2C
	depends on DT_HAS_ADI_MAX96724_ENABLED
	default y
	help
	  Enable driver for the ADI MAX96724 quad GMSL2 deserializer.
	  The MAX96724 receives video data over a GMSL2 coaxial link
	  and outputs it via MIPI CSI-2 D-PHY.

if VIDEO_MAX96724

config VIDEO_MAX96724_INIT_PRIORITY
	int "MAX96724 init priority"
	default 56
	help
	  Initialization priority for the MAX96724 deserializer. Must run
	  after the host I2C controller (typically priority 50) and before
	  the MAX96717 serializer (default 58), so that the deserializer's
	  I2C proxy is live when the serializer is initialized through it.
	  Slot 57 belongs to the deserializer's I2C gate.

endif

config VIDEO_GMSL_RAW10_DOUBLE
	bool "Carry RAW10 as 20-bit double pixels over the GMSL2 link"
	depends on VIDEO_MAX96717 || VIDEO_MAX96724
	default y
	help
	  Pixel-mode bit-depth doubling for 10-bit streams: the serializer packs
	  two pixels per 20-bit word (bpp10dblz, soft bpp 20) and the
	  deserializer unpacks them with its alternate memory map (ALT_MEM_MAP10).
	  The pixel clock halves and the link overhead drops from one bit per
	  pixel to one bit per pixel pair. Both drivers follow this option, so a
	  link is doubled at both ends or at neither.

	  Undoubled, an IMX219 at 912 Mbps per lane needs 2.23 Gbps of a 3 Gbps
	  link and loses the end of every line; doubled, it needs 2.13 Gbps.
```

## drivers/video/Kconfig.mchp_sam_csi2dc
```kconfig
# Microchip SAM CSI-2 Demux Controller driver configuration options

# Copyright (C) 2025 Microchip Technology Inc. and its subsidiaries
# SPDX-License-Identifier: Apache-2.0

config VIDEO_MCHP_SAM_CSI2DC
	bool "Microchip SAM CSI-2 Demux Controller driver"
	default y
	depends on DT_HAS_MICROCHIP_SAMA7G5_CSI2DC_ENABLED
	select VIDEO_MCHP_SAM_CSI2HOST
	help
	  Enable the driver for the CSI-2 Demux Controller found on the Microchip
	  SAMA7G5 family. It converts the CSI-2 stream received by the MIPI CSI-2
	  host controller into a parallel stream for the Image Sensor Controller.

config VIDEO_MCHP_SAM_CSI2DC_INIT_PRIORITY
	int "Microchip SAM CSI-2 Demux Controller init priority"
	default 62
	depends on VIDEO_MCHP_SAM_CSI2DC
	help
	  Initialization priority of the CSI-2 Demux Controller. It must
	  initialize after the MIPI CSI-2 host controller.
```

## drivers/video/Kconfig.mchp_sam_csi2host
```kconfig
# Microchip SAM MIPI CSI-2 host controller driver configuration options

# Copyright (C) 2025 Microchip Technology Inc. and its subsidiaries
# SPDX-License-Identifier: Apache-2.0

config VIDEO_MCHP_SAM_CSI2HOST
	bool "Microchip SAM MIPI CSI-2 host controller driver"
	default y
	depends on DT_HAS_MICROCHIP_SAMA7G5_CSI2HOST_ENABLED
	help
	  Enable the driver for the MIPI CSI-2 host controller and its D-PHY
	  receiver found on the Microchip SAMA7G5 family. It feeds the CSI-2
	  Demux Controller (CSI2DC).

config VIDEO_MCHP_SAM_CSI2HOST_INIT_PRIORITY
	int "Microchip SAM MIPI CSI-2 host controller init priority"
	default 61
	depends on VIDEO_MCHP_SAM_CSI2HOST
	help
	  Initialization priority of the MIPI CSI-2 host controller. It must
	  initialize after the image sensor it receives data from.
```

## drivers/video/Kconfig.mchp_sam_isc
```kconfig
# Microchip SAM Image Sensor Controller driver configuration options

# Copyright (C) 2025 Microchip Technology Inc. and its subsidiaries
# SPDX-License-Identifier: Apache-2.0

config VIDEO_MCHP_SAM_ISC
	bool "Microchip SAM Image Sensor Controller driver"
	default y
	depends on DT_HAS_MICROCHIP_SAMA7G5_ISC_ENABLED
	help
	  Enable the driver for the eXtended Image Sensor Controller (XISC) found
	  on the Microchip SAMA7G5 family. It captures a parallel video stream,
	  optionally converts raw Bayer frames to RGB or YUV, and writes the
	  frames to memory.

config VIDEO_MCHP_SAM_ISC_INIT_PRIORITY
	int "Microchip SAM Image Sensor Controller init priority"
	default 63
	depends on VIDEO_MCHP_SAM_ISC
	help
	  Initialization priority of the Image Sensor Controller. It must
	  initialize after the device providing its parallel input.
```

## drivers/video/Kconfig.mcux_csi
```kconfig
# NXP MCUX CSI driver configuration options

# Copyright (c) 2019, Linaro Limited
# SPDX-License-Identifier: Apache-2.0

config VIDEO_MCUX_CSI
	bool "NXP MCUX CMOS Sensor Interface (CSI) driver"
	default y
	depends on DT_HAS_NXP_IMX_CSI_ENABLED
	select PINCTRL

config VIDEO_MCUX_CSI_INIT_PRIORITY
	int "NXP MCUX CSI init priority"
	default 59
	depends on VIDEO_MCUX_CSI
	help
	  Initialization priority for the CSI interface on an NXP MCUX device.

config VIDEO_MCUX_MIPI_CSI2_MAX_FORMATS
	int "Max number of formats in the capability format list"
	default 32
	help
	  Number of formats that can be generated from the source device. The table of formats is
	  populated once from the source device and the number of formats stays the same during the
	  execution.
```

## drivers/video/Kconfig.mcux_pngdec
```kconfig
# SPDX-License-Identifier: Apache-2.0
#
# Copyright 2026 NXP

config VIDEO_MCUX_PNGDEC
	bool "NXP PNG Decoder"
	default y
	depends on DT_HAS_NXP_PNGDEC_ENABLED
	help
	  Enable NXP PNG decoder video device driver.
```

## drivers/video/Kconfig.native_sim_fifo
```kconfig
# Copyright The Zephyr Project Contributors
# SPDX-License-Identifier: Apache-2.0

config VIDEO_NATIVE_SIM_FIFO
	bool "Native simulator host FIFO video source [EXPERIMENTAL]"
	default y
	depends on DT_HAS_ZEPHYR_NATIVE_SIM_VIDEO_FIFO_ENABLED
	depends on NATIVE_LIBRARY
	select NATIVE_USE_NSI_ERRNO
	select EXPERIMENTAL
	help
	  Enable a video capture device reading raw frames from a named pipe
	  (FIFO) on the host filesystem. A host process such as ffmpeg feeds the
	  FIFO.
```

## drivers/video/Kconfig.ov5647
```kconfig
# SPDX-FileCopyrightText: Copyright The Zephyr Project Contributors
# SPDX-License-Identifier: Apache-2.0

config VIDEO_OV5647
	bool "OV5647 CMOS digital image sensor"
	select I2C
	select GPIO if $(dt_compat_any_has_prop,$(DT_COMPAT_OVTI_OV5647),pwdn-gpios)
	depends on DT_HAS_OVTI_OV5647_ENABLED
	default y
	help
	  Enable driver for OV5647 CMOS digital image sensor device
```

## drivers/video/Kconfig.sc2336
```kconfig
# Copyright (c) 2026 Espressif Systems (Shanghai) Co., Ltd.
# SPDX-License-Identifier: Apache-2.0

config VIDEO_SC2336
	bool "SC2336 2 Mega-Pixel CMOS image sensor"
	select I2C
	select GPIO if $(dt_compat_any_has_prop,$(DT_COMPAT_SMARTSENS_SC2336),reset-gpios) || \
			$(dt_compat_any_has_prop,$(DT_COMPAT_SMARTSENS_SC2336),powerdown-gpios)
	depends on DT_HAS_SMARTSENS_SC2336_ENABLED
	default y
	help
	  Enable driver for the SmartSens SC2336 2 Mega-Pixel CMOS image sensor.
```

## drivers/video/Kconfig.stm32_dcmi
```kconfig
# STM32 DCMI driver configuration options

# Copyright (c) 2024 Charles Dias <charlesdias.cd@outlook.com>
# SPDX-License-Identifier: Apache-2.0

config VIDEO_STM32_DCMI
	bool "STM32 Digital camera interface (DCMI) driver"
	default y
	depends on DT_HAS_ST_STM32_DCMI_ENABLED
	select PINCTRL
	select RESET
	select USE_STM32_HAL_DCMI
	select USE_STM32_HAL_MDMA if SOC_SERIES_STM32H7X
	select DMA
	select USE_STM32_HAL_DMA
	select USE_STM32_HAL_DMA_EX
	help
	  Enable driver for STM32 Digital camera interface periheral.
```
