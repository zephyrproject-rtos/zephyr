## drivers/stepper_motor/Kconfig
```kconfig
# SPDX-FileCopyrightText: Copyright (c) 2023 Carl Zeiss Meditec AG
# SPDX-License-Identifier: Apache-2.0

menuconfig STEPPER_MOTOR_CONTROLLER
	bool "Stepper Motor Controller"
	help
		Enable stepper motor controller

if STEPPER_MOTOR_CONTROLLER

module = STEPPER_MOTOR_CONTROLLER
module-str = stepper_motor_controller
source "subsys/logging/Kconfig.template.log_config"

config STEPPER_MOTOR_CONTROLLER_INIT_PRIORITY
	int "Stepper Motor Controller init priority"
	default 90
	help
	  Stepper motor controller initialization priority.

comment "Stepper Motor Controller Drivers"

source "drivers/stepper_motor/tmc5041/Kconfig"

endif
```

## drivers/stepper_motor/tmc5041/Kconfig
```kconfig
# SPDX-FileCopyrightText: Copyright (c) 2023 Carl Zeiss Meditec AG
# SPDX-License-Identifier: Apache-2.0

menu "TMC5041 Controller and Device"

config TMC5041_SPI
	bool "Use TMC5041 with SPI"
	help
	  If y, the TMC5041 module uses SPI

config TMC5041
	bool "Activate driver for TMC5041"
	default $(dt_compat_enabled,$(DT_COMPACT_TRINAMIC_TMC5041))
	depends on SPI
	select TMC5041_SPI
	help
	  TMC5041 dual controller/driver for up to two 2-phase bipolar stepper motors.

config TMC5041_INT
	bool "TMC5041 interrupt handling support via INT pin"
	depends on TMC5041
	help
	  When enabled, the TMC5041 can be provided with a interrupt input GPIO to
	  in order to react on a position reached event. In case more than one
	  interrupt source is possible, it is necessary to carefully check for the
	  actual event, without risking losing an event.

config TMC5041_SHELL
	bool "TMC5041 shell"
	depends on TMC5041
	depends on SHELL
	default y if !SHELL_MINIMAL
	help
	  This shell provides specialised access to basic trinamic tmc5041 shell to
	  read/write registers. Here, information about the TMC5041 registers are
	  accessible.

menuconfig TMC5041_STEPPER_MOTOR_DEVICE
	bool "A tmc5041 based Stepper Motor Device"
	help
	  This menu allows to enable a stepper motor device

if TMC5041_STEPPER_MOTOR_DEVICE

config TMC5041_STEPPER_MOTOR_DEVICE_SHELL
	bool "Shell for a tmc5041 stepper motor device"
	depends on TMC5041_STEPPER_MOTOR_DEVICE
	depends on SHELL
	default y if !SHELL_MINIMAL
	help
	  This shell provides specialised access to basic stepper motor device shell
	  to execute various functions.

module = STEPPER_MOTOR_DEVICE
module-str = STEPPER_MOTOR_DEVICE
source "subsys/logging/Kconfig.template.log_config"

config STEPPER_MOTOR_DEVICE_INIT_PRIORITY
	int "Stepper Motor Device init priority"
	default 90
	help
	  Stepper motor device initialization priority.

endif

endmenu
```

## drivers/stepper_motor_controller/Kconfig
```kconfig
# SPDX-FileCopyrightText: Copyright (c) 2023 Carl Zeiss Meditec AG
# SPDX-License-Identifier: Apache-2.0

menuconfig STEPPER_MOTOR_CONTROLLER
	bool "Stepper Motor Controller"
	help
		Enable stepper motor controller

if STEPPER_MOTOR_CONTROLLER

module = STEPPER_MOTOR_CONTROLLER
module-str = stepper_motor_controller
source "subsys/logging/Kconfig.template.log_config"

config STEPPER_MOTOR_CONTROLLER_INIT_PRIORITY
	int "Stepper Motor Controller init priority"
	default 90
	help
	  Stepper motor controller initialization priority.

config STEPPER_MOTOR_CONTROLLER_HAS_CONSTANT_VELOCITY_MODE
	bool "Controller has constant speed mode"
	help
	  A constant speed command produces a motion in order to reach and maintain a user defined target speed

config STEPPER_MOTOR_CONTROLLER_HAS_STALL_DETECTION
	bool "Controller has stall detection"
	help
	  Stepper Motor Controller has stall detection and can stop the motor upon detecting stall guard

config STEPPER_MOTOR_CONTROLLER_HAS_ABSOLUTE_POSITIONING
	bool "Controller allows absolute positioning"
	help
	  Prior to normal operation of the drive an absolute reference position must be set. The reference
	  position can be found using a mechanical stop which can be detected by stall detection, or by a
	  reference switch.

comment "Stepper Motor Controller Drivers"

endif
```

## drivers/stm32mini_dev_button/Kconfig
```kconfig
menuconfig BUTTON
	bool "key input Drivers"
	help
	  Enable display drivers

if BUTTON

module = BUTTON
module-str = button_input

source "drivers/stm32mini_dev_button/Kconfig.stm32mini_dev_button"

endif
```

## drivers/stm32mini_dev_button/Kconfig.stm32mini_dev_button
```kconfig
# Copyright (c) 2019 Marc Reilly <marc@cpdesign.com.au>
# SPDX-License-Identifier: Apache-2.0

menuconfig BUTTON_INPUT
	bool "stm32mini_dev input driver"
    default y
	help
	  Enable driver for stm32mini_dev input driver.
```

## drivers/syscon/Kconfig
```kconfig
# SYSCON configuration options

# Copyright (c) 2021 Carlo Caione <ccaione@baylibre.com>
# SPDX-License-Identifier: Apache-2.0

#
# SYSCON options
#
menuconfig SYSCON
	bool "System Controller (SYSCON) drivers"
	help
	  SYSCON (System Controller) drivers. System controller node represents
	  a register region containing a set of miscellaneous registers. The
	  registers are not cohesive enough to represent as any specific type
	  of device. The typical use-case is for some other node's driver, or
	  platform-specific code, to acquire a reference to the syscon node and
	  extract information from there.

if SYSCON

module = SYSCON
module-str = syscon
source "subsys/logging/Kconfig.template.log_config"

config SYSCON_GENERIC
	bool "Generic SYSCON (System Controller) driver"
	default y
	depends on DT_HAS_SYSCON_ENABLED
	help
	  Enable generic SYSCON (System Controller) driver

config SYSCON_INIT_PRIORITY
	int "SYSCON (System Controller) driver init priority"
	default 50
	help
	  This option controls the priority of the syscon device
	  initialization. Higher priority ensures that the device is
	  initialized earlier in the startup cycle. If unsure, leave at default
	  value

endif # SYSCON
```

## drivers/syscon/Kconfig.bflb_efuse
```kconfig
# Copyright (c) 2024-2025 MASSDRIVER EI (massdriver.space)
# SPDX-License-Identifier: Apache-2.0

config SYSCON_BFLB_EFUSE
	bool "Bouffalolab EFUSEs driver"
	default y
	depends on DT_HAS_BFLB_EFUSE_ENABLED
	help
	  E-Fuse access via SYSCON API for Bouffalolab platforms.
```

## drivers/syscon/Kconfig.nxp_imx_ocotp
```kconfig
# Copyright (c) 2025 Basalte bv
# SPDX-License-Identifier: Apache-2.0

config SYSCON_IMX_OCOTP
	bool "NXP i.MX on-chip OTP (OCOTP)"
	default y
	depends on DT_HAS_NXP_IMX_OCOTP_ENABLED
	help
	  OCOTP access via SYSCON API for NXP i.MX platforms.
```

## drivers/syscon/Kconfig.sifli_efuse
```kconfig
# Copyright (c) 2025 SiFli Technologies(Nanjing) Co., Ltd
# SPDX-License-Identifier: Apache-2.0

config SYSCON_SIFLI_EFUSE
	bool "SiFli SF32LB eFuse driver"
	default y
	depends on DT_HAS_SIFLI_SF32LB_EFUSE_ENABLED
	help
	  E-Fuse access via SYSCON API for SiFli SF32LB platforms.
	  The driver caches entire eFuse content at init time for
	  fast subsequent reads.
```

## drivers/tee/Kconfig
```kconfig
# Copyright (c) 2023 EPAM Systems
# SPDX-License-Identifier: Apache-2.0

menuconfig TEE
	bool "Trusted Environment Drivers"
	help
	  Include TEE drivers in system config

if TEE

module = TEE
module-str = tee

comment "Device Drivers"

source "drivers/tee/optee/Kconfig"

endif # TEE
```

## drivers/tee/optee/Kconfig
```kconfig
# Copyright (c) 2023 EPAM Systems
# SPDX-License-Identifier: Apache-2.0

config OPTEE
	bool "OP-TEE driver"
	depends on (ARM64 && ARMV8_A_NS && HAS_ARM_SMCCC) || ZTEST
	help
	  This implements support of the OP-TEE firmware which is loaded
	  as BL32 image. OP-TEE is a Trust Zone OS which implements mechanisms
	  of the hardware isolation and rely to ARM TrustZone technology.
	  Driver requests functions from the OP-TEE and implements RPC mechanism
	  needed by OP-TEE to run services. See https://www.op-tee.org for more
	  information.

config OPTEE_MAX_NOTIF
	int "Max number of OP-TEE notifications"
	depends on OPTEE
	default 255
	help
	 Sets the maximum notifications from OP-TEE to the Normal World. OP-TEE using
	 this mechanism for the synchronization.
```

## drivers/timeaware_gpio/Kconfig
```kconfig
# Kconfig - INTEL PMC TGPIO configuration options
#
# Copyright (c) 2023 Intel Corporation
#
# SPDX-License-Identifier: Apache-2.0
#

menuconfig TIMEAWARE_GPIO_INTEL
	bool "Intel PMC Time aware GPIO driver"
	default y
	depends on DT_HAS_INTEL_PMC_TAGPIO_ENABLED
	help
	  Intel PMC time aware GPIO driver found on Intel PCH subsystem
```

## drivers/timeaware_gpio/Kconfig.intel
```kconfig
# INTEL PMC TGPIO configuration options
#
# Copyright (c) 2023 Intel Corporation
# SPDX-License-Identifier: Apache-2.0

config TIMEAWARE_GPIO_INTEL
	bool "Intel Time aware GPIO driver"
	default y
	depends on DT_HAS_INTEL_TIMEAWARE_GPIO_ENABLED
	help
	  Intel time aware GPIO driver found on Intel PCH subsystem
```

## drivers/timer/Kconfig
```kconfig
# Timer driver configuration options

# Copyright (c) 2014-2015 Wind River Systems, Inc.
# Copyright (c) 2016 Cadence Design Systems, Inc.
# Copyright (c) 2019 Intel Corp.
# SPDX-License-Identifier: Apache-2.0

if SYS_CLOCK_EXISTS

menu "Timer drivers"

config TIMER_HAS_64BIT_CYCLE_COUNTER
	bool
	help
	  When this option is true, the k_cycle_get_64() call is
	  available to provide values from a 64-bit cycle counter.

config TIMER_READS_ITS_FREQUENCY_AT_RUNTIME
	bool "Timer queries its hardware to find its frequency at runtime"
	help
	  The drivers select this option automatically when needed. Do not modify
	  this unless you have a very good reason for it.

config SYSTEM_CLOCK_SLOPPY_IDLE
	bool "Timer allowed to skew uptime clock during idle"
	help
	  When true, the timer driver is not required to maintain a
	  correct system uptime count when the system enters idle.
	  Some platforms may take advantage of this to reduce the
	  overhead from regular interrupts required to handle counter
	  wraparound conditions.

config SYSTEM_CLOCK_INIT_PRIORITY
	int "System clock driver initialization priority"
	default 0
	help
	  This options can be used to set a specific initialization priority
	  value for the system clock driver. As driver initialization  might need
	  the clock to be running already, you should let the default value as it
	  is (0).

# Hidden option to be selected by individual SoC.
config TICKLESS_CAPABLE
	bool
	help
	  Timer drivers should select this flag if they are capable of
	  supporting tickless operation.  That is, a call to
	  sys_clock_set_timeout() with a number of ticks greater than
	  one should be expected not to produce a call to
	  sys_clock_announce() (really, not to produce an interrupt at
	  all) until the specified expiration.

config SYSTEM_TIMER_HAS_DISABLE_SUPPORT
	bool
	help
	  This option should be selected by drivers implementing support for
	  sys_clock_disable() API.

config SYSTEM_CLOCK_LOCK_FREE_COUNT
	bool
	help
	  This option should be selected by drivers implementing a lock free
	  cycle count accessor. This is needed for instrumenting spin lock
	  hold times.

source "drivers/timer/Kconfig.altera_avalon"
source "drivers/timer/Kconfig.ambiq"
source "drivers/timer/Kconfig.x86"
source "drivers/timer/Kconfig.arcv2"
source "drivers/timer/Kconfig.arm_arch"
source "drivers/timer/Kconfig.cavs"
source "drivers/timer/Kconfig.cc13xx_cc26xx_rtc"
source "drivers/timer/Kconfig.cortex_m_systick"
source "drivers/timer/Kconfig.esp32"
source "drivers/timer/Kconfig.gecko"
source "drivers/timer/Kconfig.ite_it8xxx2"
source "drivers/timer/Kconfig.leon_gptimer"
source "drivers/timer/Kconfig.litex"
source "drivers/timer/Kconfig.mchp_xec_rtos"
source "drivers/timer/Kconfig.mcux_gpt"
source "drivers/timer/Kconfig.mcux_lptmr"
source "drivers/timer/Kconfig.mcux_os"
source "drivers/timer/Kconfig.mips_cp0"
source "drivers/timer/Kconfig.native_posix"
source "drivers/timer/Kconfig.npcx_itim"
source "drivers/timer/Kconfig.nrf_rtc"
source "drivers/timer/Kconfig.nrf_grtc"
source "drivers/timer/Kconfig.nrf_xrtc"
source "drivers/timer/Kconfig.rcar_cmt"
source "drivers/timer/Kconfig.riscv_machine"
source "drivers/timer/Kconfig.rv32m1_lptmr"
source "drivers/timer/Kconfig.sam0_rtc"
source "drivers/timer/Kconfig.smartbond"
source "drivers/timer/Kconfig.stm32_lptim"
source "drivers/timer/Kconfig.ti_dm_timer"
source "drivers/timer/Kconfig.xlnx_psttc"
source "drivers/timer/Kconfig.xtensa"
source "drivers/timer/Kconfig.mtk_adsp"

endmenu

endif # SYS_CLOCK_EXISTS
```

## drivers/timer/Kconfig.altera_avalon
```kconfig
# Copyright (c) 2014-2015 Wind River Systems, Inc.
# Copyright (c) 2016 Cadence Design Systems, Inc.
# Copyright (c) 2019 Intel Corp.
# SPDX-License-Identifier: Apache-2.0

config ALTERA_AVALON_TIMER
	bool "Altera Avalon Interval Timer"
	default y
	depends on NIOS2
	help
	  This module implements a kernel device driver for the Altera Avalon
	  Interval Timer as described in the Embedded IP documentation, for use
	  with Nios II and possibly other Altera soft CPUs. It provides the
	  standard "system clock driver" interfaces.
```

## drivers/timer/Kconfig.ambiq
```kconfig
# SPDX-License-Identifier: Apache-2.0
#
# Copyright (c) 2023 Antmicro <www.antmicro.com>

config AMBIQ_STIMER_TIMER
	bool "Ambiq STIMER system clock driver"
	default y
	depends on DT_HAS_AMBIQ_STIMER_ENABLED
	select AMBIQ_HAL
	select TICKLESS_CAPABLE
	select AMBIQ_HAL_USE_STIMER
	help
	  Ambiq Apollo4 stimer driver
```

## drivers/timer/Kconfig.amd_tmrctr
```kconfig
#
# Copyright 2026 Advanced Micro Devices, Inc.
#
# SPDX-License-Identifier: Apache-2.0
#

config AMD_TMRCTR
	bool "AMD AXI Timer"
	default y
	depends on DT_HAS_AMD_XPS_TIMER_1_00_A_ENABLED
	select TICKLESS_CAPABLE
	select TIMER_HAS_64BIT_CYCLE_COUNTER
	help
	  This module implements a kernel device driver for the AMD AXI
	  Timer IP.

	  The driver supports periodic and tickless kernel operation using
	  one timer channel as the clock event source and the second timer
	  channel as the clock source.
```

## drivers/timer/Kconfig.arcv2
```kconfig
# Copyright (c) 2014-2015 Wind River Systems, Inc.
# Copyright (c) 2016 Cadence Design Systems, Inc.
# Copyright (c) 2019 Intel Corp.
# SPDX-License-Identifier: Apache-2.0

menuconfig ARCV2_TIMER
	bool "ARC Timer"
	default y
	depends on ARC
	select TICKLESS_CAPABLE
	help
	  This module implements a kernel device driver for the ARCv2 processor timer 0
	  and provides the standard "system clock driver" interfaces.

config ARCV2_TIMER_IRQ_PRIORITY
	int "ARC timer interrupt priority"
	default 0
	depends on ARCV2_TIMER
	help
	  This option specifies the IRQ priority used by the ARC timer. Lower
	  values have higher priority.
```

## drivers/timer/Kconfig.arm_arch
```kconfig
# Copyright (c) 2014-2015 Wind River Systems, Inc.
# Copyright (c) 2016 Cadence Design Systems, Inc.
# Copyright (c) 2019 Intel Corp.
# SPDX-License-Identifier: Apache-2.0

config ARM_ARCH_TIMER
	bool "ARM architected timer"
	depends on GIC
	select ARCH_HAS_CUSTOM_BUSY_WAIT
	select TICKLESS_CAPABLE
	select TIMER_HAS_64BIT_CYCLE_COUNTER
	help
	  This module implements a kernel device driver for the ARM architected
	  timer which provides per-cpu timers attached to a GIC to deliver its
	  per-processor interrupts via PPIs.

config ARM_ARCH_TIMER_ERRATUM_740657
	bool "ARM architected timer is affected by ARM erratum 740657"
	depends on ARM_ARCH_TIMER
	help
	  This option indicates that the ARM architected timer as implemented
	  in the target hardware is affected by the ARM erratum 740657 (comp.
	  ARM Cortex-A9 processors Software Developers Errata Notice, ARM
	  document ID032315) which leads to an additional, spurious interrupt
	  indication upon every actual timer interrupt. This option activates
	  the workaround for the erratum within the timer driver.
```
