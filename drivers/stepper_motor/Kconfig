## drivers/timer/Kconfig.aurix
```kconfig
# Copyright (c) 2026 Infineon Technologies AG
# SPDX-License-Identifier: Apache-2.0

config AURIX_STM
	bool "AURIX System Timer Module (STM) support"
	depends on SOC_SERIES_TC3X || SOC_SERIES_TC4X
	default y
	select TICKLESS_CAPABLE
	select TIMER_HAS_64BIT_CYCLE_COUNTER
	select SYSTEM_TIMER_HAS_DISABLE_SUPPORT
	select SYSTEM_CLOCK_LOCK_FREE_COUNT
	help
	  This option enables the system timer driver for Infineon AURIX
	  System Timer Modules on TC3X and TC4X devices.
```

## drivers/timer/Kconfig.bcm2835
```kconfig
# Copyright (c) 2026 Jonathan Elliot Peace <jep@alphabetiq.com>
# SPDX-License-Identifier: Apache-2.0

config BCM2835_SYSTEM_TIMER
	bool "BCM2835 system timer"
	default y
	depends on DT_HAS_BRCM_BCM2835_SYSTEM_TIMER_ENABLED
	select TICKLESS_CAPABLE
	help
	  Kernel system-clock driver for the Broadcom BCM2835 free-running
	  1 MHz system timer (Raspberry Pi 1 / Zero / Zero W). A compare-channel
	  match interrupt drives the kernel tick in either tickless or ticking
	  mode.
```

## drivers/timer/Kconfig.cavs
```kconfig
# Copyright (c) 2014-2015 Wind River Systems, Inc.
# Copyright (c) 2016 Cadence Design Systems, Inc.
# Copyright (c) 2019 Intel Corp.
# SPDX-License-Identifier: Apache-2.0

# Keep this option as an alias to INTEL_ADSP_TIMER because
# SoF is still referencing this symbol. The reason is the
# symbiotic relationship between these two projects, that from
# Zephyr's perspective is the framework and also the application.
# Once it gets merged, we have to update SoF to use INTEL_ADSP_TIMER
# option and remove it.
config CAVS_TIMER
	bool
	help
	  Temporary alias to INTEL_ADSP_TIMER

config INTEL_ADSP_TIMER
	bool "Intel Audio DSP timer"
	select CAVS_TIMER
	select TICKLESS_CAPABLE
	select TIMER_HAS_64BIT_CYCLE_COUNTER
	help
	  The DSP wall clock timer is a timer driven directly by
	  external oscillator and is external to the CPU core(s).
	  It is not as fast as the internal core clock, but provides
	  a common and synchronized counter for all CPU cores (which
	  is useful for SMP).
```

## drivers/timer/Kconfig.cc13x2_cc26x2_rtc
```kconfig
# Copyright (c) 2014-2015 Wind River Systems, Inc.
# Copyright (c) 2016 Cadence Design Systems, Inc.
# Copyright (c) 2019 Intel Corp.
# SPDX-License-Identifier: Apache-2.0

config CC13X2_CC26X2_RTC_TIMER
	bool "TI SimpleLink CC13x2/CC26x2 RTC timer"
	default y
	depends on DT_HAS_TI_CC13XX_CC26XX_RTC_ENABLED
	select TICKLESS_CAPABLE
	select TIMER_HAS_64BIT_CYCLE_COUNTER
	help
	  This module implements a kernel device driver for the TI SimpleLink
	  CC13X2_CC26X2 series Real Time Counter and provides the standard
	  "system clock driver" interfaces.
```

## drivers/timer/Kconfig.cc13xx_cc26xx_rtc
```kconfig
# Copyright (c) 2014-2015 Wind River Systems, Inc.
# Copyright (c) 2016 Cadence Design Systems, Inc.
# Copyright (c) 2019 Intel Corp.
# SPDX-License-Identifier: Apache-2.0

config CC13XX_CC26XX_RTC_TIMER
	bool "TI SimpleLink CC13xx/CC26xx RTC system clock timer"
	default y
	depends on DT_HAS_TI_CC13XX_CC26XX_RTC_TIMER_ENABLED
	select TICKLESS_CAPABLE
	select TIMER_HAS_64BIT_CYCLE_COUNTER
	help
	  This module implements a kernel device driver for the TI SimpleLink
	  CC13XX_CC26XX series Real Time Counter and provides the standard
	  "system clock driver" interfaces.
```

## drivers/timer/Kconfig.cc23x0_systim
```kconfig
# Copyright (c) 2024 Texas Instruments Incorporated
# Copyright (c) 2024 BayLibre, SAS
#
# SPDX-License-Identifier: Apache-2.0

config CC23X0_SYSTIM_TIMER
	bool "TI SimpleLink CC23X0 system clock timer"
	default y
	depends on HAS_CC23X0_SDK
	select TICKLESS_CAPABLE
	help
	  This module provides the "system clock driver" interfaces
	  for the TI Simplelink CC23X0 devices.
```
