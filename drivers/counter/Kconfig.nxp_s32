## drivers/counter/Kconfig.nxp_s32
```kconfig
# Copyright 2022-2023 NXP
# SPDX-License-Identifier: Apache-2.0

config COUNTER_NXP_S32_SYS_TIMER
	bool "NXP S32 System Timer Module driver"
	default y
	depends on DT_HAS_NXP_S32_SYS_TIMER_ENABLED
	select CLOCK_CONTROL
	help
	  Enable support for NXP S32 System Timer Module (STM) driver.
```

## drivers/counter/Kconfig.pic32cxsg
```kconfig
# Copyright (c) 2024 Microchip
# SPDX-License-Identifier: Apache-2.0

config COUNTER_PIC32CXSG_TC32
	bool "Microchip PIC32CXSG series 32-bit basic timer driver"
	default y
	depends on DT_HAS_PIC32CXSG_TC32_ENABLED
	help
	  Enable the Microchip PIC32CXSG series timer counter (TC) driver in 32-bit wide
	  mode.
```

## drivers/counter/Kconfig.qmsi
```kconfig
# Kconfig - counter configuration options

#
# Copyright (c) 2016 Intel Corporation
#
# SPDX-License-Identifier: Apache-2.0
#

config AON_COUNTER_QMSI
	bool "AON counter driver"
	depends on COUNTER && QMSI
	help
	  Enable support for AON counter.

config AON_COUNTER_QMSI_DEV_NAME
	string "QMSI AON Counter Device Name"
	depends on AON_COUNTER_QMSI
	default "AON_COUNTER"
	help
	  Specify the device name for AON counter driver.

config AON_TIMER_QMSI
	bool "AON periodic timer driver"
	depends on COUNTER && QMSI
	help
	  Enable support for AON periodic timer.

config COUNTER_0_NAME
	string "QMSI AON Timer Device Name"
	depends on AON_TIMER_QMSI
	default "AON_TIMER"
	help
	  Specify the device name for AON timer driver.

config AON_TIMER_IRQ_PRI
	int "Interrupt priority"
	depends on AON_TIMER_QMSI
	help
	  aon timer interrupt priority.

config AON_API_REENTRANCY
	bool "AON driver API reentrancy"
	depends on AON_TIMER_QMSI
	help
	  Enable support for AON driver API reentrancy.

config RTC_QMSI
	bool "QMSI RTC Driver"
	depends on QMSI
	help
	  Build QMSI RTC driver.

if RTC_QMSI

config RTC_QMSI_API_REENTRANCY
	bool
	prompt "RTC shim driver API reentrancy"
	help
	  Enable support for RTC shim driver API reentrancy.

config RTC_PRESCALER
	int
	default 1
	prompt "Prescaler size"
	help
	  RTC prescaler used to determine ticks per second

endif
```

## drivers/counter/Kconfig.renesas_ra
```kconfig
# Renesas RA Family

# Copyright (c) 2024-2026 Renesas Electronics Corporation
# SPDX-License-Identifier: Apache-2.0

config COUNTER_RA_AGT
	bool "Renesas RA AGT driver"
	default y
	depends on DT_HAS_RENESAS_RA_AGT_COUNTER_ENABLED
	select USE_RA_FSP_AGT
	help
	  Enable support for Renesas Low Power Asynchronous General Purpose Timer (AGT) driver.

config COUNTER_RENESAS_RA_ULPT
	bool "Renesas RA ULPT driver"
	default y
	depends on DT_HAS_RENESAS_RA_ULPT_COUNTER_ENABLED
	select USE_RA_FSP_ULPT
	help
	  Enable support for Renesas RA Ultra-Low-Power Timer (ULPT) Driver.
```

## drivers/counter/Kconfig.renesas_rcar
```kconfig
# Copyright (c) 2025 Renesas Electronics Corporation
# SPDX-License-Identifier: Apache-2.0

config COUNTER_RCAR_CMT
	bool "Renesas CMT counter driver"
	default y
	depends on DT_HAS_RENESAS_RCAR_CMT_COUNTER_ENABLED
	help
	  Enable R-Car CMT counter driver.
```

## drivers/counter/Kconfig.renesas_rz
```kconfig
# Copyright (c) 2024-2025 Renesas Electronics Corporation
# SPDX-License-Identifier: Apache-2.0

config COUNTER_RENESAS_RZ_GTM
	bool "Renesas RZ General Timer (GTM) Counter driver"
	default y
	depends on DT_HAS_RENESAS_RZ_GTM_COUNTER_ENABLED
	select USE_RZ_FSP_GTM
	help
	  Enable the counter driver for the Renesas RZ General Timer (GTM).

config COUNTER_RENESAS_RZ_CMTW
	bool "Renesas RZ Compare Match Timer W (CMTW) Counter driver"
	default y
	depends on DT_HAS_RENESAS_RZ_CMTW_COUNTER_ENABLED
	select USE_RZ_FSP_CMTW
	help
	  Enable the counter driver for the Renesas RZ Compare Match Timer W (CMTW).
```

## drivers/counter/Kconfig.rpi_pico
```kconfig
# Copyright (c) 2023 TOKITA Hiroshi
# SPDX-License-Identifier: Apache-2.0

config COUNTER_TIMER_RPI_PICO
	def_bool y
	select PICOSDK_USE_TIMER
	select PICOSDK_USE_CLAIM
	depends on DT_HAS_RASPBERRYPI_PICO_TIMER_ENABLED
```

## drivers/counter/Kconfig.rpi_pico_pit
```kconfig
# Copyright (c) 2024 Navimatix GmbH
# SPDX-License-Identifier: Apache-2.0

config COUNTER_RPI_PICO_PIT
	bool "RPI Pico PIT driver"
	default y
	depends on DT_HAS_RASPBERRYPI_PICO_PIT_CHANNEL_ENABLED
	select PICOSDK_USE_PWM
```

## drivers/counter/Kconfig.rts5912
```kconfig
# Realtek counter configuration options

# Copyright (c) 2025 Realtek Corporation
# SPDX-License-Identifier: Apache-2.0

config COUNTER_REALTEK_RTS5912
	bool "Realtek rts5912 series counter driver"
	default y
	depends on DT_HAS_REALTEK_RTS5912_TIMER_ENABLED
	help
	  Enable counter driver for Realtek RTS5912 MCU series. Such driver
	  will expose the basic timer devices present on the MCU.
```

## drivers/counter/Kconfig.rts5912_slwtmr
```kconfig
# Realtek counter configuration options

# Copyright (c) 2025 Realtek Corporation
# SPDX-License-Identifier: Apache-2.0

config COUNTER_REALTEK_RTS5912_SLWTMR
	bool "Realtek rts5912 series slow timer counter driver"
	default y
	depends on DT_HAS_REALTEK_RTS5912_SLWTIMER_ENABLED
	help
	  Enable counter driver for Realtek RTS5912 MCU series. Such driver
	  will expose the slow timer devices present on the MCU.
```

## drivers/counter/Kconfig.rv3032_counter
```kconfig
# Copyright (c) 2025 BayLibre, SAS
# SPDX-License-Identifier: Apache-2.0

config COUNTER_RV3032
	bool "RV3032 Counter driver"
	default y
	depends on DT_HAS_MICROCRYSTAL_RV3032_COUNTER_ENABLED
	depends on DT_HAS_MICROCRYSTAL_RV3032_MFD_ENABLED
	select MFD
	help
	  Enable dummy counter driver

config COUNTER_MICROCRYSTAL_RV3032_INIT_PRIORITY
	int "Init priority of rc3032c7 Counter"
	depends on COUNTER_RV3032
	default 50
	help
	  Initialization priority for the Microcrystal rv3032c7 Counter driver.
```

## drivers/counter/Kconfig.sam
```kconfig
# Copyright (c) 2021 Piotr Mienkowski
# SPDX-License-Identifier: Apache-2.0

# Workaround for not being able to have commas in macro arguments
DT_COMPAT_ATMEL_SAM_TC := atmel,sam-tc

config COUNTER_SAM_TC
	bool "Atmel SAM MCU family counter (TC) driver"
	default $(dt_compat_enabled,$(DT_COMPAT_ATMEL_SAM_TC))
	depends on SOC_FAMILY_SAM
	help
	  Enable the Atmel SAM MCU family counter (TC) driver.
```

## drivers/counter/Kconfig.sam0
```kconfig
# Copyright (c) 2019 Derek Hageman <hageman@inthat.cloud>
# SPDX-License-Identifier: Apache-2.0

config COUNTER_SAM0_TC32
	bool "SAM0 series 32-bit basic timer driver"
	default y
	depends on DT_HAS_ATMEL_SAM0_TC32_ENABLED
	select PINCTRL
	help
	  Enable the SAM0 series timer counter (TC) driver in 32-bit wide
	  mode.
```

## drivers/counter/Kconfig.sam_rtt
```kconfig
# Copyright 2023 Bjarki Arge Andreasen
# SPDX-License-Identifier: Apache-2.0

config COUNTER_SAM_RTT
	bool "Atmel SAM series Real-Time Timer (RTT) driver"
	depends on DT_HAS_ATMEL_SAM_RTT_ENABLED
	default y
```

## drivers/counter/Kconfig.silabs
```kconfig
# Silicon Labs Counter driver config

# Copyright (c) 2019, Piotr Mienkowski
# Copyright (c) 2026, Shontal Biton, Based on:
# Kconfig.mcux_lptmr, Copyright (c) 2020 Vestas Wind Systems A/S
# SPDX-License-Identifier: Apache-2.0

DT_CHOSEN_SILABS_SLEEPTIMER := silabs,sleeptimer

config COUNTER_GECKO_RTCC
	bool "Silicon Labs Gecko Counter (RTCC) driver"
	default y
	depends on DT_HAS_SILABS_GECKO_RTCC_ENABLED
	select SOC_GECKO_CMU
	select SOC_GECKO_RTCC
	help
	  Enable counter driver based on RTCC module for Silicon Labs Gecko
	  chips.

config COUNTER_GECKO_STIMER
	bool "Silicon Labs Gecko Counter Sleep Timer driver"
	default y
	depends on $(dt_chosen_enabled,$(DT_CHOSEN_SILABS_SLEEPTIMER))
	select SILABS_SISDK_SLEEPTIMER
	help
	  Enable the counter driver for Sleep Timer module for Silicon Labs
	  Gecko chips.

config COUNTER_SILABS_BURTC
	bool "Silicon Labs Counter Backup Timer (BURTC) driver"
	default y
	depends on DT_HAS_SILABS_BURTC_COUNTER_ENABLED
	select SILABS_SISDK_BURTC
	help
	  Enable the counter driver for Backup Real Time Counter module
	  for Silicon Labs chips.

config COUNTER_SILABS_BURTC_ALARM
	bool "BURTC alarm support"
	default y
	depends on COUNTER_SILABS_BURTC
	help
	  BURTC is a commonly used wake-up source for many Silabs MCUs and
	  may be used as the companion low-power timer for the Cortex-M
	  systick. Enabling single-shot alarm support requires reprogramming
	  the hardware compare register (COMP), which is the same
	  resource used for the periodic TOP callback. Because of this
	  hardware limitation, this Kconfig option selects whether alarm
	  support is enabled. When alarm support is enabled the driver will
	  not allow set TOP operation at runtime (attempts to set TOP will
	  return -ENOTSUP); When alarm support is disabled the driver will
	  not allow set and cancel ALARM operation at runtime (attempts to
	  set and cancel ALARM will return -ENOTSUP). Choose the configuration
	  that matches your application's requirements.
```

## drivers/counter/Kconfig.smartbond_timer
```kconfig
# Copyright (c) 2022 Renesas Electronics Corporation
# SPDX-License-Identifier: Apache-2.0

config COUNTER_SMARTBOND_TIMER
	bool "Renesas SmartBond(tm) counter driver"
	default y
	depends on DT_HAS_RENESAS_SMARTBOND_TIMER_ENABLED
	select CLOCK_CONTROL_SMARTBOND
	select CLOCK_CONTROL
	help
	  Enable the counter driver for for Renesas SmartBond(tm) family of processors.
```

## drivers/counter/Kconfig.stm32_rtc
```kconfig
# STM32 Cube LL RTC

# Copyright (c) 2018, Linaro Limited
# SPDX-License-Identifier: Apache-2.0

menuconfig COUNTER_RTC_STM32
	bool "STM32 Counter RTC driver"
	default y if !RTC
	depends on DT_HAS_ST_STM32_RTC_ENABLED
	depends on !SOC_SERIES_STM32WB0X
	select USE_STM32_LL_RTC
	help
	  Build RTC driver for STM32 SoCs.
	  Tested on STM32 C0, F0, F2, F3, F4, F7, G0, G4, H7, L1, L4, L5, U5 series

if COUNTER_RTC_STM32

config COUNTER_RTC_STM32_SAVE_VALUE_BETWEEN_RESETS
	bool "Save rtc time value between resets"
	default n
	help
	  Keep the counter value after each reset.

config COUNTER_RTC_STM32_SUBSECONDS
	bool "Use the subseconds as a basic tick."
	depends on !SOC_SERIES_STM32F1X
	help
	  Use the subseconds as the basic time tick. It increases resolution
	  of the counter. The frequency of the time is RTC Source Clock divided
	  by 2. It is the clock after the first asynchronous prescaler.
	  The config increases power consumption.

endif # COUNTER_RTC_STM32
```

## drivers/counter/Kconfig.stm32_timer
```kconfig
# Copyright (c) 2021 Kent Hall
# SPDX-License-Identifier: Apache-2.0

config COUNTER_TIMER_STM32
	bool "STM32 counter driver"
	default y
	depends on DT_HAS_ST_STM32_COUNTER_ENABLED
	select USE_STM32_LL_TIM
	select RESET
	help
	  Enable the counter driver for STM32 family of processors.
```

## drivers/counter/Kconfig.template.sam0_tc32
```kconfig
# Copyright (c) 2019 Derek Hageman <hageman@inthat.cloud>
#
# SPDX-License-Identifier: Apache-2.0
#


choice
	bool "Timer $(index) prescaler"

	config COUNTER_SAM0_TC32_$(index)_PRESCALER_1
		bool "clock / 1"
	config COUNTER_SAM0_TC32_$(index)_PRESCALER_2
		bool "clock / 2"
	config COUNTER_SAM0_TC32_$(index)_PRESCALER_4
		bool "clock / 4"
	config COUNTER_SAM0_TC32_$(index)_PRESCALER_8
		bool "clock / 8"
	config COUNTER_SAM0_TC32_$(index)_PRESCALER_16
		bool "clock / 16"
	config COUNTER_SAM0_TC32_$(index)_PRESCALER_64
		bool "clock / 64"
	config COUNTER_SAM0_TC32_$(index)_PRESCALER_256
		bool "clock / 256"
	config COUNTER_SAM0_TC32_$(index)_PRESCALER_1024
		bool "clock / 1024"

endchoice

config COUNTER_SAM0_TC32_$(index)_DIVISOR
	int
	default 1 if COUNTER_SAM0_TC32_$(index)_PRESCALER_1
	default 2 if COUNTER_SAM0_TC32_$(index)_PRESCALER_2
	default 4 if COUNTER_SAM0_TC32_$(index)_PRESCALER_4
	default 8 if COUNTER_SAM0_TC32_$(index)_PRESCALER_8
	default 16 if COUNTER_SAM0_TC32_$(index)_PRESCALER_16
	default 64 if COUNTER_SAM0_TC32_$(index)_PRESCALER_64
	default 256 if COUNTER_SAM0_TC32_$(index)_PRESCALER_256
	default 1024 if COUNTER_SAM0_TC32_$(index)_PRESCALER_1024
```

## drivers/counter/Kconfig.tmr_cmsdk_apb
```kconfig
# Counter and timer configuration options

# Copyright (c) 2016 Linaro Limited
# SPDX-License-Identifier: Apache-2.0

config TIMER_TMR_CMSDK_APB
	bool "ARM CMSDK (Cortex-M System Design Kit) Timer driver"
	default y
	depends on DT_HAS_ARM_CMSDK_TIMER_ENABLED
	help
	  The timers (TMR) present in the platform are used as timers.
	  This option enables the support for the timers.
```

## drivers/counter/Kconfig.xec
```kconfig
# XEC counter configuration options

# Copyright (c) 2019 Intel Corporation
# SPDX-License-Identifier: Apache-2.0

config COUNTER_XEC
	bool "Microchip XEC series counter driver"
	default y
	depends on DT_HAS_MICROCHIP_XEC_TIMER_ENABLED
	help
	  Enable counter driver for Microchip XEC MCU series. Such driver
	  will expose the basic timer devices present on the MCU.
```

## drivers/counter/Kconfig.xlnx
```kconfig
# Xilinx AXI Timer

# Copyright (c) 2020 Henrik Brix Andersen <henrik@brixandersen.dk>
# SPDX-License-Identifier: Apache-2.0

config COUNTER_XLNX_AXI_TIMER
	bool "Xilinx AXI Timer driver"
	default y
	depends on DT_HAS_XLNX_XPS_TIMER_1_00_A_ENABLED
	help
	  Enable counter support for the Xilinx AXI Timer v2.0 IP.
```

## drivers/counter/Kconfig.xlnx_ttc
```kconfig
# Copyright 2026 Advanced Micro Devices, Inc.
#
# SPDX-License-Identifier: Apache-2.0

# TTC Counter configuration

config COUNTER_XLNX_TTC
	bool "Xilinx TTC (Triple Timer Counter) driver"
	default y
	depends on DT_HAS_XLNX_TTC_COUNTER_ENABLED
	help
	  Enable driver for Xilinx TTC (Triple Timer Counter).
	  Each timer within a TTC block is treated as a separate counter device.

if COUNTER_XLNX_TTC

module = COUNTER_XLNX_TTC
module-str = ttc
source "subsys/logging/Kconfig.template.log_config"

endif # COUNTER_XLNX_TTC
```

## drivers/counter/Kconfig.xlnx_zynqmp_rtc
```kconfig
# Copyright (c) 2026 Advanced Micro Devices, Inc.
# SPDX-License-Identifier: Apache-2.0

config COUNTER_XLNX_ZYNQMP_RTC
	bool "Xilinx ZynqMP RTC driver"
	default y
	depends on DT_HAS_XLNX_ZYNQMP_RTC_ENABLED
	help
	  Enable the driver for the Xilinx Zynq Ultrascale+ MPSoC
	  Real Time Clock.
```

## drivers/counter/Kconfig.xuantie
```kconfig
# XUANTIE xiaohui&smartl COUNTER configuration option

# Copyright (C) 2017-2024 Alibaba Group Holding Limited
# SPDX-License-Identifier: Apache-2.0

config COUNTER_XUANTIE
	bool "XuanTie Freedom counter driver"
	default y
	help
	  This option enables the XuanTie xiaohui&smartl serial driver.
```
