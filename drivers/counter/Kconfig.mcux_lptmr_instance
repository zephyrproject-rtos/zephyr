## drivers/counter/Kconfig.mcux_lptmr_instance
```kconfig
# MCUXpresso SDK Low Power Timer (LPTMR)

# Copyright (c) 2020 Vestas Wind Systems A/S
# SPDX-License-Identifier: Apache-2.0

config COUNTER_MCUX_LPTMR
	bool "MCUX LPTMR driver"
	default y
	depends on DT_HAS_NXP_LPTMR_ENABLED
	help
	  Enable support for the MCUX Low Power Timer (LPTMR).

if PM || POWEROFF

# Only include following kconfig option when the lptmr
# works as a wakeup source.
config COUNTER_MCUX_LPTMR_WAKEUP_SOURCE_INDEX
	int "Index in wakeup unit when LPTMR is used as a wakeup source"
	default 6 if SOC_FAMILY_MCXN || SOC_FAMILY_MCXA
	default 0 if SOC_FAMILY_MCXW
	depends on ($(dt_nodelabel_bool_prop,lptmr$(mcux_hw_lptmr_index),wakeup-source))

endif
```

## drivers/counter/Kconfig.mcux_pit
```kconfig
# MCUXpresso SDK Periodic Interrupt Timer (PIT)

# Copyright 2020 NXP
# SPDX-License-Identifier: Apache-2.0

config COUNTER_MCUX_PIT
	bool "MCUX PIT driver"
	default y
	depends on DT_HAS_NXP_KINETIS_PIT_ENABLED
	help
	  Enable support for the MCUX Periodic Interrupt Timer (PIT).
```

## drivers/counter/Kconfig.mcux_qtmr
```kconfig
# MCUXpresso SDK QTMR

# Copyright (c) 2022 KT-Elektronik, Klaucke und Partner GmbH
# SPDX-License-Identifier: Apache-2.0

config COUNTER_MCUX_QTMR
	bool "MCUX QTMR driver"
	default y
	depends on DT_HAS_NXP_IMX_TMR_ENABLED
	help
	  Enable support for mcux Quad Timer (QTMR) driver.
```

## drivers/counter/Kconfig.mcux_rtc
```kconfig
# MCUXpresso SDK RTC

# Copyright (c) 2018, NXP
# SPDX-License-Identifier: Apache-2.0

config COUNTER_MCUX_RTC
	bool "MCUX RTC driver"
	default y
	depends on DT_HAS_NXP_KINETIS_RTC_ENABLED
	help
	  Enable support for mcux rtc driver.
```

## drivers/counter/Kconfig.mcux_rtc_jdp
```kconfig
# Copyright 2025 NXP
# SPDX-License-Identifier: Apache-2.0

config COUNTER_MCUX_RTC_JDP
	bool "MCUX RTC JDP driver"
	default y
	depends on DT_HAS_NXP_RTC_JDP_ENABLED
	help
	  Enable support for MCU RTC JDP driver.
```

## drivers/counter/Kconfig.mcux_snvs
```kconfig
# MCUXpresso SDK SNVS (Secure) RTC

# Copyright (c) 2021 Basalte bv
# SPDX-License-Identifier: Apache-2.0

config COUNTER_MCUX_SNVS
	bool "IMX SNVS RTC driver"
	default y
	depends on DT_HAS_NXP_IMX_SNVS_RTC_ENABLED
	help
	  Enable support for the IMX SNVS High/Low Power clock.

config COUNTER_MCUX_SNVS_SRTC
	bool "IMX SNVS SRTC low power support"
	depends on COUNTER_MCUX_SNVS
	default y
	help
	  Enable the low power SRTC in SNVS to synchronise.

config COUNTER_MCUX_SNVS_SRTC_WAKE
	bool "IMX SNVS wake-up on SRTC alarm"
	depends on COUNTER_MCUX_SNVS_SRTC
	default y
	help
	  Assert Wake-Up Interrupt on SRTC alarm
```

## drivers/counter/Kconfig.mcux_stm
```kconfig
# Copyright 2025 NXP
#
# SPDX-License-Identifier: Apache-2.0

# MCUXpresso SDK System Timer Module (STM)

config COUNTER_MCUX_STM
	bool "MCUX STM driver"
	default y
	depends on DT_HAS_NXP_STM_ENABLED
	help
	  Enable support for the MCUX System Timer Module (STM).
```

## drivers/counter/Kconfig.mcux_sysctr
```kconfig
# Copyright 2026 NXP
#
# SPDX-License-Identifier: Apache-2.0

# MCUXpresso SDK System Counter (SYS_CTR)

config COUNTER_MCUX_SYSCTR
	bool "MCUX System Counter (SYS_CTR) driver"
	default y
	depends on DT_HAS_NXP_SYSCTR_ENABLED
	help
	  Enable support for the NXP System Counter (SYS_CTR).
	  SYS_CTR is a 56-bit free-running up-counter that provides a shared
	  time base for multiple processor cores. It supports two compare
	  frames, each capable of generating an interrupt.
```

## drivers/counter/Kconfig.mcux_wake_timer
```kconfig
# MCUXpresso SDK Wake Timer

# Copyright 2026 NXP
# SPDX-License-Identifier: Apache-2.0

config COUNTER_MCUX_WAKE_TIMER
	bool "MCUX Wake Timer driver"
	default y
	depends on DT_HAS_NXP_WAKE_TIMER_ENABLED
	help
	  Enable support for the MCUX Wake Timer, a 32-bit down-counter
	  clocked at 1 kHz that can wake the chip from low-power modes.

config COUNTER_MCUX_WAKE_TIMER_ALARM
	bool "Wake Timer alarm support"
	depends on COUNTER_MCUX_WAKE_TIMER
	help
	  The Wake Timer has a single count/reload register, so the periodic
	  TOP callback and the single-shot ALARM both need the same hardware
	  resource. Because of this limitation, this Kconfig option selects
	  which one is available at runtime. When alarm support is enabled the
	  driver supports relative single-shot alarms only and will return
	  -ENOTSUP for absolute alarms and set TOP operation; when alarm support
	  is disabled the driver will not allow set and cancel ALARM operation at
	  runtime (attempts to set and cancel ALARM will return -ENOTSUP). Choose
	  the configuration that matches your application's requirements.

if COUNTER_MCUX_WAKE_TIMER_ALARM
comment "NOTE: Enabling Wake Timer ALARM disables set TOP operation and absolute alarms."
endif
```

## drivers/counter/Kconfig.mec5
```kconfig
# Microchip MEC5 basic timer counter configuration options

# Copyright (c) 2024 Microchip Technology Inc.
# SPDX-License-Identifier: Apache-2.0

config COUNTER_MEC5_BTMR
	bool "Microchip MEC5 series counter driver using basic timer"
	default y
	depends on DT_HAS_MICROCHIP_MEC5_BTMR_COUNTER_ENABLED
	help
	  Enable counter driver for Microchip XEC MCU series. Such driver
	  will expose the basic timer devices present on the MCU.
```

## drivers/counter/Kconfig.mspm0
```kconfig
# Copyright (c) 2025 Linumiz GmbH
# Copyright (c) 2025 Texas Instruments Incorporated
# SPDX-License-Identifier: Apache-2.0

config COUNTER_MSPM0_TIMER
	bool "TI MSPM GPTIMER counter driver"
	default y
	depends on DT_HAS_TI_MSPM0_TIMER_COUNTER_ENABLED
	help
	  Enable the TI MSPM MCU family counter driver.
```

## drivers/counter/Kconfig.native_posix
```kconfig
# Copyright (c) 2020, Nordic Semiconductor ASA
# SPDX-License-Identifier: Apache-2.0

config COUNTER_NATIVE_POSIX
	bool "Counter on COUNTER_0"
	default y
	depends on BOARD_NATIVE_POSIX

config COUNTER_NATIVE_POSIX_FREQUENCY
	int "native_posix counter frequency in Hz"
	default 1000
	depends on COUNTER_NATIVE_POSIX
```

## drivers/counter/Kconfig.native_posix_rtc
```kconfig
# Counter native_posix rtc

# Copyright (c) 2020, Nordic Semiconductor ASA
# SPDX-License-Identifier: Apache-2.0

config COUNTER_NATIVE_POSIX_RTC
	bool "Enable Counter on RTC"
	depends on BOARD_NATIVE_POSIX
	default y if BOARD_NATIVE_POSIX
	help
		Zephyr Counter implementation using native posix' RTC hardware model.
```

## drivers/counter/Kconfig.native_sim
```kconfig
# Copyright (c) 2020, Nordic Semiconductor ASA
# SPDX-License-Identifier: Apache-2.0

config COUNTER_NATIVE_SIM
	bool "Counter on COUNTER_0"
	default y
	depends on DT_HAS_ZEPHYR_NATIVE_SIM_COUNTER_ENABLED

config COUNTER_NATIVE_SIM_FREQUENCY
	int "native_sim counter frequency in Hz"
	default 1000
	depends on COUNTER_NATIVE_SIM

config COUNTER_NATIVE_SIM_NBR_CHANNELS
	int "native_sim counter: number of channels"
	default 4
	depends on COUNTER_NATIVE_SIM
```

## drivers/counter/Kconfig.nct_itim32
```kconfig
# Copyright (c) 2025 Nuvoton Technology Corporation.
# SPDX-License-Identifier: Apache-2.0

config COUNTER_NCT_ITIM32
	bool "Nuvoton NCT series internal 32-bit timer"
	default y
	depends on DT_HAS_NUVOTON_NCT_ITIM32_ENABLED
	help
	  This module implements a kernel device driver for the Nuvoton NCT
	  series internal 32-bits counter/timer.
```

## drivers/counter/Kconfig.neorv32
```kconfig
# NEORV32 General Purpose Timer (GPTMR)
#
# Copyright (c) 2025 Henrik Brix Andersen <henrik@brixandersen.dk>
# SPDX-License-Identifier: Apache-2.0

config COUNTER_NEORV32_GPTMR
	bool "NEORV32 GPTMR driver"
	default y
	depends on DT_HAS_NEORV32_GPTMR_ENABLED
	depends on SYSCON
	help
	  Enable NEORV32 General Purpose Timer (GPTMR) driver.
```

## drivers/counter/Kconfig.npcm_itim32
```kconfig
# Copyright (c) 2024 Nuvoton Technology Corporation.
# SPDX-License-Identifier: Apache-2.0

config COUNTER_NPCM_ITIM32
	bool "Nuvoton NPCM series internal 32-bit timer"
	default y
	depends on DT_HAS_NUVOTON_NPCM_ITIM32_ENABLED
	help
	  This module implements a kernel device driver for the Nuvoton NPCM
	  series internal 32-bits counter/timer.
```

## drivers/counter/Kconfig.npcx
```kconfig
# NPCX LCT driver configuration options

# Copyright (c) 2025 Nuvoton Technology Corporation.
# SPDX-License-Identifier: Apache-2.0

config COUNTER_NPCX_NPCXN_V1
	bool
	help
	  This option enables LCT version 1 support for npcxn variant.

config COUNTER_NPCX_NPCXN_V2
	bool
	help
	  This option enables LCT version 2 support for npcxn variant.

config COUNTER_NPCX_NPCKN
	bool
	help
	  This option enables LCT version 1 support for npckn variant.

config COUNTER_NPCX_LCT
	bool "NPCX Long Countdown Timer Module driver"
	default y
	depends on DT_HAS_NUVOTON_NPCX_LCT_V1_ENABLED ||\
		   DT_HAS_NUVOTON_NPCX_LCT_V2_ENABLED ||\
		   DT_HAS_NUVOTON_NPCK_LCT_ENABLED
	select COUNTER_NPCX_NPCXN_V1 if DT_HAS_NUVOTON_NPCX_LCT_V1_ENABLED
	select COUNTER_NPCX_NPCXN_V2 if DT_HAS_NUVOTON_NPCX_LCT_V2_ENABLED
	select COUNTER_NPCX_NPCKN if DT_HAS_NUVOTON_NPCK_LCT_ENABLED
	help
	  Enable support for NPCX Long Countdown Timer Module (LCT) driver.
```

## drivers/counter/Kconfig.nrf5
```kconfig
config RTC_NRF5
	bool "NRF5 RTC Driver"
	depends on COUNTER && SOC_FAMILY_NRF5
	default y
	help
	Build NRF5 RTC driver.

config RTC_0
	bool "Enable RTC 0 instance"
	depends on RTC_NRF5
	default y

config RTC_0_NAME
	string "RTC 0 driver instance name"
	default "RTC_0"
	depends on RTC_0
	help
	RTC_0 driver instance name

config RTC_0_IRQ_PRI
	int "RTC 0 driver Interrupt priority"
	depends on RTC_0
	default 1
	help
	RTC interrupt priority.

config RTC_1
	bool "Enable RTC 1 instance"
	depends on RTC_NRF5
	default n

config RTC_1_NAME
	string "RTC1 driver instance name"
	default "RTC_1"
	depends on RTC_1
	help
	RTC_1 driver instance name

config RTC_1_IRQ_PRI
	int "RTC 1 driver Interrupt priority"
	depends on RTC_1
	default 1
	help
	RTC interrupt priority.

config RTC_2
	bool "Enable RTC 2 instance"
	depends on RTC_NRF5
	default n

config RTC_2_NAME
	string "RTC 2 driver instance name"
	default "RTC_2"
	depends on RTC_2
	help
	RTC_2 driver instance name

config RTC_2_IRQ_PRI
	int "RTC 2 Driver Interrupt priority"
	depends on RTC_2
	default 1
	help
	RTC interrupt priority.
```

## drivers/counter/Kconfig.nrfx
```kconfig
# Copyright (c) 2017 - 2018, Nordic Semiconductor ASA
# SPDX-License-Identifier: Apache-2.0

config COUNTER_NRF_TIMER
	def_bool y
	depends on DT_HAS_NORDIC_NRF_TIMER_ENABLED

config COUNTER_NRF_RTC
	def_bool y
	depends on DT_HAS_NORDIC_NRF_RTC_ENABLED

config COUNTER_NRFX_TIMER_USE_CLOCK_CONTROL
	def_bool y
	depends on $(dt_nodelabel_enabled,timer120) || \
		 $(dt_nodelabel_enabled,timer121)
	select CLOCK_CONTROL

# Internal flag which detects if PPI wrap feature is enabled for any instance
config COUNTER_RTC_WITH_PPI_WRAP
	def_bool $(dt_nodelabel_bool_prop,rtc0,ppi-wrap) || \
		 $(dt_nodelabel_bool_prop,rtc1,ppi-wrap) || \
		 $(dt_nodelabel_bool_prop,rtc2,ppi-wrap)
	depends on COUNTER_NRF_RTC
	select NRFX_PPI if HAS_HW_NRF_PPI
	select NRFX_DPPI if HAS_HW_NRF_DPPIC

# Internal flag which detects if fixed top feature is enabled for any instance
config COUNTER_RTC_CUSTOM_TOP_SUPPORT
	def_bool !$(dt_nodelabel_bool_prop,rtc0,fixed-top) || \
		 !$(dt_nodelabel_bool_prop,rtc1,fixed-top) || \
		 !$(dt_nodelabel_bool_prop,rtc2,fixed-top)
	depends on COUNTER_NRF_RTC
```

## drivers/counter/Kconfig.nxp_irtc
```kconfig
# Copyright 2026 NXP
# SPDX-License-Identifier: Apache-2.0

config COUNTER_NXP_IRTC
	bool "NXP IRTC wake timer counter driver"
	default y
	depends on DT_HAS_NXP_IRTC_WAKE_TIMER_ENABLED
	help
	  Enable the counter driver for the NXP IRTC wake timer.
```

## drivers/counter/Kconfig.nxp_mrt
```kconfig
# Copyright 2023 NXP
# SPDX-License-Identifier: Apache-2.0

config COUNTER_NXP_MRT
	bool "NXP MRT driver"
	default y
	depends on DT_HAS_NXP_MRT_CHANNEL_ENABLED && \
			DT_HAS_NXP_MRT_ENABLED
	select RESET
	help
	  Enable driver for the NXP Multirate Timer (MRT).
```

## drivers/counter/Kconfig.nxp_ostimer
```kconfig
# Copyright (c) 2026 NXP
# SPDX-License-Identifier: Apache-2.0

config COUNTER_NXP_OSTIMER
	bool "NXP OS Timer (OSTIMER) counter driver"
	default y
	depends on $(dt_compat_any_has_prop,$(DT_COMPAT_NXP_OS_TIMER),role,counter)
	select COUNTER_SUPPORTS_64BITS_TICKS
	help
	  Enable counter driver for the NXP OS Timer (OSTIMER) peripheral.
	  OSTIMER is a 64-bit free-running counter with a single match register
	  for one-shot alarms.
```

## drivers/counter/Kconfig.nxp_pcf85263a
```kconfig
#
# Copyright (c) 2022 Fraunhofer AICOS
#

config COUNTER_NXP_PCF85263A
	bool "NXP PCF85263A RTC/Stop-watch"
	depends on I2C
	help
	  Enable counter driver based on NXP PCF85263A I2C device.

choice
	prompt "PCF85263A INTA pin mode"

config NXP_PCF85263A_INTA_CLK_OUT
	bool "CLK output mode"

config NXP_PCF85263A_INTA_BATT_OUT
	bool "Battery mode indication"

config NXP_PCF85263A_INTA_INT_OUT
	bool "Interrupt (INTA) output"

config NXP_PCF85263A_INTA_HIZ
	bool "Hi-Z"

endchoice


choice
	prompt "PCF85263A TS pin mode"

config NXP_PCF85263A_TS_DISABLED
	bool "Disabled"

config NXP_PCF85263A_TS_INTB_OUT
	bool "Interrupt (INTB) output"

config NXP_PCF85263A_TS_CLK_OUT
	bool "Clock output"

config NXP_PCF85263A_TS_INPUT
	bool "Input mode"

endchoice
```

## drivers/counter/Kconfig.nxp_pit
```kconfig
# MCUXpresso SDK Periodic Interrupt Timer (PIT)

# Copyright 2020 NXP
# SPDX-License-Identifier: Apache-2.0

config COUNTER_NXP_PIT
	bool "NXP PIT driver"
	default y
	depends on DT_HAS_NXP_PIT_ENABLED
	help
	  Enable support for the NXP Periodic Interrupt Timer (PIT).
```
