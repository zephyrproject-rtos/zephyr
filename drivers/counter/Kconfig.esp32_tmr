## drivers/counter/Kconfig.esp32_tmr
```kconfig
# ESP32 General Purpose Timer configuration

# Copyright (c) 2020-2025 Espressif Systems (Shanghai) Co., Ltd.
# SPDX-License-Identifier: Apache-2.0

config COUNTER_TMR_ESP32
	bool "ESP32 Counter Driver based on GP-Timers"
	default y
	depends on DT_HAS_ESPRESSIF_ESP32_COUNTER_ENABLED
	select COUNTER_SUPPORTS_64BITS_TICKS
	select COUNTER_SUPPORTS_CAPTURE if ESP32_SOC_ETM_SUPPORTED
	help
	  Enables the Counter driver API based on Espressif's General
	  Purpose Timers for ESP32 series devices.

config COUNTER_TMR_ESP32_CAPTURE
	bool "ESP32 GP-Timer counter capture via ETM"
	default y
	depends on COUNTER_TMR_ESP32 && COUNTER_CAPTURE
	depends on ESP32_SOC_ETM_SUPPORTED
	select ESP32_ETM
	help
	  Enables GPIO edge triggered counter capture for the ESP32
	  GP-Timer counter driver. A GPIO edge is routed through the Event
	  Task Matrix (ETM) to the timer capture task so the counter value
	  is latched in hardware at the edge. Only available on SoCs that
	  expose ETM for both the timer and GPIO peripherals.
```

## drivers/counter/Kconfig.gd32
```kconfig
# GD32 counter timer configuration options

# Copyright (c) 2022 TOKITA Hiroshi <tokita.hiroshi@gmail.com>
# SPDX-License-Identifier: Apache-2.0

config COUNTER_TIMER_GD32
	bool "GD32 timer counter driver"
	default y
	depends on DT_HAS_GD_GD32_TIMER_ENABLED && SOC_FAMILY_GD32_ARM
	select USE_GD32_TIMER
	help
	  Enable counter timer driver for GD32 series devices.
```

## drivers/counter/Kconfig.gecko
```kconfig
# Silicon Labs Gecko Counter driver config

# Copyright (c) 2019, Piotr Mienkowski
# SPDX-License-Identifier: Apache-2.0

config COUNTER_GECKO_RTCC
	bool "Silicon Labs Gecko Counter (RTCC) driver"
	default y
	depends on DT_HAS_SILABS_GECKO_RTCC_ENABLED
	select SOC_GECKO_CMU
	select SOC_GECKO_RTCC
	help
	  Enable counter driver based on RTCC module for Silicon Labs Gecko
	  chips.

config COUNTER_GECKO_STIMER
	bool "Silicon Labs Gecko Counter Sleep Timer driver"
	default y
	depends on DT_HAS_SILABS_GECKO_STIMER_ENABLED
	select SOC_SILABS_SLEEPTIMER
	help
	  Enable the counter driver for Sleep Timer module for Silicon Labs
	  Gecko chips.
```

## drivers/counter/Kconfig.generic
```kconfig
# Copyright (c) 2019, Nordic Semiconductor ASA
#
# SPDX-License-Identifier: Apache-2.0
#

config COUNTER_GENERIC
	bool "Generic counter driver"
	default n
	help
	  Generic counter driver provides a generic 32-bit counter
	  (counting up) with at least one compare channel using selected
	  counter as a backend.
	  This driver could be used to provide a counter of known capabilities
	  on a platforms with limited hardware.

if COUNTER_GENERIC

config COUNTER_GENERIC_TEST_MODE
	bool "Enable test mode"
	default n
	help
	  Test mode enables custom configuration (like suboptimal top value)
	  which allows testing of corner cases.

endif # COUNTER_GENERIC
```

## drivers/counter/Kconfig.ifx_cat1
```kconfig
# Infineon CAT1 counter driver

# Copyright (c) 2023 Cypress Semiconductor Corporation (an Infineon company) or
# an affiliate of Cypress Semiconductor Corporation
# SPDX-License-Identifier: Apache-2.0

config COUNTER_INFINEON_CAT1
	bool "Infineon CAT1 COUNTER driver"
	default y
	depends on DT_HAS_INFINEON_CAT1_COUNTER_ENABLED
	select USE_INFINEON_TIMER
	help
	  This option enables the COUNTER driver for Infineon CAT1 family.
```

## drivers/counter/Kconfig.ifx_tcpwm
```kconfig
# Copyright (c) 2025 Infineon Technologies AG,
# or an affiliate of Infineon Technologies AG.
#
# SPDX-License-Identifier: Apache-2.0

config COUNTER_INFINEON_TCPWM
	bool "Infineon CAT1 COUNTER driver"
	default y
	depends on DT_HAS_INFINEON_TCPWM_COUNTER_ENABLED
	select USE_INFINEON_TIMER
	help
	  This option enables the COUNTER driver for Infineon CAT1 family.
```

## drivers/counter/Kconfig.imx7d_gpt
```kconfig
# Copyright (c) 2024 MAKEEN Energy A/S
# SPDX-License-Identifier: Apache-2.0


config GPT_IMX
	bool "i.MX GPT Driver"
	default y
	depends on $(dt_compat_enabled,$(DT_COMPAT_NXP_IMX7D_GPT))
	help
	  Enable support for i.MX ftm driver.

config COUNTER_GPT_IMX
	bool "IMX GPT driver"
	default y
	depends on GPT_IMX
	help
	  Enable support for Flexible Timer (FTM) driver.
```

## drivers/counter/Kconfig.imx_epit
```kconfig
# IMX EPIT configuration options

# Copyright (c) 2018, NXP
# SPDX-License-Identifier: Apache-2.0

config COUNTER_IMX_EPIT
	bool "IMX EPIT driver"
	default y
	depends on DT_HAS_NXP_IMX_EPIT_ENABLED
	help
	  Enable the IMX EPIT driver.
```

## drivers/counter/Kconfig.ite_it51xxx
```kconfig
# Copyright (c) 2025 ITE Corporation. All Rights Reserved.
# SPDX-License-Identifier: Apache-2.0

config COUNTER_ITE_IT51XXX
	bool "ITE IT51XXX Counter driver"
	default y
	depends on DT_HAS_ITE_IT51XXX_COUNTER_ENABLED
	help
	  Enable counter support for the ITE IT51XXX.
```

## drivers/counter/Kconfig.ite_it8xxx2
```kconfig
# Copyright (c) 2025 ITE Corporation. All Rights Reserved.
# SPDX-License-Identifier: Apache-2.0

config COUNTER_ITE_IT8XXX2
	bool "ITE IT8XXX2 Timer driver"
	default y
	depends on DT_HAS_ITE_IT8XXX2_COUNTER_ENABLED
	help
	  Enable counter support for the ITE IT8XXX2.
```

## drivers/counter/Kconfig.k3_rtc_counter
```kconfig
# Copyright (c) 2026 Texas Instruments Inc.
# SPDX-License-Identifier: Apache-2.0

config COUNTER_TI_K3_RTC
	bool "RTC Counter Driver for TI K3 SoCs"
	default y
	depends on DT_HAS_TI_K3_RTC_COUNTER_ENABLED
	help
		Enable the RTC driver for TI K3 SoCs.
```

## drivers/counter/Kconfig.m41t62_rtc
```kconfig
# Copyright (c) 2021 Greyp Bikes d.o.o
#
# SPDX -License-Identifier: Apache-2.0
#

config COUNTER_M41T62
	bool "Enable I2C-based driver for M41T62"
	depends on I2C

config COUNTER_M41T62_INIT_PRIORITY
	int "Init priority"
	depends on COUNTER_M41T62
	default 65
	help
	 M41T62 device driver initialization priority.
```

## drivers/counter/Kconfig.max32_rtc
```kconfig
# Copyright (c) 2024 Analog Devices, Inc.
# SPDX-License-Identifier: Apache-2.0

config COUNTER_RTC_MAX32
	bool "MAX32xxx counter rtc driver"
	default y
	depends on DT_HAS_ADI_MAX32_RTC_COUNTER_ENABLED
	help
	  Enable the counter rtc driver for MAX32 MCUs.
```

## drivers/counter/Kconfig.max32_timer
```kconfig
# Copyright (c) 2024 Analog Devices, Inc.
# SPDX-License-Identifier: Apache-2.0

config COUNTER_TIMER_MAX32
	bool "MAX32xxx counter driver"
	default y
	depends on DT_HAS_ADI_MAX32_COUNTER_ENABLED
	help
	  Enable the counter driver for MAX32 MCUs.
```

## drivers/counter/Kconfig.max32_wut
```kconfig
# Copyright (c) 2025 Analog Devices, Inc.
# SPDX-License-Identifier: Apache-2.0

config COUNTER_WUT_MAX32
	bool "MAX32xxx wake-up timer driver"
	default y
	depends on DT_HAS_ADI_MAX32_WUT_ENABLED
	help
	  Enable the wake-up timer driver for MAX32 MCUs.
```

## drivers/counter/Kconfig.maxim_ds3231
```kconfig
# Copyright (c) 2019 Peter Bigot Consulting, LLC
#
# SPDX-License-Identifier: Apache-2.0
#

config COUNTER_MAXIM_DS3231
	bool "Maxim DS3231 RTC/TCXO"
	depends on I2C
	select POLL
	help
	  Enable counter driver based on Maxim DS3231 I2C device.
```

## drivers/counter/Kconfig.mchp
```kconfig
# Copyright (c) 2025-2026 Microchip Technology Inc.
# SPDX-License-Identifier: Apache-2.0

config COUNTER_MCHP_G1_TCC
	bool "Microchip TCC G1 Counter driver"
	default y
	depends on DT_HAS_MICROCHIP_TCC_G1_COUNTER_ENABLED
	help
	  This option enables the counter driver for Microchip timer peripherals

config COUNTER_MCHP_TC_G1
	bool "Microchip TC G1 Counter driver"
	default y
	depends on DT_HAS_MICROCHIP_TC_G1_COUNTER_ENABLED
	help
	  This option enables the counter driver for Microchip timer peripherals.

config COUNTER_MCHP_RTC_G1
	bool "Microchip RTC G1 Counter driver"
	default y
	depends on DT_HAS_MICROCHIP_RTC_G1_COUNTER_ENABLED
	help
	  This option enables the counter driver for Microchip timer peripherals

config COUNTER_MCHP_TC_G2
	bool "Microchip Timer Counter (TC) g2 driver"
	default y
	depends on DT_HAS_MICROCHIP_TC_G2_COUNTER_ENABLED
	help
	  Enable the Microchip Timer Counter g2 driver.
```

## drivers/counter/Kconfig.mchp_sam_pit64b
```kconfig
# Copyright (C) 2025 Microchip Technology Inc. and its subsidiaries
#
# SPDX-License-Identifier: Apache-2.0
#

config COUNTER_MCHP_SAM_PIT64B
	bool "Microchip SAM PIT64B Counter"
	default y
	depends on DT_HAS_MICROCHIP_SAM_PIT64B_COUNTER_ENABLED
	help
	  Enable the Microchip PIT64B counter driver.
```

## drivers/counter/Kconfig.mchp_sam_tc
```kconfig
# Copyright (C) 2025 Microchip Technology Inc. and its subsidiaries
#
# SPDX-License-Identifier: Apache-2.0
#

config COUNTER_MCHP_SAM_TC
	bool "Microchip SAM Timer counter (TC)"
	default y
	depends on DT_HAS_MICROCHIP_SAM_TC_ENABLED
	help
	  Enable the Microchip SAM Timer Counter driver.
```

## drivers/counter/Kconfig.mcp7940n
```kconfig
# Copyright (c) 2021 Laird Connectivity
#
# SPDX-License-Identifier: Apache-2.0
#

config COUNTER_MICROCHIP_MCP7940N
	bool "Microchip MCP7940N RTC"
	default y
	depends on DT_HAS_MICROCHIP_MCP7940N_ENABLED
	select I2C
	help
	  Enable RTC driver based on Microchip MCP7940N I2C device.
```

## drivers/counter/Kconfig.mcux_ctimer
```kconfig
# MCUXpresso SDK CTIMER

# Copyright (c) 2021 Toby firth
# SPDX-License-Identifier: Apache-2.0

config COUNTER_MCUX_CTIMER
	bool "MCUX CTIMER driver"
	default y
	depends on DT_HAS_NXP_LPC_CTIMER_ENABLED
	help
	  Enable support for MCUX CTIMER driver.

config COUNTER_MCUX_CTIMER_RESERVE_CHANNEL_FOR_SETTOP
	bool "reserve a ctimer channel to set the top value"
	default y
	depends on COUNTER_MCUX_CTIMER
	help
	  This reserves a CTimer channel to set the top value. Without
	  this the set top value can be set only to the max counter value.

if COUNTER_MCUX_CTIMER

config COUNTER_MCUX_CTIMER_CAPTURE
	bool "MCUX CTIMER Capture function"
	default n
	select PINCTRL
	help
	  Enable support for MCUX CTIMER Capture

config COUNTER_MCUX_CTIMER_DMA
	bool "MCUX CTIMER DMA function"
	default n
	help
	  Enable support for MCUX CTIMER DMA
endif
```

## drivers/counter/Kconfig.mcux_ftm
```kconfig
# Copyright 2025 NXP
#
# SPDX-License-Identifier: Apache-2.0

# MCUXpresso SDK FlexTimer (FTM)

config COUNTER_MCUX_FTM
	bool "MCUX FTM driver"
	default y
	depends on DT_HAS_NXP_FTM_ENABLED
	help
	  Enable support for the MCUX FlexTimer (FTM).
```

## drivers/counter/Kconfig.mcux_gpt
```kconfig
# MCUXpresso SDK RTC

# Copyright (c) 2019 Linaro Limited
# SPDX-License-Identifier: Apache-2.0

config COUNTER_MCUX_GPT
	bool "MCUX GPT driver"
	default y
	depends on DT_HAS_NXP_IMX_GPT_ENABLED
	help
	  Enable support for mcux General Purpose Timer (GPT) driver.
```

## drivers/counter/Kconfig.mcux_lpc_rtc
```kconfig
# Copyright (c) 2021-23, NXP
# SPDX-License-Identifier: Apache-2.0

config COUNTER_MCUX_LPC_RTC
	bool "MCUX LPC RTC driver"
	default y
	depends on DT_HAS_NXP_LPC_RTC_ENABLED || \
		   DT_HAS_NXP_LPC_RTC_HIGHRES_ENABLED
	help
	  Enable the LPC rtc driver.

config COUNTER_MCUX_LPC_RTC_1HZ
	bool "MCUX LPC RTC 1Hz counter driver"
	default y
	depends on DT_HAS_NXP_LPC_RTC_ENABLED
	help
	  Enable support for LPC 1Hz counter.

config COUNTER_MCUX_LPC_RTC_HIGHRES
	bool "MCUX LPC RTC High Resolution counter driver"
	default y
	depends on DT_HAS_NXP_LPC_RTC_HIGHRES_ENABLED
	help
	  Enable support for LPC rtc high resolution counter.
```

## drivers/counter/Kconfig.mcux_lpit
```kconfig
# Copyright 2025 NXP
# SPDX-License-Identifier: Apache-2.0

# MCUXpresso SDK Low Power Periodic Interrupt Timer (LPIT)
config COUNTER_MCUX_LPIT
	bool "NXP LPIT driver"
	default y
	depends on DT_HAS_NXP_LPIT_CHANNEL_ENABLED && \
			DT_HAS_NXP_LPIT_ENABLED
	help
	  Enable support for the NXP Low Power Periodic Interrupt Timer (LPIT).
```
