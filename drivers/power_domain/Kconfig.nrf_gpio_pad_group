## drivers/power_domain/Kconfig.nrf_gpio_pad_group
```kconfig
# Copyright 2025 Nordic Semiconductor ASA
# SPDX-License-Identifier: Apache-2.0

config POWER_DOMAIN_NRF_GPIO_PAD_GROUP
	bool "NRFS Global Domain Power Request driver"
	depends on DT_HAS_NORDIC_NRF_GPIO_PAD_GROUP_ENABLED
	default y
```

## drivers/power_domain/Kconfig.nrfs_gdpwr
```kconfig
# Copyright 2025 Nordic Semiconductor ASA
# SPDX-License-Identifier: Apache-2.0

config POWER_DOMAIN_NRFS_GDPWR
	bool "NRFS Global Domain Power Request driver"
	depends on DT_HAS_NORDIC_NRFS_GDPWR_ENABLED
	depends on MULTITHREADING
	select NRFS
	select NRFS_GDPWR_SERVICE_ENABLED
	default y

if POWER_DOMAIN_NRFS_GDPWR

config POWER_DOMAIN_NRFS_GDPWR_TIMEOUT_MS
	int "GDPWR request timeout in milliseconds"
	default 500

endif # POWER_DOMAIN_NRFS_GDPWR
```

## drivers/power_domain/Kconfig.nrfs_swext
```kconfig
# Copyright 2025 Nordic Semiconductor ASA
# SPDX-License-Identifier: Apache-2.0

config POWER_DOMAIN_NRFS_SWEXT
	bool "NRFS SWEXT power domain driver"
	depends on DT_HAS_NORDIC_NRFS_SWEXT_ENABLED
	select NRFS
	select NRFS_SWEXT_SERVICE_ENABLED
	default y
```

## drivers/power_domain/Kconfig.rpi_bcm283x
```kconfig
# Copyright (c) 2026 Muhammad Waleed Badar
# SPDX-License-Identifier: Apache-2.0

config POWER_DOMAIN_RASPBERRYPI_BCM283X
	bool "Raspberry Pi BCM283x power domain driver"
	default y
	depends on DT_HAS_RASPBERRYPI_BCM283X_POWER_ENABLED
	select RASPBERRYPI_FIRMWARE
	help
	  Enable Driver for Raspberry Pi BCM283x power domain.

if POWER_DOMAIN_RASPBERRYPI_BCM283X

config POWER_DOMAIN_RASPBERRYPI_BCM283X_INIT_PRIORITY
	int "Raspberry Pi BCM283x power domain init priority"
	default 46
	help
	  Must be higher (later) than CONFIG_RASPBERRYPI_FIRMWARE_INIT_PRIORITY so the
	  Raspberry Pi firmware interface is ready before this drivers initialization runs.

endif
```

## drivers/power_domain/Kconfig.silabs_siwx91x
```kconfig
# Copyright 2025 Silicon Laboratories Inc.
# SPDX-License-Identifier: Apache-2.0

config POWER_DOMAIN_SILABS_SIWX91X
	bool "Silabs siwx91x power domain driver"
	default y
	select DEVICE_DEPS
	depends on DT_HAS_SILABS_SIWX91X_POWER_DOMAIN_ENABLED
	help
	  Driver for Silabs siwx91x power domain.

config SIWX91X_POWER_DOMAIN_INIT_PRIORITY
	int "Silabs siwx91x power domain init priority"
	default 10
	help
	  Silabs siwx91x power domain initialization priority.
```

## drivers/ps2/Kconfig
```kconfig
# PS/2 configuration options

# Copyright (c) 2019 Intel Corporation
# SPDX-License-Identifier: Apache-2.0

menuconfig PS2
	bool "PS/2 drivers"
	help
	  Include PS/2 drivers in system config.

if PS2

# zephyr-keep-sorted-start
source "drivers/ps2/Kconfig.it51xxx"
source "drivers/ps2/Kconfig.npcx"
source "drivers/ps2/Kconfig.xec"
# zephyr-keep-sorted-stop

module = PS2
module-str = ps2
source "subsys/logging/Kconfig.template.log_config"

config PS2_INIT_PRIORITY
	int "PS/2 driver init priority"
	default 40
	help
	  PS/2 device driver initialization priority.
	  There isn't any critical component relying on this priority at
	  the moment.

endif # PS2
```

## drivers/ps2/Kconfig.it51xxx
```kconfig
# IT51XXX PS2 configuration options

# Copyright (c) 2026 ITE Corporation. All Rights Reserved.
# SPDX-License-Identifier: Apache-2.0

config PS2_IT51XXX
	bool "IT51XXX PS2 driver"
	depends on DT_HAS_ITE_IT51XXX_PS2_ENABLED
	select PINCTRL
	default y
	help
	  Enable the IT51XXX PS2 driver.
```

## drivers/ps2/Kconfig.npcx
```kconfig
# NPCX PS2 configuration options

# Copyright (c) 2021 Nuvoton Technology Corporation.
# SPDX-License-Identifier: Apache-2.0

menuconfig PS2_NPCX
	bool "Nuvoton NPCX embedded controller (EC) PS2 driver"
	depends on DT_HAS_NUVOTON_NPCX_PS2_CHANNEL_ENABLED
	select PINCTRL
	default y
	help
	  Enable the NPCX family PS2 driver. It provides four PS/2 channels.
	  Each channel has two quasi-bidirectional signals that serve as
	  direct interfaces to an external keyboard, mouse or any other
	  PS/2-compatible pointing device.The driver also depends on the KBC
	  8042 keyboard controller.

if PS2_NPCX

config PS2_CHANNEL_INIT_PRIORITY
	int "PS/2 channel driver init priority"
	default 41
	help
	  PS/2 channel device driver initialization priority.
	  This should be lower than the PS2_INIT_PRIORITY as
	  NPCX PS/2 controller device driver should initialize
	  prior to channel device driver.

endif # PS2_NPCX
```

## drivers/psci/Kconfig
```kconfig
# PSCI driver configuration options

# Copyright (c) 2020 Carlo Caione <ccaione@baylibre.com>
# SPDX-License-Identifier: Apache-2.0

config ARM_PSCI
	bool "Support for the ARM Power State Coordination Interface (PSCI)"
	depends on ARMV8_A
	help
	  Say Y here if you want Zephyr to communicate with system firmware
	  implementing the PSCI specification for CPU-centric power
	  management operations described in ARM document number ARM DEN
	  0022A ("Power State Coordination Interface System Software on
	  ARM processors").

if ARM_PSCI

module = PSCI
module-str = psci
source "subsys/logging/Kconfig.template.log_config"

endif
```

## drivers/pse/Kconfig
```kconfig
# SPDX-License-Identifier: Apache-2.0

menuconfig PSE
	bool "PSE drivers"
	help
	  Include PSE drivers in system config

if PSE

module = PSE
module-str = pse
source "subsys/logging/Kconfig.template.log_config"

config PSE_INIT_PRIORITY
	int "PSE init priority"
	default 95
	help
	  PSE initialization priority.

comment "Device Drivers"

source "drivers/pse/si3474/Kconfig"

endif # PSE
```

## drivers/pse/si3474/Kconfig
```kconfig
# SPDX-License-Identifier: Apache-2.0

menuconfig SI3474
	bool "Si3474 PoE PSE Device"
	default y
	select I2C
	help
	  Enable driver for Si3474 device.

if SI3474

choice SI3474_TRIGGER_MODE
	prompt "Trigger mode"
	default SI3474_TRIGGER_GLOBAL_THREAD
	help
	  Specify the type of triggering to be used by the driver.

config SI3474_TRIGGER_NONE
	bool "No trigger"

config SI3474_TRIGGER_GLOBAL_THREAD
	bool "Use global thread"
	depends on GPIO
	select SI3474_TRIGGER

endchoice

config SI3474_TRIGGER
	bool

config SI3474_THREAD_PRIORITY
	int "Thread priority"
	depends on SI3474_TRIGGER_GLOBAL_THREAD
	default 12
	help
	  Priority of thread used by the driver to handle interrupts.

config SI3474_THREAD_STACK_SIZE
	int "Thread stack size"
	depends on SI3474_TRIGGER_GLOBAL_THREAD
	default 2048
	help
	  Stack size of thread used by the driver to handle interrupts.

endif # SI3474
```

## drivers/psi5/Kconfig
```kconfig
# Copyright 2025 NXP
# SPDX-License-Identifier: Apache-2.0

menuconfig PSI5
	bool "Peripheral Sensor Interface (PSI5) driver"
	help
	  Enable PSI5 Driver Configuration

if PSI5

module = PSI5
module-str = psi5
source "subsys/logging/Kconfig.template.log_config"

config PSI5_INIT_PRIORITY
	int "PSI5 driver init priority"
	default KERNEL_INIT_PRIORITY_DEVICE
	help
	  PSI5 driver device initialization priority.

source "drivers/psi5/Kconfig.nxp_s32"

endif # PSI5
```

## drivers/psi5/Kconfig.nxp_s32
```kconfig
# Copyright 2025 NXP
# SPDX-License-Identifier: Apache-2.0

config PSI5_NXP_S32
	bool "NXP S32 PSI5 driver"
	default y
	depends on DT_HAS_NXP_S32_PSI5_ENABLED
	select PINCTRL if $(dt_compat_any_has_prop,$(DT_COMPAT_NXP_S32_PSI5),pinctrl-0)
	help
	  Enable support for NXP S32 PSI5 driver.
```

## drivers/ptp_clock/Kconfig
```kconfig
# Copyright (c) 2018 Intel Corporation.
# SPDX-License-Identifier: Apache-2.0

config PTP_CLOCK
	bool "Precision Time Protocol (PTP) Clock drivers"
	help
	  Enable options for Precision Time Protocol Clock drivers.

if PTP_CLOCK

source "drivers/ptp_clock/Kconfig.nxp_enet"

config PTP_CLOCK_INIT_PRIORITY
	int "Init priority"
	default 75
	help
	  PTP Clock device driver initialization priority

endif # PTP_CLOCK
```

## drivers/ptp_clock/Kconfig.ha1588
```kconfig
# Copyright 2025 CISPA Helmholtz Center for Information Security gGmbH
# SPDX-License-Identifier: Apache-2.0

config PTP_CLOCK_HA1588
	bool "HA1588 PTP Clock driver"
	default y
	depends on DT_HAS_HA1588_RTC_1_0_ENABLED && NET_L2_PTP
	help
	  Enable ha1588 PTP clock support.

if PTP_CLOCK_HA1588

config PTP_CLOCK_HA1588_TSU
	bool "HA1588 TSU support"
	help
	  Enable driver support for ha1588 Time-Stamp Unit.
	  Used in hardware designs where Ethernet MAC lacks
	  timestamping functionality.

endif
```

## drivers/ptp_clock/Kconfig.native
```kconfig
# Copyright 2026 The Zephyr Project Contributors
# SPDX-License-Identifier: Apache-2.0

config PTP_CLOCK_NATIVE
	bool "PTP Clock driver for native_sim"
	default y
	depends on DT_HAS_ZEPHYR_NATIVE_PTP_CLOCK_ENABLED
	depends on ARCH_POSIX
	select NET_L2_PTP_TIMESTAMPING
	select NATIVE_USE_NSI_ERRNO
	help
	  Enable PTP clock driver for native_sim to support Ethernet timestamping.
```

## drivers/ptp_clock/Kconfig.nxp_enet_qos
```kconfig
# SPDX-FileCopyrightText: Copyright 2026 NXP
# SPDX-License-Identifier: Apache-2.0

config PTP_CLOCK_NXP_ENET_QOS
	bool "NXP ENET QoS PTP Clock driver"
	default y
	depends on DT_HAS_NXP_ENET_QOS_PTP_CLOCK_ENABLED && NET_L2_PTP
	depends on ETH_NXP_ENET_QOS
	help
	  Enable NXP ENET QoS PTP clock support
```

## drivers/ptp_clock/Kconfig.nxp_netc
```kconfig
# Copyright 2025 NXP
# SPDX-License-Identifier: Apache-2.0

config PTP_CLOCK_NXP_NETC
	bool "NXP NETC PTP Clock driver"
	default y
	depends on DT_HAS_NXP_NETC_PTP_CLOCK_ENABLED
	depends on ETH_NXP_IMX_NETC
	help
	  Enable NXP NETC PTP clock support.

if PTP_CLOCK_NXP_NETC

config PTP_CLOCK_NXP_NETC_CLK_DIV
	int
	default 2
	help
	  NXP NETC PTP reference clock division.

endif # PTP_CLOCK_NXP_NETC
```

## drivers/pulse_io/Kconfig
```kconfig
# Pulse IO subsystem
#
# Copyright (c) 2026 Espressif Systems (Shanghai) Co., Ltd.
# SPDX-License-Identifier: Apache-2.0

menuconfig PULSE_IO
	bool "Pulse IO drivers"
	help
	  Enable support for the Pulse IO subsystem, a vendor-neutral
	  abstraction for hardware that generates and captures timed
	  digital edges on a GPIO line.

if PULSE_IO

module = PULSE_IO
module-str = pulse_io
source "subsys/logging/Kconfig.template.log_config"

config PULSE_IO_INIT_PRIORITY
	int "Pulse IO init priority"
	default 80
	help
	  Device driver init priority for Pulse IO devices.

config PULSE_IO_LOOPBACK
	bool "Software loopback Pulse IO backend"
	default y
	depends on DT_HAS_ZEPHYR_PULSE_IO_LOOPBACK_ENABLED
	help
	  Enable the software loopback Pulse IO backend. It loops
	  transmitted symbols back on receive so the subsystem API can
	  be tested without hardware.

endif # PULSE_IO
```

## drivers/pwm/Kconfig
```kconfig
# PWM configuration options

# Copyright (c) 2015 Intel Corporation
# SPDX-License-Identifier: Apache-2.0

menuconfig PWM
	bool "Pulse Width Modulation (PWM) drivers"
	help
	  Enable config options for PWM drivers.

if PWM

module = PWM
module-str = pwm
source "subsys/logging/Kconfig.template.log_config"

config PWM_INIT_PRIORITY
	int "PWM initialization priority"
	default KERNEL_INIT_PRIORITY_DEVICE
	help
	  System initialization priority for PWM drivers.

config PWM_SHELL
	bool "PWM shell"
	depends on SHELL
	help
	  Enable the PWM related shell commands.

config PWM_CAPTURE
	bool "Provide API for PWM capture"
	help
	  This option extends the Zephyr PWM API with the ability to capture PWM
	  period/pulse widths.

config PWM_EVENT
	bool "Provide API for PWM event [EXPERIMENTAL]"
	select EXPERIMENTAL
	help
	  This option extends the Zephyr PWM API with the ability to configure
	  and receive PWM events.

source "drivers/pwm/Kconfig.*"

endif # PWM
```

## drivers/pwm/Kconfig.ambiq_timer
```kconfig
# Copyright (c) 2025, Ambiq Micro Inc. <www.ambiq.com>
# SPDX-License-Identifier: Apache-2.0

config PWM_AMBIQ_TIMER
	bool "Ambiq Timer PWM driver"
	default y
	depends on DT_HAS_AMBIQ_TIMER_PWM_ENABLED
	select AMBIQ_HAL
	select AMBIQ_HAL_USE_TIMER
	help
	  Enable timer based pwm driver.

config PWM_AMBIQ_CTIMER
	bool "Ambiq CTimer PWM driver"
	default y
	depends on DT_HAS_AMBIQ_CTIMER_PWM_ENABLED
	select AMBIQ_HAL
	select AMBIQ_HAL_USE_TIMER
	help
	  Enable ctimer based pwm driver.
```

## drivers/pwm/Kconfig.ameba
```kconfig
# AMEBA PWM configuration options

# Copyright (c) 2026 Realtek Semiconductor Corp.
# SPDX-License-Identifier: Apache-2.0

config PWM_AMEBA
	bool "AMEBA PWM driver"
	default y
	depends on DT_HAS_REALTEK_AMEBA_PWM_ENABLED
	select PINCTRL
	help
	  Enable the PWM driver for AMEBA family of processors.
```

## drivers/pwm/Kconfig.atm
```kconfig
# PWM configuration options

# Copyright (c) 2021-2024 Atmosic
# SPDX-License-Identifier: Apache-2.0

config PWM_ATM
	bool "Atmosic PWM driver"
	default y
	depends on DT_HAS_ATMOSIC_ATM3X_PWM_ENABLED || DT_HAS_ATMOSIC_ATMX2_PWM_ENABLED
	help
	  This option enables the PWM driver for Atmosic family of
	  processors.
```

## drivers/pwm/Kconfig.b91
```kconfig
# Copyright (c) 2021 Telink Semiconductor
# SPDX-License-Identifier: Apache-2.0

config PWM_TELINK_B91
	bool "Telink Semiconductor B91 PWM driver"
	default y
	depends on DT_HAS_TELINK_B91_PWM_ENABLED
	help
	  Enables Telink B91 PWM driver.
```

## drivers/pwm/Kconfig.b9x
```kconfig
# Copyright (c) 2021-2023 Telink Semiconductor
# SPDX-License-Identifier: Apache-2.0

config PWM_TELINK_B9X
	bool "Telink Semiconductor B9x PWM driver"
	default y
	depends on DT_HAS_TELINK_B9X_PWM_ENABLED
	help
	  Enables Telink B9x PWM driver.
```
