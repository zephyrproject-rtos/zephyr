## drivers/crypto/Kconfig.opentitan_aes
```kconfig
# Copyright (c) 2026, Bana Tawalbeh
# SPDX-License-Identifier: Apache-2.0

config CRYPTO_OPENTITAN_AES
	bool "OpenTitan AES driver"
	default y
	depends on DT_HAS_LOWRISC_OPENTITAN_AES_ENABLED
	help
	  Enable this option to use OpenTitan AES hardware accelerator

config CRYPTO_OPENTITAN_MAX_SESSION
	int "Maximum number of concurrent sessions"
	default 2
	help
	  This determines the number of pre-allocated session structures
	  available in RAM.
```

## drivers/crypto/Kconfig.pufs
```kconfig
# PUF Security Cryptographic Accelerator configuration options

# Copyright (c) 2024 Muhammad Junaid Aslam <junaid.aslam@rapidsilicon.com>
# SPDX-License-Identifier: Apache-2.0

menuconfig PUFCC_SECURITY
	bool "PUF Security Hardware"
	depends on DT_HAS_PUFSECURITY_PUFCC_ENABLED
	help
		Enable PUF Security Hardware.

	if PUFCC_SECURITY

		config RS_RTOS_PORT
			bool "Enable Zephyr Specific Code changes."
			default n

		config CRYPTO_PUF_SECURITY
			bool "PUF security Cryptographic Accelerator driver"
			default n
			depends on DT_HAS_PUFSECURITY_PUFCC_ENABLED
			select RS_RTOS_PORT
			help
				Enable PUF Security based Cryptographic Accelerator driver.

		config CRYPTO_PUF_SECURITY_OTP
			bool "PUF security One Time Programmable Memory"
			default n
			depends on DT_HAS_PUFSECURITY_OTP_ENABLED
			select RS_RTOS_PORT
			help
				Enable PUF Security based One Time Programmable Memory.

	endif
	
```

## drivers/crypto/Kconfig.rpi_pico
```kconfig
# Copyright (c) 2025 TOKITA Hiroshi
# SPDX-License-Identifier: Apache-2.0

config CRYPTO_RPI_PICO_SHA256
	bool "Raspberry Pi RP2 series SHA-256 Accelerator"
	default y
	depends on DT_HAS_RASPBERRYPI_PICO_SHA256_ENABLED
	select PICOSDK_USE_SHA256
	help
	  Enable driver for RP2 series SHA-256 accelerator
```

## drivers/crypto/Kconfig.rts5912
```kconfig
# SPDX-License-Identifier: Apache-2.0
#
# Copyright (c) 2024 Realtek Semiconductor Corporation, SIBG-SD7
#

config CRYPTO_RTS5912_SHA
	bool "Realtek embedded controller (EC) SHA2 driver"
	depends on DT_HAS_REALTEK_RTS5912_SHA_ENABLED
	default y
	help
	  Enable SHA driver.
```

## drivers/crypto/Kconfig.sf32lb
```kconfig
# SiFli SF32LB Crypto Accelerator configuration options

# Copyright (c) 2025 SiFli Technologies(Nanjing) Co., Ltd
# SPDX-License-Identifier: Apache-2.0

config CRYPTO_SF32LB
	bool "SiFli SF32LB Crypto Accelerator driver"
	default y
	depends on DT_HAS_SIFLI_SF32LB_CRYPTO_ENABLED
	help
	  Enable SiFli SF32LB Crypto Accelerator driver.
	  This driver supports AES encryption/decryption and
	  SHA hash operations.

if CRYPTO_SF32LB

config CRYPTO_SIFLI_MAX_SESSION
	int "Maximum number of sessions"
	default 2
	help
	  Maximum number of concurrent crypto sessions.

config CRYPTO_SIFLI_HASH
	bool "SiFli SHA hash support"
	default y
	help
	  Enable SHA-224 and SHA-256 hash support.

config CRYPTO_SIFLI_AES
	bool "SiFli AES cipher support"
	default y
	help
	  Enable AES-128/192/256 ECB/CBC/CTR cipher support.

config CRYPTO_SIFLI_ASYNC
	bool "SiFli crypto async operations support"
	default n
	help
	  Enable async crypto operations using interrupts.
	  When disabled, the driver uses polling mode.

endif # CRYPTO_SF32LB
```

## drivers/crypto/Kconfig.si32
```kconfig
# Copyright (c) 2024 GARDENA GmbH
# SPDX-License-Identifier: Apache-2.0

config CRYPTO_SI32
	bool "Si32 AES driver"
	default y
	depends on DT_HAS_SILABS_SI32_AES_ENABLED
	select DMA
	help
	  Enable hardware accelerated AES driver.

config CRYPTO_SI32_MAX_SESSION
	int "Maximum of sessions the Si32 driver can handle"
	default 2
	depends on CRYPTO_SI32
	help
	  This can be used to tweak the amount of sessions the driver
	  can handle in parallel.
```

## drivers/crypto/Kconfig.smartbond
```kconfig
# Smartbond Cryptographic Accelerator configuration options

# Copyright (c) 2023 Renesas Electronics Corporation
# SPDX-License-Identifier: Apache-2.0

menuconfig CRYPTO_SMARTBOND
	bool "Smartbond Cryptographic Accelerator driver"
	depends on DT_HAS_RENESAS_SMARTBOND_CRYPTO_ENABLED
	default y
	help
	  Enable Smartbond Cryptographic Accelerator driver.

config CRYPTO_ASYNC
	bool "Support ASYNC crypto operations."
	depends on CRYPTO_SMARTBOND
	help
	  Enable ASYNC crypto operations.
```

## drivers/crypto/Kconfig.stm32
```kconfig
# STM32 Cryptographic Accelerator configuration options

# Copyright (c) 2020 Markus Fuchs <markus.fuchs@de.sauter-bc.com>
# SPDX-License-Identifier: Apache-2.0

menuconfig CRYPTO_STM32
	bool "STM32 Cryptographic Accelerator driver"
	default y
	depends on DT_HAS_ST_STM32_AES_ENABLED || DT_HAS_ST_STM32_CRYP_ENABLED
	select USE_STM32_HAL_CRYP
	select USE_STM32_HAL_CRYP_EX
	select RESET
	help
	  Enable STM32 HAL-based Cryptographic Accelerator driver.

if CRYPTO_STM32

config CRYPTO_STM32_MAX_SESSION
	int "Maximum of sessions STM32 crypto driver can handle"
	default 2
	help
	  This can be used to tweak the amount of sessions the driver
	  can handle in parallel.

config CRYPTO_STM32_USE_MBEDTLS_CT_MEMCMP
	bool "Use mbedtls_ct_memcmp for constant-time comparisons"
	default y
	depends on MBEDTLS
	help
	  When disabled, operations such as authentication tag validation
	  use memcmp, which is known to be vulnerable to timing attacks.
	  It is recommended to use a constant-time comparison method
	  to enhance security.

endif # CRYPTO_STM32

config CRYPTO_STM32_HASH
	bool "STM32 Hash Accelerator driver"
	default y
	depends on DT_HAS_ST_STM32_HASH_ENABLED
	select USE_STM32_HAL_HASH
	select USE_STM32_HAL_HASH_EX
	help
	  Enable support for the STM32 HASH hardware accelerator (SHA224/SHA256),
	  using the STM32 HAL HASH driver.

config CRYPTO_STM32_HASH_MAX_SESSIONS
	int "Maximum of sessions STM32 hash driver can handle"
	default 2
	depends on CRYPTO_STM32_HASH
	help
	  This can be used to tweak the amount of sessions the driver
	  can handle in parallel.
```

## drivers/crypto/Kconfig.stm32_sha
```kconfig
# Copyright (c) 2025 Bayrem Gharsellaoui
# SPDX-License-Identifier: Apache-2.0

config CRYPTO_STM32_SHA
	bool "STM32 Hash Accelerator driver"
	default y
	depends on DT_HAS_ST_STM32_HASH_ENABLED
	select USE_STM32_HAL_HASH
	select USE_STM32_HAL_HASH_EX
	help
	  Enable support for the STM32 HASH hardware accelerator (SHA224/SHA256),
	  using the STM32 HAL HASH driver.

config CRYPTO_HASH_MAX_SESSIONS
	int "Maximum of sessions STM32 hash driver can handle"
	default 2
	depends on CRYPTO_STM32_SHA
	help
	  This can be used to tweak the amount of sessions the driver
	  can handle in parallel.
```

## drivers/crypto/Kconfig.xec
```kconfig
# Copyright (c) 2022 Intel Corporation
# SPDX-License-Identifier: Apache-2.0


config CRYPTO_MCHP_XEC_SYMCR
	bool "Microchip XEC symmetric crypto (AES/Hash) driver"
	default y
	depends on DT_HAS_MICROCHIP_XEC_SYMCR_ENABLED
	help
	  Enable Microchip XEC symmetic crypto (AES/Hash) driver.
	  Symmetric crypto provides a single hardware interface
	  to AES and hash engines.
```

## drivers/dac/Kconfig
```kconfig
# DAC configuration options

# Copyright (c) 2020 Libre Solar Technologies GmbH
# SPDX-License-Identifier: Apache-2.0

#
# DAC options
#
menuconfig DAC
	bool "Digital-to-Analog Converter (DAC) drivers"
	help
	  Enable DAC (Digital to Analog Converter) driver configuration.

if DAC

module = DAC
module-str = DAC
source "subsys/logging/Kconfig.template.log_config"

config DAC_SHELL
	bool "DAC shell"
	depends on SHELL
	help
	  Enable DAC related shell commands.

config DAC_INIT_PRIORITY
	int "DAC init priority"
	default KERNEL_INIT_PRIORITY_DEVICE
	help
	  DAC driver device initialization priority.

# zephyr-keep-sorted-start
source "drivers/dac/Kconfig.ad559x"
source "drivers/dac/Kconfig.ad569x"
source "drivers/dac/Kconfig.ad56x1"
source "drivers/dac/Kconfig.ad56xx"
source "drivers/dac/Kconfig.dac161s997"
source "drivers/dac/Kconfig.dacx0501"
source "drivers/dac/Kconfig.dacx0508"
source "drivers/dac/Kconfig.dacx3608"
source "drivers/dac/Kconfig.esp32"
source "drivers/dac/Kconfig.gd32"
source "drivers/dac/Kconfig.ltc166x"
source "drivers/dac/Kconfig.max22017"
source "drivers/dac/Kconfig.mchp"
source "drivers/dac/Kconfig.mcp4725"
source "drivers/dac/Kconfig.mcp4728"
source "drivers/dac/Kconfig.mcux"
source "drivers/dac/Kconfig.renesas_ra"
source "drivers/dac/Kconfig.sam"
source "drivers/dac/Kconfig.sam0"
source "drivers/dac/Kconfig.samd5x"
source "drivers/dac/Kconfig.silabs"
source "drivers/dac/Kconfig.stm32"
source "drivers/dac/Kconfig.test"
# zephyr-keep-sorted-stop

endif # DAC
```

## drivers/dac/Kconfig.ad5529r
```kconfig
# AD5529R DAC configuration options

# Copyright (c) 2026 The Zephyr Project Contributors
# SPDX-License-Identifier: Apache-2.0

config DAC_AD5529R
	bool "Analog Devices AD5529R DAC driver"
	default y
	select SPI
	depends on DT_HAS_ADI_AD5529R_ENABLED
	help
	  Enable the driver for the Analog Devices AD5529R 16-channel,
	  16-bit voltage output DAC.

if DAC_AD5529R

config DAC_AD5529R_INIT_PRIORITY
	int "Init priority"
	default 80
	help
	  Analog Devices AD5529R DAC device driver initialization priority.

endif # DAC_AD5529R
```

## drivers/dac/Kconfig.ad5592
```kconfig
# Copyright (c) 2023 Grinn
# SPDX -License-Identifier: Apache-2.0

config DAC_AD5592
	bool "AD5592 DAC driver"
	default y
	depends on DT_HAS_ADI_AD5592_DAC_ENABLED
	select MFD
	help
	  Enable the AD5592 DAC driver.
```

## drivers/dac/Kconfig.ad559x
```kconfig
# Copyright (c) 2023 Grinn
# SPDX -License-Identifier: Apache-2.0

config DAC_AD559X
	bool "AD559x DAC driver"
	default y
	depends on DT_HAS_ADI_AD559X_DAC_ENABLED
	select MFD
	help
	  Enable the AD559x DAC driver.
```

## drivers/dac/Kconfig.ad568x
```kconfig
# DAC configuration options

# Copyright (c) 2023 SILA Embedded Solutions GmbH
#
# SPDX-License-Identifier: Apache-2.0

config DAC_AD568X
	bool "Analog Devices AD5687/9 DAC driver"
	default y
	select SPI
	depends on DT_HAS_ADI_AD5687_ENABLED \
		|| DT_HAS_ADI_AD5689_ENABLED
	help
	  Enable the driver for the Analog Devices AD5687/9 DAC

if DAC_AD568X

config DAC_AD568X_INIT_PRIORITY
	int "Init priority"
	default 80
	help
	  Analog Devices AD5687/9 DAC device driver initialization priority.

endif # DAC_AD568X
```

## drivers/dac/Kconfig.ad569x
```kconfig
# Copyright (c) 2024 Jan Kubiznak <jan.kubiznak@deveritec.com>
# SPDX-License-Identifier: Apache-2.0

config DAC_AD569X
	bool "Analog Devices AD5691 / AD5692 / AD5693 DAC driver"
	default y
	select I2C
	depends on DT_HAS_ADI_AD5691_ENABLED || DT_HAS_ADI_AD5692_ENABLED || DT_HAS_ADI_AD5693_ENABLED
	help
	  Enable the driver for the Analog Devices AD569X.
```

## drivers/dac/Kconfig.ad56x1
```kconfig
# DAC configuration options

# SPDX-FileCopyrightText: Copyright The Zephyr Project Contributors
# SPDX-License-Identifier: Apache-2.0

config DAC_AD56X1
	bool "Analog Devices AD56x1 DAC driver"
	default y
	select SPI
	depends on DT_HAS_ADI_AD5601_ENABLED \
		|| DT_HAS_ADI_AD5611_ENABLED \
		|| DT_HAS_ADI_AD5621_ENABLED
	help
	  Enable the driver for the Analog Devices AD56x1 DAC

if DAC_AD56X1

config DAC_AD56X1_INIT_PRIORITY
	int "Init priority"
	default 80
	help
	  Analog Devices AD56x1 DAC device driver initialization priority.

endif # DAC_AD56X1
```

## drivers/dac/Kconfig.ad56xx
```kconfig
# DAC configuration options

# Copyright (c) 2023 SILA Embedded Solutions GmbH
#
# SPDX-License-Identifier: Apache-2.0

config DAC_AD56XX
	bool "Analog Devices AD56xx DAC driver"
	default y
	select SPI
	depends on DT_HAS_ADI_AD5628_ENABLED \
		|| DT_HAS_ADI_AD5648_ENABLED \
		|| DT_HAS_ADI_AD5668_ENABLED \
		|| DT_HAS_ADI_AD5672_ENABLED \
		|| DT_HAS_ADI_AD5674_ENABLED \
		|| DT_HAS_ADI_AD5676_ENABLED \
		|| DT_HAS_ADI_AD5679_ENABLED \
		|| DT_HAS_ADI_AD5684_ENABLED \
		|| DT_HAS_ADI_AD5686_ENABLED \
		|| DT_HAS_ADI_AD5687_ENABLED \
		|| DT_HAS_ADI_AD5689_ENABLED
	help
	  Enable the driver for the Analog Devices AD56xx DAC

if DAC_AD56XX

config DAC_AD56XX_INIT_PRIORITY
	int "Init priority"
	default 80
	help
	  Analog Devices AD56xx DAC device driver initialization priority.

endif # DAC_AD56XX
```

## drivers/dac/Kconfig.dac161s997
```kconfig
# Copyright (c) 2025 Vitrolife A/S
#
# SPDX-License-Identifier: Apache-2.0

config DAC_DAC161S997
	bool "TI DAC161S997 DAC driver"
	default y
	select SPI
	depends on DT_HAS_TI_DAC161S997_ENABLED
	help
	  Enable the driver for the TI DAC161S997.
```

## drivers/dac/Kconfig.dac_emul
```kconfig
# Copyright (c) 2024 Vaisala Oyj
# SPDX-License-Identifier: Apache-2.0

config DAC_EMUL
	bool "DAC emulator"
	default y
	depends on DT_HAS_ZEPHYR_DAC_EMUL_ENABLED
```

## drivers/dac/Kconfig.dac_ltc268x
```kconfig
config DAC_LTC268X
	bool
	prompt "LTC-268X: 16-channel, 12 or 16-bit DAC"
	default n
	help
	  This option enables support for the LTC-268X DAC

if DAC_LTC268X

config DAC_LTC268X_INIT_PRIORITY
	int "Init priority"
	default 80
	help
	  LTC 268x DAC device driver initialization priority.

endif # DAC_LTC268X
```

## drivers/dac/Kconfig.dacx0501
```kconfig
# DAC configuration options

# Copyright (c) 2023 Google, LLC.
#
# SPDX-License-Identifier: Apache-2.0

config DAC_DACX0501
	bool "TI DACx0501 DAC driver"
	default y
	depends on DT_HAS_TI_DACX0501_ENABLED
	select I2C
	help
	  Enable the driver for the TI DACx0501.

if DAC_DACX0501

config DAC_DACX0501_INIT_PRIORITY
	int "Init priority"
	default 80
	help
	  TI DACx0501 DAC device driver initialization priority. Must be greater than I2C_INIT_PRIORITY.

endif # DAC_DACX0501
```

## drivers/dac/Kconfig.dacx0508
```kconfig
# DAC configuration options

# Copyright (c) 2020 M2I Corporation
#
# SPDX-License-Identifier: Apache-2.0

config DAC_DACX0508
	bool "TI DACx0508 DAC driver"
	default y
	depends on SPI
	depends on DT_HAS_TI_DAC60508_ENABLED || DT_HAS_TI_DAC70508_ENABLED || \
		   DT_HAS_TI_DAC80508_ENABLED
	help
	  Enable the driver for the TI DACx0508.

if DAC_DACX0508

config DAC_DACX0508_INIT_PRIORITY
	int "Init priority"
	default 80
	help
	  TI DACx0508 DAC device driver initialization priority.

endif # DAC_DACX0508
```

## drivers/dac/Kconfig.dacx311
```kconfig
# DAC configuration options
#
# Copyright (c) 2025  Andreas Wolf <awolf002@gmail.com>
#
# SPDX-License-Identifier: Apache-2.0

config DAC_DACX311
	bool "TI DACx311/DACx411 DAC driver"
	default y
	depends on DT_HAS_TI_DAC8411_ENABLED || \
		DT_HAS_TI_DAC8311_ENABLED || DT_HAS_TI_DAC7311_ENABLED || \
		DT_HAS_TI_DAC6311_ENABLED || DT_HAS_TI_DAC5311_ENABLED
	select SPI
	help
	  Enable the driver for TI DACx311/DACx411 chip.
```

## drivers/dac/Kconfig.dacx3508
```kconfig
# DAC configuration options

# SPDX-FileCopyrightText: Copyright The Zephyr Project Contributors
#
# SPDX-License-Identifier: Apache-2.0

config DAC_DACX3508
	bool "TI DACx3508 DAC driver"
	default y
	select SPI
	depends on DT_HAS_TI_DAC43508_ENABLED \
		|| DT_HAS_TI_DAC53508_ENABLED \
		|| DT_HAS_TI_DAC63508_ENABLED
	help
	  Enable the driver for the TI DACx3508.

if DAC_DACX3508

config DAC_DACX3508_INIT_PRIORITY
	int "Init priority"
	default 80
	help
	  TI DACx3508 DAC device driver initialization priority.

endif # DAC_DACX3508
```
