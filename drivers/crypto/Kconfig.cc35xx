## drivers/crypto/Kconfig.cc35xx
```kconfig
# Copyright (c) 2025 Conclusive Engineering Sp. z o.o.
# SPDX-License-Identifier: Apache-2.0

config CRYPTO_TI_CC35XX
	bool "TI Crypto driver"
	default n
	depends on DT_HAS_TI_CC35XX_HSM_CRYPTO_ENABLED
	select TI_CC35XX_HSM
	help
	  This option enables the driver for the HSM Crypto submodule
	  for TI SimpleLink CC35xx SoCs.
```

## drivers/crypto/Kconfig.msp
```kconfig
# Copyright (c) 2026 Linumiz
# Copyright (c) 2026 Texas Instruments Inc.

# SPDX-License-Identifier: Apache-2.0

config CRYPTO_MSPM0_AES
	bool "TI MSPM0 AES driver support"
	default y
	depends on DT_HAS_TI_MSPM0_AES_ENABLED
	depends on CRYPTO
	select USE_MSPM0_DL_AES
	help
	  Enable TI MSPM0 AES driver support

config CRYPTO_MSP_AES_ADV
	bool "TI MSP AESADV driver support"
	default y
	depends on DT_HAS_TI_MSP_AES_ADV_ENABLED
	depends on CRYPTO
	help
	  Enable TI MSP Advanced AES driver support

config CRYPTO_MSPM0_MAX_SESSION
	int "Maximum AES sessions"
	default 2
	depends on CRYPTO_MSPM0_AES || CRYPTO_MSP_AES_ADV
	help
	  Maximum number of concurrent AES sessions
```

## drivers/crypto/Kconfig.opentitan
```kconfig
# SPDX-FileCopyrightText: 2026 Yousef Kitaneh
# SPDX-License-Identifier: Apache-2.0

config CRYPTO_OPENTITAN_HMAC
	bool "lowRISC OpenTitan HMAC SHA-256 accelerator driver"
	default y
	depends on DT_HAS_LOWRISC_OPENTITAN_HMAC_ENABLED
	help
	  Enable the lowRISC OpenTitan HMAC hardware accelerator driver
	  for SHA-256 hash operations.
```

## drivers/dac/Kconfig.it51xxx
```kconfig
# Copyright (c) 2026 ITE Corporation. All Rights Reserved.
# SPDX-License-Identifier: Apache-2.0

config DAC_ITE_IT51XXX
	bool "ITE IT51xxx DAC driver"
	default y
	depends on DT_HAS_ITE_IT51XXX_DAC_ENABLED
	select PINCTRL
	help
	  Enable the DAC driver for ITE IT51xxx processors.
	  The hardware has two channels with fixed 8-bit resolution.
	  Each channel outputs a voltage between 0 V and AVCC.
```

## drivers/dac/Kconfig.mspm0
```kconfig
# TI MSPM0 DAC Driver Configuration

# Copyright (c) 2026 Linumiz
# Copyright (c) 2026 Texas Instruments Incorporated
# SPDX-License-Identifier: Apache-2.0

config DAC_MSPM0
	bool "TI MSPM0 Digital To Analog Converter (DAC) Driver"
	default y
	depends on DT_HAS_TI_MSPM0_DAC_ENABLED
	help
	  Enable support for the DAC (Digital-to-Analog Converter)
	  peripheral driver for Texas Instruments MSPM0 G-Series MCUs.
```

## drivers/dai/amd/dmic/Kconfig.dmic_dai
```kconfig
# SPDX-FileCopyrightText: Copyright (c) 2026 AMD
# SPDX-License-Identifier: Apache-2.0

config DAI_AMD_DMIC
	bool "AMD DMIC DAI driver"
	default y
	depends on DT_HAS_AMD_DMIC_DAI_ENABLED
	help
	  Enable the AMD ACP DMIC (PDM) DAI driver.
	  Handles DMIC0 (WOV PDM) and DMIC1 (PDM2) capture instances.
```

## drivers/debug/Kconfig.infineon
```kconfig
# Copyright The Zephyr Project Contributors
# SPDX-License-Identifier: Apache-2.0

config DEBUG_INFINEON_CAT1_TRACE
	bool "Infineon CAT1 parallel trace port"
	default y
	depends on DT_HAS_INFINEON_CAT1_TRACE_ENABLED
	depends on PINCTRL
	help
	  Route the Infineon CAT1 parallel trace port pins (trace clock and trace
	  data) so an external trace probe can capture ETM/ITM instruction trace.
	  This covers the CAT1 MCUs with the CoreSight SoC-600 DEBUG600 subsystem,
	  such as PSOC Edge E84 and PSOC Control C3. HSIOM is a secure peripheral on
	  these devices, so the trace pins can only be muxed by firmware running on
	  the secure CM33.
```

## drivers/disk/Kconfig.memc_ram
```kconfig
# Copyright (c) 2026 Nordic Semiconductor ASA
# SPDX-License-Identifier: Apache-2.0

config DISK_DRIVER_MEMC_RAM
	bool "MEMC RAM disk"
	depends on DT_HAS_ZEPHYR_MEMC_RAM_DISK_ENABLED
	select MEMC
	default y
	help
	  Disk driver backed by an external RAM device accessed
	  through the MEMC subsystem API. Sector read/write
	  operations are translated to memc_read()/memc_write()
	  calls on the linked MEMC device.

if DISK_DRIVER_MEMC_RAM

config MEMC_RAMDISK_INIT_PRIORITY
	int "MEMC RAM disk init priority"
	default MEMC_INIT_PRIORITY
	help
	  Init priority for the MEMC RAM disk driver.
	  Must be at least CONFIG_MEMC_INIT_PRIORITY to ensure
	  the backing MEMC device is available when this driver
	  initializes.

module = MEMC_RAMDISK
module-str = memc_ramdisk
source "subsys/logging/Kconfig.template.log_config"

endif # DISK_DRIVER_MEMC_RAM
```

## drivers/disk/Kconfig.scsi
```kconfig
# Copyright (c) 2026 Advanced Micro Devices, Inc.
# SPDX-License-Identifier: Apache-2.0

config DISK_DRIVER_SCSI
	bool "Generic disk_access backend over SCSI mid-layer"
	depends on SCSI
	help
	  Register a disk_access volume backed by a bound struct scsi_device.
	  Transport-agnostic: used by USB MSC, UFS, or application code that
	  binds a SCSI device and calls scsi_disk_register().

if DISK_DRIVER_SCSI

config SCSI_DISK_BOUNCE_BUF
	bool "Bounce buffer for unaligned disk I/O"
	default y
	help
	  When application buffers are not aligned to CONFIG_SCSI_DISK_BUF_ALIGN,
	  copy through a static internal bounce buffer (same model as the SD
	  card_buffer). Each struct scsi_disk embeds CONFIG_SCSI_DISK_BOUNCE_SIZE
	  bytes; no heap is used.

config SCSI_DISK_BOUNCE_SIZE
	int "Bounce buffer size in bytes"
	default 4096
	depends on SCSI_DISK_BOUNCE_BUF
	help
	  Size of the internal bounce buffer used for unaligned I/O.

config SCSI_DISK_BUF_ALIGN
	int "Minimum buffer alignment for direct SCSI I/O"
	default 4
	help
	  Buffers aligned to this boundary are passed directly to the SCSI
	  mid-layer; others use the bounce buffer when enabled.

module = SCSI_DISK
module-str = scsi_disk
source "subsys/logging/Kconfig.template.log_config"

endif # DISK_DRIVER_SCSI
```

## drivers/disk/Kconfig.semihost
```kconfig
# Copyright (c) 2026 RBR Ltd.
# SPDX-License-Identifier: Apache-2.0

config DISK_DRIVER_SEMIHOST
	bool "Semihost file-backed disk"
	default y
	depends on DT_HAS_ZEPHYR_SEMIHOST_DISK_ENABLED
	depends on SEMIHOST
	help
	  Enable a disk driver backed by a file on the semihosting host.
	  Suitable for QEMU targets. Disk data persists in the host file
	  between runs.

if DISK_DRIVER_SEMIHOST

module = SEMIHOST_DISK
module-str = semihost_disk
source "subsys/logging/Kconfig.template.log_config"

endif # DISK_DRIVER_SEMIHOST
```

## drivers/disk/Kconfig.usb_msc
```kconfig
# Copyright (c) 2026 Espressif Systems (Shanghai) Co., Ltd.
# SPDX-License-Identifier: Apache-2.0

config USB_MSC_DISK
	bool "USB mass storage disk access"
	depends on DT_HAS_ZEPHYR_USB_MSC_DISK_ENABLED
	default y
	select USB_HOST_STACK
	select USBH_MSC
	help
	  Expose a USB mass storage device attached to the USB host stack
	  as a disk access device, so a file system can be mounted on it.

if USB_MSC_DISK

module = USB_MSC_DISK
module-str = usb msc disk
source "subsys/logging/Kconfig.template.log_config"

endif # USB_MSC_DISK
```

## drivers/disk/Kconfig.virtio_blk
```kconfig
# SPDX-FileCopyrightText: Copyright (c) 2026 Process Mission
# SPDX-License-Identifier: Apache-2.0

config DISK_DRIVER_VIRTIO_BLK
	bool "VIRTIO block disk driver"
	default y
	depends on DT_HAS_VIRTIO_BLK_ENABLED
	select VIRTIO
	help
	  Enable driver for VIRTIO block devices.

if DISK_DRIVER_VIRTIO_BLK

config DISK_VIRTIO_BLK_MAX_SEGMENTS
	int "VIRTIO block max scatter-gather data segments per request"
	depends on MMU
	default 14
	range 1 254
	help
	  Maximum number of scatter-gather data segments a single block request
	  may carry. This is the data segment budget, not the final virtqueue
	  size. The request queue is sized for (MAX_SEGMENTS + 2) descriptors
	  times MAX_INFLIGHT, rounded up to a power of two; the two extra
	  descriptors hold the request header and status byte. The default of
	  14 segments with 4 requests in flight uses a 64-entry queue.

	  The request queue is limited to 256 entries. When the configured
	  combination would need more, the driver lowers the effective number of
	  in-flight requests at build time, so every MAX_SEGMENTS value in its
	  range still builds.

	  This bounds how physically fragmented a single transfer can be before
	  the driver splits it into several device requests.

config DISK_VIRTIO_BLK_MAX_INFLIGHT
	int "VIRTIO block max in-flight requests"
	default 4
	range 1 16
	help
	  Number of requests the driver can keep in flight. Each request needs
	  its own header, status byte and completion semaphore. The request
	  queue is sized for this many maximum-length requests, rounded up to a
	  power of two and capped at 256 entries. This value is an upper bound:
	  when (MAX_SEGMENTS + 2) * MAX_INFLIGHT would exceed 256, the driver
	  lowers the effective number of in-flight requests at build time. If the
	  device advertises a smaller queue, that size is used.

	  The default of 4 raises the default request queue from 16 to 64
	  entries. Set to 1 to keep the previous single-request behavior.

config DISK_VIRTIO_BLK_SECTOR_SIZE
	int "VIRTIO block fallback logical block size"
	default 512
	range 512 4096
	help
	  Logical block (sector) size reported to the disk access layer when the
	  device does not advertise VIRTIO_BLK_F_BLK_SIZE. When the device does
	  advertise it, the device-reported blk_size is used instead and this
	  value is ignored. Must be a multiple of 512 and, under CONFIG_MMU, must
	  not exceed the MMU page size.

module = DISK_VIRTIO_BLK
module-str = disk_virtio_blk
source "subsys/logging/Kconfig.template.log_config"

endif # DISK_DRIVER_VIRTIO_BLK
```

## drivers/disk/Kconfig.virtual_fat_disk
```kconfig
# Copyright (c) 2026 Leica Geosystems AG
# SPDX-License-Identifier: Apache-2.0

config DISK_DRIVER_VIRTUAL_FAT
	bool "Virtual FAT disk"
	depends on DT_HAS_ZEPHYR_VIRTUAL_FAT_DISK_ENABLED
	select VIRTUAL_FAT
	default y

if DISK_DRIVER_VIRTUAL_FAT

module = VIRTUAL_FAT_DISK
module-str = virtual_fat_disk
source "subsys/logging/Kconfig.template.log_config"

endif # DISK_DRIVER_VIRTUAL_FAT
```

## drivers/display/Kconfig.adi_adv7535
```kconfig
# Copyright (c) 2026 Antmicro <www.antmicro.com>
#
# SPDX-License-Identifier: Apache-2.0

config ADI_ADV7535
	bool "Analog Devices ADV7535 DSI-to-HDMI bridge driver"
	default y
	select MIPI_DSI
	select I2C
	select GPIO
	depends on DT_HAS_ADI_ADV7535_ENABLED
	help
	  Enable driver for Analog Devices ADV7535 DSI-to-HDMI display bridge.

if ADI_ADV7535

config ADV7535_THREAD_PRIORITY
	int "Driver internal thread priority"
	default -1 if COOP_ENABLED
	default 0
	help
	  Priority of the thread used to handle ADV7535 interrupts.
	  Defaults to the lowest priority cooperative thread.

config ADV7535_THREAD_STACK_SIZE
	int "Driver internal thread stack size"
	default 1024
	help
	  Size of the stack used in the driver.

endif
```

## drivers/display/Kconfig.adv7535
```kconfig
# Copyright (C) 2026, Savoir-faire Linux, Inc.
# SPDX-License-Identifier: Apache-2.0

config ADV7535
	bool "Analog Devices ADV7535 DSI-to-HDMI bridge"
	default y
	select I2C
	select MIPI_DSI
	depends on DT_HAS_ADI_ADV7535_ENABLED
	help
	  Initialize an ADV7535 for an RGB888 video mode and attach it to a
	  MIPI DSI host. Runtime mode selection and HDMI services are not supported.

if ADV7535

config ADV7535_INIT_PRIORITY
	int "ADV7535 initialization priority"
	default 90
	help
	  Must be later than the MIPI DSI host initialization priority.

endif
```

## drivers/display/Kconfig.axs15231b
```kconfig
# SPDX-FileCopyrightText: Copyright 2026 NXP

config AXS15231B
	bool "AXS15231B display driver"
	default y
	depends on DT_HAS_ESPRESSIF_AXS15231B_ENABLED
	select MIPI_DBI
	help
	  Enable driver for AXS15231B display controller.
```

## drivers/display/Kconfig.dummy
```kconfig
# Configuration options for dummy display

# Copyright (c) 2018 Jan Van Winkel <jan.van_winkel@dxplore.eu>
# SPDX-License-Identifier: Apache-2.0

config DUMMY_DISPLAY
	bool "Dummy display driver"
	default y
	depends on DT_HAS_ZEPHYR_DUMMY_DC_ENABLED
	help
	  Enable dummy display driver compliant with display driver API.

config DUMMY_DISPLAY_PLANES
	int "Planes of the dummy display"
	depends on DUMMY_DISPLAY
	default 4
	range 0 8
	help
	  Number of planes the dummy display reports and accepts
	  through display_set_plane(). With 0 the plane operations are not
	  implemented and return -ENOSYS, as on a display without planes.
```

## drivers/display/Kconfig.ek79007
```kconfig
# Copyright (c) 2026 Espressif Systems (Shanghai) Co., Ltd.
# SPDX-License-Identifier: Apache-2.0

config EK79007
	bool "EK79007 display panel driver"
	default y
	depends on DT_HAS_FITIPOWER_EK79007_ENABLED
	select MIPI_DSI
	select GPIO if $(dt_compat_any_has_prop,$(DT_COMPAT_FITIPOWER_EK79007),bl-gpios) || \
		$(dt_compat_any_has_prop,$(DT_COMPAT_FITIPOWER_EK79007),reset-gpios)
	help
	  Enable driver for the EK79007 MIPI DSI display panel.

config DISPLAY_EK79007_INIT_PRIORITY
	int "Initialization priority"
	depends on EK79007
	default MIPI_DSI_INIT_PRIORITY
	help
	  EK79007 display driver initialization priority. The panel attaches
	  to the MIPI DSI host, so it has to initialize after the host and
	  after the controller streaming to it.
```

## drivers/display/Kconfig.esp32_dpi
```kconfig
# Copyright (c) 2026 Espressif Systems (Shanghai) Co., Ltd.
# SPDX-License-Identifier: Apache-2.0

config DISPLAY_ESP32_DPI
	bool "Espressif ESP32 LCD_CAM DPI display controller"
	default y
	depends on DT_HAS_ESPRESSIF_ESP32_DPI_DISPLAY_ENABLED
	depends on ESP32_LCD_CAM
	depends on DT_HAS_ESPRESSIF_ESP32_GDMA_ENABLED
	select DMA
	select PINCTRL
	select SHARED_MULTI_HEAP
	help
	  Enable driver for panels connected to the ESP32-S3 LCD_CAM
	  parallel RGB (MIPI DPI) interface.

if DISPLAY_ESP32_DPI

config DISPLAY_ESP32_DPI_BOUNCE_BUFFER_LINES
	int "DPI bounce buffer height in lines"
	default 20
	range 1 64
	help
	  Height of each of the two internal SRAM bounce buffers through
	  which the PSRAM framebuffer is sent to the panel. The panel height
	  must be a multiple of this value.

endif
```

## drivers/display/Kconfig.esp32_dsi
```kconfig
# Copyright (c) 2026 Espressif Systems (Shanghai) Co., Ltd.
# SPDX-License-Identifier: Apache-2.0

menuconfig DISPLAY_ESP32_DSI
	bool "ESP32 MIPI DSI display controller"
	default y
	depends on DT_HAS_ESPRESSIF_ESP_DSI_DISPLAY_ENABLED
	depends on SOC_SERIES_ESP32P4
	select ESP_SPIRAM
	select SHARED_MULTI_HEAP
	select MIPI_DSI
	help
	  Enable driver for the ESP32 MIPI DSI display controller, which
	  streams the framebuffer to a video mode panel. The framebuffers are
	  megabytes in size, so they are allocated from external memory.

if DISPLAY_ESP32_DSI

config DISPLAY_ESP32_DSI_FB_NUM
	int "Framebuffers to allocate in the driver"
	default 2
	range 1 2
	help
	  Two framebuffers let the driver present a finished frame while the
	  next one is drawn, so an update is tear-free.

config DISPLAY_ESP32_DSI_INIT_PRIORITY
	int "ESP32 MIPI DSI display controller init priority"
	default DISPLAY_INIT_PRIORITY
	help
	  Initialization priority of the controller. The host starts the
	  scanout once a panel attaches, so this only has to place the
	  controller before the panel.

endif # DISPLAY_ESP32_DSI
```
