## drivers/display/Kconfig.esp32_lcd_cam_rgb
```kconfig
# Copyright (c) 2026 Kim Bøndergaard <kim@fam-boendergaard.dk>
# SPDX-License-Identifier: Apache-2.0

config DISPLAY_ESP32_LCD_CAM_RGB
	bool "ESP32 LCD_CAM RGB display controller"
	default y
	depends on SOC_SERIES_ESP32S3
	depends on DT_HAS_ESPRESSIF_ESP32_LCD_CAM_RGB_ENABLED
	help
	  Enable the ESP32-S3 LCD_CAM RGB display controller. It owns the
	  framebuffer and streams it to a parallel RGB panel.

config DISPLAY_ESP32_LCD_CAM_RGB_INIT_PRIORITY
	int "LCD_CAM RGB init priority"
	default DISPLAY_INIT_PRIORITY
	depends on DISPLAY_ESP32_LCD_CAM_RGB
	help
	  Initialization priority of the LCD_CAM RGB display controller. Its value
	  must not be lower than the init priority value of the panel controller,
	  which has to be ready before the RGB stream starts.

config DISPLAY_ESP32_LCD_CAM_RGB_BOUNCE_BUFFER_SIZE
	int "LCD_CAM RGB bounce buffer size per instance (bytes)"
	depends on DISPLAY_ESP32_LCD_CAM_RGB
	range 1024 65536
	default 16128
	help
	  Maximum internal SRAM reserved for the bounce buffers of each
	  LCD_CAM RGB display instance. The driver selects a layout within this
	  limit based on the framebuffer size. Each DMA chunk must be 256 to
	  4032 bytes and a multiple of 64 bytes. The DMA ring contains at least
	  four bounce buffers, each holding one chunk. The framebuffer must divide
	  evenly into chunks, with a whole number of frame chunks per ring cycle.
```

## drivers/display/Kconfig.esp32_rgb
```kconfig
# Copyright (c) 2026 Espressif Systems (Shanghai) Co., Ltd.
# SPDX-License-Identifier: Apache-2.0

config DISPLAY_ESP32_RGB
	bool "Espressif RGB panel on ESP32 LCD-CAM"
	default y
	depends on DT_HAS_ESPRESSIF_ESP32_RGB_ENABLED
	select DMA
	select PINCTRL
	help
	  Enable driver for Espressif RGB panels connected to the
	  ESP32-S3 LCD-CAM parallel RGB interface.

if DISPLAY_ESP32_RGB

config ESP32_RGB_BOUNCE_BUFFER_LINES
	int "RGB bounce buffer height in lines"
	default 20
	range 0 64
	help
	  When non-zero, scanout copies the PSRAM framebuffer into internal
	  SRAM bounce buffers for GDMA (required for reliable ESP32-S3 RGB
	  panels with octal PSRAM). Set to 0 to DMA directly from PSRAM.

endif
```

## drivers/display/Kconfig.framebuffer
```kconfig
# Copyright (c) 2026 Muhammad Waleed Badar
# SPDX-License-Identifier: Apache-2.0

config DISPLAY_FRAMEBUFFER
	bool
	help
	  Enable library used for framebuffer drivers.
```

## drivers/display/Kconfig.ili98xx_dsi
```kconfig
# SPDX-FileCopyrightText: 2026 Renesas Electronics Corporation
# SPDX-License-Identifier: Apache-2.0

config ILI98XX_DSI
	bool
	help
	  Hidden configuration entry for all ILI9XXX MIPI-DSI drivers.

config ILI9806E_DSI
	bool "ILI9806E_DSI display driver"
	default y
	depends on DT_HAS_ILITEK_ILI9806E_ENABLED
	select MIPI_DSI
	select ILI98XX_DSI
	help
	  Enable driver for ILI9806E_DSI display driver.

config ILI9881C_DSI
	bool "ILI9881C_DSI display driver"
	default y
	depends on DT_HAS_ILITEK_ILI9881C_ENABLED
	select MIPI_DSI
	select ILI98XX_DSI
	select GPIO if $(dt_compat_any_has_prop,$(DT_COMPAT_ILITEK_ILI9881C),reset-gpios) || \
		$(dt_compat_any_has_prop,$(DT_COMPAT_ILITEK_ILI9881C),bl-gpios)
	help
	  Enable driver for ILI9881C_DSI display driver.
```

## drivers/display/Kconfig.jdi_parallel
```kconfig
# Copyright (c) 2026 Qingsong Gou <gouqs@hotmail.com>
# SPDX-License-Identifier: Apache-2.0

config JDI_PARALLEL
	bool "JDI parallel interface display driver"
	default y
	depends on DT_HAS_JDI_PARALLEL_ENABLED
	select JDI
	help
	  Enable driver for JDI parallel interface display.
```
