## drivers/disk/Kconfig.ufs
```kconfig
# Copyright (c) 2025 Advanced Micro Devices, Inc.
# SPDX-License-Identifier: Apache-2.0

config DISK_DRIVER_UFS
	bool "Disk operations on UFS card"
	default y if DT_HAS_ZEPHYR_UFS_DISK_ENABLED
	select SCSI
	select UFS_STACK
	help
	  UFS device as disk driver.

if DISK_DRIVER_UFS

config UFSDISK_INIT_PRIORITY
	int "Init priority"
	default 90
	help
	  UFS disk device driver initialization priority

config UFS_BUFFER_SIZE
	int
	default 4096
	help
	  Size in bytes of internal buffer UFS card uses for unaligned reads.

module = UFSDISK
module-str = ufsdisk
source "subsys/logging/Kconfig.template.log_config"

endif # DISK_DRIVER_UFS
```

## drivers/disk/Kconfig.usb2
```kconfig
# Copyright (c) 2023 Intel Corporation
# SPDX-License-Identifier: Apache-2.0

config DISK_DRIVER_USB2
	bool "USB2 Disk"
	help
	  This option enables to use USB 2.0 disk along with a file system.

if DISK_DRIVER_USB2

config DISK_USB2_VOLUME_NAME
	string "USB2 Disk mount point or drive name"
	default "USB2"
	help
	  Disk name as per file system naming guidelines.

module = USB2DISK
module-str = usb2disk
source "subsys/logging/Kconfig.template.log_config"

endif # DISK_DRIVER_USB2
```

## drivers/disk/Kconfig.usdhc
```kconfig
# Copyright (c) 2021 NXP
# SPDX-License-Identifier: Apache-2.0

# USDHC peripheral require the SD card to power cycle after DAT3 is
# pulled low
config SDMMC_USDHC_DAT3_PWR_TOGGLE
	bool
	help
	  USDHC peripheral requires the SD card power to be cycled after DAT3 is
	  pulled high, before the USDHC peripheral can detect the SD card via DAT3
	  pull

config SDMMC_USDHC_DAT3_PWR_DELAY
	int
	default 0
	help
	  Period in milliseconds to delay between powering off the SD card and
	  applying power again, whenever the SD card power will be cycled.
```

## drivers/disk/nvme/Kconfig
```kconfig
# Copyright (c) 2022 Intel Corporation
# SPDX-License-Identifier: Apache-2.0

menuconfig NVME
	bool "NVMe disk"
	depends on PCIE
	select PCIE_MSI_X
	select PCIE_MSI_MULTI_VECTOR
	help
	  NVMe disk(s) might be present on the system through PCIe, enable this
	  driver to support these. It will enable MSI-X and MSI multi-vector
	  support

if NVME

config NVME_ADMIN_ENTRIES
	int "Number of admin queue entries"
	range 2 4096
	default 256
	help
	  This sets the amount of allocated admin queue entries.
	  Do not touch this unless you know what you are doing.

config NVME_IO_QUEUES
	int "Number of IO queues"
	range 1 65536
	default 1
	help
	  This sets the amount of allocated I/O queues.
	  Do not touch this unless you know what you are doing.

config NVME_IO_ENTRIES
	int "Number of IO queue entries"
	range 2 65536
	default 256
	help
	  This sets the amount of allocated IO queue entries.
	  Do not touch this unless you know what you are doing.

config NVME_INT_PRIORITY
	int "Interrupt priority"
	default 2
	help
	  Interrupt priority used for the MSI-X generated interrupts.

module = NVME
module-str = nvme
source "subsys/logging/Kconfig.template.log_config"

endif # NVME
```

## drivers/display/Kconfig
```kconfig
# Display drivers

# Copyright (c) 2017 Intel Corporation
# SPDX-License-Identifier: Apache-2.0

menuconfig DISPLAY
	bool "Display controller drivers"
	help
	  Enable display drivers

if DISPLAY

config DISPLAY_INIT_PRIORITY
	int "Display devices init priority"
	default 85
	help
	  Display devices initialization priority.

module = DISPLAY
module-str = display
source "subsys/logging/Kconfig.template.log_config"

source "drivers/display/Kconfig.*"

endif # DISPLAY
```

## drivers/display/Kconfig.ac057tc1
```kconfig
# Copyright 2026 Fabian Blatz <fabianblatz@gmail.com>
# SPDX-License-Identifier: Apache-2.0

config AC057TC1
	bool "AC057TC1 display controller"
	default y
	depends on DT_HAS_EINK_AC057TC1_ENABLED
	select MIPI_DBI
	select DISPLAY_COLOR_PALETTE
	select DISPLAY_COLOR_DITHER_SUPPORTED
	help
	  Enable driver for AC057TC1 display controller.
```

## drivers/display/Kconfig.backlight_pwm
```kconfig
# Configuration for backlight pwm driver

# Copyright (c) 2024 Martin Kiepfer <mrmarteng@teleschirm.org>
# SPDX-License-Identifier: Apache-2.0

config BACKLIGHT_PWM
	bool "Backlight PWM driver"
	default y
	depends on DT_HAS_BACKLIGHT_PWM_ENABLED
	help
	  Enable Backlight PWM driver.

config BACKLIGHT_PWM_INIT_PRIORITY
	int "Backlight-PWM driver initialization priority"
	default 70
	help
	  Initialization priority for the Backlight-PWM driver. It must be
	  greater than the PWM controller init priority.
```

## drivers/display/Kconfig.charlieplex_led_matrix
```kconfig
# Copyright (c) 2026 Qualcomm Innovation Center, Inc.
# SPDX-License-Identifier: Apache-2.0

config DISPLAY_CHARLIEPLEX_LED_MATRIX
	bool "Charlieplexed LED matrix display driver"
	default y
	depends on DT_HAS_CHARLIEPLEX_LED_MATRIX_ENABLED
	select GPIO
	select COUNTER
	help
	  Enable the display driver for a monochrome/grayscale LED matrix driven
	  by charlieplexed GPIOs. N GPIO lines drive up to N*(N-1) LEDs; each
	  pixel is lit by driving one line high and one low while the rest are
	  high-impedance. A timer (counter device) ISR scans the pixels fast
	  enough for persistence of vision. The GPIO bank, pixel-to-pin-pair
	  map, refresh frequency and grayscale depth are configured in a
	  "charlieplex-led-matrix" compatible devicetree node. Exposes the
	  display API.

if DISPLAY_CHARLIEPLEX_LED_MATRIX

config DISPLAY_CHARLIEPLEX_LED_MATRIX_INIT_PRIORITY
	int "Charlieplex LED matrix init priority"
	default DISPLAY_INIT_PRIORITY
	help
	  Device initialization priority. Must be greater than GPIO and COUNTER
	  init priorities so those devices are ready first.

endif # DISPLAY_CHARLIEPLEX_LED_MATRIX
```

## drivers/display/Kconfig.co5300
```kconfig
# Copyright 2025 NXP
# SPDX-License-Identifier: Apache-2.0

config CO5300
	bool "CO5300 display driver"
	default y
	select MIPI_DSI
	depends on DT_HAS_CHIPONE_CO5300_ENABLED
	help
	  Enable driver for CO5300 display controller
```

## drivers/display/Kconfig.color_dither
```kconfig
# SPDX-FileCopyrightText: Copyright The Zephyr Project Contributors
# SPDX-License-Identifier: Apache-2.0

config DISPLAY_COLOR_DITHER_SUPPORTED
	bool
	help
	  Selected by display drivers that integrate the color dithering helper.

menuconfig DISPLAY_COLOR_DITHER
	bool "Color dithering"
	default y
	depends on DISPLAY_COLOR_PALETTE
	depends on DISPLAY_COLOR_DITHER_SUPPORTED
	help
	  Enable a helper library that lets palette-backed display drivers that integrate it
	  automatically accept RGB565 and/or RGB888 writes and dither them down to the panel's
	  native I_4 palette format.

if DISPLAY_COLOR_DITHER

config DISPLAY_COLOR_DITHER_INPUT_RGB565
	bool "Accept RGB565 input"
	default y
	help
	  Let palette-backed drivers accept RGB565 frames and dither them to their I_4 palette. Adds
	  a per-instance conversion buffer sized for one full I_4 frame.

config DISPLAY_COLOR_DITHER_INPUT_RGB888
	bool "Accept RGB888 input"
	help
	  Let palette-backed drivers accept RGB888 frames and dither them to their I_4 palette. Adds
	  a per-instance conversion buffer sized for one full I_4 frame.

choice DISPLAY_COLOR_DITHER_ALGORITHM
	prompt "Dithering algorithm"
	default DISPLAY_COLOR_DITHER_ALGORITHM_ATKINSON
	help
	  Algorithm used when non-I_4 writes are converted to the panel's I_4 palette format.

config DISPLAY_COLOR_DITHER_ALGORITHM_NONE
	bool "None (nearest-palette only)"
	help
	  Map each source pixel to its nearest palette entry. Fastest option, preserves hard edges
	  in text, icons and exact palette artwork.

config DISPLAY_COLOR_DITHER_ALGORITHM_ORDERED_BAYER_4X4
	bool "Ordered Bayer 4x4"
	help
	  Good general-purpose choice for small displays and simple graphics.

config DISPLAY_COLOR_DITHER_ALGORITHM_ORDERED_BAYER_8X8
	bool "Ordered Bayer 8x8"
	help
	  Smoother gradients than 4x4 ordered dithering, at the cost of a larger visible ordered
	  pattern.

config DISPLAY_COLOR_DITHER_ALGORITHM_FLOYD_STEINBERG
	bool "Floyd-Steinberg"
	help
	  Diffuses quantization error between neighbouring pixels. Typically slower and uses two
	  extra per-row signed-error buffers, but gives the best average tone and hue accuracy for
	  photos and gradients.

config DISPLAY_COLOR_DITHER_ALGORITHM_ATKINSON
	bool "Atkinson"
	help
	  Error-diffusion variant from the original Macintosh imaging stack.
	  A good fit for monochrome and few-colour palettes (e-paper, retro UI). Uses three extra
	  per-row signed-error buffers.

endchoice

choice DISPLAY_COLOR_DITHER_DEFAULT_FORMAT
	prompt "Default pixel format reported by opt-in drivers"
	default DISPLAY_COLOR_DITHER_DEFAULT_RGB888 if DISPLAY_COLOR_DITHER_INPUT_RGB888
	default DISPLAY_COLOR_DITHER_DEFAULT_RGB565 if DISPLAY_COLOR_DITHER_INPUT_RGB565
	default DISPLAY_COLOR_DITHER_DEFAULT_I4
	help
	  Palette-backed I_4 drivers that use this helper advertise this as their input pixel format
	  on boot. Applications that never call display_set_pixel_format() will write in this
	  format.

config DISPLAY_COLOR_DITHER_DEFAULT_I4
	bool "I_4"

config DISPLAY_COLOR_DITHER_DEFAULT_RGB565
	bool "RGB565"
	depends on DISPLAY_COLOR_DITHER_INPUT_RGB565

config DISPLAY_COLOR_DITHER_DEFAULT_RGB888
	bool "RGB888"
	depends on DISPLAY_COLOR_DITHER_INPUT_RGB888

endchoice

endif # DISPLAY_COLOR_DITHER
```

## drivers/display/Kconfig.display_backlight
```kconfig
# Copyright 2024 Fabian Blatz <fabianblatz@gmail.com>
# SPDX-License-Identifier: Apache-2.0

config DISPLAY_BACKLIGHT
	bool
	help
	  Enable library used for display backlight drivers.

if DISPLAY_BACKLIGHT

config DISPLAY_BACKLIGHT_CONTROL_ENABLE_GPIO
	bool "Gpio enable pin for display backlight"
	help
	  Enable support for gpio enable pin.

config DISPLAY_BACKLIGHT_CONTROL_PWM
	bool "Control display brightness via PWM"
	help
	  Enable brightness control via external PWM.

endif # DISPLAY_BACKLIGHT
```

## drivers/display/Kconfig.display_mipi_dbi
```kconfig
# Copyright 2024 NXP
# SPDX-License-Identifier: Apache-2.0

config DISPLAY_MIPI_DBI
	bool "MIPI DBI display driver"
	default n
	select MIPI_DBI
	help
	  Enable driver for MIPI DBI display driver.
```

## drivers/display/Kconfig.downsampling_dither_proxy
```kconfig
# Copyright (c) 2026 MASSDRIVER EI (massdriver.space)
# SPDX-License-Identifier: Apache-2.0

config DOWNSAMPLING_DITHER_PROXY
	bool "Downsampling dithering display driver"
	default y
	depends on DT_HAS_ZEPHYR_DOWNSAMPLING_DITHER_PROXY_ENABLED
	help
	  Enable mock display driver proxying a display for dithering.
```

## drivers/display/Kconfig.eadogs164
```kconfig
# EADOGS164 display driver configuration options

# Copyright (c) 2020
# SPDX-License-Identifier: Apache-2.0

menuconfig EADOGS164_DISPLAY
	bool "EADOGS164 display driver"
	depends on I2C
	help
	  Enable driver for EADOGS164 display driver.

if EADOGS164_DISPLAY

config EADOGS164_DISPLAY_ROM
	int "Select one of out possible ROM, 0-ROMA, 1-ROMB, 3-ROMC"
	default 1

config EADOGS164_DISPLAY_RAB2_0
	int "resistor values for internal feedback amp for LCD voltage (0-7)"
	default 3

endif # EADOGS164_DISPLAY
```

## drivers/display/Kconfig.ed2208_gca
```kconfig
# Copyright 2026 The Zephyr Project Contributors
# SPDX-License-Identifier: Apache-2.0

config ED2208_GCA
	bool "ED2208-GCA (EL073TF1) display controller"
	default y
	depends on DT_HAS_EINK_ED2208_GCA_ENABLED
	select MIPI_DBI
	help
	  Enable driver for ED2208-GCA (EL073TF1) Spectra 6 e-ink displays.
```

## drivers/display/Kconfig.efi_gop
```kconfig
# Copyright (c) 2025 rede97
# SPDX-License-Identifier: Apache-2.0

config DISPLAY_EFI_GOP
	bool "EFI GOP (Graphics Output Protocol) framebuffer display"
	default n
	depends on DISPLAY && X86_EFI && DT_HAS_ZEPHYR_EFI_GOP_DISPLAY_ENABLED
	help
	  Display driver for the EFI GOP framebuffer. Uses GOP information
	  (address, size, resolution, pitch) saved by the Zephyr EFI loader
	  (zefi) when it initializes the screen. The framebuffer is mapped
	  into the kernel and exposed via the display API.
	  Only available when booted via x86 EFI with GOP provided by the
	  bootloader.
```

## drivers/display/Kconfig.ek79652
```kconfig
# EK79652 display controller configuration options

# Copyright (c) 2021 Linumiz
# SPDX-License-Identifier: Apache-2.0

config EK79652
	bool "EK79652 compatible display controller driver"
	depends on SPI
	help
	  Enable driver for EK79652 compatible controller.
```

## drivers/display/Kconfig.g1120tb101
```kconfig
# Copyright (c) 2025 STMicroelectronics
# SPDX-License-Identifier: Apache-2.0

config G1120TB101
	bool "G1120TB101 display controller"
	default y
	depends on DT_HAS_GVO_G1120TB101_ENABLED
	select MIPI_DSI
	help
	  Enable the driver for GVO G1120TB101 display controller.

if G1120TB101

config DISPLAY_G1120TB101_INIT_PRIORITY
	int "Initialization priority"
	default DISPLAY_INIT_PRIORITY
	help
	  G1120TB101 display driver initialization priority.

endif
```

## drivers/display/Kconfig.gc9a01a
```kconfig
# GC9A01A display driver configuration options

# SPDX-License-Identifier: Apache-2.0

config GC9A01A
	bool "GC9A01A display driver"
	default y
	depends on DT_HAS_WAVESHARE_GC9A01A_ENABLED
	select SPI
	select PWM
	help
	  Enable driver for GC9A01A display driver.
```

## drivers/display/Kconfig.gc9x01x
```kconfig
# Copyright 2023 Martin Kiepfer <mrmarteng@teleschirm.org>
# SPDX-License-Identifier: Apache-2.0

config GC9X01X
	bool "GC9X01X display driver"
	default y
	depends on DT_HAS_GALAXYCORE_GC9X01X_ENABLED
	select MIPI_DBI
	help
	  Enable driver for GC9X01X display driver.
```

## drivers/display/Kconfig.gd7965
```kconfig
# GD7965 display controller configuration options

# Copyright (c) 2020 Phytec Messtechnik GmbH
# SPDX-License-Identifier: Apache-2.0

config GD7965
	bool "GD7965 compatible display controller driver"
	depends on SPI
	help
	  Enable driver for GD7965 compatible controller.
```

## drivers/display/Kconfig.grove
```kconfig
# SPDX-License-Identifier: Apache-2.0

config GROVE_LCD_RGB
	bool "Enable the Seeed Grove LCD RGB Backlight"
	help
	  Setting this value will enable driver support for the Groove-LCD RGB
	  Backlight.

config GROVE_LCD_RGB_I2C_MASTER_DEV_NAME
	string "I2C Master where Grove LCD is connected"
	depends on GROVE_LCD_RGB
	default "I2C_0"
	help
	  Specify the device name of the I2C master device to which the
	  Grove LCD is connected.
```

## drivers/display/Kconfig.hub12
```kconfig
# Copyright (c) 2025 Siratul Islam <sirat4757@gmail.com>
# SPDX-License-Identifier: Apache-2.0

config HUB12
	bool "HUB12 LED Panel Display Controller"
	default y
	depends on DT_HAS_ZEPHYR_HUB12_ENABLED
	select SPI
	select GPIO
	help
	  HUB12 LED panel controller for 32x16 monochrome displays
```

## drivers/display/Kconfig.hx8347
```kconfig
# HX8347 display driver configuration options

# Copyright (c) 2022 Alexander Wachter
# SPDX-License-Identifier: Apache-2.0


config HX8347
	bool "HX8347D display driver"
	select SPI
	help
	  Enable driver for HX8347 display driver.
```

## drivers/display/Kconfig.hx8353e
```kconfig
# Copyright (c) 2026 Andrew Yong <me@ndoo.sg>
# SPDX-License-Identifier: Apache-2.0

config HX8353E
	bool "Himax HX8353E display driver"
	default y
	depends on DT_HAS_HIMAX_HX8353E_ENABLED
	select MIPI_DBI
	help
	  Enable driver for the Himax HX8353E 132RGB×162 dot TFT LCD controller.
	  The controller is driven via a MIPI DBI Type B (Intel 8080) parallel
	  bus. Supports optional GPIO backlight on/off and optional PWM brightness
	  control via the backlight-gpios and pwms devicetree properties.
```
