## drivers/mfd/Kconfig.max20335
```kconfig
# Copyright (c) 2023 Grinn
# SPDX-License-Identifier: Apache-2.0

config MFD_MAX20335
	bool "MAX20335 PMIC multi-function device driver"
	default y
	depends on DT_HAS_MAXIM_MAX20335_ENABLED
	select I2C
	help
	  Enable the Maxim MAX20335 PMIC multi-function device driver
```

## drivers/mfd/Kconfig.max22017
```kconfig
# Copyright (c) 2024 Analog Devices Inc.
# Copyright (c) 2024 BayLibre SAS
# SPDX-License-Identifier: Apache-2.0

config MFD_MAX22017
	bool "Analog Devices MAX22017 DAC/GPIO chip"
	default y
	depends on SPI
	select CRC
	depends on DT_HAS_ADI_MAX22017_ENABLED
	help
	  Enable the driver for the Analog Devices MAX22017 DAC/GPIO chip
```

## drivers/mfd/Kconfig.max2221x
```kconfig
# Copyright (c) 2025 Analog Devices Inc.
# SPDX-License-Identifier: Apache-2.0

config MFD_MAX2221X
	bool "Analog Devices MAX2221X multi-function device driver"
	default y
	depends on SPI
	depends on DT_HAS_ADI_MAX2221X_ENABLED
	help
	  Enable the driver for the Analog Devices MAX2221X multi-function device driver
```

## drivers/mfd/Kconfig.max31790
```kconfig
# Copyright (c) 2024 SILA Embedded Solutions GmbH
# SPDX -License-Identifier: Apache-2.0

config MFD_MAX31790
	bool "Maxim Integrated MAX31790 I2C configurable PWM controller"
	default y
	depends on DT_HAS_MAXIM_MAX31790_ENABLED
	select I2C
	help
	  Enable driver for Maxim Integrated MAX31790.
```

## drivers/mfd/Kconfig.mchp_sam
```kconfig
# Copyright (C) 2025 Microchip Technology Inc. and its subsidiaries
#
# SPDX-License-Identifier: Apache-2.0

config MFD_MCHP_SAM_FLEXCOM
	bool "Driver for the Microchip SAM FLEXCOM Interface"
	default y
	depends on DT_HAS_MICROCHIP_SAM_FLEXCOM_ENABLED
	help
	  Enabled the SAM FLEXCOM driver.
```

## drivers/mfd/Kconfig.nct38xx
```kconfig
# Copyright (c) 2023 Google, LLC
# SPDX -License-Identifier: Apache-2.0

config MFD_NCT38XX
	bool "Nuvton NCT38xx multi-function device driver"
	default y
	depends on DT_HAS_NUVOTON_NCT38XX_ENABLED
	select I2C
	help
	  Enable the Nuvoton NCT38xx TCPC multi-function device driver.
```

## drivers/mfd/Kconfig.npm10xx
```kconfig
# Copyright (c) 2026 Nordic Semiconductor
# SPDX-License-Identifier: Apache-2.0

config MFD_NPM10XX
	bool "nPM10xx PMIC multi-function device driver"
	default y
	depends on DT_HAS_NORDIC_NPM10XX_ENABLED
	select I2C
	help
	  Enable the Nordic nPM10xx PMIC multi-function device driver

config MFD_NPM10XX_INIT_PRIORITY
	int "nPM10xx MFD initialization priority"
	default MFD_INIT_PRIORITY
	depends on MFD_NPM10XX
	help
	  Multi-function device initialization priority for nPM10xx
```

## drivers/mfd/Kconfig.npm1300
```kconfig
# Copyright (c) 2023 Nordic Semiconductor ASA
# SPDX-License-Identifier: Apache-2.0

config MFD_NPM1300
	bool "nPM1300 PMIC multi-function device driver"
	default y
	depends on DT_HAS_NORDIC_NPM1300_ENABLED
	select I2C
	help
	  Enable the Nordic nPM1300 PMIC multi-function device driver

config MFD_NPM1300_INIT_PRIORITY
	int "nPM1300 MFD initialization priority"
	default MFD_INIT_PRIORITY
	depends on MFD_NPM1300
	help
	  Multi-function device initialization priority for nPM1300.
```

## drivers/mfd/Kconfig.npm13xx
```kconfig
# Copyright (c) 2023 Nordic Semiconductor ASA
# SPDX-License-Identifier: Apache-2.0

config MFD_NPM13XX
	bool "nPM13xx PMIC multi-function device driver"
	default y
	depends on DT_HAS_NORDIC_NPM1300_ENABLED || DT_HAS_NORDIC_NPM1304_ENABLED
	select I2C
	help
	  Enable the Nordic nPM13xx PMIC multi-function device driver

config MFD_NPM13XX_INIT_PRIORITY
	int "nPM13xx MFD initialization priority"
	default MFD_INIT_PRIORITY
	depends on MFD_NPM13XX
	help
	  Multi-function device initialization priority for nPM13xx.
```

## drivers/mfd/Kconfig.npm2100
```kconfig
# Copyright (c) 2024 Nordic Semiconductor ASA
# SPDX-License-Identifier: Apache-2.0

config MFD_NPM2100
	bool "nPM2100 PMIC multi-function device driver"
	default y
	depends on DT_HAS_NORDIC_NPM2100_ENABLED
	select I2C
	help
	  Enable the Nordic nPM2100 PMIC multi-function device driver
```

## drivers/mfd/Kconfig.npm6001
```kconfig
# Copyright (c) 2023 Nordic Semiconductor ASA
# SPDX-License-Identifier: Apache-2.0

config MFD_NPM6001
	bool "nPM6001 PMIC multi-function device driver"
	default y
	depends on DT_HAS_NORDIC_NPM6001_ENABLED
	select I2C
	help
	  Enable the Nordic nPM6001 PMIC multi-function device driver

config MFD_NPM6001_INIT_PRIORITY
	int "nPM6001 MFD initialization priority"
	default MFD_INIT_PRIORITY
	depends on MFD_NPM6001
	help
	  Multi-function device initialization priority for nPM6001.
```

## drivers/mfd/Kconfig.pca9422
```kconfig
# Copyright 2025 NXP
# SPDX-License-Identifier: Apache-2.0

config MFD_PCA9422
	bool "NXP PCA9422 PMIC multi-function device driver"
	default y
	depends on DT_HAS_NXP_PCA9422_ENABLED
	select I2C
	help
	  Enable the NXP PCA9422 PMIC multi-function device driver.
	  This PMIC provides a charger/regulator function via I2C bus.
```

## drivers/mfd/Kconfig.pf1550
```kconfig
# Copyright (c) 2024 Arduino SA
# SPDX-License-Identifier: Apache-2.0

config MFD_PF1550
	bool "PF1550 PMIC multi-function device driver"
	default y
	depends on DT_HAS_NXP_PF1550_ENABLED
	select I2C
	help
	  Enable the NXP PF1550 PMIC multi-function device driver
```

## drivers/mfd/Kconfig.rp1
```kconfig
# Copyright (c) 2024 Junho Lee <junho@tsnlab.com>
# SPDX -License-Identifier: Apache-2.0

config MFD_RP1
	bool "RP1 peripheral controller driver"
	default y
	depends on DT_HAS_RASPBERRYPI_RP1_ENABLED
	help
	  Enable driver for RP1 peripheral controller on Raspberry Pi 5.
```

## drivers/mfd/Kconfig.rv3028
```kconfig
# Copyright (c) 2026 Janez Ugovsek <janez@ugovsek.info>
# SPDX-License-Identifier: Apache-2.0

config MFD_RV3028
	bool "Micro Crystal RV3028 RTC multifunction device driver"
	default y
	depends on DT_HAS_MICROCRYSTAL_RV3028_ENABLED
	select I2C
	help
	  Enable the parent MFD driver for the Micro Crystal RV3028 RTC.
	  This driver owns the I2C register access and shared resources used by
	  the RV3028 functional child drivers.

config MFD_RV3028_INIT_PRIORITY
	int "RV3028 MFD initialization priority"
	depends on MFD_RV3028
	default 50
	help
	  Initialization priority for the Micro Crystal RV3028 MFD driver.
	  It must be earlier than the initialization priority of RV3028
	  child drivers.
```

## drivers/mfd/Kconfig.sc18is606_mfd
```kconfig
# Copyright (c) 2026, tinyvision.ai
# SPDX-License-Identifier: Apache-2.0

config MFD_SC18IS606
	bool "NXP SC18IS606 SPI/GPIO bridge"
	default y
	depends on DT_HAS_NXP_SC18IS606_ENABLED
	select I2C
	help
	  Enable the driver for the NXP SC18IS606 SPI/GPIO bridge
```

## drivers/mfd/Kconfig.tle9104
```kconfig
# Copyright (c) 2024 SILA Embedded Solutions GmbH
# SPDX-License-Identifier: Apache-2.0

config MFD_TLE9104
	bool "Infineon TLE9104 SPI powertrain switch"
	default y
	depends on DT_HAS_INFINEON_TLE9104_ENABLED
	# using select SPI at this point introduces a cyclic dependency
	depends on SPI
	help
	  Enable driver for TLE9104 SPI-based powertrain switch.
```

## drivers/mfd/ateccx08/Kconfig
```kconfig
# Microchip ATECCx08 MFD

# Copyright (c) 2024 Vogl Electronic GmbH
# SPDX-License-Identifier: Apache-2.0

config MFD_ATECCX08
	bool
	help
	  Enable support for Microchip ATECCx08 I2C CRYPTOs.

config MFD_ATECC608
	bool "Microchip ATECC608 I2C CRYPTO support"
	default y
	depends on DT_HAS_MICROCHIP_ATECC608_ENABLED
	select I2C
	select MFD_ATECCX08
	help
	  Enable support for Microchip ATECC608 I2C CRYPTOs.

config MFD_ATECC508
	bool "Microchip ATECC508 I2C CRYPTO support"
	default y
	depends on DT_HAS_MICROCHIP_ATECC508_ENABLED
	select I2C
	select MFD_ATECCX08
	help
	  Enable support for Microchip ATECC508 I2C CRYPTOs.

if MFD_ATECCX08

config MFD_ATECCX08_INIT_PRIORITY
	int "Microchip ATECCx08 Initialization priority"
	default 55
	help
	  This option enables the Microchip ATECCx08 eeprom driver OTP.

config MFD_ATECCX08_SUBDEVICE_INIT_PRIORITY
	int "Microchip ATECCx08 subdevice Initialization priority"
	default 56
	help
	  This option enables the Microchip ATECCx08 eeprom driver OTP.

endif
```

## drivers/mipi_dbi/Kconfig
```kconfig
# MIPI DBI controller options

# Copyright 2023,2025 NXP
# SPDX-License-Identifier: Apache-2.0

menuconfig MIPI_DBI
	bool "MIPI-DBI Host Controller drivers [EXPERIMENTAL]"
	select EXPERIMENTAL
	help
	  Add support for MIPI-DBI compliant host controllers

if MIPI_DBI

module = MIPI_DBI
module-str = mipi_dbi
source "subsys/logging/Kconfig.template.log_config"

config MIPI_DBI_INIT_PRIORITY
	int "Initialization priority"
	default 80
	help
	  MIPI-DBI Host Controllers initialization priority.

# zephyr-keep-sorted-start
source "drivers/mipi_dbi/Kconfig.bflb"
source "drivers/mipi_dbi/Kconfig.bitbang"
source "drivers/mipi_dbi/Kconfig.esp32"
source "drivers/mipi_dbi/Kconfig.nxp_dcnano_lcdif"
source "drivers/mipi_dbi/Kconfig.nxp_flexio_lcdif"
source "drivers/mipi_dbi/Kconfig.nxp_lcdic"
source "drivers/mipi_dbi/Kconfig.rpi_pico"
source "drivers/mipi_dbi/Kconfig.sf32lb_lcdc"
source "drivers/mipi_dbi/Kconfig.smartbond"
source "drivers/mipi_dbi/Kconfig.spi"
source "drivers/mipi_dbi/Kconfig.stm32_fmc"
# zephyr-keep-sorted-stop

endif
```

## drivers/mipi_dbi/Kconfig.ambiq
```kconfig
# Copyright (c) 2025 Ambiq Micro Inc.
#
# SPDX-License-Identifier: Apache-2.0

config MIPI_DBI_AMBIQ
	bool "Ambiq MIPI DBI Type-B (Intel 8080) driver"
	default y
	depends on DT_HAS_AMBIQ_MIPI_DBI_ENABLED
	depends on MIPI_DBI
	depends on GPIO
	select AMBIQ_COMPONENT_USE_NEMADC
	help
	  Enable MIPI DBI Type-B (Intel 8080) parallel interface driver
```

## drivers/mipi_dbi/Kconfig.bflb
```kconfig
# Copyright 2025 MASSDRIVER EI (massdriver.space)
# SPDX-License-Identifier: Apache-2.0

config MIPI_DBI_BFLB
	bool "Bouffalolab MIPI DBI driver"
	default y
	depends on DT_HAS_BFLB_DBI_ENABLED
	select DMA
	help
	  Enable support for the Bouffalolab DBI controller

if MIPI_DBI_BFLB

config MIPI_DBI_BFLB_ASSUME_HOLD_ON_CS
	bool "Default to HOLD_ON_CS mode"
	default y
	help
	  Pretend SPI_HOLD_ON_CS was passed by the display driver, as this is the expectation.

endif # MIPI_DBI_BFLB
```

## drivers/mipi_dbi/Kconfig.esp32
```kconfig
# Copyright (c) 2025 Chen Xingyu <hi@xingrz.me>
# SPDX-License-Identifier: Apache-2.0

config MIPI_DBI_ESP32
	bool "MIPI DBI driver for ESP32 LCD-CAM display interface"
	default y
	depends on DT_HAS_ESPRESSIF_ESP32_LCD_CAM_MIPI_DBI_ENABLED
	select DMA
	help
	  Enable support for the ESP32 LCD-CAM display interface.
```

## drivers/mipi_dbi/Kconfig.intel8080
```kconfig
# Copyright 2024 Kim Bøndergaard <kim@fam-boendergaard.dk>
# SPDX-License-Identifier: Apache-2.0

config MIPI_DBI_INTEL8080
	bool "MIPI DBI Intel8080 parallel driver"
	default y
	depends on DT_HAS_ZEPHYR_MIPI_DBI_INTEL8080_ENABLED
	help
	  Enable support for MIPI DBI Intel8080 driver. This driver implements
	  a MIPI-DBI mode A compatible controller using a  GPIO outputs

if MIPI_DBI_INTEL8080

config MIPI_DBI_INTEL8080_BUS_WIDTH
	int "Width of databus"
	default 8
	help
	  Width of parallelbus and thus number of GPIOs to configuire

endif # MIPI_DBI_INTEL8080
```

## drivers/mipi_dbi/Kconfig.nxp_dcnano_lcdif
```kconfig
# Copyright 2025 NXP
# SPDX-License-Identifier: Apache-2.0

config MIPI_DBI_NXP_DCNANO_LCDIF
	bool "MIPI DBI driver for NXP DCnano LCDIF"
	default y
	depends on DT_HAS_NXP_MIPI_DBI_DCNANO_LCDIF_ENABLED
	select PINCTRL
	help
	  Enable support for MIPI DBI driver for NXP FlexIO based LCDIF controller.
```

## drivers/mipi_dbi/Kconfig.nxp_lcdic
```kconfig
# Copyright 2023 NXP
# SPDX-License-Identifier: Apache-2.0

config MIPI_DBI_NXP_LCDIC
	bool "NXP MIPI DBI LCDIC driver"
	default y
	depends on DT_HAS_NXP_LCDIC_ENABLED
	depends on CLOCK_CONTROL
	select PINCTRL
	help
	  Enable support for NXP SPI LCDIC display controller driver

if MIPI_DBI_NXP_LCDIC

config MIPI_DBI_NXP_LCDIC_DMA
	bool "Use DMA for transfers with LCDIC driver"
	select DMA
	help
	  Use DMA for transfers when sending data with the LCDIC driver.
	  Commands will still be sent in polling mode.

endif # MIPI_DBI_NXP_LCDIC
```
