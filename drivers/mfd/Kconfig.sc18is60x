## drivers/misc/mchp_evsys/Kconfig
```kconfig
# Copyright (c) 2026 Muhammed Asif P
# SPDX-License-Identifier: Apache-2.0

config MCHP_EVSYS
	bool
	default y
	depends on CLOCK_CONTROL
	help
	  Enable the Event System driver g1.

	  This driver is not user-selectable and should be enabled by drivers
	  which uses event system

if MCHP_EVSYS

config MCHP_EVSYS_INIT_PRIORITY
	int "mchp evsys driver init priority"
	default KERNEL_INIT_PRIORITY_DEVICE
	help
	  Mirochip EVSYS device driver initialization priority.

config MCHP_EVSYS_G1
	bool
	default y
	depends on DT_HAS_MICROCHIP_EVSYS_G1_ENABLED
	help
	  Enable the Event System driver g1.

	  This driver is not user-selectable and should be enabled by drivers
	  which uses event system

module = MCHP_EVSYS
module-str = mchp_evsys
source "subsys/logging/Kconfig.template.log_config"

endif # MCHP_EVSYS
```

## drivers/misc/pio_rpi_pico/Kconfig
```kconfig
# Copyright (c) 2023 TOKITA Hiroshi <tokita.hiroshi@fujitsu.com>
# SPDX-License-Identifier: Apache-2.0

config PIO_RPI_PICO
	bool "Raspberry Pi Pico PIO"
	default y
	depends on DT_HAS_RASPBERRYPI_PICO_PIO_ENABLED
	depends on RESET
	select PICOSDK_USE_PIO
	select PINCTRL

if PIO_RPI_PICO

config PIO_RPI_PICO_IRQ
	bool "Raspberry Pi Pico PIO interrupt support"
	help
	  Connect the interrupt lines of each PIO block and dispatch them to
	  the child devices that registered a handler.

	  A PIO block has two interrupt lines shared by all four of its state
	  machines, so a child device cannot connect them on its own without
	  locking out every other child of the same block. Child drivers that
	  need PIO interrupts should select this symbol and register through
	  pio_rpi_pico_register_irq().

config PIO_RPI_PICO_MAX_IRQ_HANDLERS
	int "Maximum number of handlers per PIO interrupt line"
	depends on PIO_RPI_PICO_IRQ
	default 4
	range 1 8
	help
	  Number of handler slots reserved per interrupt line, per PIO block.
	  A child device registers one handler per line it uses, so this is the
	  number of child devices that can share a line of the same block.

endif # PIO_RPI_PICO
```

## drivers/misc/ti_cc35xx_hsm/Kconfig
```kconfig
# TI CC35xxE HSM driver configuration
# Copyright (c) 2025 Conclusive Engineering Sp. z o.o.
# SPDX-License-Identifier: Apache-2.0

config TI_CC35XX_HSM
	bool "TI SimpleLink CC35xx Hardware Security Module (HSM)"
	default n
	depends on DT_HAS_TI_CC35XX_HSM_ENABLED
	select RING_BUFFER
	help
	  This option enables the driver for the Hardware Security Module (HSM)
	  for TI SimpleLink CC35xx family SoCs.

if TI_CC35XX_HSM

config TI_CC35XX_HSM_INIT_PRIORITY
	int "TI CC35XX HSM driver init priority"
	depends on TI_CC35XX_HSM
	default KERNEL_INIT_PRIORITY_DEVICE
	help
	  TI CC35XX HSM driver device initialization priority.


config TI_CC35XX_HSM_ENTROPY_POOL_SIZE
	int "Number of bytes in the entropy pool"
	default 512
	range 256 65536
	help
	  The size in bytes of the buffer used to store entropy generated by the
	  hardware. Should be a power of two for high performance.

config TI_CC35XX_HSM_ITS
	bool "TI CC35XX HSM internal trusted storage"
	select CC35XXE_GENERATE_FLASH_MAP_CONFIG
	help
	  Build the TI internal trusted storage adapter required by TI SDK
	  mbedTLS persistent PSA key storage.

config TI_CC35XX_HSM_PSA_ADAPTER
	bool "TI CC35XX HSM PSA adapter"
	default y if CRYPTO_TI_CC35XX
	select TI_CC35XX_HSM_ITS
	help
	  Build the TI HSM PSA adapter and its internal trusted storage backend.

endif # TI_CC35XX_HSM
```

## drivers/misc/ti_unicomm/Kconfig
```kconfig
# Copyright (c) 2026 Texas Instruments Incorporated
# SPDX-License-Identifier: Apache-2.0

config TI_UNICOMM
	bool "Texas Instruments Unified Communication Peripheral"
	default y
	depends on DT_HAS_TI_UNICOMM_ENABLED
```

## drivers/modem/vendor_modem_cellular/Kconfig
```kconfig
# Configuration specific to individual backends
# Copyright (c) 2026 Embeint Inc

configdefault MODEM_CHAT_COMMANDS_CONDITIONAL
	default y if DT_HAS_NORDIC_NRF93M1_ENABLED

config MODEM_CELLULAR_U_BLOX_SARA_R4_GNSS
	bool "u-blox SARA-R4 GNSS receiver support"
	depends on GNSS && DT_HAS_U_BLOX_SARA_R4_ENABLED
```

## drivers/modem/vendor_standalone/hl78xx/hl78xx_at_monitor/Kconfig.hl78xx_at_monitor
```kconfig
# SPDX-FileCopyrightText: Copyright The Zephyr Project Contributors
# SPDX-FileCopyrightText: Copyright (c) 2026 Netfeasa Ltd.
# SPDX-License-Identifier: Apache-2.0

menuconfig HL78XX_AT_MONITOR
	bool "HL78XX parsed AT monitor"

if HL78XX_AT_MONITOR

config HL78XX_AT_MONITOR_HEAP_SIZE
	int "Heap size for deferred AT notifications"
	range 64 4096
	default 1024
	help
	  Heap size used to copy and queue parsed unsolicited AT notifications
	  for deferred monitor dispatch in the system workqueue. A notification
	  that does not fit is dropped, logged at error level and counted; the
	  count is readable through hl78xx_at_monitor_dropped_count(). A copied
	  notification is about 100 bytes and the modem emits several back to
	  back around registration, so keep room for a burst.
	  Direct monitor dispatch does not use this heap.

config HL78XX_AT_MONITOR_MAX_INSTANCE_MONITORS
	int "Maximum number of runtime HL78xx AT monitors"
	default 8
	range 1 64
	help
	  Maximum number of runtime AT monitors that can be registered.
	  This bound allows AT monitor dispatch to snapshot runtime monitors
	  without allocating memory.


module=HL78XX_AT_MONITOR
module-dep=LOG
module-str=Parsed AT monitor library
source "subsys/logging/Kconfig.template.log_config"

endif # HL78XX_AT_MONITOR
```

## drivers/mpc/Kconfig
```kconfig
# Memory Protection Controller (MPC) drivers
#
# SPDX-FileCopyrightText: Copyright (c) 2026 Infineon Technologies AG,
# SPDX-FileCopyrightText: or an affiliate of Infineon Technologies AG. All rights reserved.
#
# SPDX-License-Identifier: Apache-2.0

menu "Memory Protection Controller (MPC) drivers"

config MPC
	bool
	help
	  Set by any Memory Protection Controller (MPC) driver to indicate
	  that the mpc_configure_all() API (<zephyr/drivers/mpc/mpc.h>) is
	  available.  Individual MPC drivers select this symbol; application
	  and Secure-image code can test CONFIG_MPC instead of naming a
	  specific driver.

# zephyr-keep-sorted-start
source "drivers/mpc/arm_tz_mpc/Kconfig"
source "drivers/mpc/infineon_mpc/Kconfig"
# zephyr-keep-sorted-stop

endmenu
```
