## drivers/mfd/Kconfig.sc18is60x
```kconfig
# Copyright (c) 2026 tinyvision.ai
# SPDX-License-Identifier: Apache-2.0

config MFD_SC18IS60X
	bool "NXP SC18IS60x I2C-to-SPI bridge"
	default y
	depends on DT_HAS_NXP_SC18IS606_ENABLED || DT_HAS_NXP_SC18IS602_ENABLED
	select I2C
	help
	  Enable the MFD driver for NXP SC18IS60x I2C-host bridges
	  (SC18IS602/SC18IS602B and SC18IS606).
```

## drivers/mfd/Kconfig.silabs_ncp
```kconfig
# Copyright (c) 2026 Silicon Laboratories Inc.
# SPDX-License-Identifier: Apache-2.0

menuconfig MFD_SILABS_NCP
	bool "Silicon Labs network co-processor (CPC primary)"
	default y
	depends on DT_HAS_SILABS_NCP_ENABLED
	select SILABS_CPC
	select EXPERIMENTAL
	help
	  Enable the driver for Silicon Labs network co-processors. The host
	  runs the CPC (Co-Processor Communication) protocol in the primary
	  role. Child nodes expose the radio protocols offered by the
	  co-processor.

if MFD_SILABS_NCP

config MFD_SILABS_NCP_BUS_SPI
	bool "Silicon Labs NCP over SPI"
	default y
	depends on $(dt_compat_on_bus,$(DT_COMPAT_SILABS_NCP),spi)
	depends on SPI
	depends on GPIO
	select SPI_ASYNC

config MFD_SILABS_NCP_BUS_SDIO
	bool "Silicon Labs NCP over SDIO"
	default y
	depends on $(dt_compat_on_bus,$(DT_COMPAT_SILABS_NCP),sd)
	depends on SDHC
	depends on SDIO_STACK

config MFD_SILABS_NCP_SDIO_POLL_INTERVAL_MS
	int "Polling interval when the host controller has no card interrupt"
	depends on MFD_SILABS_NCP_BUS_SDIO
	default 10

config MFD_SILABS_NCP_BUS_UART
	bool "Silicon Labs NCP over UART"
	default y
	depends on $(dt_compat_on_bus,$(DT_COMPAT_SILABS_NCP),uart)
	depends on SERIAL
	depends on GPIO
	depends on UART_ASYNC_API
	select CRC

config MFD_SILABS_NCP_UART_RX_BUF_SIZE
	int "Size of each of the two UART reception buffers"
	depends on MFD_SILABS_NCP_BUS_UART
	default 256
	help
	  The UART DMA fills these two buffers alternately, and the UART driver
	  hands over what it received at the latest when a buffer is full.
	  This is the largest chunk the UART callback copies at once.

config MFD_SILABS_NCP_UART_RX_RING_BUF_SIZE
	int "Size of the UART reception ring buffer"
	depends on MFD_SILABS_NCP_BUS_UART
	default 2048
	help
	  The UART callback copies the received bytes into this ring buffer,
	  the transport parses the frames from it on its work queue. It must
	  hold what the co-processor can send before the transport runs and
	  acknowledges, which the CPC flow control bounds: for every endpoint,
	  its receive window (the number of receive buffers of the child
	  driver) times its largest frame, plus a few 11-byte control frames.
	  With the HCI driver alone, 4 buffers of about 270 bytes need less
	  than 1.5 KiB. It must also hold at least one UART reception buffer.
	  An overrun is logged and the frame is recovered by retransmission.

config MFD_SILABS_NCP_INIT_PRIORITY
	int "Initialization priority"
	default 86
	help
	  Priority of the silabs,ncp devices. Must be greater than the
	  priority of the bus they sit on (SPI_INIT_PRIORITY,
	  SDHC_INIT_PRIORITY, SERIAL_INIT_PRIORITY) and lower than the priority of the child
	  drivers that open CPC endpoints.

config MFD_SILABS_NCP_WQ_STACK_SIZE
	int "Stack size of the work queue of a silabs,ncp device"
	default 2048
	help
	  Each silabs,ncp device runs its transport on its own work queue. The
	  child drivers also use it for the work they defer from the thread of
	  the CPC core, like the HCI driver handing the packets to the host, so
	  the stack must hold that path too.

config MFD_SILABS_NCP_WQ_PRIORITY
	int "Cooperative priority of the work queue of a silabs,ncp device"
	default 6
	help
	  The work queue must run while the users of the co-processor wait for
	  a reply, possibly from the system work queue. It must not depend on
	  the system work queue, like the RX thread of the other HCI drivers.
	  The value is passed to K_PRIO_COOP().

config MFD_SILABS_NCP_RX_FRAME_POOL_COUNT
	int "Number of RX frames of a CPC bus"
	default 20
	help
	  A frame is the CPC header and its bookkeeping, 52 bytes, the
	  payload lives in the buffers of the child drivers. The transport
	  takes the whole pool to receive ahead of the core, so this is the
	  number of frames the co-processor can have in flight. The pool is
	  allocated from the libc heap.

config MFD_SILABS_NCP_TX_FRAME_POOL_COUNT
	int "Number of TX frames of a CPC bus"
	default 20
	help
	  Frames the core can have in flight towards the co-processor,
	  including its own acknowledgments. Same size and allocation as the
	  RX frames.

endif # MFD_SILABS_NCP
```

## drivers/mfd/Kconfig.tla2528
```kconfig
# Copyright (c) 2026 Leica Geosystems AG
# SPDX-License-Identifier: Apache-2.0

config MFD_TLA2528
	bool "Texas Instruments TLA2528 I2C ADC with GPIOs"
	default y
	depends on DT_HAS_TI_TLA2528_ENABLED
	select I2C
	help
	  Enable the mfd driver implementation for the TLA2528
```

## drivers/mfd/Kconfig.tlc6c59xx
```kconfig
# Copyright (c) 2026 iomico
# SPDX-License-Identifier: Apache-2.0

config MFD_TLC6C59XX
	bool "TLC6C59XX MFD driver"
	default y
	depends on DT_HAS_TI_TLC6C59XX_ENABLED
	depends on SPI
	help
	  Enable the SPI parent driver for chains of Texas Instruments
	  TLC6C59XX 8- or 12-channel shift-register LED drivers.
```

## drivers/mfd/Kconfig.tle927x
```kconfig
# SPDX-FileCopyrightText: Copyright (c) 2026 Deere & Company
# SPDX-FileCopyrightText: Copyright (c) 2026 Linumiz
# SPDX-License-Identifier: Apache-2.0

config MFD_TLE927X
	bool "Infineon TLE927x System Basis Chip"
	default y
	depends on DT_HAS_INFINEON_TLE927X_ENABLED
	depends on SPI
	help
	  Enable driver for the Infineon TLE927x high-end System Basis Chip
	  family. The driver takes the SBC from Init to Normal mode. The SBC
	  watchdog runs from then on and must be serviced through the TLE927x
	  watchdog child driver.

if MFD_TLE927X

config MFD_TLE927X_INIT_PRIORITY
	int "TLE927x MFD driver init priority"
	default 75
	help
	  Init priority for the TLE927x MFD driver. It must be greater than
	  SPI_INIT_PRIORITY and lower than the init priority of the TLE927x
	  child drivers.

endif # MFD_TLE927X
```

## drivers/mfd/Kconfig.waveshare_ch32v003
```kconfig
# Copyright (c) 2026 Kim Bøndergaard
# SPDX-License-Identifier: Apache-2.0

menuconfig MFD_WAVESHARE_CH32V003
	bool "Waveshare CH32V003 I2C IO expander (MFD)"
	default y
	depends on DT_HAS_WAVESHARE_CH32V003_ENABLED
	select I2C
	help
	  Enable the MFD driver for the Waveshare CH32V003 I2C IO expander.

if MFD_WAVESHARE_CH32V003

config MFD_WAVESHARE_CH32V003_INIT_PRIORITY
	int "MFD init priority"
	default 65
	help
	  Device driver initialization priority for CH32V003 MFD.

endif # MFD_WAVESHARE_CH32V003
```

## drivers/mipi_dbi/Kconfig.bitbang
```kconfig
# Copyright 2024 Stefan Gloor
# SPDX-License-Identifier: Apache-2.0

config MIPI_DBI_BITBANG
	bool "MIPI DBI bit banging driver"
	default y
	depends on DT_HAS_ZEPHYR_MIPI_DBI_BITBANG_ENABLED
	select GPIO
	help
	  Enable support for MIPI DBI bit banging driver. This driver implements
	  a MIPI-DBI mode A and B compatible controller using GPIO.

config MIPI_DBI_BITBANG_MAX_LUT_PORTS
	int "Maximum GPIO ports covered by the 8-bit data bus lookup table"
	default 4
	range 1 4
	depends on MIPI_DBI_BITBANG
	help
	  An 8-bit data bus is written one byte at a time through a 256-entry
	  lookup table per GPIO port the bus spans. Each table takes 1 KiB of
	  flash per instance, and each slot adds a device pointer, a mask and a
	  table pointer to every instance's configuration. A bus spanning more
	  ports than this value is written one pin at a time. Set to 1 if all
	  data pins are on one port to keep only a single slot.
```

## drivers/mipi_dbi/Kconfig.nxp_dcif
```kconfig
# Copyright 2026 NXP
# SPDX-License-Identifier: Apache-2.0

config MIPI_DBI_NXP_DCIF
	bool "MIPI DBI driver for NXP DCIF"
	default y
	depends on DT_HAS_NXP_MIPI_DBI_DCIF_ENABLED
	select PINCTRL
	help
	  Enable support for MIPI DBI driver for NXP DCIF display controller.

if MIPI_DBI_NXP_DCIF

config MIPI_DBI_NXP_DCIF_MAINTAIN_CACHE
	bool "Maintain cache coherency"
	default y
	help
	  Maintain cache coherency for the DBI framebuffer. This is generally
	  required, unless the framebuffer is placed in uncached memory.

endif # MIPI_DBI_NXP_DCIF
```

## drivers/mipi_dbi/Kconfig.nxp_flexio_lcdif
```kconfig
# Copyright 2024 NXP
# SPDX-License-Identifier: Apache-2.0

config MIPI_DBI_NXP_FLEXIO_LCDIF
	bool "MIPI DBI driver for NXP Flexio LCDIF"
	default y
	depends on DT_HAS_NXP_MIPI_DBI_FLEXIO_LCDIF_ENABLED
	depends on CLOCK_CONTROL
	select MCUX_FLEXIO
	select DMA
	select PINCTRL
	help
	  Enable support for MIPI DBI driver for NXP FlexIO based LCDIF controller.

if MIPI_DBI_NXP_FLEXIO_LCDIF

config MIPI_DBI_NXP_FLEXIO_LCDIF_SMARTDMA
	bool "Use SMARTDMA controller with FlexIO LCDIF"
	default y if $(dt_compat_any_has_prop,$(DT_COMPAT_NXP_MIPI_DBI_FLEXIO_LCDIF),dma-names,smartdma)
	depends on DMA_MCUX_SMARTDMA
	help
	  Use SMARTDMA to accelerate the FlexIO LCDIF data transfer, instead
	  of a generic DMA controller (e.g. eDMA). This is auto-enabled when
	  the FlexIO LCDIF instance's own "dmas"/"dma-names" devicetree
	  properties route it to the SMARTDMA controller, mirroring how
	  DMA_MCUX_EDMA auto-enables based on the eDMA controller's own
	  devicetree node. It is not driven off DMA_MCUX_SMARTDMA directly,
	  since some boards enable that option for an unrelated peripheral
	  (e.g. MIPI DSI) while still wiring the FlexIO LCDIF instance to a
	  generic DMA controller.

	  Some SoCs also need an INPUTMUX route (see the "mux-states"
	  devicetree property) to connect the FlexIO IRQ to a SmartDMA
	  trigger input. Boards that use this route must enable CONFIG_MUX
	  and CONFIG_MUX_NXP_INPUTMUX themselves (a "select" here would
	  create a Kconfig dependency loop through DMA_MCUX_SMARTDMA -> DMA).

endif # MIPI_DBI_NXP_FLEXIO_LCDIF
```

## drivers/mipi_dbi/Kconfig.spi
```kconfig
# Copyright 2023 NXP
# SPDX-License-Identifier: Apache-2.0

config MIPI_DBI_SPI
	bool "MIPI DBI SPI driver"
	default y
	depends on DT_HAS_ZEPHYR_MIPI_DBI_SPI_ENABLED
	select SPI
	help
	  Enable support for MIPI DBI SPI driver. This driver implements
	  a MIPI-DBI mode C compatible controller using a SPI device, as well
	  as GPIO outputs for the reset and D/C signals

if MIPI_DBI_SPI

config MIPI_DBI_SPI_SHARED_DC
	bool
	default $(dt_compat_any_has_prop,$(DT_COMPAT_ZEPHYR_MIPI_DBI_SPI),dc-gpios-shared,True)
	depends on PINCTRL
	select PINCTRL_NON_STATIC
	help
	  Support for a data/command pin that is shared with the SPI bus.
	  The pad is handed back to the bus pin control state after every
	  transfer instead of being driven for the lifetime of the device.

config MIPI_DBI_SPI_3WIRE
	bool "Emulated 3 wire SPI support"
	help
	  Support 3 wire MIPI DBI (Mode C option 2) in MIPI DBI SPI
	  driver. This requires manually packing each byte with a data/command
	  bit, and may slow down display data transmission.

endif # MIPI_DBI_SPI
```

## drivers/mipi_dsi/Kconfig.cdns_ti
```kconfig
# TI / Cadence DSI TX driver
#
# Copyright (c) 2026 Texas Instruments Incorporated
# SPDX-License-Identifier: Apache-2.0

config MIPI_DSI_CDNS_TI
	bool "TI / Cadence DSI host controller (AM62L, AM62P)"
	default y
	depends on DT_HAS_TI_J721E_DSI_ENABLED
	help
	  MIPI DSI host driver for TI K3 SoCs using the Cadence DSI TX controller.
	  The Cadence DPHY TX is initialised inline (no separate PHY driver).
	  Supports video mode output and LP-mode DCS command transfers.
```

## drivers/mipi_dsi/Kconfig.esp32
```kconfig
# Copyright (c) 2026 Espressif Systems (Shanghai) Co., Ltd.
# SPDX-License-Identifier: Apache-2.0

config MIPI_DSI_ESP32
	bool "ESP32 MIPI DSI host controller"
	default y
	depends on DT_HAS_ESPRESSIF_ESP_MIPI_DSI_ENABLED
	depends on SOC_SERIES_ESP32P4
	depends on DISPLAY_ESP32_DSI
	help
	  Enable driver for the ESP32 MIPI DSI host controller.
```

## drivers/misc/hwaccel/Kconfig
```kconfig
# Copyright (c) 2026 Ana Clara Forcelli <ana.forcelli@lsitec.org.br>
# SPDX-License-Identifier: Apache-2.0

menuconfig HWACCEL
	bool "Hardware Acceleration drivers and API"

if HWACCEL

module = HWACCEL
module-str = hwaccel
#source "subsys/logging/Kconfig.template.log_config"

config HWACCEL_INIT_PRIORITY
	int "Hardware Acceleration Init Priority"
	default 85

# zephyr-keep-sorted-start
source "drivers/misc/hwaccel/Kconfig.puppy"

endif
```

## drivers/misc/hwaccel/Kconfig.puppy
```kconfig
# Copyright (c) 2026 Ana Clara Forcelli <ana.forcelli@lsitec.org.br>
# SPDX-License-Identifier: Apache-2.0

config PUPPY_UDMA_FILTER
    bool "Enable Caninos's in-chip DSP accelerator"
	depends on DT_HAS_PUPPY_UDMA_FILTER_ENABLED
    default y
```

## drivers/misc/infineon_mxcordic/Kconfig
```kconfig
# SPDX-FileCopyrightText: Copyright (c) 2026 Infineon Technologies AG,
# SPDX-FileCopyrightText: or an affiliate of Infineon Technologies AG. All rights reserved.
#
# SPDX-License-Identifier: Apache-2.0

config INFINEON_MXCORDIC
	bool "Infineon MXCORDIC math accelerator driver"
	default y
	depends on DT_HAS_INFINEON_MXCORDIC_ENABLED
	select USE_INFINEON_MXCORDIC
	help
	  Enable the vendor-specific driver for the Infineon MXCORDIC hardware
	  math accelerator found on PSOC Control C3 (PSC3) devices. The driver
	  exposes blocking sin, cos, tan, atan2, asin, acos, sinh, cosh, tanh,
	  atanh, sqrt, magnitude, and Park transform operations.

if INFINEON_MXCORDIC

config INFINEON_MXCORDIC_INIT_PRIORITY
	int "Init priority"
	default 90
	help
	  Infineon MXCORDIC driver device initialization priority.

module = INFINEON_MXCORDIC
module-str = infineon_mxcordic
source "subsys/logging/Kconfig.template.log_config"

endif # INFINEON_MXCORDIC
```

## drivers/misc/it51xxx_hw_rsa/Kconfig
```kconfig
# Copyright (c) 2026 ITE Corporation.
# SPDX-License-Identifier: Apache-2.0

module = IT51XXX_HW_RSA
module-str = it51xxx-hw-rsa
source "subsys/logging/Kconfig.template.log_config"

config IT51XXX_HW_RSA_CALCULATION
	bool "IT51XXX hardware RSA calculation"
	default y
	depends on DT_HAS_ITE_IT51XXX_HW_RSA_ENABLED
	select SOC_IT51XXX_CPU_IDLE_GATING
	select SOC_IT51XXX_HW_CRYPTO_ACCELERATE
	select MFD
	help
	  This option enables it51xxx hardware rsa engine.

if IT51XXX_HW_RSA_CALCULATION

config IT51XXX_RSA_INIT_PRIORITY
	int "IT51XXX HW RSA init priority"
	default 51
	help
	  it51xxx hardware rsa driver initialization priority.

endif # IT51XXX_HW_RSA_CALCULATION
```

## drivers/misc/it51xxx_psa_crypto/Kconfig
```kconfig
# Copyright (c) 2026 ITE Corporation.
# SPDX-License-Identifier: Apache-2.0

module = IT51XXX_PSA_CRYPTO
module-str = it51xxx-psa-crypto
source "subsys/logging/Kconfig.template.log_config"

config IT51XXX_PSA_CRYPTO
	bool "ITE IT51XXX PSA crypto device driver"
	depends on DT_HAS_ITE_IT51XXX_CRYPTO_ENABLED
	depends on PSA_CRYPTO
	select SOC_IT51XXX_HW_CRYPTO_ACCELERATE
	default y
	help
	  This option enables the it51xxx psa crypto driver.

if IT51XXX_PSA_CRYPTO

config IT51XXX_PSA_CRYPTO_SHA
	bool "IT51XXX PSA crypto SHA driver"
	default y
	depends on DT_HAS_ITE_IT51XXX_PSA_SHA_ENABLED
	select SOC_IT51XXX_CPU_IDLE_GATING
	help
	  This option enables it51xxx psa crypto sha driver.

config IT51XXX_PSA_CRYPTO_RSA
	bool "IT51XXX PSA crypto RSA driver"
	default y
	depends on DT_HAS_ITE_IT51XXX_PSA_RSA_ENABLED
	select SOC_IT51XXX_CPU_IDLE_GATING
	select PSA_WANT_ALG_RSA_PKCS1V15_SIGN
	select PSA_WANT_ALG_RSA_PKCS1V15_CRYPT
	help
	  This option enables it51xxx psa crypto rsa driver.

endif # IT51XXX_PSA_CRYPTO
```
