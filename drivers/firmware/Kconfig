## drivers/flash/Kconfig.adi_max32_spixf
```kconfig
# ADI MAX32 SPIXF Quad SPI flash driver configuration

# Copyright (c) 2025 Analog Devices, Inc
# SPDX-License-Identifier: Apache-2.0

config FLASH_ADI_MAX32_SPIXF
	bool "ADI MAX32 SPIXF Quad SPI Flash driver"
	default y
	depends on DT_HAS_ADI_MAX32_SPIXF_NOR_ENABLED
	select FLASH_HAS_DRIVER_ENABLED
	select FLASH_JESD216
	select FLASH_HAS_PAGE_LAYOUT
	select FLASH_HAS_EXPLICIT_ERASE
	select PINCTRL
	help
	  Enable QSPI-NOR support on the MAX32 family of processors.

if FLASH_ADI_MAX32_SPIXF

config FLASH_ADI_MAX32_SPIXF_SFDP_RUNTIME
	bool "Read flash parameters at runtime"
	depends on FLASH_ADI_MAX32_SPIXF
	help
	  Read flash device characteristics from the device at runtime.
	  This option should provide functionality for all supported
	  JESD216-compatible devices, with the following notes:
	  - Quad Enable Requirements bitfield (DW15) must be present in the SFDP
	    tables to configure Quad mode. Otherwise it defaults to Dual or
	    Single mode as supported by the device.

	  If not selected, the driver uses a fixed configuration, and the device
	  size, page size, and jedec-id properties must be set in devicetree node.

endif
```

## drivers/flash/Kconfig.aesc
```kconfig
# SPDX-FileCopyrightText: 2026 Aesc Silicon
# SPDX-License-Identifier: Apache-2.0

config FLASH_AESC
	bool "Aesc Silicon SPI XIP flash controller driver"
	default y
	depends on DT_HAS_AESC_SPI_FLASH_CONTROLLER_ENABLED
	select FLASH_HAS_DRIVER_ENABLED
	help
	  Enable the Aesc Silicon SPI flash controller driver. It provides
	  read-only access to the execute-in-place mapped SPI NOR flash;
	  programming (write/erase) is not supported yet.
```

## drivers/flash/Kconfig.ambiq
```kconfig
# Copyright (c) 2023 Ambiq Micro Inc.
# SPDX-License-Identifier: Apache-2.0

config FLASH_AMBIQ
	bool "Ambiq flash driver on MRAM or flash"
	default y
	depends on DT_HAS_AMBIQ_FLASH_CONTROLLER_ENABLED
	select AMBIQ_HAL
	select FLASH_HAS_PAGE_LAYOUT
	select FLASH_HAS_DRIVER_ENABLED
	select FLASH_HAS_NO_EXPLICIT_ERASE if SOC_SERIES_APOLLO4X
	select FLASH_HAS_EXPLICIT_ERASE if SOC_SERIES_APOLLO3X
	help
	  Enables Ambiq flash driver on MRAM (e.g. Apollo4x) or
	  flash (e.g. Apollo3x).
```

## drivers/flash/Kconfig.ameba
```kconfig
# Copyright (c) 2026 Realtek Semiconductor Corp.
# SPDX-License-Identifier: Apache-2.0

config SOC_FLASH_AMEBA
	bool "AMEBA flash driver"
	default y
	depends on DT_HAS_REALTEK_AMEBA_FLASH_CONTROLLER_ENABLED
	select FLASH_HAS_DRIVER_ENABLED
	select FLASH_HAS_PAGE_LAYOUT
	select FLASH_HAS_EXPLICIT_ERASE
	help
	  Enable AMEBA internal flash driver.

config FLASH_AMEBA_BUF_SIZE
	int "AMEBA flash RAM buffer size"
	default 256
	depends on SOC_FLASH_AMEBA
	help
	  If the source address of a flash write operation is also a flash address,
	  the data needs to be copied to RAM first before writing to the flash.
	  This configuration sets the size of this RAM buffer.
```

## drivers/flash/Kconfig.andes
```kconfig
# Kconfig Andes QSPI-NOR configuration options
#
# Copyright (c) 2023 Andes Technology Corporation.
#
# SPDX-License-Identifier: Apache-2.0
#

menuconfig FLASH_ANDES_QSPI
	bool "Andes FLASH driver"
	default y
	depends on DT_HAS_ANDESTECH_QSPI_NOR_ENABLED
	select FLASH_HAS_PAGE_LAYOUT
	select FLASH_JESD216
	select FLASH_HAS_DRIVER_ENABLED
	select FLASH_HAS_EXPLICIT_ERASE
	depends on !SPI_NOR
	help
	  Enable driver for Andes QSPI

if FLASH_ANDES_QSPI

choice FLASH_ANDES_QSPI_SFDP
	prompt "Source for Serial Flash Discoverable Parameters"
	default FLASH_ANDES_QSPI_SFDP_RUNTIME

config FLASH_ANDES_QSPI_SFDP_DEVICETREE
	bool "Basic Flash Parameters from devicetree node"
	help
	  The JESD216 Basic Flash Parameters table must be provided in the
	  sfdp-bfp property in devicetree.  The size and jedec-id properties are
	  also required.

config FLASH_ANDES_QSPI_SFDP_RUNTIME
	bool "Read flash parameters at runtime"
	help
	  Read all flash device characteristics from the device at runtime.
	  This option is the most flexible as it should provide functionality
	  for all supported JESD216-compatible devices.

endchoice

endif

config FLASH_ANDES_QSPI_XIP
	bool "Andes FLASH driver for XIP chip"
	default y
	depends on DT_HAS_ANDESTECH_QSPI_NOR_XIP_ENABLED
	select FLASH_HAS_PAGE_LAYOUT
	select FLASH_HAS_DRIVER_ENABLED
	select FLASH_HAS_EXPLICIT_ERASE
	select FLASH_HAS_EX_OP
	depends on XIP
	depends on !SPI_NOR
	depends on ARCH_HAS_RAMFUNC_SUPPORT
	depends on !SMP
	help
	  Enable minimalistic driver for Andes QSPI that can be used with a
	  flash chip that is used for XIP execution. The driver places necessary
	  code in RAM, because code can not be fetched from flash while
	  performing erase/write operations.

if FLASH_ANDES_QSPI || FLASH_ANDES_QSPI_XIP

config FLASH_ANDES_QSPI_INIT_PRIORITY
	int
	default 80
	help
	  Device driver initialization priority.

config FLASH_ANDES_QSPI_LAYOUT_PAGE_SIZE
	int "Page size to use for FLASH_LAYOUT feature"
	default 65536
	help
	  When CONFIG_FLASH_PAGE_LAYOUT is used this driver will support
	  that API.  By default the page size corresponds to the block
	  size (65536).  Other options include the 32K-byte erase size
	  (32768), the sector size (4096), or any non-zero multiple of the
	  sector size.

endif

if FLASH_ANDES_QSPI_XIP

config FLASH_ANDES_QSPI_XIP_COUNT_REGS
	bool "Use separated write/read count registers"
	help
	  The Andes qspi module has separated write/read count registers.

endif
```

## drivers/flash/Kconfig.at25xv021a
```kconfig
# Copyright (c) 2025 Cirrus Logic, Inc.
# SPDX-License-Identifier: Apache-2.0

config SPI_FLASH_AT25XV021A
	bool "Atmel AT25 SPI flash variant"
	default y
	depends on DT_HAS_ATMEL_AT25XV021A_ENABLED
	select FLASH_HAS_DRIVER_ENABLED
	select FLASH_HAS_PAGE_LAYOUT
	select FLASH_HAS_EXPLICIT_ERASE
	select SPI
	help
	  Enable support for AT25XV021A SPI flash variants.

	  Vendors that have manufactured such variants include:
	  - Renesas Electronics
	  - Adesto Technologies
```

## drivers/flash/Kconfig.at45
```kconfig
# Copyright (c) 2020 Nordic Semiconductor ASA
# SPDX-License-Identifier: Apache-2.0

menuconfig SPI_FLASH_AT45
	bool "AT45 family flash driver"
	default y
	depends on DT_HAS_ATMEL_AT45_ENABLED
	select FLASH_HAS_DRIVER_ENABLED
	select FLASH_HAS_PAGE_LAYOUT
	select SPI
	help
	  This driver can handle several instances of AT45 family chips that
	  are enabled by specifying devicetree nodes with the "compatible"
	  property set to "atmel,at45" and other required properties like
	  JEDEC ID, chip capacity, block and page size etc. configured
	  accordingly.

	  The driver is only capable of using "power of 2" binary page sizes
	  in those chips and at initialization configures them to work in
	  that mode (unless it is already done).

if SPI_FLASH_AT45

config SPI_FLASH_AT45_USE_READ_MODIFY_WRITE
	bool "Use Read-Modify-Write command in flash_write()"
	default y
	select FLASH_ANY_HAS_UNRESTRICTED_WRITE
	help
	  Use the Read-Modify-Write command (opcode 0x58) instead of the default
	  Main Memory Program without Built-In Erase (opcode 0x02). This allows
	  writing of data without prior erasing of corresponding pages.

if !SPI_FLASH_AT45_USE_READ_MODIFY_WRITE

config SPI_FLASH_AT45_USE_DEFAULT_WRITE
	bool "Use default main memory program in flash_write()"
	default y
	select FLASH_ANY_HAS_RESTRICTED_WRITE
	help
	  Use the default Main Memory Program (opcode 0x02) for writing data,
	  this requires pages to be erased before write.

endif

config SPI_FLASH_AT45_INIT_PRIORITY
	int "Driver initialization priority"
	default 80
	help
	  Device driver initialization priority.
	  SPI driver needs to be initialized before this one.

endif # SPI_FLASH_AT45
```

## drivers/flash/Kconfig.atm
```kconfig
# Copyright (c) 2023-2025 Atmosic
#
# SPDX-License-Identifier: Apache-2.0

config SOC_FLASH_ATM
	bool "Atmosic external flash driver"
	depends on DT_HAS_ATMOSIC_EXTERNAL_FLASH_CONTROLLER_ENABLED
	select FLASH_HAS_DRIVER_ENABLED
	select FLASH_HAS_PAGE_LAYOUT
	select FLASH_HAS_EXPLICIT_ERASE
	select MPU_ALLOW_FLASH_WRITE if ARM_MPU
	default y if !(BOOTLOADER_MCUBOOT && TRUSTED_EXECUTION_SECURE)
	help
	  Enable Atmosic external flash driver.

config SOC_FLASH_ATM_FORCE_PUYA
	bool "Force recovered manufactuer ID to PUYA"
	depends on SOC_FLASH_ATM
	depends on SOC_SERIES_ATMX2

config SOC_FLASH_ATM_USE_BREAK_IN
	bool "Allow the use of Atmosic flash break-in support if available"
	default y
	depends on SOC_FLASH_ATM
	depends on MULTITHREADING
	depends on !MCUBOOT

config SOC_FLASH_ATM_BREAK_IN_SUSPEND_US
	int "Atmosic break-in suspend time in microseconds"
	default 50
	depends on SOC_FLASH_ATM_USE_BREAK_IN

config SOC_FLASH_ATM_RRAM
	bool "Atmosic RRAM driver"
	depends on DT_HAS_ATMOSIC_RRAM_CONTROLLER_ENABLED
	select FLASH_HAS_DRIVER_ENABLED
	select FLASH_HAS_PAGE_LAYOUT
	select FLASH_HAS_NO_EXPLICIT_ERASE
	select MPU_ALLOW_FLASH_WRITE if ARM_MPU
	default y
	help
	  Enable Atmosic RRAM driver.
```

## drivers/flash/Kconfig.b91
```kconfig
# Copyright (c) 2021 Telink Semiconductor
# SPDX-License-Identifier: Apache-2.0

config SOC_FLASH_TELINK_B91
	bool "Telink Semiconductor B91 flash driver"
	default y
	depends on DT_HAS_TELINK_B91_FLASH_CONTROLLER_ENABLED
	select FLASH_HAS_PAGE_LAYOUT
	select FLASH_HAS_DRIVER_ENABLED
	select FLASH_HAS_EXPLICIT_ERASE
	help
	  Enables Telink B91 flash driver.
```

## drivers/flash/Kconfig.b9x
```kconfig
# Copyright (c) 2021-2024 Telink Semiconductor
# SPDX-License-Identifier: Apache-2.0

config SOC_FLASH_TELINK_B9X
	bool "Telink Semiconductor B9x flash driver"
	default y
	depends on DT_HAS_TELINK_B9X_FLASH_CONTROLLER_ENABLED
	select FLASH_HAS_PAGE_LAYOUT
	select FLASH_HAS_DRIVER_ENABLED
	help
	  Enables Telink B9x flash driver.
```

## drivers/flash/Kconfig.bee_nor
```kconfig
# Copyright(c) 2026, Realtek Semiconductor Corporation.
# SPDX-License-Identifier: Apache-2.0

config SOC_FLASH_BEE_NOR
	bool "Realtek Bee Nor flash driver"
	default y
	depends on DT_HAS_REALTEK_BEE_NOR_FLASH_CONTROLLER_ENABLED
	select FLASH_HAS_DRIVER_ENABLED
	select FLASH_HAS_PAGE_LAYOUT
	select FLASH_HAS_EXPLICIT_ERASE
	help
	  Enable Realtek Bee Nor flash driver.

if SOC_FLASH_BEE_NOR

choice
	prompt "Realtek Bee Nor Flash Bit Mode"
	default SOC_FLASH_BEE_NOR_1BIT_MODE
	help
	  Selects the flash bit mode to use. The available options are
	  limited by the hardware's supported modes defined in the
	  device tree.

config SOC_FLASH_BEE_NOR_1BIT_MODE
	bool "Flash 1-bit mode"
	help
	  Set Realtek Bee Nor Flash to 1-bit mode (default).
	  This is the standard SPI mode using CLK, CS#, DI, and DO pins.

config SOC_FLASH_BEE_NOR_2BIT_MODE
	bool "Flash 2-bit mode (Dual)"
	depends on $(dt_compat_any_has_prop,$(DT_COMPAT_REALTEK_BEE_NOR_FLASH),supports-2bit)
	help
	  Set Realtek Bee Nor Flash to 2-bit (Dual) mode.
	  Uses DI and DO as IO0 and IO1 respectively.

config SOC_FLASH_BEE_NOR_4BIT_MODE
	bool "Flash 4-bit mode (Quad)"
	depends on $(dt_compat_any_has_prop,$(DT_COMPAT_REALTEK_BEE_NOR_FLASH),supports-4bit)
	help
	  Set Realtek Bee Nor Flash to 4-bit (Quad) mode.
	  Uses all six pins (DI, DO, WP#, HOLD#) as IO0-IO3.
	  Note: The flash used by Bee Family SoCs only partially supports quad-read
	  mode. Users should verify the flash model and characteristics in advance.

config SOC_FLASH_BEE_NOR_DTR_4BIT_MODE
	bool "Flash 4-bit DTR mode (Quad)"
	depends on $(dt_compat_any_has_prop,$(DT_COMPAT_REALTEK_BEE_NOR_FLASH),supports-dtr-4bit)
	help
	  Set Realtek Bee Nor Flash to 4-bit DTR (Double Transfer Rate) mode.
	  This provides higher performance but requires flash hardware support.

endchoice

config SOC_FLASH_BEE_NOR_BIT_MODE
	int
	default 0 if SOC_FLASH_BEE_NOR_1BIT_MODE
	default 1 if SOC_FLASH_BEE_NOR_2BIT_MODE
	default 2 if SOC_FLASH_BEE_NOR_4BIT_MODE
	default 3 if SOC_FLASH_BEE_NOR_DTR_4BIT_MODE

endif # SOC_FLASH_BEE_NOR
```

## drivers/flash/Kconfig.bflb
```kconfig
# Copyright (c) 2024-2025 MASSDRIVER EI (massdriver.space)
# SPDX-License-Identifier: Apache-2.0

config SOC_FLASH_BFLB
	bool "Bouffalolab flash driver"
	default y
	depends on DT_HAS_BFLB_SF_CONTROLLER_ENABLED
	select FLASH_HAS_DRIVER_ENABLED
	select FLASH_HAS_PAGE_LAYOUT
	select FLASH_HAS_EXPLICIT_ERASE
	imply CODE_DATA_RELOCATION
	help
	  Enables Bouffalolab flash driver for the flash controller

if SOC_FLASH_BFLB

config SOC_FLASH_BFLB_SFDP
	bool "SFDP on BFLB SF controller"
	default y
	depends on $(dt_compat_any_has_prop,$(DT_COMPAT_BFLB_SF_FLASH),use-sfdp,True)
	select FLASH_JESD216
	help
	  Enables direct access to flash via controller instead of via cache and XIP

config SOC_FLASH_BFLB_DIRECT_ACCESS
	bool "Bouffalolab flash driver read mode"
	default n
	help
	  Enables direct access to flash via controller instead of via cache and XIP

endif
```

## drivers/flash/Kconfig.cadence_nand
```kconfig
# Copyright (c) 2023 Intel Corporation.
# SPDX-License-Identifier: Apache-2.0

# Macro to find node in device tree
DT_CHOSEN_CDNS_NAND_NODE := nand

config FLASH_CDNS_NAND
	bool "Cadence NAND Flash driver"
	default y
	depends on DT_HAS_CDNS_NAND_ENABLED
	select FLASH_HAS_PAGE_LAYOUT
	select FLASH_HAS_DRIVER_ENABLED
	select FLASH_HAS_EXPLICIT_ERASE
	help
	  Enable Cadence NAND support.

if FLASH_CDNS_NAND

config CDNS_NAND_INTERRUPT_SUPPORT
	bool "Cadence Nand Interrupt Support"
	def_bool $(dt_node_has_prop,$(DT_CHOSEN_CDNS_NAND_NODE),interrupts)
	help
	  Enable Cadence Nand Interrupt Support.

choice
	prompt "Set the NAND Operating mode"
	default CDNS_NAND_CDMA_MODE
	help
	  Specify the Operating mode used by the driver.

config CDNS_NAND_CDMA_MODE
	bool "Cadence Nand CDMA Operating Mode"

config CDNS_NAND_PIO_MODE
	bool "Cadence Nand PIO Operating Mode"

config CDNS_NAND_GENERIC_MODE
	bool "Cadence Nand Generic Operating Mode"

endchoice

config FLASH_CDNS_CDMA_PAGE_COUNT
	int "Set the page count for a single transfer in the CDMA Mode"
	default 10
	help
	  Configure the page count for a single transfer in the CDMA Mode

config FLASH_CDNS_CDMA_BLOCK_COUNT
	int "Set the block count for a single transfer in the CDMA Mode"
	default 10
	help
	  Configure the block count for a single transfer in the CDMA Mode

endif # FLASH_CDNS_NAND
```
