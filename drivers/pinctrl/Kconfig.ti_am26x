## drivers/pinctrl/Kconfig.ti_am26x
```kconfig
# Copyright (c) 2025 Texas Instruments
# SPDX-License-Identifier: Apache-2.0

config PINCTRL_TI_AM26X
	bool "TI AM26x pinctrl driver"
	default y
	depends on DT_HAS_TI_AM26X_PINCTRL_ENABLED
	help
	  Enable the TI AM26x pinctrl driver
```

## drivers/pinctrl/Kconfig.ti_cc32xx
```kconfig
# Copyright (c) 2023 Nordic Semiconductor ASA
# SPDX-License-Identifier: Apache-2.0

config PINCTRL_TI_CC32XX
	bool "TI CC32XX pinctrl driver"
	default y
	depends on DT_HAS_TI_CC32XX_PINCTRL_ENABLED
	help
	  Enable the TI CC32XX pinctrl driver
```

## drivers/pinctrl/Kconfig.ti_k3
```kconfig
# Copyright (c) 2023 Enphase Energy
# SPDX-License-Identifier: Apache-2.0

config PINCTRL_TI_K3
	bool "TI K3 pinctrl driver"
	default y
	depends on DT_HAS_TI_K3_PINCTRL_ENABLED
	help
	  Enable the TI K3 pinctrl driver
```

## drivers/pinctrl/Kconfig.ti_tms570
```kconfig
# Copyright (c) 2025 ispace, inc.
# SPDX-License-Identifier: Apache-2.0

config PINCTRL_TI_TMS570
	bool "TI TMS570 pinctrl driver"
	default y
	depends on DT_HAS_TI_TMS570_PINMUX_ENABLED
	help
	  Enable the TI TMS570 pinmux driver
```

## drivers/pinctrl/Kconfig.tlx
```kconfig
# Copyright (c) 2022-2023 Telink Semiconductor
# SPDX-License-Identifier: Apache-2.0

config PINCTRL_TELINK_TLX
	bool "Telink TLX-series pin controller driver"
	default y
	depends on DT_HAS_TELINK_TLX_PINCTRL_ENABLED
	help
	  Enables Telink TLX-series pin controller driver
```

## drivers/pinctrl/Kconfig.w91
```kconfig
# Copyright (c) 2024 Telink Semiconductor
# SPDX-License-Identifier: Apache-2.0

config PINCTRL_TELINK_W91
	bool "Telink W91-series pin controller driver"
	default y
	depends on DT_HAS_TELINK_W91_PINCTRL_ENABLED
	help
	  Enables Telink W91-series pin controller driver
```

## drivers/pinctrl/Kconfig.wch_00x_afio
```kconfig
# Copyright (c) 2025 Michael Hope <michaelh@juju.nz>
# SPDX-License-Identifier: Apache-2.0

config PINCTRL_WCH_00X_AFIO
	bool "WCH AFIO pin controller driver for CH32V00x"
	default y
	depends on DT_HAS_WCH_00X_AFIO_ENABLED
	help
	  WCH CH32V00x AFIO pin controller driver, excluding the CH32V003.
```

## drivers/pinctrl/Kconfig.wch_20x_30x_afio
```kconfig
# Copyright (c) 2024 MASSDRIVER EI (massdriver.sapce)
# SPDX-License-Identifier: Apache-2.0

config PINCTRL_WCH_20X_30X_AFIO
	bool "WCH AFIO pin controller driver for CH32V20x/30x"
	default y
	depends on DT_HAS_WCH_20X_30X_AFIO_ENABLED
	help
	  WCH CH32V20x/30x AFIO pin controller driver.
```

## drivers/pinctrl/Kconfig.wch_afio
```kconfig
# Copyright (c) 2024 Michael Hope
# SPDX-License-Identifier: Apache-2.0

config PINCTRL_WCH_AFIO
	bool "WCH AFIO pin controller driver"
	default y
	depends on DT_HAS_WCH_AFIO_ENABLED
	help
	  WCH AFIO pin controller driver.
```

## drivers/pinctrl/Kconfig.wch_afio_20x_30x
```kconfig
# Copyright (c) 2024 MASSDRIVER EI (massdriver.sapce)
# SPDX-License-Identifier: Apache-2.0

config PINCTRL_WCH_AFIO_20X_30X
	bool "WCH AFIO pin controller driver for CH32V20x/30x"
	default y
	depends on DT_HAS_WCH_AFIO_20X_30X_ENABLED
	help
	  WCH CH32V20x/30x AFIO pin controller driver.
```

## drivers/pinctrl/Kconfig.wch_ch570
```kconfig
# SPDX-FileCopyrightText: 2026 SMILE (smile.eu)
# SPDX-License-Identifier: Apache-2.0

config PINCTRL_WCH_CH570
	bool "WCH CH570 pin controller driver"
	default y
	depends on DT_HAS_WCH_CH570_PINCTRL_ENABLED
	help
	  WCH CH570-CH572 pin controller driver.
```

## drivers/pinctrl/Kconfig.wch_h41x_afio
```kconfig
# Copyright (c) 2026 Liu Changjie
# SPDX-License-Identifier: Apache-2.0

config PINCTRL_WCH_H41X_AFIO
	bool "WCH AFIO pin controller driver for CH32H41x"
	default y
	depends on DT_HAS_WCH_H41X_AFIO_ENABLED
	help
	  WCH CH32H41x AFIO pin controller driver (per-pin alternate function
	  mux model).
```

## drivers/pinctrl/Kconfig.xec
```kconfig
# Copyright (c) 2021 Microchip Technology Inc.
# SPDX-License-Identifier: Apache-2.0

config PINCTRL_MCHP_XEC
	bool "Pin controller driver for MCHP XEC MCUs"
	default y
	depends on DT_HAS_MICROCHIP_XEC_PINCTRL_ENABLED
	help
	  Enable pin controller driver for Microchip XEC MCUs
```

## drivers/pinctrl/Kconfig.xlnx
```kconfig
# Copyright (c) 2022 Henrik Brix Andersen <henrik@brixandersen.dk>
# SPDX-License-Identifier: Apache-2.0

config PINCTRL_XLNX_ZYNQ
	bool "Xilinx Zynq 7000 processor system MIO pin controller driver"
	default y
	depends on DT_HAS_XLNX_PINCTRL_ZYNQ_ENABLED
	select SYSCON
	help
	  Enable the Xilinx Zynq 7000 processor system MIO pin controller driver.
```

## drivers/pinctrl/Kconfig.xmc4xxx
```kconfig
# Copyright (c) 2022 Schlumberger
# SPDX-License-Identifier: Apache-2.0

config PINCTRL_XMC4XXX
	bool "XMC4XXX pin controller driver"
	default y
	depends on DT_HAS_INFINEON_XMC4XXX_PINCTRL_ENABLED
	help
	  Enables XMC4XXX pin controller driver.
```

## drivers/pinctrl/Kconfig.zynqmp
```kconfig
# Copyright (c) 2024 Antmicro <www.antmicro.com>
# SPDX-License-Identifier: Apache-2.0

config PINCTRL_XLNX_ZYNQMP
	bool "Xilinx ZynqMP pin controller driver"
	default y
	depends on DT_HAS_XLNX_PINCTRL_ZYNQMP_ENABLED
	help
	  Enable the Xilinx ZynqMP processor system MIO pin controller driver.
```

## drivers/pinctrl/renesas/Kconfig
```kconfig
# Copyright (c) 2024 EPAM Systems
# SPDX-License-Identifier: Apache-2.0

rsource "*/Kconfig"
```

## drivers/pinctrl/renesas/ra/Kconfig
```kconfig
# Copyright (c) 2023 TOKITA Hiroshi <tokita.hiroshi@fujitsu.com>
# Copyright (c) 2024 Renesas Electronics Corporation
# SPDX-License-Identifier: Apache-2.0

config PINCTRL_RENESAS_RA
	bool "Renesas RA series pin controller driver"
	default y
	depends on DT_HAS_RENESAS_RA_PINCTRL_ENABLED
	help
	  Enable Renesas RA series pin controller driver.

config PINCTRL_RENESAS_RA_PFS
	bool "Renesas RA pinctrl driver"
	default y
	depends on DT_HAS_RENESAS_RA_PINCTRL_PFS_ENABLED
	help
	  Enable the Renesas RA series pinctrl driver with PFS secure register.
```

## drivers/pinctrl/renesas/rcar/Kconfig
```kconfig
# Copyright (c) 2021 IoT.bzh
# SPDX-License-Identifier: Apache-2.0

config PINCTRL_RCAR_PFC
	bool "Pin controller driver for Renesas RCar SoC"
	default y
	depends on DT_HAS_RENESAS_RCAR_PFC_ENABLED || DT_HAS_RENESAS_RCAR_PFC_X5H_ENABLED
	help
	  Enable pin controller driver for Renesas RCar SoC

config PINCTRL_RCAR_VOLTAGE_CONTROL
	bool "Voltage control functionality of Renesas R-Car PFC driver"
	default y if SOC_SERIES_RCAR_GEN3
	depends on PINCTRL_RCAR_PFC

config PINCTRL_RCAR_SCMI
	bool "SCMI functionality of Renesas R-Car PFC driver"
	default y
	depends on PINCTRL_RCAR_PFC
	depends on ARM_SCMI_PINCTRL_HELPERS
	help
	  Perform pin configuration operations through SCMI (System Control
	  and Management Interface) pinctrl protocol. The entity which acts
	  as SCMI server to provide this service is a dedicated SCP (System
	  Control Processor) firmware.
```

## drivers/pinctrl/renesas/rh850/Kconfig
```kconfig
# Copyright (c) 2026 Renesas Electronics Corporation
# SPDX-License-Identifier: Apache-2.0

config PINCTRL_RENESAS_RH850
	bool "Renesas RH850 pinctrl driver"
	default y
	depends on DT_HAS_RENESAS_RH850_PINCTRL_ENABLED
	help
	  Enable the Renesas RH850 series pin controller driver.
```

## drivers/pinctrl/renesas/rz/Kconfig
```kconfig
# Copyright (c) 2023 Antmicro <www.antmicro.com>
# Copyright (c) 2024-2025 Renesas Electronics Corporation
# SPDX-License-Identifier: Apache-2.0

config PINCTRL_RZT2M
	bool "Renesas RZ/T2M pin controller driver"
	default y
	depends on DT_HAS_RENESAS_RZT2M_PINCTRL_ENABLED
	help
	  Renesas RZ/T2M pinctrl driver

config PINCTRL_RENESAS_RZ
	bool "Renesas RZ pin controller driver"
	default y
	depends on DT_HAS_RENESAS_RZG_PINCTRL_ENABLED \
		|| DT_HAS_RENESAS_RZN_PINCTRL_ENABLED \
		|| DT_HAS_RENESAS_RZT_PINCTRL_ENABLED \
		|| DT_HAS_RENESAS_RZA_PINCTRL_ENABLED \
		|| DT_HAS_RENESAS_RZV_PINCTRL_ENABLED
	select USE_RZ_FSP_IOPORT
	help
	  Enable Renesas RZ pinctrl driver.

config PINCTRL_RENESAS_RZA2M
	bool "Renesas RZA2M pin controller driver"
	default y
	depends on DT_HAS_RENESAS_RZA2M_PINCTRL_ENABLED
	help
	  Enable Renesas RZ pinctrl driver.
```

## drivers/pinmux/Kconfig
```kconfig
# Pinmux configuration options

# Copyright (c) 2015 Intel Corporation
# SPDX-License-Identifier: Apache-2.0

#
# PinMux options
#
menuconfig PINMUX
	bool "Board pinmux driver"

if PINMUX

config PINMUX_INIT_PRIORITY
	int "Init priority"
	default 45
	help
	  Pinmux driver initialization priority.
	  Pinmux driver almost certainly should be initialized before the
	  rest of hardware devices (which may need specific pins already
	  configured for them), and usually after generic GPIO drivers.
	  Thus, its priority should be between KERNEL_INIT_PRIORITY_DEFAULT
	  and KERNEL_INIT_PRIORITY_DEVICE. There are exceptions to this
	  rule for particular boards. Don't change this value unless you
	  know what you are doing.

source "drivers/pinmux/Kconfig.beetle"

source "drivers/pinmux/Kconfig.lpc11u6x"

source "drivers/pinmux/Kconfig.mcux"

source "drivers/pinmux/Kconfig.mcux_lpc"

source "drivers/pinmux/Kconfig.rv32m1"

source "drivers/pinmux/Kconfig.stm32"

source "drivers/pinmux/Kconfig.xec"

endif # PINMUX
```

## drivers/pinmux/Kconfig.b91
```kconfig
# Copyright (c) 2021 Telink Semiconductor
# SPDX-License-Identifier: Apache-2.0

config PINMUX_TELINK_B91
	bool "Telink Semiconductor B91 pinmux driver"
	depends on SOC_RISCV_TELINK_B91
	default y
	help
	  Enables Telink B91 pinmux driver.
```

## drivers/pinmux/Kconfig.beetle
```kconfig
# Kconfig.beetle - ARM V2M Beetle PINMUX configuration options
#
#
# Copyright (c) 2016 Linaro Limited
#
# SPDX-License-Identifier: Apache-2.0
#

config PINMUX_BEETLE
	bool "ARM V2M Beetle Pin multiplexer driver"
	depends on SOC_SERIES_BEETLE
	help
	  Enable driver for ARM V2M Beetle Pin multiplexer.
```

## drivers/pinmux/Kconfig.cc13xx_cc26xx
```kconfig
# Kconfig.cc13xx_cc26xx - TI CC13xx / CC26xx PINMUX configuration options
#
# Copyright (c) 2019 Brett Witherspoon
#
# SPDX-License-Identifier: Apache-2.0
#

config PINMUX_CC13XX_CC26XX
	bool "TI SimpleLink CC13xx / CC26xx pinmux driver"
	depends on SOC_SERIES_CC13X2_CC26X2
	help
	  Enable the TI SimpleLink CC13xx / CC26xx pinmux driver.
```
