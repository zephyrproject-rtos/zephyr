## drivers/pinctrl/Kconfig.rapidsi
```kconfig
# Copyright (c) 2024 Rapid Silicon
# SPDX-License-Identifier: Apache-2.0

config PINCTRL_RAPIDSI
	bool "Rapid Silicon pin controller driver"
	default n
	depends on DT_HAS_RAPIDSI_PINCTRL_ENABLED
	depends on PINCTRL
	help
	  Rapid Silicon pin controller driver
```

## drivers/pinctrl/Kconfig.rcar
```kconfig
# Copyright (c) 2021 IoT.bzh
# SPDX-License-Identifier: Apache-2.0

config PINCTRL_RCAR_PFC
	bool "Pin controller driver for Renesas RCar SoC"
	default y
	depends on DT_HAS_RENESAS_RCAR_PFC_ENABLED
	help
	  Enable pin controller driver for Renesas RCar SoC

config PINCTRL_RCAR_VOLTAGE_CONTROL
	bool "Voltage control functionality of Renesas R-Car PFC driver"
	default y if SOC_SERIES_RCAR_GEN3
	depends on PINCTRL_RCAR_PFC
```

## drivers/pinctrl/Kconfig.realtek_rts5912
```kconfig
# SPDX-License-Identifier: Apache-2.0
#
# Copyright (c) 2024 Realtek Semiconductor Corporation, SIBG-SD7
#

config PINCTRL_REALTEK_RTS5912
	bool "Pin controller driver for REALTEK RTS MCUs"
	default y if DT_HAS_REALTEK_RTS5912_PINCTRL_ENABLED
	help
	  Enable pin controller driver for REALTEK RTS MCUs
```

## drivers/pinctrl/Kconfig.rp1
```kconfig
# Copyright (c) 2025 TOKITA Hiroshi
# SPDX-License-Identifier: Apache-2.0

config PINCTRL_RP1
	bool "Raspberry Pi RP1 pin controller driver"
	default y
	depends on DT_HAS_RASPBERRYPI_RP1_PINCTRL_ENABLED
	help
	  Enable pin controller driver for the Raspberry Pi RP1 peripheral.
```

## drivers/pinctrl/Kconfig.rpi_pico
```kconfig
# Copyright (c) 2021 Yonatan Schachter
# SPDX-License-Identifier: Apache-2.0

config PINCTRL_RPI_PICO
	bool "RaspberryPi Pico pin controller driver"
	default y
	depends on DT_HAS_RASPBERRYPI_PICO_PINCTRL_ENABLED
	select PICOSDK_USE_GPIO
	help
	  RaspberryPi Pico pinctrl driver
```

## drivers/pinctrl/Kconfig.rts5817
```kconfig
# Copyright (c) 2024 Realtek Semiconductor, Inc.
# SPDX-License-Identifier: Apache-2.0

config PINCTRL_RTS5817
	bool "RTS5817 pin controller driver"
	default y
	depends on DT_HAS_REALTEK_RTS5817_PINCTRL_ENABLED
	help
	  Enable driver for RTS5817 pin controller.
```

## drivers/pinctrl/Kconfig.rv32m1
```kconfig
# Copyright (c) 2022 Henrik Brix Andersen <henrik@brixandersen.dk>
# SPDX-License-Identifier: Apache-2.0

config PINCTRL_RV32M1
	bool "RV32M1 pin controller driver"
	default y
	depends on DT_HAS_OPENISA_RV32M1_PINMUX_ENABLED
	help
	  Enable the RV32M1 pin controller driver.

config PINCTRL_RV32M1_INIT_PRIORITY
	int "RV32M1 initialization priority"
	default 35
	depends on PINCTRL_RV32M1
	help
	  RV32M1 pin controller initialization priority.
```

## drivers/pinctrl/Kconfig.rw
```kconfig
# Copyright 2022 NXP
# SPDX-License-Identifier: Apache-2.0

config PINCTRL_RW
	bool "Pin controller driver for NXP RW MCUs"
	default y
	depends on DT_HAS_NXP_RW_IOMUX_PINCTRL_ENABLED
	help
	  Enable pin controller driver for NXP RW61x series MCUs
```

## drivers/pinctrl/Kconfig.rzt2m
```kconfig
# Copyright (c) 2023 Antmicro <www.antmicro.com>
# SPDX-License-Identifier: Apache-2.0

config PINCTRL_RZT2M
	bool "Renesas RZ/T2M pin controller driver"
	default y
	depends on DT_HAS_RENESAS_RZT2M_PINCTRL_ENABLED
	help
	  Renesas RZ/T2M pinctrl driver
```

## drivers/pinctrl/Kconfig.sam
```kconfig
# Copyright (c) 2022, Gerson Fernando Budke <nandojve@gmail.com>
# SPDX-License-Identifier: Apache-2.0

config PINCTRL_SAM
	bool "Atmel SAM pin controller driver"
	default y
	depends on DT_HAS_ATMEL_SAM_PINCTRL_ENABLED
	help
	  Atmel pin controller driver is used on SAM and SAM4L SoC series

config PINCTRL_SAM_PIO4
	bool "Microchip SAM Parallel Input/Output Controller driver"
	default y
	depends on DT_HAS_MICROCHIP_SAMA7G5_PINCTRL_ENABLED
	help
	  Microchip Parallel Input/Output Controller is used on SAMA5D2 and
	  SAMA7G5 SoC series
```

## drivers/pinctrl/Kconfig.sam0
```kconfig
# Copyright (c) 2022, Gerson Fernando Budke <nandojve@gmail.com>
# SPDX-License-Identifier: Apache-2.0

config PINCTRL_SAM0
	bool "Atmel SAM0 pin controller driver"
	default y
	depends on DT_HAS_ATMEL_SAM0_PINCTRL_ENABLED
	help
	  Atmel pin controller driver is used on SAM0 SoC series
```

## drivers/pinctrl/Kconfig.sf32lb52x
```kconfig
# Copyright (c) 2025 Core Devices LLC
# SPDX-License-Identifier: Apache-2.0

config PINCTRL_SF32LB52X
	bool "Pin controller driver for SiFli SF32LB52X series"
	default y
	depends on DT_HAS_SIFLI_SF32LB52X_PINMUX_ENABLED
	help
	  Enable pin controller driver for SiFli SF32LB52X series
```

## drivers/pinctrl/Kconfig.sf32lb58
```kconfig
# Copyright (c) 2025 Qingdao IotPi Ltd.
# SPDX-License-Identifier: Apache-2.0

config PINCTRL_SF32LB58
       bool "Pin Controller driver for Sifli SF32LB58x HPSYS"
       default y
       depends on DT_HAS_SIFLI_SF32LB58_PINMUX_ENABLED
       help
         Enable Pin Controller driver for Sifli SF32LB58
```

## drivers/pinctrl/Kconfig.sf32lb58_hpsys
```kconfig
# Copyright (c) 2025 Qingdao IotPi Ltd.
# SPDX-License-Identifier: Apache-2.0

config PINCTRL_SF32LB58_HPSYS
       bool "Pin Controller driver for Sifli SF32LB58 HPSYS"
       default y
       depends on DT_HAS_SIFLI_SF32LB58_HPSYS_PINMUX_ENABLED
       help
         Enable Pin Controller driver for Sifli SF32LB HPSYS
```

## drivers/pinctrl/Kconfig.sifive
```kconfig
# Copyright (c) 2022 Antmicro <www.antmicro.com>
# SPDX-License-Identifier: Apache-2.0

config PINCTRL_SIFIVE
	bool "SiFive Freedom SoC pinmux driver"
	default y
	depends on DT_HAS_SIFIVE_PINCTRL_ENABLED
	help
	  Enable driver for the SiFive Freedom SoC pinctrl driver
```

## drivers/pinctrl/Kconfig.silabs_dbus
```kconfig
# Copyright (c) 2022 Silicon Labs
# SPDX-License-Identifier: Apache-2.0

config PINCTRL_SILABS_DBUS
	bool "Silabs DBUS pin controller driver"
	default y
	depends on DT_HAS_SILABS_DBUS_PINCTRL_ENABLED
	help
	  Silabs DBUS pin controller driver. This driver is used by series
	  using the DBUS (Digital Bus) for pin multiplexing.
```

## drivers/pinctrl/Kconfig.single
```kconfig
# Copyright (c) 2023 Enphase Energy
# SPDX-License-Identifier: Apache-2.0

config PINCTRL_SINGLE
	bool "pinctrl single driver"
	default y
	depends on DT_HAS_PINCTRL_SINGLE_ENABLED
	help
	  Enable the pinctrl single driver.
	  One-register-per-pin type device tree based pinctrl driver.
	  Adapted from Linux.
```

## drivers/pinctrl/Kconfig.siwx91x
```kconfig
# Copyright (c) 2023 Antmicro
# SPDX-License-Identifier: Apache-2.0

config PINCTRL_SILABS_SIWX91X
	bool "Silabs SiWx91x SoC series pinctrl driver"
	default y
	depends on DT_HAS_SILABS_SIWX91X_PINCTRL_ENABLED
	help
	  Enable the pinctrl driver for the Silabs SiWx91x SoC series.
```

## drivers/pinctrl/Kconfig.smartbond
```kconfig
# Copyright (c) 2022 Renesas Electronics Corporation
# SPDX-License-Identifier: Apache-2.0

config PINCTRL_SMARTBOND
	bool "Renesas SmartBond(tm) pinctrl driver"
	default y
	depends on DT_HAS_RENESAS_SMARTBOND_PINCTRL_ENABLED
	help
	  Enable pinctrl driver for Renesas SmartBond(tm) MCU family.
```

## drivers/pinctrl/Kconfig.sophgo
```kconfig
# Copyright (c) 2023-2024 Chen Xingyu <hi@xingrz.me>
# SPDX-License-Identifier: Apache-2.0

config PINCTRL_SOPHGO_CVI
	bool "SOPHGO CVI series pin controller driver"
	default y
	depends on DT_HAS_SOPHGO_CVI_PINCTRL_ENABLED
	help
	  Enables support for the SOPHGO CVI series pin controller.
```

## drivers/pinctrl/Kconfig.stm32
```kconfig
# Copyright (c) 2021 Nordic Semiconductor ASA
# SPDX-License-Identifier: Apache-2.0

config PINCTRL_STM32
	bool "Pin controller driver for STM32 MCUs"
	depends on SOC_FAMILY_STM32
	default y
	help
	  Enable pin controller driver for STM32 MCUs

config PINCTRL_STM32_REMAP_INIT_PRIORITY
	int "Remap initialization priority"
	default 2
	help
	  Initialization priority for the routine in charge of configuring the
	  remap for pins PA11/12.
```

## drivers/pinctrl/Kconfig.sunxi
```kconfig
# Copyright (c) 2026 Khai Do
# SPDX-License-Identifier: Apache-2.0

config PINCTRL_SUNXI
	bool "Allwinner sunXi pinctrl driver"
	default y
	depends on DT_HAS_ALLWINNER_SUN50I_H618_PINCTRL_ENABLED
	help
	  Enable pinctrl driver for Allwinner SoCs.
```

## drivers/pinctrl/Kconfig.sy1xx
```kconfig
# SPDX-License-Identifier: Apache-2.0
# Copyright (c) 2024 sensry.io

config PINCTRL_SY1XX
	bool "Sensry sy1xx pin controller driver"
	default y
	depends on DT_HAS_SENSRY_SY1XX_PINCTRL_ENABLED
	help
	  Sensry pin controller driver is used on sy1xx SoC series
```

## drivers/pinctrl/Kconfig.syna
```kconfig
# Copyright (c) 2025 Synaptics, Inc.
# SPDX-License-Identifier: Apache-2.0

config PINCTRL_SYNA
	bool "Pin controller driver for Synaptics MCUs"
	default y
	depends on DT_HAS_SYNA_PINCTRL_ENABLED
	help
	  Enable pin controller driver for Synaptics MCUs
```

## drivers/pinctrl/Kconfig.syna_sr100
```kconfig
# Copyright (c) 2025 Synaptics, Inc.
# SPDX-License-Identifier: Apache-2.0

config PINCTRL_SYNA_SR100
	bool "Pin controller driver for Synaptics SR100 MCUs"
	default y
	depends on DT_HAS_SYNA_SR100_PINCTRL_ENABLED
	help
	  Enable pin controller driver for Synaptics SR100 MCUs
```
