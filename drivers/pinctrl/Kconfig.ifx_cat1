## drivers/pinctrl/Kconfig.ifx_cat1
```kconfig
# ==================================================================================================
# Copyright (c) 2025 Cypress Semiconductor Corporation (an Infineon company) or
# an affiliate of Cypress Semiconductor Corporation
#
# SPDX-License-Identifier: Apache-2.0
# ==================================================================================================

# Infineon CAT1 Pin controller configuration options

config PINCTRL_INFINEON_CAT1
	bool "Pin controller driver for Infineon CAT1 MCUs"
	default y
	depends on DT_HAS_INFINEON_CAT1_PINCTRL_ENABLED
	help
	  Enable Pin controller driver for Infineon CAT1 MCUs
```

## drivers/pinctrl/Kconfig.ifx_catx
```kconfig
#Infineon CAT1 Pin controller configuration options

# Copyright (c) 2022 Cypress Semiconductor Corporation (an Infineon company) or
# an affiliate of Cypress Semiconductor Corporation
# SPDX-License-Identifier: Apache-2.0

config PINCTRL_INFINEON_CATX
        bool "Pin controller driver for Infineon CATx MCUs"
        default y
        depends on DT_HAS_INFINEON_CATX_PINCTRL_ENABLED
        help
          Enable Pin controller driver for Infineon CATx MCUs
```

## drivers/pinctrl/Kconfig.imx
```kconfig
# Copyright 2022, 2024 NXP
# SPDX-License-Identifier: Apache-2.0

config PINCTRL_IMX
	bool "Pin controller driver for iMX MCUs"
	depends on DT_HAS_NXP_IMX_IOMUXC_ENABLED
	depends on HAS_MCUX_IOMUXC || HAS_IMX_IOMUXC
	default y
	help
	  Enable pin controller driver for NXP iMX series MCUs

config PINCTRL_IMX_SCU
	bool "Pin controller driver for SCU-based i.MX SoCs"
	depends on DT_HAS_NXP_IMX_IOMUXC_SCU_ENABLED
	default y
	help
	  Enable pin controller driver for SCU-based NXP i.MX SoCs.

config PINCTRL_IMX_SCMI
	bool "Pin controller SCMI-based driver for i.MX SoCs"
	depends on ARM_SCMI_PINCTRL_HELPERS
	default y
	help
	  Enable pin controller SCMI-based driver for NXP i.MX SoCs.

# TODO: Find better place for this option
config MCUX_XBARA
	bool "MCUX XBARA driver"
	depends on DT_HAS_NXP_MCUX_XBAR_ENABLED
	help
	  Enable the MCUX XBARA driver.

config MCUX_XBARB
	bool "MCUX XBARB driver"
	depends on DT_HAS_NXP_MCUX_XBAR_ENABLED
	help
	  Enable the MCUX XBARB driver.
```

## drivers/pinctrl/Kconfig.iopctl
```kconfig
# Copyright 2024 NXP
# SPDX-License-Identifier: Apache-2.0

config PINCTRL_NXP_IOPCTL
	bool "IOPCTL Pin controller driver for NXP MCUs"
	default y
	depends on DT_HAS_NXP_RT_IOPCTL_PINCTRL_ENABLED
	help
	  Enable pin controller driver for NXP MCUs
```

## drivers/pinctrl/Kconfig.it8xxx2
```kconfig
# Copyright (c) 2022 ITE Corporation. All Rights Reserved.
# SPDX-License-Identifier: Apache-2.0

config PINCTRL_ITE_IT8XXX2
	bool "ITE IT8XXX2 pin controller driver"
	default y
	depends on DT_HAS_ITE_IT8XXX2_PINCTRL_FUNC_ENABLED
	help
	  Enable IT8XXX2 pin controller driver.
```

## drivers/pinctrl/Kconfig.k32_iocon
```kconfig
#
# Copyright (c) 2024 Sendrato
#
# SPDX-License-Identifier: Apache-2.0
#

config PINCTRL_K32_IOCON
	bool "IOCON Pin controller driver for NXP K32 MCUs"
	default y
	depends on DT_HAS_NXP_K32_IOCON_PINCTRL_ENABLED
	help
	  Enable pin controller driver for NXP LPC MCUs
```

## drivers/pinctrl/Kconfig.kinetis
```kconfig
# Copyright (c) 2022 NXP
# SPDX-License-Identifier: Apache-2.0

config PINCTRL_NXP_KINETIS
	bool "Pin controller driver for NXP Kinetis MCUs"
	default y
	depends on DT_HAS_NXP_KINETIS_PINMUX_ENABLED
	help
	  Enable pin controller driver for NXP Kinetis MCUs
```

## drivers/pinctrl/Kconfig.lpc84x
```kconfig
# Copyright (c) 2026 Aerlync Labs Inc.
# SPDX-License-Identifier: Apache-2.0

config PINCTRL_LPC84X
	bool "LPC84x pinctrl driver"
	default y
	depends on DT_HAS_NXP_LPC84X_SWM_ENABLED
	help
	 Enable the LPC84x pinctrl driver.
```

## drivers/pinctrl/Kconfig.lpc_iocon
```kconfig
# Copyright 2022, NXP
# SPDX-License-Identifier: Apache-2.0

config PINCTRL_NXP_IOCON
	bool "IOCON Pin controller driver for NXP LPC MCUs"
	default y
	depends on DT_HAS_NXP_LPC_IOCON_PINCTRL_ENABLED || \
		   DT_HAS_NXP_LPC11U6X_PINCTRL_ENABLED || \
		   DT_HAS_NXP_RT_IOCON_PINCTRL_ENABLED
	help
	  Enable pin controller driver for NXP LPC MCUs
```

## drivers/pinctrl/Kconfig.max32
```kconfig
# Copyright (c) 2023-2024 Analog Devices, Inc.
# SPDX-License-Identifier: Apache-2.0

config PINCTRL_MAX32
	bool "Analog Devices MAX32 MCUs pin controller driver"
	default y
	depends on DT_HAS_ADI_MAX32_PINCTRL_ENABLED
	help
	  Pin controller driver support for max32 SoC series
```

## drivers/pinctrl/Kconfig.mchp
```kconfig
# Copyright (c) 2025 Microchip Technology Inc.
# SPDX-License-Identifier: Apache-2.0

config PINCTRL_MCHP_COMMON
	bool "Microchip pin controller"
	help
	  Common options for Microchip pinctrl drivers.

config PINCTRL_MCHP_PORT_G1
	bool
	default y
	depends on DT_HAS_MICROCHIP_PORT_G1_PINCTRL_ENABLED
	select PINCTRL_MCHP_COMMON
	help
	  This option enables PINCTRL driver for group (g1) of PORT peripherals.

if PINCTRL_MCHP_COMMON

config PIN_OPEN_DRAIN
	bool "Support for open-drain option"
	help
	  This option enables Open drain configuration for the pin.

config PIN_SLEW_RATE
	bool "Support for slew-rate control"
	help
	  This option enables Slew rate for the pin.

config PIN_DRIVE_STRENGTH
	bool "Support for drive strength"
	help
	  This option enables Drive strength for the pin.

endif # PINCTRL_MCHP_COMMON
```

## drivers/pinctrl/Kconfig.mci_io_mux
```kconfig
# Copyright 2022 NXP
# SPDX-License-Identifier: Apache-2.0

config PINCTRL_MCI_IO_MUX
	bool "NXP MCI IO MUX Pinctrl Driver"
	default y
	depends on DT_HAS_NXP_MCI_IO_MUX_ENABLED
	help
	  Enable pin controller driver for NXP MCI_IO_MUX
```

## drivers/pinctrl/Kconfig.mcux
```kconfig
# Copyright 2022, NXP
# SPDX-License-Identifier: Apache-2.0

DT_COMPAT_MCUX_RT_PINCTRL := nxp,mcux-rt-pinctrl
DT_COMPAT_MCUX_RT11XX_PINCTRL := nxp,mcux-rt11xx-pinctrl

config PINCTRL_MCUX_RT
	bool "Pin controller driver for MCUX RT1xxx MCUs"
	depends on SOC_SERIES_IMX_RT
	default $(dt_compat_enabled,$(DT_COMPAT_MCUX_RT_PINCTRL)) ||	\
		$(dt_compat_enabled,$(DT_COMPAT_MCUX_RT11XX_PINCTRL))
	help
	  Enable pin controller driver for NXP RT1XXX series MCUs
```

## drivers/pinctrl/Kconfig.mec5
```kconfig
# Copyright (c) 2024 Microchip Technology Inc.
# SPDX-License-Identifier: Apache-2.0

config PINCTRL_MCHP_MEC5
	bool "Pin controller driver for MCHP MEC5 MCUs"
	default y
	depends on DT_HAS_MICROCHIP_MEC5_PINCTRL_ENABLED
	help
	  Enable pin controller driver for Microchip MEC5 MCUs
```

## drivers/pinctrl/Kconfig.mspm0
```kconfig
# SPDX-License-Identifier: Apache-2.0
# Copyright (c) 2024 Texas Instruments

config PINCTRL_MSPM0
	bool "TI pinctrl MSPM0 driver"
	default y
	depends on DT_HAS_TI_MSPM0_PINCTRL_ENABLED
	help
	  Enable support for the PINCTRL on TI MSPM0 series.
```

## drivers/pinctrl/Kconfig.nct
```kconfig
# NCT Pin Controller configuration options

# Copyright (c) 2024 Nuvoton Technology Corporation.
# SPDX-License-Identifier: Apache-2.0


config PINCTRL_NCT
	bool "Nuvoton NCT enhanced Super I/O (eSIO) pin controller driver"
	default y
	depends on DT_HAS_NUVOTON_NCT_PINCTRL_ENABLED
	help
	  This option enables the pin controller driver for NCT family of
	  processors.
```

## drivers/pinctrl/Kconfig.npcm
```kconfig
# NPCM Pin Controller configuration options

# Copyright (c) 2024 Nuvoton Technology Corporation.
# SPDX-License-Identifier: Apache-2.0


config PINCTRL_NPCM
	bool "Nuvoton NPCM enhanced Super I/O (eSIO) pin controller driver"
	default y
	depends on DT_HAS_NUVOTON_NPCM_PINCTRL_ENABLED
	help
		This option enables the pin controller driver for NPCM family of
		processors.
```

## drivers/pinctrl/Kconfig.npcx
```kconfig
# NPCX Pin Controller configuration options

# Copyright (c) 2022 Nuvoton Technology Corporation.
# SPDX-License-Identifier: Apache-2.0

DT_COMPAT_ST_PINCTRL_NPCX := nuvoton,npcx-pinctrl

config PINCTRL_NPCX
	bool "Nuvoton NPCX embedded controller (EC) pin controller driver"
	depends on SOC_FAMILY_NPCX
	default $(dt_compat_enabled,$(DT_COMPAT_ST_PINCTRL_NPCX))
	help
	  This option enables the pin controller driver for NPCX family of
	  processors.
```

## drivers/pinctrl/Kconfig.nrf
```kconfig
# Copyright (c) 2021 Nordic Semiconductor ASA
# SPDX-License-Identifier: Apache-2.0

config PINCTRL_NRF
	bool "nRF pin controller driver"
	default y
	depends on DT_HAS_NORDIC_NRF_PINCTRL_ENABLED
	select PINCTRL_STORE_REG
	help
	  nRF pin controller driver

config PINCTRL_NRF_CUSTOM_HOOKS
	bool "nRF pin controller custom hooks"
	depends on PINCTRL_NRF
```

## drivers/pinctrl/Kconfig.numaker
```kconfig
# Nuvoton NuMaker Pin Controller configuration options

# Copyright (c) 2023 Nuvoton Technology Corporation.
# SPDX-License-Identifier: Apache-2.0

config PINCTRL_NUMAKER
	bool "Nuvoton NuMaker pin controller driver"
	default y
	depends on DT_HAS_NUVOTON_NUMAKER_PINCTRL_ENABLED
	help
	  This option enables the pin controller driver for Nuvoton NuMaker MCUs.
```

## drivers/pinctrl/Kconfig.numicro
```kconfig
# Copyright (c) 2022 SEAL AG
# SPDX-License-Identifier: Apache-2.0

config PINCTRL_NUMICRO
	bool "Pin controller driver for Nuvoton NuMicro MCUs"
	default y
	depends on DT_HAS_NUVOTON_NUMICRO_PINCTRL_ENABLED
	help
	  Enable pin controller driver for Nuvoton NuMicro MCUs
```

## drivers/pinctrl/Kconfig.nxp_port
```kconfig
# Copyright 2022, 2024 NXP
# SPDX-License-Identifier: Apache-2.0

config PINCTRL_NXP_PORT
	bool "Pin controller driver for NXP PORT peripheral"
	default y
	depends on DT_HAS_NXP_PORT_PINMUX_ENABLED
	help
	  Enable pin controller driver for NXP PORT peripheral
```

## drivers/pinctrl/Kconfig.nxp_s32
```kconfig
# Copyright 2022 NXP
# SPDX-License-Identifier: Apache-2.0

config PINCTRL_NXP_S32
	bool "Pin controller driver for NXP S32 processors"
	default y
	depends on DT_HAS_NXP_S32ZE_PINCTRL_ENABLED
	help
	  Enable pin controller driver for NXP S32 processors.
```

## drivers/pinctrl/Kconfig.nxp_siul2
```kconfig
# Copyright 2022-2023, 2025 NXP
# SPDX-License-Identifier: Apache-2.0

config PINCTRL_NXP_SIUL2
	bool "Pin controller driver for NXP SIUL2"
	default y
	depends on DT_HAS_NXP_S32ZE_SIUL2_PINCTRL_ENABLED || DT_HAS_NXP_S32K3_SIUL2_PINCTRL_ENABLED
	help
	  Enable pin controller driver for NXP SIUL2.
```

## drivers/pinctrl/Kconfig.pic32cxsg
```kconfig
# Copyright (c) 2024, Microchip
# SPDX-License-Identifier: Apache-2.0

config PINCTRL_PIC32CXSG
	bool "Microchip PIC32CXSG pin controller driver"
	default y
	depends on DT_HAS_MICROCHIP_PIC32CXSG_PINCTRL_ENABLED
	help
	  Microchip pin controller driver is used on PIC32CXSG SoC series
```
