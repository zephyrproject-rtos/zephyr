## drivers/pinctrl/Kconfig.arm_mps2
```kconfig
# Copyright 2025 Arm Limited and/or its affiliates <open-source-office@arm.com>
# SPDX-License-Identifier: Apache-2.0


config PINCTRL_ARM_MPS2
	bool "Arm MPS2 pin controller driver"
	default y
	depends on DT_HAS_ARM_MPS2_PINCTRL_ENABLED
	help
	  Arm MPS2 pinctrl driver
```

## drivers/pinctrl/Kconfig.arm_mps3
```kconfig
# Copyright 2025 Arm Limited and/or its affiliates <open-source-office@arm.com>
# SPDX-License-Identifier: Apache-2.0

config PINCTRL_ARM_MPS3
	bool "Arm MPS3 pin controller driver"
	default y
	depends on DT_HAS_ARM_MPS3_PINCTRL_ENABLED
	help
	  Arm MPS2 pinctrl driver
```

## drivers/pinctrl/Kconfig.arm_mps4
```kconfig
# Copyright 2025 Arm Limited and/or its affiliates <open-source-office@arm.com>
# SPDX-License-Identifier: Apache-2.0

config PINCTRL_ARM_MPS4
	bool "Arm MPS4 pin controller driver"
	default y
	depends on DT_HAS_ARM_MPS4_PINCTRL_ENABLED
	help
	  Arm MPS4 pinctrl driver
```

## drivers/pinctrl/Kconfig.arm_v2m_beetle
```kconfig
# Copyright 2025 Arm Limited and/or its affiliates <open-source-office@arm.com>
# SPDX-License-Identifier: Apache-2.0

config PINCTRL_ARM_V2M_BEETLE
	bool "Arm V2M Beetle pin controller driver"
	default y
	depends on DT_HAS_ARM_V2M_BEETLE_PINCTRL_ENABLED
	help
	  Arm MPS2 V2M Beetle driver
```

## drivers/pinctrl/Kconfig.at32
```kconfig
# Copyright (c) 2021 Teslabs Engineering S.L.
# SPDX-License-Identifier: Apache-2.0

config PINCTRL_AT32
	bool "AT32 pin controller driver"
	default y
	depends on DT_HAS_ARTERY_AT32_PINCTRL_ENABLED
	help
	  AT32 pin controller driver. This driver is used by series using the
	  AF pin multiplexing model.
```

## drivers/pinctrl/Kconfig.aurix
```kconfig
# Copyright (c) 2024 Infineon Technologies AG
# SPDX-License-Identifier: Apache-2.0

config PINCTRL_TC3X
	bool "Infineon TC3x pin controller driver"
	default y
	select PINCTRL_STORE_REG
	depends on DT_HAS_INFINEON_TC3X_PINCTRL_ENABLED
	help
	  Enables Infineon TC3x pin controller driver

config PINCTRL_TC4X
	bool "Infineon TC4x pin controller driver"
	default y
	select PINCTRL_STORE_REG
	depends on DT_HAS_INFINEON_TC4X_PINCTRL_ENABLED
	help
	  Enables Infineon TC4x pin controller driver
```

## drivers/pinctrl/Kconfig.b91
```kconfig
# Copyright (c) 2022 Telink Semiconductor
# SPDX-License-Identifier: Apache-2.0

config PINCTRL_TELINK_B91
	bool "Telink B91 pin controller driver"
	default y
	depends on DT_HAS_TELINK_B91_PINCTRL_ENABLED
	help
	  Enables Telink B91 pin controller driver
```

## drivers/pinctrl/Kconfig.b9x
```kconfig
# Copyright (c) 2022-2024 Telink Semiconductor
# SPDX-License-Identifier: Apache-2.0

config PINCTRL_TELINK_B9X
	bool "Telink B9X-series pin controller driver"
	default y
	depends on DT_HAS_TELINK_B9X_PINCTRL_ENABLED
	help
		Enables Telink B9X-series pin controller driver
```

## drivers/pinctrl/Kconfig.bcm2711
```kconfig
# Copyright (c) 2025 Muhammad Waleed Badar
# SPDX-License-Identifier: Apache-2.0

config PINCTRL_BCM2711
	bool "Broadcom BCM2711 pin controller driver"
	default y
	depends on DT_HAS_BRCM_BCM2711_PINCTRL_ENABLED
	help
	  Enables Broadcom BCM2711 pin controller driver
```

## drivers/pinctrl/Kconfig.bcm2712
```kconfig
# Copyright (c) 2025 TOKITA Hiroshi
# SPDX-License-Identifier: Apache-2.0

config PINCTRL_BCM2712
	bool "Broadcom BCM2712 pin controller driver"
	default y
	depends on DT_HAS_BRCM_BCM2712_PINCTRL_ENABLED
	help
	  Enable pin controller driver for the BCM2712 SoC pinmux block.
```

## drivers/pinctrl/Kconfig.bee
```kconfig
# Copyright (c) 2026, Realtek Semiconductor Corporation
# SPDX-License-Identifier: Apache-2.0

config PINCTRL_BEE
	bool "Realtek Bee series pin controller driver"
	default y
	depends on DT_HAS_REALTEK_BEE_PINCTRL_ENABLED
	select HAL_REALTEK_BEE_PINMUX
	help
	  This option enables the pin controller driver for Realtek Bee SoCs.
```

## drivers/pinctrl/Kconfig.bflb
```kconfig
# Copyright (c) 2021-2025 Gerson Fernando Budke <nandojve@gmail.com>
#
# SPDX-License-Identifier: Apache-2.0

config PINCTRL_BFLB
	bool "Bouffalo Lab pin control driver"
	depends on DT_HAS_BFLB_PINCTRL_ENABLED
	default y
	help
	  Bouffalo Lab pin control driver
```

## drivers/pinctrl/Kconfig.cc13xx_cc26xx
```kconfig
# Copyright (c) 2022 Vaishnav Achath
# SPDX-License-Identifier: Apache-2.0

config PINCTRL_CC13XX_CC26XX
	bool "TI SimpleLink CC13xx / CC26xx pinctrl driver"
	default y
	depends on DT_HAS_TI_CC13XX_CC26XX_PINCTRL_ENABLED
	help
	  Enable the TI SimpleLink CC13xx / CC26xx pinctrl driver
```

## drivers/pinctrl/Kconfig.cc23x0
```kconfig
# Copyright (c) 2024 Texas Instruments Incorporated
# Copyright (c) 2024 BayLibre, SAS
#
# SPDX-License-Identifier: Apache-2.0

config PINCTRL_CC23X0
	bool "TI SimpleLink CC23X0 pinctrl driver"
	default y
	depends on DT_HAS_TI_CC23X0_PINCTRL_ENABLED
	help
	  Enable the TI SimpleLink CC23X0 pinctrl driver
```

## drivers/pinctrl/Kconfig.ch32v
```kconfig
# Copyright (c) 2023-2024 Chen Xingyu <hi@xingrz.me>
# SPDX-License-Identifier: Apache-2.0

config PINCTRL_CH5XX
	bool "WCH CH5xx pin controller"
	default y
	depends on DT_HAS_WCH_CH5XX_PINCTRL_ENABLED
	depends on GPIO
	help
	  Enable WCH CH5xx pin controller.
```

## drivers/pinctrl/Kconfig.dspic33
```kconfig
# Copyright (c) 2024 Microchip Technology Inc.
# SPDX-License-Identifier: Apache-2.0

config PINCTRL_MCHP_DSPIC33
	bool "Pin controller driver for Microchip dsPIC33 MCUs"
	default y
	depends on DT_HAS_MICROCHIP_DSPIC33_PINCTRL_ENABLED
	help
	  Enable the pin controller driver for Microchip dsPIC33 MCUs.
```

## drivers/pinctrl/Kconfig.em32
```kconfig
# SPDX-FileCopyrightText: 2026 ELAN Microelectronics Corp.
# SPDX-License-Identifier: Apache-2.0

# EM32F967 Pin Control configuration

config PINCTRL_EM32
	bool "EM32F967 pin control driver"
	default y
	depends on DT_HAS_ELAN_EM32_PINCTRL_ENABLED
	select SYSCON
	help
	  Enable pin control driver for EM32F967 SoC.
	  This driver provides pin multiplexing and configuration
	  support for GPIO, UART, SPI, I2C, and PWM functions.
```

## drivers/pinctrl/Kconfig.emsdp
```kconfig
# Copyright (c) 2023 Synopsys
# SPDX-License-Identifier: Apache-2.0

config PINCTRL_EMSDP
	bool "EMSDP pinmux driver"
	default y
	depends on DT_HAS_SNPS_EMSDP_PINCTRL_ENABLED
	help
	  Enable driver for the synopsys ARC EMSDP pinctrl driver
```

## drivers/pinctrl/Kconfig.ene
```kconfig
# Copyright (c) 2023 ENE Technology Inc.
# SPDX-License-Identifier: Apache-2.0

config PINCTRL_ENE_KB1200
	bool "ENE KB1200 Pin controller driver"
	default y
	depends on DT_HAS_ENE_KB1200_PINCTRL_ENABLED
	help
	  Enable pin controller driver for ENE KB1200 MCUs

config PINCTRL_ENE_KB106X
	bool "ENE KB106X Pin controller driver"
	default y
	depends on DT_HAS_ENE_KB106X_PINCTRL_ENABLED
	help
	  Enable pin controller driver for ENE KB106X MCUs

config PINCTRL_ENE_KB106X_ALT_OUTPUT_LOOKBACK
	bool "ENE KB106X Pin controller alt-output lookback"
	depends on PINCTRL_ENE_KB106X
	help
	  Enable alt-output lookback for ENE KB106X MCUs
```

## drivers/pinctrl/Kconfig.eos_s3
```kconfig
# Copyright (c) 2023 Antmicro <www.antmicro.com>
# SPDX-License-Identifier: Apache-2.0

config PINCTRL_QUICKLOGIC_EOS_S3
	bool "QuickLogic EOS S3 SoC pinctrl driver"
	default y
	depends on DT_HAS_QUICKLOGIC_EOS_S3_PINCTRL_ENABLED
	help
	  Enable driver for the QuickLogic EOS S3 SoC pinctrl driver
```

## drivers/pinctrl/Kconfig.esp32
```kconfig
# Copyright (c) 2022 Espressif Systems (Shanghai) Co., Ltd.
# SPDX-License-Identifier: Apache-2.0

config PINCTRL_ESP32
	bool "ESP32 pin controller"
	default y
	depends on DT_HAS_ESPRESSIF_ESP32_PINCTRL_ENABLED
	help
	  Enables ESP32 pin controller
```

## drivers/pinctrl/Kconfig.gd32
```kconfig
# Copyright (c) 2021 Teslabs Engineering S.L.
# SPDX-License-Identifier: Apache-2.0

config PINCTRL_GD32_AF
	bool "GD32 AF pin controller driver"
	default y
	depends on DT_HAS_GD_GD32_PINCTRL_AF_ENABLED
	help
	  GD32 AF pin controller driver. This driver is used by series using the
	  AF pin multiplexing model.

config PINCTRL_GD32_AFIO
	bool "GD32 AFIO pin controller driver"
	default y
	depends on DT_HAS_GD_GD32_PINCTRL_AFIO_ENABLED
	help
	  GD32 AFIO pin controller driver. This driver is used by series using the
	  AFIO pin multiplexing model.
```

## drivers/pinctrl/Kconfig.gecko
```kconfig
# Copyright (c) 2022 Silicon Labs
# SPDX-License-Identifier: Apache-2.0
# TODO: copyright changes?

config PINCTRL_GECKO
	bool "Gecko pin controller driver"
	default y
	depends on DT_HAS_SILABS_GECKO_PINCTRL_ENABLED
	select PINCTRL_STORE_REG
	help
	  Gecko pin controller driver
```

## drivers/pinctrl/Kconfig.hc32
```kconfig
# Copyright (c) 2026 Liu Changjie <liucj1228@outlook.com>
# SPDX-License-Identifier: Apache-2.0

config PINCTRL_HC32
	bool "XHSC HC32 pin controller driver"
	default y
	depends on DT_HAS_XHSC_HC32_PINCTRL_ENABLED
	depends on HAS_HC32_DDL
	select HC32_LL_GPIO
	help
	  Enable pin control support for XHSC HC32 SoCs.
```

## drivers/pinctrl/Kconfig.hi3861
```kconfig
# Copyright (c) 2023 Chen Xingyu <hi@xingrz.me>
# SPDX-License-Identifier: Apache-2.0

config PINCTRL_HI3861
	bool "Hi3861 IO MUX"
	default y
	depends on DT_HAS_HISILICON_HI3861_PINCTRL_ENABLED
	help
	  Enable support for Hi3861 IO MUX.
```
