## drivers/amp/Kconfig
```kconfig
# SPDX-FileCopyrightText: Copyright The Zephyr Project Contributors
# SPDX-FileCopyrightText: Copyright (c) 2026 Siemens Mobility GmbH
# SPDX-License-Identifier: Apache-2.0

#
# AMP options
#
menuconfig AMP
	bool "Asynchronous Multiprocessing drivers"

if AMP

module = AMP
module-str = AMP
source "subsys/logging/Kconfig.template.log_config"

# TODO: Find a good default init priority
config AMP_INIT_PRIORITY
	int "AMP init priority"
	default KERNEL_INIT_PRIORITY_DEFAULT
	help
	  AMP driver device initialization priority.

config AMP_IDENTIFICATION_INCLUDES_CLUSTER_NUMBER
	bool "AMP core identification includes a cluster number"
	default n

config AMP_IDENTIFICATION_INCLUDES_CLUSTER_TYPE
	bool "AMP core identificaiton includes a cluster type"
	default n

source "drivers/amp/Kconfig.openamp_ops"

# zephyr-keep-sorted-start
source "drivers/amp/Kconfig.ti_k3"
# zephyr-keep-sorted-stop

endif # AMP
```

## drivers/amp/Kconfig.openamp_ops
```kconfig
# SPDX-FileCopyrightText: Copyright The Zephyr Project Contributors
# SPDX-FileCopyrightText: Copyright (c) 2026 Siemens Mobility GmbH
# SPDX-License-Identifier: Apache-2.0

#
# AMP options
#
menuconfig AMP_OPENAMP_OPS
	bool "Provide OpenAMP operations"

if AMP_OPENAMP_OPS

module = AMP_OPENAMP_OPS
module-str = AMP_OPENAMP_OPS
source "subsys/logging/Kconfig.template.log_config"

config AMP_OPENAMP_OPS_PROVIDE_REMOTEPROC
	bool "Provide a OpenAMP remoteproc_ops struct that use the Zephyr API"
	depends on OPENAMP
	default n

# All storage_ops are to be used from remoteproc_load which needs remoteproc_ops
if AMP_OPENAMP_OPS_PROVIDE_REMOTEPROC

config AMP_OPENAMP_OPS_PROVIDE_STORAGE_OPS_LOCK_TIMEOUT
	int "Maximum amount to wait to acquire the Mutex for global storage option data (ms)"
	default 1000
	help
	  The memory operations require a small amount of global data that is
	  protected by a mutex. It is acquired in open and released in close. This
	  options says how long it is allowed to wait to wait to acquire it in open
	  in milliseconds

config AMP_OPENAMP_OPS_PROVIDE_STORAGE_OPS_MEMCPY
	bool "Provide a OpenAMP storage_ops struct that uses memcpy for an ELF in addressable memory"
	default n

endif # AMP_OPENAMP_OPS_PROVIDE_REMOTEPROC

config HEAP_MEM_POOL_ADD_SIZE_AMPO_PENAMP_OPS
	int "Heap memory pool size for provided OpenAMP operations"
	default 2048
	depends on AMP_OPENAMP_OPS_PROVIDE_STORAGE_OPS_MEMCPY
	help
	  Used inside of upstream OpenAMP to hold data while parsing ELF files

# zephyr-keep-sorted-start
source "drivers/amp/Kconfig.ti_k3"
# zephyr-keep-sorted-stop

endif # AMP
```

## drivers/amp/Kconfig.ti_k3
```kconfig
# SPDX-FileCopyrightText: Copyright The Zephyr Project Contributors
# SPDX-FileCopyrightText: Copyright (c) 2026 Siemens Mobility GmbH
# SPDX-License-Identifier: Apache-2.0

config AMP_TI_K3
	bool "TI K3 AMP Driver"
	default y
	depends on DT_HAS_TI_AMP_K3_ENABLED
	depends on TISCI
	imply POWER_DOMAIN
	imply PM_DEVICE
	imply PM_DEVICE_RUNTIME
	select AMP_IDENTIFICATION_INCLUDES_CLUSTER_NUMBER
	select AMP_IDENTIFICATION_INCLUDES_CLUSTER_TYPE
```

## drivers/audio/Kconfig.cs35l56
```kconfig
# Copyright (c) 2026 Cirrus Logic, Inc.
# SPDX-License-Identifier: Apache-2.0

menuconfig AUDIO_CODEC_CS35L56
	bool "Cirrus Logic CS35L56 codec support"
	default y
	depends on DT_HAS_CIRRUS_CS35L56_ENABLED || \
				DT_HAS_CIRRUS_CS35L57_ENABLED
	select GPIO
	select REGULATOR
	help
	  Enable driver for CS35L56 family of smart amplifiers

if AUDIO_CODEC_CS35L56

config AUDIO_CODEC_CS35L56_RESET
	def_bool $(dt_compat_any_has_prop,$(DT_COMPAT_CIRRUS_CS35L56),reset-gpios) || \
			$(dt_compat_any_has_prop,$(DT_COMPAT_CIRRUS_CS35L57),reset-gpios)
	select GPIO

config AUDIO_CODEC_CS35L56_REGULATOR
	def_bool $(dt_compat_any_has_prop,$(DT_COMPAT_CIRRUS_CS35L56),vdd-p-supply) || \
			$(dt_compat_any_has_prop,$(DT_COMPAT_CIRRUS_CS35L57),vdd-p-supply) || \
			$(dt_compat_any_has_prop,$(DT_COMPAT_CIRRUS_CS35L56),vdd-io-supply) || \
			$(dt_compat_any_has_prop,$(DT_COMPAT_CIRRUS_CS35L57),vdd-io-supply) || \
			$(dt_compat_any_has_prop,$(DT_COMPAT_CIRRUS_CS35L56),vdd-a-supply) || \
			$(dt_compat_any_has_prop,$(DT_COMPAT_CIRRUS_CS35L57),vdd-a-supply) || \
			$(dt_compat_any_has_prop,$(DT_COMPAT_CIRRUS_CS35L56),vdd-b-supply) || \
			$(dt_compat_any_has_prop,$(DT_COMPAT_CIRRUS_CS35L57),vdd-b-supply) || \
			$(dt_compat_any_has_prop,$(DT_COMPAT_CIRRUS_CS35L56),vdd-amp-supply) || \
			$(dt_compat_any_has_prop,$(DT_COMPAT_CIRRUS_CS35L57),vdd-amp-supply)
	select REGULATOR

endif # AUDIO_CODEC_CS35L56
```

## drivers/audio/Kconfig.cs35l5x
```kconfig
# Copyright (c) 2026 Cirrus Logic, Inc.
# SPDX-License-Identifier: Apache-2.0

menuconfig AUDIO_CODEC_CS35L5X
	bool "Cirrus Logic CS35L5X codec support"
	default y
	depends on DT_HAS_CIRRUS_CS35L56_ENABLED || \
				DT_HAS_CIRRUS_CS35L57_ENABLED
	help
	  Enable driver for CS35L5X family of smart amplifiers

if AUDIO_CODEC_CS35L5X

config AUDIO_CODEC_CS35L5X_RESET
	def_bool $(dt_compat_any_has_prop,$(DT_COMPAT_CIRRUS_CS35L56),reset-gpios) || \
			$(dt_compat_any_has_prop,$(DT_COMPAT_CIRRUS_CS35L57),reset-gpios)
	select GPIO

config AUDIO_CODEC_CS35L5X_REGULATOR
	def_bool $(dt_compat_any_has_prop,$(DT_COMPAT_CIRRUS_CS35L56),vdd-p-supply) || \
			$(dt_compat_any_has_prop,$(DT_COMPAT_CIRRUS_CS35L57),vdd-p-supply) || \
			$(dt_compat_any_has_prop,$(DT_COMPAT_CIRRUS_CS35L56),vdd-io-supply) || \
			$(dt_compat_any_has_prop,$(DT_COMPAT_CIRRUS_CS35L57),vdd-io-supply) || \
			$(dt_compat_any_has_prop,$(DT_COMPAT_CIRRUS_CS35L56),vdd-a-supply) || \
			$(dt_compat_any_has_prop,$(DT_COMPAT_CIRRUS_CS35L57),vdd-a-supply) || \
			$(dt_compat_any_has_prop,$(DT_COMPAT_CIRRUS_CS35L56),vdd-b-supply) || \
			$(dt_compat_any_has_prop,$(DT_COMPAT_CIRRUS_CS35L57),vdd-b-supply) || \
			$(dt_compat_any_has_prop,$(DT_COMPAT_CIRRUS_CS35L56),vdd-amp-supply) || \
			$(dt_compat_any_has_prop,$(DT_COMPAT_CIRRUS_CS35L57),vdd-amp-supply)
	select REGULATOR

config AUDIO_CODEC_CS35L5X_INIT_PRIORITY
	int "CS35L5X audio codec init priority"
	default 60
	help
	  Init priority for the CS35L5X audio codec driver. It must be
	  greater than the init priority for the bound regulator init
	  priority.

endif # AUDIO_CODEC_CS35L5X
```

## drivers/audio/Kconfig.cs35lxx
```kconfig
# Copyright (c) 2026 Cirrus Logic, Inc.
# SPDX-License-Identifier: Apache-2.0

config AUDIO_CODEC_CS35LXX
	def_bool DT_HAS_CIRRUS_CS35L56_ENABLED || \
		DT_HAS_CIRRUS_CS35L57_ENABLED

if AUDIO_CODEC_CS35LXX

config AUDIO_CODEC_CS35LXX_I2C
	def_bool $(dt_compat_on_bus,$(DT_COMPAT_CIRRUS_CS35L56),i2c) || \
		$(dt_compat_on_bus,$(DT_COMPAT_CIRRUS_CS35L57),i2c)
	select I2C

config AUDIO_CODEC_CS35LXX_SPI
	def_bool $(dt_compat_on_bus,$(DT_COMPAT_CIRRUS_CS35L56),spi) || \
		$(dt_compat_on_bus,$(DT_COMPAT_CIRRUS_CS35L57),spi)
	select SPI

endif # AUDIO_CODEC_CS35LXX
```

## drivers/audio/Kconfig.cs42l51
```kconfig
# Copyright (c) 2026 ZAL Zentrum für Angewandte Luftfahrtforschung GmbH
# SPDX-License-Identifier: Apache-2.0

config AUDIO_CODEC_CS42L51
	bool "Cirrus CS42L51 driver"
	default y
	select I2C
	select GPIO
	depends on DT_HAS_CIRRUS_CS42L51_ENABLED
	help
	  Enable the driver for the Cirrus CS42L51 low power stereo
	  audio codec with headphone driver.
```

## drivers/audio/Kconfig.cs47l63
```kconfig
# SPDX-FileCopyrightText: Copyright The Zephyr Project Contributors
# SPDX-License-Identifier: Apache-2.0

config AUDIO_CODEC_CS47L63
	bool "CS47L63 audio codec [EXPERIMENTAL]"
	default y
	depends on DT_HAS_CIRRUS_CS47L63_ENABLED
	select EXPERIMENTAL
	select SPI
	select GPIO
	help
	  Cirrus Logic CS47L63 low-power audio codec. SPI control, I2S audio
	  on ASP1 or ASP2 (cirrus,asp), headphone output, analog line input
	  and PDM microphone, through the audio_codec API. The on-chip DSP
	  cores and their loadable firmware are not supported.

config AUDIO_CODEC_CS47L63_GPIO
	bool "CS47L63 GPIO pin access"
	default y
	depends on AUDIO_CODEC_CS47L63 && DT_HAS_CIRRUS_CS47L63_GPIO_ENABLED
	help
	  Pin access for the CS47L63 GPIO controller child node: a pin set
	  up through it is written again each time the audio driver resets
	  the part. An output is released from the reset until that write,
	  held only by the pin's bus keeper.
```

## drivers/audio/Kconfig.dac_audio_sam
```kconfig
# SPDX-FileCopyrightText: Copyright (c) 2026 Ugo Marchand
# SPDX-License-Identifier: Apache-2.0

menuconfig AUDIO_CODEC_DAC_SAM
	bool "Atmel SAM DAC audio playback driver"
	default y
	depends on DT_HAS_ATMEL_SAM_DAC_AUDIO_ENABLED
	depends on SOC_SERIES_SAMX7X
	select CACHE_MANAGEMENT if DCACHE
	select DAC
	select DMA
	help
	  Enable PCM audio playback on an Atmel SAM DACC channel, paced by a
	  Timer Counter channel and fed by the DMA.

config AUDIO_CODEC_DAC_SAM_MAX_BLOCK_SIZE
	int "Maximum PCM block size in bytes"
	depends on AUDIO_CODEC_DAC_SAM
	default 512
	range 2 32766
	help
	  Size of the largest block the driver accepts, in bytes. The driver
	  statically allocates two buffers of this size per instance, so the
	  cost in RAM is twice this value. Must be even, since one sample is
	  two bytes.
```

## drivers/audio/Kconfig.dac_stm32
```kconfig
# Copyright (c) 2026 Draeger
# SPDX-License-Identifier: Apache-2.0

config AUDIO_DAC_STM32
	bool "STM32 DAC audio playback driver (timer-triggered DMA)"
	default y
	depends on DT_HAS_ST_STM32_DAC_AUDIO_ENABLED
	select DAC
	select COUNTER
	select DMA
	help
	  Enable audio playback through an STM32 on-chip DAC channel.

config AUDIO_DAC_STM32_MAX_BLOCK_SIZE
	int "STM32 DAC audio maximum block size in bytes"
	default 512
	range 2 32766
	help
	  The driver is using double buffering: the buffer holds two blocks,
	  so the RAM cost per instance is twice this value.
```

## drivers/audio/Kconfig.dmic_mcux_pdm
```kconfig
# Copyright 2025 NXP
# SPDX-License-Identifier: Apache-2.0

config AUDIO_DMIC_MCUX_PDM
	bool "NXP MICFIL PDM DMA-driven DMIC driver"
	default y
	depends on DT_HAS_NXP_DMIC_PDM_ENABLED
	select DMA
	select PINCTRL
	help
	  Enable the DMA-driven capture driver for the NXP PDM Microphone
	  Interface (MICFIL), written against the fsl_pdm.h HAL. It implements
	  the Zephyr dmic API with arbitrary logical-to-hardware channel maps by
	  fanning the single MICFIL DMA request out to one eDMA channel per
	  captured channel, chained together with the eDMA minor link.

if AUDIO_DMIC_MCUX_PDM

config AUDIO_DMIC_MCUX_PDM_QUEUE_SIZE
	int "Number of RX buffers that can be queued"
	default 8
	help
	  Depth of the message queue that holds completed capture blocks until
	  the application reads them. Each queued entry is one memory-slab block.

endif # AUDIO_DMIC_MCUX_PDM
```

## drivers/audio/Kconfig.dmic_pdm_nrfx
```kconfig
# Copyright (c) 2021 Nordic Semiconductor ASA
# SPDX-License-Identifier: Apache-2.0

config AUDIO_DMIC_NRFX_PDM
	bool "nRF PDM nrfx driver"
	default y
	depends on DT_HAS_NORDIC_NRF_PDM_ENABLED
	select NRFX_PDM
	select PINCTRL
	help
	  Enable support for nrfx PDM driver for nRF MCU series.

if AUDIO_DMIC_NRFX_PDM

config AUDIO_DMIC_NRFX_PDM_CUSTOM_RATIO
	bool "Use custom decimation ratio mechanism."
	help
	  By default, PDM uses enumerated decimation ratio values.
	  Provided that its supported by hardware, PDM can use
	  custom ratio values which allow wider selection range,
	  which comes with cost of longer configuration.

endif # AUDIO_DMIC_NRFX_PDM
```

## drivers/audio/Kconfig.dmic_renesas_ra
```kconfig
# Copyright The Zephyr Project Contributors
# SPDX-License-Identifier: Apache-2.0

config AUDIO_DMIC_RENESAS_RA
	bool "Renesas RA PDM driver"
	default y
	depends on DT_HAS_RENESAS_RA_PDM_ENABLED
	select PINCTRL
	select USE_RA_FSP_PDM
	help
	  Enable the digital microphone driver for the Renesas RA PDM interface.

if AUDIO_DMIC_RENESAS_RA

config AUDIO_DMIC_RENESAS_RA_FIFO_BUFFER_SAMPLES
	int "Samples in the per-channel FIFO buffer"
	default 1024
	range 32 65536
	help
	  Size, in 32-bit samples, of the buffer the PDM interface fills for each channel. It
	  has to hold at least two PCM blocks, since one is copied out while the next fills, so
	  the largest usable block is half of this.

config AUDIO_DMIC_RENESAS_RA_QUEUE_SIZE
	int "Number of queued PCM blocks"
	default 4
	range 2 16
	help
	  Number of captured blocks the driver queues before dmic_read() has to consume them.

endif # AUDIO_DMIC_RENESAS_RA
```

## drivers/audio/Kconfig.dmic_renesas_ra_pdm
```kconfig
# Copyright The Zephyr Project Contributors
# SPDX-License-Identifier: Apache-2.0

config AUDIO_DMIC_RENESAS_RA_PDM
	bool "Renesas RA PDM-IF digital microphone driver"
	default y
	depends on DT_HAS_RENESAS_RA_PDM_ENABLED
	select USE_RA_FSP_PDM
	select PINCTRL
	help
	  Enable the digital microphone driver for the Renesas RA Pulse Density
	  Modulation Interface.

if AUDIO_DMIC_RENESAS_RA_PDM

config AUDIO_DMIC_RENESAS_RA_PDM_BLOCK_SAMPLES
	int "Largest capture block (samples)"
	default 512
	range 8 4096
	help
	  Longest block, in samples, that dmic_configure() may ask for. Each
	  channel keeps two blocks of this size, four bytes per sample, for the
	  interface to fill while the completed one is converted.

config AUDIO_DMIC_RENESAS_RA_PDM_BLOCK_COUNT
	int "Capture blocks queued to the application"
	default 4
	range 2 32
	help
	  Depth of the queue holding converted blocks waiting for dmic_read().
	  Blocks are dropped once it fills, so it has to cover the longest the
	  reader can be held off.

endif # AUDIO_DMIC_RENESAS_RA_PDM
```

## drivers/audio/Kconfig.dmic_rp2040_pio
```kconfig
# Copyright (c) Arduino s.r.l. and/or its affiliated companies
# SPDX-License-Identifier: Apache-2.0

config AUDIO_DMIC_RPI_PICO_PIO
	bool "RP2040 PIO-based PDM DMIC driver"
	default y
	depends on DT_HAS_RASPBERRYPI_RP2040_PDM_ENABLED
	select PICOSDK_USE_PIO
	select PICOSDK_USE_DMA
	help
	  Enable the RP2040 PIO + DMA PDM capture driver. Uses a PIO state
	  machine to generate the PDM clock and sample data, DMA to transfer
	  raw bits to a buffer, and the ST OpenPDM filter to decimate to PCM.
```

## drivers/audio/Kconfig.es7210
```kconfig
# SPDX-FileCopyrightText: Copyright The Zephyr Project Contributors
# SPDX-License-Identifier: Apache-2.0

config AUDIO_CODEC_ES7210
	bool "Everest Semiconductor ES7210 ADC"
	default y
	depends on DT_HAS_EVEREST_ES7210_ENABLED
	select I2C
	help
	  Enable the ES7210 microphone ADC with I2C control and I2S output.
```
