## drivers/audio/Kconfig.es8311
```kconfig
# Copyright (c) 2026 Hsiu-Chi Tsai
# SPDX-License-Identifier: Apache-2.0

config AUDIO_CODEC_ES8311
	bool "Everest Semiconductor ES8311 audio codec"
	default y
	depends on DT_HAS_EVEREST_ES8311_ENABLED
	select I2C
	help
	  Enable the ES8311 mono ADC/DAC with I2C control and standard I2S:
	  two 16-bit slots, MSB first, normal clock polarity. The codec must
	  receive continuous bit and frame clocks from the I2S controller.

	  Set audio_codec_cfg.mclk_freq to the external MCLK frequency at
	  256 times the sample rate. Supported rates are 8000, 11025, 12000,
	  16000, 22050, 24000, 32000, 44100 and 48000 Hz. Zero selects BCLK
	  multiplication, limited to 32000, 44100 and 48000 Hz by the 1 MHz
	  multiplier-input minimum for 3.3 V operation.

	  Input and output volume use whole dB, clamped to -95 through +32 dB.
	  Capture uses differential MIC1, a DT-selected PGA gain and a fixed
	  +24 dB digital scale before input volume. Output uses headphone mode.

	  Configuration leaves both directions muted. Start the I2S transport
	  before audio_codec_start(); a stopped direction applies its cached
	  volume and mute on start. Use audio_codec_apply_properties() for
	  running directions. A failed property unmute stops each direction
	  rolled back to mute; call audio_codec_start() to retry.

	  Check audio_codec_stop() before stopping I2S clocks. The application
	  manages regulators, clocks and external amplifiers; device PM is not
	  implemented. Supplies must be available before initialization, or use
	  zephyr,deferred-init and device_init() after enabling them. Muting
	  cannot be guaranteed when I2C fails; validate analog settling and
	  power transitions on the board.
```

## drivers/audio/Kconfig.max98357a
```kconfig
# SPDX-FileCopyrightText: 2026 Muhammad Waleed Badar
# SPDX-License-Identifier: Apache-2.0

config AUDIO_CODEC_MAX98357A
	bool "MAX98357A class D amplifier driver"
	default y
	depends on DT_HAS_MAXIM_MAX98357A_ENABLED
	select I2S
	select GPIO if $(dt_compat_any_has_prop,$(DT_COMPAT_MAXIM_MAX98357A),sdmode-gpios)
	help
	  Enable the driver for the Maxim MAX98357A PCM input class D mono
	  amplifier. The amplifier has no control bus; the driver validates the
	  I2S configuration and drives the SD_MODE pin when it is wired to a
	  GPIO.
```

## drivers/audio/Kconfig.nau8540
```kconfig
# Copyright (c) 2026 RAKwireless Technology Limited
# SPDX-License-Identifier: Apache-2.0

config AUDIO_CODEC_NAU8540
	bool "NAU8540 Audio Codec driver"
	default y
	select I2C
	select GPIO if $(dt_compat_any_has_prop,$(DT_COMPAT_NUVOTON_NAU8540),csb-gpios)
	depends on DT_HAS_NUVOTON_NAU8540_ENABLED
	help
	  Enable the I2C control driver for the Nuvoton NAU85L40 / NAU85L40B
	  analog microphone ADC. PCM audio is produced on I2S.
```

## drivers/audio/Kconfig.nau88c10
```kconfig
# SPDX-FileCopyrightText: Copyright The Zephyr Project Contributors
#
# SPDX-License-Identifier: Apache-2.0

config AUDIO_CODEC_NAU88C10
	bool "Nuvoton NAU88C10 driver"
	default y
	depends on DT_HAS_NUVOTON_NAU88C10_ENABLED
	select I2C
	help
	  Enable the driver for the Nuvoton NAU88C10 mono audio codec, a wideband
	  voice codec with a microphone preamplifier, a speaker driver and a mono
	  line output.
```

## drivers/audio/Kconfig.tas2560
```kconfig
# Copyright (c) 2026 RAKwireless Technology Limited
# SPDX-License-Identifier: Apache-2.0

config AUDIO_TAS2560
	bool "TAS2560 audio amplifier support"
	default y
	depends on DT_HAS_TI_TAS2560_ENABLED
	select I2C
	help
	  Enable the TAS2560 Class-D amplifier. Playback is I2S with the PLL
	  set to 1024 times the sample rate.
```

## drivers/audio/Kconfig.tlv320aic3104
```kconfig
# SPDX-FileCopyrightText: Copyright (c) 2026 DevItWise
# SPDX-FileCopyrightText: Copyright The Zephyr Project Contributors
# SPDX-License-Identifier: Apache-2.0

config AUDIO_TLV320AIC3104
	bool "TLV320AIC3104 audio codec"
	default y
	depends on DT_HAS_TI_TLV320AIC3104_ENABLED
	select I2C
	select GPIO
	help
	  Texas Instruments TLV320AIC3104 low-power stereo audio codec.
	  I2C control, supports volume and mute via the audio_codec API.
```

## drivers/auxdisplay/Kconfig.mspm0_lcd
```kconfig
# Copyright (c) 2025 Texas Instruments
# SPDX-License-Identifier: Apache-2.0

config AUXDISPLAY_MSPM0_LCD
	bool "TI MSPM0 LCD controller"
	default y
	depends on DT_HAS_TI_MSPM0_LCD_ENABLED
	select PINCTRL
	help
	  Enable support for the TI MSPM0 LCD segment display controller.
```

## drivers/auxdisplay/Kconfig.st_slcd
```kconfig
# Copyright 2026 Renato Mauro
# SPDX-License-Identifier: Apache-2.0

config AUXDISPLAY_ST_SLCD
	bool "ST SLCD display driver"
	default y
	depends on DT_HAS_ST_SLCD_ENABLED
	select RTC
	select PINCTRL
	select USE_STM32_HAL_LCD
	help
	  Enable STMicroelectronics SLCD (Segmented LCD) auxdisplay driver.
	  Provides the standard auxdisplay API for ST SLCD hardware,
	  handling both hardware initialization and the display panel layer
	  in a single unified driver.
```

## drivers/auxdisplay/Kconfig.tm1650
```kconfig
# SPDX-License-Identifier: Apache-2.0
# Copyright (c) 2026 Smile

config AUXDISPLAY_TM1650
	bool "Titan Micro TM1650 7-segment display support"
	default y
	depends on DT_HAS_TITANMEC_TM1650_ENABLED
	select I2C if $(dt_compat_on_bus,$(DT_COMPAT_TITANMEC_TM1650),i2c)
	select GPIO if $(dt_compat_any_has_prop,$(DT_COMPAT_TITANMEC_TM1650),clk-gpios)
	help
	  Enable driver for TM (Shenzhen Titan Micro Elec) TM1650 7-segment LED display.
	  This driver supports 4-digit 7-segment displays commonly found in clock modules
	  and simple numeric displays.

	  The TM1650 uses an I2C compatible two-wire serial interface (CLK and DIO) and can control
	  up to 4 digits with brightness control.

	  This driver implements the auxdisplay API, allowing generic display usage, and allows
	  controling the device using GPIOs or an I2C interface.
```
