## drivers/i2c/Kconfig.it8xxx2
```kconfig
# Copyright (c) 2020 ITE Corporation. All Rights Reserved.
# SPDX-License-Identifier: Apache-2.0

DT_COMPAT_ITE_IT8XXX2_I2C := ite,it8xxx2-i2c
DT_COMPAT_ITE_ENHANCE_I2C := ite,enhance-i2c

config I2C_ITE_IT8XXX2
	bool "ITE IT8XXX2 I2C driver"
	depends on SOC_IT8XXX2
	default $(dt_compat_enabled,$(DT_COMPAT_ITE_IT8XXX2_I2C))
	help
	  Enable I2C support on it8xxx2_evb.
	  Supported Speeds: 100kHz, 400kHz and 1MHz.
	  This driver supports repeated start.

config I2C_ITE_ENHANCE
	bool "ITE IT8XXX2 I2C enhance driver"
	depends on SOC_IT8XXX2
	default $(dt_compat_enabled,$(DT_COMPAT_ITE_ENHANCE_I2C))
	help
	  This option can enable the enhance I2C
	  of IT8XXX2 and support three channels.

if I2C_ITE_ENHANCE

config I2C_IT8XXX2_CQ_MODE
	bool "IT8XXX2 I2C command queue mode"
	default y
	select SOC_IT8XXX2_CPU_IDLE_GATING
	help
	  This is an option to enable command queue mode which can
	  reduce the time between each byte to improve the I2C bus
	  clock stretching during I2C transaction.
	  I2C command queue mode of it8xxx2 can support I2C APIs
	  including: i2c_write(), i2c_read(), i2c_burst_read.

config I2C_CQ_MODE_MAX_PAYLOAD_SIZE
	int "It is allowed to configure the size up to 2K bytes."
	range 32 2048
	default 64
	help
	  This is the command queue mode payload size which size
	  up to 2k bytes.

endif # I2C_ITE_ENHANCE
```

## drivers/i2c/Kconfig.kb1200
```kconfig
# ENE I2C configuration options

# Copyright (c) 2023 ENE Technology

config I2C_KB1200
	bool "KB1200 I2C driver"
	depends on SOC_ENE_KB1200
	help
	  Enable the ENE KB1200 I2C driver.
```

## drivers/i2c/Kconfig.litex
```kconfig
# Copyright (c) 2019 Antmicro <www.antmicro.com>
# SPDX-License-Identifier: Apache-2.0

config I2C_LITEX
	bool "LiteX I2C driver"
	default y
	depends on DT_HAS_LITEX_I2C_ENABLED
	select I2C_BITBANG
	help
	  Enable support for Litex I2C driver

config I2C_LITEX_LITEI2C
	bool "LiteX LiteI2C I2C driver"
	default y
	depends on DT_HAS_LITEX_LITEI2C_ENABLED
	help
	  Enable support for Litex I2C driver
```

## drivers/i2c/Kconfig.lpc11u6x
```kconfig
# Copyright (c) 2020 Seagate Technology LLC
# SPDX-License-Identifier: Apache-2.0

config I2C_LPC11U6X
	bool "LPC11U6X I2C driver"
	default y
	depends on DT_HAS_NXP_LPC11U6X_I2C_ENABLED
	help
	  Enable I2C support on the LPC11U6X SoCs
```

## drivers/i2c/Kconfig.max32
```kconfig
# Copyright (c) 2024 Analog Devices, Inc.
# SPDX-License-Identifier: Apache-2.0

menuconfig I2C_MAX32
	bool "Analog Devices MAX32 I2C driver"
	default y
	depends on DT_HAS_ADI_MAX32_I2C_ENABLED
	help
	  i2c driver for max32 family.

if I2C_MAX32

config I2C_MAX32_INTERRUPT
	bool "Interrupt support for MAX32 I2C driver"
	default y
	help
	  Enable interrupt support for MAX32 I2C controller mode
	  transfers.

endif # I2C_MAX32
```

## drivers/i2c/Kconfig.mchp
```kconfig
# Copyright (c) 2025-2026 Microchip Technology Inc.
# SPDX-License-Identifier: Apache-2.0

config I2C_MCHP_SERCOM
	bool
	help
	  Common options for Microchip I2C SERCOM drivers.

config I2C_MCHP_SERCOM_G1
	bool
	default y
	depends on DT_HAS_MICROCHIP_SERCOM_G1_I2C_ENABLED
	select PINCTRL
	select I2C_MCHP_SERCOM
	help
	  Enable support for Microchip SERCOM I2C g1 driver.

if I2C_MCHP_SERCOM

config I2C_MCHP_DMA_DRIVEN
	bool
	default y
	depends on DMA
	depends on $(dt_compat_all_has_prop,$(DT_COMPAT_MICROCHIP_SERCOM_G1_I2C),dmas)
	help
	  This enables DMA driven transfers for the I2C peripheral.
	  Requires DMA controller and dmas property in device tree.
	  It can be used in blocking and non-blocking modes.

config I2C_MCHP_TRANSFER_TIMEOUT
	int "Microchip Transfer timeout [ms]"
	default 500
	help
	  Timeout in milliseconds used for each I2C transfer.
	  0 means that the driver should use the K_FOREVER value,
	  i.e. it should wait as long as necessary.

endif # I2C_MCHP_SERCOM
```

## drivers/i2c/Kconfig.mchp_mss
```kconfig
# Microchip PolarFire SoC Icicle Kit I2C configuration options

# Copyright (c) 2023 Microchip Technology Inc.
# SPDX-License-Identifier: Apache-2.0

config I2C_MCHP_MSS
	bool "Microchip PolarFire SoC I2C driver"
	default y
	depends on DT_HAS_MICROCHIP_MPFS_I2C_ENABLED
	help
	  Enable PolarFire SoC Icicle Kit I2C driver.
```

## drivers/i2c/Kconfig.mcux
```kconfig
# I2C configuration options

# Copyright (c) 2024, NXP
# SPDX-License-Identifier: Apache-2.0

menuconfig I2C_MCUX_FLEXCOMM
	bool "MCUX FLEXCOMM I2C driver"
	default y
	depends on DT_HAS_NXP_LPC_I2C_ENABLED
	select PINCTRL
	select RESET
	select I2C_TRANSFER_TIMEOUT_SUPPORTED
	help
	  Enable the mcux flexcomm i2c driver.

config I2C_MCUX_FLEXCOMM_BUS_RECOVERY
	bool "Bus recovery support"
	depends on I2C_MCUX_FLEXCOMM && PINCTRL
	select I2C_BITBANG
	help
	  Enable flexcomm i2c driver bus recovery support via GPIO bitbanging.
```

## drivers/i2c/Kconfig.mcux_lpi2c
```kconfig
# MCUX LPI2C I2C
#
# Copyright (c) 2024 Meta
# Copyright (c) 2024 NXP
#
# SPDX-License-Identifier: Apache-2.0
#

config I2C_MCUX_LPI2C_ENABLED
	bool
	default y
	depends on DT_HAS_NXP_IMX_LPI2C_ENABLED
	select HAS_I2C_RTIO

choice
	prompt "MCUX LPI2C driver implementation"
	depends on I2C_MCUX_LPI2C_ENABLED
	default I2C_MCUX_LPI2C if !I2C_RTIO
	default I2C_MCUX_LPI2C_RTIO if I2C_RTIO

config I2C_MCUX_LPI2C
	bool "MCUX LPI2C driver"
	depends on CLOCK_CONTROL
	select PINCTRL
	help
	  Enable the mcux LPI2C driver.

config I2C_MCUX_LPI2C_RTIO
	bool "MCUX LPI2C driver with RTIO"
	depends on I2C_RTIO
	depends on CLOCK_CONTROL
	select PINCTRL
	help
	  Enable the mcux LPI2C driver with rtio interface.

endchoice

if I2C_MCUX_LPI2C || I2C_MCUX_LPI2C_RTIO

config I2C_MCUX_LPI2C_BUS_RECOVERY
	bool "Bus recovery support"
	select I2C_BITBANG
	help
	  Enable LPI2C driver bus recovery support via GPIO bitbanging.

endif # I2C_MCUX_LPI2C || I2C_MCUX_LPI2C_RTIO
```

## drivers/i2c/Kconfig.mec5
```kconfig
# Microchip MEC5 I2C configuration options

# Copyright (c) 2024 Microchip Technology Inc.
# SPDX-License-Identifier: Apache-2.0

config I2C_MCHP_MEC5
	bool "Microchip MEC5 family I2C driver"
	default y
	depends on DT_HAS_MICROCHIP_MEC5_I2C_ENABLED
	help
	  Enable the Microchip MEC5 family I2C driver.
```

## drivers/i2c/Kconfig.nct
```kconfig
# NCT I2C driver configuration options

# Copyright (c) 2025 Nuvoton Technology Corporation.
# SPDX-License-Identifier: Apache-2.0

config I2C_NCT
	bool "Nuvoton NCT I2C driver"
	default y
	depends on DT_HAS_NUVOTON_NCT_I2C_ENABLED
	help
	  This option enables the I2C driver for NCT family of
	  processors.
	  Say y to use I2C modules on NCT MCU.
```

## drivers/i2c/Kconfig.npcm
```kconfig
# NPCM I2C driver configuration options

# Copyright (c) 2024 Nuvoton Technology Corporation.
# SPDX-License-Identifier: Apache-2.0

config I2C_NPCM
	bool "Nuvoton NPCM I2C driver"
	default y
	depends on DT_HAS_NUVOTON_NPCM_I2C_ENABLED
	help
	  This option enables the I2C driver for NPCM family of
	  processors.
	  Say y to use I2C modules on NPCM MCU.
```

## drivers/i2c/Kconfig.npcx
```kconfig
# NPCX I2C driver configuration options

# Copyright (c) 2020 Nuvoton Technology Corporation.
# SPDX-License-Identifier: Apache-2.0

config I2C_NPCX
	bool "Nuvoton NPCX embedded controller (EC) I2C driver"
	default y
	depends on DT_HAS_NUVOTON_NPCX_I2C_PORT_ENABLED
	select PINCTRL
	help
	  This option enables the I2C driver for NPCX family of
	  processors.
	  Say y if you wish to use I2C modules on NPCX MCU.

config I2C_NPCX_PORT_INIT_PRIORITY
	int "NPCX I2C port init priority"
	default 51
	depends on I2C_NPCX
	help
	  Initialization priority for the I2C port on an NPCX device, must be
	  set to a lower priority than the controller one (I2C_INIT_PRIORITY).

config I2C_NPCX_FIFO_DRIVEN
	bool
	default y
	depends on $(dt_compat_any_has_prop,$(DT_COMPAT_NUVOTON_NPCX_I2C_CTRL),dma-driven,False)
	depends on I2C_NPCX
	help
	  For I2C peripherals that support FIFO mode, data transfers shall be performed
	  using FIFO‑driven transactions.

config I2C_NPCX_DMA_DRIVEN
	bool
	default y
	depends on $(dt_compat_any_has_prop,$(DT_COMPAT_NUVOTON_NPCX_I2C_CTRL),dma-driven,True)
	depends on I2C_NPCX
	help
	  For I2C peripherals that support DMA mode, data transfers shall be performed
	  using DMA‑driven transactions.

config I2C_NPCX_INVALID_STOP_WORKAROUND
	bool
	default y
	depends on NPCX_SOC_VARIANT_NPCXN
	help
	  Workaround for invalid STOP condition issue in NPCXn variant I2C controllers.
```

## drivers/i2c/Kconfig.nrf5
```kconfig
# Kconfig.nrf5 - NRF5 I2C configuration options
#
#
# Copyright (c) 2018 Aapo Vienamo
#
# SPDX-License-Identifier: Apache-2.0
#


config I2C_NRF5
	bool "NRF5 I2C driver"
	depends on SOC_FAMILY_NRF5
	select GPIO
	default n
	help
	  This option enables the I2C driver for Nordic Semiconductor nRF5
	  family processors.

if I2C_NRF5

if I2C_0

config I2C_NRF5_0_GPIO_SDA_PIN
	int "Port 0 SDA Pin Number"
	range 0 31
	depends on I2C_NRF5
	help
	  The GPIO pin to use for SDA.

config I2C_NRF5_0_GPIO_SCL_PIN
	int "Port 0 SCL Pin Number"
	range 0 31
	depends on I2C_NRF5
	help
	  The GPIO pin to use for SCL.

endif # I2C_0

if I2C_1

config I2C_NRF5_1_GPIO_SDA_PIN
	int "Port 1 SDA Pin Number"
	range 0 31
	depends on I2C_NRF5
	help
	  The GPIO pin to use for SDA.

config I2C_NRF5_1_GPIO_SCL_PIN
	int "Port 1 SCL Pin Number"
	range 0 31
	depends on I2C_NRF5
	help
	  The GPIO pin to use for SCL.

endif # I2C_1

endif # I2C_NRF5
```

## drivers/i2c/Kconfig.nrfx
```kconfig
# nrfx I2C support

# Copyright (c) 2018, Nordic Semiconductor ASA
# SPDX-License-Identifier: Apache-2.0

menuconfig I2C_NRFX
	bool "nRF TWI nrfx drivers"
	default y
	depends on SOC_FAMILY_NORDIC_NRF
	depends on MULTITHREADING
	select PINCTRL
	help
	  Enable support for nrfx TWI drivers for nRF MCU series.

if I2C_NRFX

config I2C_NRFX_TWI
	def_bool y
	depends on DT_HAS_NORDIC_NRF_TWI_ENABLED
	select NRFX_TWI

config I2C_NRFX_TWIM
	def_bool y
	depends on DT_HAS_NORDIC_NRF_TWIM_ENABLED
	select NRFX_TWIM

config I2C_NRFX_TRANSFER_TIMEOUT
	int "Transfer timeout [ms]"
	default 500
	help
	  Timeout in milliseconds used for each I2C transfer.
	  0 means that the driver should use the K_FOREVER value,
	  i.e. it should wait as long as necessary.

config I2C_NRFX_TWIS
	def_bool y
	depends on DT_HAS_NORDIC_NRF_TWIS_ENABLED
	depends on I2C_TARGET
	depends on I2C_TARGET_BUFFER_MODE
	select NRFX_TWIS

if I2C_NRFX_TWIS

config I2C_NRFX_TWIS_BUF_SIZE
	int "DMA buffer size in bytes"
	default 64

endif # I2C_NRFX_TWIS

endif # I2C_NRFX
```

## drivers/i2c/Kconfig.numaker
```kconfig
# NUMAKER I2C driver configuration options

# Copyright (c) 2023 Nuvoton Technology Corporation
# SPDX-License-Identifier: Apache-2.0

config I2C_NUMAKER
	bool "Nuvoton NuMaker I2C driver"
	default y
	select HAS_NUMAKER_I2C
	select PINCTRL
	depends on DT_HAS_NUVOTON_NUMAKER_I2C_ENABLED
	help
	  This option enables I2C driver for Nuvoton NuMaker family of
	  processors.
	  Say y if you wish to enable NuMaker I2C.
```

## drivers/i2c/Kconfig.numicro
```kconfig
# SPDX-License-Identifier: Apache-2.0
#
# Nuvoton I2C configuration
#
# Copyright (c) 2026 Fiona Behrens (me@kloenk.dev)

config I2C_NUMICRO
	bool "Nuvoton Numicro I2C driver"
	default y
	select PINCTRL
	depends on DT_HAS_NUVOTON_NUMICRO_I2C_ENABLED
	help
	  This option enables I2C driver for Nuvoton Numicro family of
	  processors.
	  Say y if you wish to enable Numicro I2C.
```

## drivers/i2c/Kconfig.nxp_s32
```kconfig
# Copyright 2024 NXP
# SPDX-License-Identifier: Apache-2.0

config I2C_NXP_S32_I3C
	bool "NXP S32 I2C driver over I3C peripheral"
	default y if DT_HAS_NXP_S32_I2C_I3C_ENABLED
	help
	  Enable I2C support over I3C peripheral on NXP S32 SoCs

if I2C_NXP_S32_I3C

config I2C_NXP_S32_I3C_TRANSFER_TIMEOUT
	int "Transfer timeout [ms]"
	default 0
	help
	  Timeout in milliseconds used for each I2C transfer. 0 means that the
	  driver should use the K_FOREVER value, i.e. it should wait as long as
	  necessary.

endif
```

## drivers/i2c/Kconfig.pic32cxsg
```kconfig
# Copyright (c) 2024 Microchip
# SPDX-License-Identifier: Apache-2.0

menuconfig I2C_PIC32CXSG
	bool "Microchip PIC32CXSG series I2C SERCOM driver"
	default y
	depends on DT_HAS_PIC32CXSG_I2C_ENABLED
	help
	  Enable the Microchip PIC32CXSG series SERCOM I2C driver.

config I2C_PIC32CXSG_DMA_DRIVEN
	bool "DMA support for Microchip PIC32CXSG I2C devices"
	depends on I2C_PIC32CXSG
	select DMA
	help
	  This enables DMA driven transactions for the I2C peripheral.
	  DMA driven mode requires fewer interrupts to handle the
	  transaction and ensures that high speed modes are not delayed
	  by data reloading.
```

## drivers/i2c/Kconfig.qmsi
```kconfig
#
# Copyright (c) 2018 Intel Corporation
#
# SPDX-License-Identifier: Apache-2.0
#

menuconfig I2C_QMSI
	bool "QMSI I2C driver"
	depends on QMSI
	select HAS_DTS_I2C
	help
	  This option enable the QMSI I2C driver.

	  This driver is simply a shim driver based on the I2C driver
	  provided by the QMSI BSP.

if I2C_QMSI

config I2C_SDA_SETUP
	int
	help
	  The delay time of clock rising edge relative to i2c data signal
	  change. The unit is i2c module base clock.

config I2C_SDA_TX_HOLD
	int
	help
	  The hold time on the data signal after a negative edge of i2c clock
	  while i2c acts as transmitter. The unit is i2c module base clock.

config I2C_SDA_RX_HOLD
	int
	help
	  The hold time on the data signal after a negative edge of i2c clock
	  while i2c acts as receiver. The unit is i2c module base clock.

endif # I2C_QMSI
```

## drivers/i2c/Kconfig.quark_se_ss
```kconfig
# Kconfig.quark_se_ss - Quark SE Sensor Subsystem I2C configuration options
#
#
# Copyright (c) 2016 Intel Corporation
#
# Licensed under the Apache License, Version 2.0 (the "License");
# you may not use this file except in compliance with the License.
# You may obtain a copy of the License at
#
#     http://www.apache.org/licenses/LICENSE-2.0
#
# Unless required by applicable law or agreed to in writing, software
# distributed under the License is distributed on an "AS IS" BASIS,
# WITHOUT WARRANTIES OR CONDITIONS OF ANY KIND, either express or implied.
# See the License for the specific language governing permissions and
# limitations under the License.
#

menuconfig I2C_QUARK_SE_SS
	bool "I2C Driver for Quark SE Sensor Subsystem (SS)"
	default n
	depends on SOC_QUARK_SE_SS
	depends on I2C
	help
	This option enables the driver to support the I2C on Quark SE Sensor
	Subsystem.

if I2C_QUARK_SE_SS

config I2C_QUARK_SE_SS_0
	bool "Enable Quark SE SS I2C Port 0"
	depends on I2C_QUARK_SE_SS
	default n

config I2C_QUARK_SE_SS_0_NAME
	string "Select a name for finding the device"
	depends on I2C_QUARK_SE_SS_0
	default "I2C_SS_0"

config I2C_QUARK_SE_SS_0_DEFAULT_CFG
	hex "Default Configuration for Quark SE SS I2C Port 0"
	depends on I2C_QUARK_SE_SS_0
	default 0x0
	help
	Allows the I2C port to be brought up with a default configuration.
	This is useful to set if other drivers depend upon using the I2C bus
	before the application has a chance to custom configure the port.
	Setting this value does not prohibit the application from customizing
	the values later. Refer to the I2C datasheet for proper values.

config I2C_QUARK_SE_SS_1
	bool "Enable Quark SE SS I2C Port 1"
	depends on I2C_QUARK_SE_SS
	default n

config I2C_QUARK_SE_SS_1_NAME
	string "Select a name for finding the device"
	depends on I2C_QUARK_SE_SS_1
	default "I2C_SS_1"

config I2C_QUARK_SE_SS_1_DEFAULT_CFG
	hex "Default Configuration for Quark SE SS I2C Port 1"
	depends on I2C_QUARK_SE_SS_1
	default 0x0
	help
	Allows the I2C port to be brought up with a default configuration.
	This is useful to set if other drivers depend upon using the I2C bus
	before the application has a chance to custom configure the port.
	Setting this value does not prohibit the application from customizing
	the values later. Refer to the I2C datasheet for proper values.

endif # I2C_QUARK_SE_SS
```
