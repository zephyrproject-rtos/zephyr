## drivers/i2c/Kconfig.rcar
```kconfig
# Renesas R-Car Gen3 I2C configuration options

# Copyright (c) 2021 IoT.bzh
# SPDX-License-Identifier: Apache-2.0

config I2C_RCAR
	bool "Renesas R-Car I2C Driver"
	default y
	depends on DT_HAS_RENESAS_RCAR_I2C_ENABLED
	help
	  Enable Renesas R-Car I2C Driver.
```

## drivers/i2c/Kconfig.renesas_ra
```kconfig
# Renesas RA Family

# Copyright (c) 2024-2025 Renesas Electronics Corporation
# SPDX-License-Identifier: Apache-2.0

config I2C_RENESAS_RA_IIC
	bool "Renesas RA I2C IIC driver"
	default y
	depends on DT_HAS_RENESAS_RA_IIC_ENABLED
	select USE_RA_FSP_I2C_IIC_CONTROLLER
	select USE_RA_FSP_I2C_IIC_TARGET if I2C_TARGET
	select PINCTRL
	help
	  Enable Renesas RA I2C IIC Driver.

if I2C_RENESAS_RA_IIC && I2C_TARGET && I2C_TARGET_BUFFER_MODE

config I2C_TARGET_RENESAS_RA_IIC_BUFFER_SIZE
	int "I2C Target data buffer length"
	range 1 1024
	default 256
	help
	  Specify the size of the data buffer used
	  in the Renesas RA I2C IIC target driver.

endif

config I2C_RENESAS_RA_SCI
	bool "Renesas RA SCI I2C"
	default y
	depends on DT_HAS_RENESAS_RA_I2C_SCI_ENABLED
	select USE_RA_FSP_SCI_I2C
	select PINCTRL
	help
	  Enable Renesas RA SCI I2C Driver.

if I2C_RENESAS_RA_SCI

config I2C_RENESAS_RA_SCI_DTC
	bool "DTC on Transmission and Reception"
	default y
	select USE_RA_FSP_DTC
	help
	  Enable DTC on transmission and reception

endif

config I2C_RENESAS_RA_SCI_B
	bool "Renesas RA SCI-B I2C"
	default y
	depends on DT_HAS_RENESAS_RA_I2C_SCI_B_ENABLED
	select USE_RA_FSP_SCI_B_I2C
	select PINCTRL
	help
	  Enable Renesas RA SCI-B I2C Driver.

if I2C_RENESAS_RA_SCI_B

config I2C_RENESAS_RA_SCI_B_DTC
	bool "DTC on Transmission and Reception"
	default y
	select USE_RA_FSP_DTC
	help
	   Enable DTC on transmission and reception

endif
```

## drivers/i2c/Kconfig.renesas_rx
```kconfig
# Renesas RX Family

# Copyright (c) 2025 Renesas Electronics Corporation
# SPDX-License-Identifier: Apache-2.0

config I2C_RENESAS_RX_RIIC
	bool "Renesas RX I2C Master"
	default y
	depends on DT_HAS_RENESAS_RX_I2C_ENABLED
	select USE_RX_RDP_I2C
	select PINCTRL
	help
	  Enable Renesas RX I2C Driver.

if I2C_RENESAS_RX_RIIC

config I2C_RENESAS_RX_CALLBACK
	bool "Renesas RX I2C Callback Support"
	depends on I2C_CALLBACK
	default y
	help
	  Enable Callback support for the I2C Driver

endif # I2C_RENESAS_RX_RIIC
```

## drivers/i2c/Kconfig.renesas_rz
```kconfig
# Copyright (c) 2024-2025 Renesas Electronics Corporation
# SPDX-License-Identifier: Apache-2.0

config I2C_RENESAS_RZ_RIIC
	bool "Renesas RZ I2C RIIC Master"
	default y
	depends on DT_HAS_RENESAS_RZ_RIIC_ENABLED
	select USE_RZ_FSP_RIIC_MASTER
	select PINCTRL
	help
	  Enable Renesas RZ I2C RIIC Driver.

config I2C_RENESAS_RZ_IIC
	bool "Renesas RZ I2C IIC Master"
	default y
	depends on DT_HAS_RENESAS_RZ_IIC_ENABLED
	select USE_RZ_FSP_IIC_MASTER
	select PINCTRL
	help
	  Enable Renesas RZ I2C IIC Driver.
```
