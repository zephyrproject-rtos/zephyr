## drivers/i2c/Kconfig.rts5912
```kconfig
# Copyright (c) 2025 Realtek, SIBG-SD7
# SPDX-License-Identifier: Apache-2.0

menuconfig I2C_RTS5912
	bool "Realtek RTS5912 I2C support"
	default y
	depends on DT_HAS_REALTEK_RTS5912_I2C_ENABLED
	select I2C_ALLOW_NO_STOP_TRANSACTIONS
	select I2C_DW_EXTENDED_SUPPORT
	help
	  Enable the Realtek RTS5912 I2C driver

config I2C_RTS5912_INIT_PRIORITY
	int "RTS5912 Init priority"
	depends on I2C_RTS5912
	default 51
	help
	  I2C device driver initialization priority.
```

## drivers/i2c/Kconfig.sam0
```kconfig
# Copyright (c) 2019 Derek Hageman <hageman@inthat.cloud>
# SPDX-License-Identifier: Apache-2.0

menuconfig I2C_SAM0
	bool "SAM0 series I2C SERCOM driver"
	default y
	depends on DT_HAS_ATMEL_SAM0_I2C_ENABLED
	select PINCTRL
	help
	  Enable the SAM0 series SERCOM I2C driver.

config I2C_SAM0_DMA_DRIVEN
	bool "DMA support for SAM0 I2C devices"
	depends on I2C_SAM0
	select DMA
	help
	  This enables DMA driven transactions for the I2C peripheral.
	  DMA driven mode requires fewer interrupts to handle the
	  transaction and ensures that high speed modes are not delayed
	  by data reloading.

config I2C_SAM0_TRANSFER_TIMEOUT
	int "Transfer timeout [ms]"
	depends on I2C_SAM0
	default 500
	help
	  Timeout in milliseconds used for each I2C transfer.
	  0 means that the driver should use the K_FOREVER value,
	  i.e. it should wait as long as necessary.
```

## drivers/i2c/Kconfig.sam_twihs
```kconfig
# sam twihs I2C support

# Copyright (c) 2023 Intel Corporation
# SPDX-License-Identifier: Apache-2.0

config I2C_SAM_TWIHS
	bool "Atmel SAM (TWIHS) I2C driver"
	default y
	depends on DT_HAS_ATMEL_SAM_I2C_TWIHS_ENABLED
	select PINCTRL
	help
	  Enable Atmel SAM MCU Family (TWIHS) I2C bus driver.
```

## drivers/i2c/Kconfig.sbcon
```kconfig
# Copyright (c) 2016 Linaro Ltd.
# SPDX-License-Identifier: Apache-2.0

config I2C_SBCON
	bool "I2C driver for ARM's SBCon two-wire serial bus interface"
	default y
	depends on DT_HAS_ARM_VERSATILE_I2C_ENABLED
	select I2C_BITBANG
```

## drivers/i2c/Kconfig.secure_iot
```kconfig
# Copyright (c) 2024 Mindgrove Technologies.
# SPDX-License-Identifier: Apache-2.0

config I2C_SECURE_IOT
	bool "Mindgrove Silicon Secure IoT I2C driver"
	default y
	# depends on DT_HAS_SECURE_IOT_I2C0_ENABLED
	help
	  Enable I2C support on Secure IoT.
```

## drivers/i2c/Kconfig.sedi
```kconfig
#
# Copyright (c) 2023 Intel Corporation
#
# SPDX-License-Identifier: Apache-2.0
#

config I2C_SEDI
	bool "Intel SEDI I2C Driver"
	default y
	depends on DT_HAS_INTEL_SEDI_I2C_ENABLED
	help
	  This option enables the Intel SEDI I2C driver.
	  This driver is simply a shim driver built upon the SEDI
	  bare metal I2C driver in the hal-intel module
```

## drivers/i2c/Kconfig.sf32lb
```kconfig
# Copyright (c) 2025, Qingsong Gou <gouqs@hotmail.com>
# SPDX-License-Identifier: Apache-2.0

config I2C_SF32LB
	bool "SiFli SF32LB I2C driver"
	default y
	depends on DT_HAS_SIFLI_SF32LB_I2C_ENABLED
	select DMA if $(dt_compat_any_has_prop,$(DT_COMPAT_SIFLI_SF32LB_I2C),dmas)
	help
	  Enable I2C driver for SiFli SF32LB.
```

## drivers/i2c/Kconfig.sifive
```kconfig
# Copyright (c) 2018 SiFive Inc.
# SPDX-License-Identifier: Apache-2.0

config I2C_SIFIVE
	bool "Sifive I2C driver"
	default y
	depends on DT_HAS_SIFIVE_I2C0_ENABLED
	help
	  Enable I2C support on SiFive Freedom
```

## drivers/i2c/Kconfig.silabs
```kconfig
# Copyright (c) 2025 Silicon Laboratories Inc.
# SPDX-License-Identifier: Apache-2.0

menuconfig I2C_SILABS
	bool "Silabs I2C_S2 driver"
	default y
	depends on DT_HAS_SILABS_I2C_ENABLED
	depends on CLOCK_CONTROL
	select SILABS_SISDK_I2C
	select I2C_TRANSFER_TIMEOUT_SUPPORTED
	help
	  Enable I2C series 2 driver for the Silabs gecko SoC series.

if I2C_SILABS

config  I2C_SILABS_DMA
	bool "DMA support for I2C operations"
	depends on DMA
	default y if $(dt_compat_any_has_prop,$(DT_COMPAT_SILABS_I2C),dmas)
	help
	  Enable DMA mode for I2C DMA transfer.


endif # I2C_SILABS
```

## drivers/i2c/Kconfig.smartbond
```kconfig
# Copyright (c) 2022 Renesas Electronics Corporation and/or its affiliates
# SPDX-License-Identifier: Apache-2.0

config I2C_SMARTBOND
	bool "Renesas SmartBond(tm) I2C driver"
	default y
	depends on DT_HAS_RENESAS_SMARTBOND_I2C_ENABLED
	select PINCTRL
	help
	  Enable I2C driver for Renesas SmartBond(tm) DA1469x series MCU.
```

## drivers/i2c/Kconfig.stm32
```kconfig
# Copyright (c) 2018 Intel Corporation
# SPDX-License-Identifier: Apache-2.0

menuconfig I2C_STM32
	bool "STM32 I2C driver"
	default y
	depends on DT_HAS_ST_STM32_I2C_V1_ENABLED || DT_HAS_ST_STM32_I2C_V2_ENABLED
	select PINCTRL
	help
	  Enable I2C support on the STM32 SoCs

if I2C_STM32

config I2C_STM32_V1
	bool
	default y
	depends on DT_HAS_ST_STM32_I2C_V1_ENABLED
	select I2C_STM32_INTERRUPT if I2C_TARGET
	help
	  Driver variant matching `st,stm32-i2c-v1` compatible.

config I2C_STM32_V2
	bool
	default y
	depends on DT_HAS_ST_STM32_I2C_V2_ENABLED
	select I2C_STM32_INTERRUPT if I2C_TARGET
	help
	  Driver variant matching `st,stm32-i2c-v2` compatible.
	  If I2C_TARGET is enabled it selects I2C_STM32_INTERRUPT, since target mode
	  is only supported by this driver with interrupts enabled.

config I2C_STM32_INTERRUPT
	bool "STM32 MCU I2C Interrupt Support"
	depends on I2C_STM32_V1 || I2C_STM32_V2
	default y
	help
	  Enable Interrupt support for the I2C Driver

config I2C_STM32_COMBINED_INTERRUPT
	bool
	depends on I2C_STM32_INTERRUPT
	default y if SOC_SERIES_STM32C0X || SOC_SERIES_STM32F0X || \
		     SOC_SERIES_STM32G0X || SOC_SERIES_STM32L0X || \
		     SOC_SERIES_STM32U0X || SOC_SERIES_STM32WB0X

config I2C_STM32_BUS_RECOVERY
	bool "Bus recovery support"
	select I2C_BITBANG
	help
	  Enable STM32 driver bus recovery support via GPIO bitbanging.

config I2C_STM32_V2_TIMING
	bool "compute the I2C V2 bus timing"
	depends on I2C_STM32_V2
	help
	  Enable STM32 driver bus to calculate the Timing.

endif # I2C_STM32
```

## drivers/i2c/Kconfig.sy1xx
```kconfig
# Copyright (c) 2024 sensry.io
# SPDX-License-Identifier: Apache-2.0

config I2C_SY1XX
	bool "Sensry SY1XX I2C driver"
	default y
	depends on DT_HAS_SENSRY_SY1XX_I2C_ENABLED
	help
	  Enable Sensry SY1xx SOC Family I2C driver.

config I2C_SY1XX_BUFFER_SIZE
	int "SY1XX I2C buffer size"
	default 128
	depends on I2C_SY1XX
	help
	  Default buffer size in bytes for the SY1XX I2C driver used for chunked transfers.
```

## drivers/i2c/Kconfig.tca9546a
```kconfig
# Copyright (c) 2020 Innoseis BV
# SPDX-License-Identifier: Apache-2.0

menuconfig I2C_TCA9546A
	bool "I2C addressable switch"
	help
	  Enable TCA9546A i2C bus switch

if I2C_TCA9546A

config I2C_TCA9546_ROOT_INIT_PRIO
	int "TCA9546a root driver init priority"
	default I2C_INIT_PRIORITY

config I2C_TCA9546_CHANNEL_INIT_PRIO
	int "TCA9546a channel driver init priority"
	default I2C_INIT_PRIORITY

endif
```

## drivers/i2c/Kconfig.tca954x
```kconfig
# Copyright (c) 2020 Innoseis BV
# SPDX-License-Identifier: Apache-2.0

menuconfig I2C_TCA954X
	bool "I2C addressable switch"
	default y
	depends on DT_HAS_TI_TCA9546A_ENABLED || DT_HAS_TI_TCA9548A_ENABLED
	help
	  Enable TCA954x series I2C bus switch

if I2C_TCA954X

config I2C_TCA954X_ROOT_INIT_PRIO
	int "TCA954x root driver init priority"
	default I2C_INIT_PRIORITY
	help
	  Should be lower than `I2C_TCA954X_CHANNEL_INIT_PRIO`

config I2C_TCA954X_CHANNEL_INIT_PRIO
	int "TCA954x channel driver init priority"
	default I2C_INIT_PRIORITY
	help
	  Should be higher than `I2C_TCA954X_ROOT_INIT_PRIO`

endif
```

## drivers/i2c/Kconfig.test
```kconfig
# Copyright (c) 2021, Nordic Semiconductor ASA
# SPDX-License-Identifier: Apache-2.0

# Hidden option for turning on the dummy driver for vnd,i2c devices
# used in testing.
config I2C_TEST
	def_bool DT_HAS_VND_I2C_ENABLED
	depends on DT_HAS_VND_I2C_ENABLED
```

## drivers/i2c/Kconfig.ti_unicomm
```kconfig
# Copyright (c) 2026 Texas Instruments Incorporated
# SPDX-License-Identifier: Apache-2.0

config I2C_TI_UNICOMM
    bool "TI UNICOMM I2C Driver"
    default y
    depends on DT_HAS_TI_UNICOMM_I2C_ENABLED
    help
        Enable I2C on TI devices with the UNICOMM peripheral.
```

## drivers/i2c/Kconfig.tlx
```kconfig
# Copyright (c) 2024 Telink Semiconductor
# SPDX-License-Identifier: Apache-2.0

config I2C_TELINK_TLX
	bool "Telink Semiconductor TLx-series I2C driver"
	default y
	depends on DT_HAS_TELINK_TLX_I2C_ENABLED
	help
	  Enables Telink TLx-series I2C driver.
```

## drivers/i2c/Kconfig.w91
```kconfig
# Copyright (c) 2021-2023 Telink Semiconductor
# SPDX-License-Identifier: Apache-2.0

config I2C_TELINK_W91
	bool "Telink Semiconductor W91 I2C driver"
	default y
	depends on DT_HAS_TELINK_W91_I2C_ENABLED
	help
	  Enables Telink W91 I2C driver.
```

## drivers/i2c/Kconfig.wch
```kconfig
# Copyright (c) 2025 Andrei-Edward Popa
# SPDX-License-Identifier: Apache-2.0

config I2C_WCH
	bool "WCH I2C driver"
	default y
	depends on DT_HAS_WCH_I2C_ENABLED
	select PINCTRL
	help
	  Enable I2C support on WCH platforms

config I2C_WCH_XFER_TIMEOUT_MS
	int "Set the transfer timeout in milliseconds"
	depends on I2C_WCH
	default 500
```

## drivers/i2c/Kconfig.xec
```kconfig
# Microchip XEC I2C configuration options

# Copyright (c) 2019 Intel Corporation
# SPDX-License-Identifier: Apache-2.0

config I2C_XEC
	bool "XEC Microchip I2C driver"
	default y
	depends on DT_HAS_MICROCHIP_XEC_I2C_ENABLED
	select PINCTRL
	help
	  Enable the Microchip XEC I2C driver.

config I2C_XEC_V2
	bool "XEC Microchip I2C driver"
	default y
	depends on DT_HAS_MICROCHIP_XEC_I2C_V2_ENABLED
	select PINCTRL
	help
	  Enable the Microchip XEC I2C V2 driver.

if I2C_XEC_V2

config I2C_XEC_PORT_MUX
	bool "Allow I2C configuration to switch port and frequency"
	default y
	help
	  Microhip MEC I2C-SMBus controllers each have a hardware port
	  multiplexer. The MUX allows each controller to be connected to
	  one of the 16 ports the specific chip implements. This can be
	  used to dynamically switch controllers between multiple ports.
	  Multiple controllers may also be connected to the same port.
	  It is recommended the controller be reset and reconfigured after
	  switching to a new port. The controller samples the pins over
	  a time window when it is released from reset. This feature
	  enodes the 4-bit port select field in unused bits[19:16] of
	  the 32-bit I2C driver configuration word. This allows the
	  application to switch the port and configure a new frequency
	  in one API call.

endif # I2C_XEC_V2
```

## drivers/i2c/Kconfig.xilinx_axi
```kconfig
# Copyright 2023 Calian Ltd.  All rights reserved.
# SPDX-License-Identifier: Apache-2.0

config I2C_XILINX_AXI
	bool "Xilinx AXI I2C driver"
	default y
	depends on DT_HAS_XLNX_XPS_IIC_2_00_A_ENABLED || DT_HAS_XLNX_XPS_IIC_2_1_ENABLED
	select EVENTS
	help
	  Enable the Xilinx AXI IIC Bus Interface driver.
	  This is an FPGA logic core as described by Xilinx document PG090.
```

## drivers/i2c/slave/Kconfig
```kconfig
# I2C Slave configuration options

# Copyright (c) 2017 BayLibre, SAS
# SPDX-License-Identifier: Apache-2.0

#
# I2C options
#
config I2C_SLAVE
	bool "I2C Slave Drivers"
	help
	  Enable I2C Slave Driver Configuration

if I2C_SLAVE

endif # I2C_SLAVE
```

## drivers/i2c/slave/Kconfig.eeprom
```kconfig
# Kconfig - I2C EEPROM Slave configuration options

#
# Copyright (c) 2017 BayLibre, SAS
#
# SPDX-License-Identifier: Apache-2.0
#

config I2C_EEPROM_SLAVE
	bool "I2C Slave EEPROM driver"
	help
	  Enable virtual I2C Slave EEPROM driver
```

## drivers/i2c/target/Kconfig
```kconfig
# I2C Target configuration options

# Copyright (c) 2017 BayLibre, SAS
# SPDX-License-Identifier: Apache-2.0

#
# I2C options
#
menuconfig I2C_TARGET
	bool "I2C Target Drivers"
	help
	  Enable I2C Target Driver Configuration

if I2C_TARGET

config I2C_TARGET_INIT_PRIORITY
	int "Init priority"
	default 60
	help
	  I2C Target device driver initialization priority.

config I2C_TARGET_BUFFER_MODE
	bool "I2C target driver for buffer mode [EXPERIMENTAL]"
	select EXPERIMENTAL
	help
	  This is an option to enable buffer mode.

config I2C_TARGET_TIMEOUT
	bool "I2C Target timeout option"
	help 
		This option enables a target to timeout if the SCL line is held low.

source "drivers/i2c/target/Kconfig.eeprom"

endif # I2C_TARGET
```

## drivers/i2c/target/Kconfig.hid
```kconfig
config I2C_HID_TARGET
       bool "Support HID over I2C target"
       depends on I2C_TARGET_BUFFER_MODE

if I2C_HID_TARGET

config I2C_HID_TARGET_IN_BUF_COUNT
	int "Number of buffers in the IN pool"
	range 1 256
	default 8
	help
	  Number of buffers in the IN pool per HID instance.

endif
```
