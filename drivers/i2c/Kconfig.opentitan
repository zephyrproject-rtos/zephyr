## drivers/ieee802154/Kconfig.dw3000
```kconfig
# SPDX-FileCopyrightText: Copyright The Zephyr Project Contributors
# SPDX-License-Identifier: Apache-2.0

menuconfig IEEE802154_DW3000
	bool "Qorvo DW3000 IEEE 802.15.4 driver"
	default y
	depends on DT_HAS_QORVO_DW3000_ENABLED
	depends on !NET_L2_OPENTHREAD
	select GPIO
	select SPI
	help
	  Driver for the Qorvo DW3000 family of IEEE 802.15.4 HRP UWB
	  transceivers. It accepts the parts with one antenna port, the DW3110
	  and the DW3210, and has been tested with the DW3110.

	  The driver works with the IEEE 802.15.4 L2 or in raw mode, on
	  channels 5 and 9: an application that uses the network configuration
	  library has to set NET_CONFIG_IEEE802154_CHANNEL to one of them. The
	  driver cannot set the transmit power; it refuses requests for one and
	  leaves the power at its reset value. OpenThread is not supported, as
	  it needs a radio that waits for the acknowledgment of a frame it sends
	  (IEEE802154_HW_TX_RX_ACK).

if IEEE802154_DW3000

config IEEE802154_DW3000_INIT_PRIO
	int "Initialization priority"
	default 80
	help
	  Initialization priority of the transceiver. The SPI bus and the GPIO
	  controllers it is wired to have to be initialized before it.

config IEEE802154_DW3000_RX_STACK_SIZE
	int "RX thread stack size"
	default 1024
	help
	  Stack size of the thread that serves the interrupt line of a
	  transceiver. Received frames are read from the transceiver and handed
	  to the network stack on this thread.

endif # IEEE802154_DW3000
```

## drivers/input/Kconfig.ameba_ctc
```kconfig
# Copyright (c) 2026 Realtek Semiconductor Corp.
# SPDX-License-Identifier: Apache-2.0

config INPUT_CTC_AMEBA
	bool "Ameba multi-channel capacitive touch driver"
	default y
	depends on DT_HAS_REALTEK_AMEBA_CAPTOUCH_ENABLED
	select PINCTRL
	help
	  Enable driver for Ameba multi-channel capacitive touch.
```

## drivers/input/Kconfig.axs5106l
```kconfig
# SPDX-FileCopyrightText: Copyright The Zephyr Project Contributors
# SPDX-License-Identifier: Apache-2.0

menuconfig INPUT_AXS5106L
	bool "AXS5106L capacitive touch controller driver"
	default y
	depends on DT_HAS_CHIPSOURCETEK_AXS5106L_ENABLED
	select GPIO
	select I2C
	select INPUT_TOUCH
	help
	  Enable driver for the ChipSourceTek AXS5106L capacitive touch
	  controller.

if INPUT_AXS5106L

config INPUT_AXS5106L_PERIOD_MS
	int "Sample period in milliseconds"
	default 20
	range 1 1000
	help
	  Period between two reads of the touch data while the panel is touched
	  or the interrupt line stays asserted, or all the time when no interrupt
	  GPIO is configured.

endif # INPUT_AXS5106L
```

## drivers/input/Kconfig.ch32
```kconfig
# SPDX-FileCopyrightText: Copyright Michael Hope <michaelh@juju.nz>
# SPDX-License-Identifier: Apache-2.0

config INPUT_CH32_TKEY
	bool "CH32 Touch Key Detection (TKEY) driver"
	default y
	depends on DT_HAS_WCH_CH32_TKEY_ENABLED
	select CLOCK_CONTROL
	select PINCTRL
	help
	  Enable Touch Key Detection (TKEY) peripheral driver for WCH CH32 microcontrollers.
```

## drivers/input/Kconfig.cst3530
```kconfig
# Copyright (c) 2024 Dylan Rowe
# SPDX-License-Identifier: Apache-2.0

config INPUT_CST3530
	bool "CST3530 capacitive touch panel driver"
	default y
	depends on DT_HAS_HYNITRON_CST3530_ENABLED
	select I2C
	select INPUT_TOUCH
	help
	  Enable driver for hynitron cst3530 touch panel.
```

## drivers/input/Kconfig.gt1151
```kconfig
# Copyright (c) 2026 Espressif Systems (Shanghai) Co., Ltd.
# SPDX-License-Identifier: Apache-2.0

menuconfig INPUT_GT1151
	bool "Goodix GT1151 capacitive touch panel driver"
	default y
	depends on DT_HAS_GOODIX_GT1151_ENABLED
	select I2C
	select INPUT_TOUCH
	help
	  Enable driver for Goodix GT1151 capacitive touch controllers.

if INPUT_GT1151

config INPUT_GT1151_PERIOD_MS
	int "Sample period"
	depends on !INPUT_GT1151_INTERRUPT
	default 10
	help
	  Sample period in milliseconds when in polling mode.

config INPUT_GT1151_INTERRUPT
	bool "Interrupt"
	help
	  Enable interrupt support (requires GPIO).

config INPUT_GT1151_MAX_TOUCH_POINTS
	int "Maximum touch points"
	default 1
	range 1 10
	help
	  Maximum number of touch points to report.

endif
```

## drivers/input/Kconfig.mchp_touch
```kconfig
# Copyright (c) 2026 Microchip Technology Inc.
# SPDX-License-Identifier: Apache-2.0

menu "Microchip Capacitive Touch Driver"

config INPUT_MCHP_TOUCH
	bool "Microchip capacitive touch driver support"
	default y
	depends on DT_HAS_MICROCHIP_PTC_CONTROLLER_ENABLED
	depends on INPUT
	help
	  Provides support for the Microchip capacitive touch driver.

if INPUT_MCHP_TOUCH

config INPUT_MCHP_TOUCH_THREAD_STACK_SIZE
	int "Touch driver thread stack size"
	default 310
	help
	  Specifies the stack size, in bytes, for the capacitive touch
	  driver thread. The minimum supported value is 310 bytes.

config INPUT_MCHP_TOUCH_THREAD_PRIORITY
	int "Touch driver thread priority"
	default 7
	help
	  Specifies the priority of the capacitive touch driver thread.

config INPUT_MCHP_TOUCH_EN_BTTN_MODULE
	bool "Touch button module support"
	default y
	help
	  Provides touch button functionality.

config INPUT_MCHP_TOUCH_EN_FREQ_HOP
	bool "Frequency hopping support"
	default y
	help
	  Provides frequency hopping for the capacitive touch driver.

config INPUT_MCHP_TOUCH_EN_FREQ_AUTO_TUNE
	bool "Frequency-hopping auto-tuning support"
	default y
	depends on INPUT_MCHP_TOUCH_EN_FREQ_HOP
	help
	  Provides automatic tuning for frequency hopping.

config INPUT_MCHP_TOUCH_EN_SCROLLER
	bool "Touch scroller module support"
	depends on DT_HAS_MICROCHIP_PTC_SCROLLER_ENABLED
	help
	  Provides touch scroller functionality.

config INPUT_MCHP_SCROLLER_TOUCH_EVENT
	bool "Scroller touch-detection event reporting"
	default y
	depends on INPUT_MCHP_TOUCH_EN_SCROLLER
	help
	  When this option is selected, the scroller reports two events
	  one event indicates that the scroller is being touched, and
	  the other reports the scroller position.
	  Each event has a different code defined in the device tree.
	  The touch-detection event uses the node-specific code,
	  while the position event uses the scroller-node-specific code.
	  When this option is not selected, only the scroller-position event
	  is reported using the scroller-node-specific code.

config INPUT_MCHP_TOUCH_DATASTREAMER
	bool "Touch Datastreamer [UNI-DIRECTION]"
	default y
	depends on SERIAL
	help
	  Provides touch data for visualization in MPLAB Data Visualizer.
	  Supports unidirectional data streaming only. Tuning is not supported.

endif # INPUT_MCHP_TOUCH

endmenu
```

## drivers/input/Kconfig.tsm12
```kconfig
# SPDX-FileCopyrightText: Copyright The Zephyr Project Contributors
# SPDX-License-Identifier: Apache-2.0

menuconfig INPUT_TSM12
	bool "TSM12 capacitive touch sensor"
	default y
	depends on DT_HAS_ADSEMI_TSM12_ENABLED
	select I2C
	help
	  Enable driver for the AD Semiconductor TSM12 12-channel capacitive
	  touch sensor and register-compatible parts such as the Si12T.

if INPUT_TSM12

config INPUT_TSM12_PERIOD_MS
	int "Sample period"
	default 50
	help
	  Sample period in milliseconds. Instances without int-gpios are
	  polled continuously; instances with int-gpios are polled only while
	  a channel is touched, to detect the release.

endif # INPUT_TSM12
```
