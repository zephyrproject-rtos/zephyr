## drivers/i2c/Kconfig.opentitan
```kconfig
# Copyright (c) 2025 Rivos Inc.
# SPDX-License-Identifier: Apache-2.0

config I2C_OPENTITAN
	bool "OpenTitan I2C driver"
	default y
	depends on DT_HAS_LOWRISC_OPENTITAN_I2C_2_0_0_ENABLED
	help
	  Enable the controller-mode driver for the OpenTitan I2C IP,
	  version 2.0.0.

config I2C_OPENTITAN_TIMEOUT_US
	int "Transfer stall timeout (us)"
	depends on I2C_OPENTITAN
	default 1000
	help
	  Time the bus may make no progress beyond the nominal byte time before
	  a transfer fails with -ETIMEDOUT. Raise this for targets that stretch
	  the clock for long periods.
```

## drivers/i2c/Kconfig.py32
```kconfig
# SPDX-FileCopyrightText: Copyright The Zephyr Project Contributors
# SPDX-License-Identifier: Apache-2.0

menuconfig I2C_PY32
	bool "Puya PY32 I2C controller driver"
	default y
	depends on DT_HAS_PUYA_PY32_I2C_ENABLED
	select PINCTRL
	select RESET
	help
	  Enable polling controller transfers with 7-bit addresses at 100 or
	  400 kHz. Repeated starts and fragmented buffers are supported.
	  Each transfer must end with STOP. Target mode is not supported.

if I2C_PY32

config I2C_PY32_TIMEOUT_MS
	int "Transfer timeout (ms)"
	default 1000
	range 1 60000
	help
	  Maximum duration of a complete I2C transfer, including clock stretching
	  and waiting for an idle bus. A timeout resets the peripheral.

endif # I2C_PY32
```

## drivers/i2c/Kconfig.sc18im704
```kconfig
# Copyright (c) 2023 Basalte bv
# SPDX-License-Identifier: Apache-2.0

config I2C_SC18IM704
	bool "NXP SC18IM704 I2C controller driver"
	default y
	depends on DT_HAS_NXP_SC18IM704_I2C_ENABLED
	select UART_USE_RUNTIME_CONFIGURE
	help
	  Enables NXP SC18IM704 I2C controller driver

if I2C_SC18IM704

config I2C_SC18IM704_INIT_PRIORITY
	int "SC18IM704 I2C init priority"
	default 51
	help
	  SC18IM704 I2C controller initialization priority.

	  Note: Has to be greater than the UART bus initialization priority.

config I2C_SC18IM704_READ_TIMEOUT_MS
	int "SC18IM704 read timeout per byte (ms)"
	default 1000
	help
	  How long a transfer waits for each byte the bridge sends back. The
	  wait polls the UART without sleeping, so a bridge that does not
	  answer (unpowered, unplugged, or at another baud rate) holds the CPU
	  for that long.

config I2C_SC18IM704_VERIFY
	bool "Verify SC18IM704 I2C transfers"
	default y
	help
	  Verify the I2C state register after I2C transfers to detect errors.

endif
```

## drivers/i2c/Kconfig.virtio
```kconfig
# SPDX-FileCopyrightText: Copyright The Zephyr Project Contributors
# SPDX-License-Identifier: Apache-2.0

config I2C_VIRTIO
	bool "VIRTIO I2C adapter driver"
	default y
	depends on DT_HAS_VIRTIO_I2C_ENABLED
	select VIRTIO
	help
	  Enable driver for VIRTIO I2C adapter devices.

	  Every transfer is a round trip to the virtio device, so the I2C API
	  can only be used from a thread.

if I2C_VIRTIO

config I2C_VIRTIO_MAX_MSGS
	int "Messages submitted per batch"
	default 8
	range 1 255
	help
	  How many messages of one i2c_transfer the driver queues before
	  notifying the device. A transfer longer than this is split into
	  several batches, which is correct but costs one extra round trip
	  apiece, so the default is set well above the two messages a register
	  read takes.

	  Each slot costs a handful of bytes of RAM, and sizes the request
	  virtqueue at three descriptors per message.

endif # I2C_VIRTIO
```

## drivers/i2c/target/Kconfig.eeprom
```kconfig
# I2C EEPROM Target configuration options

# Copyright (c) 2017 BayLibre, SAS
# SPDX-License-Identifier: Apache-2.0

config I2C_EEPROM_TARGET
	bool "I2C Target EEPROM driver"
	default y
	depends on DT_HAS_ZEPHYR_I2C_TARGET_EEPROM_ENABLED
	select I2C_TARGET_REGSET_LIB
	help
	  Enable virtual I2C Target EEPROM driver

config I2C_EEPROM_TARGET_RUNTIME_ADDR
	bool "Set I2C Target EEPROM Address at Runtime"
	depends on I2C_EEPROM_TARGET
	help
	  Enable changing virtual I2C Target EEPROM device address at runtime
```

## drivers/i2c/target/Kconfig.tmp103
```kconfig
# I2C EEPROM Target configuration options

# SPDX-FileCopyrightText: Copyright The Zephyr Project Contributors
# SPDX-License-Identifier: Apache-2.0

config I2C_TMP103_TARGET
	bool "I2C Target TMP103 driver"
	default y
	depends on DT_HAS_ZEPHYR_I2C_TARGET_TMP103_ENABLED
	select I2C_TARGET_REGSET_LIB
	help
	  Enable virtual I2C Target TMP103 driver
```

## drivers/i2s/Kconfig
```kconfig
# I2S (Inter-IC Sound) driver configuration options

# Copyright (c) 2017 Piotr Mienkowski
# SPDX-License-Identifier: Apache-2.0

#
# I2S Drivers
#
menuconfig I2S
	bool "Inter-IC Sound (I2S) bus drivers"
	help
	  Enable support for the I2S (Inter-IC Sound) hardware bus.

if I2S

config I2S_RTIO
	bool "I2S RTIO API"
	select EXPERIMENTAL
	select RTIO
	help
	  API and implementations of I2S for RTIO

if I2S_RTIO

config I2S_RTIO_WRAPPER
	bool "Support legacy APIs for RTIO based I2S device drivers"
	help
	  Adds support for using legacy I2S APIs with RTIO based I2S device drivers.

if I2S_RTIO_WRAPPER

config I2S_RTIO_WRAPPER_MAX_BLOCK_COUNT
	int "The maximum number of blocks in any memory slab provided to an I2S device"
	default 16

endif # I2S_RTIO_WRAPPER

endif # I2S_RTIO

config I2S_INIT_PRIORITY
	int "Init priority"
	default KERNEL_INIT_PRIORITY_DEVICE
	help
	  Device driver initialization priority.

module = I2S
module-str = i2s
source "subsys/logging/Kconfig.template.log_config"

comment "Device Drivers"

source "drivers/i2s/Kconfig.*"

endif # I2S
```

## drivers/i2s/Kconfig.fake
```kconfig
# SPDX-FileCopyrightText: Copyright 2026 Nordic Semiconductor ASA
# SPDX-License-Identifier: Apache-2.0

config I2S_FAKE
	bool "Fake I2S driver"
	default y
	depends on DT_HAS_ZEPHYR_FAKE_I2S_ENABLED
	help
	  Enable support for the FFF-based fake I2S driver.
```

## drivers/i2s/Kconfig.fallback
```kconfig
# SPDX-FileCopyrightText: Copyright 2026 Nordic Semiconductor ASA
# SPDX-License-Identifier: Apache-2.0

config I2S_FALLBACK
	bool "I2S fallback iodev"
	depends on I2S_RTIO

if I2S_FALLBACK

config I2S_FALLBACK_THREAD_STACK_SIZE
	int "Stack size of I2S fallback iodev thread"
	default 2048

config I2S_FALLBACK_THREAD_PRIORITY
	int "Priority of I2S fallback iodev thread"
	default 0

config I2S_FALLBACK_TIMEOUT_MS
	int "Timeout waiting for block to be transferred during stream, in milliseconds"
	default 1000

endif # I2S_FALLBACK
```

## drivers/i2s/Kconfig.infineon_tdm
```kconfig
# SPDX-FileCopyrightText: Copyright (c) 2026 Infineon Technologies AG,
# SPDX-FileCopyrightText: or an affiliate of Infineon Technologies AG. All rights reserved.
# SPDX-FileCopyrightText: Copyright (c) 2026 Linumiz
#
# SPDX-License-Identifier: Apache-2.0

config I2S_INFINEON_TDM
	bool "Infineon TDM I2S driver"
	default y
	depends on DT_HAS_INFINEON_TDM_I2S_ENABLED
	depends on CLOCK_CONTROL
	select PINCTRL
	select DMA
	help
	  Register-level I2S driver for the Infineon TDM/I2S interface.

if I2S_INFINEON_TDM

config I2S_INFINEON_TDM_RX_QUEUE_SIZE
	int "RX queue length"
	default 8
	help
	  Number of received blocks the RX queue holds. This should match the
	  number of blocks in the memory slab that holds the received data.

config I2S_INFINEON_TDM_TX_QUEUE_SIZE
	int "TX queue length"
	default 8
	help
	  Number of blocks the TX queue holds. This should match the number of
	  blocks in the memory slab that holds the data to transmit.

endif # I2S_INFINEON_TDM
```

## drivers/i2s/Kconfig.native_sim
```kconfig
# Copyright 2026 NXP
# SPDX-License-Identifier: Apache-2.0

config I2S_NATIVE_SIM
	bool "native_sim I2S"
	depends on DT_HAS_ZEPHYR_NATIVE_SIM_I2S_ENABLED
	default y
	select NATIVE_USE_NSI_ERRNO
	help
	  Enable the native_sim I2S driver, which streams RX and TX PCM samples
	  from and to host files or, with I2S_NATIVE_SIM_ALSA, host ALSA devices.

if I2S_NATIVE_SIM

config I2S_NATIVE_SIM_ALSA
	bool "native_sim ALSA host audio"
	select NATIVE_SIMULATOR_PREFER_REAL_TIME
	help
	  When this option is enabled, this driver can also connect to ALSA PCM
	  devices. Paths starting with "alsa:" open that ALSA device instead of a
	  file, for example "alsa:default". Requires the host ALSA dev library.
	  Word sizes of 8, 16, 24 and 32 bits are supported; 24-bit words are
	  LSB-justified in 32-bit samples.

config I2S_NATIVE_SIM_RX_PATH
	string "native_sim I2S RX path"
	default "alsa:default" if I2S_NATIVE_SIM_ALSA
	default "i2s_in.pcm"
	help
	  Default host PCM file, or ALSA device, consumed by native_sim I2S RX
	  devices. Can be overridden from command line.

config I2S_NATIVE_SIM_TX_PATH
	string "native_sim I2S TX path"
	default "alsa:default" if I2S_NATIVE_SIM_ALSA
	default "i2s_out.pcm"
	help
	  Default host PCM file, or ALSA device, produced by native_sim I2S TX
	  devices. Can be overridden from command line.

config I2S_NATIVE_SIM_QUEUE_SIZE
	int "native_sim I2S queue depth"
	default 8
	range 2 64
	help
	  Number of queued I2S blocks per native_sim I2S device.

config I2S_NATIVE_SIM_THREAD_PRIORITY
	int "native_sim I2S worker priority"
	default 8
	help
	  Priority of the native_sim I2S worker thread.

endif # I2S_NATIVE_SIM
```

## drivers/i2s/Kconfig.rpi_pico
```kconfig
# Copyright (c) 2026 Robin Sachsenweger Ballantyne <makenenjoy@gmail.com>
# SPDX-License-Identifier: Apache-2.0

config I2S_RPI_PICO_PIO
	bool "Raspberry Pi Pico PIO I2S controller driver"
	default y
	depends on DT_HAS_RASPBERRYPI_PICO_I2S_PIO_ENABLED
	select PICOSDK_USE_PIO
	select DMA
	select PINCTRL
	help
	  Enable driving I2S via PIO on the Raspberry Pi Pico

if I2S_RPI_PICO_PIO

config I2S_RPI_PICO_PIO_RX_QUEUE_SIZE
	int "RX queue length"
	default 8
	help
	  Number of blocks the RX software queue can hold.

config I2S_RPI_PICO_PIO_TX_QUEUE_SIZE
	int "TX queue length"
	default 8
	help
	  Number of blocks the TX software queue can hold.

endif # I2S_RPI_PICO_PIO
```

## drivers/i2s/Kconfig.silabs_usart
```kconfig
# Copyright (c) 2026 Silicon Laboratories Inc.
# SPDX-License-Identifier: Apache-2.0

menuconfig I2S_SILABS_USART
	bool "Silicon Labs USART I2S (Series 2)"
	default y
	depends on DT_HAS_SILABS_USART_I2S_ENABLED
	depends on DT_HAS_SILABS_LDMA_ENABLED
	depends on CLOCK_CONTROL
	select DMA
	select PINCTRL
	select SILABS_SISDK_USART
	help
	  I2S over USART synchronous mode with I2SCTRL enabled (Series 2+ and
	  similar). Audio data is transferred using the SoC LDMA controller
	  (requires ``dmas`` / ``dma-names`` on the USART I2S devicetree node).
	  TX (stereo and mono) is supported; RX is not supported yet.
	  Bit clock runs only while TX data is active; ``i2s_configure()``
	  must set ``I2S_OPT_BIT_CLK_GATED`` (``I2S_OPT_BIT_CLK_CONT`` returns
	  ``-EINVAL``).

if I2S_SILABS_USART

config I2S_SILABS_USART_TX_BLOCK_COUNT
	int "TX queue depth (memory blocks)"
	default 4
	range 2 16

endif # I2S_SILABS_USART
```

## drivers/i2s/Kconfig.stm32
```kconfig
# STM32 I2S driver configuration options

# Copyright (c) 2018 STMicroelectronics
# SPDX-License-Identifier: Apache-2.0

menuconfig I2S_STM32
	bool "STM32 MCU I2S controller driver"
	default y
	depends on DT_HAS_ST_STM32_I2S_ENABLED
	select CACHE_MANAGEMENT if DCACHE
	select DMA
	select PINCTRL
	help
	  Enable I2S support on the STM32 family of processors.
	  (Tested on the STM32F4 & STM32H7 series)

if I2S_STM32

config I2S_STM32_RX_BLOCK_COUNT
	int "RX queue length"
	default 4

config I2S_STM32_TX_BLOCK_COUNT
	int "TX queue length"
	default 4

endif # I2S_STM32

menuconfig I2S_STM32_SAI
	bool "STM32 MCU SAI controller driver"
	default y
	depends on DT_HAS_ST_STM32_SAI_ENABLED
	select CACHE_MANAGEMENT if DCACHE
	select DMA
	select USE_STM32_HAL_SAI
	select USE_STM32_HAL_SAI_EX if SOC_SERIES_STM32F4X
	help
	  Enable SAI support on the STM32 family of processors.

if I2S_STM32_SAI

config I2S_STM32_SAI_BLOCK_COUNT
	int "SAI queue length"
	default 4

config I2S_STM32_SAI_MCLK_CLOCK_CONTROL
	bool "STM32 SAI MCLK clock control provider"
	help
	  Expose the MCLK output of each SAI sub-block through the clock
	  control API. This allows consumers, such as audio codecs, to
	  reference the MCLK clock using a clocks phandle to the "mclk"
	  child node and retrieve its configured rate.

endif # I2S_STM32_SAI
```

## drivers/i2s/Kconfig.ti_cc27xx
```kconfig
# Copyright (c) 2026 Texas Instruments Incorporated
# SPDX-License-Identifier: Apache-2.0

config I2S_TI_CC27XX
	bool "TI CC27XX I2S driver"
	default y
	depends on DT_HAS_TI_CC27XX_I2S_ENABLED
	select PINCTRL
	help
	  Enable I2S driver for TI CC27XX SoCs.

	  The CC27XX I2S peripheral supports:
	  - Controller and Target modes
	  - Dual-phase (I2S, LJF, RJF) and single-phase (DSP) formats
	  - 8-24 bits per word
	  - Up to 8 channels per data line
	  - Built-in DMA for data transfer
	  - Configurable clock dividers

if I2S_TI_CC27XX

config I2S_TI_CC27XX_TXQ_SIZE
	int "Max number of messages on TX queue"
	default 16

config I2S_TI_CC27XX_RXQ_SIZE
	int "Max number of messages on RX queue"
	default 16

endif # I2S_TI_CC27XX
```

## drivers/i2s/Kconfig.ti_cc35xx
```kconfig
# Copyright (c) 2026 Conclusive Engineering Sp. z o.o.
# SPDX-License-Identifier: Apache-2.0

menuconfig I2S_TI_CC35XX
	bool "TI CC35XX I2S controller driver"
	default y
	depends on DT_HAS_TI_CC35XX_I2S_ENABLED
	help
	  Enable TI CC35XX I2S controller.

if I2S_TI_CC35XX

config I2S_TI_CC35XX_RXQ_SIZE
	int "Max number of messages on RX queue"
	default 64

config I2S_TI_CC35XX_TXQ_SIZE
	int "Max number of messages on TX queue"
	default 64

endif # I2S_TI_CC35XX
```

## drivers/i3c/Kconfig.dw
```kconfig
# Copyright (c) 2023 Meta Platforms, Inc. and its affiliates.
# Copyright (c) 2026 Microchip Technology Inc.
#
# SPDX-License-Identifier: Apache-2.0

module = I3C_DW
module-str = i3c-dw
source "subsys/logging/Kconfig.template.log_config"

menuconfig I3C_DW
	bool "DW I3C support"
	select I3C_IBI_WORKQUEUE if I3C_USE_IBI && I3C_CONTROLLER
	depends on DT_HAS_SNPS_DESIGNWARE_I3C_ENABLED || DT_HAS_MICROCHIP_XEC_I3C_ENABLED
	depends on CLOCK_CONTROL
	default y
	help
	  Enable the Synopsys DesignWare I3C driver. Supports the upstream
	  snps,designware-i3c compatible and the Microchip XEC variant
	  microchip,xec-i3c, which is the same IP behind an XEC wrapper adding
	  ECIA interrupt routing and a HOST_CFG port-select register.

if I3C_DW

config I3C_DW_RW_TIMEOUT_MS
	int "Set the Read/Write timeout in milliseconds"
	default 100

config I3C_DW_TARGET_BUF_SIZE
	int "Target-mode receive buffer size in bytes"
	depends on I3C_TARGET && I3C_TARGET_BUFFER_MODE
	default 256
	help
	  Size of the buffer a received private write is assembled into before
	  buf_write_received_cb is called. Set it to the RX FIFO size. Anything
	  larger is unreachable, and anything smaller truncates a write the IP
	  received in full. See QUEUE_SIZE_CAPABILITY

endif # I3C_DW
```
