## drivers/i2c/Kconfig
```kconfig
# Copyright (c) 2025, Qingsong Gou <gouqs@hotmail.com>
# SPDX-License-Identifier: Apache-2.0

config I2C_SF32LB
	bool "SF32LB I2C instance"
	default y
	depends on DT_HAS_SIFLI_SF32LB_I2C_ENABLED
	help
	  Enable I2C instance on SF32LB chips.

if I2C_SF32LB

config I2C_SF32LB_INTERRUPT
	bool "SF32LB I2C Interrupt Support"
	help
	  Enable interrupt support on SF32LB chips.

config I2C_SF32LB_DMA
	bool "SF32LB I2C DMA Support"
	select DMA
	help
	  Enable DMA support on SF32LB chips.

endif # I2C_SF32LB
```

## drivers/i2c/Kconfig.ambiq
```kconfig
# Ambiq SDK I2C
#
# Copyright (c) 2023 Antmicro <www.antmicro.com>
#
# SPDX-License-Identifier: Apache-2.0
#

menuconfig I2C_AMBIQ
	bool "AMBIQ I2C driver"
	default y
	depends on DT_HAS_AMBIQ_I2C_ENABLED
	select AMBIQ_HAL
	select AMBIQ_HAL_USE_I2C
	help
	  Enable driver for Ambiq I2C.

if I2C_AMBIQ

config I2C_AMBIQ_HANDLE_CACHE
	bool "Turn on cache handling in i2c driver"
	default y
	depends on CACHE_MANAGEMENT && DCACHE
	help
	  Disable this if cache has been handled in upper layers.

config I2C_AMBIQ_BUS_RECOVERY
	bool "Bus recovery support"
	select I2C_BITBANG
	help
	  Enable AMBIQ driver bus recovery support via GPIO bitbanging.

endif # I2C_AMBIQ
```

## drivers/i2c/Kconfig.ameba
```kconfig
# AMEBA I2C configuration options

# Copyright (c) 2026 Realtek Semiconductor Corp.
# SPDX-License-Identifier: Apache-2.0

config I2C_AMEBA
	bool "AMEBA I2C driver"
	default y
	depends on DT_HAS_REALTEK_AMEBA_I2C_ENABLED
	select PINCTRL
	# the ASYNC implementation requires a DMA controller
	help
	  Enables the AMEBA I2C driver

config I2C_AMEBA_INTERRUPT
	bool "Ameba I2C Interrupt Support"
	depends on I2C_AMEBA
	default n
	help
	  Enable Interrupt support for the I2C Driver

config I2C_ASYNC_API
	bool "Ameba I2C DMA Support"
	depends on I2C_AMEBA
	select DMA
	default n
	help
	  Enable DMQ support for the I2C Driver
```

## drivers/i2c/Kconfig.andes_atciic100
```kconfig
# Kconfig Andes ATCIIC100 configuration option
#
# Copyright (c) 2022 Andes Technology Corporation.
#
# SPDX-License-Identifier: Apache-2.0
#

config I2C_ANDES_ATCIIC100
	bool "Andes ATCIIC100 I2C driver"
	default y
	depends on DT_HAS_ANDESTECH_ATCIIC100_ENABLED
	help
	  Enable driver for the Andes ATCIIC100 I2C controller.
```

## drivers/i2c/Kconfig.atm
```kconfig
# ATM I2C configuration options

# Copyright (c) 2021-2023 Atmosic
# SPDX-License-Identifier: Apache-2.0

menuconfig I2C_ATM
	bool "Atmosic I2C driver"
	default y
	depends on DT_HAS_ATMOSIC_ATM_I2C_ENABLED
	help
	  Enables the ATM I2C driver

if I2C_ATM

config I2C_0
	default y
	bool "Enable I2C Port 0"

config I2C_1
	default y
	bool "Enable I2C Port 1"

config I2C_ATM_TIMEOUT
	int "I2C busy wait timeout to receive a data bit"
	default 100000

if I2C_0

config I2C_ATM_0_IRQ
	int "Port 0 IRQ line"
	default 4

endif # I2C_0

if I2C_1

config I2C_ATM_1_IRQ
	int "Port 1 IRQ line"
	default 5

endif # I2C_1

endif # I2C_ATM
```

## drivers/i2c/Kconfig.atmel_sam3
```kconfig
# Kconfig.atmel_sam3 - Atmel SAM3 I2C configuration options
#
#
# Copyright (c) 2016 Intel Corporation
#
# Licensed under the Apache License, Version 2.0 (the "License");
# you may not use this file except in compliance with the License.
# You may obtain a copy of the License at
#
#     http://www.apache.org/licenses/LICENSE-2.0
#
# Unless required by applicable law or agreed to in writing, software
# distributed under the License is distributed on an "AS IS" BASIS,
# WITHOUT WARRANTIES OR CONDITIONS OF ANY KIND, either express or implied.
# See the License for the specific language governing permissions and
# limitations under the License.
#

menuconfig I2C_ATMEL_SAM3
	bool "Atmel SAM3 I2C Driver"
	depends on I2C && SOC_ATMEL_SAM3
	default n
	help
	Enable I2C support on the Atmel SAM3 family processor.

	Says y to enable additional options to enable support
	for individual controllers.

if I2C_ATMEL_SAM3

config I2C_ATMEL_SAM3_0
	bool "Atmel SAM3 I2C Controller 0 (TWI0)"
	depends on I2C_ATMEL_SAM3
	default n
	help
	Build driver for thw I2C Controller #0 (TWI0).

	Says y if you intend to use the TWI0.

config I2C_ATMEL_SAM3_0_NAME
	string "Device name for Atmel SAM3 I2C Controller 0"
	depends on I2C_ATMEL_SAM3_0
	default "I2C0"
	help
	The device name for Atmel SAM3 I2C Controller 0.

	Default is "I2C0".

config I2C_ATMEL_SAM3_0_INT_PRIORITY
	int "IRQ Priority for Atmel SAM3 I2C Controller 0"
	depends on I2C_ATMEL_SAM3_0
	default 2
	help
	IRQ priority for Atmel SAM3 I2C Controller 0.

	Default is 2.

config I2C_ATMEL_SAM3_0_DEFAULT_CFG
	hex "Default configuration for Atmel SAM3 I2C Controller 0"
	depends on I2C_ATMEL_SAM3_0
	default 0x12
	help
	Allows the I2C port to be brought up with a default configuration.
	This is useful to set if other drivers depend upon using the I2C bus
	before the application has a chance to custom configure the port.
	Setting this value does not prohibit the application from customizing
	the values later.  Refer to the I2C driver for proper values.

	Default is 0x12 (master mode, standard speed).

config I2C_ATMEL_SAM3_1
	bool "Atmel SAM3 I2C Controller 1 (TWI1)"
	depends on I2C_ATMEL_SAM3
	default n
	help
	Build driver for thw I2C Controller #1 (TWI1).

	Says y if you intend to use the TWI1.

config I2C_ATMEL_SAM3_1_NAME
	string "Device name for Atmel SAM3 I2C Controller 1"
	depends on I2C_ATMEL_SAM3_1
	default "I2C1"
	help
	The device name for Atmel SAM3 I2C Controller 1.

	Default is "I2C1".

config I2C_ATMEL_SAM3_1_INT_PRIORITY
	int "IRQ Priority for Atmel SAM3 I2C Controller 1"
	depends on I2C_ATMEL_SAM3_1
	default 2
	help
	IRQ priority for Atmel SAM3 I2C Controller 1.

	Default is 2.

config I2C_ATMEL_SAM3_1_DEFAULT_CFG
	hex "Default configuration for Atmel SAM3 I2C Controller 1"
	depends on I2C_ATMEL_SAM3_1
	default 0x12
	help
	Allows the I2C port to be brought up with a default configuration.
	This is useful to set if other drivers depend upon using the I2C bus
	before the application has a chance to custom configure the port.
	Setting this value does not prohibit the application from customizing
	the values later.  Refer to the I2C driver for proper values.

	Default is 0x12 (master mode, standard speed).

endif # I2C_ATMEL_SAM3
```

## drivers/i2c/Kconfig.b91
```kconfig
# Copyright (c) 2021 Telink Semiconductor
# SPDX-License-Identifier: Apache-2.0

config I2C_TELINK_B91
	bool "Telink Semiconductor B91 I2C driver"
	default y
	depends on DT_HAS_TELINK_B91_I2C_ENABLED
	help
	  Enables Telink B91 I2C driver.
```

## drivers/i2c/Kconfig.b9x
```kconfig
# Copyright (c) 2021-2023 Telink Semiconductor
# SPDX-License-Identifier: Apache-2.0

config I2C_TELINK_B9X
	bool "Telink Semiconductor B9x I2C driver"
	default y
	depends on DT_HAS_TELINK_B9X_I2C_ENABLED
	help
	  Enables Telink B9x I2C driver.
```

## drivers/i2c/Kconfig.bcm2711
```kconfig
# Copyright (c) 2026 Muhammad Waleed Badar
# SPDX-License-Identifier: Apache-2.0

config I2C_BCM2711
	bool "Broadcom BCM2711 I2C controller"
	default y
	depends on DT_HAS_BRCM_BCM2711_I2C_ENABLED
	help
	  Enable support for Broadcom BCM2711 I2C controller.

config I2C_BCM2711_BUS_RECOVERY
	bool "Bus recovery support"
	depends on I2C_BCM2711
	select I2C_BITBANG
	help
	  Enable BCM2711 driver bus recovery support via GPIO bitbanging.
```

## drivers/i2c/Kconfig.bcm_iproc
```kconfig
# Copyright 2020 Broadcom
# Copyright 2024 Meta Platforms
# SPDX-License-Identifier: Apache-2.0

config I2C_IPROC
	bool "Broadcom iProc I2C controller"
	default y
	depends on DT_HAS_BRCM_IPROC_I2C_ENABLED
	help
	  Enable support for Broadcom iProc I2C controller.
```

## drivers/i2c/Kconfig.bflb
```kconfig
# Copyright (c) 2024-2025 MASSDRIVER EI (massdriver.space)
# SPDX-License-Identifier: Apache-2.0

config I2C_BFLB
	bool "Bouffalolab I2C driver"
	default y
	depends on DT_HAS_BFLB_I2C_ENABLED
	select I2C_TRANSFER_TIMEOUT_SUPPORTED
	help
	  I2C driver support for Bouffalolab platforms
```

## drivers/i2c/Kconfig.cc13xx_cc26xx
```kconfig
# Copyright (c) 2019 Brett Witherspoon
# SPDX-License-Identifier: Apache-2.0

config I2C_CC13XX_CC26XX
	bool "TI SimpleLink CC13xx / CC26xx I2C driver"
	default y
	depends on DT_HAS_TI_CC13XX_CC26XX_I2C_ENABLED
	select PINCTRL
	help
	  Enable support for I2C on the TI SimpleLink CC13xx / CC26xx series.
```

## drivers/i2c/Kconfig.cc23x0
```kconfig
# Copyright (c) 2024 Baylibre, SAS
#
# SPDX-License-Identifier: Apache-2.0

config I2C_CC23X0
	bool "TI SimpleLink CC23x0 I2C driver"
	default y
	depends on DT_HAS_TI_CC23X0_I2C_ENABLED
	select PINCTRL
	help
	  Enable support for I2C on the TI SimpleLink CC23x0 series.
```

## drivers/i2c/Kconfig.cdns
```kconfig
# Copyright 2025 Advanced Micro Devices, Inc.
#
# SPDX-License-Identifier: Apache-2.0

config I2C_CADENCE
	bool "Cadence I2C driver"
	default y
	depends on DT_HAS_CDNS_I2C_ENABLED
	select EVENTS
	help
	  Enable Cadence I2C driver.

if I2C_CADENCE

config I2C_CADENCE_BROKEN_HOLD_BIT
	bool "Workaround for errata condition found on the Zynq-7000"
	default n
	help
	  Disallows message transfers with a repeated start condition following a read operation. Also
	  disables interrupts between the address register write and control register write during
	  message reception, to prevent transfer size register rollover.

endif # I2C_CADENCE
```

## drivers/i2c/Kconfig.dw
```kconfig
# Copyright (c) 2018 Intel Corporation
# SPDX-License-Identifier: Apache-2.0

menuconfig I2C_DW
	bool "Design Ware I2C support"
	default y
	depends on DT_HAS_SNPS_DESIGNWARE_I2C_ENABLED
	help
	  Enable the Design Ware I2C driver

config I2C_DW_CLOCK_SPEED
	int "Set the clock speed for I2C"
	depends on I2C_DW
	default 32

config I2C_DW_LPSS_DMA
	bool "Use I2C integrated DMA for asynchronous transfer"
	depends on I2C_DW
	select DMA
	select DMA_INTEL_LPSS
	help
	  This option enables I2C DMA feature to be used for asynchronous
	  data transfers. All Tx operations are done using dma channel 0 and
	  all Rx operations are done using dma channel 1.

config I2C_DW_RW_TIMEOUT_MS
	int "Set the Read/Write timeout in milliseconds"
	depends on I2C_DW
	default 100
```

## drivers/i2c/Kconfig.ene
```kconfig
# Copyright (c) 2024 ENE Technology Inc.
# SPDX-License-Identifier: Apache-2.0

config I2C_ENE_KB1200
	bool "ENE KB1200 I2C driver"
	default y
	depends on DT_HAS_ENE_KB1200_I2C_ENABLED
	select PINCTRL
	help
	  Enable the ENE KB1200 I2C driver.

config I2C_ENE_KB106X
	bool "ENE KB106X I2C driver"
	default y
	depends on DT_HAS_ENE_KB106X_I2C_ENABLED
	select PINCTRL
	help
	  Enable the ENE KB106X I2C driver.
```

## drivers/i2c/Kconfig.eos_s3
```kconfig
# Copyright (c) 2023 Jakub Duchniewicz
# SPDX-License-Identifier: Apache-2.0

config I2C_EOS_S3
	bool "EOS S3 SoC I2C driver"
	default y
	depends on DT_HAS_EOS_S3_ENABLED
	help
	  Enables EOS S3 I2C via Wishbone bus driver.
```

## drivers/i2c/Kconfig.esp32
```kconfig
# ESP32 I2C configuration options

# Copyright (c) 2017 Intel Corporation
# Copyright (c) 2021 Espressif Systems (Shanghai) Co., Ltd.
# SPDX-License-Identifier: Apache-2.0

config I2C_ESP32
	bool "ESP32 I2C driver"
	default y
	depends on DT_HAS_ESPRESSIF_ESP32_I2C_ENABLED
	select GPIO_ESP32
	help
	  Enables the ESP32 I2C driver.

	  When CONFIG_I2C_TARGET is also enabled, the driver exposes I2C
	  target callbacks. Target mode relies on the SCL stretch-cause
	  hardware feature and is supported on ESP32-S2, ESP32-S3,
	  ESP32-C3, ESP32-C5, ESP32-C6 and ESP32-H2. ESP32 and ESP32-C2
	  are excluded.

config I2C_ESP32_TARGET_BUF
	int "ESP32 I2C target buffered RX size"
	depends on I2C_ESP32 && I2C_TARGET && I2C_TARGET_BUFFER_MODE
	range 32 1024
	default 256
	help
	  Size in bytes of the per-instance RX buffer used by the ESP32
	  I2C target driver when CONFIG_I2C_TARGET_BUFFER_MODE is
	  enabled. Bytes received during a write transaction are cached
	  until the master issues STOP, at which point buf_write_received
	  is invoked once with the accumulated data. Reads stream out of
	  the pointer supplied by buf_read_requested and are not bounded
	  by this size.
```

## drivers/i2c/Kconfig.gd32
```kconfig
# Copyright (c) 2021 BrainCo Inc.
# SPDX-License-Identifier: Apache-2.0

config I2C_GD32
	bool "GigaDevice GD32 I2C driver"
	default y
	depends on DT_HAS_GD_GD32_I2C_ENABLED
	help
	  Enables GigaDevice GD32 I2C driver
```

## drivers/i2c/Kconfig.gpio
```kconfig
# Copyright (c) 2017 Linaro Ltd.
# SPDX-License-Identifier: Apache-2.0

config I2C_GPIO
	bool "GPIO bit banging I2C support"
	default y
	depends on DT_HAS_GPIO_I2C_ENABLED
	select I2C_BITBANG
	help
	  Enable software driven (bit banging) I2C support using GPIO pins

if I2C_GPIO

config I2C_GPIO_CLOCK_STRETCHING
	bool "GPIO bit banging I2C clock stretching support"
	default y
	help
	  Enable Slave clock stretching support

config I2C_GPIO_CLOCK_STRETCHING_TIMEOUT_US
	int "GPIO bit banging I2C clock stretching timeout (us)"
	default 100000
	help
	  Timeout for clock stretching in microseconds.

endif # I2C_GPIO
```

## drivers/i2c/Kconfig.i2c_emul
```kconfig
# Copyright 2020 Google LLC
# SPDX-License-Identifier: Apache-2.0

config I2C_EMUL
	bool "I2C emulator"
	default y
	depends on DT_HAS_ZEPHYR_I2C_EMUL_CONTROLLER_ENABLED
	help
	  Enable the I2C emulator driver. This is a fake driver in that it
	  does not talk to real hardware. Instead it talks to emulation
	  drivers that pretend to be devices on the emulated I2C bus. It is
	  used for testing drivers for I2C devices.
```

## drivers/i2c/Kconfig.i2c_pec_test_emul
```kconfig
# Copyright 2023 Google LLC
# SPDX-License-Identifier: Apache-2.0

config I2C_PEC_TEST_EMUL
	bool "I2C echo device with PEC emulator"
	default y
	depends on DT_HAS_ZEPHYR_I2C_PEC_TEST_ENABLED
	depends on EMUL
	help
	  Enable I2C echo device with PEC emulator. This is an emulated device which
	  is intended to be used for testing I2C PEC code.

if I2C_PEC_TEST_EMUL

config I2C_PEC_TEST_EMUL_BUFFER_SIZE
	int "Size of internal buffer in bytes"
	default 16
	help
	  The size of the internal buffer used by I2C echo devices with PEC.

endif # I2C_PEC_TEST_EMUL
```

## drivers/i2c/Kconfig.ifx_cat1
```kconfig
# Infineon CAT1 I2C configuration options

# Copyright (c) 2023 Cypress Semiconductor Corporation (an Infineon company) or
# an affiliate of Cypress Semiconductor Corporation
#
# SPDX-License-Identifier: Apache-2.0

config I2C_INFINEON_CAT1
	bool "Infineon CAT1 I2C driver"
	default y
	depends on DT_HAS_INFINEON_CAT1_I2C_ENABLED
	select USE_INFINEON_I2C
	select PINCTRL
	help
	  This option enables the I2C driver for Infineon CAT1 family.

config I2C_PDL_INFINEON_CAT1
	bool "Infineon CAT1 I2C driver (PDL)"
	default y
	depends on DT_HAS_INFINEON_CAT1_I2C_PDL_ENABLED
	select USE_INFINEON_I2C
	select PINCTRL
	help
	  This option enables the I2C driver for the Infineon CAT1 family.

config I2C_INFINEON_CAT1_TARGET_BUF
	int "I2C Target data buffer length"
	depends on USE_INFINEON_I2C
	range 1 1024
	default 64
	help
	  Buffer to receive data as an I2C Target.
```

## drivers/i2c/Kconfig.infineon_xmc4
```kconfig
# Infineon XMC4 I2C configuration options

# Copyright (c) 2023 Cypress Semiconductor Corporation (an Infineon company) or
# an affiliate of Cypress Semiconductor Corporation
#
# SPDX-License-Identifier: Apache-2.0

menuconfig I2C_INFINEON_XMC4
	bool "Infineon XMC4 I2C driver"
	default y
	depends on DT_HAS_INFINEON_XMC4XXX_I2C_ENABLED
	select PINCTRL
	help
	  This option enables the I2C driver for Infineon XMC4 family.

config I2C_INFINEON_XMC4_TARGET_BUF
	int "I2C Target data buffer length"
	depends on I2C_INFINEON_XMC4
	range 1 1024
	default 64
	help
	  Buffer to receive data as an I2C Target.
```
