## drivers/dac/Kconfig.dacx3608
```kconfig
# DAC configuration options

# Copyright (c) 2020 Matija Tudan
#
# SPDX-License-Identifier: Apache-2.0

config DAC_DACX3608
	bool "TI DACX3608 DAC driver"
	default y
	depends on I2C
	depends on DT_HAS_TI_DAC43608_ENABLED || DT_HAS_TI_DAC53608_ENABLED
	help
	  Enable the driver for the TI DACX3608.

if DAC_DACX3608

config DAC_DACX3608_INIT_PRIORITY
	int "Init priority"
	default 80
	help
	  TI DACX3608 DAC device driver initialization priority.

endif # DAC_DACX3608
```

## drivers/dac/Kconfig.esp32
```kconfig
# ESP32 DAC configuration options

# Copyright (c) 2022 Espressif Systems (Shanghai) Co., Ltd.
# SPDX-License-Identifier: Apache-2.0

config DAC_ESP32
	bool "ESP32 DAC driver"
	default y
	depends on DT_HAS_ESPRESSIF_ESP32_DAC_ENABLED
	help
	  Enable the ESP32 DAC driver
```

## drivers/dac/Kconfig.gd32
```kconfig
# DAC configuration options

# Copyright (c) 2021 BrainCo Inc.
#
# SPDX-License-Identifier: Apache-2.0

config DAC_GD32
	bool "GD32 DAC driver"
	default y
	depends on DT_HAS_GD_GD32_DAC_ENABLED
	help
	  Enable GigaDevice GD32 DAC driver
```

## drivers/dac/Kconfig.infineon_autanalog_ctdac
```kconfig
# Copyright (c) 2026 Infineon Technologies AG,
# or an affiliate of Infineon Technologies AG.
#
# SPDX-License-Identifier: Apache-2.0

# Infineon AutAnalog CT DAC configuration options

config DAC_INFINEON_AUTANALOG
	bool "Infineon AutAnalog CT DAC driver"
	default y
	depends on DT_HAS_INFINEON_AUTANALOG_CTDAC_ENABLED
	select MFD
	help
	  This option enables the CT DAC driver for Infineon MCUs using
	  the AutAnalog CT DAC subsystem. The CT DAC is a 12-bit
	  continuous-time segmented DAC. This driver supports FW channel
	  (#15) for direct value writes via the Zephyr DAC API, and
	  waveform channels (#0-#14) for autonomous LUT-based output.

config DAC_INFINEON_AUTANALOG_INIT_PRIORITY
	int "Infineon AutAnalog DAC init priority"
	default 43
	depends on DAC_INFINEON_AUTANALOG
	help
	  Initialization priority for the AutAnalog DAC driver.  Must be
	  higher than CONFIG_MFD_INFINEON_AUTANALOG_INIT_PRIORITY (MFD parent)
	  and lower than CONFIG_MFD_INFINEON_AUTANALOG_AC_START_PRIORITY so
	  that the DAC hardware configuration is loaded before the Autonomous
	  Controller starts and triggers the DAC via the STT.
```

## drivers/dac/Kconfig.infineon_hppass_csg
```kconfig
# SPDX-FileCopyrightText: <text>Copyright (c) 2026 Infineon Technologies AG,
# or an affiliate of Infineon Technologies AG. All rights reserved.</text>
#
# SPDX-License-Identifier: Apache-2.0

config DAC_INFINEON_HPPASS_CSG
	bool "Infineon HPPASS CSG DAC driver"
	default y
	depends on DT_HAS_INFINEON_HPPASS_CSG_DAC_ENABLED
	select MFD
	help
	  Enable the DAC driver for the Infineon HPPASS CSG block. Each instance
	  exposes one CSG slice's 10-bit DAC through the Zephyr DAC API in
	  direct-write mode.  Advanced modes (buffered, hysteretic, slope, LUT)
	  are not yet supported.

config DAC_INFINEON_HPPASS_CSG_INIT_PRIORITY
	int "Infineon HPPASS CSG DAC init priority"
	default 50
	depends on DAC_INFINEON_HPPASS_CSG
	help
	  Initialization priority for the per-slice DAC child driver.  Must be
	  higher (later) than CONFIG_MFD_INFINEON_HPPASS_CSG_INIT_PRIORITY so
	  the CSG MFD parent is ready before this driver runs.
```

## drivers/dac/Kconfig.ltc166x
```kconfig
# DAC configuration options

# Copyright (C) 2023 Marcus Folkesson <marcus.folkesson@gmail.com>
#
# SPDX-License-Identifier: Apache-2.0

config DAC_LTC166X
	bool "Linear Technology LTC166X DAC"
	default y
	select SPI
	depends on DT_HAS_LLTC_LTC1660_ENABLED || DT_HAS_LLTC_LTC1665_ENABLED
	help
	  Enable the driver for the Linear Technology LTC166X DAC

if DAC_LTC166X

config DAC_LTC166X_INIT_PRIORITY
	int "Init priority"
	default 80
	help
	  Linear Technology LTC166X DAC device driver initialization priority.

endif # DAC_LTC166X
```

## drivers/dac/Kconfig.max22017
```kconfig
# Copyright (c) 2024 Analog Devices Inc.
# Copyright (c) 2024 BayLibre SAS
# SPDX-License-Identifier: Apache-2.0

config DAC_MAX22017
	bool "Analog Devices MAX22017 DAC"
	default y
	depends on DT_HAS_ADI_MAX22017_DAC_ENABLED
	select MFD
	help
	  Enable the driver for the Analog Devices MAX22017 DAC

if DAC_MAX22017

config DAC_MAX22017_INIT_PRIORITY
	int "Init priority"
	default 80
	help
	  Analog Devices MAX22017 DAC device driver initialization priority.

endif # DAC_MAX22017
```

## drivers/dac/Kconfig.mchp
```kconfig
# Copyright (c) 2025-2026 Microchip Technology Inc.
# SPDX-License-Identifier: Apache-2.0

config DAC_MCHP_G1
	bool "Microchip G1 DAC Driver"
	depends on DT_HAS_MICROCHIP_DAC_G1_ENABLED
	default y
	select PINCTRL
	help
	  Enable support for the Microchip DAC driver on G1 DAC peripherals.

if DAC_MCHP_G1

config DAC_MCHP_G1_DIFFERENTIAL
	bool "Differential Mode"
	help
	  Enable Differential Mode support for G1 DAC

endif # DAC_MCHP_G1
```

## drivers/dac/Kconfig.mcp4725
```kconfig
# DAC configuration options

# Copyright (c) 2021 Laird Connectivity
#
# SPDX-License-Identifier: Apache-2.0

config DAC_MCP4725
	bool "Microchip MCP4725 DAC driver"
	default y
	select I2C
	depends on DT_HAS_MICROCHIP_MCP4725_ENABLED
	help
	  Enable the driver for the Microchip MCP4725.

if DAC_MCP4725

config DAC_MCP4725_INIT_PRIORITY
	int "Init priority"
	default 80
	help
	  Microchip MCP4725 DAC device driver initialization priority.

endif # DAC_MCP4725
```

## drivers/dac/Kconfig.mcp4728
```kconfig
# Copyright 2021 Grinn
#
# SPDX-License-Identifier: Apache-2.0

config DAC_MCP4728
	bool "Microchip MCP4728 DAC driver"
	default y
	select I2C
	depends on DT_HAS_MICROCHIP_MCP4728_ENABLED
	help
	  Enable driver for the Microchip MCP4728.

if DAC_MCP4728

config DAC_MCP4728_INIT_PRIORITY
	int "Init priority"
	default 80
	help
	  Microchip MCP4728 device driver initialization priority.

endif # DAC_MCP4728
```

## drivers/dac/Kconfig.mcp48xx
```kconfig
# Copyright 2024 Novatech LLC
#
# SPDX-License-Identifier: Apache-2.0

config DAC_MCP48XX
	bool "Microchip MCP48XX DAC driver"
	select SPI
	help
	  Enable driver for the Microchip MCP48xx series DAC devices.

if DAC_MCP48XX

config DAC_MCP48XX_INIT_PRIORITY
	int "Init Priority"
	default 80
	help
	  Microchip MCP48xx DAC device driver initialization priority.

endif
```

## drivers/dac/Kconfig.mcux
```kconfig
# DAC configuration options

# Copyright (c) 2020 Henrik Brix Andersen <henrik@brixandersen.dk>
#
# SPDX-License-Identifier: Apache-2.0

config DAC_MCUX_DAC
	bool "NXP Kinetis MCUX DAC driver"
	default y
	depends on DT_HAS_NXP_KINETIS_DAC_ENABLED
	help
	  Enable the driver for the NXP Kinetis MCUX DAC.

config DAC_MCUX_DAC32
	bool "NXP Kinetis MCUX DAC32 driver"
	default y
	depends on DT_HAS_NXP_KINETIS_DAC32_ENABLED
	select PINCTRL
	help
	  Enable the driver for the NXP Kinetis MCUX DAC32.

config DAC_MCUX_LPDAC
	bool "NXP MCUX LPDAC driver"
	default y
	depends on DT_HAS_NXP_LPDAC_ENABLED
	help
	  Enable the driver for the NXP MCUX LPDAC.

config DAC_MCUX_DAC32_TESTOUT
	bool "DAC test output"
	depends on DAC_MCUX_DAC32
	help
	  Enable the DAC test output.

config DAC_MCUX_GAU
	bool "NXP GAU DAC driver"
	default y
	depends on DT_HAS_NXP_GAU_DAC_ENABLED
	help
	  Enable the driver for the NXP GAU DAC.
```

## drivers/dac/Kconfig.pic32cxsg
```kconfig
# Copyright (c) 2024 Microchip
# SPDX-License-Identifier: Apache-2.0

config DAC_PIC32CXSG
	bool "Microchip PIC32CXSG series DAC Driver"
	default y
	depends on DT_HAS_PIC32CXSG_DAC_ENABLED
	help
	  Enables the Microchip PIC32CXSG MCU Family Digital-to-Analog (DAC) driver.
```

## drivers/dac/Kconfig.renesas_ra
```kconfig
# Copyright (c) 2025 Renesas Electronics Corporation
# SPDX-License-Identifier: Apache-2.0

config DAC_RENESAS_RA
	bool "Renesas RA DAC"
	default y
	depends on DT_HAS_RENESAS_RA_DAC_ENABLED
	select USE_RA_FSP_DAC
	select PINCTRL
	help
	  Enable Renesas RA DAC Driver.

if DAC_RENESAS_RA
config DAC_RENESAS_RA_DA_AD_SYNCHRONIZE
	bool "D/A A/D Synchronous Conversion"
	help
	  - n: Do not synchronize DAC12 with ADC (unit 1) operation
	  (disable interference reduction between D/A and A/D conversion).
	  - y: Synchronize DAC12 with ADC (unit 1) operation
	  (enable interference reduction between D/A and A/D conversion).

choice DAC_RENESAS_RA_DAVREFCR
	prompt "D/A Reference Voltage"
	depends on $(dt_nodelabel_bool_prop,dac_global,has-davrefcr)
	default DAC_RENESAS_RA_DAVREFCR_AVCC0_AVSS0

config DAC_RENESAS_RA_DAVREFCR_NONE
	bool "No reference voltage selected"
	help
	  No reference voltage selected

config DAC_RENESAS_RA_DAVREFCR_AVCC0_AVSS0
	bool "Using AVCC0/AVSS0 for reference voltage source"
	help
	  AVCC0/AVSS0 selected

config DAC_RENESAS_RA_DAVREFCR_VREFH_VREFL
	bool "Using VREFH/VREFL for reference voltage source"
	help
	  VREFH/VREFL selected

endchoice #DAC_RENESAS_RA_DAVREFCR
endif # DAC_RENESAS_RA
```

## drivers/dac/Kconfig.sam
```kconfig
# Copyright (c) 2021 Piotr Mienkowski
# SPDX-License-Identifier: Apache-2.0
#

config DAC_SAM
	bool "Atmel SAM DAC driver"
	default y
	depends on DT_HAS_ATMEL_SAM_DAC_ENABLED
	select PINCTRL
	help
	  Enable Atmel SAM MCU Family Digital Audio Converter (DAC) driver.
```

## drivers/dac/Kconfig.sam0
```kconfig
# Copyright (c) 2020 Google LLC
# SPDX-License-Identifier: Apache-2.0

config DAC_SAM0
	bool "Atmel SAM0 series DAC Driver"
	default y
	depends on DT_HAS_ATMEL_SAM0_DAC_ENABLED
	help
	  Enables the Atmel SAM0 MCU Family Digital-to-Analog (DAC) driver.
```

## drivers/dac/Kconfig.samd5x
```kconfig
# Copyright (c) 2025 Daikin Comfort Technologies North America, Inc.
# SPDX-License-Identifier: Apache-2.0

config DAC_SAMD5X
	bool "Atmel SAMD5x series DAC Driver"
	default y
	depends on DT_HAS_ATMEL_SAMD5X_DAC_ENABLED
	select PINCTRL
	help
	  Enables the Atmel SAMD5x MCU Family Digital-to-Analog Converter(DAC) driver.
```

## drivers/dac/Kconfig.silabs
```kconfig
# Copyright (c) 2025 Silicon Laboratories Inc.
# SPDX-License-Identifier: Apache-2.0

config DAC_SILABS_VDAC
	bool "Silabs DAC driver for VDAC"
	default y
	depends on DT_HAS_SILABS_VDAC_ENABLED
	select PINCTRL
	select SILABS_SISDK_VDAC
	help
	  Enable the Digital-to-Analog Converter driver for the
	  VDAC hardware block present on Silicon Labs devices.
```

## drivers/dac/Kconfig.stm32
```kconfig
# DAC configuration options

# Copyright (c) 2020 Libre Solar Technologies GmbH
#
# SPDX-License-Identifier: Apache-2.0

config DAC_STM32
	bool "STM32 DAC driver"
	default y
	depends on DT_HAS_ST_STM32_DAC_ENABLED
	select PINCTRL
	help
	  Enable the driver implementation for the stm32xx DAC
```

## drivers/dac/Kconfig.test
```kconfig
# Copyright (c) 2024 TOKITA Hiroshi
# SPDX-License-Identifier: Apache-2.0

config DAC_TEST
	def_bool DT_HAS_VND_DAC_ENABLED
	depends on DT_HAS_VND_DAC_ENABLED
```

## drivers/dai/Kconfig
```kconfig
# Dai driver configuration options

# Copyright (c) 2022 Intel Corporation
# SPDX-License-Identifier: Apache-2.0

#
# DAI Drivers
#
menuconfig DAI
	bool "Digital Audio Interface (DAI) drivers"
	help
	  Enable support for the DAI interface drivers.

if DAI

config DAI_INIT_PRIORITY
	int "Init priority"
	default 70
	help
	  Device driver initialization priority.

config DAI_USERSPACE
	bool "DAI user-space support"
	depends on USERSPACE
	help
	  Expose the DAI interface to user-space threads via syscalls.

config DAI_MAX_BESPOKE_CFG_SIZE
	int "Maximum bespoke configuration blob size"
	default 1024
	depends on DAI_USERSPACE
	range 256 4096
	help
	  Maximum size of bespoke configuration objects passed to the DAI
	  driver via syscalls. The objects are temporarily allocated on the
	  stack for validation when copied from user-space to kernel memory.

module = DAI
module-str = dai
source "subsys/logging/Kconfig.template.log_config"

comment "Device Drivers"

# zephyr-keep-sorted-start
source "drivers/dai/intel/alh/Kconfig.alh"
source "drivers/dai/intel/dmic/Kconfig.dmic"
source "drivers/dai/intel/hda/Kconfig.hda"
source "drivers/dai/intel/ssp/Kconfig.ssp"
source "drivers/dai/intel/uaol/Kconfig.uaol"
source "drivers/dai/nxp/esai/Kconfig.esai"
source "drivers/dai/nxp/micfil/Kconfig.micfil"
source "drivers/dai/nxp/sai/Kconfig.sai"
# zephyr-keep-sorted-stop

endif # DAI
```

## drivers/dai/amd/sdw/Kconfig.acp_sdw_dai
```kconfig
# SPDX-FileCopyrightText: Copyright The Zephyr Project Contributors
# Copyright (c) 2026 AMD
# SPDX-License-Identifier: Apache-2.0

config DAI_AMD_SDW
	bool "AMD SoundWire DAI driver"
	default y
	depends on DAI && DT_HAS_AMD_ACP_SDW_DAI_ENABLED
	help
	  Select this to enable AMD SoundWire DAI driver.
```

## drivers/dai/amd/tdm/Kconfig.acp_tdm_dai
```kconfig
# SPDX-FileCopyrightText: Copyright (c) 2026 AMD
# SPDX-License-Identifier: Apache-2.0

config DAI_AMD_TDM
	bool "AMD TDM DAI driver"
	default y
	depends on DT_HAS_AMD_TDM_DAI_ENABLED
	help
	  Enable the unified TDM DAI driver.
	  Handles all three TDM instances: TDM0 (Headset), TDM1 (SP),
	  and TDM2 (Bluetooth).
```

## drivers/dai/intel/alh/Kconfig.alh
```kconfig
# SOF ALH configuration options

# Copyright (c) 2022 Intel Corporation
# SPDX-License-Identifier: Apache-2.0

config DAI_INTEL_ALH
	bool "Intel ALH driver for Dai interface"
	default y
	depends on DT_HAS_INTEL_ALH_DAI_ENABLED
	select DMA
	help
	  Select this to enable Intel ALH driver.
	  The ALH is an intermediary device, which acts as a hub and provides an
	  abstracted support for numerous sound interfaces (e.g. SoundWire).

if DAI_INTEL_ALH

config DAI_ALH_HAS_OWNERSHIP
	bool "Intel ALH driver has ownership only on ACE 1.5"
	default y
	depends on SOC_INTEL_ACE15_MTPM
	help
	  Select this to enable programming HW ownership

endif
```

## drivers/dai/intel/dmic/Kconfig.dmic
```kconfig
# SOF DMIC configuration options

# Copyright (c) 2022 Intel Corporation
# SPDX-License-Identifier: Apache-2.0

config DAI_INTEL_DMIC
	bool "Intel digital PDM microphone driver support for DAI interface"
	default y
	depends on DT_HAS_INTEL_DAI_DMIC_ENABLED
	help
	  Enable Intel digital PDM microphone driver for DAI interface

if DAI_INTEL_DMIC

choice
	prompt "Driver operation mode"
	default DAI_INTEL_DMIC_NHLT
	help
	  The driver can support two operation modes.
	  1. A HW registers dump blob that is passed via IPC
	  2. DAI tokens those describe the use case PCM format
	  and PDM bus and microphone parameters

config DAI_INTEL_DMIC_NHLT
	bool "Use NHLT DMIC blob"
	help
	  All registers configuration is retrieved from blob. The
	  number of channels, sample rate, and PCM format are
	  defined in the blob and there are no runtime made
	  configuration choices.

config DAI_INTEL_DMIC_TPLG_PARAMS
	bool "Use parameters from topology - WIP"
	help
	  All registers configuration is computed on the fly
	  based on use case and microphone datasheet parameters
	  and topology defined PCM format. The parameters are
	  easy to to customize in the topology.
	  WORK IN PROGRESS, not enabled in the driver yet

endchoice

config DAI_DMIC_HAS_OWNERSHIP
	bool "Use DMIC ownership claim/release"
	default n
	help
	 a feature introduced in ACE1.5 hardware
	 dmic ownership must be claimed before use of dmic

config DAI_DMIC_HAS_MULTIPLE_LINE_SYNC
	bool "Use DMIC sync for multiple lines"
	default n
	help
	 a feature introduced in ACE1.5 hardware
	 dmic sync registers must be set before use of dmic

config DAI_DMIC_HW_CONTROLLERS
	int "Number of hardware controllers in the system"
	default 2

config DAI_DMIC_HW_FIFOS
	int "Number of stream FIFOs in DMIC controller"
	default 2

config DAI_DMIC_HW_IOCLK
	int "IO Clock value for DMIC"
	default 19200000

config DAI_DMIC_PLATFORM_SYNC_PERIOD
	int "Sync period per platform"
	default 4000
	help
	  DMIC sync period used for:
	  CONFIG_DAI_DMIC_HW_IOCLK / CONFIG_DAI_DMIC_PLATFORM_SYNC_PERIOD
	  From spec: E.g. for 19.2 MHz XTAL oscillator clock, 4 KHz sync period,
	  the value to be programmed is 4799 (12BFh)

endif
```
