## drivers/usb/uhc/Kconfig.musb
```kconfig
# Copyright The Zephyr Project Contributors
# SPDX-License-Identifier: Apache-2.0

config UHC_MUSB
	bool
	help
	  Mentor Graphics Inventra MUSB host controller core, used by the
	  vendor glue drivers.

if UHC_MUSB

config UHC_MUSB_STACK_SIZE
	int "MUSB driver thread stack size"
	default 1024
	help
	  MUSB host controller driver thread stack size.

config UHC_MUSB_THREAD_PRIORITY
	int "MUSB driver thread priority"
	default 8
	help
	  MUSB host controller driver thread priority.

endif # UHC_MUSB
```

## drivers/usb/uhc/Kconfig.ohci
```kconfig
# SPDX-FileCopyrightText: Copyright The Zephyr Project Contributors
# SPDX-License-Identifier: Apache-2.0

config UHC_OHCI_DMA_COHERENT
	bool
	default $(dt_compat_all_has_prop,$(DT_COMPAT_GENERIC_OHCI),dma-coherent,True)
	help
	  All enabled OHCI controllers are DMA coherent with the CPU caches.

config UHC_OHCI
	bool "Generic OHCI USB host controller driver"
	default y
	depends on DT_HAS_GENERIC_OHCI_ENABLED
	depends on !64BIT
	select NOCACHE_MEMORY if !UHC_OHCI_DMA_COHERENT && DCACHE && ARCH_HAS_NOCACHE_MEMORY_SUPPORT
	select CACHE_MANAGEMENT if !UHC_OHCI_DMA_COHERENT && DCACHE
	# The root hub is presented to the host stack as a hub device
	select USBH_HUB_CLASS if USB_HOST_STACK
	help
	  Generic OHCI USB host controller driver for any OHCI
	  controller (OpenHCI 1.0a compatible). Only supported on
	  32 bit, as OHCI only uses 32 bit registers for addresses.

	  Controllers that are not DMA coherent (no dma-coherent
	  property) keep their descriptors in the nocache memory
	  region and maintain the transfer buffers with cache
	  operations.

if UHC_OHCI

config UHC_OHCI_PCI
	bool
	default y
	depends on $(dt_compat_on_bus,$(DT_COMPAT_GENERIC_OHCI),pcie)
	select PCIE
	select DYNAMIC_INTERRUPTS if !PCIE_CONTROLLER

config UHC_OHCI_BULK_SLOTS
	int "Number of concurrent bulk/interrupt transfer slots"
	range 1 8
	default 4
	help
	  Number of concurrently active bulk/interrupt transfer slots. One slot
	  is always reserved for control transfers. Each additional slot allows
	  one more bulk or interrupt endpoint to stay posted simultaneously
	  (e.g. both IN and OUT for CDC-ECM data plus the interrupt notification
	  endpoint). Memory cost is one ED plus UHC_OHCI_MAX_TDS transfer
	  descriptors per slot.

config UHC_OHCI_MAX_TDS
	int "Maximum TDs per transfer slot"
	range 4 128
	default 64
	help
	  Maximum number of OHCI transfer descriptors per slot. The driver
	  allocates one pool of this size for the control slot and for each
	  bulk/interrupt slot (see UHC_OHCI_BULK_SLOTS).

endif # UHC_OHCI
```

## drivers/usb/uhc/Kconfig.stm32
```kconfig
# Copyright (c) 2026 Hamza Bahri
# SPDX-License-Identifier: Apache-2.0

config UHC_STM32
	bool "STM32 USB_DRD_FS host controller driver [EXPERIMENTAL]"
	default y
	depends on DT_HAS_ST_STM32_USB_ENABLED
	# Only the USB_DRD_FS flavour of st,stm32-usb has host channels.
	depends on SOC_SERIES_STM32H5X
	select EXPERIMENTAL
	select EVENTS
	select USE_STM32_LL_USB
	select USE_STM32_HAL_HCD
	select STM32_USB_COMMON
	select PINCTRL
	help
	  STM32 USB host controller driver for the USB_DRD_FS controller,
	  built on the STM32Cube HAL HCD. Full-speed and low-speed devices,
	  control, bulk and interrupt transfers; isochronous is not supported.
```

## drivers/usb/uhc/Kconfig.virtual
```kconfig
# Copyright (c) 2022 Nordic Semiconductor ASA
# SPDX-License-Identifier: Apache-2.0

config UHC_VIRTUAL
	bool "Virtual USB host controller driver"
	select UVB
	default y
	depends on DT_HAS_ZEPHYR_UHC_VIRTUAL_ENABLED
	help
	  Virtual USB host controller driver.

config UHC_VIRTUAL_STACK_SIZE
	int "Virtual controller driver internal thread stack size"
	depends on UHC_VIRTUAL
	default 512
	help
	  Virtual host controller driver internal thread stack size.

config UHC_VIRTUAL_THREAD_PRIORITY
	int "Virtual controller driver thread priority"
	depends on UHC_VIRTUAL
	default 8
	help
	  Virtual host controller driver thread priority.
```

## drivers/usb_c/vbus/Kconfig.usbc_vbus_adc
```kconfig
# USB-C VBUS device configuration options

# Copyright 2022 The Chromium OS Authors
# SPDX-License-Identifier: Apache-2.0

config USBC_VBUS_ADC
	bool "USB-C VBUS ADC"
	default y
	depends on DT_HAS_ZEPHYR_USB_C_VBUS_ADC_ENABLED
	select GPIO if $(dt_compat_any_has_prop,$(DT_COMPAT_ZEPHYR_USB_C_VBUS_ADC),discharge-gpios) || \
		$(dt_compat_any_has_prop,$(DT_COMPAT_ZEPHYR_USB_C_VBUS_ADC),power-gpios)
	help
	  Measure VBUS with an ADC through a voltage divider
```

## drivers/uwb/Kconfig
```kconfig
# Copyright 2026 NXP
# SPDX-License-Identifier: Apache-2.0

if UWB

rsource "emul/Kconfig"

endif
```

## drivers/uwb/emul/Kconfig
```kconfig
# Copyright 2026 NXP
# SPDX-License-Identifier: Apache-2.0

config UWB_TRANSPORT_EMUL
	bool "Emulated UWB transport backend"
	depends on DT_HAS_ZEPHYR_UWB_EMUL_ENABLED
	default y
	help
	  Selects the pipe-based emulated UWB transport backend.
	  A thread simulates the UWB device and responds to
	  standard UCI commands.
```

## drivers/uwb/nxp/Kconfig
```kconfig
# Copyright 2026 NXP
# SPDX-License-Identifier: Apache-2.0

config NXP_UWB_DEVICE
	bool "NXP UWB Device"
	default n
	select SPI
	select GPIO
	select SPI_ASYNC
	help
	  Enables NXP UWB driver

config NXP_UWB_DEVICE_TX_BUFFER_MAX
	int "NXP SR250 UWB Driver maximum Tx size"
	depends on SHIELD_NXP_SR250
	default 4096


choice "NXP_UWB_LOG_LEVEL_CHOICE"
	prompt "Max compiled-in log level for NXP-UWB"
	default NXP_UWB_LOG_LEVEL_DEFAULT
	depends on LOG

config NXP_UWB_LOG_LEVEL_OFF
	bool "NXP-UWB logging level Off"

config NXP_UWB_LOG_LEVEL_ERR
	bool "NXP-UWB logging level Error"

config NXP_UWB_LOG_LEVEL_WRN
	bool "NXP-UWB logging level Warning"

config NXP_UWB_LOG_LEVEL_INF
	bool "NXP-UWB logging level Info"

config NXP_UWB_LOG_LEVEL_DBG
	bool "NXP-UWB logging level Debug"

config NXP_UWB_LOG_LEVEL_DEFAULT
	bool "NXP-UWB logging level Default"

endchoice

config UWB_NXP_LOG_LEVEL
	int
	depends on LOG
	default 0 if NXP_UWB_LOG_LEVEL_OFF
	default 1 if NXP_UWB_LOG_LEVEL_ERR
	default 2 if NXP_UWB_LOG_LEVEL_WRN
	default 3 if NXP_UWB_LOG_LEVEL_INF
	default 4 if NXP_UWB_LOG_LEVEL_DBG
	default LOG_DEFAULT_LEVEL if NXP_UWB_LOG_LEVEL_DEFAULT
```
