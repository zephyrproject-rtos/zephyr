## drivers/timer/Kconfig.renesas_rh850_ostm
```kconfig
# SPDX-FileCopyrightText: Copyright (c) 2026 Linumiz
#
# SPDX-License-Identifier: Apache-2.0

config RENESAS_RH850_OSTM_TIMER
	bool "Renesas RH850 OS timer (OSTM) system timer"
	default y
	depends on DT_HAS_RENESAS_RH850_OSTM_ENABLED
	select TICKLESS_CAPABLE
	select TIMER_HAS_64BIT_CYCLE_COUNTER
	select SYSTEM_TIMER_HAS_DISABLE_SUPPORT
	select SYSTEM_CLOCK_LOCK_FREE_COUNT
	help
	  System timer driver for the RH850 OS timer OSTM0 in free-run
	  compare mode.
```

## drivers/timer/Kconfig.rpi_pico
```kconfig
# Copyright (c) 2026 Muhammad Waleed Badar
# SPDX-License-Identifier: Apache-2.0

config RPI_PICO_SYSTEM_TIMER
	bool "Raspberry Pi Pico TIMER as the system timer"
	default y
	depends on DT_HAS_RASPBERRYPI_PICO_SYSTEM_TIMER_ENABLED
	depends on RESET
	select TICKLESS_CAPABLE
	help
	  Use a TIMER block of the Raspberry Pi Pico as the system timer. It
	  counts microseconds and is the same for both cores, which the
	  SysTick of a core is not, so it can keep the time of an SMP kernel.
```

## drivers/timer/Kconfig.ti_dm_timer
```kconfig
# Copyright (C) 2023 BeagleBoard.org Foundation
# Copyright (C) 2023 S Prashanth
# Copyright (C) 2026 Siemens Mobility GmbH
#
# SPDX-License-Identifier: Apache-2.0

config TI_DM_TIMER
	bool "TI Dual-Mode Timer"
	default y
	depends on $(dt_chosen_has_compat,$(DT_CHOSEN_Z_SYSTEM_TIMER),$(DT_COMPAT_TI_AM654_TIMER))
	depends on $(dt_chosen_enabled,$(DT_CHOSEN_Z_SYSTEM_TIMER))
	select TICKLESS_CAPABLE
	select SYSCON if $(dt_compat_any_has_prop,$(DT_COMPAT_TI_AM654_TIMER),clksel)
	help
	  This module implements a kernel device driver for TI Dual-Mode timer. This
	  driver provides system tick interface.
```

## drivers/timer/Kconfig.ti_mspm0_timer
```kconfig
# SPDX-FileCopyrightText: Copyright (c) 2026 Linumiz
#
# SPDX-License-Identifier: Apache-2.0

DT_CHOSEN_ZEPHYR_SYSTEM_TIMER := zephyr,system-timer
DT_CHOSEN_ZEPHYR_SYSTEM_TIMER_PATH := $(dt_chosen_path,$(DT_CHOSEN_ZEPHYR_SYSTEM_TIMER))

config TI_MSPM0_SYSTEM_TIMER
	bool "TI MSPM0 System Timer Driver"
	depends on $(dt_chosen_enabled,$(DT_CHOSEN_ZEPHYR_SYSTEM_TIMER))
	depends on $(dt_node_has_compat,$(DT_CHOSEN_ZEPHYR_SYSTEM_TIMER_PATH),$(DT_COMPAT_TI_MSPM0_TIMER))
	select SYSTEM_TIMER_HAS_DISABLE_SUPPORT
	select TICKLESS_CAPABLE
	help
	  This option disables the CORTEX-M SysTick as system timer and
	  enables the TI MSPM0 TIMG12 timer as system timer for the kernel operations.
```

## drivers/timer/Kconfig.xtensa_esp32
```kconfig
# Copyright (c) 2026 The Zephyr Project Contributors
# SPDX-License-Identifier: Apache-2.0

config XTENSA_ESP32_SYS_TIMER
	bool "ESP32 Xtensa per-core system timer support"
	depends on SOC_SERIES_ESP32
	default y if SMP
	select TICKLESS_CAPABLE
	help
	  Per-core-safe system timer driver for original ESP32 (Xtensa), needed
	  because CCOUNT/CCOMPARE are genuine per-core special registers there,
	  unlike Xtensa SoCs with a shared external timer. See
	  drivers/timer/xtensa_esp32_sys_timer.c for details.
	  Only needed under CONFIG_SMP, where two cores each have their own
	  independent CCOUNT/CCOMPARE base -- with a single core, the generic
	  XTENSA_TIMER driver's single shared last_count is already correct,
	  so non-SMP builds keep using it unchanged rather than switching to
	  an unnecessary, less-tested driver.
	  The mutual-exclusion override for the generic XTENSA_TIMER driver
	  lives in soc/espressif/esp32/Kconfig.defconfig -- a plain sourced
	  Kconfig fragment like this one cannot reopen a symbol declared
	  elsewhere to add defaults/dependencies; only files named
	  Kconfig.defconfig get that special, Zephyr-specific treatment.
```

## drivers/uaol/Kconfig
```kconfig
# UAOL driver configuration options

# Copyright (c) 2024 Intel Corporation
# SPDX-License-Identifier: Apache-2.0

#
# UAOL options
#
menuconfig UAOL
	bool "UAOL drivers"
	help
	  Enable support for USB Audio Offload Link (UAOL) drivers.

if UAOL

config UAOL_INIT_PRIORITY
	int "UAOL init priority"
	default KERNEL_INIT_PRIORITY_DEFAULT
	help
	  UAOL driver device initialization priority.

config UAOL_USERSPACE
	bool "UAOL user-space support"
	depends on USERSPACE
	help
	  Expose the UAOL rate adjustment and feedback interpretation
	  interface to user-space threads via syscalls.

config UAOL_INTEL_ADSP
	bool "Intel ADSP UAOL driver."
	default y
	depends on DT_HAS_INTEL_ADSP_UAOL_ENABLED
	depends on PM_DEVICE_RUNTIME
	help
	  Intel ADSP UAOL driver.

config UAOL_INTEL_ADSP_CLOCK_FREQUENCY
	int "Clock frequency for UAOL"
	default 19200000

endif # UAOL
```

## drivers/usb/udc/Kconfig.infineon_usbfs
```kconfig
# SPDX-FileCopyrightText: Copyright (c) 2026 Infineon Technologies AG,
# SPDX-FileCopyrightText: or an affiliate of Infineon Technologies AG. All rights reserved.
#
# SPDX-License-Identifier: Apache-2.0

config UDC_INFINEON_USBFS
	bool "Infineon MXUSBFS device controller driver"
	default y
	depends on DT_HAS_INFINEON_USBFS_ENABLED
	select EVENTS
	help
	  Infineon MXUSBFS full-speed USB device controller driver

if UDC_INFINEON_USBFS

config UDC_INFINEON_USBFS_DMA
	bool "DMA endpoint data transfers"
	default y
	# The SoC provides a single USBFS instance, labelled usbfs0 on every die.
	depends on $(dt_nodelabel_has_prop,usbfs0,dmas)
	select USE_INFINEON_DMA
	help
	  Copy data endpoint payloads between the endpoint buffer and RAM
	  with DataWire instead of the CPU. Throughput is about the same,
	  but each packet costs less CPU time, mostly on OUT endpoints

config UDC_INFINEON_USBFS_STACK_SIZE
	int "UDC controller driver internal thread stack size"
	default 1024
	help
	  Device controller driver internal thread stack size.

config UDC_INFINEON_USBFS_THREAD_PRIORITY
	int "UDC controller driver thread priority"
	default 8
	help
	  Device controller driver thread priority.

endif # UDC_INFINEON_USBFS
```

## drivers/usb/udc/Kconfig.kinetis
```kconfig
# Copyright (c) 2022 Nordic Semiconductor ASA
# SPDX-License-Identifier: Apache-2.0

config UDC_KINETIS
	bool "Kinetis USB device controller driver"
	default y
	depends on DT_HAS_NXP_KINETIS_USBD_ENABLED
	select DYNAMIC_INTERRUPTS if UHC_NXP_KHCI
	select EVENTS
	help
	  Kinetis USB device controller criver.

if UDC_KINETIS

config UDC_KINETIS_STACK_SIZE
	int "UDC controller driver internal thread stack size"
	default 512
	help
	  Device controller driver internal thread stack size.

config UDC_KINETIS_THREAD_PRIORITY
	int "UDC controller driver thread priority"
	default 8
	help
	  Device controller driver thread priority.

endif # UDC_KINETIS
```

## drivers/usb/udc/Kconfig.mchp
```kconfig
# Copyright (c) 2026 Microchip Technology Inc.
# SPDX-License-Identifier: Apache-2.0

config UDC_MCHP_UDPHS_G1
	bool "Microchip USB Device High Speed Port (UDPHS) G1"
	default y
	depends on DT_HAS_MICROCHIP_UDPHS_G1_UDC_ENABLED
	select PINCTRL
	select GPIO
	select SYS_MEM_BLOCKS
	select EVENTS
	select UDC_DRIVER_HAS_HIGH_SPEED_SUPPORT
	help
	  Enable the Microchip UDPHS G1 driver.

if UDC_MCHP_UDPHS_G1

config UDC_MCHP_UDPHS_G1_STACK_SIZE
	int "UDC controller driver internal thread stack size"
	default 1024
	help
	  Device controller driver internal thread stack size.

config UDC_MCHP_UDPHS_G1_THREAD_PRI
	int "UDC controller driver thread priority"
	default 8
	help
	  Device controller driver thread priority.

config UDC_MCHP_UDPHS_G1_DMA
	bool "DMA support"
	default y
	help
	  Enable DMA transfer, otherwise data will be transferred via FIFO.

config UDC_MCHP_UDPHS_G1_BURST_LOCK
	bool "Lock bus access for maximum bandwidth"
	help
	  USB packets system data bursts will be locked for
	  maximum optimization of the bus bandwidth usage.

endif # UDC_MCHP_UDPHS_G1

config UDC_MCHP_G2
	bool "Microchip G2 USB device controller driver"
	default y
	depends on DT_HAS_MICROCHIP_USB_G2_ENABLED
	select UDC_DRIVER_HAS_HIGH_SPEED_SUPPORT
	select EVENTS
	help
	  USB device controller driver for Microchip G2 family.
	  This driver supports USB 2.0 High-Speed and Full-Speed operation.

if UDC_MCHP_G2

config UDC_MCHP_G2_STACK_SIZE
	int "UDC controller driver internal thread stack size"
	depends on UDC_MCHP_G2
	default 1024
	help
	  Microchip G2 USB device controller driver internal thread stack size.

config UDC_MCHP_G2_THREAD_PRIORITY
	int "Microchip G2 controller driver thread priority"
	depends on UDC_MCHP_G2
	default 8
	help
	  Microchip G2 USB device controller driver thread priority.

config UDC_MCHP_G2_VBUS_POLL_PERIOD_MS
	int "VBUS polling period in milliseconds"
	depends on UDC_MCHP_G2
	default 100
	range 10 1000
	help
	  Period between successive VBUS level checks performed by the system
	  work queue.  A shorter period reduces the latency between cable
	  plug/unplug and the UDC_EVT_VBUS_READY / UDC_EVT_VBUS_REMOVED event
	  being delivered to the upper layer, at the cost of slightly higher
	  CPU overhead.  100 ms is adequate for typical USB-device applications.

endif # UDC_MCHP_G2
```

## drivers/usb/udc/Kconfig.mchp_usbhs
```kconfig
# SPDX-FileCopyrightText: Copyright The Zephyr Project Contributors
# SPDX-FileCopyrightText: Copyright (c) 2026 Arkadiusz Grzelka
#
# SPDX-License-Identifier: Apache-2.0

config UDC_MCHP_USBHS
	bool "Microchip PIC32CZ USBHS device controller"
	default y
	depends on DT_HAS_MICROCHIP_PIC32CZ_USBHS_ENABLED
	select EVENTS
	select GPIO
	select UDC_DRIVER_HAS_HIGH_SPEED_SUPPORT
	help
	  USB Device Controller Driver for the PIC32CZ CA USBHS peripheral,
	  a Mentor Graphics Inventra core behind a Microchip wrapper. Device
	  role only, PIO only.

if UDC_MCHP_USBHS

config UDC_MCHP_USBHS_STACK_SIZE
	int "UDC controller driver internal thread stack size"
	default 1024
	help
	  Device controller driver internal thread stack size.

config UDC_MCHP_USBHS_THREAD_PRIORITY
	int "UDC controller driver thread priority"
	default 8
	help
	  Device controller driver thread priority.

endif # UDC_MCHP_USBHS
```

## drivers/usb/udc/Kconfig.mcux
```kconfig
# Copyright 2024 NXP
# SPDX-License-Identifier: Apache-2.0

config UDC_NXP_EHCI
	bool "NXP MCUX USB EHCI Device controller driver"
	default y
	depends on DT_HAS_NXP_EHCI_ENABLED
	select UDC_DRIVER_HAS_HIGH_SPEED_SUPPORT
	select PINCTRL
	select NOCACHE_MEMORY if CPU_HAS_DCACHE
	select DYNAMIC_INTERRUPTS if UHC_NXP_EHCI
	select EVENTS
	imply UDC_BUF_FORCE_NOCACHE

	help
	  NXP MCUX USB Device Controller Driver for EHCI.

if UDC_NXP_EHCI

config UDC_NXP_EHCI_THREAD_STACK_SIZE
	int "NXP EHCI UDC driver internal thread stack size"
	default 1024
	help
	  Stack size of the internal thread that processes controller events.

config UDC_NXP_EHCI_THREAD_PRIORITY
	int "NXP EHCI UDC driver internal thread priority"
	default 8
	help
	  Cooperative priority of the internal thread that processes
	  controller events.

endif # UDC_NXP_EHCI


config UDC_NXP_IP3511
	bool "NXP MCUX USB IP3511 Device controller driver"
	default y
	depends on DT_HAS_NXP_LPCIP3511_ENABLED
	select UDC_DRIVER_HAS_HIGH_SPEED_SUPPORT
	select PINCTRL
	select EVENTS
	help
	  NXP MCUX USB Device Controller Driver for IP3511.

if UDC_NXP_IP3511

config UDC_NXP_IP3511_THREAD_STACK_SIZE
	int "NXP IP3511 UDC driver internal thread stack size"
	default 1024
	help
	  Stack size of the internal thread that processes controller events.

config UDC_NXP_IP3511_THREAD_PRIORITY
	int "NXP IP3511 UDC driver internal thread priority"
	default 8
	help
	  Cooperative priority of the internal thread that processes
	  controller events.

endif # UDC_NXP_IP3511
```

## drivers/usb/udc/Kconfig.musb
```kconfig
# SPDX-FileCopyrightText: Copyright The Zephyr Project Contributors
# SPDX-FileCopyrightText: Copyright (c) 2026 Arkadiusz Grzelka
#
# SPDX-License-Identifier: Apache-2.0

config UDC_MUSB
	bool
	select EVENTS
	help
	  Mentor Graphics MUSB device controller core, selected by the
	  vendor glue driver that instantiates it.
```

## drivers/usb/udc/Kconfig.rts5817
```kconfig
# Copyright (c) 2026 Realtek Semiconductor, Inc.
# SPDX-License-Identifier: Apache-2.0

config UDC_RTS5817
	bool "RTS5817 UDC driver"
	default y
	depends on DT_HAS_REALTEK_RTS5817_USBD_ENABLED
	select UDC_DRIVER_HAS_HIGH_SPEED_SUPPORT
	select EVENTS
	help
	  Enable driver for RTS5817 USB.

if UDC_RTS5817

config UDC_RTS5817_THREAD_PRIORITY
	int "rts5817 usb controller driver thread priority"
	default 8
	help
	  RTS5817 device controller driver thread priority.

config UDC_RTS5817_STACK_SIZE
	int "UDC driver internal thread stack size"
	default 1024
	help
	  RTS UDC driver internal thread stack size.

config UDC_RTS5817_USE_RC_CLOCK
	bool "Use RC clock source"
	depends on OTP
	help
	  This config will switch udc clock source to RC
	  before connecting to host, using RC clock can
	  can reduce power consumption.

endif	# UDC_RTS5817
```

## drivers/usb/uhc/Kconfig.dwc3
```kconfig
# Copyright (c) 2026 Advanced Micro Devices, Inc.
# SPDX-License-Identifier: Apache-2.0

config UHC_DWC3
	bool "Synopsys DWC3 xHCI USB Host Controller driver"
	default y
	depends on DT_HAS_SNPS_DWC3_ENABLED
	help
	  Synopsys DesignWare USB3 DRD controller in xHCI host mode.
	  Bulk and control paths follow xHCI ring management; optional Xilinx/AMD
	  USB2 wrapper tuning via a second `reg` entry named `usb2_wrapper`

config UHC_DWC3_DEBUG
	bool "Verbose DWC3 xHCI ring and context debug logs"
	depends on UHC_DWC3
	default n
	help
	  LOG_DBG traces for EP0/bulk ring sync, device-context verification,
	  and transfer-ring bookkeeping. Enable when debugging enumeration or
	  bulk pipe issues on integrated DWC3+xHCI controllers.

config UHC_DWC3_BULK_OUT_STAGING_BUFSZ
	int "Bulk/interrupt OUT staging buffer size (bytes)"
	default 16384
	range 512 131072
	depends on UHC_DWC3
	help
	  __aligned(64) per-controller buffer for bulk/interrupt OUT when the
	  net_buf payload physical address is not 64-byte aligned. Payload length
	  must fit or enqueue returns -E2BIG.

config UHC_DWC3_BULK_FLOW_LOG
	bool "Log DWC3 bulk pipe recovery at INFO"
	depends on UHC_DWC3
	default n
	help
	  INFO logs for bulk EP state, Configure Endpoint drop+add, and enqueue
	  recovery on integrated DWC3+xHCI (use with CONFIG_USBH_MSC_FLOW_LOG).
```

## drivers/usb/uhc/Kconfig.it51xxx
```kconfig
# Copyright (c) 2026 ITE Corporation.
# SPDX-License-Identifier: Apache-2.0

config UHC_IT51XXX
	bool "IT51XXX USB host controller driver"
	default y
	depends on DT_HAS_ITE_IT51XXX_UHC_ENABLED
	help
	  IT51XXX USB host controller driver.

if UHC_IT51XXX

config UHC_IT51XXX_MAX_ERROR_RETRIES
	int "Maximum error retries for bulk and control transfers"
	default 3
	help
	  Maximum number of times the driver retries control or bulk
	  transaction after bus error, such as timeout, CRC error,
	  bit-stuffing error, or RX overflow. Set to zero to disable
	  retries.

config UHC_IT51XXX_ROOT_RESET_MS
	int "Root port reset duration (ms)"
	range 50 100
	default 50
	help
	  Duration, in milliseconds, for which the root hub drives reset
	  signaling on a downstream-facing port (TDRSTR). USB 2.0 requires
	  at least 50 ms.

config UHC_IT51XXX_RESET_RECOVERY_MS
	int "Reset recovery time (ms)"
	range 10 30
	default 10
	help
	  Reset recovery time in milliseconds. USB 2.0 requires at least 10 ms.

config UHC_IT51XXX_THREAD_PRIORITY
	int "IT51XXX UHC driver internal thread priority"
	default 8
	help
	  IT51XXX UHC driver internal thread priority.

config UHC_IT51XXX_STACK_SIZE
	int "IT51XXX UHC driver internal thread stack size"
	default 1024
	help
	  Size of the stack used in the driver for IT51XXX UHC event handling.

endif # UHC_IT51XXX
```

## drivers/usb/uhc/Kconfig.mchp_usbhs
```kconfig
# Copyright The Zephyr Project Contributors
# SPDX-License-Identifier: Apache-2.0

config UHC_MCHP_USBHS
	bool "Microchip PIC32CZ USBHS host controller driver"
	default y
	depends on DT_HAS_MICROCHIP_PIC32CZ_USBHS_ENABLED
	select GPIO
	select UHC_MUSB
	help
	  USB host controller driver for the PIC32CZ CA USBHS peripheral, a
	  Mentor Graphics MUSB core behind a Microchip wrapper. Host role
	  only, PIO only, control and bulk transfers only.
```
