## drivers/timer/Kconfig.rv32m1_lptmr
```kconfig
# Copyright (c) 2014-2015 Wind River Systems, Inc.
# Copyright (c) 2016 Cadence Design Systems, Inc.
# Copyright (c) 2019 Intel Corp.
# SPDX-License-Identifier: Apache-2.0

config RV32M1_LPTMR_TIMER
	bool "RV32M1 LPTMR system timer driver"
	default y
	depends on DT_HAS_OPENISA_RV32M1_LPTMR_ENABLED
	depends on RV32M1_INTMUX
	help
	  This module implements a kernel device driver for using the LPTMR
	  peripheral as the system clock. It provides the standard "system clock
	  driver" interfaces.
```

## drivers/timer/Kconfig.sam0_rtc
```kconfig
# Copyright (c) 2014-2015 Wind River Systems, Inc.
# Copyright (c) 2016 Cadence Design Systems, Inc.
# Copyright (c) 2019 Intel Corp.
# SPDX-License-Identifier: Apache-2.0

config SAM0_RTC_TIMER
	bool "Atmel SAM0 series RTC timer"
	depends on SOC_FAMILY_SAM0
	select TICKLESS_CAPABLE
	help
	  This module implements a kernel device driver for the Atmel SAM0
	  series Real Time Counter and provides the standard "system clock
	  driver" interfaces.
```

## drivers/timer/Kconfig.silabs
```kconfig
# Copyright (c) 2024 Silicon Laboratories Inc.
# SPDX-License-Identifier: Apache-2.0

DT_CHOSEN_SILABS_SLEEPTIMER := silabs,sleeptimer

config SILABS_SLEEPTIMER_TIMER
	bool "Silabs Sleeptimer system clock driver"
	depends on SOC_FAMILY_SILABS_S2 || SOC_FAMILY_SILABS_SIWX91X
	depends on $(dt_chosen_enabled,$(DT_CHOSEN_SILABS_SLEEPTIMER))
	select SILABS_SISDK_SLEEPTIMER
	select TICKLESS_CAPABLE
	select TIMER_READS_ITS_FREQUENCY_AT_RUNTIME
	help
	  This module implements a kernel device driver for the sleeptimer
	  and provides the standard "system clock driver" interfaces.
```

## drivers/timer/Kconfig.smartbond
```kconfig
# Copyright (c) 2023 Renesas Electronics Corporation
# SPDX-License-Identifier: Apache-2.0

config SMARTBOND_TIMER
	bool "Renesas SmartBond(tm) timer"
	default y
	depends on SOC_FAMILY_RENESAS_SMARTBOND
	depends on CLOCK_CONTROL
	depends on !$(dt_nodelabel_enabled,timer2)
	select TICKLESS_CAPABLE
	help
	  This module implements a kernel device driver for the TIMER2 timer
	  and provides the standard "system clock driver" interfaces.
```
