## drivers/timer/Kconfig.native_posix
```kconfig
# Copyright (c) 2014-2015 Wind River Systems, Inc.
# Copyright (c) 2016 Cadence Design Systems, Inc.
# Copyright (c) 2019 Intel Corp.
# SPDX-License-Identifier: Apache-2.0

config NATIVE_POSIX_TIMER
	bool "(POSIX) native_sim/posix timer driver"
	default y
	depends on BOARD_NATIVE_POSIX || BOARD_NATIVE_SIM
	select TICKLESS_CAPABLE
	select TIMER_HAS_64BIT_CYCLE_COUNTER
	select SYSTEM_TIMER_HAS_DISABLE_SUPPORT
	help
	  This module implements a kernel device driver for the native_sim/posix HW timer
	  model
```

## drivers/timer/Kconfig.native_sim
```kconfig
# Copyright (c) 2014-2015 Wind River Systems, Inc.
# Copyright (c) 2016 Cadence Design Systems, Inc.
# Copyright (c) 2019 Intel Corp.
# SPDX-License-Identifier: Apache-2.0

config NATIVE_SIM_TIMER
	bool "(POSIX) native_sim timer driver"
	default y
	depends on BOARD_NATIVE_SIM
	select TICKLESS_CAPABLE
	select TIMER_HAS_64BIT_CYCLE_COUNTER
	select SYSTEM_TIMER_HAS_DISABLE_SUPPORT
	help
	  This module implements a kernel device driver for the native_sim HW timer model

config NATIVE_POSIX_TIMER
	bool "(POSIX) native_sim/posix timer driver (deprecated)"
	select NATIVE_SIM_TIMER
	select DEPRECATED
	depends on BOARD_NATIVE_SIM
	help
	  Deprecated option. Replaced by NATIVE_SIM_TIMER
```

## drivers/timer/Kconfig.nct_itim_systick
```kconfig
# Copyright (c) 2024 Nuvoton Technology Corporation.
# SPDX-License-Identifier: Apache-2.0

config NCT_ITIM_SYSTICK
	bool "Nuvoton NCT series SYSTICK that use internal timer"
	default n
	depends on DT_HAS_NUVOTON_NCT_ITIM_SYSTICK_ENABLED
	select TICKLESS_CAPABLE
	select TIMER_HAS_64BIT_CYCLE_COUNTER
	help
	  This module implements standard "system clock driver" interfaces that
	  use Nuvoton NCT series internal timer.
	  Due to its limited 32-bits hardware timer, tracking a separate cycle
	  count in software to support 64-bits sys_clock_cycle_get_64().
```

## drivers/timer/Kconfig.npcx_itim
```kconfig
# Copyright (c) 2014-2015 Wind River Systems, Inc.
# Copyright (c) 2016 Cadence Design Systems, Inc.
# Copyright (c) 2019 Intel Corp.
# SPDX-License-Identifier: Apache-2.0

config NPCX_ITIM_TIMER
	bool "Nuvoton NPCX series internal 64/32-bit timers"
	default y
	depends on DT_HAS_NUVOTON_NPCX_ITIM_TIMER_ENABLED
	select TICKLESS_CAPABLE
	select TIMER_HAS_64BIT_CYCLE_COUNTER
	help
	  This module implements a kernel device driver for the Nuvoton NPCX
	  series internal 64/32-bit timers and provides the standard "system
	  clock driver" interfaces.
```

## drivers/timer/Kconfig.nrf_grtc
```kconfig
# Timer driver configuration options
# Copyright (c) 2024 Nordic Semiconductor ASA

menuconfig NRF_GRTC_TIMER
	bool "nRF GRTC Timer"
	default y
	depends on DT_HAS_NORDIC_NRF_GRTC_ENABLED
	select TICKLESS_CAPABLE
	select TIMER_HAS_64BIT_CYCLE_COUNTER
	select NRFX_GRTC
	help
	  This module implements a kernel device driver for the nRF Global Real
	  Time Counter NRF_GRTC and provides the standard "system clock driver"
	  interfaces.

if NRF_GRTC_TIMER

config NRF_GRTC_ALWAYS_ON
	bool
	help
	  Always keep the SYSCOUNTER active even if the CPU is in sleep mode.

config NRF_GRTC_TIMER_APP_DEFINED_INIT
	bool "Application defines GRTC initialization"
	help
	  Application defines the initialization procedure and time of the GRTC
	  drivers, rather than leaving it up to SYS_INIT.

config NRF_GRTC_START_SYSCOUNTER
	bool "Start SYSCOUNTER on driver init"
	select NRF_GRTC_TIMER_CLOCK_MANAGEMENT
	help
	  Start the SYSCOUNTER when initializing the GRTC. This should only be
	  handled by one processor in the system.

config NRF_GRTC_TIMER_CLOCK_MANAGEMENT
	bool
	help
	  Compile additional driver code for enabling management functionality of
	  the GRTC. Usually this is only needed by the processor that is starting
	  the SYSCOUNTER, but can be shared by multiple processors in the system.

config NRF_GRTC_SYSCOUNTER_SLEEP_MINIMUM_LATENCY
	int
	default 1000
	depends on POWEROFF
	help
	  The value (in us) ensures that the wakeup event will not fire
	  too early. In other words, applying SYSCOUNTER sleep state for less than
	  NRF_GRTC_SYSCOUNTER_SLEEP_MINIMUM_LATENCY period makes no sense.

config NRF_GRTC_TIMER_AUTO_KEEP_ALIVE
	bool
	default y if NRF_GRTC_START_SYSCOUNTER
	help
	  This feature prevents the SYSCOUNTER from sleeping when any core is in
	  active state.

endif # NRF_GRTC_TIMER
```

## drivers/timer/Kconfig.nrf_rtc
```kconfig
# Copyright (c) 2014-2015 Wind River Systems, Inc.
# Copyright (c) 2016 Cadence Design Systems, Inc.
# Copyright (c) 2019 Intel Corp.
# SPDX-License-Identifier: Apache-2.0

config NRF_RTC_TIMER
	bool "nRF Real Time Counter (NRF_RTC1) Timer"
	depends on CLOCK_CONTROL
	depends on SOC_COMPATIBLE_NRF
	select TICKLESS_CAPABLE
	select SYSTEM_TIMER_HAS_DISABLE_SUPPORT
	select NRFX_PPI if SOC_NRF52832
	depends on !$(dt_nodelabel_enabled,rtc1)
	help
	  This module implements a kernel device driver for the nRF Real Time
	  Counter NRF_RTC1 and provides the standard "system clock driver"
	  interfaces.

if NRF_RTC_TIMER

config NRF_RTC_TIMER_USER_CHAN_COUNT
	int "Additional channels that can be used"
	default 2 if NRF_802154_RADIO_DRIVER && SOC_COMPATIBLE_NRF5340_CPUNET
	default 3 if NRF_802154_RADIO_DRIVER
	default 0
	help
	  Use nrf_rtc_timer.h API. Driver is not managing allocation of channels.

config NRF_RTC_TIMER_LOCK_ZERO_LATENCY_IRQS
	# hidden option
	bool
	depends on ZERO_LATENCY_IRQS
	default y if !BT_LL_SW_SPLIT
	help
	  Enable use of __disable_irq() to disable Zero Latency IRQs to prevent
	  higher priority contexts (including ZLIs) that might preempt the
	  handler and call nrf_rtc_timer API from destroying the internal state
	  in nrf_rtc_timer.

config NRF_RTC_TIMER_TRIGGER_OVERFLOW
	bool "Trigger overflow"
	help
	  When enabled, a function can be used to trigger RTC overflow and
	  effectively shift time into the future.

config NRF_RTC_COUNTER_BIT_WIDTH
	int
	default 15 if SOC_NRF52832
	default 24
	range 15 24

endif # NRF_RTC_TIMER
```

## drivers/timer/Kconfig.nrf_xrtc
```kconfig
# Common RTC configuration

# Copyright (c) 2023 Nordic Semiconductor ASA
# SPDX-License-Identifier: Apache-2.0

if NRF_RTC_TIMER
choice
	prompt "Clock startup policy"
	default SYSTEM_CLOCK_WAIT_FOR_STABILITY

config SYSTEM_CLOCK_NO_WAIT
	bool "No wait"
	help
	  System clock source is initiated but does not wait for clock readiness.
	  When this option is picked, system clock may not be ready when code relying
	  on kernel API is executed. Requested timeouts will be prolonged by the
	  remaining startup time.

config SYSTEM_CLOCK_WAIT_FOR_AVAILABILITY
	bool "Wait for availability"
	help
	  System clock source initialization waits until clock is available. In some
	  systems, clock initially runs from less accurate source which has faster
	  startup time and then seamlessly switches to the target clock source when
	  it is ready. When this option is picked, system clock is available after
	  system clock driver initialization but it may be less accurate. Option is
	  equivalent to waiting for stability if clock source does not have
	  intermediate state.

config SYSTEM_CLOCK_WAIT_FOR_STABILITY
	bool "Wait for stability"
	help
	  System clock source initialization waits until clock is stable. When this
	  option is picked, system clock is available and stable after system clock
	  driver initialization.

endchoice
endif # NRF_RTC_TIMER
```

## drivers/timer/Kconfig.omap_dm_timer
```kconfig
# Copyright (C) 2023 BeagleBoard.org Foundation
# Copyright (C) 2023 S Prashanth
#
# SPDX-License-Identifier: Apache-2.0

config OMAP_DM_TIMER
	bool "TI Dual-Mode Timer"
	default y
	select TICKLESS_CAPABLE
	depends on DT_HAS_TI_AM654_DMTIMER_ENABLED
	help
		This module implements a kernel device driver for TI dual-mode timer. This
		driver provides system tick interface
```

## drivers/timer/Kconfig.openrisc_tick
```kconfig
#
# Copyright (c) 2025 NVIDIA Corporation <jholdsworth@nvidia.com>
#
# SPDX-License-Identifier: Apache-2.0
#

config OPENRISC_TICK_TIMER
	bool "OpenRISC Tick Timer"
	depends on OPENRISC
	select TICKLESS_CAPABLE
	help
	  This module implements a kernel device driver for the OpenRISC Tick timer.
```

## drivers/timer/Kconfig.pic32cxsg_rtc
```kconfig
# Copyright (c) 2024 Microchip
# SPDX-License-Identifier: Apache-2.0

config PIC32CXSG_RTC_TIMER
	bool "Microchip PIC32CXSG series RTC timer"
	default y
	depends on DT_HAS_PIC32CXSG_RTC_ENABLED
	select TICKLESS_CAPABLE
	help
	  This module implements a kernel device driver for the Microchip PIC32CXSG
	  series Real Time Counter and provides the standard "system clock
	  driver" interfaces.
```

## drivers/timer/Kconfig.pse
```kconfig
# Kconfig - PSE HPET timer driver configuration options
# Copyright (c) 2021 Intel Corporation
#
# SPDX-License-Identifier: Apache-2.0
#

config PSE_HPET_TIMER
	bool "PSE HPET timer"
	select TIMER_READS_ITS_FREQUENCY_AT_RUNTIME
	select TICKLESS_KERNEL
	select TICKLESS_CAPABLE
	help
	  This option selects High Precision Event Timer (HPET) as a
	  system timer.

if PSE_HPET_TIMER
config HPET_TIMER_BASE_ADDRESS
	hex "HPET Base Address"
	default 0x40a00000
	help
	  This options specifies the base address of the HPET timer device.

config HPET_TIMER_IRQ
	int "HPET Timer IRQ"
	default 20
	help
	  This option specifies the IRQ used by the HPET timer.

config HPET_TIMER_IRQ_PRIORITY
	int "HPET Timer IRQ Priority"
	default 4
	help
	  This option specifies the IRQ priority used by the HPET timer.

endif #PSE_HPET_TIMER
```

## drivers/timer/Kconfig.rcar_cmt
```kconfig
# Copyright (c) 2014-2015 Wind River Systems, Inc.
# Copyright (c) 2016 Cadence Design Systems, Inc.
# Copyright (c) 2019 Intel Corp.
# SPDX-License-Identifier: Apache-2.0

config RCAR_CMT_TIMER
	bool "Renesas RCar cmt timer"
	default y
	depends on DT_HAS_RENESAS_RCAR_CMT_ENABLED
	help
	  This module implements a kernel device driver for the Renesas RCAR
	  platform provides the standard "system clock driver" interfaces.
	  If unchecked, no timer will be used.
```

## drivers/timer/Kconfig.realtek_rts5912_rtmr
```kconfig
# SPDX-License-Identifier: Apache-2.0
#
# Copyright (c) 2024 Realtek Semiconductor Corporation, SIBG-SD7
#

config REALTEK_RTS5912_RTMR
	bool "Realtek RTS5912 RTOS Timer"
	default y if DT_HAS_REALTEK_RTS5912_RTMR_ENABLED
	select TICKLESS_CAPABLE
	select SYSTEM_TIMER_HAS_DISABLE_SUPPORT
	help
	  This module implements a kernel device driver for the Realtek
	  RTS5912 series RTOS timer.
```

## drivers/timer/Kconfig.renesas_ra8_ulpt
```kconfig
# Copyright (c) 2024 Renesas Electronics Corporation
# SPDX-License-Identifier: Apache-2.0

config ULPT_RENESAS_RA
	bool "Renesas RA Series ULPT Driver"
	default y
	depends on DT_HAS_RENESAS_RA8_ULPT_TIMER_ENABLED
	select USE_RA_FSP_TIMER_ULPT
	depends on PM
	help
	  Enable Renesas RA series ULPT driver.
```

## drivers/timer/Kconfig.renesas_ra_ulpt
```kconfig
# Copyright (c) 2025 Renesas Electronics Corporation
# SPDX-License-Identifier: Apache-2.0

config RENESAS_RA_ULPT_TIMER
	bool "Renesas RA Series ULPT Timer"
	default y if PM
	depends on DT_HAS_RENESAS_RA_ULPT_TIMER_ENABLED
	select TICKLESS_CAPABLE
	help
	  This module implements a kernel device driver for the Renesas RA series
	  ULPT timer and provides the standard "system clock driver" interfaces.
```

## drivers/timer/Kconfig.renesas_rx
```kconfig
# Copyright (c) 2024 Renesas Electronics Corporation
# SPDX-License-Identifier: Apache-2.0

config RENESAS_RX_TIMER_CMT
	bool "Renesas RX timer CMT"
	default y
	depends on DT_HAS_RENESAS_RX_TIMER_CMT_ENABLED
	select TIMER_HAS_64BIT_CYCLE_COUNTER
	select TICKLESS_CAPABLE
	help
	  This module implements a kernel device driver for the Renesas RX
	  platform provides the standard "system clock driver" interfaces.
	  If unchecked, no timer will be used.
```

## drivers/timer/Kconfig.renesas_rz
```kconfig
# Copyright (c) 2024 Renesas Electronics Corporation
# SPDX-License-Identifier: Apache-2.0

config RZ_OS_TIMER
	bool "Renesas RZ OS timer"
	default y
	depends on DT_HAS_RENESAS_RZ_GTM_OS_TIMER_ENABLED
	select TIMER_READS_ITS_FREQUENCY_AT_RUNTIME
	select SYSTEM_TIMER_HAS_DISABLE_SUPPORT
	select TICKLESS_CAPABLE
	select USE_RZ_FSP_GTM
	help
	  This module implements a kernel device driver for the Renesas RZ
	  platform provides the standard "system clock driver" interfaces.
```

## drivers/timer/Kconfig.renesas_rza2m
```kconfig
# Copyright (c) 2025 Renesas Electronics Corporation
# SPDX-License-Identifier: Apache-2.0

config RZA2M_OSTM_TIMER
	bool "Renesas RZ/A2M OS timer"
	default y
	depends on DT_HAS_RENESAS_RZA2M_OSTM_TIMER_ENABLED
	select TIMER_READS_ITS_FREQUENCY_AT_RUNTIME
	select SYSTEM_TIMER_HAS_DISABLE_SUPPORT
	select TICKLESS_CAPABLE
	help
	  This module implements a kernel device driver for the Renesas RZ/A2M
	  platform provides the standard "system clock driver" interfaces.
```

## drivers/timer/Kconfig.riscv_machine
```kconfig
# Copyright (c) 2014-2015 Wind River Systems, Inc.
# Copyright (c) 2016 Cadence Design Systems, Inc.
# Copyright (c) 2019-2023 Intel Corp.
# SPDX-License-Identifier: Apache-2.0

config RISCV_MACHINE_TIMER
	bool "RISCV Machine Timer"
	default y
	depends on RISCV_M_MODE
	depends on DT_HAS_RISCV_MACHINE_TIMER_ENABLED || \
		   DT_HAS_NUCLEI_SYSTIMER_ENABLED
	select TICKLESS_CAPABLE
	select TIMER_HAS_64BIT_CYCLE_COUNTER
	# On RV64 the mtime/mtimecmp registers and the driver's cycle-domain math
	# (cycle_diff_t == unsigned long) are 64-bit, so a full SYS_CLOCK_MAX_WAIT
	# is overflow-safe. On RV32 cycle_diff_t is 32-bit, so do not offer the
	# long-wait capability there.
	select SYSTEM_CLOCK_LONG_WAIT_CAPABLE if 64BIT
	help
	  This module implements a kernel device driver for the generic RISCV machine
	  timer driver. It provides the standard "system clock driver" interfaces.

if RISCV_MACHINE_TIMER

config RISCV_MACHINE_TIMER_SYSTEM_CLOCK_DIVIDER
	int
	default 0
	help
	  Specifies the division ratio of the system clock supplied to the Machine Timer.

	  A clock obtained by dividing the system clock by a value of [2^N] is
	  supplied to the timer. Where N is this parameter's value.
	  When N=2, it is divided by 4, and when N=5, it is divided by 32.
	  Default case is N=0, this means use system clock as machine timer clock.
	  It is normal configuration for RISC-V machine clock.

	  This parameter usually depends on the hardware configuration.
	  The division ratio should define in devicetree,
	  and it is desirable usage that references it with using a function such as
	  dt_node_int_prop_int from Kconfig. (Tune in the conf file is not preferable.)

endif
```

## drivers/timer/Kconfig.riscv_opensbi
```kconfig
# openSBI timer driver configuration options

# Copyright (c) 2024 sensry.io
# SPDX-License-Identifier: Apache-2.0


if RISCV_OPENSBI

config RISCV_OPENSBI_TIMER
	bool "RISCV openSBI Timer"
	default y
	help
	  This enabled the use of openSBI timer to trigger the zephyr scheduler

endif
```

## drivers/timer/Kconfig.riscv_supervisor
```kconfig
# Copyright (c) 2024 MASSDRIVER EI (massdriver.space)
# Copyright (c) 2018-2023 Intel Corp.
# SPDX-License-Identifier: Apache-2.0

config RISCV_SUPERVISOR_TIMER
	bool "RISCV Supervisor Timer"
	default y
	depends on RISCV_S_MODE
	depends on DT_HAS_RISCV_MACHINE_TIMER_ENABLED || \
		   DT_HAS_NUCLEI_SYSTIMER_ENABLED
	select TICKLESS_CAPABLE
	select TIMER_HAS_64BIT_CYCLE_COUNTER
	# On RV64 the time CSR / SBI timer and the driver's cycle-domain math
	# (cycle_diff_t == unsigned long) are 64-bit, so a full SYS_CLOCK_MAX_WAIT
	# is overflow-safe. On RV32 cycle_diff_t is 32-bit, so do not offer the
	# long-wait capability there.
	select SYSTEM_CLOCK_LONG_WAIT_CAPABLE if 64BIT
	help
	  This module implements a kernel device driver for the RISC-V supervisor
	  mode timer. It uses the SBI timer extension to set timer deadlines and
	  reads time via the "time" CSR. It provides the standard "system clock
	  driver" interfaces.
```
