## drivers/timer/Kconfig.ch32v
```kconfig
# Copyright (c) 2023-2024 Chen Xingyu <hi@xingrz.me>
# SPDX-License-Identifier: Apache-2.0

config CH32V_V3_SYSTICK
	bool "WCH CH32V V3 SysTick"
	default y
	depends on DT_HAS_WCH_CH32V_V3_SYSTICK_ENABLED
	select TIMER_HAS_64BIT_CYCLE_COUNTER
	help
	  Enable WCH CH32V V3 SysTick driver.
```

## drivers/timer/Kconfig.cmsdk_apb_timer
```kconfig
# Copyright (c) 2026 Google LLC
# SPDX-License-Identifier: Apache-2.0

DT_CHOSEN_ZEPHYR_SYSTEM_TIMER := zephyr,system-timer
DT_CHOSEN_ZEPHYR_SYSTEM_TIMER_PATH := $(dt_chosen_path,$(DT_CHOSEN_ZEPHYR_SYSTEM_TIMER))
DT_COMPAT_CMSDK_TIMER := arm,cmsdk-timer

config CMSDK_APB_TIMER
	bool "CMSDK APB Timer as system clock"
	depends on $(dt_chosen_enabled,$(DT_CHOSEN_ZEPHYR_SYSTEM_TIMER))
	depends on $(dt_node_has_compat,$(DT_CHOSEN_ZEPHYR_SYSTEM_TIMER_PATH),$(DT_COMPAT_CMSDK_TIMER))
	select TICKLESS_CAPABLE
	default y if SYS_CLOCK_EXISTS
	help
	  Enable support for the CMSDK APB Timer as the system clock.

if CMSDK_APB_TIMER

config CMSDK_APB_TIMER_MIN_DELAY_OVERRIDE
	bool "Override the value of minimum delay cycles"

config CMSDK_APB_TIMER_MIN_DELAY_CYCLES
	int "Minimum delay cycles"
	depends on CMSDK_APB_TIMER_MIN_DELAY_OVERRIDE
	default 1024
	help
	  The value set overrides the default minimum delay cycles value.

endif # CMSDK_APB_TIMER
```

## drivers/timer/Kconfig.cortex_m_systick
```kconfig
# Copyright (c) 2014-2015 Wind River Systems, Inc.
# Copyright (c) 2016 Cadence Design Systems, Inc.
# Copyright (c) 2019 Intel Corp.
# SPDX-License-Identifier: Apache-2.0

config CORTEX_M_SYSTICK
	bool "Cortex-M SYSTICK timer"
	depends on CPU_CORTEX_M_HAS_SYSTICK
	default y
	depends on DT_HAS_ARM_ARMV6M_SYSTICK_ENABLED || \
		   DT_HAS_ARM_ARMV7M_SYSTICK_ENABLED || \
		   DT_HAS_ARM_ARMV8M_SYSTICK_ENABLED || \
		   DT_HAS_ARM_ARMV8_1M_SYSTICK_ENABLED
	select TICKLESS_CAPABLE
	select SYSTEM_TIMER_HAS_DISABLE_SUPPORT
	select SYSTEM_TIMER_HAS_LPM_COMPANION_SUPPORT
	select CORTEX_M_SYSTICK_INSTALL_ISR
	help
	  This module implements a kernel device driver for the Cortex-M processor
	  SYSTICK timer and provides the standard "system clock driver" interfaces.

config CORTEX_M_SYSTICK_INSTALL_ISR
	bool
	depends on CPU_CORTEX_M_HAS_SYSTICK
	help
	  This option should be selected by SysTick-based drivers so that the
	  sys_clock_isr() function is installed.

config CORTEX_M_SYSTICK_64BIT_CYCLE_COUNTER
	bool "Cortex-M SYSTICK timer with sys_clock_cycle_get_64() support"
	depends on CORTEX_M_SYSTICK
	default y if (SYS_CLOCK_HW_CYCLES_PER_SEC > 60000000)
	select TIMER_HAS_64BIT_CYCLE_COUNTER
	help
	  This driver, due to its limited 24-bits hardware counter, is already
	  tracking a separate cycle count in software. This option make that
	  count a 64-bits value to support sys_clock_cycle_get_64().
	  This is cheap to do as expensive math operations (i.e. divisions)
	  are performed only on counter interval values that always fit in
	  32 bits.

	  This is set to y by default when the hardware clock is fast enough
	  to wrap sys_clock_cycle_get_32() in about a minute or less.

if CORTEX_M_SYSTICK

# Deprecated SysTick-specific Kconfig symbols.
# Retained with prompts so that existing prj.conf assignments keep working
# during the migration period.  The new generic symbols are selected via
# "default ... if ..." rules in Kconfig.system_timer_lpm.
# Scheduled for removal in Zephyr 4.6.0.

config CORTEX_M_SYSTICK_LPM_TIMER_NONE
	bool "[DEPRECATED] SysTick LPM timer: none"
	select DEPRECATED
	help
	  Deprecated. Use CONFIG_SYSTEM_TIMER_LPM_COMPANION_NONE instead.

config CORTEX_M_SYSTICK_LPM_TIMER_COUNTER
	bool "[DEPRECATED] SysTick LPM timer: counter"
	select DEPRECATED
	help
	  Deprecated. Use CONFIG_SYSTEM_TIMER_LPM_COMPANION_COUNTER instead.

config CORTEX_M_SYSTICK_LPM_TIMER_HOOKS
	bool "[DEPRECATED] SysTick LPM timer: hooks"
	select DEPRECATED
	help
	  Deprecated. Use CONFIG_SYSTEM_TIMER_LPM_COMPANION_HOOKS instead.

config CORTEX_M_SYSTICK_RESET_BY_LPM
	bool "[DEPRECATED] SysTick reset by LPM"
	select DEPRECATED
	select SYSTEM_TIMER_RESET_BY_LPM
	help
	  Deprecated. Use CONFIG_SYSTEM_TIMER_RESET_BY_LPM instead.

endif # CORTEX_M_SYSTICK
```

## drivers/timer/Kconfig.esp32c3_sys
```kconfig
# Copyright (c) 2014-2015 Wind River Systems, Inc.
# Copyright (c) 2016 Cadence Design Systems, Inc.
# Copyright (c) 2019 Intel Corp.
# SPDX-License-Identifier: Apache-2.0

config ESP32C3_SYS_TIMER
	bool "ESP32C3 sys-timer support"
	depends on SOC_ESP32C3
	default y
	select TICKLESS_CAPABLE
	select TIMER_HAS_64BIT_CYCLE_COUNTER
	help
	  This option enables the system timer driver for the Espressif ESP32C3
	  and provides the standard "system clock driver" interface.
```

## drivers/timer/Kconfig.gecko
```kconfig
# Copyright (c) 2023 Antmicro <www.antmicro.com>
# SPDX-License-Identifier: Apache-2.0

config GECKO_BURTC_TIMER
	bool "SiLabs Gecko BURTC system clock driver"
	depends on SOC_GECKO_SERIES2
	depends on DT_HAS_SILABS_GECKO_BURTC_ENABLED
	select SOC_GECKO_BURTC
	select TICKLESS_CAPABLE
	select TIMER_READS_ITS_FREQUENCY_AT_RUNTIME
	help
	  If you enable this, BURTC will be used to provide hw_cycles and
	  kernel ticks instead of Cortex-M SysTick. You need this for system
	  to be able to keep track of time and wake up from EM2 & EM3 sleep
	  states.

	  NOTE:
	  Using BURTC instead of SysTick has a large impact on kernel timing
	  precision.
	  1. You won't be able to use the usual 0.1ms-granularity tickless
	     scheduling. Kernel tick duration should be at least 6 BURTC clock
	     cycles, that is ~183 us @ 32768 Hz (LFXO, LFRCO) or
	     ~6 ms @ 1000 Hz (ULFRCO).
	  2. In general, accuracy of real-time scheduling by kernel will be
	     degraded: all timeout-based facilities, such as timers, delayable
	     work, k_sleep, will issue thread wake ups less precisely than when
	     using SysTick timer.
	  3. hw_cycles granularity will be equal to 1 BURTC clock, that is
	     ~31 us @ 32768 Hz or ~1 ms @ 1000 Hz. This reduces timing
	     precision of all code which relies on cycles API, e.g.
	     k_cycle_get_32() and similar functions.

	  If unsure, say 'N'.
```

## drivers/timer/Kconfig.hpet
```kconfig
# Copyright (c) 2014-2015 Wind River Systems, Inc.
# Copyright (c) 2016 Cadence Design Systems, Inc.
# Copyright (c) 2019 Intel Corp.
# SPDX-License-Identifier: Apache-2.0

config HPET_TIMER
	bool "HPET timer"
	select IOAPIC if X86
	select LOAPIC if X86
	imply TIMER_READS_ITS_FREQUENCY_AT_RUNTIME
	select TICKLESS_CAPABLE
	select TIMER_HAS_64BIT_CYCLE_COUNTER
	help
	  This option selects High Precision Event Timer (HPET) as a
	  system timer.
```

## drivers/timer/Kconfig.ifx_cat1_lp
```kconfig
# Infineon CAT1 LPTIMER configuration options

# Copyright (c) 2025 Cypress Semiconductor Corporation (an Infineon company) or
# an affiliate of Cypress Semiconductor Corporation
#
# SPDX-License-Identifier: Apache-2.0

config INFINEON_CAT1_LP_TIMER
	bool "Infineon CAT1 Low Power Timer driver"
	default y
	depends on DT_HAS_INFINEON_CAT1_LP_TIMER_ENABLED
	depends on PM
	select USE_INFINEON_LPTIMER
	select TICKLESS_CAPABLE
	help
	  This module implements a kernel device driver for the LowPower Timer
	  and provides the standard "system clock driver" interfaces.
```

## drivers/timer/Kconfig.infineon_lp
```kconfig
# Copyright (c) 2025 Infineon Technologies AG,
# or an affiliate of Infineon Technologies AG.
#
# SPDX-License-Identifier: Apache-2.0
#
# Infineon CAT1 LPTIMER configuration options

config INFINEON_LP_TIMER_HAL
	bool "Infineon Low Power Timer driver"
	default y
	depends on DT_HAS_INFINEON_LP_TIMER_ENABLED
	depends on USE_INFINEON_LEGACY_HAL
	depends on PM
	select USE_INFINEON_LPTIMER
	select TICKLESS_CAPABLE
	help
	  This module implements a kernel device driver for the LowPower Timer
	  and provides the standard "system clock driver" interfaces.  This implementation
	  is based on the Infineon Legacy HAL.

config INFINEON_LP_TIMER_PDL
	bool "Infineon Low Power Timer driver"
	default y
	depends on DT_HAS_INFINEON_LP_TIMER_ENABLED
	depends on !USE_INFINEON_LEGACY_HAL
	select USE_INFINEON_LPTIMER
	select TICKLESS_CAPABLE
	help
	  This module implements a PDL based kernel device driver for the LowPower Timer
	  and provides the standard "system clock driver" interfaces.
```

## drivers/timer/Kconfig.it51xxx
```kconfig
# Copyright (c) 2025 ITE Corporation. All Rights Reserved.
# SPDX-License-Identifier: Apache-2.0

config ITE_IT51XXX_TIMER
	bool "ITE it51xxx timer driver"
	default y
	depends on DT_HAS_ITE_IT51XXX_TIMER_ENABLED
	select TICKLESS_CAPABLE
	help
	  This module implements a kernel device driver for the ITE IT51XXX
	  HW timer model.

config ITE_IT51XXX_TIMER_COUNTUP_IN_COMBINATION_MODE
	bool
	depends on ITE_IT51XXX_TIMER
	default y if SOC_IT51526AW || SOC_IT51526BW
	help
	  Enable count-up mode for external timers when combination mode
	  is used. This should be selected according to the hardware
	  design.
```

## drivers/timer/Kconfig.ite_it8xxx2
```kconfig
# Copyright (c) 2014-2015 Wind River Systems, Inc.
# Copyright (c) 2016 Cadence Design Systems, Inc.
# Copyright (c) 2019 Intel Corp.
# SPDX-License-Identifier: Apache-2.0

config ITE_IT8XXX2_TIMER
	bool "ITE it8xxx2 timer driver"
	default y
	depends on DT_HAS_ITE_IT8XXX2_TIMER_ENABLED
	select TICKLESS_CAPABLE
	help
	  This module implements a kernel device driver for the ITE it8xxx2
	  HW timer model
```

## drivers/timer/Kconfig.leon_gptimer
```kconfig
# Copyright (c) 2014-2015 Wind River Systems, Inc.
# Copyright (c) 2016 Cadence Design Systems, Inc.
# Copyright (c) 2019 Intel Corp.
# SPDX-License-Identifier: Apache-2.0

config LEON_GPTIMER
	bool "LEON timer"
	default y
	depends on DT_HAS_GAISLER_GPTIMER_ENABLED
	select DYNAMIC_INTERRUPTS
	help
	  This module implements a kernel device driver for the GRLIB
	  GPTIMER which is common in LEON systems.
```

## drivers/timer/Kconfig.litex
```kconfig
# Copyright (c) 2014-2015 Wind River Systems, Inc.
# Copyright (c) 2016 Cadence Design Systems, Inc.
# Copyright (c) 2019 Intel Corp.
# SPDX-License-Identifier: Apache-2.0

config LITEX_TIMER
	bool "LiteX Timer"
	default y
	depends on DT_HAS_LITEX_TIMER0_ENABLED
	select TIMER_HAS_64BIT_CYCLE_COUNTER
	help
	  This module implements a kernel device driver for LiteX Timer.
```

## drivers/timer/Kconfig.max32_rv32_sys_timer
```kconfig
# Copyright (c) 2026 Analog Devices, Inc.
# SPDX-License-Identifier: Apache-2.0

config MAX32_RV32_SYS_TIMER
	bool "ADI MAX32 RV32 system timer driver"
	default y
	select TICKLESS_CAPABLE
	depends on DT_HAS_ADI_MAX32_RV32_SYS_TIMER_ENABLED
	help
	  This module implements a kernel device driver for using a MAX32 timer
	  peripheral as the system clock for the RV32 core. It provides the
	  standard "system clock driver" interfaces.
```

## drivers/timer/Kconfig.max32_wut
```kconfig
# Copyright (c) 2025 Analog Devices, Inc.
# SPDX-License-Identifier: Apache-2.0

config MAX32_WUT_TIMER
	bool "MAX32 Wake-Up Timer system clock driver"
	default y
	depends on DT_HAS_ADI_MAX32_WUT_TIMER_ENABLED
	depends on SOC_FAMILY_MAX32
	select TICKLESS_CAPABLE
	help
	  This module implements a kernel device driver for the MAX32
	  Wake-Up Timer and provides the standard "system clock driver"
	  interfaces.
```

## drivers/timer/Kconfig.mchp_dspic33
```kconfig
# Copyright (C) 2025 Microchip Technology Inc.
# SPDX-License-Identifier: Apache-2.0

config MCHP_DSPIC33_TIMER
	bool "Microchip DSPIC33A timer"
	default y
	depends on DT_HAS_MICROCHIP_DSPIC33_TIMER_ENABLED
	help
	  This module implements a kernel device driver for the Microchip
	  DSPIC33A timer 1
```

## drivers/timer/Kconfig.mchp_xec_rtos
```kconfig
# Copyright (c) 2014-2015 Wind River Systems, Inc.
# Copyright (c) 2016 Cadence Design Systems, Inc.
# Copyright (c) 2019 Intel Corp.
# SPDX-License-Identifier: Apache-2.0

config MCHP_XEC_RTOS_TIMER
	bool "Microchip XEC series RTOS timer"
	default y
	depends on DT_HAS_MICROCHIP_XEC_RTOS_TIMER_ENABLED
	select TICKLESS_CAPABLE
	select SYSTEM_TIMER_HAS_DISABLE_SUPPORT
	help
	  This module implements a kernel device driver for the Microchip
	  XEC series RTOS timer and provides the standard "system clock
	  driver" interfaces.
```

## drivers/timer/Kconfig.mcux_gpt
```kconfig
# Copyright (c) 2021 NXP
# SPDX-License-Identifier: Apache-2.0

config MCUX_GPT_TIMER
	bool "MCUX GPT Event timer"
	default y
	depends on PM
	depends on DT_HAS_NXP_GPT_HW_TIMER_ENABLED
	select TICKLESS_CAPABLE
	help
	  This module implements a kernel device driver for the NXP GPT timer,
	  and provides the standard "system clock driver" interfaces. It uses the
	  first GPT peripheral defined in the system, which can no longer be used
	  for the GPT counter driver.
```

## drivers/timer/Kconfig.mcux_lptmr
```kconfig
# Copyright (c) 2014-2015 Wind River Systems, Inc.
# Copyright (c) 2016 Cadence Design Systems, Inc.
# Copyright (c) 2019 Intel Corp.
# Copyright (c) 2026 NXP
# SPDX-License-Identifier: Apache-2.0

DT_CHOSEN_ZEPHYR_SYSTEM_TIMER := zephyr,system-timer
DT_CHOSEN_ZEPHYR_SYSTEM_TIMER_PATH := $(dt_chosen_path,$(DT_CHOSEN_ZEPHYR_SYSTEM_TIMER))
DT_COMPAT_NXP_LPTMR := nxp,lptmr

config MCUX_LPTMR_TIMER
	bool "MCUX LPTMR timer"
	default $(dt_node_has_compat,$(DT_CHOSEN_ZEPHYR_SYSTEM_TIMER_PATH),$(DT_COMPAT_NXP_LPTMR))
	depends on $(dt_chosen_enabled,$(DT_CHOSEN_ZEPHYR_SYSTEM_TIMER))
	depends on $(dt_node_has_compat,$(DT_CHOSEN_ZEPHYR_SYSTEM_TIMER_PATH),$(DT_COMPAT_NXP_LPTMR))
	select TICKLESS_CAPABLE
	help
	  This module implements a kernel device driver for the NXP MCUX Low
	  Power Timer (LPTMR) and provides the standard "system clock driver"
	  interfaces. The instance to use is selected via the zephyr,system-timer
	  chosen property.
```

## drivers/timer/Kconfig.mcux_os
```kconfig
# Copyright (c) 2014-2015 Wind River Systems, Inc.
# Copyright (c) 2016 Cadence Design Systems, Inc.
# Copyright (c) 2019 Intel Corp.
# SPDX-License-Identifier: Apache-2.0

config MCUX_OS_TIMER
	bool "MCUX OS Event timer"
	default y
	depends on DT_HAS_NXP_OS_TIMER_ENABLED
	select TICKLESS_CAPABLE
	select TIMER_HAS_64BIT_CYCLE_COUNTER
	help
	  This module implements a kernel device driver for the NXP OS
	  event timer and provides the standard "system clock driver" interfaces.

if MCUX_OS_TIMER

config MCUX_OS_TIMER_PM_POWERED_OFF
	bool "Reinitialize the OS Timer"
	help
	  OS Timer is turned off in certain low power modes. When this option is
	  picked, OS Timer will take steps to store state and reinitialize on wakeups.

config MCUX_OS_TIMER_MIN_DELAY
	int "Minimum delay cycles for OS timer match value"
	default 1000
	help
	  Timer hardware requires a minimum setup time to reliably trigger
	  interrupts. If a match value is set too close to the current timer
	  count, the hardware may not have enough time to process it.
	  Lower values can improve timing precision but may be less reliable.
	  Higher values provide more safety margin but slightly reduce timing accuracy.

endif # MCUX_OS_TIMER
```

## drivers/timer/Kconfig.mcux_rtc_jdp
```kconfig
# Copyright 2026 NXP
# SPDX-License-Identifier: Apache-2.0

DT_CHOSEN_ZEPHYR_SYSTEM_TIMER := zephyr,system-timer
DT_CHOSEN_ZEPHYR_SYSTEM_TIMER_PATH := $(dt_chosen_path,$(DT_CHOSEN_ZEPHYR_SYSTEM_TIMER))
DT_COMPAT_NXP_RTC_JDP := nxp,rtc-jdp

config MCUX_RTC_JDP_TIMER
	bool "MCUX RTC JDP system timer"
	default y
	depends on $(dt_chosen_enabled,$(DT_CHOSEN_ZEPHYR_SYSTEM_TIMER))
	depends on $(dt_node_has_compat,$(DT_CHOSEN_ZEPHYR_SYSTEM_TIMER_PATH),$(DT_COMPAT_NXP_RTC_JDP))
	select TICKLESS_CAPABLE
	select SYSTEM_TIMER_HAS_DISABLE_SUPPORT
	select TIMER_READS_ITS_FREQUENCY_AT_RUNTIME
	help
	  This module implements a kernel device driver for the NXP RTC (JDP
	  generation) and provides the standard "system clock driver" interfaces.
	  Because the RTC keeps running across all low-power states it can serve as
	  the system tick source without a companion timer. The instance to use is
	  selected via the zephyr,system-timer chosen property.
```
