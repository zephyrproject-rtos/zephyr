## drivers/timer/Kconfig.mcux_sysctr
```kconfig
# Copyright 2026 NXP
# SPDX-License-Identifier: Apache-2.0

DT_CHOSEN_ZEPHYR_SYSTEM_TIMER := zephyr,system-timer
DT_CHOSEN_ZEPHYR_SYSTEM_TIMER_PATH := $(dt_chosen_path,$(DT_CHOSEN_ZEPHYR_SYSTEM_TIMER))
DT_COMPAT_NXP_SYSCTR := nxp,sysctr

config MCUX_SYSCTR_TIMER
	bool "MCUX System Counter (SYS_CTR) timer"
	depends on $(dt_chosen_enabled,$(DT_CHOSEN_ZEPHYR_SYSTEM_TIMER))
	depends on $(dt_node_has_compat,$(DT_CHOSEN_ZEPHYR_SYSTEM_TIMER_PATH),$(DT_COMPAT_NXP_SYSCTR))
	select TICKLESS_CAPABLE
	select TIMER_HAS_64BIT_CYCLE_COUNTER
	select SYSTEM_TIMER_HAS_DISABLE_SUPPORT
	help
	  System clock driver for the NXP System Counter (SYS_CTR): a 56-bit
	  free-running counter at 24 MHz with two compare frames. Only compare
	  frame 0 is used, for the system timer; pick the instance with the
	  zephyr,system-timer chosen property.

	  Note that SYS_CTR is a time base shared by multiple cores, and this
	  driver resets the whole block (counter and both compare frames) at
	  init. So it must own that instance: don't enable it if another core
	  or a boot stage is already using the same SYS_CTR.

if MCUX_SYSCTR_TIMER

config MCUX_SYSCTR_TIMER_MIN_DELAY
	int "Minimum delay cycles for the timer match value"
	default 1000
	help
	  Timer hardware requires a minimum setup time to reliably trigger
	  interrupts. If a match value is set too close to the current timer
	  count, the hardware may not have enough time to process it.
	  Lower values can improve timing precision but may be less reliable.
	  Higher values provide more safety margin but slightly reduce timing accuracy.

endif # MCUX_SYSCTR_TIMER
```

## drivers/timer/Kconfig.mcux_utick
```kconfig
# Copyright 2025 NXP
# SPDX-License-Identifier: Apache-2.0

config MCUX_UTICK_TIMER
	bool "MCUX Micro-Tick Timer"
	default n
	depends on DT_HAS_NXP_UTICK_ENABLED
	select TICKLESS_CAPABLE
	select SYSTEM_TIMER_HAS_DISABLE_SUPPORT
	help
	  This module implements a kernel device driver for the NXP MCUX Micro
	  Tick timer and provides the standard "system clock driver" interfaces.

if MCUX_UTICK_TIMER

config SYS_CLOCK_HW_CYCLES_PER_SEC
	int
	default 1000000
	help
	  UTICK source frequency in Hz (e.g. 1 MHz). Must match real UTICK clock.

endif
```

## drivers/timer/Kconfig.mec5
```kconfig
# Copyright (c) 2024 Microchip Technology Inc.
# SPDX-License-Identifier: Apache-2.0

config MCHP_MEC5_KTIMER
	bool "Microchip MEC5 HAL kernel timer"
	default y
	depends on DT_HAS_MICROCHIP_MEC5_KTIMER_ENABLED
	select TICKLESS_CAPABLE
	select SYSTEM_TIMER_HAS_DISABLE_SUPPORT
	select ARCH_HAS_CUSTOM_BUSY_WAIT
	help
	  This module implements a kernel timer device driver for the
	  Microchip MEC5 SoC. It makes use of two hardware timers.
	  The 32-bit 32 KHz based RTOS timer which is operational in
	  full power and deep sleep. Basic timer 5 is a 48 MHz based
	  32-bit down counter with frequency divider used for the
	  custom busy wait kernel API.
```

## drivers/timer/Kconfig.mips_cp0
```kconfig
# Copyright (c) 2021 Antony Pavlov <antonynpavlov@gmail.com>
#
# SPDX-License-Identifier: Apache-2.0

config MIPS_CP0_TIMER
	bool "MIPS CP0 Timer"
	depends on MIPS
	select TICKLESS_CAPABLE
	help
	  This module implements a kernel device driver for the MIPS CP0 timer.
```

## drivers/timer/Kconfig.mtk_adsp
```kconfig
# Copyright 2023 The ChromiumOS Authors
# SPDX-License-Identifier: Apache-2.0

config MTK_ADSP_TIMER
	bool "MediaTek Audio DSP timer"
	depends on SOC_FAMILY_MTK
	select TICKLESS_CAPABLE
	select TIMER_HAS_64BIT_CYCLE_COUNTER
	select SYSTEM_CLOCK_LOCK_FREE_COUNT
	help
	  MediaTek MT81xx Audio DSPs have a 13 Mhz wall clock timer
	  for system time that is independent of CPU speed.
```
