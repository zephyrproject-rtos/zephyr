## drivers/timer/Kconfig.stm32_lptim
```kconfig
# STM32 LPTIM configuration options

# Copyright (c) 2019 STMicroelectronics
# SPDX-License-Identifier: Apache-2.0

DT_CHOSEN_STDBY_TIMER := st,lptim-stdby-timer
DT_CHOSEN_Z_SYSTEM_TIMER := zephyr,system-timer
DT_CHOSEN_Z_SYSTEM_TIMER_PATH := $(dt_chosen_path,$(DT_CHOSEN_Z_SYSTEM_TIMER))

# Selecting an LPTIM as system timer by using the `stm32_lp_tick_source` nodelabel
# is no longer supported since Zephyr v4.5; instead, the selection should be done
# using the standard `zephyr,system-timer` chosen. Detect the old mechanism and
# break build if found, with an hopefully helpful error message.
$(error-if,$(dt_nodelabel_has_compat,stm32_lp_tick_source,$(DT_COMPAT_ST_STM32_LPTIM)),\
Detected usage of deprecated nodelabel `stm32_lp_tick_source` to select system timer. \
Please use the `$(DT_CHOSEN_Z_SYSTEM_TIMER)` chosen to select LPTIM instance instead.)

menuconfig STM32_LPTIM_TIMER
	bool "STM32 Low Power Timer [EXPERIMENTAL]"
	default y
	depends on $(dt_chosen_has_compat,$(DT_CHOSEN_Z_SYSTEM_TIMER),$(DT_COMPAT_ST_STM32_LPTIM))
	depends on $(dt_chosen_enabled,$(DT_CHOSEN_Z_SYSTEM_TIMER))
	depends on DT_HAS_ST_STM32_LPTIM_ENABLED
	depends on CLOCK_CONTROL && PM
	select RESET
	select TICKLESS_CAPABLE
	select EXPERIMENTAL
	help
	  This module implements a kernel device driver for the LowPower Timer
	  and provides the standard "system clock driver" interfaces.

if STM32_LPTIM_TIMER

# Invisible symbols exposing the selected LPTIM source to Kconfig
# NOTE: the values 2/3 correspond too STM32_SRC_LSE/STM32_SRC_LSI
# defined in include/zephyr/dt-bindings/clock/stm32_common_clocks.h
STM32_LPTIM_SYSTIMER_CLK_SRC := \
	$(dt_node_ph_array_prop_int,$(DT_CHOSEN_Z_SYSTEM_TIMER_PATH),clocks,1,bus)

config STM32_LPTIM_CLOCK_LSI
	def_bool $(STM32_LPTIM_SYSTIMER_CLK_SRC) = 3
	help
	  LSI used as LPTIM clock source

config STM32_LPTIM_CLOCK_LSE
	def_bool $(STM32_LPTIM_SYSTIMER_CLK_SRC) = 2
	help
	  LSE used as LPTIM clock source

config STM32_LPTIM_CLOCK
	int
	default 32768 if STM32_LPTIM_CLOCK_LSE
	default 32000 if STM32_LPTIM_CLOCK_LSI

config STM32_LPTIM_TIMEBASE
	hex "LPTIM AutoReload value"
	default 0xFFFF if STM32_LPTIM_CLOCK_LSE
	default 0xF9FF if STM32_LPTIM_CLOCK_LSI

config STM32_LPTIM_TICK_FREQ_RATIO_OVERRIDE
	bool "Override tick to freq ratio check"
	default y if ZTEST
	help
	  For LPTIM configuration, a specific tick freq is advised
	  depending on LPTIM input clock:
	  - LSI(32KHz): 4000 ticks/sec
	  - LSE(32768): 4096 ticks/sec
	  To prevent misconfigurations, a dedicated check is implemented
	  in the driver.
	  This options allows to override this check

config STM32_LPTIM_STDBY_TIMER
	bool
	default $(dt_chosen_enabled,$(DT_CHOSEN_STDBY_TIMER))
	depends on COUNTER
	depends on TICKLESS_KERNEL
	select EXPERIMENTAL
	help
	  Use an additional timer while entering Standby mode.
	  There are chips e.g. STM32WBAX family that use LPTIM as a system timer,
	  but LPTIM is not clocked in standby mode. These chips usually have
	  another timer that is not stopped, but it has lower frequency e.g.
	  RTC, thus it can't be used as a main system timer.
	  Same approach is used on STM32U5 and STOP3 mode.

	  Use the Standby timer for timeout (wakeup) when the system is entering
	  Standby state.

	  The chosen Standby timer node has to support setting alarm from the
	  counter API.

endif # STM32_LPTIM_TIMER
```

## drivers/timer/Kconfig.stm32wb0_radio_timer
```kconfig
# STM32WB0x radio timer configuration options

# Copyright (c) 2025 STMicroelectronics
# SPDX-License-Identifier: Apache-2.0

config STM32WB0_RADIO_TIMER
	bool "STM32 Radio Timer for WB0x"
	default y if PM || BT
	depends on SOC_SERIES_STM32WB0X
	select USE_STM32_HAL_RADIO_TIMER
	select HAS_STM32LIB
	select TICKLESS_CAPABLE
	select SYSTEM_TIMER_HAS_DISABLE_SUPPORT
```

## drivers/timer/Kconfig.sy1xx_sys_timer
```kconfig
# Copyright (c) 2024 sensry.io
# SPDX-License-Identifier: Apache-2.0

config SY1XX_SYS_TIMER
	bool "Sensry ganymed system timer"
	default y
	depends on SOC_SERIES_SY1XX
	depends on $(dt_nodelabel_enabled,systick)
	help
	  This module implements a kernel device driver for the system timer
	  and provides the standard "system clock driver" interfaces.
```

## drivers/timer/Kconfig.tc3x
```kconfig
# Copyright (c) 2024 Infineon Technologies AG
# SPDX-License-Identifier: Apache-2.0

config TC3X_STM
	bool "TC3x System Timer Module (STM) support"
	depends on SOC_SERIES_TC3X
	default y
	select TICKLESS_CAPABLE
	select TIMER_HAS_64BIT_CYCLE_COUNTER
	select SYSTEM_TIMER_HAS_DISABLE_SUPPORT
	help
	  This option enables the system timer driver for the Infineon TC3x
	  System Timer Module as separate modules.
```

## drivers/timer/Kconfig.tc4x
```kconfig
# Copyright (c) 2024 Infineon Technologies AG
# SPDX-License-Identifier: Apache-2.0

config TC4X_STM
	bool "TC4x System Timer Module (STM) support"
	depends on SOC_SERIES_TC4X
	default y
	select TICKLESS_CAPABLE
	select TIMER_HAS_64BIT_CYCLE_COUNTER
	select SYSTEM_TIMER_HAS_DISABLE_SUPPORT
	help
	  This option enables the system timer driver for the Infineon TC4x
	  System Timer Module integrated in the cores.
```

## drivers/timer/Kconfig.tcc_vcpttc
```kconfig
# Copyright 2024 Hounjoung Rim <hounjoung@tsnlab.com>
# SPDX-License-Identifier: Apache-2.0

config TCC_VCPTTC_TIMER
	bool "Telechips VCP ttc timer support"
	default y
	depends on DT_HAS_TCC_TTCVCP_ENABLED
	help
	  This module implements a kernel device driver for the Telechips VCP
	  platform provides the standard "system clock driver" interfaces.
	  If unchecked, no timer will be used.

config TCC_VCPTTC_TIMER_INDEX
	int "Telechips VCP ttc timer index"
	range 0 9
	default 0
	depends on TCC_VCPTTC_TIMER
	help
	  This is the index of TTC timer picked to provide system clock.
```

## drivers/timer/Kconfig.ti_rti_timer
```kconfig
# Copyright (C) 2025 Texas Instruments Incorporated
#
# SPDX-License-Identifier: Apache-2.0

config TI_RTI_TIMER
	bool "TI RTI Timer"
	default y
	depends on DT_HAS_TI_AM26_RTITIMER_ENABLED
	help

	  This module implements a kernel device driver for TI RTI timer. This
	  driver provides system tick interface.
```

## drivers/timer/Kconfig.tms570_rti_timer
```kconfig
# Copyright (C) 2025 ispace, inc.
#
# SPDX-License-Identifier: Apache-2.0

config TMS570_RTI_TIMER
	bool "TI TMS570 RTI Timer"
	default y
	depends on SOC_TI_TMS570LC43X
	help
	  This module implements a kernel device driver for the TI TMS570 RTI
	  timer.
```

## drivers/timer/Kconfig.wch_ch32v00x
```kconfig
# Copyright (c) 2024 Michael Hope
# SPDX-License-Identifier: Apache-2.0

config CH32V00X_SYSTICK
	bool "CH32V QingKe core systick timer"
	depends on SOC_SERIES_QINGKE_V2A || SOC_SERIES_QINGKE_V4C || SOC_SERIES_CH32V00X || SOC_SERIES_QINGKE_V4B || SOC_SERIES_QINGKE_V4F
	default y
	depends on DT_HAS_WCH_SYSTICK_ENABLED
```

## drivers/timer/Kconfig.wch_qingke_systick
```kconfig
# Copyright (c) 2022 TOKITA Hiroshi <tokita.hiroshi@gmail.com>
# SPDX-License-Identifier: Apache-2.0

config WCH_QINGKE_SYSTICK
	bool "WCH QingKe core systick"
	depends on SOC_SERIES_CH32V30X
	default y
	select TICKLESS_CAPABLE
	select TIMER_HAS_64BIT_CYCLE_COUNTER
	help
	  The option enables the driver for the WCH QingKe Core's systick timer
```

## drivers/timer/Kconfig.x86
```kconfig
# Copyright (c) 2014-2015 Wind River Systems, Inc.
# Copyright (c) 2016 Cadence Design Systems, Inc.
# Copyright (c) 2019-2023 Intel Corp.
# SPDX-License-Identifier: Apache-2.0

choice
	prompt "Default System Timer"
	default HPET_TIMER if SOC_FAMILY_INTEL_ISH || SOC_ATOM || SOC_LAKEMONT
	default APIC_TSC_DEADLINE_TIMER
	depends on X86
	help
	  Select Default System Timer.

config HPET_TIMER
	bool "HPET timer"
	depends on DT_HAS_INTEL_HPET_ENABLED
	select IOAPIC
	select LOAPIC
	imply TIMER_READS_ITS_FREQUENCY_AT_RUNTIME
	select TICKLESS_CAPABLE
	select TIMER_HAS_64BIT_CYCLE_COUNTER
	help
	  This option selects High Precision Event Timer (HPET) as a
	  system timer.

config APIC_TIMER
	bool "Local APIC timer"
	select LOAPIC
	select TIMER_HAS_64BIT_CYCLE_COUNTER
	select SYSTEM_CLOCK_LOCK_FREE_COUNT
	help
	  Use the x86 local APIC in periodic mode as the system time
	  source.  NOTE: this probably isn't what you want except on
	  older or idiosyncratic hardware (or environments like qemu
	  without complete APIC emulation).  Modern hardware will work
	  better with CONFIG_APIC_TSC_DEADLINE_TIMER.

config APIC_TSC_DEADLINE_TIMER
	bool "Local APIC timer using TSC deadline mode"
	select LOAPIC
	select TICKLESS_CAPABLE
	select TIMER_HAS_64BIT_CYCLE_COUNTER
	help
	  Extremely simple timer driver based the local APIC TSC
	  deadline capability.  The use of a free-running 64 bit
	  counter with comparator eliminates almost all edge cases
	  from the handling, and the near-instruction-cycle resolution
	  permits effectively unlimited precision where needed (the
	  limit becomes the CPU time taken to execute the timing
	  logic). SMP-safe and very fast, this should be the obvious
	  choice for any x86 device with invariant TSC and TSC
	  deadline capability.

config APIC_TIMER_TSC
	bool "Local APIC timer using TSC time source"
	depends on !SMP
	select LOAPIC
	select TICKLESS_CAPABLE
	select TIMER_HAS_64BIT_CYCLE_COUNTER
	help
	  If your CPU supports invariant TSC but no TSC deadline capability
	  then this choice will rely on the TSC as time source and the
	  local APIC in one-shot mode as the timeout event source.
	  You must know the ratio of the TSC frequency to the local APIC
	  timer frequency.

endchoice

if APIC_TIMER

config APIC_TIMER_IRQ
	int "Local APIC timer IRQ"
	default 24
	help
	  This option specifies the IRQ used by the local APIC timer.
	  Note: this MUST be set to the index immediately after the
	  last IO-APIC IRQ (the timer is the first entry in the APIC
	  local vector table).  This footgun is not intended to be
	  user-configurable and almost certainly should be managed via
	  a different mechanism.

endif # APIC_TIMER

if APIC_TIMER_TSC

config APIC_TIMER_TSC_N
	int "TSC to local APIC timer frequency multiplier (N)"
	default 1

config APIC_TIMER_TSC_M
	int "TSC to local APIC timer frequency divisor (M)"
	default 1

endif # APIC_TIMER_TSC

config APIC_TIMER_IRQ_PRIORITY
	int "Local APIC timer interrupt priority"
	depends on APIC_TIMER || APIC_TSC_DEADLINE_TIMER || APIC_TIMER_TSC
	default 4
	help
	  This option specifies the interrupt priority used by the
	  local APIC timer.
```

## drivers/timer/Kconfig.xlnx_psttc
```kconfig
# Copyright (c) 2014-2015 Wind River Systems, Inc.
# Copyright (c) 2016 Cadence Design Systems, Inc.
# Copyright (c) 2019 Intel Corp.
# SPDX-License-Identifier: Apache-2.0

config XLNX_PSTTC_TIMER
	bool "Xilinx PS Triple-Timer Counter support"
	default y
	depends on DT_HAS_XLNX_TTCPS_ENABLED
	select TICKLESS_CAPABLE
	help
	  Enable the AMD Xilinx PS Triple Timer Counter (TTC) timer driver for
	  Zynq UltraScale+ MPSoC (ZynqMP) and Versal platforms. This TTC-based
	  timer driver provides the "standard system clock driver" interface.
	  If disabled, the TTC will not be used as the system timer.

config XLNX_PSTTC_TIMER_INDEX
	int "Xilinx PS Triple-Timer Counter index"
	range 0 3
	default 0
	depends on XLNX_PSTTC_TIMER
	help
	  This is the index of TTC timer picked to provide system clock.
```

## drivers/timer/Kconfig.xlnx_tmrctr
```kconfig
# Copyright (c) 2023 Advanced Micro Devices, Inc. (AMD)
# Copyright (c) 2023 Alp Sayin <alpsayin@gmail.com>
# SPDX-License-Identifier: Apache-2.0




config XLNX_TMRCTR
	bool "Xilinx AXI Timer/Counter"
	select TICKLESS_CAPABLE
	default y if MICROBLAZE
	help
		This module implements a kernel device driver for the MICROBLAZE AXI Timer devices.
		AXI timer is not capable of matching against a preloaded value. Thus, it's not
		capable of providing TICKLESS_KERNEL.

config XLNX_TMRCTR_TIMER_INDEX
	int "Xilinx TMRCTR timer index"
	default 0
	depends on XLNX_TMRCTR
	help
		This is the index of timer/counter picked to provide system clock.
```

## drivers/timer/Kconfig.xtensa
```kconfig
# Copyright (c) 2014-2015 Wind River Systems, Inc.
# Copyright (c) 2016 Cadence Design Systems, Inc.
# Copyright (c) 2019 Intel Corp.
# Copyright (c) 2026 Espressif Systems (Shanghai) Co., Ltd.
# SPDX-License-Identifier: Apache-2.0

config XTENSA_TIMER
	bool "Xtensa timer support"
	depends on XTENSA
	default y
	select TICKLESS_CAPABLE
	help
	  Enables a system timer driver for Xtensa based on the CCOUNT
	  and CCOMPARE special registers.

config XTENSA_TIMER_ID
	int "System timer CCOMPAREn register index"
	default 0
	depends on XTENSA_TIMER
	help
	  Index of the CCOMPARE register (and associated interrupt)
	  used for the system timer.  Xtensa CPUs have hard-configured
	  interrupt priorities associated with each timer, and some of
	  them can be unmaskable (and thus not usable by OS code that
	  need synchronization, like the timer subsystem!).  In
	  general timer zero is guaranteed to be present and usable.

choice XTENSA_TIMER_LPM_TIMER
	prompt "Xtensa CCOUNT low-power mode support"
	depends on XTENSA_TIMER
	default XTENSA_TIMER_LPM_TIMER_NONE
	help
	  CCOUNT stops when the CPU clock is gated during low-power modes.
	  A companion timer that remains active can be used to compensate
	  for the missed cycles.

config XTENSA_TIMER_LPM_TIMER_NONE
	bool "No compensation"
	help
	  Use no additional device as low-power mode timer.
	  The SoC must never enter a low-power mode where CCOUNT stops
	  when this option is selected.

config XTENSA_TIMER_LPM_TIMER_HOOK
	bool "Hook-based compensation"
	depends on PM && TICKLESS_KERNEL
	help
	  The platform provides a hook returning the number of
	  CPU cycles missed while CCOUNT was stopped during
	  low-power mode.

endchoice
```

## drivers/touch/Kconfig
```kconfig
# Copyright 2022 Interrupt Labs <info@interruptlabs.ca>
# SPDX-License-Identifier: Apache-2.0
menuconfig TOUCH
	bool "Touch Drivers"
	help
	  Include touch drivers in system config

if TOUCH
config TOUCH_INIT_PRIORITY
	int "Touch init priority"
	default 90
	help
	  Touch initialization priority.

source "drivers/touch/iqs5xx/Kconfig"
endif # TOUCH
```

## drivers/touch/iqs5xx/Kconfig
```kconfig
# IQS5XX Trackpad Controller

# Copyright (C) 2022 Ryan Walker <info@interruptlabs.ca>
# SPDX-License-Identifier: Apache-2.0

config TOUCH_LOG_LEVEL
	int "Log Level for Touch"
	default 4

config IQS5XX
	bool "IQS5XX Driver"
	depends on I2C && GPIO
	help
	  Projected capacitive trackpad/touchscreen controller.

config IQS5XX_X_RES
	int "IQS5XX X Resolution"
	depends on IQS5XX
	default 3072

config IQS5XX_Y_RES
	int "IQS5XX Y Resolution"
	depends on IQS5XX
	default 2048

config IQS5XX_TOTAL_RX
	int "IQS5XX RX Channels"
	depends on IQS5XX
	default 9

config IQS5XX_TOTAL_TX
	int "IQS5XX RX Channels"
	depends on IQS5XX
	default 13
```

## drivers/touchscreen/Kconfig
```kconfig
#
# Copyright (c) 2016 Linaro Ltd.
#
# SPDX-License-Identifier: Apache-2.0
#

menuconfig TOUCHSCREEN
	bool
	prompt "Touchscreen Support"
	default n
	help
	  Include support for touchscreens.

if TOUCHSCREEN

config TOUCHSCREEN_HELPERS
	bool "Helper functions for using touchscreens"
	default y
	help
	  Functions for setting up touchscreen calibration and converting
	  samples to display coordinates.

source "drivers/touchscreen/Kconfig.stmpe811"

endif
```
