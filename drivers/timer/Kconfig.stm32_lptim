## drivers/touchscreen/Kconfig.stmpe811
```kconfig
#
# Copyright (c) 2017 Linaro Ltd.
#
# SPDX-License-Identifier: Apache-2.0
#

menuconfig TSC_STMPE811
	bool "STMPE811 touchscreen driver"
	depends on I2C

if TSC_STMPE811

config TSC_STMPE811_NAME
	string "Device name for the STMPE811 touchscreen driver"
	default "TOUCHSCREEN"

config TSC_STMPE811_IRQ_PRI
	int "Interrupt priority for the STMPE811"
	default 0

config TSC_STMPE811_I2C_DEVICE
	string "Name of I2C device that the STMPE811 is attached to"

config TSC_STMPE811_I2C_ADDR
	int "I2C address of the STMPE811 device"
	default 65

config TSC_STMPE811_Z_SAMPLES
	bool "Include Z coordinate (pressure) samples"

config TSC_STMPE811_FRACTION_Z
	int "Value for the TSC_FRACTION_Z register"
	depends on TSC_STMPE811_Z_SAMPLES
	range 0 7
	default 4
	help
	  This value governs the range of the Z coordinate (pressure) and
	  a suitable value depend on the resistance of the touchscreen.

endif
```

## drivers/uart_generic/Kconfig
```kconfig
# Kconfig - Modem configuration options

#
# Copyright (c) 2018 Foundries.io
#
# SPDX-License-Identifier: Apache-2.0
#

menuconfig UART_GENERIC
	bool "Generic UART Device Drivers"
	help
	  Enable config options for generic UART device drivers.

if UART_GENERIC

config UART_SHELL
	bool "Enable UART shell"
	select CONSOLE_SHELL
	help
	  Activate shell module that provides functions to communicate with UART devices.

endif # UART_GENERIC
```

## drivers/ufshc/Kconfig
```kconfig
# Copyright (c) 2025 Advanced Micro Devices, Inc.
# SPDX-License-Identifier: Apache-2.0

# UFS Host Controller (UFSHC) Drivers Configuration
menuconfig UFSHC
	bool "UFS Host Controller (UFSHC) drivers"
	help
	  Enable support for UFS host controller drivers.

if UFSHC

source "drivers/ufshc/Kconfig.amd_versal2"

# UFS Host Controller driver initialization priority
config UFSHC_INIT_PRIORITY
	int "UFSHC driver init priority"
	default 85
	help
	  Set the initialization priority for the UFSHC driver during system boot.

# Buffer alignment for UFS Host Controller drivers
config UFSHC_BUFFER_ALIGNMENT
	int
	default 64
	help
	  Some UFS host controllers require specific buffer alignment for DMA operations.
	  Devices should adjust this value if a different alignment is necessary for operation.
	  This value represents the alignment of data buffers in bytes (default: 64 bytes).

module = UFSHC
module-str = ufshc
source "subsys/logging/Kconfig.template.log_config"

endif # UFSHC
```

## drivers/ufshc/Kconfig.amd_versal2
```kconfig
# Copyright (c) 2025 Advanced Micro Devices, Inc.
# SPDX-License-Identifier: Apache-2.0

config UFS_AMD_VERSAL2
	bool "AMD Versal Gen 2 UFS controller driver"
	default y
	depends on DT_HAS_AMD_VERSAL2_UFS_ENABLED
	help
	  This option enables support for the AMD Versal Gen2 UFS (Universal Flash Storage)
	  Host Controller.
```

## drivers/usb/Kconfig
```kconfig
# USB configuration options

# Copyright (c) 2016 Wind River Systems, Inc.
# SPDX-License-Identifier: Apache-2.0

config USB_BUF_FORCE_NOCACHE
	bool
	depends on NOCACHE_MEMORY && DCACHE && (UDC_DRIVER || UHC_DRIVER)
	help
	  Place the buffer pools in the nocache memory region if the driver
	  cannot handle buffers in cached memory.

source "drivers/usb/bc12/Kconfig"
source "drivers/usb/udc/Kconfig"
source "drivers/usb/uhc/Kconfig"
source "drivers/usb/uvb/Kconfig"
source "drivers/usb/device/Kconfig"
source "drivers/usb/common/Kconfig"
```

## drivers/usb/bc12/Kconfig
```kconfig
# Copyright (c) 2022 Google LLC
# SPDX-License-Identifier: Apache-2.0

menuconfig USB_BC12
	bool "USB BC1.2 Drivers"
	help
	  Enable USB BC1.2 (battery charging detection) drivers.

if USB_BC12

module = USB_BC12
module-str = usb_bc12
source "subsys/logging/Kconfig.template.log_config"

source "drivers/usb/bc12/Kconfig.pi3usb9201"

endif # USB_BC12
```

## drivers/usb/bc12/Kconfig.nrf54l
```kconfig
# Copyright Nordic Semiconductor ASA
# SPDX-License-Identifier: Apache-2.0

config USB_BC12_NRF_USBHS
	bool "Nordic USBHS PD Charging-Type Detector"
	default y
	depends on DT_HAS_NORDIC_NRF_USBHS_BC12_ENABLED
	help
	  Nordic portable device mode USB Charging-Type Detector.
```

## drivers/usb/bc12/Kconfig.pi3usb9201
```kconfig
# Copyright (c) 2022 Google LLC
# SPDX-License-Identifier: Apache-2.0

config USB_BC12_PI3USB9201
	bool "Diodes PI3USB9201"
	default y
	depends on DT_HAS_DIODES_PI3USB9201_ENABLED
	help
	  This is a Dual-Role USB Charging-Type Detector. It can operate in
	  host or client mode. It supports Battery Charging Specification, rev
	  1.2 (BC1.2) with Standard/Charging/Dedicated downstream port
	  (SDP/CDP/DCP) advertisement when in host mode. In portable device or
	  client mode it starts BC1.2 detection to detect the attached host
	  type. It provides an I2C interface to report detection results.

config EMUL_BC12_PI3USB9201
	bool "Emulate a Pericom PI3USB9201 USB charging detector"
	default y
	depends on ZTEST && DT_HAS_DIODES_PI3USB9201_ENABLED
	help
	  This is an emulator for the Pericom PI3USB9201 USB charging detector.

	  The backend API allows test code to force the type of the partner
	  charginging device.

if USB_BC12_PI3USB9201

config USB_BC12_PI3USB9201_CDP_ERRATA
	bool "PI3USB9201 CDP Errata"
	default y
	help
	  When this option is enabled and the charging mode is configured for
	  CDP (Charging Downstream Port), after successful CDP detection the
	  driver automatically sets the charging mode to SDP (Standard
	  Downstream Port).

	  This is a workaround for a glitch seen on the USB data lines when
	  operating in CDP mode. Note that the BC1.2 negotiation compeletes
	  before switching to SDP mode, so the attached portable device can
	  continue to draw up to 1.5 A.

endif # USB_BC12_PI3USB9201
```
