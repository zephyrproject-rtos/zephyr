## drivers/opamp/Kconfig.mspm0_opamp_gpamp
```kconfig
# TI MSPM0 Family

# SPDX-FileCopyrightText: Copyright (c) 2026 Texas Instruments
# SPDX-License-Identifier: Apache-2.0

config OPAMP_MSPM0_GPAMP
	bool "TI MSPM0 GPAMP driver"
	default y
	select SYSCON
	depends on DT_HAS_TI_MSPM0_GPAMP_ENABLED
```

## drivers/opamp/Kconfig.stm32_opamp
```kconfig
# Copyright (c) 2025 Alexander Kozhinov <ak.alexander.kozhinov@gmail.com>
# Copyright (c) 2026 Witekio
# SPDX-License-Identifier: Apache-2.0

config OPAMP_STM32
	bool "STM32 OPAMP driver"
	default y
	select PINCTRL
	depends on DT_HAS_ST_STM32_OPAMP_ENABLED

config OPAMP_LL_API_VER
	int
	depends on OPAMP_STM32
	range 1 2
	default 1 if SOC_SERIES_STM32G4X
	default 2 if SOC_SERIES_STM32U5X
	help
	  Version of the STM32 LL OPAMP API of the series
```

## drivers/otp/Kconfig.aspeed
```kconfig
# Copyright (c) 2026 ASPEED Technology Inc.
# SPDX-License-Identifier: Apache-2.0

config OTP_AST27X0
	bool "ASPEED AST27x0 OTP driver"
	default y
	depends on DT_HAS_ASPEED_AST2700_OTP_ENABLED
	help
	  Enable read-only access to the OTP controller of the ASPEED AST27x0
	  series.
```

## drivers/otp/Kconfig.rockchip
```kconfig
# SPDX-FileCopyrightText: Copyright The Zephyr Project Contributors
# SPDX-License-Identifier: Apache-2.0

config OTP_ROCKCHIP
	bool "Rockchip RK3588 OTP driver"
	default y
	depends on DT_HAS_ROCKCHIP_RK3588_OTP_ENABLED
	help
	  Enable Rockchip RK3588 OTP driver.
```

## drivers/pinctrl/Kconfig.rockchip
```kconfig
# SPDX-FileCopyrightText: Copyright (c) 2026 Process Mission
# SPDX-License-Identifier: Apache-2.0

config PINCTRL_ROCKCHIP
	bool "Rockchip RK3588 pin controller"
	default y
	depends on DT_HAS_ROCKCHIP_RK3588_PINCTRL_ENABLED
	depends on SOC_RK3588
	help
	  Enable the Rockchip RK3588 IOC pin controller.
```

## drivers/pinctrl/Kconfig.wch_ch582m
```kconfig
# Copyright (c) 2026 Zephyr Project Contributors
# SPDX-License-Identifier: Apache-2.0

config PINCTRL_WCH_CH582M
	bool "WCH CH582M pin controller driver"
	default y
	depends on DT_HAS_WCH_CH582M_PINCTRL_ENABLED
	help
	  WCH CH582M pin controller driver.
```

## drivers/pinctrl/Kconfig.wch_x03x_afio
```kconfig
# Copyright (c) 2026 Chen Ren
# SPDX-License-Identifier: Apache-2.0

config PINCTRL_WCH_X03X_AFIO
	bool "WCH AFIO pin controller driver for CH32X035"
	default y
	depends on DT_HAS_WCH_X03X_AFIO_ENABLED
	help
	  WCH CH32X035 AFIO pin controller driver.
```

## drivers/ptp_clock/Kconfig.renesas_ra
```kconfig
# Copyright The Zephyr Project Contributors
# SPDX-License-Identifier: Apache-2.0

config PTP_CLOCK_RENESAS_RA_GPTP
	bool "Renesas RA ESWM gPTP timer PTP clock driver"
	default y
	depends on DT_HAS_RENESAS_RA_GPTP_TIMER_ENABLED
	depends on ETH_RENESAS_RA_RMAC
	select USE_RA_FSP_GPTP
	help
	  Enable the PTP clock driver for the gPTP timer of the Renesas RA
	  Layer 3 Ethernet Switch Module (ESWM).
```

## drivers/pwm/Kconfig.renesas_rx
```kconfig
# Copyright (c) 2025-2026 Renesas Electronics Corporation
# SPDX-License-Identifier: Apache-2.0

config PWM_RENESAS_RX_MTU
	bool "Renesas RX MTU PWM driver"
	default y
	depends on DT_HAS_RENESAS_RX_MTU_PWM_ENABLED
	depends on HAS_RENESAS_RX_RDP
	help
	  Enable the Renesas RX PWM driver.

config PWM_RENESAS_RX_GPT
	bool "Renesas RX GPT PWM driver"
	default y
	depends on DT_HAS_RENESAS_RX_GPT_PWM_ENABLED
	select USE_RX_FSP_GPT
	select PINCTRL
	help
	  Enable the Renesas RX GPT PWM Driver.
```

## drivers/rc/Kconfig.pwm_ir_transmitter
```kconfig
# SPDX-FileCopyrightText: Copyright (c) 2026 Linumiz
# SPDX-License-Identifier: Apache-2.0

config RC_PWM_IR_TRANSMITTER
	bool "PWM infrared transmitter"
	default y
	depends on DT_HAS_PWM_IR_TRANSMITTER_ENABLED && PWM && COUNTER
	select RC_TX
	help
	  Transmit driver for an infrared LED driven by a PWM carrier. A
	  counter alarm switches the carrier on and off at each edge.

config RC_PWM_IR_TRANSMITTER_GUARD_US
	int "Minimum lead time of an edge alarm, in us"
	default 2
	range 0 1000
	depends on RC_PWM_IR_TRANSMITTER
	help
	  An edge whose alarm would be armed less than this ahead, and at
	  least one counter tick ahead, is late: the transmission stops with
	  -ETIME. It covers the time from the check to the alarm being armed.
```

## drivers/regulator/Kconfig.alif_phy
```kconfig
# Copyright (c) 2026 Analog Devices, Inc.
# SPDX-License-Identifier: Apache-2.0

config REGULATOR_ALIF_PHY
	bool "Alif PHY power regulator driver"
	default y
	depends on DT_HAS_ALIF_PHY_REGULATOR_ENABLED
	help
	  Enable the driver for the Alif PHY power switches
	  controlled by the PWR_CTRL register.

config REGULATOR_ALIF_PHY_INIT_PRIORITY
	int "Alif PHY power regulator init priority"
	default 75
	depends on REGULATOR_ALIF_PHY
	help
	  Init priority for the Alif PHY power regulator driver.
```

## drivers/regulator/Kconfig.nxp_pmc_bandgap
```kconfig
# SPDX-FileCopyrightText: Copyright 2026 NXP
# SPDX-License-Identifier: Apache-2.0

config REGULATOR_NXP_PMC_BANDGAP
	bool "NXP PMC bandgap buffer driver"
	default y
	depends on DT_HAS_NXP_PMC_BANDGAP_BUFFER_ENABLED
	help
	  Enable the NXP Kinetis-style PMC buffered bandgap output driver.

config REGULATOR_NXP_PMC_BANDGAP_INIT_PRIORITY
	int "NXP PMC bandgap buffer driver init priority"
	default 45
	depends on REGULATOR_NXP_PMC_BANDGAP
	help
	  Init priority for the NXP PMC buffered bandgap output.
```

## drivers/regulator/Kconfig.nxp_vref
```kconfig
# Copyright 2023 NXP
# SPDX-License-Identifier: Apache-2.0

config REGULATOR_NXP_VREF
	bool "NXP VREF peripheral driver"
	default y
	depends on DT_HAS_NXP_VREF_ENABLED
	select PM_EARLY_SYSTEM_TIMER_RESUME if PM && PM_DEVICE_SYSTEM_MANAGED
	help
	  Enable the NXP VREF driver. With device runtime PM, the first
	  regulator enable holds a runtime reference until the last disable.
	  Configuration operations temporarily resume the register block
	  without enabling the output.
	  With PM_POLICY_DEVICE_CONSTRAINTS enabled, an active output holds
	  the power-state constraints described by devicetree.
	  With system-managed device PM, the system timer resumes before
	  devices so the VREF startup delays can complete. This enables the
	  experimental early system timer resume sequence.

config REGULATOR_NXP_VREF_INIT_PRIORITY
	int "NXP VREF peripheral driver init priority"
	default 45
	depends on DT_HAS_NXP_VREF_ENABLED
	help
	  Init priority for the NXP VREF peripheral.
```

## drivers/regulator/Kconfig.tps6521x
```kconfig
# SPDX-FileCopyrightText: Copyright The Zephyr Project Contributors
# SPDX-License-Identifier: Apache-2.0

config REGULATOR_TPS6521X
	bool "TI TPS65214/TPS65215 PMIC regulator driver"
	default y
	depends on DT_HAS_TI_TPS6521X_REGULATOR_ENABLED
	select MFD
	help
	  Enable the TI TPS65214 and TPS65215 PMIC regulator driver: three
	  buck converters and two LDOs.

if REGULATOR_TPS6521X

config REGULATOR_TPS6521X_INIT_PRIORITY
	int "TPS6521x regulator driver init priority"
	default 86
	help
	  Init priority for the TPS6521x regulator driver. It must be greater
	  than MFD_INIT_PRIORITY.

endif
```

## drivers/reset/Kconfig.aesc
```kconfig
# SPDX-FileCopyrightText: 2026 Aesc Silicon
# SPDX-License-Identifier: Apache-2.0

config RESET_AESC
	bool "Aesc Silicon reset controller driver"
	default y
	depends on DT_HAS_AESC_RESET_CONTROLLER_ENABLED
	help
	  Enable the Aesc Silicon reset controller driver. The IP core only
	  supports pulsing a reset domain, so reset_line_assert() and
	  reset_line_deassert() are not implemented. reset_line_toggle() and
	  reset_status() require IP version 1.1.0 or newer.
```

## drivers/sdhc/Kconfig.bcm2712
```kconfig
# SPDX-FileCopyrightText: Copyright (c) 2026 Process Mission
# SPDX-License-Identifier: Apache-2.0

menuconfig SDHC_BCM2712
	bool "Broadcom BCM2712 SD host controller"
	default y
	depends on DT_HAS_BRCM_BCM2712_SDHCI_ENABLED
	select SDHC_STANDARD_CORE
	select SDHC_SUPPORTS_UHS
	select SDHC_SUPPORTS_NATIVE_MODE
	select EVENTS
	select PINCTRL
	select GPIO
	select REGULATOR
	help
	  Enable the BCM2712 SD host controller with PIO fallback, 3.3 V
	  legacy/HS and optional 1.8 V SDR50/SDR104 signalling up to 200 MHz.
	  Use sd-uhs-modes to select UHS modes on boards with a switchable I/O
	  supply and 1.8 V signalling enabled.
	  SDR104 multi-block transfers require a card that supports CMD23.
	  Configure main-bank SDIO pins through pinctrl. Dedicated EMMC pads used
	  by the SD card slot must retain the boot firmware configuration.
	  Use interrupts when devicetree provides an interrupt specifier;
	  otherwise poll for completion. Support SD memory and SDIO requests.
	  Requests are limited to 512 bytes per block, including SDIO.
	  In tuning-required modes with retuning mode below 2, requests larger
	  than 4 MiB are rejected. Applications must use smaller transfers.
	  SDIO card interrupts require a devicetree interrupt specifier.
	  eMMC-specific modes are not implemented.
	  Power/voltage, clock-stability and controller or card recovery failures
	  latch the host until the application calls sdhc_hw_reset() and
	  reinitializes the card. The SD stack does not reset the host itself.
	  Failed tuning can be retried after successful command/data line recovery.

if SDHC_BCM2712

menuconfig SDHC_BCM2712_DMA
	bool "BCM2712 ADMA2 transfers"
	depends on DCACHE
	default y
	select CACHE_MANAGEMENT
	help
	  Use ADMA2 with a driver-owned bounce buffer when the controller supports
	  the selected format. Use PIO when ADMA2 is unavailable or the transfer
	  does not fit the bounce buffer.

if SDHC_BCM2712_DMA

config SDHC_BCM2712_DMA_64BIT
	bool "64-bit ADMA2 descriptors"
	default y
	help
	  Use the SDHCI v3-compatible 64-bit descriptor format. If the
	  controller does not report 64-bit system bus support, ADMA2 is
	  disabled and all transfers use PIO. Disable this option to use 32-bit
	  descriptors and limit DMA addresses to the lower 4 GiB.

config SDHC_BCM2712_DMA_BUFFER_SIZE
	int "BCM2712 ADMA2 bounce buffer size"
	default 4096
	range 64 65536
	help
	  Allocate this many bytes per host for DMA transfers. Round the allocation
	  up to the cache-line alignment. Transfers exceeding this size use PIO.

endif # SDHC_BCM2712_DMA

endif # SDHC_BCM2712
```

## drivers/sdhc/Kconfig.rockchip
```kconfig
# SPDX-FileCopyrightText: 2026 Seunghoon Park
# SPDX-License-Identifier: Apache-2.0

config SDHC_ROCKCHIP_DW_MSHC
	bool "Rockchip RK3568 SD/MMC host controller driver"
	default y
	depends on DT_HAS_ROCKCHIP_RK3568_DW_MSHC_ENABLED
	select SDHC_SUPPORTS_NATIVE_MODE
	select SYSCON
	help
	  Enable the driver for the DesignWare Mobile Storage Host Controller
	  found on the Rockchip RK3568 and RK3566 SoCs. SD cards at 3.3 V
	  (default and high speed) on a 1-bit or 4-bit bus are supported.
	  The controller is polled. Data is moved with the CPU through the
	  controller FIFO, or with the internal DMA controller if
	  SDHC_ROCKCHIP_DW_MSHC_IDMAC is enabled.

config SDHC_ROCKCHIP_DW_MSHC_IDMAC
	bool "Use the internal DMA controller for data transfers"
	depends on SDHC_ROCKCHIP_DW_MSHC
	select CACHE_MANAGEMENT
	help
	  Move data with the internal DMA controller of the host controller
	  instead of the CPU when the buffer allows it: the buffer address
	  and length must be multiples of the data cache line size, the
	  buffer and the descriptors must lie in RAM below 4 GiB (physical
	  address) and the transfer must not exceed 256 KiB. Any other
	  transfer is done by the CPU through the FIFO. The data cache is
	  cleaned and invalidated around each transfer.

	  This option sets the SD buffer alignment to the data cache line
	  size, so that buffers from the SD stack are eligible. Without it
	  most transfers fall back to the CPU.

# With D-cache enabled, align the buffers of the SD stack to a full cache line:
# the internal DMA is only used for such buffers, and invalidating a buffer
# must not corrupt adjacent data that shares a cache line.
config SDHC_BUFFER_ALIGNMENT
	default DCACHE_LINE_SIZE if SDHC_ROCKCHIP_DW_MSHC_IDMAC && DCACHE
```

## drivers/sensor/adi/ade9000/Kconfig
```kconfig
# Copyright (c) 2026 A-Eberle <Daniel.Kampert@a-eberle.de>
#
# SPDX-License-Identifier: Apache-2.0

config ADE9000
	bool "ADE9000 polyphase energy metering IC"
	default y
	depends on DT_HAS_ADI_ADE9000_ENABLED
	depends on SENSOR
	select SPI
	select GPIO if $(dt_compat_any_has_prop,$(DT_COMPAT_ADI_ADE9000),reset-gpios)
	help
	  Enable the driver for the Analog Devices ADE9000 polyphase energy
	  metering IC.

if ADE9000

choice ADE9000_TRIGGER_MODE
	prompt "Trigger mode"
	default ADE9000_TRIGGER_GLOBAL_THREAD if $(dt_compat_any_has_prop,$(DT_COMPAT_ADI_ADE9000),irq0-gpios)
	default ADE9000_TRIGGER_GLOBAL_THREAD if $(dt_compat_any_has_prop,$(DT_COMPAT_ADI_ADE9000),irq1-gpios)
	default ADE9000_TRIGGER_NONE
	help
	  Specify the type of triggering used by the driver for IRQ0 and IRQ1.

config ADE9000_TRIGGER_NONE
	bool "No trigger"

config ADE9000_TRIGGER_GLOBAL_THREAD
	bool "Use global thread"
	depends on GPIO
	select ADE9000_TRIGGER

config ADE9000_TRIGGER_OWN_THREAD
	bool "Use own thread"
	depends on GPIO
	select ADE9000_TRIGGER

endchoice

config ADE9000_TRIGGER
	bool

config ADE9000_THREAD_PRIORITY
	int "Thread priority"
	depends on ADE9000_TRIGGER_OWN_THREAD
	default 10
	help
	  Priority of the thread that services IRQ0 and IRQ1.

config ADE9000_THREAD_STACK_SIZE
	int "Thread stack size"
	depends on ADE9000_TRIGGER_OWN_THREAD
	default 1024
	help
	  Stack size of the thread that services IRQ0 and IRQ1.

config ADE9000_MULTIPOINT
	bool "Run time multipoint gain and phase calibration"
	default y if $(dt_compat_any_has_prop,$(DT_COMPAT_ADI_ADE9000),multi-point-compensation,True)
	select FPU if CPU_HAS_FPU
	help
	  Adds ade9000_multipoint_set() and ade9000_multipoint_get() to change the
	  thresholds, gains and phase compensation of the multipoint regions at
	  run time, e.g. with a calibration stored in flash.

endif # ADE9000
```

## drivers/sensor/adi/adt7604/Kconfig
```kconfig
# SPDX-FileCopyrightText: Copyright (c) 2026 Analog Devices, Inc.
# SPDX-License-Identifier: Apache-2.0

config ADT7604
	bool "ADT7604 20-Channel Digital Temperature Sensor"
	default y
	depends on DT_HAS_ADI_ADT7604_ENABLED || DT_HAS_ADI_LTC2984_ENABLED
	select SPI
	select SPI_RTIO
	select RTIO_WORKQ
	select SENSOR_ASYNC_API
	help
	  Enable driver for Analog Devices ADT7604 20-Channel Digital
	  Temperature Measurement System and the register-compatible LTC2984
	  Multi-Sensor High Accuracy Digital Temperature Measurement System.

	  The ADT7604 supports multiple sensor types including RTDs,
	  thermocouples, thermistors, diodes, copper trace sensing,
	  and leak detection across 20 configurable channels. The LTC2984
	  additionally supports thermocouples (with automatic cold junction
	  compensation), diodes, and Direct ADC voltage measurements.
```

## drivers/sensor/adi/adxl382/Kconfig
```kconfig
# Copyright (c) 2026 Deere & Company
# SPDX-License-Identifier: Apache-2.0

config ADXL382
	bool "ADXL382 accelerometer sensor driver"
	default y
	depends on SENSOR && DT_HAS_ADI_ADXL382_ENABLED
	select SPI
	select RTIO_WORKQ if SENSOR_ASYNC_API
	help
	  Poll XYZ in low-power mode at a fixed +/-60 g range. Supports the
	  sensor fetch/get channels and, with SENSOR_ASYNC_API, one-shot RTIO
	  reads decoded to q31 m/s^2.
```
