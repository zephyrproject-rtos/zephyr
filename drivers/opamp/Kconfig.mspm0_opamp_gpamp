## drivers/sensor/bosch/bmi260/Kconfig
```kconfig
# Copyright (c) 2026 Shreyas Acharya
# SPDX-License-Identifier: Apache-2.0

menuconfig BMI260
	bool "BMI260 inertial measurement unit"
	default y
	depends on DT_HAS_BOSCH_BMI260_ENABLED
	select I2C if $(dt_compat_on_bus,$(DT_COMPAT_BOSCH_BMI260),i2c)
	select SPI if $(dt_compat_on_bus,$(DT_COMPAT_BOSCH_BMI260),spi)
	help
	  Enable driver for the Bosch BMI260 6-axis inertial measurement unit,
	  providing accelerometer, gyroscope and die temperature readings over
	  I2C or SPI.

if BMI260

config BMI260_BUS_I2C
	bool
	default y
	depends on $(dt_compat_on_bus,$(DT_COMPAT_BOSCH_BMI260),i2c)

config BMI260_BUS_SPI
	bool
	default y
	depends on $(dt_compat_on_bus,$(DT_COMPAT_BOSCH_BMI260),spi)

config BMI260_LOG_CONFIG
	bool "Log the device configuration after initialization"
	depends on LOG
	help
	  Read back and log the rate, range, offset compensation and error
	  registers once initialization has finished. Useful when a reading
	  looks wrong and the question is whether the device is configured the
	  way the driver believes it is.

endif # BMI260
```

## drivers/sensor/bosch/bmp280/Kconfig
```kconfig
# Copyright (c) 2026 NBuiLe
# SPDX-License-Identifier: Apache-2.0

config BMP280
	bool "Bosch BMP280 pressure and temperature sensor"
	default y
	depends on DT_HAS_BOSCH_BMP280_ENABLED
	depends on SENSOR
	select I2C
	help
	  Enable driver for the Bosch BMP280 pressure and temperature sensor.
```

## drivers/sensor/bosch/bmp388/Kconfig
```kconfig
# Copyright (c) 2020 Facebook, Inc. and its affiliates
# SPDX-License-Identifier: Apache-2.0

menuconfig BMP388
	bool "Bosch BMP388 pressure sensor"
	default y
	depends on DT_HAS_BOSCH_BMP388_ENABLED || DT_HAS_BOSCH_BMP390_ENABLED || \
			DT_HAS_BOSCH_BMP384_ENABLED
	select I2C if $(dt_compat_on_bus,$(DT_COMPAT_BOSCH_BMP388),i2c) || \
			$(dt_compat_on_bus,$(DT_COMPAT_BOSCH_BMP390),i2c) || \
			$(dt_compat_on_bus,$(DT_COMPAT_BOSCH_BMP384),i2c)
	select SPI if $(dt_compat_on_bus,$(DT_COMPAT_BOSCH_BMP388),spi) || \
			$(dt_compat_on_bus,$(DT_COMPAT_BOSCH_BMP390),spi) || \
			$(dt_compat_on_bus,$(DT_COMPAT_BOSCH_BMP384),spi)
	help
	  Enable driver for the Bosch BMP388, BMP384 and BMP390 pressure sensors

if BMP388

choice BMP388_TRIGGER_MODE
	prompt "Trigger mode"
	default BMP388_TRIGGER_GLOBAL_THREAD
	help
	  Specify the type of triggering to be used by the driver.

config BMP388_TRIGGER_NONE
	bool "No trigger"

config BMP388_TRIGGER_GLOBAL_THREAD
	bool "Use global thread"
	depends on GPIO
	depends on $(dt_compat_any_has_prop,$(DT_COMPAT_BOSCH_BMP388),int-gpios)
	select BMP388_TRIGGER

config BMP388_TRIGGER_OWN_THREAD
	bool "Use own thread"
	depends on GPIO
	depends on $(dt_compat_any_has_prop,$(DT_COMPAT_BOSCH_BMP388),int-gpios)
	select BMP388_TRIGGER

config BMP388_TRIGGER_DIRECT
	bool "Use IRQ handler"
	depends on GPIO
	depends on $(dt_compat_any_has_prop,$(DT_COMPAT_BOSCH_BMP388),int-gpios)
	select BMP388_TRIGGER
endchoice

config BMP388_TRIGGER
	bool

config BMP388_THREAD_PRIORITY
	int "Own thread priority"
	depends on BMP388_TRIGGER_OWN_THREAD
	default 10
	help
	  Priority of the thread used by the driver to handle interrupts.

config BMP388_THREAD_STACK_SIZE
	int "Own thread stack size"
	depends on BMP388_TRIGGER_OWN_THREAD
	default 1024
	help
	  Stack size of thread used by the driver to handle interrupts.

config BMP388_FORCED_MODE
	bool "Forced mode sampling"
	depends on !BMP388_TRIGGER
	help
	  Keep the sensor in sleep mode, triggering a single forced mode
	  measurement on each sample fetch and waiting for the result, instead
	  of reading the latest result of continuous normal mode measurements.
	  This reduces power consumption for infrequent sampling. The ODR is
	  not used in this mode.

config BMP388_ODR_RUNTIME
	bool "Change ODR at runtime."
	depends on !BMP388_FORCED_MODE
	default y

config BMP388_OSR_RUNTIME
	bool "Change OSR at runtime."
	default y

endif # BMP388
```

## drivers/sensor/dfrobot/Kconfig
```kconfig
# Copyright (c) 2026, Iomico
# SPDX-License-Identifier: Apache-2.0

source "drivers/sensor/dfrobot/sen0466/Kconfig"
```

## drivers/sensor/dfrobot/sen0466/Kconfig
```kconfig
# Copyright (c) 2026, Iomico
# SPDX-License-Identifier: Apache-2.0

config SEN0466
	bool "DFRobot SEN0466 CO sensor"
	default y
	depends on DT_HAS_DFROBOT_SEN0466_ENABLED
	select I2C
	help
	  Enable driver for the DFRobot SEN0466 electrochemical carbon
	  monoxide sensor, reporting CO concentration in ppm and the
	  temperature of an on-board NTC over I2C.

config EMUL_SEN0466
	bool "Emulator for the DFRobot SEN0466"
	default y
	depends on SEN0466
	depends on EMUL
	help
	  Enable the emulator for the DFRobot SEN0466, so the driver can be
	  exercised without hardware.
```
