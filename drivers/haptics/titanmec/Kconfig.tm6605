## drivers/haptics/titanmec/Kconfig.tm6605
```kconfig
# Copyright (c) 2026 Anuj Deshpande
# SPDX-License-Identifier: Apache-2.0

config HAPTICS_TM6605
	bool "TM6605 Haptics Driver"
	default y
	depends on DT_HAS_TITANMEC_TM6605_ENABLED
	select I2C
	help
	  Enable I2C-based driver for the Titan Micro Electronics TM6605
	  Linear Resonant Actuator (LRA) haptic driver.
```

## drivers/hdlc_rcp_if/Kconfig
```kconfig
# Configuration options for HDLC RCP communication Interface

# Copyright (c) 2024 NXP
# SPDX-License-Identifier: Apache-2.0

#
# HDLC communication Interface used by Zephyr running Openthread RCP host
#

menuconfig HDLC_RCP_IF
	bool "HDLC interface for a Zephyr Openthread RCP host"
	depends on NET_L2_OPENTHREAD && !OPENTHREAD_COPROCESSOR
	select EVENTS

if HDLC_RCP_IF

# zephyr-keep-sorted-start
source "drivers/hdlc_rcp_if/Kconfig.nxp"
source "drivers/hdlc_rcp_if/Kconfig.spi"
source "drivers/hdlc_rcp_if/Kconfig.uart"
# zephyr-keep-sorted-stop

config HDLC_RCP_IF_DRV_NAME
	string "HDLC RCP Interface Driver's name"
	default "hdlc_rcp_if"
	help
	  This option sets the driver name

module = HDLC_RCP_IF_DRIVER
module-str = HDLC driver for Openthread RCP host
module-help = Sets log level for Openthread HDLC RCP host interface Device Drivers.
source "subsys/logging/Kconfig.template.log_config"

endif # HDLC_RCP_IF
```

## drivers/hdlc_rcp_if/Kconfig.nxp
```kconfig
# Configuration options for NXP HDLC RCP communication Interface

# Copyright (c) 2024 NXP
# SPDX-License-Identifier: Apache-2.0

#
# HDLC communication Interface used by Zephyr running Openthread RCP host
#

config HDLC_RCP_IF_NXP
	bool "NXP HDLC interface for Zephyr Openthread RCP host"
	default y
	depends on DT_HAS_NXP_HDLC_RCP_IF_ENABLED
```

## drivers/hdlc_rcp_if/Kconfig.spi
```kconfig
# Configuration options for NXP HDLC RCP SPI communication Interface

# Copyright (c) 2025 Basalte bv
# SPDX-License-Identifier: Apache-2.0

config HDLC_RCP_IF_SPI
	bool "SPI HDLC interface for Zephyr Openthread RCP host"
	default y
	depends on DT_HAS_SPI_HDLC_RCP_IF_ENABLED
	depends on SPI

if HDLC_RCP_IF_SPI

config HDLC_RCP_IF_SPI_MAX_FRAME_SIZE
	int "HDLC RCP IF SPI maximum frame size"
	default 2048
	help
	  Maximum frame size for the OpenThread HDLC host SPI.

config HDLC_RCP_IF_SPI_ALIGN_ALLOWANCE
	int "HDLC RCP IF SPI RX align allowance"
	default 0
	range 0 16
	help
	  Specify the maximum number of 0xFF bytes to clip from the start of MISO frames.

config HDLC_RCP_IF_SPI_SMALL_PACKET_SIZE
	int "HDLC RCP IF SPI small packet size"
	default 32
	help
	  Specify the smallest packet we can receive in a single transaction.
	  Larger packets will require multiple transactions.

config HDLC_RCP_IF_SPI_DEFERRED_INIT
	bool "Defer SPI RCP interface start until explicitly requested"
	depends on HDLC_RCP_IF_SPI
	help
	  When enabled, prevents net_if_post_init() from automatically
	  bringing up the OpenThread interface at boot, and defers SPI
	  interrupt arming until hdlc_api.deferred_init() is called.
	  This is required when the RCP firmware is loaded asynchronously
	  (e.g. IW61X firmware uploaded via BT UART H4 before SPI is active).
	  hdlc_api.deferred_init() can be called once the firmware is ready.
	  the SPI IRQ is armed and the network interface is brought up.
	  When disabled, SPI IRQ is armed during init and the interface
	  is brought up automatically.
endif
```

## drivers/hdlc_rcp_if/Kconfig.uart
```kconfig
# Configuration options for NXP HDLC RCP UART communication Interface

# Copyright (c) 2024 DENX Software Engineering GmbH
#               Lukasz Majewski <lukma@denx.de>
# SPDX-License-Identifier: Apache-2.0

#
# HDLC UART communication Interface used by Zephyr running Openthread RCP host
#

config HDLC_RCP_IF_UART
	bool "UART HDLC interface for Zephyr Openthread RCP host"
	default y
	depends on DT_HAS_UART_HDLC_RCP_IF_ENABLED

config OPENTHREAD_HDLC_RCP_IF_UART_RX_RING_BUFFER_SIZE
	int "Set HDLC RCP IF UART RX ring buffer size"
	default 4096
	help
	  RX buffer size for the OpenThread HDLC host UART.

config OPENTHREAD_HDLC_RCP_IF_UART_TX_RING_BUFFER_SIZE
	int "Set HDLC RCP IF UART TX ring buffer size"
	default 1344
	help
	  TX buffer size for the OpenThread HDLC host UART.
```

## drivers/hwinfo/Kconfig.ambiq
```kconfig
# Copyright The Zephyr Project Contributors
# SPDX-License-Identifier: Apache-2.0

config HWINFO_AMBIQ
	bool "AMBIQ hwinfo"
	default y
	depends on SOC_SERIES_APOLLO4X || SOC_SERIES_APOLLO5X
	select HWINFO_HAS_DRIVER
	select AMBIQ_HAL
	select AMBIQ_HAL_USE_HWINFO
	help
	  Enable AMBIQ hwinfo driver
```

## drivers/hwinfo/Kconfig.andes
```kconfig
# Copyright The Zephyr Project Contributors
# SPDX-License-Identifier: Apache-2.0

config HWINFO_ANDES
	bool "Andes system ID"
	default y
	depends on SOC_FAMILY_ANDES_V5
	depends on SYSCON
	select HWINFO_HAS_DRIVER
	help
	  Enable Andes hwinfo driver
```

## drivers/hwinfo/Kconfig.cc13xx_cc26xx
```kconfig
# Copyright The Zephyr Project Contributors
# SPDX-License-Identifier: Apache-2.0

menuconfig HWINFO_CC13XX_CC26XX
	bool "TI SimpleLink CC13xx/CC26xx hwinfo driver"
	default y
	depends on SOC_SERIES_CC13X2_CC26X2 || SOC_SERIES_CC13X2X7_CC26X2X7
	select HWINFO_HAS_DRIVER
	help
	  Enable TI SimpleLink CC13xx/CC26xx hwinfo driver.

if HWINFO_CC13XX_CC26XX

config HWINFO_CC13XX_CC26XX_ALWAYS_USE_FACTORY_DEFAULT
	bool "Ignore CCFG and always use factory value"
	default y
	help
	  Always return factory pre-programmed values, stored in FCFG and ignore
	  values provided in CCFG (Customer Configuration).

choice
	prompt "Select MAC address type for device ID"
	default HWINFO_CC13XX_CC26XX_USE_IEEE_MAC
	help
	  Specify the MAC address type to be used as device ID by the driver.

config HWINFO_CC13XX_CC26XX_USE_IEEE_MAC
	bool "Use IEEE 802.15.4 extended address"
	help
	  Use 8-bytes length IEEE 802.15.4 extended address as device ID value.

config HWINFO_CC13XX_CC26XX_USE_BLE_MAC
	bool "Use BLE MAC address"
	help
	  Use 6-bytes length BLE MAC address as device ID value.

endchoice

endif # HWINFO_CC13XX_CC26XX
```

## drivers/hwinfo/Kconfig.cc23x0
```kconfig
# Copyright The Zephyr Project Contributors
# SPDX-License-Identifier: Apache-2.0

config HWINFO_CC23X0
	bool "TI CC23X0 hwinfo"
	default y
	depends on SOC_FAMILY_TI_SIMPLELINK && SOC_SERIES_CC23X0
	select HWINFO_HAS_DRIVER
	help
	  Enable CC23X0 hwinfo driver.
```

## drivers/hwinfo/Kconfig.esp32
```kconfig
# Copyright The Zephyr Project Contributors
# SPDX-License-Identifier: Apache-2.0

config HWINFO_ESP32
	bool "ESP32 device ID"
	default y
	depends on SOC_FAMILY_ESPRESSIF_ESP32
	select HWINFO_HAS_DRIVER
	help
	  Enable ESP32 hwinfo driver.
```

## drivers/hwinfo/Kconfig.gd32
```kconfig
# Copyright (c) 2025 Aleksandr Senin <al@meshium.net>
# SPDX-License-Identifier: Apache-2.0

config HWINFO_GD32
	bool "GD32 HWINFO"
	default y
	depends on SOC_FAMILY_GD_GD32
	select HWINFO_HAS_DRIVER
	help
	  Enable HWINFO support for GD32.

	  This driver provides:
	  - Device unique ID (96-bit UID) readout via the GD32 UID registers.
	  - Reset cause reporting via the RCU reset status register (RCU_RSTSCK).

	  Supported reset causes are reported based on the reset flag macros
	  available in the GigaDevice HAL headers (for example external pin reset,
	  watchdog reset, software reset, brownout reset, power-on reset).
```

## drivers/hwinfo/Kconfig.gecko
```kconfig
# Copyright The Zephyr Project Contributors
# SPDX-License-Identifier: Apache-2.0

config HWINFO_GECKO
	bool "GECKO hwinfo"
	default y
	depends on SOC_FAMILY_SILABS_S0 || SOC_FAMILY_SILABS_S1
	select HWINFO_HAS_DRIVER
	select SOC_GECKO_RMU
	help
	  Enable Silabs GECKO hwinfo driver.
```

## drivers/hwinfo/Kconfig.imxrt
```kconfig
# Copyright The Zephyr Project Contributors
# SPDX-License-Identifier: Apache-2.0

config HWINFO_IMXRT
	bool "NXP i.mx RT device ID"
	default y
	depends on SOC_SERIES_IMXRT10XX || SOC_SERIES_IMXRT11XX || SOC_SERIES_IMXRT118X
	select HWINFO_HAS_DRIVER
	help
	  Enable NXP i.mx RT hwinfo driver.
```

## drivers/hwinfo/Kconfig.litex
```kconfig
# Copyright The Zephyr Project Contributors
# SPDX-License-Identifier: Apache-2.0

config HWINFO_LITEX
	bool "LiteX device ID"
	default y
	depends on SOC_LITEX_VEXRISCV
	depends on DT_HAS_LITEX_DNA0_ENABLED
	select HWINFO_HAS_DRIVER
	help
	  Enable LiteX hwinfo driver
```

## drivers/hwinfo/Kconfig.max32
```kconfig
# Copyright The Zephyr Project Contributors
# SPDX-License-Identifier: Apache-2.0

config HWINFO_MAX32
	bool "MAX32 hwinfo"
	default y
	depends on SOC_FAMILY_MAX32
	depends on !TRUSTED_EXECUTION_NONSECURE
	select HWINFO_HAS_DRIVER
	help
	  Enable MAX32 hwinfo driver.
```

## drivers/hwinfo/Kconfig.mchp
```kconfig
# Copyright (c) 2025 Microchip Technology Inc.
# SPDX-License-Identifier: Apache-2.0

config HWINFO_MCHP_G1
	bool "Microchip hwinfo"
	default y
	depends on DT_HAS_MICROCHIP_HWINFO_G1_ENABLED || \
		   DT_HAS_MICROCHIP_RSTC_G1_RESET_ENABLED
	select HWINFO_HAS_DRIVER
	help
	  Enable mchp hwinfo driver
```

## drivers/hwinfo/Kconfig.mcux_mcx_cmc
```kconfig
# Copyright The Zephyr Project Contributors
# SPDX-License-Identifier: Apache-2.0

config HWINFO_MCUX_MCX_CMC
	bool "NXP MCX CMC reset cause"
	default y
	depends on DT_HAS_NXP_CMC_RESET_CAUSE_ENABLED
	select HWINFO_HAS_DRIVER
	help
	  Enable NXP kinetis mcux CMC hwinfo driver.
```

## drivers/hwinfo/Kconfig.mcux_rcm
```kconfig
# Copyright The Zephyr Project Contributors
# SPDX-License-Identifier: Apache-2.0

config HWINFO_MCUX_RCM
	bool "NXP kinetis reset cause"
	default y
	depends on DT_HAS_NXP_RCM_HWINFO_ENABLED
	select HWINFO_HAS_DRIVER
	help
	  Enable NXP kinetis mcux RCM hwinfo driver.
```

## drivers/hwinfo/Kconfig.mcux_rgm
```kconfig
# Copyright 2026 NXP
# SPDX-License-Identifier: Apache-2.0

config HWINFO_MCUX_RGM
	bool "NXP MC_RGM reset cause"
	default y
	depends on DT_HAS_NXP_MC_RGM_ENABLED
	select HWINFO_HAS_DRIVER
	help
	  Enable the NXP MC_RGM (Reset Generation Module) hwinfo driver for
	  reset cause reporting on NXP MCUs with the MC_RGM module, such as the
	  MCXE family.
```

## drivers/hwinfo/Kconfig.mcux_rstctl
```kconfig
# Copyright The Zephyr Project Contributors
# SPDX-License-Identifier: Apache-2.0

config HWINFO_MCUX_RSTCTL
	bool "NXP RSTCTL reset cause"
	default y
	depends on DT_HAS_NXP_RSTCTL_HWINFO_ENABLED
	select HWINFO_HAS_DRIVER
	help
	  Enable NXP mcux RSTCTL hwinfo driver.
```

## drivers/hwinfo/Kconfig.mcux_sim
```kconfig
# Copyright The Zephyr Project Contributors
# SPDX-License-Identifier: Apache-2.0

config HWINFO_MCUX_SIM
	bool "NXP kinetis SIM device ID"
	default y
	depends on DT_HAS_NXP_SIM_UUID_ENABLED
	select HWINFO_HAS_DRIVER
	help
	  Enable NXP kinetis mcux SIM hwinfo driver.
```

## drivers/hwinfo/Kconfig.mcux_src
```kconfig
# Copyright The Zephyr Project Contributors
# SPDX-License-Identifier: Apache-2.0

config HWINFO_MCUX_SRC
	bool "NXP SRC reset cause"
	default y
	depends on HAS_MCUX_SRC
	select HWINFO_HAS_DRIVER
	help
	  Enable NXP i.MX mcux SRC hwinfo driver.
```

## drivers/hwinfo/Kconfig.mcux_src_rev2
```kconfig
# Copyright The Zephyr Project Contributors
# SPDX-License-Identifier: Apache-2.0

config HWINFO_MCUX_SRC_V2
	bool "NXP SRC reset cause (multicore devices)"
	default y
	depends on DT_HAS_NXP_IMX_SRC_REV2_ENABLED
	select HWINFO_HAS_DRIVER
	help
	  Enable version 2 multicore NXP i.MX mcux SRC hwinfo driver.
```

## drivers/hwinfo/Kconfig.mcux_syscon
```kconfig
# Copyright The Zephyr Project Contributors
# SPDX-License-Identifier: Apache-2.0

config HWINFO_MCUX_SYSCON
	bool "NXP LPC device ID"
	default y
	depends on DT_HAS_NXP_LPC_UID_ENABLED
	select HWINFO_HAS_DRIVER
	help
	  Enable NXP LPC mcux hwinfo driver.
```

## drivers/hwinfo/Kconfig.mspm0
```kconfig
# Copyright The Zephyr Project Contributors
# SPDX-License-Identifier: Apache-2.0

config HWINFO_MSPM0
	bool "TI MSPM0 hwinfo"
	default y
	depends on SOC_SERIES_MSPM0G || SOC_SERIES_MSPM0L
	select HWINFO_HAS_DRIVER
	help
	  Enable TI MSPM0 hwinfo driver
```
