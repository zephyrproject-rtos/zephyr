## drivers/interrupt_controller/Kconfig.s1000
```kconfig
# Kconfig - Intel_S1000 configuration
#
# Copyright (c) 2017 Intel Corporation
#
# SPDX-License-Identifier: Apache-2.0
#

config CAVS_ICTL
	bool "CAVS Interrupt Logic"
	depends on MULTI_LEVEL_INTERRUPTS
	help
	  These are 4 in number supporting a max of 32 interrupts each.

config CAVS_ISR_TBL_OFFSET
	int "Offset in the SW ISR Table"
	default 0
	depends on CAVS_ICTL
	help
	  This indicates the offset in the SW_ISR_TABLE beginning from where
	  the ISRs for CAVS Interrupt Controller are assigned.

config CAVS_ICTL_0_NAME
	string "CAVS 0 Driver name"
	depends on CAVS_ICTL
	default "CAVS_0"

config CAVS_ICTL_0_OFFSET
	int "Parent interrupt number to which CAVS_0 maps"
	default 0
	depends on CAVS_ICTL

config CAVS_ICTL_1_NAME
	string "CAVS 1 Driver name"
	depends on CAVS_ICTL
	default "CAVS_1"

config CAVS_ICTL_1_OFFSET
	int "Parent interrupt number to which CAVS_1 maps"
	default 0
	depends on CAVS_ICTL

config CAVS_ICTL_2_NAME
	string "CAVS 2 Driver name"
	depends on CAVS_ICTL
	default "CAVS_2"

config CAVS_ICTL_2_OFFSET
	int "Parent interrupt number to which CAVS_2 maps"
	default 0
	depends on CAVS_ICTL

config CAVS_ICTL_3_NAME
	string "CAVS 3 Driver name"
	depends on CAVS_ICTL
	default "CAVS_3"

config CAVS_ICTL_3_OFFSET
	int "Parent interrupt number to which CAVS_3 maps"
	default 0
	depends on CAVS_ICTL

config CAVS_ICTL_INIT_PRIORITY
	int "CAVS ICTL Init priority"
	default 60
	depends on CAVS_ICTL
	help
	  Cavs Interrupt Logic initialization priority.
```

## drivers/interrupt_controller/Kconfig.sam0
```kconfig
# SAM0 EIC configuration

# Copyright (c) 2019 Derek Hageman <hageman@inthat.cloud>
# SPDX-License-Identifier: Apache-2.0

config SAM0_EIC
	bool "External Interrupt Controller (EIC) Driver for SAM0 series devices"
	default y
	depends on DT_HAS_ATMEL_SAM0_EIC_ENABLED
	help
	  Enable EIC driver for SAM0 series of devices.  This is required for
	  GPIO interrupt support.
```

## drivers/interrupt_controller/Kconfig.scr_ipic
```kconfig
# Copyright (c) 2023 Syntacore
# SPDX-License-Identifier: Apache-2.0

config SCR_IPIC
	bool "Syntacore Integrated Programmable Interrupt Controller (IPIC)"
	default y
	depends on DT_HAS_SYNTACORE_IPIC_ENABLED
	select MULTI_LEVEL_INTERRUPTS
	select 2ND_LEVEL_INTERRUPTS
	help
	  Integrated Programmable Interrupt Controller provides support
	  for external interrupt lines defined by the Syntacore specification.

config IPIC_STATIC_LINE_MAPPING
	bool "The given interrupt controller supports static line mapping"
	default y
	help
	  The given interrupt controller external pins are statically
	  mapped to the corresponding interrupt vectors.

config EXT_IPIC_IRQ_LN_NUM
	int "The amount of external pins receiving signals"
	default 16
	help
	  The amount of external pins of the given interrupt controller
```

## drivers/interrupt_controller/Kconfig.shakti_plic
```kconfig
# Need to do changes suitable for shakti's plic


# Copyright (c) 2022 Carlo Caione <ccaione@baylibre.com>
# SPDX-License-Identifier: Apache-2.0

config SHAKTI_PLIC
	bool "Platform Level Interrupt Controller (PLIC)"
	default y
	help
	  Platform Level Interrupt Controller provides support
	  for external interrupt lines defined by the RISC-V SoC.
```
