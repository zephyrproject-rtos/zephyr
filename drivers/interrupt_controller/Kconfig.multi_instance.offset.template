## drivers/interrupt_controller/Kconfig.multi_instance.offset.template
```kconfig
# Copyright (c) 2023 Meta
# SPDX-License-Identifier: Apache-2.0

config INTC_ID_$(instance-id)_OFFSET
	int "placeholder"
	default 0
	help
	  placeholder
```

## drivers/interrupt_controller/Kconfig.nct
```kconfig
# NCT GPIO driver configuration options

# Copyright (c) 2024 Nuvoton Technology Corporation.
# SPDX-License-Identifier: Apache-2.0

config NCT_MIWU
	bool "Nuvoton NCT embedded controller (EC) miwu driver"
	default y
	depends on DT_HAS_NUVOTON_NCT_MIWU_ENABLED
	help
	  This option enables the Multi-Input Wake-Up Unit (MIWU) driver
	  for NCT family ofprocessors.
	  This is required for GPIO, RTC, LPC/eSPI interrupt support.
```

## drivers/interrupt_controller/Kconfig.neorv32
```kconfig
# Copyright (c) 2024 Calian Advanced Technologies
# SPDX-License-Identifier: Apache-2.0

menuconfig NEORV32_XIRQ
	bool "NEORV32 External Interrupt Controller (XIRQ)"
	default y
	depends on DT_HAS_NEORV32_XIRQ_ENABLED
	depends on MULTI_LEVEL_INTERRUPTS
	depends on SYSCON
	select 2ND_LEVEL_INTERRUPTS
	help
	  NEORV32 XIRQ is the optional core within the NEORV32 CPU
	  implementation to support external interrupt sources.

if NEORV32_XIRQ

config NEORV32_XIRQ_INIT_PRIORITY
	int "Init priority for XIRQ interrupt controller"
	default 51
	help
	  NEORV32 XIRQ initialization priority.

endif # NEORV32_XIRQ
```

## drivers/interrupt_controller/Kconfig.npcm
```kconfig
# NPCM GPIO driver configuration options

# Copyright (c) 2024 Nuvoton Technology Corporation.
# SPDX-License-Identifier: Apache-2.0

config NPCM_MIWU
	bool "Nuvoton NPCM embedded controller (EC) miwu driver"
	default y
	depends on DT_HAS_NUVOTON_NPCM_MIWU_ENABLED
	help
	  This option enables the Multi-Input Wake-Up Unit (MIWU) driver
	  for NPCM family ofprocessors.
	  This is required for GPIO, RTC, LPC/eSPI interrupt support.
```

## drivers/interrupt_controller/Kconfig.npcx
```kconfig
# NPCX GPIO driver configuration options

# Copyright (c) 2020 Nuvoton Technology Corporation.
# SPDX-License-Identifier: Apache-2.0

config NPCX_MIWU
	bool "Nuvoton NPCX embedded controller (EC) miwu driver"
	default y
	depends on DT_HAS_NUVOTON_NPCX_MIWU_ENABLED
	help
	  This option enables the Multi-Input Wake-Up Unit (MIWU) driver
	  for NPCX family of processors.
	  This is required for GPIO, RTC, LPC/eSPI interrupt support.

config NPCX_MIWU_BOTH_EDGE_TRIG_WORKAROUND
	bool
	default y if SOC_NPCX9M7FB
	help
	  Workaround the issue "MIWU Any Edge Trigger Condition"
	  in the npcx9m7fb SoC errata.
```

## drivers/interrupt_controller/Kconfig.nrf
```kconfig
# Nordic Semiconductor interrupt controller configuration

# Copyright (c) 2022 Nordic Semiconductor ASA
# SPDX-License-Identifier: Apache-2.0

# Workaround for not being able to have commas in macro arguments
DT_COMPAT_NORDIC_NRF_EGU := nordic,nrf-egu

config INTC_NRF_EGU
	bool "EGU interrupt driver"
	depends on $(dt_compat_enabled,$(DT_COMPAT_NORDIC_NRF_EGU))
	depends on NRFX_EGU
	help
	  Enable support for EGU interrupt driver for nRF MCU series.

choice INTC_SWI
	prompt "Software interrupt implementation"
	help
	  Enables software interrupt utility. The software interrupt can be used
	  to de-escalate interrupt processing from zero-latency interrupts to a
	  priority level at which it is safe to use kernel services.

DT_CHOSEN_SWI_NRF_EGU := nordic,swi-egu

config INTC_SWI_NRF_EGU
	bool "NRF EGU software interrupt implementation"
	depends on INTC_NRF_EGU
	depends on $(dt_chosen_enabled,$(DT_CHOSEN_SWI_NRF_EGU))
	help
	  Event Generator Unit backed software interrupt implementation.

endchoice
```

## drivers/interrupt_controller/Kconfig.nxp_gint
```kconfig
# Copyright 2026 NXP
# SPDX-License-Identifier: Apache-2.0

config NXP_GINT
	bool "Grouped GPIO Input Interrupt(GINT) controller for NXP MCUs"
	default y
	depends on DT_HAS_NXP_GINT_ENABLED
	select RESET
	help
	  Enable GINT driver for NXP MCUs
```

## drivers/interrupt_controller/Kconfig.nxp_irqsteer
```kconfig
# Copyright 2023 NXP
# SPDX-License-Identifier: Apache-2.0

config NXP_IRQSTEER
	bool "IRQ_STEER interrupt controller for NXP chips"
	default y
	depends on DT_HAS_NXP_IRQSTEER_INTC_ENABLED
	depends on MULTI_LEVEL_INTERRUPTS
	help
		The IRQSTEER INTC provides support for MUX-ing
		multiple interrupts from peripheral to one or
		more CPU interrupt lines. This is used for CPUs
		such as XTENSA DSPs.
```

## drivers/interrupt_controller/Kconfig.nxp_irqsteer1
```kconfig
# Copyright 2025 NXP
# SPDX-License-Identifier: Apache-2.0

config NXP_IRQSTEER1
	bool "IRQ_STEER interrupt controller for NXP chips"
	default y
	depends on DT_HAS_NXP_IRQSTEER1_INTC_ENABLED
	depends on MULTI_LEVEL_INTERRUPTS
	help
		The IRQSTEER INTC provides support for MUX-ing
		multiple interrupts from peripheral to one or
		more CPU interrupt lines.
```

## drivers/interrupt_controller/Kconfig.nxp_pint
```kconfig
# Copyright 2023 NXP
# SPDX-License-Identifier: Apache-2.0

config NXP_PINT
	bool "Pin interrupt and pattern match engine (PINT) for NXP MCUs"
	default y
	depends on DT_HAS_NXP_PINT_ENABLED
	select NXP_INPUTMUX
	help
	  Enable PINT driver for NXP MCUs
```

## drivers/interrupt_controller/Kconfig.nxp_s32
```kconfig
# Copyright 2022-2025 NXP
# SPDX-License-Identifier: Apache-2.0

config NXP_S32_WKPU
	bool "Wake-up Unit interrupt controller driver for NXP S32 MCUs"
	default y
	depends on DT_HAS_NXP_S32_WKPU_ENABLED
	help
	  Wake-up Unit interrupt controller driver for NXP S32 MCUs

if NXP_S32_WKPU

config NXP_S32_WKPU_SOURCES_MAX
	int
	range 32 64
	default 64 if SOC_SERIES_S32K3
	help
	  Number of WKPU external and internal sources per controller. This is
	  a SoC integration option.

endif # NXP_S32_WKPU
```

## drivers/interrupt_controller/Kconfig.nxp_siul2
```kconfig
# Copyright 2022-2025 NXP
# SPDX-License-Identifier: Apache-2.0

config NXP_SIUL2_EIRQ
	bool "NXP SIUL2 external interrupt controller driver"
	default y
	depends on DT_HAS_NXP_SIUL2_EIRQ_ENABLED
	select NOCACHE_MEMORY if ARCH_HAS_NOCACHE_MEMORY_SUPPORT
	select PINCTRL
	help
	  NXP SIUL2 external interrupt controller driver.

if NXP_SIUL2_EIRQ

config NXP_SIUL2_EIRQ_EXT_INTERRUPTS_MAX
	int
	default 8 if SOC_SERIES_S32ZE
	default 32 if SOC_SERIES_S32K3
	help
	  Number of SIUL2 external interrupts per controller. This is a SoC
	  integration option.

config NXP_SIUL2_EIRQ_EXT_INTERRUPTS_GROUP
	int
	default 8
	help
	  Number of SIUL2 external interrupts grouped into a single core
	  interrupt line. This is a SoC integration option.

endif # NXP_SIUL2_EIRQ
```

## drivers/interrupt_controller/Kconfig.pfic
```kconfig
# Copyright (c) 2022 TOKITA Hiroshi <tokita.hiroshi@gmail.com>
# SPDX-License-Identifier: Apache-2.0

config WCH_PFIC
	bool "Enhanced Core Local Interrupt Controller (ECLIC)"
	default y
	depends on DT_HAS_WCH_PFIC_ENABLED
	help
	  Interrupt controller for Nuclei SoC core.
```

## drivers/interrupt_controller/Kconfig.pic32cxsg
```kconfig
# PIC32CXSG EIC configuration

# Copyright (c) 2024 Microchip
# SPDX-License-Identifier: Apache-2.0

config PIC32CXSG_EIC
	bool "External Interrupt Controller (EIC) Driver for Microchip PIC32CXSG series devices"
	default y
	depends on DT_HAS_PIC32CXSG_EIC_ENABLED
	help
	  Enable EIC driver for Microchip PIC32CXSG series of devices.  This is required for
	  GPIO interrupt support.
```

## drivers/interrupt_controller/Kconfig.plic
```kconfig
# Copyright (c) 2022 Carlo Caione <ccaione@baylibre.com>
# SPDX-License-Identifier: Apache-2.0

config PLIC
	bool "Platform Level Interrupt Controller (PLIC)"
	default y
	depends on DT_HAS_SIFIVE_PLIC_1_0_0_ENABLED
	select MULTI_LEVEL_INTERRUPTS
	select 2ND_LEVEL_INTERRUPTS
	help
	  Platform Level Interrupt Controller provides support
	  for external interrupt lines defined by the RISC-V SoC.

if PLIC

config PLIC_SUPPORTS_SOFT_INTERRUPT
	bool
	default y
	depends on DT_HAS_ANDESTECH_NCEPLIC100_ENABLED
	help
	  Enabled when the PLIC supports software-triggered interrupts.

config PLIC_SUPPORTS_TRIG_TYPE
	bool
	default y
	depends on DT_HAS_ANDESTECH_NCEPLIC100_ENABLED
	help
	  Enabled when the PLIC supports multiple trigger types,
	  such as level, edge, etc.

if PLIC_SUPPORTS_TRIG_TYPE

config PLIC_TRIG_TYPE_REG_OFFSET
	hex "Trigger type register offset"
	default 0x1080 if DT_HAS_ANDESTECH_NCEPLIC100_ENABLED
	help
	  Offset to the 'trigger type' register.

config PLIC_TRIG_TYPE_BITWIDTH
	int "Trigger type bitwidth"
	default 1
	help
	  Number of bits required to differentiate between the trigger types.

config PLIC_SUPPORTS_TRIG_EDGE
	bool
	default y
	depends on DT_HAS_ANDESTECH_NCEPLIC100_ENABLED
	help
	  Enabled when the PLIC supports edge-triggered interrupt.

endif # PLIC_SUPPORTS_TRIG_TYPE

config PLIC_IRQ_AFFINITY
	bool "Configure IRQ affinity"
	depends on SMP
	depends on MP_MAX_NUM_CPUS > 1
	help
	  Enable configuration of IRQ affinity.

config PLIC_IRQ_AFFINITY_MASK
	hex "Default IRQ affinity mask"
	depends on PLIC_IRQ_AFFINITY
	default 0x1
	help
	  Default mask for the driver when IRQ affinity is enabled.

config PLIC_SHELL
	bool "PLIC shell commands"
	depends on SHELL
	help
	  Enable additional shell commands useful for debugging.
	  Caution: This can use quite a bit of RAM (PLICs * IRQs * sizeof(uint16_t)).

if PLIC_SHELL

config PLIC_SHELL_IRQ_COUNT
	bool "IRQ count shell commands"
	default y
	help
	  Records the number of hits per interrupt line and provide shell commands to access them.
	  Caution: This can use quite a bit of RAM (PLICs * IRQs * sizeof(PLIC_IRQ_COUNT_TYPE)).

config PLIC_SHELL_IRQ_AFFINITY
	bool "Shell commands to configure IRQ affinity"
	default y
	depends on PLIC_IRQ_AFFINITY
	help
	  Provide shell commands to configure IRQ affinity in runtime.

endif # PLIC_SHELL

endif # PLIC
```

## drivers/interrupt_controller/Kconfig.renesas_ra
```kconfig
# Copyright (c) 2023 TOKITA Hiroshi <tokita.hiroshi@fujitsu.com>
# SPDX-License-Identifier: Apache-2.0

config RENESAS_RA_ICU
	bool "Renesas RA series interrupt controller unit"
	default y
	depends on DT_HAS_RENESAS_RA_INTERRUPT_CONTROLLER_UNIT_ENABLED
	select GEN_ISR_TABLES
	help
	  Renesas RA series interrupt controller unit
```

## drivers/interrupt_controller/Kconfig.renesas_ra2
```kconfig
# Copyright (c) 2021-2024 MUNIC SA
# SPDX-License-Identifier: Apache-2.0

config RENESAS_GROUPING_ICU
	bool
	help
	 This option enables Renesas ICU with
	 grouping interrupts mapping.

config RENESAS_RA2_ICU
	bool
	depends on DT_HAS_RENESAS_RA2_ICU_ENABLED
	select RENESAS_GROUPING_ICU
	default y
	help
	 This option enables the ICU driver for RA2 family of
	 processors.

if RENESAS_RA2_ICU

config NUM_RENESAS_ICU_GROUPS
	int
	depends on RENESAS_GROUPING_ICU
	default 8
	help
	 Number of Renesas ICU interrupt's groups.

endif
```

## drivers/interrupt_controller/Kconfig.renesas_rz
```kconfig
# Copyright (c) 2024-2025 Renesas Electronics Corporation
# SPDX-License-Identifier: Apache-2.0

config RENESAS_RZ_EXT_IRQ
	bool "Renesas RZ external interrupt controller driver"
	default y
	depends on DT_HAS_RENESAS_RZ_EXT_IRQ_ENABLED
	select USE_RZ_FSP_EXT_IRQ
	select PINCTRL
	help
	  Renesas RZ external interrupt controller driver

if RENESAS_RZ_EXT_IRQ

config RENESAS_RZ_INTC_HAS_NMI
	bool "NMI (Non Maskable Interrupt) pin"
	default y
	depends on SOC_SERIES_RZG3S || SOC_SERIES_RZA3UL
	help
	  Renesas RZ interrupt controller has NMI (Non Maskable Interrupt) pin

endif

config RENESAS_RZ_INTC_SELECT_INTERRUPT
	bool "Renesas RZ INTC select interrupt"
	default y
	depends on DT_HAS_RENESAS_RZ_INTC_V2_ENABLED
	help
	  Renesas RZ INTC select interrupt

config RENESAS_RZ_TINT
	bool "Renesas RZ GPIO interrupt (TINT) controller driver"
	default y
	depends on DT_HAS_RENESAS_RZ_TINT_ENABLED
	help
	  Renesas RZ GPIO interrupt (TINT) controller driver

if RENESAS_RZ_TINT

config RENESAS_RZ_TINT_SUPPORT_STATUS_CLEAR_REG
	bool "Renesas RZ TINT support status clear register"
	default y
	depends on DT_HAS_RENESAS_RZ_INTC_V2_ENABLED
	help
	  Renesas RZ/V2H, RZ/V2N support a Status Clear Register
	  to reset interrupt flags, while the remaining SoCs
	  reset interrupt flags in the Status Register.

endif
```

## drivers/interrupt_controller/Kconfig.riscv_aia
```kconfig
# SPDX-FileCopyrightText: Copyright The Zephyr Project Contributors
# SPDX-License-Identifier: Apache-2.0

config RISCV_IMSIC
	bool "RISC-V IMSIC (Incoming Message-Signaled Interrupt Controller)"
	default y if DT_HAS_RISCV_IMSIC_ENABLED
	depends on RISCV && RISCV_ISA_EXT_SMCSRIND
	help
	  RISC-V Incoming Message-Signaled Interrupt Controller (IMSIC).
	  Provides per-hart interrupt files for MSI delivery in RISC-V AIA.
	  Automatically enabled when an IMSIC node exists in devicetree.

config RISCV_APLIC
	bool "RISC-V APLIC (Advanced Platform-Level Interrupt Controller)"
	default y if DT_HAS_RISCV_APLIC_ENABLED
	depends on RISCV
	help
	  RISC-V Advanced Platform-Level Interrupt Controller (APLIC).
	  Routes wired interrupts in a RISC-V AIA system.
	  Automatically enabled when an APLIC node exists in devicetree.

config RISCV_APLIC_MSI
	bool "RISC-V APLIC MSI delivery mode"
	default y if $(dt_compat_all_has_prop,$(DT_COMPAT_RISCV_APLIC),msi-parent)
	depends on RISCV_APLIC
	depends on $(dt_compat_all_has_prop,$(DT_COMPAT_RISCV_APLIC),msi-parent)
	select RISCV_IMSIC
	help
	  Enable MSI delivery mode for the APLIC.
	  Routes wired interrupts to IMSIC as Message-Signaled Interrupts.
```

## drivers/interrupt_controller/Kconfig.rv32m1
```kconfig
# RV32M1 INTMUX config

# Copyright (c) 2018 Foundries.io
# SPDX-License-Identifier: Apache-2.0

config RV32M1_INTMUX
	bool "OpenISA RV32M1 INTMUX interrupt controller support"
	default y
	depends on DT_HAS_OPENISA_RV32M1_INTMUX_ENABLED
	depends on MULTI_LEVEL_INTERRUPTS
	help
	  Select this option to enable support for the RV32M1 INTMUX
	  driver. This provides a level 2 interrupt controller for the SoC.
	  The INTMUX peripheral combines level 2 interrupts into
	  eight channels; each channel has its own level 1 interrupt to
	  the core.

if RV32M1_INTMUX

config RV32M1_INTMUX_INIT_PRIORITY
	int "INTMUX driver initialization priority"
	default 40
	help
	  Boot time initialization priority for INTMUX driver.
	  Don't change the default unless you know what you are doing.

config RV32M1_INTMUX_CHANNEL_0
	bool "INTMUX channel 0"
	help
	  Enable support for INTMUX channel 0.

config RV32M1_INTMUX_CHANNEL_1
	bool "INTMUX channel 1"
	help
	  Enable support for INTMUX channel 1.
if !BT
config RV32M1_INTMUX_CHANNEL_2
	bool "INTMUX channel 2"
	help
	  Enable support for INTMUX channel 2.

config RV32M1_INTMUX_CHANNEL_3
	bool "INTMUX channel 3"
	help
	  Enable support for INTMUX channel 3.
endif # BT
config RV32M1_INTMUX_CHANNEL_4
	bool "INTMUX channel 4"
	help
	  Enable support for INTMUX channel 4.

config RV32M1_INTMUX_CHANNEL_5
	bool "INTMUX channel 5"
	help
	  Enable support for INTMUX channel 5.

config RV32M1_INTMUX_CHANNEL_6
	bool "INTMUX channel 6"
	help
	  Enable support for INTMUX channel 6.

config RV32M1_INTMUX_CHANNEL_7
	bool "INTMUX channel 7"
	help
	  Enable support for INTMUX channel 7.

endif # RV32M1_INTMUX
```
