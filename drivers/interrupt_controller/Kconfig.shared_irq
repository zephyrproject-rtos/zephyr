## drivers/interrupt_controller/Kconfig.shared_irq
```kconfig
# shared_irq configuration options

# Copyright (c) 2015 Intel Corporation
# SPDX-License-Identifier: Apache-2.0

menuconfig SHARED_IRQ
	bool "Shared interrupt driver"
	default y
	depends on DT_HAS_SHARED_IRQ_ENABLED
	help
	  Include shared interrupt support in system. Shared interrupt
	  support is NOT required in most systems. If in doubt answer no.

config SHARED_IRQ_INIT_PRIORITY
	int "Shared IRQ init priority"
	depends on SHARED_IRQ
	default 45
	help
	  Shared IRQ are initialized on POST_KERNEL init level. They
	  have to be initialized before any device that uses them.
```

## drivers/interrupt_controller/Kconfig.stm32
```kconfig
# STM32 EXTI configuration

# Copyright (c) 2016 Open-RnD Sp. z o.o.
# Copyright (c) 2025 Alexander Kozhinov <ak.alexander.kozhinov@gmail.com>
# SPDX-License-Identifier: Apache-2.0

if SOC_FAMILY_STM32

config EXTI_STM32
	bool "STM32 External Interrupt/Event Controller (EXTI) Driver"
	default y
	depends on DT_HAS_ST_STM32_EXTI_ENABLED
	help
	  Enable STM32 EXTI driver

config GPIO_INTC_STM32
	bool "STM32 GPIO Interrupt/Event Controller (EXTI) Driver"
	default y
	depends on EXTI_STM32
	help
	  Enable STM32 GPIO interrupt controller driver

config GPIO_INTC_STM32WB0
	bool "GPIO Interrupt Controller Driver for STM32WB0 series"
	default y
	depends on DT_HAS_ST_STM32WB0_GPIO_INTC_ENABLED
	help
	  Enable GPIO interrupt controller driver for STM32WB0 series

endif # SOC_FAMILY_STM32
```

## drivers/interrupt_controller/Kconfig.swerv
```kconfig
# Copyright (c) 2026 Intel Corporation
#
# SPDX-License-Identifier: Apache-2.0

config SWERV_PIC
	bool "Cadence SweRV Programmable Interrupt Controller (PIC)"
	default y
	depends on DT_HAS_CDNS_SWERV_PIC_ENABLED || DT_HAS_SWERV_PIC_ENABLED
	help
	  Programmable Interrupt Controller for the Cadence SweRV RISC-V CPU.
```

## drivers/interrupt_controller/Kconfig.thejas32
```kconfig
# Copyright (c) 2026 Anuj Deshpande
# SPDX-License-Identifier: Apache-2.0

config THEJAS32_INTC
	bool "C-DAC THEJAS32 interrupt controller"
	default y
	depends on DT_HAS_CDAC_THEJAS32_INTC_ENABLED
	select MULTI_LEVEL_INTERRUPTS
	select 2ND_LEVEL_INTERRUPTS
	help
	  Driver for the C-DAC THEJAS32 second-level interrupt controller,
	  which aggregates the SoC peripheral interrupt sources into the
	  RISC-V machine external interrupt line.
```

## drivers/interrupt_controller/Kconfig.ti
```kconfig
# Copyright (c) 2024 Abe Kohandel <abe.kohandel@gmail.com>
# SPDX-License-Identifier: Apache-2.0

config TI_AM335X_INTC
	bool "TI AM335x ARM Interrupt Controller"
	default y
	depends on DT_HAS_TI_AM335X_INTC_ENABLED
```

## drivers/interrupt_controller/Kconfig.tic
```kconfig
# Copyright 2024 Hounjoung Rim <hounjoung@tsnlab.com>
# SPDX-License-Identifier: Apache-2.0

if CPU_CORTEX_R5

config TIC
	bool "Telechips Interrupt Controller"
	default y
	depends on DT_HAS_TCC_TIC_ENABLED
	help
	  The Telechips Interrupt Controller provides hardware assistance for prioritizing
	  and aggregating the interrupt sources for ARM Cortex-R5 processor cores.

endif
```

## drivers/interrupt_controller/Kconfig.tms570_vim
```kconfig
# Copyright (C) 2025 ispace, inc.
#
# SPDX-License-Identifier: Apache-2.0

config TMS570_VIM
	bool "TI Vectored Interrupt Manager (TMS570)"
	default y
	depends on DT_HAS_TI_TMS570_VIM_ENABLED
	help
	  The TI Vectored Interrupt Manager provides hardware assistance for prioritizing
	  and aggregating the interrupt sources for TI herules ARM Cortex-R4/R5 processor cores.
```

## drivers/interrupt_controller/Kconfig.uwp
```kconfig
#
# Copyright (c) 2018, UNISOC Incorporated
#
# SPDX-License-Identifier: Apache-2.0
#

menuconfig UWP_ICTL
	bool "UNISOC Interrupt Controller Driver"
	depends on SOC_FAMILY_UWP
	depends on MULTI_LEVEL_INTERRUPTS
	help
	  Enable UNISOC uwp5 interrupt controller.

if UWP_ICTL

config UWP_ICTL_0
	bool "UNISOC UWP irq Interrupt Controller"
	help
	  Enable ICTL irq for UNISOC UWP MCU.

config UWP_ICTL_0_NAME
	string "Device name for ICTL IRQ"
	depends on UWP_ICTL_0
	default "UWP_ICTL_IRQ"
	help
	  Set the name used by ICTL irq device during registration.

config UWP_ICTL_0_OFFSET
	hex "Parent interrupt number to which UWP_ICTL_0 maps"
	depends on UWP_ICTL_0
	default 0x40

config UWP_ICTL_1
	bool "UNISOC UWP fiq Interrupt Controller"
	help
	  Enable ICTL fiq for UNISOC UWP MCU.

config UWP_ICTL_1_NAME
	string "Device name for ICTL FIQ"
	depends on UWP_ICTL_1
	default "UWP_ICTL_FIQ"
	help
	  Set the name used by ICTL fiq device during registration.

config UWP_ICTL_1_OFFSET
	hex "Parent interrupt number to which UWP_ICTL_1 maps"
	depends on UWP_ICTL_1
	default 0x60

config UWP_ICTL_2
	bool "UNISOC UWP AON Interrupt Controller"
	help
	  Enable AON ICTL for UNISOC UWP MCU.

config UWP_ICTL_2_NAME
	string "Device name for AON ICTL"
	depends on UWP_ICTL_2
	default "UWP_ICTL_AON"
	help
	  Set the name used by AON ICTL device during registration.

config UWP_ICTL_2_OFFSET
	hex "Parent interrupt number to which UWP_ICTL_2 maps"
	depends on UWP_ICTL_2
	default 0x80

endif
```

## drivers/interrupt_controller/Kconfig.wch_exti
```kconfig
# Copyright (c) 2025 Michael Hope <michaelh@juju.nz>
# SPDX-License-Identifier: Apache-2.0

config WCH_EXTI
	bool "WCH CH32V00x/20x/30x External Interrupt and Event Controller (EXTI)"
	default y
	depends on DT_HAS_WCH_EXTI_ENABLED
	help
	  Enable the WCH CH32V00x/20x/30x External Interrupt and Event Controller (EXTI)
	  driver.
```

## drivers/interrupt_controller/Kconfig.wch_pfic
```kconfig
# Copyright (c) 2024 Michael Hope
# SPDX-License-Identifier: Apache-2.0

config WCH_PFIC
	bool "WCH Programmable Fast Interrupt Controller (PFIC)"
	default y
	depends on DT_HAS_WCH_PFIC_ENABLED
	help
	  Driver for the WCH PFIC found on QingKe RISC-V cores.

if WCH_PFIC

config WCH_PFIC_HPE
	bool "Enable QingKe Hardware Prologue/Epilogue (HPE)"
	default n
	help
	  Enable the Hardware Prologue/Epilogue (HPE) feature of the
	  QingKe PFIC.

	  When enabled, the hardware automatically saves mepc, mstatus,
	  ra, t0, and a0-a7 to a dedicated hardware FIFO on ISR entry
	  and restores them on mret.  This reduces ISR latency on
	  compatible cores.

	  Not yet supported.  Enabling this option requires additional
	  changes to _isr_wrapper (arch/riscv/core/isr.S).

config WCH_PFIC_NESTING
	bool "Enable QingKe interrupt preemption nesting"
	default y
	help
	  Enable MIE-based interrupt preemption nesting for QingKe PFIC.

	  When enabled, _isr_wrapper re-enables mstatus.MIE after the
	  full context save and interrupt-stack switch, allowing a
	  higher-priority interrupt to preempt the current ISR.  MIE
	  is cleared before context restore.

	  Priority values are configured via the WCH_PFIC_PRIORITY
	  macro in Device Tree and written to PFIC->IPRIOR[] at init
	  time.

endif # WCH_PFIC
```

## drivers/interrupt_controller/Kconfig.xec
```kconfig
# Microchip XEC ECIA configuration

# Copyright (c) 2021 Microchip Technology Inc.
# SPDX-License-Identifier: Apache-2.0

config MCHP_ECIA_XEC
	bool "External EC Interrupt Aggregator (ECIA) Driver for MCHP MEC family of MCUs"
	default y
	depends on DT_HAS_MICROCHIP_XEC_ECIA_ENABLED
	help
	  Enable XEC ECIA driver for Microchip MEC line of MCUs
```

## drivers/interrupt_controller/Kconfig.xlnx
```kconfig
#
# Copyright 2026 Advanced Micro Devices, Inc.
#
# SPDX-License-Identifier: Apache-2.0
#

config XLNX_INTC
	bool "Xilinx interrupt controller"
	default y
	depends on DT_HAS_XLNX_XPS_INTC_1_00_A_ENABLED
	select MULTI_LEVEL_INTERRUPTS
	select 2ND_LEVEL_INTERRUPTS
	help
	  Enable support for the Xilinx AXI / XPS Interrupt Controller (PG099).
```

## drivers/interrupt_controller/Kconfig.xmc4xxx
```kconfig
# XMC4XXX INTC configuration

# Copyright (c) Schlumberger
# SPDX-License-Identifier: Apache-2.0

config XMC4XXX_INTC
	bool "Interrupt Controller Driver for XMC4XXX series devices"
	default y
	depends on DT_HAS_INFINEON_XMC4XXX_INTC_ENABLED
	help
	  Enable interrupt controller driver for XMC4XXX series of devices. This is required for
	  GPIO interrupt support.
```

## drivers/io96b/Kconfig.intel_socfpga
```kconfig
# Copyright (c) 2023, Intel Corporation
# SPDX-License-Identifier: Apache-2.0

config IO96B_INTEL_SOCFPGA
	bool "Intel SoC FPGA IO96B Controller driver"
	default y
	depends on DT_HAS_INTEL_IO96B_ENABLED
	help
	 Enable the IO96B driver for Intel SoC FPGA device
```

## drivers/ipi/Kconfig
```kconfig
menuconfig IPI
	bool
	prompt "IPI drivers"
	default n
	help
	Include interrupt-based inter-processor communication
	drivers in system configuration

config IPI_QUARK_SE
	bool "Quark SE Mailbox IPI driver"
	default n
	depends on IPI
	help
	IPI driver for Quark SE mailboxes

config IPI_QUARK_SE_MASTER
	bool "Quark SE Mailbox IPI master controller"
	default n
	depends on IPI_QUARK_SE
	help
	Enable this for the first CPU that initializes IPI.
	Sets up the initial interrupt mask and clears out all
	channels. Should be turned on for one CPU only.
```

## drivers/ipm/Kconfig
```kconfig
# SPDX-License-Identifier: Apache-2.0

menuconfig IPM
	bool "Inter-Processor Mailbox (IPM) drivers"
	help
	  Include interrupt-based inter-processor mailboxes
	  drivers in system configuration

if IPM

config IPM_MHU
	bool "IPM MHU driver"
	default y
	depends on DT_HAS_ARM_MHU_ENABLED
	help
	  Driver for SSE 200 MHU (Message Handling Unit)

config IPM_NRFX
	bool "IPM NRF driver"
	default y
	depends on DT_HAS_NORDIC_NRF_IPC_ENABLED
	select NRFX_IPC
	help
	  Driver for Nordic nRF messaging unit, based
	  on nRF IPC peripheral HW.

config IPM_NRF_SINGLE_INSTANCE
	bool "Single instance of IPM device"
	help
	  Enable this option if the IPM device should have
	  a single instance, instead of one per IPC
	  message channel.

config ESP32_SOFT_IPM
	bool "ESP32 Software IPM driver"
	default y
	depends on DT_HAS_ESPRESSIF_ESP32_IPM_ENABLED
	help
	  Interprocessor driver for ESP32 when using AMP.

config IPM_IVSHMEM
	bool "IPM driver based on IVSHMEM-Doorbell"
	default y
	depends on DT_HAS_LINARO_IVSHMEM_IPM_ENABLED
	depends on IVSHMEM
	depends on IVSHMEM_DOORBELL
	help
	  Interprocessor driver using IVSHMEM Doorbell mechanism.

config XLNX_IPI
	bool "AMD-Xilinx IPM driver"
	default y
	depends on DT_HAS_XLNX_ZYNQMP_IPI_MAILBOX_ENABLED
	help
	  Inter Processor Interrupt driver for AMD-Xilinx
	  platforms such as ZynqMP Ultrascale+.

config IPM_MBOX
	bool "IPM over MBOX driver"
	default y
	depends on DT_HAS_ZEPHYR_MBOX_IPM_ENABLED
	select MBOX
	help
	  IPM driver using a MBOX driver as the backend mechanism.

source "drivers/ipm/Kconfig.nrfx"
source "drivers/ipm/Kconfig.imx"
source "drivers/ipm/Kconfig.stm32"
source "drivers/ipm/Kconfig.intel_adsp"
source "drivers/ipm/Kconfig.ivshmem"
source "drivers/ipm/Kconfig.sedi"


module = IPM
module-str = ipm
source "subsys/logging/Kconfig.template.log_config"

endif #IPM
```

## drivers/ipm/Kconfig.imx
```kconfig
# SPDX-License-Identifier: Apache-2.0
# Copyright (c) 2022, Intel Corporation

config IPM_MCUX
	bool "MCUX IPM driver"
	default y
	depends on DT_HAS_NXP_LPC_MAILBOX_ENABLED
	help
	  Driver for MCUX mailbox

config IPM_IMX
	bool "IMX IPM driver"
	default y
	depends on DT_HAS_NXP_IMX_MU_ENABLED
	help
	  Driver for NXP i.MX messaging unit

config IPM_IMX_REV2
	bool "IMX IPM driver (rev 2)"
	default y
	depends on DT_HAS_NXP_IMX_MU_REV2_ENABLED
	help
	  Rev 2 driver for NXP i.MX messaging unit (MCUX-based)

choice
	prompt "IMX IPM max data size"
	default IPM_IMX_MAX_DATA_SIZE_16
	depends on IPM_IMX || IPM_IMX_REV2
	help
	  Select maximum message size for NXP i.MX messaging unit.

config IPM_IMX_MAX_DATA_SIZE_4
	bool "4 bytes"
	help
	  There will be four message types with ids 0, 1, 2 or 3
	  and a maximum size of 4 bytes each.

config IPM_IMX_MAX_DATA_SIZE_8
	bool "8 bytes"
	help
	  There will be two message types with ids 0 or 1
	  and a maximum size of 8 bytes each.

config IPM_IMX_MAX_DATA_SIZE_16
	bool "16 bytes"
	help
	  There will be a single message type with id 0
	  and a maximum size of 16 bytes.

endchoice

config IPM_IMX_MAX_DATA_SIZE
	int
	range 4 16
	default 4 if IPM_IMX_MAX_DATA_SIZE_4
	default 8 if IPM_IMX_MAX_DATA_SIZE_8
	default 16 if IPM_IMX_MAX_DATA_SIZE_16
	depends on IPM_IMX || IPM_IMX_REV2

config IPM_IMX_MAX_ID_VAL
	int
	range 0 3
	default 3 if IPM_IMX_MAX_DATA_SIZE_4
	default 1 if IPM_IMX_MAX_DATA_SIZE_8
	default 0 if IPM_IMX_MAX_DATA_SIZE_16
	depends on IPM_IMX || IPM_IMX_REV2

config IPM_IMX_FW_READY_REPLY
	bool "Send FW_READY reply message"
	depends on IPM_IMX || IPM_IMX_REV2
	help
	  Send FW_READY reply to check for FW boot completion
```

## drivers/ipm/Kconfig.intel_adsp
```kconfig
# SPDX-License-Identifier: Apache-2.0
# Copyright (c) 2022, Intel Corporation

config IPM_CAVS_IDC
	bool "CAVS DSP Intra-DSP Communication (IDC) driver"
	depends on IPM && CAVS_ICTL
	default y if MP_NUM_CPUS > 1 && SMP
	help
	  Driver for the Intra-DSP Communication (IDC) channel for
	  cross SoC communications.

config IPM_CALLBACK_ASYNC
	bool "Deliver callbacks asynchronously"
	default y if IPM_CAVS_HOST
	help
	  When selected, the driver supports "asynchronous" command
	  delivery.  Commands will stay active after the ISR returns,
	  until the application expressly "completes" the command
	  later.

config IPM_CAVS_HOST
	bool "cAVS DSP/host communication"
	select INTEL_ADSP_IPC
	help
	  Driver for host/DSP communication on intel_adsp devices

if IPM_CAVS_HOST

config IPM_CAVS_HOST_INBOX_OFFSET
	hex "Byte offset of cAVS inbox window"
	depends on INTEL_ADSP_IPC
	default 0x6000
	help
	  Location of the host-writable inbox window within the
	  HP_SRAM_RESERVE region.  This location must be synchronized
	  with host driver and SOF source code (must match
	  SRAM_INBOX_BASE).  Be careful.

config IPM_CAVS_HOST_OUTBOX_OFFSET
	hex "Byte offset of cAVS outbox memory"
	depends on INTEL_ADSP_IPC
	default 0x1000
	help
	  Location of the "outbox" region for SOF IPC3/4 message
	  within the pre-existing window 0 (this is not the same as
	  the HP_SRAM_RESERVE region used for INBOX_OFFSET).  This
	  location must be synchronized with host driver and SOF
	  source code (where it must equal SRAM_SW_REG_SIZE).  Be
	  careful.

config IPM_CAVS_HOST_REGWORD
	bool "Store first 4 bytes in IPC register"
	depends on INTEL_ADSP_IPC
	depends on !SOC_INTEL_CAVS_V15
	help
	  Protocol variant.  When true, the first four bytes of a
	  message are passed in the cAVS IDR/TDR register pair instead
	  of in the SRAM window.  Only available on cAVS 1.8+.

endif # IPM_CAVS_HOST
```

## drivers/ipm/Kconfig.ivshmem
```kconfig
# SPDX-License-Identifier: Apache-2.0
# Copyright (c) 2023, Linaro

if IPM_IVSHMEM

config IPM_IVSHMEM_EVENT_LOOP_STACK_SIZE
	int "Stack size in bytes of IVSHMEM IPM Event loop task"
	default 8192
	help
	  Adjust the stack size, in bytes of the ivshmem event loop task.

config IPM_IVSHMEM_EVENT_LOOP_PRIO
	int "Priority of IVSHMEM IPM Event loop task"
	default 2
	help
	  Adjust the priority of the ivshmem event loop task.

endif
```

## drivers/ipm/Kconfig.mchp
```kconfig
# Copyright (c) 2024 Microchip Technology Inc
# SPDX-License-Identifier: (GPL-2.0 OR MIT)

config IPM_MCHP_IHC
	bool "IPM Microchip IHC driver"
	default y
	depends on DT_HAS_MICROCHIP_MIV_IHC_RTL_V2_ENABLED
	help
	  Driver for Microchip Inter Hart Communication unit.

config IPM_MCHP_IHC_REMOTEPROC
	bool "IPM Microchip IHC remoteproc remote"
	depends on IPM_MCHP_IHC
	help
	  Remoteproc Microchip specific initialisation and shutdown for remote
	  processor

config IPM_MCHP_IHC_REMOTEPROC_STOP_ADDR
	hex "IPM Microchip IHC remoteproc remote stop address"
	default 0xA000000
	depends on IPM_MCHP_IHC_REMOTEPROC
	help
	When remoteproc request shutdown, the system must exit cleanly to
	the specified address
```
