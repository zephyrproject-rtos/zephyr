## drivers/ipm/Kconfig.nrfx
```kconfig
# nRF IPM driver configuration

# Copyright (c) 2019 Nordic Semiconductor ASA
# SPDX-License-Identifier: Apache-2.0

if IPM_NRFX

nrfx_ipc_num = 0
rsource "Kconfig.nrfx_ipc_channel"
nrfx_ipc_num = 1
rsource "Kconfig.nrfx_ipc_channel"
nrfx_ipc_num = 2
rsource "Kconfig.nrfx_ipc_channel"
nrfx_ipc_num = 3
rsource "Kconfig.nrfx_ipc_channel"
nrfx_ipc_num = 4
rsource "Kconfig.nrfx_ipc_channel"
nrfx_ipc_num = 5
rsource "Kconfig.nrfx_ipc_channel"
nrfx_ipc_num = 6
rsource "Kconfig.nrfx_ipc_channel"
nrfx_ipc_num = 7
rsource "Kconfig.nrfx_ipc_channel"
nrfx_ipc_num = 8
rsource "Kconfig.nrfx_ipc_channel"
nrfx_ipc_num = 9
rsource "Kconfig.nrfx_ipc_channel"
nrfx_ipc_num = 10
rsource "Kconfig.nrfx_ipc_channel"
nrfx_ipc_num = 11
rsource "Kconfig.nrfx_ipc_channel"
nrfx_ipc_num = 12
rsource "Kconfig.nrfx_ipc_channel"
nrfx_ipc_num = 13
rsource "Kconfig.nrfx_ipc_channel"
nrfx_ipc_num = 14
rsource "Kconfig.nrfx_ipc_channel"
nrfx_ipc_num = 15
rsource "Kconfig.nrfx_ipc_channel"

endif # IPM_NRFX
```

## drivers/ipm/Kconfig.nrfx_ipc_channel
```kconfig
# nRF IPM driver channel configuration

# Copyright (c) 2019 Nordic Semiconductor ASA
# SPDX-License-Identifier: Apache-2.0

menu "IPM Message Channel [$(nrfx_ipc_num)] configuration"

config IPM_MSG_CH_$(nrfx_ipc_num)_ENABLE
	bool "IPM Message Channel $(nrfx_ipc_num)"

config IPM_MSG_CH_$(nrfx_ipc_num)_RX
	bool "IPM Message RX Channel"
	depends on IPM_MSG_CH_$(nrfx_ipc_num)_ENABLE

config IPM_MSG_CH_$(nrfx_ipc_num)_TX
	bool "IPM Message TX Channel"
	depends on IPM_MSG_CH_$(nrfx_ipc_num)_ENABLE
	default ! IPM_MSG_CH_$(nrfx_ipc_num)_RX

endmenu
```

## drivers/ipm/Kconfig.renesas_rz
```kconfig
# Copyright (c) 2024 Renesas Electronics Corporation
# SPDX-License-Identifier: Apache-2.0

config IPM_RENESAS_RZ_MHU
	bool "Renesas RZ MHU Driver"
	default y
	depends on DT_HAS_RENESAS_RZ_MHU_ENABLED
	select USE_RZ_FSP_MHU
	help
	  Enable the RZ MHU driver.
```

## drivers/ipm/Kconfig.rpi_pico
```kconfig
# SPDX-License-Identifier: Apache-2.0
# Copyright (c) 2025 Dan Collins

config IPM_RPI_PICO
	bool "Raspberry Pi Pico IPM Driver"
	default y
	depends on DT_HAS_RASPBERRYPI_PICO_SIO_FIFO_ENABLED
	help
	  This option enables the Raspberry Pi Pico Inter-process mailbox driver.
```

## drivers/ipm/Kconfig.sedi
```kconfig
# SPDX-License-Identifier: Apache-2.0
# Copyright (c) 2023 Intel Corporation

config IPM_SEDI
	bool "Intel SEDI IPM Driver"
	default y if DT_HAS_INTEL_SEDI_IPM_ENABLED
	select IPM_CALLBACK_ASYNC
	help
	  This option enables the Intel SEDI IPM(IPC) driver.
	  This driver is simply a shim driver built upon the SEDI
	  bare metal IPC driver in the hal-intel module
```
