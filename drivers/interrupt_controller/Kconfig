## drivers/interrupt_controller/Kconfig
```kconfig
# interrupt controller configuration options

# Copyright (c) 2015 Intel Corporation
# SPDX-License-Identifier: Apache-2.0

menu "Interrupt controller drivers"

config ARCV2_INTERRUPT_UNIT
	bool "ARCv2 Interrupt Unit"
	default y
	depends on ARC
	help
	  The ARCv2 interrupt unit has 16 allocated exceptions associated with
	  vectors 0 to 15 and 240 interrupts associated with vectors 16 to 255.
	  The interrupt unit is optional in the ARCv2-based processors. When
	  building a processor, you can configure the processor to include an
	  interrupt unit. The ARCv2 interrupt unit is highly programmable.

config SWERV_PIC
	bool "SweRV EH1 Programmable Interrupt Controller (PIC)"
	default y
	depends on DT_HAS_SWERV_PIC_ENABLED
	help
	  Programmable Interrupt Controller for the SweRV EH1 RISC-V CPU.

config VEXRISCV_LITEX_IRQ
	bool "VexRiscv LiteX Interrupt controller"
	default y
	depends on DT_HAS_LITEX_VEXRISCV_INTC0_ENABLED
	help
	  IRQ implementation for LiteX VexRiscv

config HAZARD3_INTC
	bool "Hazard3 interrupt controller"
	default y
	select PICOSDK_USE_CLAIM
	select RISCV_SOC_HAS_CUSTOM_IRQ_HANDLING
	depends on DT_HAS_HAZARD3_HAZARD3_INTC_ENABLED
	help
	  IRQ implementation for Hazard3 Interrupt Controller found on the RP2350 series SoCs

config LEON_IRQMP
	bool "GRLIB IRQMP interrupt controller"
	default y
	depends on DT_HAS_GAISLER_IRQMP_ENABLED
	help
	  GRLIB IRQMP and IRQAMP

config INTC_INIT_PRIORITY
	int "Interrupt controller init priority"
	default KERNEL_INIT_PRIORITY_DEFAULT
	help
	  Interrupt controller device initialization priority.

if MCHP_ECIA_XEC

config XEC_GIRQ_INIT_PRIORITY
	int "XEX GIRQ Interrupt controller init priority"
	default 41
	help
	  XEC GIRQ Interrupt controller device initialization priority.
	  The priority value needs to be greater than INTC_INIT_PRIORITY
	  So that the XEC GIRQ controllers are initialized after the
	  xec_ecia.

endif

module = INTC
module-str = intc
source "subsys/logging/Kconfig.template.log_config"

source "drivers/interrupt_controller/Kconfig.*"

endmenu
```

## drivers/interrupt_controller/Kconfig.acp
```kconfig
# SPDX-FileCopyrightText: Copyright The Zephyr Project Contributors
# Copyright (c) 2026 AMD
# SPDX-License-Identifier: Apache-2.0

menuconfig INTC_AMD_ACP
	bool "AMD ACP interrupt controller driver"
	default y
	depends on DT_HAS_AMD_ACP_INTC_ENABLED
	help
	  Enable support for AMD Audio Co-Processor (ACP) interrupt controller.
	  This driver manages interrupt handling for ACP 7.0 audio subsystem,
	  supporting up to 9 interrupt sources including DMA, SoundWire, and
	  other audio-related peripheral interrupts for AMD audio DSP.

if INTC_AMD_ACP

module = INTC_AMD_ACP
module-str = intc_amd_acp
source "subsys/logging/Kconfig.template.log_config"

config INTC_AMD_ACP_INIT_PRIORITY
	int "Initialization priority"
	default 40
	help
	  ACP interrupt controller initialization priority.

config INTC_AMD_ACP_ISR_TBL_OFFSET
	int "Offset in the SW ISR table"
	default 0
	help
	  This indicates the offset in the SW_ISR_TABLE beginning from where
	  the ISRs for ACP interrupt controller are assigned.

endif # INTC_AMD_ACP
```

## drivers/interrupt_controller/Kconfig.aplic
```kconfig
# Copyright (c) 2025 Institute of Software, Chinese Academy of Sciences (ISCAS)
# SPDX-License-Identifier: Apache-2.0

config RISCV_HAS_APLIC
    bool "RISC-V Advanced Platform-Level Interrupt Controller (APLIC)"
    default y
    depends on (DT_HAS_RISCV_APLIC_ENABLED || DT_HAS_QEMU_APLIC_ENABLED) && RISCV_PRIVILEGED
    select MULTI_LEVEL_INTERRUPTS
    select 2ND_LEVEL_INTERRUPTS
    help
      Enable support for the RISC-V APLIC in direct mode as a second-level
      interrupt controller.

if RISCV_HAS_APLIC

config APLIC_MAX_IRQS
    int "Maximum number of IRQs tracked by APLIC driver"
    default 1024
    range 64 1024
    help
      Size of internal enable shadow table. Should be >= number of sources.

config APLIC_INIT_PRIORITY
    int "APLIC initialization priority"
    default 40
    help
      APLIC device initialization priority.

endif # RISCV_HAS_APLIC
```

## drivers/interrupt_controller/Kconfig.at32
```kconfig
# Copyright (c) 2021 Teslabs Engineering S.L.
# SPDX-License-Identifier: Apache-2.0

config AT32_EXINT
	bool "AT32 Extended Interrupts and Events (EXINT) Controller"
	default y
	depends on DT_HAS_ARTERY_AT32_EXINT_ENABLED
	help
	  Enable the AT32 Extended Interrupts and Events (EXINT)
	  controller driver.
```

## drivers/interrupt_controller/Kconfig.aurix_ir
```kconfig
# Copyright (C) 2024 Infineon Technologies AG
# SPDX-License-Identifier: Apache-2.0

config AURIX_IR
	bool "Infineon Aurix Interrupt Router"
	default y
	depends on DT_HAS_INFINEON_AURIX_IR_ENABLED
	help
		Enable driver for Infineon Aurix interrupt router.
```

## drivers/interrupt_controller/Kconfig.bcm2835
```kconfig
# Copyright (c) 2026
# SPDX-License-Identifier: Apache-2.0

config BCM2835_ARMCTRL_INTC
	bool "Broadcom BCM2835 ARMCTRL interrupt controller"
	default y
	depends on ARM
	depends on ARM_CUSTOM_INTERRUPT_CONTROLLER
	depends on DT_HAS_BRCM_BCM2835_ARMCTRL_IC_ENABLED
	help
	  Enable support for the Broadcom BCM2835 ARM interrupt controller
	  used on Raspberry Pi 1 / Zero class boards.
```

## drivers/interrupt_controller/Kconfig.cavs
```kconfig
# CAVS interrupt controller configuration

# Copyright (c) 2017 Intel Corporation
# SPDX-License-Identifier: Apache-2.0

config CAVS_ICTL
	bool "CAVS Interrupt Logic"
	depends on MULTI_LEVEL_INTERRUPTS
	help
	  These are 4 in number supporting a max of 32 interrupts each.

if CAVS_ICTL

config CAVS_ISR_TBL_OFFSET
	int "Offset in the SW ISR Table"
	default 0
	help
	  This indicates the offset in the SW_ISR_TABLE beginning from where
	  the ISRs for CAVS Interrupt Controller are assigned.

config CAVS_ICTL_0_OFFSET
	int "Parent interrupt number to which CAVS_0 maps"
	default 0

config CAVS_ICTL_1_OFFSET
	int "Parent interrupt number to which CAVS_1 maps"
	default 0

config CAVS_ICTL_2_OFFSET
	int "Parent interrupt number to which CAVS_2 maps"
	default 0

config CAVS_ICTL_3_OFFSET
	int "Parent interrupt number to which CAVS_3 maps"
	default 0

config CAVS_ICTL_INIT_PRIORITY
	int "CAVS ICTL Init priority"
	default 45
	help
	  Cavs Interrupt Logic initialization priority.

endif # CAVS_ICTL
```

## drivers/interrupt_controller/Kconfig.ch32v
```kconfig
# Copyright (c) 2023-2024 Chen Xingyu <hi@xingrz.me>
# SPDX-License-Identifier: Apache-2.0

config CH32V_PFIC
	bool "WCH CH32V PFIC"
	default y
	depends on DT_HAS_WCH_CH32V_PFIC_ENABLED
	help
	  Enable WCH CH32V PFIC driver.
```

## drivers/interrupt_controller/Kconfig.clic
```kconfig
# Copyright (c) 2021 Tokita, Hiroshi <tokita.hiroshi@gmail.com>
# SPDX-License-Identifier: Apache-2.0

config CLIC
	bool "RISC-V Core Local Interrupt Controller (CLIC)"
	default y
	depends on DT_HAS_NUCLEI_ECLIC_ENABLED || DT_HAS_RISCV_CLIC_ENABLED
	select RISCV_SOC_HAS_CUSTOM_IRQ_HANDLING
	help
	  Core Local Interrupt Controller provide low-latency, vectored,
	  preemptive interrupts for RISC-V systems.

config NUCLEI_ECLIC
	bool "Enhanced Core Local Interrupt Controller (ECLIC)"
	default y
	depends on DT_HAS_NUCLEI_ECLIC_ENABLED
	select CLIC
	select CLIC_SMCLICSHV_EXT if RISCV_VECTORED_MODE
	select CLIC_SMCLICCONFIG_EXT
	select LEGACY_CLIC_MEMORYMAP_ACCESS
	help
	  Interrupt controller for Nuclei SoC core.

config NRFX_CLIC
	bool "VPR Core Local Interrpt Controller (CLIC)"
	default y
	depends on DT_HAS_NORDIC_NRF_CLIC_ENABLED
	select GEN_IRQ_VECTOR_TABLE
	help
	  Interrupt controller for Nordic VPR cores.

if CLIC

config CLIC_SMCLICSHV_EXT
	bool
	help
	  The selective hardware vectoring extension gives users the flexibility
	  to select the behavior for each interrupt. The CLIC driver needs to
	  implement the riscv_clic_irq_vector_set() function.

config CLIC_SMCLICCONFIG_EXT
	bool
	help
	  Enables the SMCLICCONFIG extension, allowing configuration of CLIC
	  parameters such as the number of interrupt level bits.

config CLIC_PARAMETER_INTCTLBITS
	int "The number of modifiable bits in the clicintctl registers"
	range 0 8
	default 8
	help
	  This option specifies the number of modifiable bits in the clicintctl
	  registers.

config CLIC_PARAMETER_MNLBITS
	int "The number of bits in CLICINTCTLBITS to encode the interrupt level"
	range 0 CLIC_PARAMETER_INTCTLBITS
	default 0
	help
	  This option specifies the number of bits in CLICINTCTLBITS assigned to
	  encode the interrupt level at machine mode.

config LEGACY_CLIC_MEMORYMAP_ACCESS
	bool
	help
	  Enables legacy CLIC, allowing access to CLIC registers through
	  memory-mapped access instead of indirect CSR access.

config LEGACY_CLIC
	bool "Use the legacy clic specification"
	depends on RISCV_HAS_CLIC
	help
	  Enables legacy clic, where smclicshv extension is not supported and
	  hardware vectoring is set via mode bits of mtvec.

endif # CLIC
```

## drivers/interrupt_controller/Kconfig.clint
```kconfig
# RISC-V CLINT IPI driver configuration

# SPDX-License-Identifier: Apache-2.0

config CLINT_IPI
	bool "Use CLINT to support Inter-Processor Interrupt in RISC-V SMP"
	depends on RISCV
	depends on SMP
	select SCHED_IPI_SUPPORTED
	help
	  Use CLINT(Core-Local Interruptor) to provide support
	  for Inter-Processor Interrupt in RISC-V SMP SoC;
```

## drivers/interrupt_controller/Kconfig.dw
```kconfig
# Copyright (c) 2019 Intel Corporation
# SPDX-License-Identifier: Apache-2.0

config DW_ICTL_ACE
	bool "Designware Interrupt Controller for ACE"
	default y
	depends on DT_HAS_INTEL_ACE_INTC_ENABLED
	depends on MULTI_LEVEL_INTERRUPTS
	help
	  Designware Interrupt Controller used by ACE.

menuconfig DW_ICTL
	bool "Designware Interrupt Controller"
	default y
	depends on DT_HAS_SNPS_DESIGNWARE_INTC_ENABLED
	depends on MULTI_LEVEL_INTERRUPTS
	help
	  Designware Interrupt Controller can be used as a 2nd level interrupt
	  controller which combines several sources of interrupt into one line
	  that is then routed to the 1st level interrupt controller.


if DW_ICTL

config DW_ICTL_NAME
	string "Name for Designware Interrupt Controller"
	default "DW_ICTL"
	help
	  Give a name for the instance of Designware Interrupt Controller

config DW_ISR_TBL_OFFSET
	int "Offset in the SW ISR Table"
	default 0
	help
	  This indicates the offset in the SW_ISR_TABLE beginning from where
	  the ISRs for Designware Interrupt Controller are assigned.

config DW_ICTL_INIT_PRIORITY
	int "Init priority for DW interrupt controller"
	default 48
	help
	  DesignWare Interrupt Controller initialization priority.

endif # DW_ICTL
```

## drivers/interrupt_controller/Kconfig.eclic
```kconfig
# Nuclei ECLIC interrupt-controller configuration

# Copyright (c) 2021 Tokita, Hiroshi <tokita.hiroshi@gmail.com>
# SPDX-License-Identifier: Apache-2.0

DT_COMPAT_NUCLEI_ECLIC = nuclei,eclic

config HAS_NUCLEI_ECLIC
	bool
	help
	  Indicate that the platform has ECLIC.

config NUCLEI_ECLIC
	bool "Enhanced Core Local Interrupt Controller (ECLIC)"
	default $(dt_compat_enabled,$(DT_COMPAT_NUCLEI_ECLIC))
	depends on HAS_NUCLEI_ECLIC
	help
	  Interrupt controller for Nuclei SoC core.
```

## drivers/interrupt_controller/Kconfig.esp32c3
```kconfig
# Copyright (c) 2021 Espressif Systems (Shanghai) Co., Ltd.
# SPDX-License-Identifier: Apache-2.0

config INTC_ESP32C3
	bool "ESP32C3 interrupt controller driver"
	depends on SOC_FAMILY_ESPRESSIF_ESP32
	depends on SOC_SERIES_ESP32C3 || SOC_SERIES_ESP32C6
	default y
	help
	  Enables the esp32c3 interrupt controller driver to handle ISR
	  management at SoC level.

config INTC_ESP32C3_DECISIONS_LOG
	bool "Espressif's interrupt allocator logging"
	depends on INTC_ESP32C3
	select LOG
	help
	  Enable this option to visualize information on decisions made by the
	  interrupt allocator. This has no impact on the interrupt allocator usage
	  but may be valuable for debugging purposes. When enabled, messages are
	  print to the serial console.
```

## drivers/interrupt_controller/Kconfig.gd32
```kconfig
# GD32 EXTI configuration

# Copyright (c) 2016 Open-RnD Sp. z o.o.
# SPDX-License-Identifier: Apache-2.0

if SOC_SERIES_RISCV_GIGADEVICE_GD32V

config EXTI_GD32
	bool "External Interrupt/Event Controller (EXTI) Driver for GD32 family of MCUs"
	default y if SOC_SERIES_RISCV_GIGADEVICE_GD32V
	help
	  Enable EXTI driver for GD32 line of MCUs

config EXTI_GD32_EXTI0_IRQ_PRI
	int "EXTI0 IRQ priority"
	depends on EXTI_GD32
	default 0
	help
	  IRQ priority of EXTI1:0 interrupt

config EXTI_GD32_EXTI1_IRQ_PRI
	int "EXTI1 IRQ priority"
	depends on EXTI_GD32
	default 0
	help
	  IRQ priority of EXTI1:0 interrupt

config EXTI_GD32_EXTI2_IRQ_PRI
	int "EXTI2 IRQ priority"
	depends on EXTI_GD32
	default 0
	help
	  IRQ priority of EXTI3 interrupt

config EXTI_GD32_EXTI3_IRQ_PRI
	int "EXTI3 IRQ priority"
	depends on EXTI_GD32
	default 0
	help
	  IRQ priority of EXTI3:2 interrupt

config EXTI_GD32_EXTI4_IRQ_PRI
	int "EXTI4 IRQ priority"
	depends on EXTI_GD32
	default 0
	help
	  IRQ priority of EXTI4 interrupt

config EXTI_GD32_EXTI5_9_IRQ_PRI
	int "EXTI5:9 IRQ priority"
	depends on EXTI_GD32
	default 0
	help
	  IRQ priority of EXTI5:9 interrupt

config EXTI_GD32_EXTI10_15_IRQ_PRI
	int "EXTI10:15 IRQ priority"
	depends on EXTI_GD32
	default 0
	help
	  IRQ priority of EXTI10:15 interrupt

endif # SOC_FAMILY_GD32
```

## drivers/interrupt_controller/Kconfig.gd32_exti
```kconfig
# Copyright (c) 2021 Teslabs Engineering S.L.
# SPDX-License-Identifier: Apache-2.0

config GD32_EXTI
	bool "GD32 Extended Interrupts and Events (EXTI) Controller"
	default y
	depends on DT_HAS_GD_GD32_EXTI_ENABLED
	help
	  Enable the GigaDevice GD32 Extended Interrupts and Events (EXTI)
	  controller driver.
```

## drivers/interrupt_controller/Kconfig.hc32
```kconfig
# Copyright (C) 2024-2025, Xiaohua Semiconductor Co., Ltd.
# SPDX-License-Identifier: Apache-2.0

config INTC_HC32
	bool "Interrupt/Event Controller (INTC) Driver for HC32 family of MCUs"
	default y
	depends on DT_HAS_XHSC_HC32_INTC_ENABLED
	select HC32_LL_INTERRUPTS
	select HC32_LL_INTERRUPTS_SHARE
	help
	  Enable INTC driver for HC32 line of MCUs


config INTC_EXTINT_HC32
	bool "External Interrupt Controller (EXTINT) Driver for HC32 family of MCUs"
	default y
	depends on DT_HAS_XHSC_HC32_EXTINT_ENABLED
	select HC32_LL_INTERRUPTS
	help
	  Enable EXTINT driver for HC32 line of MCUs

if INTC_EXTINT_HC32

config INTC_EXTINT_USE_SHARE_INTERRUPT
	bool "INTC EXTINT used share interrupt"
	default y
	help
	  INTC EXTINT respond to irq handlers with share interrupt.

endif # INTC_EXTINT_HC32
```

## drivers/interrupt_controller/Kconfig.infineon
```kconfig
# Copyright (c) 2026 Linumiz
# SPDX-License-Identifier: Apache-2.0

config INFINEON_INTC_CAT1
	bool "Infineon CAT1 CPUSS system interrupt multiplexer"
	default y
	depends on DT_HAS_INFINEON_CAT1_INTC_ENABLED
	depends on SOC_FAMILY_INFINEON_CAT1
	select MULTI_LEVEL_INTERRUPTS
	select 2ND_LEVEL_INTERRUPTS
	help
	  Infineon CAT1 CPUSS interrupt multiplexer driver using
	  Zephyr multi-level interrupt framework. System interrupts
	  are level 2, NvicMux lines are level 1 aggregators.
	  The _sw_isr_table is generated at build time in ROM.
```
