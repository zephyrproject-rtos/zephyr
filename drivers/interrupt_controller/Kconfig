## drivers/interrupt_controller/Kconfig.intel_vtd
```kconfig
# Intel VT-D interrupt remapping controller configuration

# Copyright (c) 2020 Intel Corporation
# SPDX-License-Identifier: Apache-2.0

menuconfig INTEL_VTD_ICTL
	bool "Intel VT-D interrupt remapping controller"
	default y
	depends on !BOARD_QEMU_X86_64 && ACPI && X86 && 64BIT && PCIE_MSI_MULTI_VECTOR
	select CACHE_MANAGEMENT
	help
	  Such interrupt remapping hardware is provided through Intel VT-D
	  technology. It's being used, currently, only for MSI/MSI-X
	  multi-vector support. If you have such PCIe device requiring
	  multi-vector support, you will need to enable this.

if INTEL_VTD_ICTL

config INTEL_VTD_ICTL_XAPIC_PASSTHROUGH
	bool "XAPIC mode pass-through"
	depends on !X2APIC
	help
	  If XAPIC mode is enabled, it will avoid remapping all interrupts.

config INTEL_VTD_ICTL_NO_SRC_ID_CHECK
	bool "Never check the source id"
	help
	  Disable the source id check in IRTE.

config INTEL_VTD_ICTL_INIT_PRIORITY
	int "Initialization priority"
	default 40
	help
	  This device should be initialized as soon as possible, before any
	  other device that would require it for MSI/MSI-X multi-vector support.

endif # INTEL_VTD_ICTL
```

## drivers/interrupt_controller/Kconfig.irq_mgr
```kconfig
# Copyright (c) 2024 Meta Platforms
# SPDX-License-Identifier: Apache-2.0

menuconfig IRQ_MANAGER
	bool "IRQ manager driver"
	default y
	depends on DT_HAS_ZEPHYR_IRQ_MANAGER_ENABLED
	help
	  Oversee a range of IRQs from a parent interrupt controller, and provide APIs
	  to allocate and free the interrupt line.

if IRQ_MANAGER

module = IRQ_MANAGER
module-str = irq-mgr
source "subsys/logging/Kconfig.template.log_config"

config IRQ_MANAGER_SHELL
	bool "IRQ manager shell"
	depends on SHELL
	help
	  Shell commands to allocate / free interrupt lines.

endif # IRQ_MANAGER
```

## drivers/interrupt_controller/Kconfig.it51xxx
```kconfig
# Copyright (c) 2025 ITE Corporation. All Rights Reserved.
# SPDX-License-Identifier: Apache-2.0

config HAS_ITE_INTC
	bool
	help
	  This option is selected when ITE_IT51XXX_INTC is enabled.

config ITE_IT51XXX_INTC
	def_bool DT_HAS_ITE_IT51XXX_INTC_ENABLED
	depends on DT_HAS_ITE_IT51XXX_INTC_ENABLED
	select HAS_ITE_INTC
	help
	  This option mainly collects several interrupts from modules.
	  Configurable level-triggered and dege-triggered mode.
	  Configurable interrupt polarity of triggered mode.
	  Each interrupt source able to enabled/masked individually.

config ITE_IT51XXX_WUC
	bool "ITE it51xxx Wakeup controller (WUC) interface"
	default y
	depends on DT_HAS_ITE_IT51XXX_WUC_ENABLED
	help
	  This option enables the wakeup controller interface for IT51XXX
	  family.
	  This is required for KSCAN, UART, eSPI, GPIO etc., interrupt support.

config ITE_IT51XXX_WUC_EITHER_EDGE_HW
	bool "Hardware either-edge triggering support for IT51XXX WUC"
	default y
	depends on $(dt_compat_any_has_prop,$(DT_COMPAT_ITE_IT51XXX_WUC),hw-either-edge-supported,True)
	help
	  Select this option if hardware supports either-edge triggering.
```

## drivers/interrupt_controller/Kconfig.it8xxx2
```kconfig
# Copyright (c) 2015 ITE Corporation
# SPDX-License-Identifier: Apache-2.0

config HAS_ITE_INTC
	bool
	help
	  This option is selected when ITE_IT8XXX2_INTC or
	  ITE_IT8XXX2_INTC_V2 is enabled.

config ITE_IT8XXX2_INTC
	def_bool DT_HAS_ITE_IT8XXX2_INTC_ENABLED
	depends on DT_HAS_ITE_IT8XXX2_INTC_ENABLED
	select HAS_ITE_INTC
	help
	 Configures the maximum number of clients allowed per shared
	 instance of the shared interrupt driver. To conserve RAM set
	 this value to the lowest practical value.
	 this software interrupt default set on by device tree.

config ITE_IT8XXX2_INTC_V2
	def_bool DT_HAS_ITE_IT8XXX2_INTC_V2_ENABLED
	depends on DT_HAS_ITE_IT8XXX2_INTC_V2_ENABLED
	select HAS_ITE_INTC
	help
	  This option enables the interrupt controller for IT82XX2 family.

config ITE_IT8XXX2_WUC
	bool "ITE it8xxx2 Wakeup controller (WUC) interface"
	default y
	depends on DT_HAS_ITE_IT8XXX2_WUC_ENABLED
	help
	 This option enables the wakeup controller interface for IT8XXX2
	 family.
	 This is required for KSCAN, UART, eSPI, GPIO etc., interrupt support.
```

## drivers/interrupt_controller/Kconfig.litex_clic
```kconfig
# Copyright (c) 2025 LiteX Contributors
# SPDX-License-Identifier: Apache-2.0

config LITEX_CLIC
	bool "LiteX Core Local Interrupt Controller (CLIC)"
	default y
	depends on DT_HAS_LITEX_CLIC_ENABLED
	depends on SOC_LITEX_VEXRISCV
	select RISCV_SOC_HAS_CUSTOM_IRQ_HANDLING
	help
	  LiteX CLIC provides interrupt management for VexRiscv cores
	  in LiteX SoCs. This implementation supports up to 64 interrupts
	  with CSR-based control for the first 16 interrupts.
	  
	  Note: This driver includes workarounds for CSRStorage pending
	  bit limitations that prevent hardware auto-clearing.

if LITEX_CLIC

config LITEX_CLIC_MAX_INTERRUPTS
	int "Maximum number of interrupts supported"
	range 16 64
	default 64
	help
	  Maximum number of interrupts that can be handled by the
	  LiteX CLIC. The first 16 interrupts have CSR control,
	  while interrupts 16-63 are hardware-controlled only.

config LITEX_CLIC_PRIORITY_BITS
	int "Number of priority bits"
	range 1 8
	default 8
	help
	  Number of bits used for interrupt priority encoding.
	  More bits provide finer priority granularity.
	  8 bits = 256 priority levels (0-255).

config LITEX_CLIC_NESTED_INTERRUPTS
	bool "Enable nested interrupt handling"
	default n
	help
	  When enabled, the interrupt handler will recursively process
	  higher priority interrupts that become pending during ISR
	  execution. This can improve interrupt latency for high-priority
	  interrupts but increases stack usage.

config LITEX_CLIC_DEBUG_REGISTERS
	bool "Enable debug register access"
	default n
	help
	  Enable access to debug registers that show the hardware bridge
	  state. Useful for debugging CSR-to-hardware connection issues
	  and verifying interrupt arbitration logic.

config LITEX_CLIC_DIRECT_API
	bool "Export direct device API functions"
	default n
	help
	  Export the litex_clic_* functions directly for use by other
	  drivers or applications. Normally only arch_irq_* functions
	  are exposed.

config LITEX_CLIC_WORKAROUND_AUTOCLEAR
	bool "Enable pending bit auto-clear workaround"
	default y
	help
	  Enable software workaround for CSRStorage pending bits that
	  don't auto-clear. This temporarily disables interrupts during
	  pending bit clearing to prevent infinite loops.
	  
	  WARNING: Disabling this may cause system hangs when interrupts
	  are enabled!

config LITEX_CLIC_LOG_LEVEL
	int "Log level for LiteX CLIC driver"
	range 0 4
	default 2
	help
	  Sets the log level for the LiteX CLIC driver.
	  0 = OFF, 1 = ERROR, 2 = WARNING, 3 = INFO, 4 = DEBUG

endif # LITEX_CLIC
```

## drivers/interrupt_controller/Kconfig.loapic
```kconfig
# Copyright (c) 2019 Intel Corporation
# SPDX-License-Identifier: Apache-2.0

menuconfig LOAPIC
	bool "LOAPIC"
	depends on X86
	help
	  This option selects local APIC as the interrupt controller.

if LOAPIC

config LOAPIC_BASE_ADDRESS
	hex "Local APIC Base Address"
	default 0xFEE00000
	help
	  This option specifies the base address of the Local APIC device.

config X2APIC
	bool "Access local APIC in x2APIC mode"
	help
	  If your local APIC supports x2APIC mode, turn this on.

config LOAPIC_SPURIOUS_VECTOR
	bool "Handle LOAPIC spurious interrupts"
	help
	  A special situation may occur when a processor raises its task
	  priority to be greater than or equal to the level of the
	  interrupt for which the processor INTR signal is currently being
	  asserted. If at the time the INTA cycle is issued, the
	  interrupt that was to be dispensed has become masked (programmed
	  by software), the local APIC will deliver a spurious-interrupt
	  vector. Dispensing the spurious-interrupt vector does not affect
	  the ISR, so the handler for this vector should return without an EOI.
	  From x86 manual Volume 3 Section 10.9.

config LOAPIC_SPURIOUS_VECTOR_ID
	int "LOAPIC spurious vector ID"
	default -1
	depends on LOAPIC_SPURIOUS_VECTOR
	help
	  IDT vector to use for spurious LOAPIC interrupts. Note that some
	  arches (P6, Pentium) ignore the low 4 bits and fix them at 0xF.
	  If this value is left at -1 the last entry in the IDT will be used.

config IOAPIC
	bool "IO-APIC"
	default y
	depends on DT_HAS_INTEL_IOAPIC_ENABLED
	help
	  This option signifies that the target has an IO-APIC device. This
	  capability allows IO-APIC-dependent code to be included.

config IOAPIC_MASK_RTE
	bool "Mask out RTE entries on boot"
	default y
	depends on IOAPIC
	help
	  At boot, mask all IOAPIC RTEs if they may be in an undefined state.
	  You don't need this if the RTEs are either all guaranteed to be masked
	  when the OS starts up, or a previous boot stage has done some IOAPIC
	  configuration that needs to be preserved.

endif # LOAPIC
```

## drivers/interrupt_controller/Kconfig.max32_rv32
```kconfig
# ADI MAX32 RV32 IC configuration

# Copyright (c) 2026 Analog Devices, Inc
# SPDX-License-Identifier: Apache-2.0

config MAX32_RV32_INTC
	bool "Interrupt Controller Driver for MAX32 RV32 cores"
	default y
	depends on DT_HAS_ADI_MAX32_RV32_INTC_ENABLED
	help
	  Enable interrupt controller driver for MAX32 RV32 cores.
```

## drivers/interrupt_controller/Kconfig.multi_instance
```kconfig
# Copyright (c) 2023 Meta
# SPDX-License-Identifier: Apache-2.0

config INTC_HAS_MULTI_INSTANCE
	bool

config INTC_MULTI_INSTANCE
	bool "Enable multi-instance interrupt controller"
	depends on INTC_HAS_MULTI_INSTANCE
	help
	  Enable the compilation of extra software to support multi-instance
	  interrupt controller

config INTC_MULTI_INSTANCE_BITS
	int "Number of bits to represent the interrupt controller"
	range 1 2
	depends on INTC_MULTI_INSTANCE
	help
	  Number of bits at the end of the `uint32_t` to be used to encode the
	  index of the interrupt controller instance. 1 bit allows up to 2 controllers,
	  2 bits allow up to 4 controllers.

config INTC_NUM_INSTANCE
	int "Number of interrupt controllers"
	range 1 4
	depends on INTC_MULTI_INSTANCE
	help
	  Number of interrupt controller enabled in the system.
	  Support up to 4 controllers.

instance-id = 0
rsource "Kconfig.multi_instance.offset.template"
instance-id = 1
rsource "Kconfig.multi_instance.offset.template"
instance-id = 2
rsource "Kconfig.multi_instance.offset.template"
instance-id = 3
rsource "Kconfig.multi_instance.offset.template"
```
