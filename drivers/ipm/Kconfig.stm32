## drivers/ipm/Kconfig.stm32
```kconfig
# SPDX-License-Identifier: Apache-2.0
# Copyright (c) 2022, Intel Corporation

config IPM_STM32_IPCC
	bool "STM32 IPCC controller"
	default y
	depends on DT_HAS_ST_STM32_IPCC_MAILBOX_ENABLED
	help
	  Driver for stm32 IPCC mailboxes

config IPM_STM32_IPCC_PROCID
	int "STM32 IPCC Processor ID"
	default 2
	range 1 2
	depends on IPM_STM32_IPCC
	help
	  use to define the Processor ID for IPCC access

config IPM_STM32_HSEM
	bool "STM32 HSEM controller"
	default y
	depends on DT_HAS_ST_STM32_HSEM_MAILBOX_ENABLED
	help
	  Driver for stm32 HSEM mailbox

config IPM_STM32_HSEM_CPU
	int "HSEM CPU ID"
	default 1 if "$(dt_nodelabel_enabled,cpu0)"
	default 2 if "$(dt_nodelabel_enabled,cpu1)"
	range 1 2
	depends on IPM_STM32_HSEM
	help
	  use to define the CPU ID used by HSEM
```

## drivers/jdi/Kconfig
```kconfig
# Copyright (c) 2026, Qingsong Gou <gouqs@hotmail.com>
# SPDX-License-Identifier: Apache-2.0

menuconfig JDI
	bool "JDI display interface drivers"
	help
	  Enable JDI display interface driver.

if JDI

module = JDI
module-str = jdi
source "subsys/logging/Kconfig.template.log_config"

config JDI_INIT_PRIORITY
	int "JDI initialization priority"
	default 84
	help
	  System initialization priority for JDI drivers.

source "drivers/jdi/Kconfig.sf32lb"

endif
```

## drivers/jdi/Kconfig.ambiq
```kconfig
# Copyright (c) 2025 Ambiq Micro Inc.
# SPDX-License-Identifier: Apache-2.0

config JDI_AMBIQ
	bool "Ambiq JDI driver"
	default y
	depends on DT_HAS_AMBIQ_JDI_ENABLED
	select GPIO
	select AMBIQ_HAL
	select AMBIQ_COMPONENT_USE_NEMADC
	help
	  Enable Ambiq JDI (Japan Display Interface) driver.
```

## drivers/jdi/Kconfig.sf32lb
```kconfig
# Copyright (c) 2026, Qingsong Gou <gouqs@hotmail.com>
# SPDX-License-Identifier: Apache-2.0

config JDI_SF32LB
	bool "SiFli SF32LB JDI LCD Bus Controller"
	default y
	depends on DT_HAS_SIFLI_SF32LB_JDI_ENABLED
	select USE_SIFLI_HAL
	select USE_SIFLI_HAL_LCD
	help
	  Enable JDI LCD Bus Controller driver for SiFli SF32LB series MCUs.

if JDI_SF32LB

config JDI_SF32LB_INIT_PRIORITY
	int "JDI init priority"
	default 45
	help
	  JDI driver init priority.

endif # JDI_SF32LB
```

## drivers/key/Kconfig
```kconfig
#
# Copyright (c) 2022 tangchunhui@coros.com
#
# SPDX-License-Identifier: Apache-2.0
#

# Top-level configuration file for KEY drivers.

menuconfig KEY
	bool "KEY drivers"
	help
	  Include KEY drivers in the system configuration.

if KEY

module = KEY
module-str = key
source "subsys/logging/Kconfig.template.log_config"

config KEY_INIT_PRIORITY
	int "KEY initialization priority"
	default 90
	help
	  System initialization priority for KEY drivers.

source "drivers/key/Kconfig.gpio"

endif # KEY
```

## drivers/key/Kconfig.gpio
```kconfig
#
# Copyright (c) 2022 tangchunhui@coros.com
#
# SPDX-License-Identifier: Apache-2.0
#

config KEY_GPIO
	bool "GPIO KEY driver"
	depends on GPIO && $(dt_compat_enabled,gpio-keys)
	help
	  Enable driver for GPIO KEYs.

if KEY_GPIO

config KEY_GPIO_SCAN_INTERVAL
	int "scan interval"
	default 20

config KEY_GPIO_TIME_DEBOUNCE
    int "debounce time"
    default 60

config KEY_GPIO_TIME_LONG
    int "long press time"
    default 0

config KEY_GPIO_TIME_HOLD
    int "hold press time"
    default 0

endif # KEY_GPIO
```

## drivers/kscan/Kconfig
```kconfig
# Keyboard scan configuration options

# Copyright (c) 2019 Intel Corporation
# SPDX-License-Identifier: Apache-2.0

menuconfig KSCAN
	bool "Keyboard scan drivers [DEPRECATED]"
	select DEPRECATED
	help
	  Include Keyboard scan drivers in system config.

if KSCAN

source "drivers/kscan/Kconfig.input"

module = KSCAN
module-str = kscan
source "subsys/logging/Kconfig.template.log_config"

config KSCAN_INIT_PRIORITY
	int "Keyboard scan driver init priority"
	default 90
	help
	  Keyboard scan device driver initialization priority.

endif # KSCAN
```

## drivers/kscan/Kconfig.atm
```kconfig
# SPDX-License-Identifier: Apache-2.0

config KSCAN_ATM
	bool "ATM keyscan driver"
	default y
	depends on DT_HAS_ATMOSIC_KSCAN_ENABLED
	help
	  Enable keyscan driver for ATM.

config KSCAN_THREAD_STACK_SIZE
	int "thread stack size"
	default 1024
	depends on KSCAN_ATM
	help
	  kscan thread stack size.
```

## drivers/kscan/Kconfig.cap1203
```kconfig
# Copyright (c) 2022 Keiya Nobuta
# SPDX-License-Identifier: Apache-2.0

menuconfig KSCAN_CAP1203
	bool "CAP1203 3-cannel capacitive touch sensor driver"
	default y
	depends on DT_HAS_MICROCHIP_CAP1203_ENABLED
	select I2C
	help
	  Enable driver for microchip CAP1203 3-cannel capacitive
	  touch sensor.

if KSCAN_CAP1203

config KSCAN_CAP1203_POLL
	bool "Polling"
	help
	  Enable polling mode when interrupt GPIO is not specified.

config KSCAN_CAP1203_PERIOD
	int "Sample period"
	depends on KSCAN_CAP1203_POLL
	default 10
	help
	  Sample period in milliseconds when in polling mode.

endif # KSCAN_CAP1203
```

## drivers/kscan/Kconfig.cst816s
```kconfig
# Copyright (c) 2020 Qingsong Gou <gouqs@hotmail.com>
# SPDX-License-Identifier: Apache-2.0

menuconfig KSCAN_CST816S
	bool "CST816S capacitive touch panel driver"
	default y
	depends on DT_HAS_HYNITRON_CST816S_ENABLED
	select I2C
	help
	  Enable driver for hynitron cst816s touch panel.

if KSCAN_CST816S

config KSCAN_CST816S_PERIOD
	int "Sample period"
	depends on !KSCAN_CST816S_INTERRUPT
	default 20
	help
	  Sample period in milliseconds when in polling mode.

config KSCAN_CST816S_INTERRUPT
	bool "Interrupt support"
	default y
	depends on GPIO
	help
	  Enable interrupt support (requires GPIO).

endif # KSCAN_CST816S
```

## drivers/kscan/Kconfig.ft5336
```kconfig
# Copyright (c) 2020 NXP
# Copyright (c) 2020 Teslabs Engineering S.L.
# SPDX-License-Identifier: Apache-2.0

menuconfig KSCAN_FT5336
	bool "FT5XX6/FT6XX6 capacitive touch panel driver"
	default y
	depends on DT_HAS_FOCALTECH_FT5336_ENABLED
	select I2C
	help
	  Enable driver for multiple Focaltech capacitive touch panel
	  controllers. This driver should support FT5x06, FT5606, FT5x16,
	  FT6x06, Ft6x36, FT5x06i, FT5336, FT3316, FT5436i, FT5336i and FT5x46.

if KSCAN_FT5336

config KSCAN_FT5336_PERIOD
	int "Sample period"
	depends on !KSCAN_FT5336_INTERRUPT
	default 10
	help
	  Sample period in milliseconds when in polling mode.

config KSCAN_FT5336_INTERRUPT
	bool "Interrupt"
	help
	  Enable interrupt support (requires GPIO).

endif # KSCAN_FT5336
```

## drivers/kscan/Kconfig.gpio
```kconfig
# Generic GPIO Keyboard Matrix

# Copyright (c) 2020 Peter Johanson <peter@peterjohanson.com>
# SPDX-License-Identifier: Apache-2.0

config KSCAN_GPIO
	bool "GPIO Keyboard Matrix KSCAN driver"
	depends on GPIO && HAS_DTS_GPIO
	help
	  Enable the generic GPIO keyboard matrix driver.
```

## drivers/kscan/Kconfig.gt911
```kconfig
# Copyright (c) 2020 NXP
# Copyright (c) 2020 Teslabs Engineering S.L.
# SPDX-License-Identifier: Apache-2.0

menuconfig KSCAN_GT911
	bool "GT9xx / GT9xxx capacitive touch panel driver"
	default y
	depends on DT_HAS_GOODIX_GT911_ENABLED
	select I2C
	help
	  Enable driver for multiple Goodix capacitive touch panel
	  controllers. This driver should support gt9110, gt912,
	  gt927, gt9271, gt928, gt967

if KSCAN_GT911

config KSCAN_GT911_PERIOD
	int "Sample period"
	depends on !KSCAN_GT911_INTERRUPT
	default 10
	help
	  Sample period in milliseconds when in polling mode.

config KSCAN_GT911_INTERRUPT
	bool "Interrupt"
	help
	  Enable interrupt support (requires GPIO).

endif # KSCAN_GT911
```

## drivers/kscan/Kconfig.ht16k33
```kconfig
# Copyright (c) 2019 - 2021 Henrik Brix Andersen <henrik@brixandersen.dk>
# SPDX-License-Identifier: Apache-2.0

config KSCAN_HT16K33
	bool "HT16K33 keyscan driver"
	default y
	depends on DT_HAS_HOLTEK_HT16K33_KEYSCAN_ENABLED
	help
	  Enable keyscan driver for HT16K33.

	  The HT16K33 is a memory mapping, multifunction LED
	  controller driver. The controller supports matrix key scan
	  circuit of up to 13x3 keys.
```

## drivers/kscan/Kconfig.input
```kconfig
# Copyright 2023 Google LLC
# SPDX-License-Identifier: Apache-2.0

config KSCAN_INPUT
	bool "Input subsystem to kscan adapter driver"
	default y
	depends on INPUT
	depends on DT_HAS_ZEPHYR_KSCAN_INPUT_ENABLED
```

## drivers/kscan/Kconfig.it8xxx2
```kconfig
# Copyright (c) 2021 ITE Corporation. All Rights Reserved.
# SPDX-License-Identifier: Apache-2.0

menuconfig KSCAN_ITE_IT8XXX2
	bool "ITE KSCAN driver"
	depends on SOC_IT8XXX2 && KSCAN
	select MULTITHREADING
	help
	  This option enables the ITE keyboard scan driver.

if KSCAN_ITE_IT8XXX2

config KSCAN_ITE_IT8XXX2_COLUMN_SIZE
	int "KSCAN_ITE_IT8XXX2_COLUMN_SIZE"
	range 16 18
	default 16
	help
	  Adjust the value to your keyboard columns. The maximum
	  column size for the ITE family is 18.

config KSCAN_ITE_IT8XXX2_ROW_SIZE
	int "KSCAN_ITE_IT8XXX2_ROW_SIZE"
	default 8
	help
	  Adjust the value to your keyboard rows. The maximum
	  row size for the ITE family is 8.

config KSCAN_ITE_IT8XXX2_DEBOUNCE_DOWN
	int "KSCAN_ITE_IT8XXX2_DEBOUNCE_DOWN"
	default 9
	help
	  Determines the time in msecs for debouncing a key press.

config KSCAN_ITE_IT8XXX2_DEBOUNCE_UP
	int "KSCAN_ITE_IT8XXX2_DEBOUNCE_UP"
	default 30
	help
	  Determines the time in msecs for debouncing a key release.

config KSCAN_ITE_IT8XXX2_POLL_PERIOD
	int "KSCAN_ITE_IT8XXX2_POLL_PERIOD"
	default 3
	help
	  Defines the poll period in msecs between matrix scans.

endif # KSCAN_ITE_IT8XXX2
```

## drivers/kscan/Kconfig.matrix
```kconfig
# Keyboard scan matrix configuration options

# Copyright (c) 2022 Nuvoton Technology Corporation.
# SPDX-License-Identifier: Apache-2.0

config KSCAN_MATRIX
	bool "keyboard scan matrix"
	help
	  A matrix circuit is used in most computer keyboards where the key
	  switches are connected by a grid of wires, similar to a diode matrix.

if KSCAN_MATRIX

config KSCAN_MATRIX_MAX_COLUMNS
	int "keyboard matrix max column"
	default 18
	help
	  Maximum columns of the matrix circuit.

config KSCAN_MATRIX_MAX_ROWS
	int "keyboard matrix max row"
	default 8
	help
	  Maximum rows of the matrix circuit.

config KSCAN_MATRIX_DRIVER
	bool "Keyboard matrix driver for scanning"
	help
	  Keyboard Scan Matrix Driver Support

if KSCAN_MATRIX_DRIVER

config KSCAN_MATRIX_DRV_NAME
	string "Keyboard Scan Matrix Driver name"
	default "kscan_matrix"
	help
	  Device name for Kscan Matrix Pseudo device.

config KSCAN_MATRIX_TASK_INIT_PRIORITY
	int "Keyboard matrix task init priority"
	default 95
	help
	  Keyboard matrix task initialization priority.

config KSCAN_MATRIX_THREAD_STACK_SIZE
	int "Stack size for the kscan matrix thread"
	default 1024
	help
	  Size of the stack used for the kscan matrix thread.

config KSCAN_MATRIX_THREAD_PRIO
	int "Keyboard matrix thread priority"
	default 0
	help
	  Priority level for kscan matrix polling thread.

config KSCAN_MATRIX_DEBOUNCE_DOWN
	int "keyboard matrix debounce down"
	default 10
	help
	  Determines the time in msecs for debouncing a key press.

config KSCAN_MATRIX_DEBOUNCE_UP
	int "keyboard matrix debounce up"
	default 20
	help
	  Determines the time in msecs for debouncing a key release.

config KSCAN_MATRIX_POLL_PERIOD
	int "keyboard matrix poll period"
	default 5
	help
	  Defines the poll period in msecs between between matrix scans

config KSCAN_MATRIX_POLL_COL_OUTPUT_SETTLE_TIME
	int "keyboard matrix poll column output settle time"
	default 50
	help
	  Delay (us) between setting column output and waiting for it
	  to settle

endif # KSCAN_MATRIX_DRIVER

endif # KSCAN_MATRIX
```

## drivers/kscan/Kconfig.npcx
```kconfig
# NPCX Keyboard Scan driver configuration options

# Copyright (c) 2022 Nuvoton Technology Corporation.
# SPDX-License-Identifier: Apache-2.0

config KSCAN_MATRIX_NPCX
	bool "Nuvoton NPCX embedded controller (EC) Keyboard Scan (KSCAN) driver"
	depends on DT_HAS_NUVOTON_NPCX_KSCAN_MATRIX_ENABLED
	default y
	help
	  This option enables the KSCAN driver for NPCX family of
	  processors.

config KSCAN_NPCX_KSO_HIGH_DRIVE
	bool "Select quasi-bidirectional buffers for KSO pins"
	depends on KSCAN_MATRIX_NPCX
	default y
	help
	  Select quasi-bidirectional buffers for KSO pins to reduce the
	  low-to-high transition time.
```

## drivers/kscan/Kconfig.sdl
```kconfig
# Copyright (c) 2020 Jabil Inc.
# SPDX-License-Identifier: Apache-2.0

config KSCAN_SDL
	bool "SDL event filter for touch panel emulation"
	default y
	depends on DT_HAS_ZEPHYR_SDL_KSCAN_ENABLED
	depends on HAS_SDL
	help
	  Enable driver for the SDL mouse event filter.
```

## drivers/kscan/Kconfig.stmpe811
```kconfig
# Copyright (c) Konstantinos Papadopoulos <kostas.papadopulos@gmail.com
# SPDX-License-Identifier: Apache-2.0

menuconfig KSCAN_STMPE811
	bool "STMPE811 resistive touch panel driver"
	depends on I2C

if KSCAN_STMPE811

config KSCAN_STMPE811_PERIOD
	int "Sample period"
	depends on !KSCAN_STMPE811_INTERRUPT
	default 10
	help
	  Sample period in milliseconds when in polling mode.

config KSCAN_STMPE811_INTERRUPT
	bool "Interrupt"
	help
	  Enable interrupt support (requires GPIO).

endif # KSCAN_STMPE811
```

## drivers/kscan/Kconfig.xec
```kconfig
# Microchip XEC Keyboard Scan Matrix configuration options

# Copyright (c) 2019 Intel Corporation
# SPDX-License-Identifier: Apache-2.0

menuconfig KSCAN_XEC
	bool "Microchip XEC series KSCAN driver"
	default y
	depends on DT_HAS_MICROCHIP_XEC_KSCAN_ENABLED
	select MULTITHREADING
	select PINCTRL
	help
	  Enable the Microchip XEC Kscan IO driver.

if KSCAN_XEC

config KSCAN_XEC_COLUMN_SIZE
	int "Keyscan XEC Column Size"
	default 16
	help
	  Adjust the value to your keyboard columns. The maximum
	  column size for the Microchip XEC family is 18 (from 0 to 17).

config KSCAN_XEC_ROW_SIZE
	int "Keyscan XEC Row Size"
	default 8
	help
	  Adjust the value to your keyboard rows. The maximum
	  column size for the Microchip XEC family is 8 (from 0 to 7).

config KSCAN_XEC_DEBOUNCE_DOWN
	int "Keyscan XEC Debounce Down"
	default 10
	help
	  Determines the time in msecs for debouncing a key press.

config KSCAN_XEC_DEBOUNCE_UP
	int "Keyscan XEC Debounce Up"
	default 20
	help
	  Determines the time in msecs for debouncing a key release.

config KSCAN_XEC_POLL_PERIOD
	int "Keyscan XEC Poll Period"
	default 5
	help
	  Defines the poll period in msecs between between matrix scans.

endif # KSCAN_XEC
```

## drivers/kscan/Kconfig.xpt2046
```kconfig
# Copyright (c) 2023 Seppo Takalo
# SPDX-License-Identifier: Apache-2.0

config KSCAN_XPT2046
	bool "XPT2046 resistive touch panel driver"
	default y
	depends on DT_HAS_XPTEK_XPT2046_ENABLED
	select SPI
	help
	  Enable driver for Xptek XPT2046 resistive touch panel.
	  This driver is very similar to ADS7843, but differs on channel numbering.
```
