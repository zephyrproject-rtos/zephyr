## drivers/led/Kconfig
```kconfig
# Copyright (c) 2018 Linaro Limited
# SPDX-License-Identifier: Apache-2.0

# Top-level configuration file for LED drivers.

menuconfig LED
	bool "Light-Emitting Diode (LED) drivers"
	help
	  Include LED drivers in the system configuration.

if LED

module = LED
module-str = led
source "subsys/logging/Kconfig.template.log_config"

config LED_INIT_PRIORITY
	int "LED initialization priority"
	default 90
	help
	  System initialization priority for LED drivers.

config LED_SHELL
	bool "LED shell"
	depends on SHELL
	help
	  Enable LED shell for testing.

config LED_TRIGGER
	bool "LED trigger support"
	depends on LED
	help
	  Enable the LED trigger framework. LED triggers are
	  kernel-based sources of LED events that can drive LEDs
	  according to a pattern or system event.

	  The framework provides a channel pool and shared
	  infrastructure. Individual triggers (timer, network activity
	  etc.) are enabled separately below.

config LED_TRIGGER_MAX_CHANNELS
	int "Maximum number of LED trigger channels"
	default 8
	depends on LED_TRIGGER
	help
	  Maximum number of LED channels that can simultaneously use
	  the trigger framework. Each channel consumes a slot from
	  a fixed-size static pool. Once claimed, a slot is never
	  freed.

config LED_TRIGGER_TIMER
	bool "Timer LED trigger"
	default y
	depends on LED_TRIGGER
	help
	  Enable the timer LED trigger, which provides periodic
	  on/off blinking via the system workqueue. This is the
	  software fallback used by led_blink() when the hardware
	  driver does not implement blink. The timer's accuracy
	  depends heavily on current system load.

# zephyr-keep-sorted-start
source "drivers/led/Kconfig.axp192"
source "drivers/led/Kconfig.dac"
source "drivers/led/Kconfig.gpio"
source "drivers/led/Kconfig.ht16k33"
source "drivers/led/Kconfig.is31fl319x"
source "drivers/led/Kconfig.is31fl3216a"
source "drivers/led/Kconfig.is31fl3733"
source "drivers/led/Kconfig.leds-group-multicolor"
source "drivers/led/Kconfig.lp3943"
source "drivers/led/Kconfig.lp50xx"
source "drivers/led/Kconfig.lp5562"
source "drivers/led/Kconfig.lp5569"
source "drivers/led/Kconfig.modulino"
source "drivers/led/Kconfig.ncp5623"
source "drivers/led/Kconfig.npm13xx"
source "drivers/led/Kconfig.pca9533"
source "drivers/led/Kconfig.pca9633"
source "drivers/led/Kconfig.pwm"
source "drivers/led/Kconfig.sct2024"
source "drivers/led/Kconfig.tlc59108"
source "drivers/led/Kconfig.xec"
# zephyr-keep-sorted-stop

endif # LED
```

## drivers/led/Kconfig.adp8866
```kconfig
# Copyright (c) 2021 Pat Deegan, https://psychogenic.com
# SPDX-License-Identifier: Apache-2.0

config ADP8866
	bool "ADP8866 LED driver"
	depends on I2C
	help
	  Enable LED driver for ADP8866.

	  ADP8866 LED driver has 9 channels,
	  Each channel can drive up to
	  25 mA per LED, with 7 bits (128 levels) of 
	  nonlinear current settings.
	  
```

## drivers/led/Kconfig.airoc
```kconfig
# Copyright (c) 2025 Beechwoods Software, Inc.
# SPDX-License-Identifier: Apache-2.0

config LED_AIROC
	bool "Infineon AIROC LED driver"
	default y
	depends on DT_HAS_INFINEON_AIROC_LEDS_ENABLED
	depends on NETWORKING
	depends on WIFI
	depends on CYW43439
	# depends on GPIO_AIROC
	help
	  Enable support for Infineon AIROC LED controllers.
```
