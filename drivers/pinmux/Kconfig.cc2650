## drivers/pinmux/Kconfig.cc2650
```kconfig
# SPDX-License-Identifier: Apache-2.0
#
# Kconfig for TI CC2650 SoC pinmux driver.

config PINMUX_CC2650
	bool "Pinmux driver for CC2650 SoC"
	depends on PINMUX && SOC_SERIES_CC2650
	depends on GPIO
	depends on GPIO_CC2650
	help
	 Enable pin multiplexer for CC2650 SoC.

	 For hardware reasons, the pinmux depends on the GPIO module
	 being activated; it must initialize *before* the pinmux does.
	 Please take care that the pinmux init priority value is *lower*
	 that the GPIO driver init priority.
```

## drivers/pinmux/Kconfig.esp32
```kconfig
# ESP32 Pin mux configuration options

# Copyright (c) 2017 Intel Corporation
# SPDX-License-Identifier: Apache-2.0

config PINMUX_ESP32
	bool "ESP32 Pin multiplexer driver"
	depends on SOC_ESP32
	help
	  Enable driver for ESP32 Pin multiplexer.
```

## drivers/pinmux/Kconfig.fe310
```kconfig
# Kconfig.fe310 - PINMUX configuration options for SiFive Freedom E310 SOC
#
# Copyright (c) 2017 Jean-Paul Etienne <fractalclone@gmail.com>
#
# SPDX-License-Identifier: Apache-2.0
#

menuconfig PINMUX_FE310
	bool "SiFive Freedom E310 SOC pinmux driver"
	depends on PINMUX && SOC_SERIES_RISCV32_FE310
	help
	  Enable driver for the SiFive Freedom E310 SOC pinmux driver

if PINMUX_FE310

config PINMUX_FE310_0_NAME
	string "FE310 pinmux 0 driver name"
	default "pinmux0"

endif # PINMUX_FE310
```

## drivers/pinmux/Kconfig.gr716
```kconfig
# Copyright (c) 2021 Cobham Gaisler AB
# SPDX-License-Identifier: Apache-2.0

config PINMUX_GR716
	bool "GR716 Pinmux driver"
	depends on SOC_GR716A
	help
	  Enable the GR716 pinmux driver.
```

## drivers/pinmux/Kconfig.hsdk
```kconfig
#
# Copyright (c) 2019 Synopsys, Inc. All rights reserved.
#
# SPDX-License-Identifier: Apache-2.0
#

config PINMUX_HSDK
	bool "ARC HSDK I/O pin mux driver"
	depends on SOC_ARC_HSDK
	help
	  Enable driver for ARC HSDK I/O pin mux.
```

## drivers/pinmux/Kconfig.intel_s1000
```kconfig
#
# Copyright (c) 2018 Intel Corporation
#
# SPDX-License-Identifier: Apache-2.0
#

config PINMUX_INTEL_S1000
	bool "Intel S1000 I/O multiplexer driver"
	depends on SOC_INTEL_S1000
	help
	  Enable driver for Intel S1000 I/O multiplexer.
```

## drivers/pinmux/Kconfig.it8xxx2
```kconfig
# Copyright (c) 2020 ITE Corporation. All Rights Reserved.
# SPDX-License-Identifier: Apache-2.0

menuconfig PINMUX_ITE_IT8XXX2
	bool "IT8XXX2 pinmux driver"
	help
	  Enable driver for the IT8XXX2 pinmux driver

config PINMUX_ITE_IT8XXX2_NAME
	string "IT8XXX2 pinmux driver name"
	default "PINMUX"
	depends on PINMUX_ITE_IT8XXX2
```

## drivers/pinmux/Kconfig.k64
```kconfig
# Kconfig.k64 - K64 PINMUX configuration options
#
#
# Copyright (c) 2016 Intel Corporation
# Copyright (c) 2016 Wind River Systems, Inc.
#
# Licensed under the Apache License, Version 2.0 (the "License");
# you may not use this file except in compliance with the License.
# You may obtain a copy of the License at
#
#     http://www.apache.org/licenses/LICENSE-2.0
#
# Unless required by applicable law or agreed to in writing, software
# distributed under the License is distributed on an "AS IS" BASIS,
# WITHOUT WARRANTIES OR CONDITIONS OF ANY KIND, either express or implied.
# See the License for the specific language governing permissions and
# limitations under the License.
#

menuconfig PINMUX_K64
	bool "Freescale K64-based Pin multiplexer driver"
	depends on PINMUX && SOC_MK64F12
	default n
	help
	Enable driver for Freescale K64-based Pin multiplexer.

if PINMUX_K64

config PINMUX_K64_GPIO_A_NAME
	string "Name of the Port A GPIO"
	depends on PINMUX_K64 && GPIO_K64
	default "GPIO_A"
	help
	The name of the Port A GPIO referred to as PTA0..PTA31.

config PINMUX_K64_GPIO_B_NAME
	string "Name of the Port B GPIO"
	depends on PINMUX_K64 && GPIO_K64
	default "GPIO_B"
	help
	The name of the Port B GPIO referred to as PTB0..PTB31.

config PINMUX_K64_GPIO_C_NAME
	string "Name of the Port C GPIO"
	depends on PINMUX_K64 && GPIO_K64
	default "GPIO_C"
	help
	The name of the Port C GPIO referred to as PTC0..PTC31.

config PINMUX_K64_GPIO_D_NAME
	string "Name of the Port D GPIO"
	depends on PINMUX_K64 && GPIO_K64
	default "GPIO_D"
	help
	The name of the Port D GPIO referred to as PTD0..PTD31.

config PINMUX_K64_GPIO_E_NAME
	string "Name of the Port E GPIO"
	depends on PINMUX_K64 && GPIO_K64
	default "GPIO_E"
	help
	The name of the Port E GPIO referred to as PTE0..PTE31.

endif # PINMUX_K64
```

## drivers/pinmux/Kconfig.ksdk
```kconfig
# Kconfig - Kinetis SDK pinmux
#
# Copyright (c) 2016, Freescale Semiconductor, Inc.
#
# Licensed under the Apache License, Version 2.0 (the "License");
# you may not use this file except in compliance with the License.
# You may obtain a copy of the License at
#
#     http://www.apache.org/licenses/LICENSE-2.0
#
# Unless required by applicable law or agreed to in writing, software
# distributed under the License is distributed on an "AS IS" BASIS,
# WITHOUT WARRANTIES OR CONDITIONS OF ANY KIND, either express or implied.
# See the License for the specific language governing permissions and
# limitations under the License.
#

menuconfig PINMUX_KSDK
	bool "KSDK pinmux driver"
	depends on HAS_KSDK
	default n
	help
	  Enable the KSDK pinmux driver.

if PINMUX_KSDK

config PINMUX_KSDK_PORTA
	bool "Port A"
	default n
	help
	  Enable Port A.

config PINMUX_KSDK_PORTA_NAME
	string "Pinmux Port A driver name"
	depends on PINMUX_KSDK_PORTA
	default "porta"

config PINMUX_KSDK_PORTB
	bool "Port B"
	default n
	help
	  Enable Port B.

config PINMUX_KSDK_PORTB_NAME
	string "Pinmux Port B driver name"
	depends on PINMUX_KSDK_PORTB
	default "portb"

config PINMUX_KSDK_PORTC
	bool "Port C"
	default n
	help
	  Enable Port C.

config PINMUX_KSDK_PORTC_NAME
	string "Pinmux Port C driver name"
	depends on PINMUX_KSDK_PORTC
	default "portc"

config PINMUX_KSDK_PORTD
	bool "Port D"
	default n
	help
	  Enable Port D.

config PINMUX_KSDK_PORTD_NAME
	string "Pinmux Port D driver name"
	depends on PINMUX_KSDK_PORTD
	default "portd"

config PINMUX_KSDK_PORTE
	bool "Port E"
	default n
	help
	  Enable Port E.

config PINMUX_KSDK_PORTE_NAME
	string "Pinmux Port E driver name"
	depends on PINMUX_KSDK_PORTE
	default "porte"

endif # PINMUX_KSDK
```

## drivers/pinmux/Kconfig.lpc11u6x
```kconfig
# Copyright (c) 2020 2020 Seagate Technology LLC
# SPDX-License-Identifier: Apache-2.0

config PINMUX_LPC11U6X
	bool "Pinmux driver for NXP LPC11U6X MCUs"
	depends on SOC_SERIES_LPC11U6X
	default y
	help
	  Enable pinmux driver for NXP LPC11U6X MCUs.
```

## drivers/pinmux/Kconfig.mcux
```kconfig
# MCUXpresso SDK pinmux

# Copyright (c) 2016, Freescale Semiconductor, Inc.
# SPDX-License-Identifier: Apache-2.0

config PINMUX_MCUX
	bool "MCUX pinmux driver"
	depends on HAS_MCUX
	help
	  Enable the MCUX pinmux driver.
```

## drivers/pinmux/Kconfig.mcux_lpc
```kconfig
# MCUXpresso SDK pinmux for LPC

# Copyright (c) 2017, NXP
# SPDX-License-Identifier: Apache-2.0

config PINMUX_MCUX_LPC
	bool "MCUX LPC pinmux driver"
	depends on HAS_MCUX
	help
	  Enable the MCUX LPC pinmux driver.
```

## drivers/pinmux/Kconfig.mcux_rt
```kconfig
# MCUXpresso SDK pinmux for RT

# Copyright (c) 2021, NXP
# SPDX-License-Identifier: Apache-2.0

config PINMUX_MCUX_RT
	bool "MCUX RT pinmux driver"
	depends on SOC_SERIES_IMX_RT
	help
	  Enable the MCUX RT pinmux driver.
```

## drivers/pinmux/Kconfig.npcx
```kconfig
# NPCX PINMUX driver configuration options

# Copyright (c) 2020 Nuvoton Technology Corporation.
# SPDX-License-Identifier: Apache-2.0

config PINMUX_NPCX
	bool "Nuvoton NPCX embedded controller (EC) pinmux driver"
	depends on SOC_FAMILY_NPCX
	help
	  This option enables the pin-mux driver for NPCX family
	  of processors.
	  Say y if you wish to use pin-mux module on NPCX MCU.
```

## drivers/pinmux/Kconfig.rv32m1
```kconfig
# RV31M1 SDK pinmux

# Copyright (c) 2018 Foundries.io
# SPDX-License-Identifier: Apache-2.0

config PINMUX_RV32M1
	bool "RV32M1 pinmux driver"
	depends on SOC_OPENISA_RV32M1_RISCV32
	help
	  Enable the RV32M1 pinmux driver.
```

## drivers/pinmux/Kconfig.sam0
```kconfig
# Kconfig.sam0 - Atmel SAM0 pinmux configuration options
#
# Copyright (c) 2018 Google LLC.
# SPDX-License-Identifier: Apache-2.0

config PINMUX_SAM0
	bool "Atmel SAM0 pin multiplexer driver"
	default y
	depends on SOC_FAMILY_SAM0
	help
	  Enable support for the Atmel SAM0 PORT pin multiplexer.
```

## drivers/pinmux/Kconfig.sifive
```kconfig
# PINMUX configuration options for SiFive Freedom SOC

# Copyright (c) 2017 Jean-Paul Etienne <fractalclone@gmail.com>
# SPDX-License-Identifier: Apache-2.0

config PINMUX_SIFIVE
	bool "SiFive Freedom SOC pinmux driver"
	depends on SOC_SERIES_RISCV_SIFIVE_FREEDOM
	help
	  Enable driver for the SiFive Freedom SOC pinmux driver
```

## drivers/pinmux/Kconfig.stm32
```kconfig
# Configuration for STM32 pinmux

# Copyright (c) 2016 Open-RnD Sp. z o.o.
# SPDX-License-Identifier: Apache-2.0

config PINMUX_STM32
	bool "Pinmux driver for STM32 MCUs"
	depends on SOC_FAMILY_STM32
	help
	  Enable pin multiplexer for STM32 MCUs

config PINMUX_STM32_REMAP_INIT_PRIORITY
	int "Remap initialization priority"
	default 2
	help
	  Initialization priority for the routine in charge of configuring the
	  remap for pins PA11/12.
```

## drivers/pinmux/Kconfig.xec
```kconfig
# Microchip XEC pinmux configuration options

# Copyright (c) 2019 Intel Corporation
# SPDX-License-Identifier: Apache-2.0

config PINMUX_XEC
	bool "XEC Microchip Pinmux driver"
	depends on SOC_FAMILY_MEC
	help
	  Enable the Microchip XEC pinmux driver.
```

## drivers/pinmux/dev/Kconfig
```kconfig
# Kconfig - Pinmux Dev configuration options

#
# Copyright (c) 2016 Intel Corporation
#
# SPDX-License-Identifier: Apache-2.0
#

config PINMUX_DEV
	bool "Configure pinmux for early board testing"
	depends on PINMUX
	default n
	help
	Enables the use of the pinmux_set and pinmux_get functions for early
	prototyping on new hardware.  WARNING: When using these options, it
	is possible to permanently damage the hardware.

config PINMUX_DEV_NAME
	string "Configure pinmux for early board testing"
	depends on PINMUX_DEV
	default "PINMUX_DEV"
	help
	The name of the pinmux dev driver.

config PINMUX_DEV_ATMEL_SAM3X
	bool "Enable pinmux dev driver for Atmel SAM3X boards"
	depends on PINMUX_DEV && SOC_SERIES_SAM3X
	help
	Enables the pinmux dev driver for boards based on the
	Atmel SAM3X family of microcontrollers.
	default n

config PINMUX_DEV_STM32
	bool "Enable pinmux dev driver for the ST STM32 family."
	depends on PINMUX_DEV && SOC_FAMILY_STM32
	help
	Enables the STM32 pinmux dev driver.
	default n

config PINMUX_DEV_ARM_V2M_BEETLE
	bool "Enable pinmux dev driver for ARM V2M Beetle boards"
	depends on PINMUX_DEV && SOC_SERIES_BEETLE
	help
	Enables the pinmux dev driver for boards based on the
	ARM Beetle SoC MCUs.
	default n
```

## drivers/pinmux/dev/Kconfig.ksdk
```kconfig
# Kconfig - Kinetis SDK pinmux dev
#
# Copyright (c) 2016, Freescale Semiconductor, Inc.
#
# Licensed under the Apache License, Version 2.0 (the "License");
# you may not use this file except in compliance with the License.
# You may obtain a copy of the License at
#
#     http://www.apache.org/licenses/LICENSE-2.0
#
# Unless required by applicable law or agreed to in writing, software
# distributed under the License is distributed on an "AS IS" BASIS,
# WITHOUT WARRANTIES OR CONDITIONS OF ANY KIND, either express or implied.
# See the License for the specific language governing permissions and
# limitations under the License.
#

menuconfig PINMUX_DEV_KSDK
	bool "KSDK pinmux dev driver"
	depends on PINMUX_DEV && PINMUX_KSDK
	default n
	help
	  Enable the KSDK pinmux dev driver.

if PINMUX_DEV_KSDK

config PINMUX_DEV_KSDK_PORTA_NAME
	string "Pinmux Dev Port A driver name"
	depends on PINMUX_KSDK_PORTA
	default "pinmux_dev_porta"

config PINMUX_DEV_KSDK_PORTB_NAME
	string "Pinmux Dev Port B driver name"
	depends on PINMUX_KSDK_PORTB
	default "pinmux_dev_portb"

config PINMUX_DEV_KSDK_PORTC_NAME
	string "Pinmux Dev Port C driver name"
	depends on PINMUX_KSDK_PORTC
	default "pinmux_dev_portc"

config PINMUX_DEV_KSDK_PORTD_NAME
	string "Pinmux Dev Port D driver name"
	depends on PINMUX_KSDK_PORTD
	default "pinmux_dev_portd"

config PINMUX_DEV_KSDK_PORTE_NAME
	string "Pinmux Dev Port E driver name"
	depends on PINMUX_KSDK_PORTE
	default "pinmux_dev_porte"

endif # PINMUX_DEV_KSDK
```

## drivers/pm_cpu_ops/Kconfig
```kconfig
# CPU power management driver configuration options

# Copyright (c) 2021 Carlo Caione <ccaione@baylibre.com>
# SPDX-License-Identifier: Apache-2.0

menuconfig PM_CPU_OPS
	bool "CPU power management drivers"
	help
	  Enable CPU power management drivers configuration

if PM_CPU_OPS

module = PM_CPU_OPS
module-str = pm_cpu_ops
source "subsys/logging/Kconfig.template.log_config"

config PM_CPU_OPS_HAS_DRIVER
	bool

config PM_CPU_OPS_PSCI
	bool "Support for the ARM Power State Coordination Interface (PSCI)"
	default y
	depends on DT_HAS_ARM_PSCI_0_2_ENABLED || DT_HAS_ARM_PSCI_1_1_ENABLED
	select PM_CPU_OPS_HAS_DRIVER
	select HAS_POWEROFF
	help
	  Say Y here if you want Zephyr to communicate with system firmware
	  implementing the PSCI specification for CPU-centric power
	  management operations described in ARM document number ARM DEN
	  0022A ("Power State Coordination Interface System Software on
	  ARM processors").

config PSCI_SHELL
	bool "Support for PSCI interface shell commands"
	default y
	depends on SHELL && PM_CPU_OPS_PSCI
	help
	  Say Y here if you need to enable PSCI interface shell commands
	  like 'warm' and 'cold' reset commands.

endif
```

## drivers/power/Kconfig
```kconfig
# Copyright (c) 2024 Nordic Semiconductor
# SPDX-License-Identifier: Apache-2.0

config POWER
	bool "Enable power driver support"

if POWER

rsource "Kconfig.nrf"

endif # POWER
```

## drivers/power/Kconfig.nrf
```kconfig
# Copyright (c) 2024 Nordic Semiconductor
# SPDX-License-Identifier: Apache-2.0

config POWER_NRF
	bool "Enable nrf power driver support"
	default y
	depends on DT_HAS_NORDIC_NRF_POWER_ENABLED
	select NRFX_POWER
```
