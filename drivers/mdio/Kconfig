## drivers/mdio/Kconfig
```kconfig
# MDIO configuration options

# Copyright (c) 2021 IP-Logix Inc.
# SPDX-License-Identifier: Apache-2.0

#
# MDIO options
#
menuconfig MDIO
	bool "Management Data Input/Output (MDIO) drivers"
	help
	  Enable MDIO Driver Configuration

if MDIO

config MDIO_SHELL
	bool "MDIO Shell"
	depends on SHELL
	help
	  Enable MDIO Shell.

	  The MDIO shell currently supports scanning and device
	  read/write.

# Include these first so that any properties (e.g. defaults) below can be
# overridden (by defining symbols in multiple locations)
source "drivers/mdio/Kconfig.esp32"
source "drivers/mdio/Kconfig.sam"
source "drivers/mdio/Kconfig.nxp_imx_netc"
source "drivers/mdio/Kconfig.nxp_s32_netc"
source "drivers/mdio/Kconfig.nxp_s32_gmac"
source "drivers/mdio/Kconfig.adin2111"
source "drivers/mdio/Kconfig.gpio"
source "drivers/mdio/Kconfig.litex"
source "drivers/mdio/Kconfig.nxp_enet"
source "drivers/mdio/Kconfig.stm32_hal"
source "drivers/mdio/Kconfig.xmc4xxx"
source "drivers/mdio/Kconfig.nxp_enet_qos"
source "drivers/mdio/Kconfig.dwcxgmac"
source "drivers/mdio/Kconfig.renesas_ra"
source "drivers/mdio/Kconfig.lan865x"

config MDIO_INIT_PRIORITY
	int "Init priority"
	default 60
	help
	  MDIO device driver initialization priority.


module = MDIO
module-str = mdio
source "subsys/logging/Kconfig.template.log_config"

endif # MDIO
```

## drivers/mdio/Kconfig.dwcxgmac
```kconfig
# Copyright (c) 2023 Intel Corporation
# SPDX-License-Identifier: Apache-2.0

config MDIO_DWCXGMAC
	bool "synopsys mdio driver"
	depends on ETH_DWC_XGMAC
	default y
	help
		Enable Synopsys dwc xgmac MDIO driver.

if  MDIO_DWCXGMAC

config MDIO_DWCXGMAC_STATUS_BUSY_CHECK_TIMEOUT
	int "A timeout value in us to check software reset status"
	default 10000
	help
	  "A timeout value in ms to check software reset status"

endif
```

## drivers/mdio/Kconfig.esp32
```kconfig
# Copyright (c) 2022 Grant Ramsay <grant.ramsay@hotmail.com>
# SPDX-License-Identifier: Apache-2.0

config MDIO_ESP32
	bool "ESP32 MDIO driver"
	default y
	depends on SOC_SERIES_ESP32
	depends on DT_HAS_ESPRESSIF_ESP32_MDIO_ENABLED
	help
	  Enable ESP32 MCU Family MDIO driver.
```

## drivers/mdio/Kconfig.gpio
```kconfig
# Copyright (c) 2023, Aleksandr Senin
# SPDX-License-Identifier: Apache-2.0

config MDIO_GPIO
	bool "GPIO bitbang MDIO controller driver"
	default y
	depends on DT_HAS_ZEPHYR_MDIO_GPIO_ENABLED
	help
	  Enable software driven (bit banging) MDIO support using GPIO pins
```

## drivers/mdio/Kconfig.i2c
```kconfig
# Copyright The Zephyr Project Contributors
# SPDX-License-Identifier: Apache-2.0

config MDIO_I2C
	bool "I2C MDIO controller driver"
	default y
	depends on DT_HAS_ZEPHYR_MDIO_I2C_ENABLED
	help
	  Enable I2C MDIO controller driver.
	  This driver is used to communicate with MDIO devices over I2C.
```

## drivers/mdio/Kconfig.intel_igc
```kconfig
# Copyright 2025 Intel Corporation
# SPDX-License-Identifier: Apache-2.0

menuconfig MDIO_INTEL_IGC
	bool "Intel IGC MDIO driver"
	default y
	depends on DT_HAS_INTEL_IGC_MDIO_ENABLED
	help
	  Enable Intel IGC MDIO driver.

if MDIO_INTEL_IGC

config MDIO_INTEL_BUSY_CHECK_TIMEOUT
	int "MDIO_INTEL_IGC busy wait timeout"
	default 10000
	help
	  This timeout in microseconds, specifies the duration to wait for the
	  completion of an MDIO read or write cycle.

endif # MDIO_INTEL_IGC
```

## drivers/mdio/Kconfig.lan865x
```kconfig
# Copyright 2024 Microchip Technology Inc
# SPDX-License-Identifier: Apache-2.0

config MDIO_LAN865X
	bool "LAN865X MDIO driver"
	default y
	depends on DT_HAS_MICROCHIP_LAN865X_MDIO_ENABLED
	depends on ETH_LAN865X
	help
	  Enable LAN865X MDIO driver.
```

## drivers/mdio/Kconfig.mchp
```kconfig
# Copyright (c) 2025 Microchip Technology Inc.
# SPDX-License-Identifier: Apache-2.0

config MDIO_MCHP_GMAC_G1
	bool "Microchip MDIO driver"
	depends on ETH_MCHP_GMAC
	default y
	help
	  Enable Microchip MCU Family MDIO driver.
```

## drivers/mdio/Kconfig.mcux
```kconfig
# Copyright (c) 2021 Bernhard Kraemer
# SPDX-License-Identifier: Apache-2.0

config MDIO_NXP_MCUX
	bool "NXP MCUX MDIO driver"
	depends on ETH_MCUX
	default y
	help
	  Enable NXP MCUX MDIO driver.
```

## drivers/mdio/Kconfig.nxp_enet
```kconfig
# Copyright 2023 NXP
# SPDX-License-Identifier: Apache-2.0

config MDIO_NXP_ENET
	bool "NXP ENET MDIO Driver"
	default y
	depends on DT_HAS_NXP_ENET_MDIO_ENABLED
	select PINCTRL
	help
	  Enable NXP ENET MDIO Driver. This Kconfig can be disabled manually
	  if all ethernet PHYs being used with ENET are not managed by MDIO bus.

if MDIO_NXP_ENET

config MDIO_NXP_ENET_TIMEOUT
	int "NXP ENET MDIO Timeout time"
	default 250
	help
	  Time in microseconds before an MDIO transaction that has not
	  finished is considered to have timed out.

endif # MDIO_NXP_ENET
```

## drivers/mdio/Kconfig.nxp_s32
```kconfig
# Copyright 2022 NXP
# SPDX-License-Identifier: Apache-2.0

config MDIO_NXP_S32_NETC
	bool "NXP S32 NETC External MDIO driver"
	default y
	depends on DT_HAS_NXP_S32_NETC_EMDIO_ENABLED
	select NOCACHE_MEMORY
	help
	  Enable NETC External MDIO Controller driver for NXP S32 SoCs.
```

## drivers/mdio/Kconfig.pic32cxsg
```kconfig
# Copyright (c) 2024 Microchip
# SPDX-License-Identifier: Apache-2.0

config MDIO_MICROCHIP_PIC32CXSG
	bool "Microchip PIC32CXSG MDIO driver"
	depends on ETH_PIC32CXSG_GMAC
	default y
	help
	  Enable Microchip PIC32CXSG MCU Family MDIO driver.
```

## drivers/mdio/Kconfig.renesas_ra
```kconfig
# Copyright (c) 2024-2025 Renesas Electronics Corporation
# SPDX-License-Identifier: Apache-2.0

config MDIO_RENESAS_RA
	bool "RENESAS MDIO controller driver"
	default y
	depends on DT_HAS_RENESAS_RA_MDIO_ENABLED
	select PINCTRL
	select USE_RA_FSP_ETHER_PHY
	help
	  Enable RENESAS MDIO support.

config MDIO_RENESAS_RA_RMAC
	bool "RENESAS MDIO RMAC controller driver"
	default y
	depends on DT_HAS_RENESAS_RA_MDIO_RMAC_ENABLED
	select PINCTRL
	select USE_RA_FSP_RMAC_PHY
	help
	  Enable RENESAS MDIO RMAC support.

if MDIO_RENESAS_RA_RMAC

config MDIO_RENESAS_RA_RMAC_MDIO_HOLD_NS
	int "MDIO hold time"
	default 0
	help
	  Time for changing MDO after rising edge of MDC in nanoseconds.
	  This value depends on PHY chip AC Characteristics. Use 0 to disable.

config MDIO_RENESAS_RA_RMAC_MDIO_CAPTURE_NS
	int "MDIO capture time"
	default 0
	help
	  Time for capturing MDI after rising edge of MDC in nanoseconds.
	  This value depends on PHY chip AC Characteristics. Use 0 to disable.

endif
```

## drivers/mdio/Kconfig.sam
```kconfig
# Copyright (c) 2021 IP-Logix Inc.
# SPDX-License-Identifier: Apache-2.0

config MDIO_ATMEL_SAM
	bool "Atmel SAM MDIO driver"
	depends on ETH_SAM_GMAC
	default y
	help
	  Enable Atmel SAM MCU Family MDIO driver.
```

## drivers/mdio/Kconfig.stm32_hal
```kconfig
# Copyright (c) 2024 BayLibre, SAS
# Copyright (c) 2024 Analog Devices Inc.
# SPDX-License-Identifier: Apache-2.0

config MDIO_ST_STM32_HAL
	bool "STM32 MDIO controller driver"
	default y
	depends on DT_HAS_ST_STM32_MDIO_ENABLED
	depends on ETH_STM32_HAL
	select PINCTRL
	help
	  Enable STM32 MDIO support.
```

## drivers/mdio/Kconfig.sy1xx
```kconfig
# Copyright (c) 2024 sensry.io
# SPDX-License-Identifier: Apache-2.0

config MDIO_SENSRY_SY1XX
	bool "Sensry SY1XX MDIO driver"
	select PINCTRL
	depends on DT_HAS_SENSRY_SY1XX_MDIO_ENABLED
	default y
	help
	  Enable Sensry SY1xx SOC Family MDIO driver.
```

## drivers/mdio/Kconfig.xlnx_gem
```kconfig
# Copyright (c) 2025 Immo Birnbaum
# SPDX-License-Identifier: Apache-2.0

config MDIO_XLNX_GEM
	bool "Xilinx GEM MDIO controller driver"
	default y
	depends on DT_HAS_XLNX_GEM_MDIO_ENABLED
	help
	  Enable Xilinx GEM MDIO support.

if MDIO_XLNX_GEM

config MDIO_XLNX_GEM_MAX_POLL_RETRIES
	int "Poll MDIO transaction completion max. retries"
	default 10
	help
	  The number of times the completion of an MDIO
	  transaction is polled before it is considered
	  timed out.

config MDIO_XLNX_GEM_POLL_DELAY
	int "Poll MDIO transaction completion delay"
	default 50
	help
	  Delay in microseconds between two MDIO transaction
	  completion polling operations.

endif # MDIO_XLNX_GEM
```

## drivers/mdio/Kconfig.xmc4xxx
```kconfig
# Copyright (c) 2023 SLB
# SPDX-License-Identifier: Apache-2.0

config MDIO_INFINEON_XMC4XXX
	bool "Infineon XMC4XXX MDIO driver"
	default y
	depends on DT_HAS_INFINEON_XMC4XXX_MDIO_ENABLED
	help
	  Enable Infineon XMC4XXX MDIO driver.
```

## drivers/memc/Kconfig
```kconfig
# Memory controller configuration options

# Copyright (c) 2020 Teslabs Engineering S.L.
# SPDX-License-Identifier: Apache-2.0

menuconfig MEMC
	bool "Memory controller drivers [EXPERIMENTAL]"
	select EXPERIMENTAL
	help
	  Add support for memory controllers

if MEMC

config MEMC_INIT_PRIORITY
	int "Initialization priority"
	default 80 if MSPI
	default 0
	help
	  Memory controllers initialization priority.

source "drivers/memc/Kconfig.*"

module = MEMC
module-str = memc
source "subsys/logging/Kconfig.template.log_config"

endif
```

## drivers/memc/Kconfig.bflb
```kconfig
# Copyright (c) 2025 MASSDRIVER EI (massdriver.space)
# SPDX-License-Identifier: Apache-2.0

config MEMC_BFLB_BL61X
	bool "Bouffalolab BL61x PSRAM Controller"
	default y
	depends on DT_HAS_BFLB_BL61X_PSRAM_ENABLED
	depends on OTP_BFLB
	depends on CLOCK_CONTROL
	help
	  Enable Bouffalolab BL61x PSRAM Controller.

config MEMC_BFLB_BL808_PSRAM_UHS
	bool "Bouffalolab BL808 UHS PSRAM Controller"
	default y
	depends on DT_HAS_BFLB_BL808_PSRAM_UHS_CONTROLLER_ENABLED
	depends on CLOCK_CONTROL
	help
	  Enable Bouffalolab BL808 UHS PSRAM Controller.
```

## drivers/memc/Kconfig.max32_hpb
```kconfig
# Copyright (c) 2025 Analog Devices, Inc
# SPDX-License-Identifier: Apache-2.0

config MEMC_MAX32_HPB
	bool "MAX32 HyperBus"
	default y
	depends on DT_HAS_ADI_MAX32_HPB_ENABLED
	select PINCTRL
	help
	  Enable ADI MAX32 HyperBus controller.

	  If you want to rely on the linker to place symbols in this memory
	  (using`zephyr_code_relocate() or Z_GENERIC_SECTION()), you have to
	  ensure this driver in initialized before KERNEL_INIT_PRIORITY_OBJECTS
	  (=30). In addition, this driver depends on a clock, so you have to
	  ensure the clock will be started before this driver as well (see
	  CLOCK_CONTROL_INIT_PRIORITY)
```

## drivers/memc/Kconfig.mcux
```kconfig
# Copyright 2020-2023, 2025 NXP
# Copyright (c) 2021 Basalte bv
# Copyright (c) 2023, ithinx GmbH
# Copyright (c) 2023, Tonies GmbH
# SPDX-License-Identifier: Apache-2.0

if DT_HAS_NXP_IMX_FLEXSPI_ENABLED

config MEMC_MCUX_FLEXSPI_W956A8MBYA
	bool "MCUX FlexSPI Winbond W956A8MBYA HyperRAM driver"
	default y
	depends on DT_HAS_NXP_IMX_FLEXSPI_W956A8MBYA_ENABLED
	select MEMC_MCUX_FLEXSPI

config MEMC_MCUX_FLEXSPI_S27KS0641
	bool "MCUX FlexSPI Cypress S27KS0641 HyperRAM driver"
	default y
	depends on DT_HAS_NXP_IMX_FLEXSPI_S27KS0641_ENABLED
	select MEMC_MCUX_FLEXSPI

config MEMC_MCUX_FLEXSPI_APS6408L
	bool "MCUX FlexSPI AP Memory APS6408L pSRAM driver"
	default y
	depends on DT_HAS_NXP_IMX_FLEXSPI_APS6408L_ENABLED
	select MEMC_MCUX_FLEXSPI

config MEMC_MCUX_FLEXSPI_IS66WVQ8M4
	bool "MCUX FlexSPI ISSI IS66WVQ8M4 pSRAM driver"
	default y
	depends on DT_HAS_NXP_IMX_FLEXSPI_IS66WVQ8M4_ENABLED
	select MEMC_MCUX_FLEXSPI

config MEMC_MCUX_FLEXSPI_APS6404L
	bool "MCUX FlexSPI AP Memory APS6404L pSRAM driver"
	default y
	depends on DT_HAS_NXP_IMX_FLEXSPI_APS6404L_ENABLED
	select MEMC_MCUX_FLEXSPI

config MEMC_MCUX_FLEXSPI_INIT_PRIORITY
	int "MCUX FLEXSPI MEMC driver initialization priority"
	default MEMC_INIT_PRIORITY
	help
	  Initialization priority for FlexSPI MEMC driver. In cases where the
	  flash driver must initialize before the MEMC RAM driver,
	  initialization priorities can be set such that
	  MEMC_MCUX_FLEXSPI_INIT_PRIORITY < FLASH_INIT_PRIORITY <
	  MEMC_INIT_PRIORITY

config MEMC_MCUX_FLEXSPI_INIT_XIP
	bool "Initialize FLEXSPI when using device for XIP"
	help
	  Initialize the FLEXSPI device even when using it for XIP. If this
	  Kconfig is enabled, the user must ensure that the pin control
	  state used does not reconfigure the pins used to interface with
	  the flash device used for XIP, and that the configuration settings
	  used for the FLEXSPI are compatible with those needed for XIP from
	  the flash device.

config FLASH_MCUX_FLEXSPI_FORCE_USING_OVRDVAL
	bool "Force using the FLEXSPI Target Clock Delay Line Override Value"
	help
	  Enable this setting to force using a specific raw value for the OVRDVAL
	  field in the DLLCR registers.

	  This option gives more granularity than the 'data-valid-time' field in
	  the dts. The unit of 'data-valid-time' is nanoseconds while the unit of
	  OVRDVAL are raw delay cells.

	  Normally the 'data-valid-time' on any 'nxp,imx-flexspi-device' device
	  will set the OVRDVAL and OVRDEN fields in the DLLCR register
	  but works only when the 'rx-clock-source' is configured to '#0 External
	  input from DQS pad' and the frequency <= 100MHz.

config FLASH_MCUX_FLEXSPI_OVRDVAL
	int "FLEXSPI Target Clock Delay Line Override Value"
	range 0 63
	default 27
	depends on FLASH_MCUX_FLEXSPI_FORCE_USING_OVRDVAL
	help
	  Raw value to be stored in the DDLCR->OVRDVAL field.

config MEMC_MCUX_FLEXSPI
	bool
	select PINCTRL

# Avoid RWW hazards by defaulting logging to disabled
choice MEMC_LOG_LEVEL_CHOICE
	default MEMC_LOG_LEVEL_OFF if FLASH_MCUX_FLEXSPI_XIP
endchoice

endif # DT_HAS_NXP_IMX_FLEXSPI_ENABLED

if DT_HAS_NXP_XSPI_PSRAM_ENABLED

config MEMC_MCUX_XSPI_INIT_XIP
	bool "Initialize XSPI when using device for XIP"
	help
	  Initialize the XSPI device even when using it for XIP. If this
	  Kconfig is enabled, the user must ensure that the pin control
	  state used does not reconfigure the pins used to interface with
	  the flash device used for XIP, and that the configuration settings
	  used for the XSPI are compatible with those needed for XIP from
	  the flash device.

config MEMC_MCUX_XSPI_PSRAM
	bool "MCUX XSPI psram driver"
	default y
	select MEMC_MCUX_XSPI
	help
	  Enable the mcux xspi psram driver.

config MEMC_MCUX_XSPI
	bool
	select PINCTRL

endif # DT_HAS_NXP_XSPI_PSRAM_ENABLED
```

## drivers/memc/Kconfig.mspi
```kconfig
# Copyright (c) 2025, Ambiq Micro Inc. <www.ambiq.com>
# SPDX-License-Identifier: Apache-2.0

menu "MSPI MEMC device driver"

config MEMC_MSPI
	bool
	select MSPI
	help
	  MSPI MEMC drivers are enabled.

config MEMC_MSPI_APS6404L
	bool "MSPI AP Memory APS6404L pSRAM driver"
	default y
	depends on DT_HAS_MSPI_APS6404L_ENABLED
	select MEMC_MSPI
	select MSPI_AMBIQ_CONTROLLER if SOC_FAMILY_AMBIQ

config MEMC_MSPI_APS_Z8
	bool "MSPI AP Memory gen Z8 pSRAM driver"
	default y
	depends on DT_HAS_MSPI_APS_Z8_ENABLED
	select MEMC_MSPI
	select MSPI_AMBIQ_CONTROLLER if SOC_FAMILY_AMBIQ

endmenu
```

## drivers/memc/Kconfig.nxp_s32
```kconfig
# Copyright 2023 NXP
# SPDX-License-Identifier: Apache-2.0

config MEMC_NXP_S32_QSPI
	bool "NXP S32 Quad Serial Peripheral Interface (QSPI) controller"
	default y
	depends on DT_HAS_NXP_S32_QSPI_ENABLED
	select PINCTRL
	help
	  Enable NXP S32 Quad Serial Peripheral Interface (QSPI) controller.
```

## drivers/memc/Kconfig.nxp_s32_xspi
```kconfig
# Copyright 2025 NXP
# SPDX-License-Identifier: Apache-2.0

config MEMC_NXP_S32_XSPI
	bool "NXP S32 eXpanded Serial Peripheral Interface (XSPI) controller"
	default y
	depends on DT_HAS_NXP_S32_XSPI_ENABLED
	select PINCTRL
	help
	  Enable NXP S32 eXpanded Serial Peripheral Interface (XSPI) controller.
```
