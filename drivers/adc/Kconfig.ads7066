## drivers/adc/Kconfig.ads7066
```kconfig
# ADS7066 ADC configuration options

# Copyright (c) 2025 GE Healthcare Technologies, Inc.
# SPDX-License-Identifier: Apache-2.0

config ADC_ADS7066
	bool "TI ADS7066 16-bit 8-channel SPI ADC"
	default y
	depends on DT_HAS_TI_ADS7066_ENABLED
	select SPI
	help
	  Enable driver for TI ADS7066 16-bit 8-channel SPI ADC.

	  The driver supports all three operating modes:
	  - On-the-Fly Mode: Zero latency channel switching using SPI command bits
	  - Manual Mode: Register-based channel selection with higher latency
	  - Auto: Channels are switched automatically with the same throughput as OTF but higher latency

if ADC_ADS7066

config ADC_ADS7066_INIT_PRIORITY
	int "ADS7066 init priority"
	default 80
	help
	  ADS7066 device initialization priority must come
	  after SPI initialization.

config ADC_ADS7066_ACQUISITION_THREAD_STACK_SIZE
	int "Stack size for the ADC acquisition thread"
	default 1024
	help
	  Size of the stack used for the internal data acquisition
	  thread.

config ADC_ADS7066_ACQUISITION_THREAD_PRIO
	int "Priority for the ADC acquisition thread"
	default 0
	help
	  Priority level for the internal ADC acquisition thread.

config ADC_ADS7066_CRC
	bool "Use CRC to check data sent to and received from the ADC"
	select CRC
	help
	  Enables the use of CRC on check integrity data to and from the ADC.

config ADC_ADS7066_CONVERSION_BUSY_WAIT
	int "Time to busy wait between SPI frames"
	default 3
	help
	  Time in microseconds that the driver will busy wait between SPI frames in order to give the
	  ADC enough time to finish the conversion.

endif # ADC_ADS7066
```

## drivers/adc/Kconfig.ads7828
```kconfig
# TI ADS7828/ADS7830 ADC configuration options

# Copyright (c) 2026 RAKwireless Technology Limited
# SPDX-License-Identifier: Apache-2.0

config ADC_ADS7828
	bool "TI ADS7828/ADS7830 I2C ADC"
	default y
	depends on DT_HAS_TI_ADS7828_ENABLED || DT_HAS_TI_ADS7830_ENABLED
	select I2C
	help
	  Enable the driver for the Texas Instruments ADS7828 12-bit and
	  ADS7830 8-bit, 8-channel I2C SAR ADCs.
```

## drivers/adc/Kconfig.ads79xx
```kconfig
# Copyright (c) 2026 James Walmsley <james@fullfat-fs.co.uk>
#
# SPDX-License-Identifier: Apache-2.0
#
config ADC_ADS79XX
	bool "TI ADS79xx-Q1 SPI ADC family"
	select SPI
	default y
	depends on DT_HAS_TI_ADS7950_ENABLED || DT_HAS_TI_ADS7951_ENABLED \
		  || DT_HAS_TI_ADS7952_ENABLED || DT_HAS_TI_ADS7953_ENABLED \
		  || DT_HAS_TI_ADS7954_ENABLED || DT_HAS_TI_ADS7955_ENABLED \
		  || DT_HAS_TI_ADS7956_ENABLED || DT_HAS_TI_ADS7957_ENABLED \
		  || DT_HAS_TI_ADS7958_ENABLED || DT_HAS_TI_ADS7959_ENABLED \
		  || DT_HAS_TI_ADS7960_ENABLED || DT_HAS_TI_ADS7961_ENABLED

if ADC_ADS79XX

config ADC_ADS79XX_INIT_PRIORITY
	int "ADS79xxx init priority"
	default 80
	help
	  ADS79xx device initialization priority must come
	  after SPI initialization

config ADC_ADS79XX_ACQUISITION_THREAD_STACK_SIZE
	int "Stack size for the ADC data acquisition thread"
	default 512
	help
	  Size of the stack used for the internal data acquisition
	  thread.

config ADC_ADS79XX_ACQUISITION_THREAD_PRIO
	int "Priority for the ADC data acquisition thread"
	default 0
	help
	  Priority level for the internal ADC data acquisition thread.

config ADC_ADS79XX_DEBUG_SPI_TRANSFERS
	bool "Extra debug of low-level SPI transfers"

endif # ADC_ADS79XX
```

## drivers/adc/Kconfig.ambiq
```kconfig
# SPDX-License-Identifier: Apache-2.0
#
# Copyright (c) 2023 Ambiq Micro Inc. <www.ambiq.com>

config ADC_AMBIQ
	bool "Ambiq Adc Driver"
	default y
	depends on DT_HAS_AMBIQ_ADC_ENABLED
	select AMBIQ_HAL
	select AMBIQ_HAL_USE_ADC
	select AMBIQ_HAL_USE_TIMER if SOC_SERIES_APOLLO3X
	help
	  Enables the Adc driver for Ambiq devices.

if ADC_AMBIQ

config ADC_AMBIQ_HANDLE_CACHE
	bool "Turn on cache handling in adc driver"
	default y
	depends on CACHE_MANAGEMENT && DCACHE
	help
	  Disable this if cache has been handled in upper layers.

config ADC_AMBIQ_DMA
	bool "Ambiq ADC DMA Support."
	default n
	help
	  Enable the ADC DMA mode for ADC instances
	  that enable dma channels in their device tree node.

if ADC_AMBIQ_DMA

config ADC_AMBIQ_DMA_MIN_SAMPLES
	int "Minimum number of samples to use DMA mode"
	default 64
	range 1 65535
	help
	  When DMA mode is enabled in device tree, the driver will only use DMA
	  if the total number of samples (channels × (1 + extra_samplings)) is
	  greater than or equal to this value. Otherwise, interrupt mode will be
	  used. This allows both DMA and interrupt modes to coexist based on
	  the workload size.

endif # ADC_AMBIQ_DMA

endif # ADC_AMBIQ
```

## drivers/adc/Kconfig.ameba
```kconfig
# Copyright (c) 2026 Realtek Semiconductor Corp.
# SPDX-License-Identifier: Apache-2.0

config ADC_AMEBA
	bool "Ameba ADC driver"
	default y
	depends on DT_HAS_REALTEK_AMEBA_ADC_ENABLED
	select PINCTRL
	help
	  Enable the driver implementation for the Ameba ADC
```

## drivers/adc/Kconfig.atm34
```kconfig
# ADC configuration options

# Copyright (c) 2023 Atmosic
# SPDX-License-Identifier: Apache-2.0

config ADC_ATM34
	bool "Atmosic ATM34 ADC driver"
	default y
	depends on DT_HAS_ATMOSIC_ATM34_ADC_ENABLED
	help
	  This option enables the ADC driver for ATM34
	  family of processors.
	  Support 16-bit resolution.
	  Support 11 channels: ch1~ch11.

if ADC_ATM34

config CBPRINTF_FP_SUPPORT
	default y
	bool "Enable floating point support"

config ADC_ASYNC
	default y
	bool "Enable asynchronous mode"

config ADC_CAL_REFRESH_INTERVAL
	int "Refresh interval (in ms) for gain extensions"
	default 5000
	help
	    Schedules calibration measurements to update the offset_comp* registers

endif
```

## drivers/adc/Kconfig.atmx2
```kconfig
# ADC configuration options

# Copyright (c) 2021-2023 Atmosic
# SPDX-License-Identifier: Apache-2.0

config ADC_ATMx2
	bool "Atmosic ATMx2 ADC driver"
	default y
	depends on DT_HAS_ATMOSIC_ATMX2_ADC_ENABLED
	help
	  This option enables the ADC driver for ATMx2
	  family of processors.
	  Voltage range 0 to 3300mV.
	  Support 10-bit resolution.
	  Support 10 channels: ch0~ch9.

if ADC_ATMx2

config CBPRINTF_FP_SUPPORT
	default y
	bool "Enable floating point support"

config ADC_ASYNC
	default y
	bool "Enable asynchronous mode"

endif
```

## drivers/adc/Kconfig.atmx3
```kconfig
# ADC configuration options

# Copyright (c) 2021-2023 Atmosic
# SPDX-License-Identifier: Apache-2.0

config ADC_ATMx3
	bool "Atmosic ATMx3 ADC driver"
	default y
	depends on DT_HAS_ATMOSIC_ATMX3_ADC_ENABLED
	help
	  This option enables the ADC driver for ATMx3
	  family of processors.
	  Support 11-bit resolution.
	  Support 11 channels: ch1~ch11.

if ADC_ATMx3

config CBPRINTF_FP_SUPPORT
	default y
	bool "Enable floating point support"

config ADC_ASYNC
	default y
	bool "Enable asynchronous mode"

endif
```

## drivers/adc/Kconfig.b91
```kconfig
# Copyright (c) 2022 Telink Semiconductor
# SPDX-License-Identifier: Apache-2.0

config ADC_TELINK_B91
	bool "Telink Semiconductor B91 ADC driver"
	depends on SOC_RISCV_TELINK_B91
	select ADC_CONFIGURABLE_INPUTS
	help
	  Enables Telink B91 ADC driver.

if ADC_TELINK_B91

config ADC_B91_ACQUISITION_THREAD_STACK_SIZE
	int "Stack size for the ADC data acquisition thread"
	default 512
	help
	  Size of the stack used for the internal data acquisition
	  thread.

config ADC_B91_ACQUISITION_THREAD_PRIO
	int "Priority for the ADC data acquisition thread"
	default 0
	help
	  Priority level for the internal ADC data acquisition thread.

endif # ADC_TELINK_B91
```

## drivers/adc/Kconfig.bee
```kconfig
# Copyright (c) 2026, Realtek Semiconductor Corporation
# SPDX-License-Identifier: Apache-2.0

config ADC_BEE
	bool "Realtek Bee series ADC driver"
	default y
	depends on DT_HAS_REALTEK_BEE_ADC_ENABLED
	select HAL_REALTEK_BEE_ADC
	select PINCTRL
	help
	  This option enables the ADC driver for Realtek Bee SoCs.
```

## drivers/adc/Kconfig.cc13xx_cc26xx
```kconfig
# Copyright (c) 2022 Florin Stancu <niflostancu@gmail.com>
# SPDX-License-Identifier: Apache-2.0

config ADC_CC13XX_CC26XX
	bool "CC13XX/CC26XX ADC driver"
	default y
	depends on DT_HAS_TI_CC13XX_CC26XX_ADC_ENABLED
	help
	  Enable the TI CC13XX/CC26XX ADC driver.
```

## drivers/adc/Kconfig.cc23x0
```kconfig
# Copyright (c) 2024 BayLibre, SAS
# SPDX-License-Identifier: Apache-2.0

config ADC_CC23X0
	bool "CC23X0 ADC driver"
	default y
	depends on DT_HAS_TI_CC23X0_ADC_ENABLED
	select PINCTRL
	help
	  Enable the TI CC23X0 ADC driver.

config ADC_CC23X0_DMA_DRIVEN
	bool "DMA support for TI CC23X0 ADC devices"
	depends on ADC_CC23X0
	select DMA
	help
	  DMA driven mode offloads data transfer tasks from the CPU
	  and requires fewer interrupts to handle the ADC sequence mode.
	  When DMA mode is used, the ADC internal gain is not compensated
	  for measurement adjustment.
```

## drivers/adc/Kconfig.cc32xx
```kconfig
# Copyright (c) 2021 Pavlo Hamov <pasha.gamov@gmail.com>
# SPDX-License-Identifier: Apache-2.0

config ADC_CC32XX
	bool "CC32XX ADC driver"
	default y
	depends on DT_HAS_TI_CC32XX_ADC_ENABLED
	help
	  This option enables the CC32XX ADC driver.
```

## drivers/adc/Kconfig.ch32v00x
```kconfig
# Copyright (c) Michael Hope <michaelh@juju.nz>
# SPDX-License-Identifier: Apache-2.0

config ADC_CH32V00X
	bool "WCH CH32V00x ADC Driver"
	default y
	depends on DT_HAS_WCH_ADC_ENABLED
	help
	  Enable the WCH CH32V00x family Analog-to-Digital Converter (ADC) driver.
```

## drivers/adc/Kconfig.dw
```kconfig
# Kconfig - ADC configuration options

#
# Copyright (c) 2015 Intel Corporation
#
# SPDX-License-Identifier: Apache-2.0
#

menuconfig ADC_DW
	bool "ARC Designware Driver"
	depends on ARC
	select ADC_0
	help
	  Enable the driver implementation of the Designware ADC IP.

if ADC_DW


config ADC_DW_CALIBRATION
	bool "Enable Calibration"
	default y
	help
	  Enables ADC to run with a calibrated output at the
	  expense of execution speed when exiting low power states.
	  If disabled, the ADC will require the application/system-integrator
	  to provide a calibration method.

choice
	prompt "Output Mode"
	default ADC_DW_SERIAL
	help
	  ADC output mode: parallel or serial.

config ADC_DW_SERIAL
	bool "Serial"

config ADC_DW_PARALLEL
	bool "Parallel"

endchoice

choice
	prompt "Capture Mode"
	default ADC_DW_RISING_EDGE
	help
	  ADC controller capture mode:
	  by rising or falling edge of adc_clk

config ADC_DW_RISING_EDGE
	bool "Rising Edge"

config ADC_DW_FALLING_EDGE
	bool "Falling Edge"

endchoice

config ADC_DW_SERIAL_DELAY
	int "Serial Delay"
	default 1
	help
	  Number of ADC clock ticks that the first bit of
	  the serial output is delayed after the conversion
	  has started.

config ADC_DW_CLOCK_RATIO
	int "Clock Ratio"
	default 1024
	help
	  ADC Clock Ratio

endif # ADC_DW
```

## drivers/adc/Kconfig.ene
```kconfig
# Copyright (c) 2024 ENE Technology Inc.
# SPDX-License-Identifier: Apache-2.0

config ADC_ENE_KB1200
	bool "ENE KB1200 ADC driver"
	default y
	depends on DT_HAS_ENE_KB1200_ADC_ENABLED
	select PINCTRL
	help
	  Enable ADC driver for ENE KB1200.

config ADC_ENE_KB106X
	bool "ENE KB106X ADC driver"
	default y
	depends on DT_HAS_ENE_KB106X_ADC_ENABLED
	select PINCTRL
	help
	  Enable ADC driver for ENE KB106X.
```

## drivers/adc/Kconfig.fake
```kconfig
# Copyright (c) 2026 Nordic Semiconductor ASA
# SPDX-License-Identifier: Apache-2.0

config ADC_FAKE
	bool "Fake ADC driver"
	default y
	depends on DT_HAS_ZEPHYR_ADC_FAKE_ENABLED
	depends on ZTEST

if ADC_FAKE

config ADC_FAKE_REF_INTERNAL
	int "Fake ADC internal reference voltage in millivolts"
	default 900

endif # ADC_FAKE
```

## drivers/adc/Kconfig.gd32
```kconfig
# ADC configuration options

# Copyright (c) 2021 BrainCo Inc.
# SPDX-License-Identifier: Apache-2.0

config ADC_GD32
	bool "GD32 ADC driver"
	default y
	depends on DT_HAS_GD_GD32_ADC_ENABLED
	select PINCTRL
	help
	  Enable GigaDevice GD32 ADC driver
```

## drivers/adc/Kconfig.gecko
```kconfig
# IADC configuration options

# Copyright (c) 2023 Antmicro <www.antmicro.com>
# SPDX-License-Identifier: Apache-2.0

config ADC_GECKO_IADC
	bool "Gecko Incremental ADC driver"
	default y
	depends on DT_HAS_SILABS_GECKO_IADC_ENABLED
	select SOC_GECKO_IADC
	select ADC_CONFIGURABLE_INPUTS
	help
	  Enable the driver implementation for the Silabs GeckoEXX32 Incremental ADC
```

## drivers/adc/Kconfig.hx711
```kconfig
# Copyright (c) 2024 Vinicius Miguel
#
# SPDX-License-Identifier: Apache-2.0

menuconfig ADC_HX711
	bool "AVIA Semiconductor HX711"
	default y
	depends on DT_HAS_AVIA_HX711_ENABLED
	help
	  Enable the driver implementation for the HX711

config ADC_HX711_ASYNC_THREAD_INIT_PRIO
	int "ADC HX711 async thread priority"
	default 0
	depends on ADC_HX711

config ADC_HX711_ACQUISITION_THREAD_STACK_SIZE
	int "Stack size for the ADC data acquisition thread"
	default 400
	depends on ADC_HX711
	help
	  Size of the stack used for the internal data acquisition
	  thread.

config ADC_HX711_WAIT_FOR_COMPLETION_TIMEOUT_MS
	int "Timeout for wait for completion of a read in ms"
	default 100
	depends on ADC_HX711
	help
	  This is the wait time in ms until a read is completed.
```

## drivers/adc/Kconfig.ifx_autanalog_sar
```kconfig
# Copyright (c) 2025 Infineon Technologies AG,
# or an affiliate of Infineon Technologies AG.
#
# SPDX-License-Identifier: Apache-2.0

# Infineon AutAnalog SAR ADC configuration options

config ADC_INFINEON_AUTANALOG_SAR
	bool "Infineon AutAnalog SAR ADC driver"
	default y
	depends on DT_HAS_INFINEON_AUTANALOG_SAR_ADC_ENABLED
	select USE_INFINEON_AUTANALOG_SAR_ADC
	select ADC_CONFIGURABLE_INPUTS
	help
	  This option enables the ADC driver for Infineon MCUs using AutAnalog SAR ADC.
```

## drivers/adc/Kconfig.ifx_cat1
```kconfig
# ==================================================================================================
# Copyright (c) 2025 Cypress Semiconductor Corporation (an Infineon company) or
# an affiliate of Cypress Semiconductor Corporation
#
# SPDX-License-Identifier: Apache-2.0
# ==================================================================================================

# Infineon CAT1 ADC configuration options

config ADC_INFINEON_CAT1
	bool "Infineon CAT1 ADC driver"
	default y
	depends on DT_HAS_INFINEON_CAT1_ADC_ENABLED
	select USE_INFINEON_ADC
	select ADC_CONFIGURABLE_INPUTS
	help
	  This option enables the ADC driver for Infineon CAT1 family.
```

## drivers/adc/Kconfig.infineon_autanalog_sar
```kconfig
# SPDX-FileCopyrightText: <text>Copyright (c) 2026 Infineon Technologies AG,
# or an affiliate of Infineon Technologies AG. All rights reserved.</text>
#
# SPDX-License-Identifier: Apache-2.0

# Infineon AutAnalog SAR ADC configuration options

config ADC_INFINEON_AUTANALOG_SAR
	bool "Infineon AutAnalog SAR ADC driver"
	default y
	depends on DT_HAS_INFINEON_AUTANALOG_SAR_ADC_ENABLED
	select MFD
	select ADC_CONFIGURABLE_INPUTS
	help
	  This option enables the ADC driver for Infineon MCUs using AutAnalog SAR ADC.

config ADC_INFINEON_AUTANALOG_SAR_STREAM
	bool "Infineon AutAnalog SAR ADC stream support"
	default y
	depends on ADC_INFINEON_AUTANALOG_SAR
	depends on ADC_STREAM
	help
	  Enable streaming mode for the Infineon AutAnalog SAR ADC using the
	  hardware FIFO to stream ADC samples via RTIO.
```
