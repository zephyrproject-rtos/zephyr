## drivers/adc/Kconfig.infineon_hppass_sar
```kconfig
# SPDX-FileCopyrightText: <text>Copyright (c) 2026 Infineon Technologies AG,
# or an affiliate of Infineon Technologies AG. All rights reserved.</text>
#
# SPDX-License-Identifier: Apache-2.0

# Infineon HPPASS SAR ADC configuration options

config ADC_INFINEON_HPPASS_SAR
	bool "Infineon HPPASS SAR ADC driver"
	default y
	depends on DT_HAS_INFINEON_HPPASS_SAR_ADC_ENABLED
	select MFD
	select USE_INFINEON_HPPASS_SAR_ADC
	select ADC_CONFIGURABLE_INPUTS
	help
	  This option enables the ADC driver for Infineon PSOC C3
	  HPPASS (High Performance Programmable Analog Sub-System) SAR ADC.

	  The HPPASS SAR ADC provides 12-bit analog-to-digital
	  conversion capabilities

if ADC_INFINEON_HPPASS_SAR

config ADC_INFINEON_HPPASS_SAR_INIT_PRIORITY
	int "Infineon HPPASS SAR ADC driver init priority"
	default 80
	help
	  Infineon HPPASS SAR ADC driver initialization priority.
	  This should be higher than the HPPASS_ANALOG_INIT_PRIORITY
	  to ensure the analog subsystem is initialized first.

config ADC_INFINEON_HPPASS_SAR_POLL_TIMEOUT_US
	int "Infineon HPPASS SAR ADC synchronous poll timeout in us"
	default 10000
	help
	  Upper bound, in microseconds, on how long a synchronous (blocking)
	  conversion waits for its result.  A conversion completes only once
	  the HPPASS MFD parent's autonomous controller is running and the
	  firmware trigger is routed to the group, both of which are outside
	  this driver's control.  Bounding the wait makes a stalled or
	  mis-routed trigger fail the read with -ETIMEDOUT instead of hanging
	  the calling thread.

endif # ADC_INFINEON_HPPASS_SAR
```

## drivers/adc/Kconfig.infineon_psoc4_sar
```kconfig
# Copyright (c) 2025 Infineon Technologies AG,
# or an affiliate of Infineon Technologies AG.
#
# SPDX-License-Identifier: Apache-2.0

# Infineon PSOC4 SAR ADC configuration options

config ADC_INFINEON_PSOC4
	bool "Infineon PSOC4 ADC driver"
	default y
	depends on DT_HAS_INFINEON_PSOC4_ADC_ENABLED
	select ADC_CONFIGURABLE_INPUTS
	select USE_INFINEON_ADC
	help
	  Enable ADC driver for Infineon PSOC4 family.

config ADC_INFINEON_PSOC4_SARSEQ_SWITCHING
	bool "Use SARSEQ hardware switch control"
	default y
	depends on ADC_INFINEON_PSOC4
	help
	  Enable SARSEQ (hardware sequencer) control of SAR ADC input switches.
	  If disabled, the driver relies on firmware-controlled switches only.
```
