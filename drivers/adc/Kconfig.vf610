## drivers/audio/Kconfig.max98091
```kconfig
# Copyright (c) 2025 Silicon Signals Pvt. Ltd.
# SPDX-License-Identifier: Apache-2.0

config AUDIO_CODEC_MAX98091
	bool "Maxim MAX98091 codec support"
	default y
	select I2C
	depends on DT_HAS_MAXIM_MAX98091_ENABLED
	help
	  Enable support for the MAX98091 I2S codec via I2C.
```

## drivers/audio/Kconfig.mpxxdtyy
```kconfig
# Copyright (c) 2018 STMicroelectronics
# SPDX-License-Identifier: Apache-2.0

config AUDIO_MPXXDTYY
	bool "ST Digital PDM microphone attached to I2S support"
	default y
	depends on DT_HAS_ST_MPXXDTYY_ENABLED
	select I2S
	select HAS_STLIB
	help
	  Enable MPXXDTYY microphone support on the selected board
```
