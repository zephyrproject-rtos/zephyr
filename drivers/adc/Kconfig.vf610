## drivers/adc/Kconfig.vf610
```kconfig
# ADC configuration options

# Copyright (c) 2021 Antonio Tessarolo
# SPDX-License-Identifier: Apache-2.0

config ADC_VF610
	bool "VF610 ADC driver"
	depends on DT_HAS_NXP_VF610_ADC_ENABLED
	default y
	help
	  Enable the VF610 ADC driver.
```

## drivers/adc/Kconfig.w91
```kconfig
# Copyright (c) 2022-2023 Telink Semiconductor
# SPDX-License-Identifier: Apache-2.0

config ADC_TELINK_W91
	bool "Telink Semiconductor W91 ADC driver"
	default y
	depends on DT_HAS_TELINK_W91_ADC_ENABLED
	select ADC_CONFIGURABLE_INPUTS
	help
	  Enables Telink W91 ADC driver.
```

## drivers/adc/Kconfig.xec
```kconfig
# Microchip XEC ADC configuration

# Copyright (c) 2019 Intel Corporation
# Copyright (c) 2023 Microchip Technology Inc.
# SPDX-License-Identifier: Apache-2.0

config ADC_XEC
	bool "Microchip XEC series ADC driver"
	default y
	depends on DT_HAS_MICROCHIP_XEC_ADC_ENABLED
	help
	  Enable ADC driver for Microchip XEC MCU series.
```

## drivers/adc/Kconfig.xmc4xxx
```kconfig
# XMC4XXX ADC configuration options

# Copyright (c) 2022 Andriy Gelman <andriy.gelman@gmail.com>
# SPDX-License-Identifier: Apache-2.0

config ADC_XMC4XXX
	bool "XMC4XXX ADC"
	default y
	depends on DT_HAS_INFINEON_XMC4XXX_ADC_ENABLED
	help
	  Enable XMC4XXX adc driver.
```

## drivers/aio/Kconfig
```kconfig
# Kconfig - AIO/Comparator configuration options
#
#
# Copyright (c) 2015-2016 Intel Corporation
#
# SPDX-License-Identifier: Apache-2.0
#

#
# AIO/Comparator options
#
menuconfig AIO_COMPARATOR
	bool "AIO/Comparator Configuration"

if AIO_COMPARATOR
menuconfig AIO_COMPARATOR_QMSI
	bool "Enable QMSI AIO/comparator driver"
	depends on QMSI
	help
	  QMSI AIO/Comparator driver.

config AIO_COMPARATOR_0_NAME
	string "Device name for AIO/comparator"
	default "AIO_CMP_0"
	help
	  Device name for the AIO/comparator.

config AIO_COMPARATOR_0_IRQ_PRI
	int "IRQ Priority for AIO/comparator"
	default 3
	help
	  IRQ Priority for the AIO/comparator.

endif # AIO_COMPARATOR
```

## drivers/analog_switch/Kconfig
```kconfig
# Copyright (c) 2026 Analog Devices Inc.
# SPDX-License-Identifier: Apache-2.0

menuconfig ANALOG_SWITCH
	bool "Analog switch drivers [EXPERIMENTAL]"
	select EXPERIMENTAL
	help
	  Include analog switch drivers in the system configuration.

if ANALOG_SWITCH

module = ANALOG_SWITCH
module-str = analog_switch
source "subsys/logging/Kconfig.template.log_config"

config ANALOG_SWITCH_INIT_PRIORITY
	int "Analog switch initialization priority"
	default 90
	help
	  System initialization priority for analog switch drivers.

rsource "Kconfig.adgm3121"

endif # ANALOG_SWITCH
```

## drivers/analog_switch/Kconfig.adgm3121
```kconfig
# Copyright (c) 2026 Analog Devices Inc.
# SPDX-License-Identifier: Apache-2.0

config ANALOG_SWITCH_ADGM3121
	bool "Analog Devices ADGM3121 MEMS switch driver"
	default y
	depends on DT_HAS_ADI_ADGM3121_ENABLED || \
		   DT_HAS_ADI_ADGM3121_GPIO_ENABLED
	depends on SPI || GPIO
	help
	  Enable driver for Analog Devices ADGM3121 DPDT MEMS switch
	  (DC-24GHz). Supports both SPI and parallel GPIO control modes.
```

## drivers/ata/Kconfig
```kconfig
# Copyright (c) 2023 Arm Limited (or its affiliates). All rights reserved.
# SPDX-License-Identifier: Apache-2.0

menuconfig ATA
	bool "Support for ATA"
	help
	  Enable support for ATA
```

## drivers/audio/Kconfig
```kconfig
# Audio Codec configuration options

# Copyright (c) 2018 Intel Corporation
# SPDX-License-Identifier: Apache-2.0

menuconfig AUDIO
	bool "Audio drivers"
	help
	  Enable support for Audio

if AUDIO
#
# Audio Codec options
#
menuconfig AUDIO_CODEC
	bool "Audio Codec Drivers"
	help
	  Enable Audio Codec Driver Configuration

if AUDIO_CODEC

config AUDIO_CODEC_INIT_PRIORITY
	int "Init priority"
	default 60
	help
	  Audio codec device driver initialization priority.

config AUDIO_CODEC_SHELL
	bool "Audio Codec shell"
	depends on SHELL
	help
	  Enable the Audio Codec shell with Audio Codec related commands.

module = AUDIO_CODEC
module-str = audio codec
source "subsys/logging/Kconfig.template.log_config"

# zephyr-keep-sorted-start
source "drivers/audio/Kconfig.aw88298"
source "drivers/audio/Kconfig.codec_dummy"
source "drivers/audio/Kconfig.cs43l22"
source "drivers/audio/Kconfig.da7212"
source "drivers/audio/Kconfig.max98091"
source "drivers/audio/Kconfig.pcm1681"
source "drivers/audio/Kconfig.sf32lb"
source "drivers/audio/Kconfig.tas2563"
source "drivers/audio/Kconfig.tas6422dac"
source "drivers/audio/Kconfig.tlv320aic26"
source "drivers/audio/Kconfig.tlv320aic3110"
source "drivers/audio/Kconfig.tlv320dac"
source "drivers/audio/Kconfig.wm8904"
source "drivers/audio/Kconfig.wm8962"
# zephyr-keep-sorted-stop

endif # AUDIO_CODEC

menuconfig AUDIO_DMIC
	bool "Digital Microphone (Audio) Drivers"
	help
	  Enable Digital Microphone Driver Configuration

if AUDIO_DMIC

config AUDIO_DMIC_INIT_PRIORITY
	int "Init priority"
	default 80
	help
	  Audio Digital Microphone device driver initialization priority.

menuconfig AUDIO_DMIC_SHELL
	bool "Audio DMIC shell"
	depends on SHELL
	select SHELL_VT100_COMMANDS
	select BASE64
	help
	  Enable shell commands to read audio data, display a live VU meter, and dump captured PCM
	  as base64 from a digital microphone device.

if AUDIO_DMIC_SHELL

config AUDIO_DMIC_SHELL_BLOCK_COUNT
	int "Number of capture buffers"
	default 4
	range 2 16
	help
	  Number of buffers in the capture pool.
	  At least two are needed so one buffer can be filled while another is processed.

config HEAP_MEM_POOL_ADD_SIZE_AUDIO_DMIC_SHELL
	int "System heap reserved for the Audio DMIC shell (bytes)"
	default 8192
	help
	  Heap reserved for shell capture buffers.
	  Raise it for higher sample rates, channel counts, or PCM widths.

config AUDIO_DMIC_SHELL_VU_PEAK_HOLD_MS
	int "Level meter peak-hold time (ms)"
	default 1000
	help
	  How long the "dmic vu" level meter holds the peak-hold tick ('|') flat after a new peak
	  before it starts decaying back toward the floor.

config AUDIO_DMIC_SHELL_VU_CLIP_HOLD_MS
	int "Level meter clip indicator hold time (ms)"
	default 2000
	help
	  How long the "dmic vu" level meter keeps the red clip indicator ('!') lit after the most
	  recent clipped sample.

config AUDIO_DMIC_SHELL_VU_STACK_SIZE
	int "Level meter worker thread stack size (bytes)"
	default 1024
	help
	  Stack size for the background worker thread that runs the "dmic vu" level meter.

endif # AUDIO_DMIC_SHELL

module = AUDIO_DMIC
module-str = audio_dmic
source "subsys/logging/Kconfig.template.log_config"

# zephyr-keep-sorted-start
source "drivers/audio/Kconfig.dmic_ambiq_pdm"
source "drivers/audio/Kconfig.dmic_infineon"
source "drivers/audio/Kconfig.dmic_mcux"
source "drivers/audio/Kconfig.dmic_mpxxdtyy"
source "drivers/audio/Kconfig.dmic_native_sim"
source "drivers/audio/Kconfig.dmic_nxp_micfil"
source "drivers/audio/Kconfig.dmic_pdm_nrfx"
source "drivers/audio/Kconfig.dmic_stm32_dfsdm"
# zephyr-keep-sorted-stop

endif # AUDIO_DMIC

endif # AUDIO
```

## drivers/audio/Kconfig.amic_ambiq_audadc
```kconfig
# Copyright (c) 2025 Ambiq Micro Inc.
# SPDX-License-Identifier: Apache-2.0

config AUDIO_AMIC_AMBIQ_AUDADC
	bool "Ambiq AUDADC driver"
	default y
	depends on DT_HAS_AMBIQ_AUDADC_ENABLED
	select AMBIQ_HAL
	select AMBIQ_HAL_USE_AUDADC
	help
	  Enable support for Ambiq AUDADC driver for Apollo 5 MCU.

if AUDIO_AMIC_AMBIQ_AUDADC

config AUDADC_AMBIQ_HANDLE_CACHE
	bool "Turn on cache handling in AUDADC driver"
	default y
	depends on CACHE_MANAGEMENT && DCACHE
	help
	  Disable this if cache has been handled in upper layers.

config AUDADC_AMBIQ_BUFFER_ALIGNMENT
	int "Set the AUDADC DMA TCB buffer alignment"
	default DCACHE_LINE_SIZE if DCACHE
	help
	  AUDADC buffer should be 32bytes aligned when placed in cachable region.

config AUDADC_AMBIQ_DC_OFFSET_CALIBRATION
	bool "Turn on DC offset calibration in AUDADC driver"
	default y
	help
	  Disable this if AUDADC slot DC offset calibration is not needed.

endif
```

## drivers/audio/Kconfig.aw88298
```kconfig
# Copyright (c) 2025 TOKITA Hiroshi
# SPDX-License-Identifier: Apache-2.0

config AUDIO_CODEC_AW88298
	bool "Awinic AW88298 digital smart amplifier"
	default y
	depends on DT_HAS_AWINIC_AW88298_ENABLED
	select I2C
	help
	  Enable support for the Awinic AW88298 digital smart amplifier.
```

## drivers/audio/Kconfig.codec_cs43l22
```kconfig
# Copyright (c) 2025 Titouan Christophe
# SPDX-License-Identifier: Apache-2.0

config AUDIO_CODEC_CS43L22
	bool "Cirrus CS43L22 driver"
	default y
	select I2C
	depends on GPIO
	depends on DT_HAS_CIRRUS_CS43L22_ENABLED
	help
	  Enable the driver for the Cirrus CS43L22 low Power, stereo DAC
	  with headphone & speaker amplifiers
```

## drivers/audio/Kconfig.codec_dummy
```kconfig
# Copyright 2026 NXP
# SPDX-License-Identifier: Apache-2.0

config AUDIO_CODEC_DUMMY
	bool "Dummy audio codec driver"
	depends on DT_HAS_ZEPHYR_DUMMY_CODEC_ENABLED
	default y
	help
	  Enable the dummy audio codec driver that can be used for testing and development purposes without requiring actual hardware.
	  The driver implements the necessary interfaces but does not perform any real audio processing.
```

## drivers/audio/Kconfig.cs35l45
```kconfig
# Copyright (c) 2024 Cirrus Logic, Inc.
# SPDX-License-Identifier: Apache-2.0

config AUDIO_CODEC_CS35L45
	bool "Cirrus Logic CS35L45 codec support"
	depends on DT_HAS_CIRRUS_CS35L45_ENABLED
	select I2C if $(dt_compat_on_bus,$(DT_COMPAT_CIRRUS_CS35L45),i2c)
	select GPIO
	select REGULATOR
	help
	  Enable driver for CS35L45 smart amplifier
```

## drivers/audio/Kconfig.da7212
```kconfig
# Copyright 2025 NXP
# SPDX-License-Identifier: Apache-2.0

config AUDIO_CODEC_DA7212
	bool "Dialog DA7212 codec support"
	default y
	select I2C
	depends on DT_HAS_DLG_DA7212_ENABLED
	help
	  Enable support for the Dialog DA7212 audio codec.
```

## drivers/audio/Kconfig.dmic_ambiq_pdm
```kconfig
# Copyright (c) 2025 Ambiq Micro Inc.
# SPDX-License-Identifier: Apache-2.0

config AUDIO_DMIC_AMBIQ_PDM
	bool "Ambiq PDM driver"
	default y
	depends on DT_HAS_AMBIQ_PDM_ENABLED
	select AMBIQ_HAL
	select AMBIQ_HAL_USE_PDM
	select PINCTRL
	help
	  Enable support for Ambiq PDM driver for Apollo 5 MCU.

if AUDIO_DMIC_AMBIQ_PDM

config PDM_AMBIQ_HANDLE_CACHE
	bool "Turn on cache handling in PDM driver"
	default y
	depends on CACHE_MANAGEMENT && DCACHE
	help
	  Disable this if cache has been handled in upper layers.

config PDM_AMBIQ_RX_BLOCK_COUNT
	int "RX queue length"
	default 4
	help
	Set the number of RX blocks (queue length) used for buffering incoming PDM data.
	Increasing this value can help prevent data loss in high-throughput scenarios,
	but will use more memory. Decreasing it reduces memory usage but may risk
	overruns if the system cannot process data quickly enough. Typical values
	range from 2 to 8 depending on application requirements.

endif
```

## drivers/audio/Kconfig.dmic_infineon
```kconfig
# Copyright (c) 2026 Infineon Technologies AG,
# or an affiliate of Infineon Technologies AG.
#
# SPDX-License-Identifier: Apache-2.0

# Infineon DMIC configuration options

config AUDIO_DMIC_INFINEON
	bool "Infineon DMIC driver"
	default y
	depends on DT_HAS_INFINEON_PDM_ENABLED
	select USE_INFINEON_PDM_PCM
	select PINCTRL
	select DMA
	help
	  Enable Infineon DMIC driver.

if AUDIO_DMIC_INFINEON

config DMIC_INFINEON_QUEUE_SIZE
	int "Receive queue length"
	default 8
	help
	  This option sets the number elements allocated for the rx software
	  queue. This should match the number of blocks in the memory slab
	  that will hold the received PCM samples.

endif # AUDIO_DMIC_INFINEON
```

## drivers/audio/Kconfig.dmic_mcux
```kconfig
# Copyright 2023 NXP
# SPDX-License-Identifier: Apache-2.0

config AUDIO_DMIC_MCUX
	bool "DMIC driver for MCUX"
	default y
	depends on DT_HAS_NXP_DMIC_ENABLED
	select DMA
	select PINCTRL
	help
	  Enable support for DMIC on NXP MCUX SoC's

if AUDIO_DMIC_MCUX

config DMIC_MCUX_DMA_BUFFERS
	int "Number of buffers to reserve for DMIC DMA"
	default 2
	range 2 16
	help
	  This determines how many buffers the driver should allocate and
	  reserve for the DMA engine. The memory slab used with the DMIC
	  API should provide at least one more buffer than this value, since
	  a buffer will always be in the RX queue.

config DMIC_MCUX_QUEUE_SIZE
	int "Size of DMIC buffer queue"
	default 8
	help
	  This sets the size of the RX buffer queue for the DMIC. Up to this
	  many buffers may be queued by the DMIC once it is triggered, before
	  the application must read buffers to avoid data being dropped.

endif # AUDIO_DMIC_MCUX
```

## drivers/audio/Kconfig.dmic_native_sim
```kconfig
# Copyright 2026 NXP
#
# SPDX-License-Identifier: Apache-2.0

config AUDIO_DMIC_NATIVE_SIM
	bool "Native simulator DMIC driver"
	depends on DT_HAS_ZEPHYR_NATIVE_SIM_DMIC_ENABLED
	help
	  Enable the native simulator DMIC driver.

if AUDIO_DMIC_NATIVE_SIM

config AUDIO_DMIC_NATIVE_SIM_FILE_PATH
	string "Input PCM file path"
	default "/tmp/native_sim_dmic_in.pcm"
	help
	  Host file path used as the PCM capture source.

config AUDIO_DMIC_NATIVE_SIM_QUEUE_SIZE
	int "Receive queue length"
	default 8
	range 1 64
	help
	  Number of capture blocks that can be queued for the application.

config AUDIO_DMIC_NATIVE_SIM_THREAD_PRIORITY
	int "Worker thread priority"
	default 5
	help
	  Priority for the native simulator DMIC worker thread.

endif # AUDIO_DMIC_NATIVE_SIM
```

## drivers/audio/Kconfig.dmic_nxp_micfil
```kconfig
# Copyright 2025 NXP
#
# SPDX-License-Identifier: Apache-2.0

config AUDIO_DMIC_NXP_MICFIL
	bool "NXP MICFIL driver"
	default y
	depends on DT_HAS_NXP_MICFIL_ENABLED
	select CLOCK_CONTROL
	select PINCTRL
	help
	  Enable NXP MICFIL driver.

if AUDIO_DMIC_NXP_MICFIL

config DMIC_NXP_MICFIL_QUEUE_SIZE
	int "Message queue depth"
	default 4
	help
	  Depth of the message queue used to pass filled buffers to the app.

endif # AUDIO_DMIC_NXP_MICFIL
```

## drivers/audio/Kconfig.dmic_nxp_pdm
```kconfig
# Copyright 2025 NXP
#
# SPDX-License-Identifier: Apache-2.0

config AUDIO_DMIC_NXP_PDM
	bool "NXP PDM driver"
	default y
	depends on DT_HAS_NXP_PDM_ENABLED
	select HAS_MCUX
	select CLOCK_CONTROL
	help
	  Enable NXP PDM driver.

if AUDIO_DMIC_NXP_PDM

config DMIC_NXP_PDM_QUEUE_SIZE
	int "Message queue depth"
	default 4
	help
	  Depth of the message queue used to pass filled buffers to the app.

endif # AUDIO_DMIC_NXP_PDM
```

## drivers/audio/Kconfig.dmic_stm32_dfsdm
```kconfig
# SPDX-FileCopyrightText: Copyright (c) 2026 STMicroelectronics
# SPDX-License-Identifier: Apache-2.0

config AUDIO_DMIC_STM32_DFSDM
	bool "STM32 DFSDM DMIC driver"
	default y
	depends on DT_HAS_ST_STM32_DFSDM_ENABLED && DT_HAS_ST_STM32_DFSDM_DMIC_ENABLED
	select USE_STM32_HAL_DFSDM
	select RESET
	select PINCTRL
	help
	  Enable support for STM32 DMIC driver.

if AUDIO_DMIC_STM32_DFSDM

config DMIC_STM32_DFSDM_QUEUE_SIZE
	int "DMIC message queue size"
	default 8
	help
	  Number of pending audio buffer messages that can be queued.  Higher
	  values mean more buffering and audio data, but more RAM footprint.
	  Lower values mean less memory footprint and latency, but possibly
	  more overruns.

config DMIC_STM32_DFSDM_MAX_SAMPLES
	int "Maximum number of samples per DMIC block"
	default 1024
	help
	  This defines the size of the static internal DMA buffer used for continuous
	  audio transfers. The driver allocates two of these blocks (Ping/Pong) per
	  active filter. Larger values allow for larger k_mem_slab block sizes but
	  consume more RAM.

endif #AUDIO_DMIC_STM32_DFSDM
```

## drivers/audio/Kconfig.intel_dmic
```kconfig
#
# Copyright (c) 2018 Intel Corporation
#
# SPDX-License-Identifier: Apache-2.0
#

config AUDIO_INTEL_DMIC
	bool "Intel digital PDM microphone driver support"
	help
	  Enable Intel digital PDM microphone driver
```
