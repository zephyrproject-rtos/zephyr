## drivers/adc/Kconfig.ti_adc108s102
```kconfig
# Kconfig - ADC configuration options

#
# Copyright (c) 2015 Intel Corporation
#
# SPDX-License-Identifier: Apache-2.0
#

menuconfig ADC_TI_ADC108S102
	bool "TI adc108s102 chip driver"
	select SPI
	select ADC_0
	default n
	help
	Enable support for TI's ADC chip adc108s102 driver.

if ADC_TI_ADC108S102

config ADC_TI_ADC108S102_SPI_PORT_NAME
	string "Master SPI port name"
	default ""
	help
	  Master SPI port name through which adc108s102 chip is accessed.

config ADC_TI_ADC108S102_SPI_CONFIGURATION
	hex "Master SPI port configuration"
	default 0x0
	help
	  Master SPI port configuration flags used to access adc108s102 chip.

config ADC_TI_ADC108S102_SPI_MAX_FREQ
	hex "Master SPI port max frequency"
	default 0x0
	help
	  Master SPI port maximum frequency used to access adc108s102 chip.

config ADC_TI_ADC108S102_SPI_SLAVE
	int "SPI slave slot"
	default 0
	help
	  adc108s102 chip's SPI slave number on master SPI port.

endif # ADC_TI_ADC108S102
```

## drivers/adc/Kconfig.ti_am335x
```kconfig
# Copyright (c) 2025, Texas Instruments
# SPDX-License-Identifier: Apache-2.0

config ADC_TI_AM335X
	bool "TI ADC Driver"
	default y
	depends on DT_HAS_TI_AM335X_ADC_ENABLED
	help
	  Enable TI AM335x Analog-to-Digital Converter (ADC) driver.
```

## drivers/adc/Kconfig.ti_k3
```kconfig
# Copyright (c) 2025, Texas Instruments
# SPDX-License-Identifier: Apache-2.0

config ADC_TI_K3
	bool "TI K3 ADC Driver"
	default y
	depends on DT_HAS_TI_ADC_K3_ENABLED
	help
	  Enable TI K3 Family Analog-to-Digital Converter (ADC) driver.
```

## drivers/adc/Kconfig.tla2021
```kconfig
# Copyright (c) 2023 Caspar Friedrich <c.s.w.friedrich@gmail.com>
# SPDX-License-Identifier: Apache-2.0

config ADC_TLA2021
	bool "Texas Instruments TLA2021 Low-Power ADC"
	default y
	depends on DT_HAS_TI_TLA2021_ENABLED
	select I2C
	help
	  TLA202x Cost-Optimized, Ultra-Small, 12-Bit, System-Monitoring ADCs

if ADC_TLA2021

config ADC_TLA2021_INIT_PRIORITY
	int "Priority for the driver initialization"
	default 80
	help
	  Fine tune the priority for the driver initialization. Make sure it's
	  higher (-> lower priority) than I2C_INIT_PRIORITY.

if ADC_ASYNC

config ADC_TLA2021_ACQUISITION_THREAD_PRIORITY
	int "Priority for the data acquisition thread"
	default 0
	help
	  Execution priority for the internal data acquisition thread.

config ADC_TLA2021_ACQUISITION_THREAD_STACK_SIZE
	int "Stack size for the data acquisition thread"
	default 512
	help
	  Stack size for the internal data acquisition thread. Requires room
	  for I2C operations.

endif # ADC_ASYNC

endif # ADC_TLA2021
```

## drivers/adc/Kconfig.tla202x
```kconfig
# Copyright (c) 2023 Caspar Friedrich <c.s.w.friedrich@gmail.com>
# SPDX-License-Identifier: Apache-2.0

config ADC_TLA202X
	bool "Texas Instruments TLA202x Low-Power ADC"
	default y
	depends on DT_HAS_TI_TLA2021_ENABLED \
		|| DT_HAS_TI_TLA2022_ENABLED \
		|| DT_HAS_TI_TLA2024_ENABLED
	select I2C
	select ADC_CONFIGURABLE_INPUTS if DT_HAS_TI_TLA2024_ENABLED
	help
	  TLA202x Cost-Optimized, Ultra-Small, 12-Bit, System-Monitoring ADCs

if ADC_TLA202X

config ADC_TLA202X_INIT_PRIORITY
	int "Priority for the driver initialization"
	default 80
	help
	  Fine tune the priority for the driver initialization. Make sure it's
	  higher (-> lower priority) than I2C_INIT_PRIORITY.

if ADC_ASYNC

config ADC_TLA202X_ACQUISITION_THREAD_PRIORITY
	int "Priority for the data acquisition thread"
	default 0
	help
	  Execution priority for the internal data acquisition thread.

config ADC_TLA202X_ACQUISITION_THREAD_STACK_SIZE
	int "Stack size for the data acquisition thread"
	default 512
	help
	  Stack size for the internal data acquisition thread. Requires room
	  for I2C operations.

endif # ADC_ASYNC

endif # ADC_TLA202X
```

## drivers/adc/Kconfig.tla2528
```kconfig
# Copyright (c) 2026 Leica Geosystems AG
# SPDX-License-Identifier: Apache-2.0

config ADC_TLA2528
	bool "Texas Instruments TLA2528 I2C"
	default y
	depends on DT_HAS_TI_TLA2528_ADC_ENABLED
	select MFD
	help
	  Enable the adc driver implementation for the TLA2528

config ADC_TLA2528_INIT_PRIO
	int "Init priority"
	default 70
	depends on ADC_TLA2528
	help
	  Device driver initialization priority.
	  Priority has to be lower (=higher value) than the TLA2528 mfd driver prio.
```

## drivers/adc/Kconfig.tlx
```kconfig
# Copyright (c) 2022-2023 Telink Semiconductor
# SPDX-License-Identifier: Apache-2.0

config ADC_TELINK_TLX
	bool "Telink Semiconductor TLx ADC driver"
	default y
	depends on DT_HAS_TELINK_TLX_ADC_ENABLED
	select ADC_CONFIGURABLE_INPUTS
	help
	  Enables Telink TLx ADC driver.

if ADC_TELINK_TLX

config ADC_TLX_ACQUISITION_THREAD_STACK_SIZE
	int "Stack size for the ADC data acquisition thread"
	default 512
	help
	  Size of the stack used for the internal data acquisition
	  thread.

config ADC_TLX_ACQUISITION_THREAD_PRIO
	int "Priority for the ADC data acquisition thread"
	default 0
	help
	  Priority level for the internal ADC data acquisition thread.

endif # ADC_TELINK_TLX
```
