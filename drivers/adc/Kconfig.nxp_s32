## drivers/adc/Kconfig.nxp_s32
```kconfig
# Copyright 2023 NXP
# SPDX-License-Identifier: Apache-2.0

config ADC_NXP_S32_ADC_SAR
	bool "NXP S32 ADC SAR driver"
	default y
	select PINCTRL
	depends on DT_HAS_NXP_S32_ADC_SAR_ENABLED
	help
	  This option enables the NXP S32 ADC SAR driver.
```

## drivers/adc/Kconfig.pic32cxsg
```kconfig
# Copyright (c) 2024 Microchip
# SPDX-License-Identifier: Apache-2.0

config ADC_PIC32CXSG
	bool "Microchip PIC32CXSG series ADC Driver"
	default y
	depends on DT_HAS_PIC32CXSG_ADC_ENABLED
	select ADC_CONFIGURABLE_INPUTS
	help
	  Enable Microchip PIC32CXSG MCU Family Analog-to-Digital Converter (ADC) driver.
```

## drivers/adc/Kconfig.qmsi
```kconfig
# Kconfig - ADC configuration options

#
# Copyright (c) 2015 Intel Corporation
#
# SPDX-License-Identifier: Apache-2.0
#

menuconfig ADC_QMSI
	bool "QMSI ADC Driver"
	depends on QMSI
	select ADC_0
	default n
	help
	  Enable the driver implementation of the QMSI ADC IP.

menuconfig ADC_QMSI_SS
	bool "QMSI ADC Driver for the Sensor Subsystem"
	depends on QMSI
	select ADC_0
	default n
	help
	  Enable the driver implementation of the QMSI ADC IP.

if ADC_QMSI || ADC_QMSI_SS

choice
	prompt "Capturing Mode"
	default ADC_QMSI_INTERRUPT
	help
	  ADC sample capture mode - interrupt mode/polling mode

config ADC_QMSI_POLL
	bool "Polling samples"

config ADC_QMSI_INTERRUPT
	bool "Interrupt notification"

endchoice

config ADC_QMSI_CALIBRATION
	bool "Enable Calibration"
	default y
	help
	  Enables ADC to run with a calibrated output at the
	  expense of execution speed when exiting low power states.
	  If disabled, the ADC will require the application/system-integrator
	  to provide a calibration method.

config ADC_QMSI_CLOCK_RATIO
	int "Clock Ratio"
	default 100
	help
	  ADC Clock Ratio

config ADC_QMSI_SERIAL_DELAY
	int "Serial Delay"
	default 1
	help
	  Number of ADC clock ticks that the first bit of
	  the serial output is delayed after the conversion
	  has started.

if ADC_QMSI
config ADC_QMSI_SAMPLE_WIDTH
	int "Sample Width"
	default 3
	help
	  Defines ADC device data sample width (resolution):

	  - 0 = 6 bits resolution

	  - 1 = 8 bits resolution

	  - 2 = 10 bits resolution

	  - 3 = 12 bits resolution
endif

if ADC_QMSI_SS
config ADC_QMSI_SAMPLE_WIDTH
	int "Sample Width"
	default 11
	help
	  Defines ADC device data sample width (resolution):

	  - 5 = 6 bits resolution

	  - 7 = 8 bits resolution

	  - 9 = 10 bits resolution

	  - 11 = 12 bits resolution
endif

endif # ADC_QMSI || ADC_QMSI_SS
```

## drivers/adc/Kconfig.renesas_ra
```kconfig
# Renesas RA Family

# Copyright (c) 2024 Renesas Electronics Corporation
# SPDX-License-Identifier: Apache-2.0

config ADC_RENESAS_RA
	bool "Renesas RA ADC"
	default y
	depends on DT_HAS_RENESAS_RA_ADC_ENABLED
	select USE_RA_FSP_ADC
	select PINCTRL
	help
	  Enable Renesas RA ADC Driver.
```

## drivers/adc/Kconfig.renesas_rx
```kconfig
# Renesas RX Family

# Copyright (c) 2025 Renesas Electronics Corporation
# SPDX-License-Identifier: Apache-2.0

config ADC_RENESAS_RX
	bool "Renesas RX ADC"
	default y
	depends on DT_HAS_RENESAS_RX_ADC_ENABLED
	select USE_RX_RDP_ADC
	select PINCTRL
	help
	  Enable Renesas RX ADC Driver.
```

## drivers/adc/Kconfig.renesas_rz
```kconfig
# Renesas RZ Family

# Copyright (c) 2024-2025 Renesas Electronics Corporation
# SPDX-License-Identifier: Apache-2.0

config ADC_RENESAS_RZ
	bool "Renesas RZ ADC Driver"
	default y
	depends on DT_HAS_RENESAS_RZ_ADC_ENABLED
	select USE_RZ_FSP_ADC
	help
	  Enable the RZ ADC driver.

config ADC_RENESAS_RZ_ADC_C
	bool "Renesas RZ ADC-C Driver"
	default y
	depends on DT_HAS_RENESAS_RZ_ADC_C_ENABLED
	select USE_RZ_FSP_ADC
	help
	  Enable the RZ ADC-C driver.
```

## drivers/adc/Kconfig.rpi_pico
```kconfig
# Copyright (c) 2022 TOKITA Hiroshi <tokita.hiroshi@fujitsu.com>
# SPDX-License-Identifier: Apache-2.0

config ADC_RPI_PICO
	bool "Raspberry Pi Pico ADC driver"
	default y
	depends on DT_HAS_RASPBERRYPI_PICO_ADC_ENABLED
	select PICOSDK_USE_ADC
	select PINCTRL
	depends on RESET
```

## drivers/adc/Kconfig.rtio
```kconfig
# Copyright (c) 2026 Nordic Semiconductor ASA
# SPDX-License-Identifier: Apache-2.0

config ADC_RTIO
	bool "ADC RTIO context"
	select RTIO

if ADC_RTIO

config ADC_RTIO_WRAPPER
	bool "ADC RTIO wrapper API implementations"
	default y
	help
	  Include implementations of the adc_channel_setup(), adc_read() and adc_read_async() APIs
	  with the ADC RTIO context.

endif # ADC_RTIO
```

## drivers/adc/Kconfig.rts5912
```kconfig
# Copyright (c) 2025, Realtek, SIBG-SD7
# SPDX-License-Identifier: Apache-2.0

config ADC_REALTEK_RTS5912
	bool "Realtek RTS5912 ADC drivers"
	default y
	depends on DT_HAS_REALTEK_RTS5912_ADC_ENABLED
	select PINCTRL
	help
	  This option enables the ADC driver for Realtek RTS5912 of processors.
```

## drivers/adc/Kconfig.sam
```kconfig
# Copyright (c) 2022, Basalte bv
# SPDX-License-Identifier: Apache-2.0

config ADC_SAM
	bool "Atmel SAM series ADC Driver"
	default y
	depends on DT_HAS_ATMEL_SAM_ADC_ENABLED
	select PINCTRL
	select ADC_CONFIGURABLE_INPUTS
	help
	  Enable Atmel SAM MCU Family Analog-to-Digital Converter (ADC) driver.
```

## drivers/adc/Kconfig.sam0
```kconfig
# Copyright (c) 2019 Derek Hageman <hageman@inthat.cloud>
# SPDX-License-Identifier: Apache-2.0

config ADC_SAM0
	bool "Atmel SAM0 series ADC Driver"
	default y
	depends on DT_HAS_ATMEL_SAM0_ADC_ENABLED
	select PINCTRL
	select ADC_CONFIGURABLE_INPUTS
	help
	  Enable Atmel SAM0 MCU Family Analog-to-Digital Converter (ADC) driver.
```

## drivers/adc/Kconfig.sam_afec
```kconfig
# ADC configuration options

# Copyright (c) 2017 comsuisse AG
# SPDX-License-Identifier: Apache-2.0

config ADC_SAM_AFEC
	bool "SAM ADC Driver"
	default y
	depends on DT_HAS_ATMEL_SAM_AFEC_ENABLED
	select PINCTRL
	help
	  Enable Atmel SAM MCU Family Analog-to-Digital Converter (ADC) driver
	  based on AFEC module.
```

## drivers/adc/Kconfig.sf32lb
```kconfig
# Copyright (c) 2025, Qingsong Gou <gouqs@hotmail.com>
# SPDX-License-Identifier: Apache-2.0

config ADC_SF32LB
	bool "ADC driver for SF32LB family of MCUs"
	default y
	depends on DT_HAS_SIFLI_SF32LB_GPADC_ENABLED
	help
	  Enable ADC driver for SF32LB series of MCUs
```

## drivers/adc/Kconfig.silabs
```kconfig
# Copyright (c) 2023 Antmicro <www.antmicro.com>
# Copyright (c) 2025 Silicon Laboratories Inc.
# SPDX-License-Identifier: Apache-2.0

config ADC_GECKO_ADC
	bool "Gecko ADC driver"
	default y
	depends on DT_HAS_SILABS_GECKO_ADC_ENABLED
	select SOC_GECKO_ADC
	select ADC_CONFIGURABLE_INPUTS
	help
	  Enable the driver implementation for the Silabs GeckoEFM32 ADC

config ADC_SILABS_IADC
	bool "Silabs Incremental ADC driver"
	default y
	depends on DT_HAS_SILABS_IADC_ENABLED
	depends on CLOCK_CONTROL
	select SILABS_SISDK_IADC
	select ADC_CONFIGURABLE_INPUTS
	help
	  Enable the driver implementation for Silabs Incremental ADC

if ADC_SILABS_IADC

config ADC_SILABS_IADC_DMA
	bool "Silabs IADC async DMA support"
	depends on DMA
	help
	  Enable DMA support with the Silabs IADC driver.
	  This allows ADC conversions to be performed (asynchronously or not)
	  using DMA for improved performance.

endif

config ADC_SILABS_SIWX91X
	bool "Silabs Siwx91x MCU ADC driver"
	default y
	depends on DT_HAS_SILABS_SIWX91X_ADC_ENABLED
	depends on CLOCK_CONTROL
	select ADC_CONFIGURABLE_INPUTS
	select PINCTRL
	help
	  Enable the driver implementation for the Silabs Siwx91x ADC
```

## drivers/adc/Kconfig.siwx91x
```kconfig
# Copyright (c) 2025 Silicon Laboratories Inc.
# SPDX-License-Identifier: Apache-2.0

config ADC_SILABS_SIWX91X
	bool "Silabs Siwx91x MCU ADC driver"
	default y
	depends on DT_HAS_SILABS_SIWX91X_ADC_ENABLED
	select ADC_CONFIGURABLE_INPUTS
	select PINCTRL
	help
	  Enable the driver implementation for the Silabs Siwx91x ADC
```

## drivers/adc/Kconfig.smartbond
```kconfig
# ADC configuration options

# Copyright (c) 2023 Renesas Electronics Corporation
# SPDX-License-Identifier: Apache-2.0

config ADC_SMARTBOND_GPADC
	bool "Renesas SmartBond(tm) ADC driver for ADC"
	default y
	depends on DT_HAS_RENESAS_SMARTBOND_ADC_ENABLED
	select ADC_CONFIGURABLE_INPUTS
	help
	  Enable support for ADC driver for Renesas SmartBond(tm) MCU series.

config ADC_SMARTBOND_SDADC
	bool "Renesas SmartBond(tm) ADC driver for Sigma-Delta ADC"
	default y
	depends on DT_HAS_RENESAS_SMARTBOND_SDADC_ENABLED
	select ADC_CONFIGURABLE_INPUTS
	help
	  Enable support for ADC driver for Renesas SmartBond(tm) MCU series.
```

## drivers/adc/Kconfig.stm32f4
```kconfig
# Kconfig - ADC configuration options

#
# Copyright (c) 2015 Intel Corporation
#
# SPDX-License-Identifier: Apache-2.0
#

menuconfig ADC_STM32F4
	bool "STM32F4 ADC driver"
	depends on SOC_FAMILY_STM32
	select USE_STM32_HAL_GPIO
	select USE_STM32_HAL_GPIO_EX
	select USE_STM32_HAL_ADC
	select USE_STM32_HAL_ADC_EX
	select USE_STM32_HAL_CORTEX
	select USE_STM32_HAL_UART
	select USE_STM32_HAL_DFSDM
	select USE_STM32_HAL_DFSDM_EX
	select USE_STM32_HAL_DMA
	select USE_STM32_HAL_DMA_EX
	select USE_STM32_HAL_RCC
	select USE_STM32_HAL_RCC_EX

	help
		Enable the driver implementation for the stm32f4xx ADC

if ADC_STM32F4

	menu ADC_0
		config ADC0_CHAN0
			bool "channel 0 (PA0)"
			default n
			depends on ADC_0
			help
			  Enables ADC channel 0 at pin PA0

		config ADC0_CHAN1
			bool "channel 1 (PA1)"
			default n
			depends on ADC_0
			help
			  Enables ADC channel 1 at pin PA1

		config ADC0_CHAN2
			bool "channel 2 (PA2)"
			default n
			depends on ADC_0
			help
			  Enables ADC channel 2  at pin PA2

		config ADC0_CHAN3
			bool "channel 3 (PA3)"
			default n
			depends on ADC_0
			help
			  Enables ADC channel 3 at pin PA3

		config ADC0_CHAN4
			bool "channel 4 (PA4)"
			default n
			depends on ADC_0
			help
			  Enables ADC channel 4 at pin PA4

		config ADC0_CHAN5
			bool "channel 5 (PA5)"
			default n
			depends on ADC_0
			help
			  Enables ADC channel 5 at pin PA5

		config ADC0_CHAN6
			bool "channel 6 (PA6)"
			default n
			depends on ADC_0
			help
			  Enables ADC channel 6 at pin PA6

		config ADC0_CHAN7
			bool "channel 7 (PA7)"
			default n
			depends on ADC_0
			help
			  Enables ADC channel 7 at pin PA7

		config ADC0_CHAN8
			bool "channel 8 (PB0)"
			default n
			depends on ADC_0
			help
			  Enables ADC channel 8 at pin PB0

		config ADC0_CHAN9
			bool "channel 9 (PB1)"
			default n
			depends on ADC_0
			help
			  Enables ADC channel 9 at pin PB1

		config ADC0_CHAN10
			bool "channel 10 (PC0)"
			default n
			depends on ADC_0
			help
			  Enables ADC channel 10 at pin PC0

		config ADC0_CHAN11
			bool "channel 11 (PC1)"
			default n
			depends on ADC_0
			help
			  Enables ADC channel 11  at pin PC1

		config ADC0_CHAN12
			bool "channel 12 (PC2)"
			default n
			depends on ADC_0
			help
			  Enables ADC channel 12 at pin PC2

		config ADC0_CHAN13
			bool "channel 13 (PC3)"
			default n
			depends on ADC_0
			help
			  Enables ADC channel 13 at pin PC3

		config ADC0_CHAN14
			bool "channel 14 (PC4)"
			default n
			depends on ADC_0
			help
			  Enables ADC channel 14 at pin PC4

		config ADC0_CHAN15
			bool "channel 15 (PC5)"
			default n
			depends on ADC_0
			help
			  Enables ADC channel 15 at pin PC5

		config ADC0_CHAN_TEMP
			bool "channel 16 (temp)"
			default n
			depends on ADC_0
			help
				Enables ADC temperature channel

		config ADC0_CHAN_VREFINT
			bool "channel 17 (Vrefint)"
			default n
			depends on ADC_0
			help
				Enables ADC internal voltage reference channel

		config ADC0_CHAN_VABT
			bool "channel 18 (VBat)"
			default n
			depends on ADC_0
			help
				Enables ADC voltage battery channel
	endmenu

	menu ADC_1
		config ADC1_CHAN0
			bool "channel 0 (PA0)"
			default n
			depends on ADC_1
			help
			  Enables ADC channel 0 at pin PA0

		config ADC1_CHAN1
			bool "channel 1 (PA1)"
			default n
			depends on ADC_1
			help
			  Enables ADC channel 1 at pin PA1

		config ADC1_CHAN2
			bool "channel 2 (PA2)"
			default n
			depends on ADC_1
			help
			  Enables ADC channel 2  at pin PA2

		config ADC1_CHAN3
			bool "channel 3 (PA3)"
			default n
			depends on ADC_1
			help
			  Enables ADC channel 3 at pin PA3

		config ADC1_CHAN4
			bool "channel 4 (PA4)"
			default n
			depends on ADC_1
			help
			  Enables ADC channel 4 at pin PA4

		config ADC1_CHAN5
			bool "channel 5 (PA5)"
			default n
			depends on ADC_1
			help
			  Enables ADC channel 5 at pin PA5

		config ADC1_CHAN6
			bool "channel 6 (PA6)"
			default n
			depends on ADC_1
			help
			  Enables ADC channel 6 at pin PA6

		config ADC1_CHAN7
			bool "channel 7 (PA7)"
			default n
			depends on ADC_1
			help
			  Enables ADC channel 7 at pin PA7

		config ADC1_CHAN8
			bool "channel 8 (PB0)"
			default n
			depends on ADC_1
			help
			  Enables ADC channel 8 at pin PB0

		config ADC1_CHAN9
			bool "channel 9 (PB1)"
			default n
			depends on ADC_1
			help
			  Enables ADC channel 9 at pin PB1

		config ADC1_CHAN10
			bool "channel 10 (PC0)"
			default n
			depends on ADC_1
			help
			  Enables ADC channel 10 at pin PC0

		config ADC1_CHAN11
			bool "channel 11 (PC1)"
			default n
			depends on ADC_1
			help
			  Enables ADC channel 11  at pin PC1

		config ADC1_CHAN12
			bool "channel 12 (PC2)"
			default n
			depends on ADC_1
			help
			  Enables ADC channel 12 at pin PC2

		config ADC1_CHAN13
			bool "channel 13 (PC3)"
			default n
			depends on ADC_1
			help
			  Enables ADC channel 13 at pin PC3

		config ADC1_CHAN14
			bool "channel 14 (PC4)"
			default n
			depends on ADC_1
			help
			  Enables ADC channel 14 at pin PC4

		config ADC1_CHAN15
			bool "channel 15 (PC5)"
			default n
			depends on ADC_1
			help
			  Enables ADC channel 15 at pin PC5

		config ADC1_CHAN_TEMP
			bool "channel 16 (temp)"
			default n
			depends on ADC_1
			help
				Enables ADC temperature channel

		config ADC1_CHAN_VREFINT
			bool "channel 17 (Vrefint)"
			default n
			depends on ADC_1
			help
				Enables ADC internal voltage reference channel

		config ADC1_CHAN_VABT
			bool "channel 18 (VBat)"
			default n
			depends on ADC_1
			help
				Enables ADC voltage battery channel
	endmenu

	menu ADC_2
		config ADC2_CHAN0
			bool "channel 0 (PA0)"
			default n
			depends on ADC_2
			help
			  Enables ADC channel 0 at pin PA0


		config ADC2_CHAN1
			bool "channel 1 (PA1)"
			default n
			depends on ADC_2
			help
			  Enables ADC channel 1 at pin PA1

		config ADC2_CHAN2
			bool "channel 2 (PA2)"
			default n
			depends on ADC_2
			help
			  Enables ADC channel 2  at pin PA2

		config ADC2_CHAN3
			bool "channel 3 (PA3)"
			default n
			depends on ADC_2
			help
			  Enables ADC channel 3 at pin PA3

		config ADC2_CHAN10
			bool "channel 10 (PC0)"
			default n
			depends on ADC_2
			help
			  Enables ADC channel 10 at pin PC0

		config ADC2_CHAN11
			bool "channel 11 (PC1)"
			default n
			depends on ADC_2
			help
			  Enables ADC channel 11  at pin PC1

		config ADC2_CHAN12
			bool "channel 12 (PC2)"
			default n
			depends on ADC_2
			help
			  Enables ADC channel 12 at pin PC2

		config ADC2_CHAN13
			bool "channel 13 (PC3)"
			default n
			depends on ADC_2
			help
			  Enables ADC channel 13 at pin PC3

		config ADC2_CHAN_TEMP
			bool "channel 16 (temp)"
			default n
			depends on ADC_2
			help
				Enables ADC temperature channel

		config ADC2_CHAN_VREFINT
			bool "channel 17 (Vrefint)"
			default n
			depends on ADC_2
			help
				Enables ADC internal voltage reference channel

		config ADC2_CHAN_VABT
			bool "channel 18 (VBat)"
			default n
			depends on ADC_2
			help
				Enables ADC voltage battery channel
	endmenu

endif # ADC_STM32F4
```

## drivers/adc/Kconfig.test
```kconfig
# Copyright (c) 2021, Commonwealth Scientific and Industrial Research
# Organisation (CSIRO) ABN 41 687 119 230.
# SPDX-License-Identifier: Apache-2.0

config ADC_TEST
	bool "Dummy stub ADC driver for vnd,adc devices"
	depends on DT_HAS_VND_ADC_ENABLED
	default y
```
