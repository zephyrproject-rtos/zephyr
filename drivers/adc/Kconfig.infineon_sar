## drivers/adc/Kconfig.mcp356x
```kconfig
# MCP356x ADC configuration options

# Copyright (c) 2022 Trent Piepho <trent.piepho@igorinstitute.com>
# SPDX-License-Identifier: Apache-2.0

config ADC_MCP356X
	bool "MCP3561/2/4 driver"
	depends on SPI
	select ADC_CONFIGURABLE_INPUTS
	help
	  Enable MCP3561/2/4 ADC driver.

	  The MCP3561/2/4 are 2/4/8 channel 24-bit A/D converters
	  with a SPI interface.

if ADC_MCP356X

config ADC_MCP356X_USE_INTERNAL_TIMER
	bool "Use internal ADC timer and continuous mode"
	default n
	help
	  This will use the timer in the ADC to create the delay between
	  samples.  The ADC operates in continuous mode when doing this.  When
	  disabled, a Zephyr system timer is used to start each conversion in
	  one-shot mode, which is now most other ADC drivers work.

	  The internal ADC timer will produce samples with less jitter, as
	  Zephyr interrupt and thread sheduling delays won't affect sampling
	  time.	 And it avoids SPI traffic to start each conversion.  However,
	  there are limitation on what the ADC timer can do as well as accurate
	  issues if not using an external MCLK.	 See the driver for more
	  details.

config ADC_MCP356X_OSR_FIXED
	bool "Fixed Oversampling rate"
	default y
	help
	  Use a fixed OSR value.  The OSR affects the output data rate as well
	  as the effective number of bits.

	  When this option is off, it can be set per ADC sequence in the
	  'oversampling' field.	 However, the value is not the power of 2 number
	  of samples, as specified in the Zephyr ADC API, but the code from the
	  table 5-6 in the datasheet.  This is a ΔΣ ADC and its oversampling
	  isn't quite the same thing as the successive approximation ADC the API
	  was designed for.

	  Thus, code written to the Zephyr API will not set oversampling
	  correctly.  Turn this option on and configure the OSR kernel.	 If code
	  is written specifically to use this ADC, then runtime control of OSR
	  can be done by turning this option off.

config ADC_MCP356X_OSR
	hex "OSR Value" if ADC_MCP356X_OSR_FIXED
	default 0x3
	range 0x0 0xf
	help
	  Value to use as OSR in fixed mode.  See datasheet table 5-6.


config ADC_MCP356X_ACQUISITION_THREAD_STACK_SIZE
	int "Stack size for the ADC data acquisition thread"
	default 512
	help
	  Size of the stack used for the internal data acquisition
	  thread.

config ADC_MCP356X_ACQUISITION_THREAD_PRIO
	int "Priority for the ADC data acquisition thread"
	default 0
	help
	  Priority level for the internal ADC data acquisition thread.

endif # ADC_MCP356X
```

## drivers/adc/Kconfig.mcp356xr
```kconfig
# Copyright (c) 2024 Syslinbit SCOP SAS
# SPDX-License-Identifier: Apache-2.0

config ADC_MCP356XR
	bool "MCP3561R/2R/4R driver"
	default y
	depends on DT_HAS_MICROCHIP_MCP356XR_ENABLED
	select SPI
	select ADC_CONFIGURABLE_INPUTS
	help
	  Enable MCP3561R/2R/4R ADC driver.

if ADC_MCP356XR

config ADC_MCP356XR_THREAD_STACK_SIZE
	int "Stack size for the ADC thread"
	default 512
	help
	  Size of the stack used for the internal ADC thread.

config ADC_MCP356XR_THREAD_PRIORITY
	int "Priority for the ADC thread"
	default 0
	help
	  Priority level for the internal ADC thread.

config ADC_MCP356XR_ADC_CHANNEL_COUNT
	int "Number of ADC channels"
	range 1 32
	default 1
	help
	  Number of ADC channels the driver must support. Each channel
	  requires 3 bytes of RAM to store the ADC settings to be used
	  for this channel.

config ADC_MCP356XR_USE_READ_CRC
	bool "Use CRC to check data received from the ADC"
	default y
	help
	  Enables the use of CRC on read communications to check integrity
	  of received data from the ADC.

config ADC_MCP356XR_POLL
	bool "Poll the ADC instead of using the IRQ pin"
	help
	  Regularly poll the ADC to retrieve status flags instead of
	  waiting for the ADC triggered IRQ. Useful in case the IRQ
	  pin of the ADC is not wired.

if ADC_MCP356XR_POLL
config ADC_MCP356XR_POLLING_PERIOD_MS
	int "Time to wait between two ADC polling in milliseconds"
	default 1
	help
	  Time the driver's internal acquisition thread will wait
	  between two ADC polling (in milliseconds).

endif #ADC_MCP356XR_POLL

endif # ADC_MCP356XR
```

## drivers/adc/Kconfig.mcp3914
```kconfig
# Copyright 2013 EVOS Energy Pty Ltd
#
#  Licensed under the Apache License, Version 2.0 (the "License");
#  you may not use this file except in compliance with the License.
#  You may obtain a copy of the License at
#
#      http://www.apache.org/licenses/LICENSE-2.0
#
#  Unless required by applicable law or agreed to in writing, software
#  distributed under the License is distributed on an "AS IS" BASIS,
#  WITHOUT WARRANTIES OR CONDITIONS OF ANY KIND, either express or implied.
#  See the License for the specific language governing permissions and
#  limitations under the License.

# MCP3914 ADC configuration options

config ADC_MCP3914
	bool "MCP3914 driver"
	default y
	depends on DT_HAS_MICROCHIP_MCP3914_ENABLED
	select SPI
	help
	  Enable MCP3914 ADC driver.

	  The MCP3914 is an 8 channel 24-bit A/D converter
	  with SPI interface.

if ADC_MCP3914

config ADC_MCP3914_ACQUISITION_THREAD_STACK_SIZE
	int "Stack size for the ADC data acquisition thread"
	default 768
	help
	  Size of the stack used for the internal data acquisition
	  thread.

config ADC_MCP3914_ACQUISITION_THREAD_PRIO
	int "Priority for the ADC data acquisition thread"
	default -5
	help
	  Priority level for the internal ADC data acquisition thread.

endif # ADC_MCP3914
```

## drivers/adc/Kconfig.mcux
```kconfig
# ADC configuration options

# Copyright (c) 2015 Intel Corporation
# SPDX-License-Identifier: Apache-2.0

config ADC_MCUX_ADC12
	bool "MCUX ADC12 driver"
	default y
	depends on DT_HAS_NXP_ADC12_ENABLED
	select PINCTRL
	help
	  Enable the MCUX ADC12 driver.

config ADC_MCUX_ADC16
	bool "MCUX ADC16 driver"
	default y
	depends on DT_HAS_NXP_KINETIS_ADC16_ENABLED
	select PINCTRL
	help
	  Enable the MCUX ADC16 driver.

config ADC_MCUX_12B1MSPS_SAR
	bool "MCUX 12B1MSPS SAR ADC driver"
	default y
	select PINCTRL
	depends on DT_HAS_NXP_MCUX_12B1MSPS_SAR_ENABLED
	help
	  Enable the MCUX 12B1MSPS SAR ADC driver.

config ADC_MCUX_LPADC
	bool "MCUX LPADC driver"
	default y
	select ADC_CONFIGURABLE_INPUTS
	select REGULATOR
	select PINCTRL
	depends on DT_HAS_NXP_LPC_LPADC_ENABLED
	help
	  Enable the MCUX LPADC driver.

config ADC_NXP_SAR_ADC
	bool "NXP SAR ADC driver"
	default y
	select ADC_CONFIGURABLE_INPUTS
	depends on DT_HAS_NXP_SAR_ADC_ENABLED
	help
	  Enable the NXP SAR ADC driver.

config ADC_MCUX_GAU
	bool "MCUX GAU ADC driver"
	default y
	depends on DT_HAS_NXP_GAU_ADC_ENABLED
	select ADC_CONFIGURABLE_INPUTS
	help
	  Enable the GAU ADC driver

if ADC_MCUX_ADC16

choice
	prompt "Clock Divide Selection"
	default ADC_MCUX_ADC16_CLK_DIV_RATIO_1

config ADC_MCUX_ADC16_CLK_DIV_RATIO_1
	bool "Divide ratio is 1"

config ADC_MCUX_ADC16_CLK_DIV_RATIO_2
	bool "Divide ratio is 2"

config ADC_MCUX_ADC16_CLK_DIV_RATIO_4
	bool "Divide ratio is 4"

config ADC_MCUX_ADC16_CLK_DIV_RATIO_8
	bool "Divide ratio is 8"

endchoice

choice ADC_MCUX_ADC16_VREF
	prompt "Voltage Reference Selection"
	default ADC_MCUX_ADC16_VREF_DEFAULT

config ADC_MCUX_ADC16_VREF_DEFAULT
	bool "Default voltage reference pair V_REFH and V_REFL"

config ADC_MCUX_ADC16_VREF_ALTERNATE
	bool "Alternate reference pair"

endchoice

config ADC_MCUX_ADC16_ENABLE_EDMA
	bool "EDMA for adc driver"
	depends on DMA_MCUX_EDMA
	help
	  Enable the MCUX ADC16 driver.

if ADC_MCUX_ADC16_ENABLE_EDMA

config ADC_MCUX_ADC16_HW_TRIGGER
	bool "ADC HW TRIGGER"
	default y
	help
	  Support HW Trigger ADC

endif # ADC_MCUX_ADC16_ENABLE_EDMA

endif # ADC_MCUX_ADC16


if ADC_MCUX_LPADC

config LPADC_DO_OFFSET_CALIBRATION
	bool "Do offset calibration"
	help
	  Do offset calibration

config LPADC_CHANNEL_COUNT
	int "LPADC channel count"
	default 15
	range 1 15
	help
	  Amount of hardware command channels to use, reduce to save RAM.
	  The user can reduce this value if their application uses fewer than
	  15 ADC channels. This value corresponds to how many of the CMD
	  registers can be configured within the ADC.

config ADC_MCUX_LPADC_DMA_DRIVEN
	bool "Use DMA to transfer data"
	select DMA
	depends on $(dt_compat_any_has_prop,$(DT_COMPAT_NXP_LPC_LPADC),dmas) && \
		   $(dt_compat_any_has_prop,$(DT_COMPAT_NXP_LPC_LPADC),dma-names)
	help
	  Use DMA in the LPADC driver to transfer data.

endif # ADC_MCUX_LPADC

if ADC_NXP_SAR_ADC

config ADC_NXP_SAR_ADC_INTERRUPT
	bool "NXP SAR ADC interrupt-driven mode"
	help
	  Use interrupt-driven conversions. When enabled the driver waits
	  on the hardware end-of-conversion interrupt for each sample.

config ADC_NXP_SAR_ADC_INTERRUPT_TIMEOUT
	int "NXP SAR ADC interrupt timeout in us"
	default 0
	depends on ADC_NXP_SAR_ADC_INTERRUPT
	help
	  Timeout in microseconds to wait for the ECH interrupt.
	  Set to 0 to wait forever.

config ADC_NXP_SAR_ADC_POLL_TIMEOUT
	int "NXP SAR ADC poll timeout in us"
	default 1000
	depends on !ADC_NXP_SAR_ADC_INTERRUPT
	help
	  Timeout in microseconds for polling mode conversions.
	  Only used when ADC_NXP_SAR_ADC_INTERRUPT is not enabled.

endif # ADC_NXP_SAR_ADC
```

## drivers/adc/Kconfig.mec5
```kconfig
# Microchip MEC5 HAL ADC SAR configuration

# Copyright (c) 2024 Microchip Technology Inc.
# SPDX-License-Identifier: Apache-2.0

config ADC_MEC5_SAR
	bool "Microchip MEC5 HAL based ADC SAR driver"
	default y
	depends on DT_HAS_MICROCHIP_MEC5_ADC_SAR_ENABLED
	help
	  Enable ADC SAR driver for Microchip MEC5 HAL based MCU series.
```

## drivers/adc/Kconfig.nct
```kconfig
# NCT ADC driver configuration options

# Copyright (c) 2025 Nuvoton Technology Corporation.
# SPDX-License-Identifier: Apache-2.0

config ADC_NCT
	bool "Nuvoton NCT ADC driver"
	default y
	depends on DT_HAS_NUVOTON_NCT_ADC_ENABLED
	help
	  This option enables the ADC driver for NCT family of
	  processors.
	  Say y if you wish to use ADC channels on NCT MCU.
```

## drivers/adc/Kconfig.npcm
```kconfig
# NPCM ADC driver configuration options

# Copyright (c) 2024 Nuvoton Technology Corporation.
# SPDX-License-Identifier: Apache-2.0

config ADC_NPCM
	bool "Nuvoton NPCM ADC driver"
	default y
	depends on DT_HAS_NUVOTON_NPCM_ADC_ENABLED
	help
	  This option enables the ADC driver for NPCM family of
	  processors.
	  Say y if you wish to use ADC channels on NPCM MCU.
```

## drivers/adc/Kconfig.npcx
```kconfig
# NPCX ADC driver configuration options

# Copyright (c) 2020 Nuvoton Technology Corporation.
# SPDX-License-Identifier: Apache-2.0

config ADC_NPCX
	bool "Nuvoton NPCX embedded controller (EC) ADC driver"
	default y
	depends on DT_HAS_NUVOTON_NPCX_ADC_ENABLED
	help
	  This option enables the ADC driver for NPCX family of
	  processors.
	  Say y if you wish to use ADC channels on NPCX MCU.

if ADC_NPCX

config ADC_NPCX_CMP_V1
	bool "ADC comparator version 1 support"
	default y if SOC_SERIES_NPCX7 || SOC_SERIES_NPCX9
	help
	  This option enables ADC comparator V1 support.

config ADC_NPCX_CMP_V2
	bool "ADC comparator version 2 support"
	default y if SOC_SERIES_NPCX4
	help
	  This option enables ADC comparator V2 support.

endif #ADC_NPCX
```

## drivers/adc/Kconfig.nrfx
```kconfig
# ADC configuration options

# Copyright (c) 2018, Nordic Semiconductor ASA
# SPDX-License-Identifier: Apache-2.0

# Workaround for not being able to have commas in macro arguments
DT_COMPAT_NORDIC_NRF_ADC   := nordic,nrf-adc
DT_COMPAT_NORDIC_NRF_SAADC := nordic,nrf-saadc

config ADC_NRFX_ADC
	bool "nRF ADC nrfx driver"
	default y
	depends on HAS_HW_NRF_ADC && $(dt_nodelabel_has_compat,adc,$(DT_COMPAT_NORDIC_NRF_ADC))
	select NRFX_ADC
	select ADC_CONFIGURABLE_INPUTS
	help
	  Enable support for nrfx ADC driver for nRF51 MCU series.

config ADC_NRFX_ADC_CHANNEL_COUNT
	int "Number of ADC channels"
	depends on ADC_NRFX_ADC
	range 1 8
	default 1
	help
	  Number of ADC channels to be supported by the driver. Each channel
	  needs a dedicated structure in RAM that stores the ADC settings
	  to be used when sampling this channel.

config ADC_NRFX_SAADC
	bool "nRF SAADC nrfx driver"
	default y
	depends on HAS_HW_NRF_SAADC && $(dt_nodelabel_has_compat,adc,$(DT_COMPAT_NORDIC_NRF_SAADC))
	select ADC_CONFIGURABLE_INPUTS
	help
	  Enable support for nrfx SAADC driver.
```

## drivers/adc/Kconfig.numaker
```kconfig
# NUMAKER ADC Driver configuration options

# Copyright (c) 2023 Nuvoton Technology Corporation.
# SPDX-License-Identifier: Apache-2.0

config ADC_NUMAKER
	bool "Nuvoton NuMaker MCU ADC driver"
	default y
	select HAS_NUMAKER_ADC
	depends on DT_HAS_NUVOTON_NUMAKER_ADC_ENABLED
	help
	  This option enables the ADC driver for Nuvoton NuMaker family of
	  processors.
	  Say y if you wish to enable NuMaker ADC.
```
