## drivers/adc/Kconfig.infineon_sar
```kconfig
# Copyright (c) 2025 Infineon Technologies AG,
# or an affiliate of Infineon Technologies AG.
#
# SPDX-License-Identifier: Apache-2.0

# Infineon SAR ADC configuration options

config ADC_INFINEON_SAR
	bool "Infineon SAR ADC driver"
	default y
	depends on DT_HAS_INFINEON_SAR_ADC_ENABLED
	select ADC_CONFIGURABLE_INPUTS
	select USE_INFINEON_ADC
	help
	  Enable SAR ADC driver for Infineon devices.

config ADC_INFINEON_SAR_SARSEQ_SWITCHING
	bool "Use SARSEQ hardware switch control"
	default y
	depends on ADC_INFINEON_SAR
	help
	  Enable SARSEQ (hardware sequencer) control of SAR ADC input switches.
	  If disabled, the driver relies on firmware-controlled switches only.
```

## drivers/adc/Kconfig.intel_quark
```kconfig
# Kconfig - ADC configuration options

#
# Copyright (c) 2018-2019 Intel Corporation
#
# SPDX-License-Identifier: Apache-2.0
#

menuconfig ADC_INTEL_QUARK_SE_C1000_SS
	bool "ADC Driver for Intel Quark SE C1000 Sensor Subsystem"
	depends on SOC_QUARK_SE_C1000_SS
	select ADC_0
	help
	  Enable the ADC driver implementation of the Intel Quark SE C1000
	  Sensor Subsystem.

if ADC_INTEL_QUARK_SE_C1000_SS

config ADC_INTEL_QUARK_SE_C1000_SS_CALIBRATION
	bool "Enable Calibration"
	default y
	help
	  Enables ADC to run with a calibrated output at the
	  expense of execution speed when exiting low power states.
	  If disabled, the ADC will require the application/system-integrator
	  to provide a calibration method.

choice
	prompt "Output Mode"
	default ADC_INTEL_QUARK_SE_C1000_SS_SERIAL
	help
	  ADC output mode: parallel or serial.

config ADC_INTEL_QUARK_SE_C1000_SS_SERIAL
	bool "Serial"

config ADC_INTEL_QUARK_SE_C1000_SS_PARALLEL
	bool "Parallel"

endchoice

choice
	prompt "Capture Mode"
	default ADC_INTEL_QUARK_SE_C1000_SS_RISING_EDGE
	help
	  ADC controller capture mode:
	  by rising or falling edge of adc_clk

config ADC_INTEL_QUARK_SE_C1000_SS_RISING_EDGE
	bool "Rising Edge"

config ADC_INTEL_QUARK_SE_C1000_SS_FALLING_EDGE
	bool "Falling Edge"

endchoice

config ADC_INTEL_QUARK_SE_C1000_SS_SERIAL_DELAY
	int "Serial Delay"
	default 1
	help
	  Number of ADC clock ticks that the first bit of
	  the serial output is delayed after the conversion
	  has started.

config ADC_INTEL_QUARK_SE_C1000_SS_CLOCK_RATIO
	int "Clock Ratio"
	default 1024
	help
	  ADC Clock Ratio

endif # ADC_INTEL_QUARK_SE_C1000_SS

menuconfig ADC_INTEL_QUARK_D2000
	bool "ADC Driver for Intel Quark D2000"
	depends on SOC_QUARK_D2000
	select ADC_0
	help
	  Enable the ADC driver implementation of the Intel Quark D2000.

if ADC_INTEL_QUARK_D2000

config ADC_INTEL_QUARK_D2000_CALIBRATION
	bool "Enable Calibration"
	default y
	help
	  Enables ADC to run with a calibrated output at the
	  expense of execution speed when exiting low power states.
	  If disabled, the ADC will require the application/system-integrator
	  to provide a calibration method.

config ADC_INTEL_QUARK_D2000_CLOCK_RATIO
	int "Clock Ratio"
	default 200
	help
	  ADC Clock Ratio

endif # ADC_INTEL_QUARK_D2000
```

## drivers/adc/Kconfig.it51xxx
```kconfig
# ADC configuration options

# Copyright (c) 2025 ITE Corporation. All Rights Reserved.
# SPDX-License-Identifier: Apache-2.0

config ADC_ITE_IT51XXX
	bool "ITE IT51XXX ADC driver"
	default y
	depends on DT_HAS_ITE_IT51XXX_ADC_ENABLED
	select PINCTRL
	help
	  This option enables the ADC driver for IT51XXX
	  family of processors.
	  Voltage range 0 to 3300mV.
	  Support 12-bit resolution.
	  Support 8 channels: ch0~ch7.

if ADC_ITE_IT51XXX

config ADC_IT51XXX_VOL_FULL_SCALE
	bool "ADC internal voltage as full-scale"
	default y
	help
	  This option enables ADC internal reference
	  voltage as full-scale 3300mV.

endif # ADC_ITE_IT51XXX
```

## drivers/adc/Kconfig.it8xxx2
```kconfig
# ADC configuration options

# Copyright (c) 2020 ITE Corporation. All Rights Reserved.
# SPDX-License-Identifier: Apache-2.0

config ADC_ITE_IT8XXX2
	bool "ITE IT8XXX2 ADC driver"
	default y
	depends on DT_HAS_ITE_IT8XXX2_ADC_ENABLED
	select PINCTRL
	help
	  This option enables the ADC driver for IT8XXX2
	  family of processors.
	  Voltage range 0 to 3000mV.
	  Support 10-bit resolution.
	  Support 8 channels: ch0~ch7.

if ADC_ITE_IT8XXX2

config ADC_IT8XXX2_VOL_FULL_SCALE
	bool "ADC internal voltage as full-scale"
	help
	  This option enables ADC internal reference
	  voltage as full-scale 3300mV.

config ADC_IT8XXX2_READING_TIMEOUT_MS
	int "IT8XXX2 ADC reading timeout (ms)"
	default 0
	help
	  Timeout in milliseconds for waiting on ADC data valid interrupt.
	  Set to 0 to wait forever (K_FOREVER).
	  If the timeout expires, the driver falls back to reading the
	  ADC value directly when valid data is available.

endif # ADC_ITE_IT8XXX2
```

## drivers/adc/Kconfig.kb1200
```kconfig
# ENE KB1200 ADC configuration

# Copyright (c) 2023 ENE Technology

config ADC_KB1200
	bool "ENE KB1200 ADC driver"
	depends on SOC_ENE_KB1200
	help
	  Enable ADC driver for ENE KB1200.
```

## drivers/adc/Kconfig.lmp90xxx
```kconfig
# LMP90xxx ADC configuration options

# Copyright (c) 2019 Vestas Wind Systems A/S
# SPDX-License-Identifier: Apache-2.0

config ADC_LMP90XXX
	bool "LMP90xxx driver"
	depends on SPI
	select ADC_CONFIGURABLE_INPUTS
	help
	  Enable LMP90xxx ADC driver.

	  The LMP90xxx is a multi-channel, low power sensor analog
	  frontend (AFE).

if ADC_LMP90XXX

config ADC_LMP90XXX_ACQUISITION_THREAD_STACK_SIZE
	int "Stack size for the ADC data acquisition thread"
	default 400
	help
	  Size of the stack used for the internal data acquisition
	  thread.

config ADC_LMP90XXX_ACQUISITION_THREAD_PRIO
	int "Priority for the ADC data acquisition thread"
	default 0
	help
	  Priority level for the internal ADC data acquisition thread.

config ADC_LMP90XXX_CRC
	bool "Use Cyclic Redundancy Check (CRC)"
	default y
	help
	  Use Cyclic Redundancy Check (CRC) to verify the integrity of
	  the data read from the LMP90xxx.

config ADC_LMP90XXX_GPIO
	bool "GPIO support"
	depends on GPIO
	select GPIO_LMP90XXX
	help
	  Enable GPIO child device support in the LMP90xxx ADC driver.

	  The GPIO functionality is handled by the LMP90xxx GPIO
	  driver.

endif # ADC_LMP90XXX
```

## drivers/adc/Kconfig.ltc2451
```kconfig
# Copyright (c) 2023 Brill Power
# SPDX-License-Identifier: Apache-2.0

config ADC_LTC2451
	bool "LTC2451 driver"
	default y
	depends on DT_HAS_LLTC_LTC2451_ENABLED
	select I2C
```

## drivers/adc/Kconfig.max11102_17
```kconfig
# Copyright (c) 2023 SILA  Embedded Solutions GmbH
#
# SPDX-License-Identifier: Apache-2.0

menuconfig ADC_MAX11102_17
	bool "Maxim Integrated MAX11102-MAX11117"
	default y
	depends on DT_HAS_MAXIM_MAX11102_ENABLED \
		|| DT_HAS_MAXIM_MAX11103_ENABLED \
		|| DT_HAS_MAXIM_MAX11105_ENABLED \
		|| DT_HAS_MAXIM_MAX11106_ENABLED \
		|| DT_HAS_MAXIM_MAX11110_ENABLED \
		|| DT_HAS_MAXIM_MAX11111_ENABLED \
		|| DT_HAS_MAXIM_MAX11115_ENABLED \
		|| DT_HAS_MAXIM_MAX11116_ENABLED \
		|| DT_HAS_MAXIM_MAX11117_ENABLED
	select SPI
	help
	  Enable the driver implementation for the MAX11102-MAX11117 family

config ADC_MAX11102_17_ACQUISITION_THREAD_INIT_PRIO
	int "ADC data acquisition thread priority"
	default 0
	depends on ADC_MAX11102_17 && ADC_ASYNC

config ADC_MAX11102_17_ACQUISITION_THREAD_STACK_SIZE
	int "Stack size for the ADC data acquisition thread"
	default 400
	depends on ADC_MAX11102_17 && ADC_ASYNC
	help
	  Size of the stack used for the internal data acquisition
	  thread.
```

## drivers/adc/Kconfig.max1125x
```kconfig
# MAX1125X ADC configuration options

# Copyright (c) 2023 Mustafa Abdullah Kus, Sparse Technology
# SPDX-License-Identifier: Apache-2.0

config ADC_MAX1125X
	bool "MAX1125X driver"
	default y
	depends on DT_HAS_MAXIM_MAX11254_ENABLED || DT_HAS_MAXIM_MAX11253_ENABLED
	select SPI
	select ADC_CONFIGURABLE_INPUTS
	help
	  Enable the driver implementation for the MAX1125X

if ADC_MAX1125X

config ADC_MAX1125X_INIT_PRIORITY
	int "Init priority"
	default 80
	help
	  ADS1X1X ADC device driver initialization priority.

config ADC_MAX1125X_ASYNC_THREAD_INIT_PRIORITY
	int "ADC MAX1125X async thread priority"
	default 0

config ADC_MAX1125X_ACQUISITION_THREAD_PRIORITY
	int "Priority for the ADC data acquisition thread"
	default 0
	help
	  Priority level for the internal ADC data acquisition thread.

config ADC_MAX1125X_ACQUISITION_THREAD_STACK_SIZE
	int "Stack size for the ADC data acquisition thread"
	default 400
	help
	  Size of the stack used for the internal data acquisition
	  thread.

endif # ADC_MAX1125X
```

## drivers/adc/Kconfig.max2253x
```kconfig
# Copyright (c) 2025 Gabriele Zampieri <opensource@arsenaling.com>
# SPDX-License-Identifier: Apache-2.0

config ADC_MAX2253X
	bool "MAX2253x ADC driver"
	depends on DT_HAS_MAXIM_MAX2253X_ENABLED
	select SPI
	default y
	help
	  Enable ADC driver for Maxim MAX2253X.

config ADC_MAX2253X_STREAM
	bool "MAX2253x streaming mode"
	depends on ADC_MAX2253X
	depends on SPI_RTIO
	help
	  Enable streaming mode for Maxim MAX2253x. Implies the use of interrupts.

config ADC_MAX2253X_INIT_PRIORITY
	int "Init priority"
	depends on ADC_MAX2253X
	default 80
	help
	  MAX2253X device driver initialization priority.

config ADC_MAX2253X_ASYNC_THREAD_INIT_PRIORITY
	int "ADC MAX2253X async thread priority"
	depends on ADC_MAX2253X
	default 0

config ADC_MAX2253X_ACQUISITION_THREAD_PRIORITY
	int "Priority for the ADC data acquisition thread"
	depends on ADC_MAX2253X
	default 0
	help
	  Priority level for the internal ADC data acquisition thread.

config ADC_MAX2253X_ACQUISITION_THREAD_STACK_SIZE
	int "Stack size for the ADC data acquisition thread"
	depends on ADC_MAX2253X
	default 400
	help
	  Size of the stack used for the internal data acquisition
	  thread.
```

## drivers/adc/Kconfig.max32
```kconfig
# ADI SoC ADC configuration options

# Copyright (c) 2023-2024 Analog Devices, Inc.
# SPDX-License-Identifier: Apache-2.0

config ADC_MAX32
	bool "MAX32 ADC driver"
	default y
	depends on DT_HAS_ADI_MAX32_ADC_ENABLED
	select PINCTRL
	help
	  Enable ADC driver for ADI MAX32xxx MCUs.

config ADC_MAX32_STREAM
	bool "Use FIFO to stream data"
	select ADC_ASYNC
	depends on ADC_MAX32
	depends on DT_HAS_ADI_MAX32_ADC_B_ME18_ENABLED
	help
	  Use this configuration option to enable streaming ADC data via RTIO.
```

## drivers/adc/Kconfig.mcp320x
```kconfig
# MCP320x ADC configuration options

# Copyright (c) 2020 Vestas Wind Systems A/S
# SPDX-License-Identifier: Apache-2.0

config ADC_MCP320X
	bool "MCP3204/MCP3208 driver"
	default y
	depends on DT_HAS_MICROCHIP_MCP3204_ENABLED || DT_HAS_MICROCHIP_MCP3208_ENABLED
	depends on SPI
	help
	  Enable MCP3204/MCP3208 ADC driver.

	  The MCP3204/MCP3208 are 4/8 channel 12-bit A/D converters
	  with SPI interface.

if ADC_MCP320X

config ADC_MCP320X_ACQUISITION_THREAD_STACK_SIZE
	int "Stack size for the ADC data acquisition thread"
	default 512
	help
	  Size of the stack used for the internal data acquisition
	  thread.

config ADC_MCP320X_ACQUISITION_THREAD_PRIO
	int "Priority for the ADC data acquisition thread"
	default 0
	help
	  Priority level for the internal ADC data acquisition thread.

endif # ADC_MCP320X
```

## drivers/adc/Kconfig.mcp3221
```kconfig
# MCP3221 ADC configuration options

# Copyright (c) 2026 Pierrick Curt
# SPDX-License-Identifier: Apache-2.0

config ADC_MCP3221
	bool "MCP3221 driver"
	default y
	depends on DT_HAS_MICROCHIP_MCP3221_ENABLED
	select I2C
	help
	  Enable MCP3221 ADC driver.

	  The MCP3221 is a 1-channel 12-bit A/D converter
	  with I2C interface.

if ADC_MCP3221

config ADC_MCP3221_ACQUISITION_THREAD_STACK_SIZE
	int "Stack size for the ADC data acquisition thread"
	default 512
	help
	  Size of the stack used for the internal data acquisition
	  thread.

config ADC_MCP3221_ACQUISITION_THREAD_PRIO
	int "Priority for the ADC data acquisition thread"
	default 0
	help
	  Priority level for the internal ADC data acquisition thread.

endif # ADC_MCP3221
```

## drivers/adc/Kconfig.mcp3425
```kconfig
# MCP3425 ADC configuration options

# Copyright (c) 2023 Alva Technology
# SPDX-License-Identifier: Apache-2.0

config ADC_MCP3425
	bool "MCP3425 driver"
	default y
	depends on DT_HAS_MICROCHIP_MCP3425_ENABLED
	select I2C
	select ADC_CONFIGURABLE_INPUTS
	help
	  Enable MCP3425 ADC driver.

if ADC_MCP3425

config ADC_MCP3425_INIT_PRIORITY
	int "ADC MCP3425 init priority"
	default 80

config ADC_MCP3425_ASYNC_THREAD_INIT_PRIO
	int "ADC MCP3425 async thread priority"
	default 0

config ADC_MCP3425_ACQUISITION_THREAD_STACK_SIZE
	int "Stack size for the ADC data acquisition thread"
	default 512
	help
	  Size of the stack used for the internal data acquisition
	  thread.

endif # ADC_MCP3425
```

## drivers/adc/Kconfig.mcp342x
```kconfig
# Copyright (c) 2025 Axel Utech <utech@sofiha.de>
# SPDX-License-Identifier: Apache-2.0

config ADC_MCP342X
	bool "Microchip MCP342X 16-Bit, Multi-Channel ΔΣ ADC"
	default y
	depends on DT_HAS_MICROCHIP_MCP3428_ENABLED \
		|| DT_HAS_MICROCHIP_MCP3427_ENABLED \
		|| DT_HAS_MICROCHIP_MCP3426_ENABLED
	select I2C
	help
	  Microchip MCP342X 16-Bit, Multi-Channel ΔΣ ADC

if ADC_MCP342X

config ADC_MCP342X_INIT_PRIORITY
	int "Priority for the driver initialization"
	default 80
	help
	  Fine tune the priority for the driver initialization. Make sure it's
	  higher (-> lower priority) than I2C_INIT_PRIORITY.

if ADC_ASYNC

config ADC_MCP342X_ACQUISITION_THREAD_PRIORITY
	int "Priority for the data acquisition thread"
	default 0
	help
	  Execution priority for the internal data acquisition thread.

config ADC_MCP342X_ACQUISITION_THREAD_STACK_SIZE
	int "Stack size for the data acquisition thread"
	default 512
	help
	  Stack size for the internal data acquisition thread. Requires room
	  for I2C operations.

endif # ADC_ASYNC

endif # ADC_MCP342X
```
