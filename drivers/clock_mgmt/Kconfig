## drivers/clock_mgmt/Kconfig
```kconfig
# Copyright 2024 NXP
# SPDX-License-Identifier: Apache-2.0

#
# Clock controller drivers
#
menuconfig CLOCK_MGMT
	bool "Clock management drivers"
	help
	  Enable support for clock management drivers. These drivers provide
	  clock configuration to the system via a series of setpoints, which
	  allow drivers to configure clocks based on their desired power
	  state

if CLOCK_MGMT

module = CLOCK_MGMT
module-str = clock management
source "subsys/logging/Kconfig.template.log_config"

config CLOCK_MGMT_SET_RATE
	bool "Support runtime rate setting"
	help
	  Allow clock consumers to request a given clock frequency via the
	  clock management framework. The framework will then configure the
	  clock tree so that the consumer is supplied with the closest
	  possible frequency to its request. Note that enabling this feature
	  will result in increased flash utilization

config CLOCK_MGMT_NOTIFY
	bool "Support clock rate change notifications"
	help
	  Support clock rate change notifications. When enabled, clock
	  consumers can register for a callback when the frequency of their
	  output clock changes.

endif # CLOCK_MGMT
```

## drivers/clock_mgmt/Kconfig.nxp_lpc55xxx
```kconfig
# Copyright 2024 NXP
# SPDX-License-Identifier: Apache-2.0

config CLOCK_MGMT_NXP_LPC55XXX
	bool "NXP LPC55xxx clock driver"
	default y
	depends on DT_HAS_NXP_LPC55XXX_SYSCON_ENABLED
	help
	  Enable support for NXP LPC55XXX syscon clock management driver
```

## drivers/clock_mgmt/nxp_syscon/Kconfig
```kconfig
# Copyright 2024 NXP
# SPDX-License-Identifier: Apache-2.0

config CLOCK_MGMT_NXP_SYSCON
	bool
	help
	  NXP SYSCON clock drivers

config CLOCK_MGMT_NXP_SYSCON_SOURCE
	bool "NXP syscon clock source driver"
	default y
	depends on DT_HAS_NXP_SYSCON_CLOCK_SOURCE_ENABLED
	select CLOCK_MGMT_NXP_SYSCON
	help
	  NXP SYSCON clock source driver

config CLOCK_MGMT_NXP_SYSCON_GATE
	bool "NXP syscon clock gate driver"
	default y
	depends on DT_HAS_NXP_SYSCON_CLOCK_GATE_ENABLED
	select CLOCK_MGMT_NXP_SYSCON
	help
	  NXP SYSCON clock gate driver

config CLOCK_MGMT_NXP_SYSCON_DIV
	bool "NXP syscon clock divider driver"
	default y
	depends on DT_HAS_NXP_SYSCON_CLOCK_DIV_ENABLED
	select CLOCK_MGMT_NXP_SYSCON
	help
	  NXP SYSCON clock divider driver

config CLOCK_MGMT_NXP_SYSCON_MUX
	bool "NXP syscon clock multiplexer driver"
	default y
	depends on DT_HAS_NXP_SYSCON_CLOCK_MUX_ENABLED
	select CLOCK_MGMT_NXP_SYSCON
	help
	  NXP SYSCON clock multiplexer driver

config CLOCK_MGMT_NXP_SYSCON_FLEXFRG
	bool "NXP syscon Flexcomm fractional rate generator driver"
	default y
	depends on DT_HAS_NXP_SYSCON_FLEXFRG_ENABLED
	select CLOCK_MGMT_NXP_SYSCON
	help
	  NXP SYSCON FLEXFRG driver

config CLOCK_MGMT_NXP_SYSCON_RTCCLK
	bool "NXP syscon rtc clock divider driver"
	default y
	depends on DT_HAS_NXP_SYSCON_RTCCLK_ENABLED
	select CLOCK_MGMT_NXP_SYSCON
	help
	  NXP SYSCON RTCCLK driver

config CLOCK_MGMT_NXP_LPC55SXX_PLL
	bool "NXP LPC55Sxxx PLL drivers"
	default y
	depends on DT_HAS_NXP_LPC55SXX_PLL0_ENABLED || \
		DT_HAS_NXP_LPC55SXX_PLL1_ENABLED || \
		DT_HAS_NXP_LPC55SXX_PLL_PDEC_ENABLED
	select CLOCK_MGMT_NXP_SYSCON
	help
	  NXP LPC55Sxxx PLL drivers
```

## drivers/clock_monitor/Kconfig
```kconfig
# SPDX-FileCopyrightText: 2026 NXP
# SPDX-License-Identifier: Apache-2.0

menuconfig CLOCK_MONITOR
	bool "Clock Monitor drivers"
	help
	  Enable the clock monitor driver class. Individual back-end drivers
	  for specific clock monitoring peripherals are selected by their
	  own Kconfig symbols sourced below.

if CLOCK_MONITOR

config CLOCK_MONITOR_INIT_PRIORITY
	int "clock_monitor init priority"
	default KERNEL_INIT_PRIORITY_DEVICE
	help
	  Device init priority for clock_monitor back-end drivers.

module = CLOCK_MONITOR
module-str = clock_monitor
source "subsys/logging/Kconfig.template.log_config"

rsource "Kconfig.nxp_cmu_fc"
rsource "Kconfig.nxp_cmu_fm"

endif # CLOCK_MONITOR
```

## drivers/clock_monitor/Kconfig.nxp_cmu_fc
```kconfig
# SPDX-FileCopyrightText: 2026 NXP
# SPDX-License-Identifier: Apache-2.0

config CLOCK_MONITOR_NXP_CMU_FC
	bool "NXP CMU_FC frequency check driver"
	default y
	depends on DT_HAS_NXP_CMU_FC_ENABLED
	help
	  Zephyr clock_monitor back-end wrapping the MCUX SDK fsl_cmu_fc HAL.
	  Provides WINDOW mode for clock frequency check.
```

## drivers/clock_monitor/Kconfig.nxp_cmu_fm
```kconfig
# Copyright (c) 2026 NXP
# SPDX-License-Identifier: Apache-2.0

config CLOCK_MONITOR_NXP_CMU_FM
	bool "NXP CMU_FM frequency meter driver"
	default y
	depends on DT_HAS_NXP_CMU_FM_ENABLED
	select HAS_MCUX
	help
	  Zephyr clock_monitor back-end wrapping the MCUX SDK fsl_cmu_fm HAL.
	  Provides METER mode for clock frequency measurement.
```

## drivers/clock_monitor/Kconfig.nxp_fmeas
```kconfig
# SPDX-FileCopyrightText: 2026 NXP
# SPDX-License-Identifier: Apache-2.0

config CLOCK_MONITOR_NXP_FMEAS
	bool "NXP BASIC FREQME (fmeas) frequency measurement driver"
	default y
	depends on DT_HAS_NXP_FMEAS_ENABLED
	select NXP_INPUTMUX
	help
	  Zephyr clock_monitor back-end for the NXP BASIC Frequency Measurement
	  (FREQME) block, wrapping the MCUX SDK fsl_fmeas HAL. This is the
	  single-register FREQMECTRL variant (RT6xx / RT5xx / RW6xx) with no
	  interrupt line: only MEASURE (one-shot) mode is supported and
	  completion is polled from a workqueue. Reference and target clocks are
	  routed through the INPUTMUX peripheral and the reference rate is queried
	  from clock_control. The measurement window is HW/HAL-fixed at 2^20
	  reference cycles.
```

## drivers/comparator/Kconfig
```kconfig
# Copyright (c) 2024 Nordic Semiconductor ASA
# SPDX-License-Identifier: Apache-2.0

menuconfig COMPARATOR
	bool "Comparator drivers"
	help
	  Enable comparator driver configuration.

if COMPARATOR

module = COMPARATOR
module-str = comparator
source "subsys/logging/Kconfig.template.log_config"

config COMPARATOR_INIT_PRIORITY
	int "COMPARATOR init priority"
	default KERNEL_INIT_PRIORITY_DEVICE
	help
	  Comparator device driver initialization priority.

rsource "Kconfig.fake_comp"
rsource "Kconfig.silabs_acmp"
rsource "Kconfig.it51xxx_vcmp"
rsource "Kconfig.mcux_acmp"
rsource "Kconfig.nxp_cmp"
rsource "Kconfig.nrf_comp"
rsource "Kconfig.nrf_lpcomp"
rsource "Kconfig.shell"
rsource "Kconfig.renesas_ra"

endif # COMPARATOR
```

## drivers/comparator/Kconfig.esp32_ana_cmpr
```kconfig
# Copyright (c) 2026 Espressif Systems (Shanghai) Co., Ltd.
# SPDX-License-Identifier: Apache-2.0

config COMPARATOR_ESP32_ANA_CMPR
	bool "ESP32 Analog Comparator (ana_cmpr) driver"
	default y
	depends on DT_HAS_ESPRESSIF_ESP32_ANA_CMPR_ENABLED
	help
	  Enable the driver for Espressif's analog comparator (ana_cmpr)
	  peripheral, present on the ESP32-P4, ESP32-C5, and ESP32-H2 SoCs.
```

## drivers/comparator/Kconfig.fake_comp
```kconfig
# Copyright (c) 2024 Nordic Semiconductor ASA
# SPDX-License-Identifier: Apache-2.0

config COMPARATOR_FAKE_COMP
	bool "Fake comparator driver"
	default y
	depends on DT_HAS_ZEPHYR_FAKE_COMP_ENABLED
	depends on ZTEST
```

## drivers/comparator/Kconfig.infineon_autanalog_ptcomp
```kconfig
# Copyright (c) 2026 Infineon Technologies AG,
# or an affiliate of Infineon Technologies AG.
#
# SPDX-License-Identifier: Apache-2.0

config COMPARATOR_INFINEON_AUTANALOG_PTCOMP
	bool "Infineon AutAnalog PTComp comparator driver"
	default y
	depends on DT_HAS_INFINEON_AUTANALOG_PTCOMP_COMP_ENABLED
	select MFD
	help
	  Enable the Infineon AutAnalog PTComp comparator driver.  Each
	  instance provides a single comparator output (Comp0 or Comp1)
	  with configurable input mux routing, power mode, and hysteresis.

config COMPARATOR_INFINEON_AUTANALOG_PTCOMP_INIT_PRIORITY
	int "Infineon AutAnalog PTComp comparator init priority"
	default 43
	depends on COMPARATOR_INFINEON_AUTANALOG_PTCOMP
	help
	  Init priority for the PTComp comparator driver.  Must be higher
	  (later) than the PTComp MFD init priority (default 42).
```

## drivers/comparator/Kconfig.infineon_hppass_csg
```kconfig
# SPDX-FileCopyrightText: Copyright (c) 2026 Infineon Technologies AG,
# or an affiliate of Infineon Technologies AG.
#
# SPDX-License-Identifier: Apache-2.0

config COMPARATOR_INFINEON_HPPASS_CSG
	bool "Infineon HPPASS CSG comparator driver"
	default y
	depends on DT_HAS_INFINEON_HPPASS_CSG_COMP_ENABLED
	depends on MFD_INFINEON_HPPASS_CSG
	help
	  Enable the comparator driver for the Infineon HPPASS CSG
	  block.  Each instance exposes the standard Zephyr comparator API
	  for one CSG slice.  The CSG MFD parent owns the combined comparator
	  interrupt and dispatches per-slice callbacks registered through
	  this driver.

config COMPARATOR_INFINEON_HPPASS_CSG_INIT_PRIORITY
	int "Infineon HPPASS CSG comparator init priority"
	default 50
	depends on COMPARATOR_INFINEON_HPPASS_CSG
	help
	  Initialization priority for the per-slice comparator child driver.
	  Must be higher (later) than CONFIG_MFD_INFINEON_HPPASS_CSG_INIT_PRIORITY
	  so the CSG MFD parent is ready to accept callback registrations
	  before this driver runs.
```

## drivers/comparator/Kconfig.it51xxx_vcmp
```kconfig
# ITE Voltage Comparator driver configuration options

# Copyright (c) 2025 ITE Technology Corporation.
# SPDX-License-Identifier: Apache-2.0

config COMPARATOR_IT51XXX_VCMP
	bool "ITE it51xxx Voltage Comparator"
	default y
	depends on ADC_ITE_IT51XXX
	depends on DT_HAS_ITE_IT51XXX_VCMP_ENABLED
	depends on DYNAMIC_INTERRUPTS
	help
	  This option enables the ITE it51xxx voltage comparator,
	  it51xxx supports three 10-bit threshold voltage comparator
	  channels, and the input of each comparator comes from ADC pin.
```

## drivers/comparator/Kconfig.mcux_acmp
```kconfig
# Copyright (c) 2024 Nordic Semiconductor ASA
# SPDX-License-Identifier: Apache-2.0

config COMPARATOR_MCUX_ACMP
	bool "NXP MCUX ACMP comparator driver"
	default y
	depends on DT_HAS_NXP_KINETIS_ACMP_ENABLED
	select PINCTRL
	select MCUX_ACMP
```

## drivers/comparator/Kconfig.nrf_comp
```kconfig
# Copyright (c) 2024 Nordic Semiconductor ASA
# SPDX-License-Identifier: Apache-2.0

config COMPARATOR_NRF_COMP
	bool "Nordic COMP comparator driver"
	default y
	depends on DT_HAS_NORDIC_NRF_COMP_ENABLED
	select NRFX_COMP
```

## drivers/comparator/Kconfig.nrf_lpcomp
```kconfig
# Copyright (c) 2024 Nordic Semiconductor ASA
# SPDX-License-Identifier: Apache-2.0

config COMPARATOR_NRF_LPCOMP
	bool "Nordic LPCOMP comparator driver"
	default y
	depends on DT_HAS_NORDIC_NRF_LPCOMP_ENABLED
	select NRFX_LPCOMP
```

## drivers/comparator/Kconfig.nrfx
```kconfig
# Comparator configuration options

# Copyright (c) 2023 Nordic Semiconductor ASA
# SPDX-License-Identifier: Apache-2.0

config COMPARATOR_NRFX_COMP
	bool "nRF COMP nrfx driver"
	default y
	depends on DT_HAS_NORDIC_NRF_COMP_ENABLED
	select NRFX_COMP
	help
	  Enable support for nRF COMP peripherals.

config COMPARATOR_NRFX_LPCOMP
	bool "nRF LPCOMP nrfx driver"
	default y
	depends on DT_HAS_NORDIC_NRF_LPCOMP_ENABLED
	select NRFX_LPCOMP
	help
	  Enable support for nRF LPCOMP peripherals.
```

## drivers/comparator/Kconfig.nxp_acomp
```kconfig
# Copyright 2025 NXP
# SPDX-License-Identifier: Apache-2.0

config COMPARATOR_NXP_ACOMP
	bool "NXP analog comparator driver"
	default y
	depends on DT_HAS_NXP_ACOMP_ENABLED
```

## drivers/comparator/Kconfig.nxp_cmp
```kconfig
# Copyright 2025  NXP
# SPDX-License-Identifier: Apache-2.0

config COMPARATOR_NXP_CMP
	bool "NXP comparator driver"
	default y
	depends on DT_HAS_NXP_CMP_ENABLED
	select PINCTRL
	select CLOCK_CONTROL
```

## drivers/comparator/Kconfig.nxp_hscmp
```kconfig
# Copyright 2025 NXP
# SPDX-License-Identifier: Apache-2.0

config COMPARATOR_NXP_HSCMP
	bool "NXP HSCMP comparator driver"
	default y
	depends on DT_HAS_NXP_HSCMP_ENABLED
	select PINCTRL
	select CLOCK_CONTROL
	select RESET
	select REGULATOR
```

## drivers/comparator/Kconfig.nxp_lpcmp
```kconfig
# Copyright 2025 NXP
# SPDX-License-Identifier: Apache-2.0

config COMPARATOR_NXP_LPCMP
	bool "NXP LPCMP comparator driver"
	default y
	depends on DT_HAS_NXP_LPCMP_ENABLED
	select CLOCK_CONTROL
```

## drivers/comparator/Kconfig.renesas_ra
```kconfig
# Copyright (c) 2025 Renesas Electronics Corporation
# SPDX-License-Identifier: Apache-2.0

config COMPARATOR_RENESAS_RA
	bool "Renesas RA ACMPHS"
	default y
	depends on DT_HAS_RENESAS_RA_ACMPHS_ENABLED
	select USE_RA_FSP_ACMPHS
	select PINCTRL
	help
	  Enable Renesas RA ACMPHS Driver.

config COMPARATOR_RENESAS_RA_LVD
	bool "Renesas RA LVD"
	default y
	depends on DT_HAS_RENESAS_RA_LVD_ENABLED
	select USE_RA_FSP_LVD
	select RUNTIME_NMI
	help
	  Enable Renesas RA LVD Driver.
```

## drivers/comparator/Kconfig.renesas_rx
```kconfig
# Copyright (c) 2025 Renesas Electronics Corporation
# SPDX-License-Identifier: Apache-2.0

config COMPARATOR_RENESAS_RX_LVD
	bool "Renesas RX LVD"
	default y
	depends on DT_HAS_RENESAS_RX_LVD_ENABLED
	select USE_RX_RDP_LVD
	select PINCTRL
	help
	  Enable Comparator driver with Low Voltage Detection (LVD) feature for Renesas RX MCUs.
```

## drivers/comparator/Kconfig.shell
```kconfig
# Copyright (c) 2024 Nordic Semiconductor ASA
# SPDX-License-Identifier: Apache-2.0

config COMPARATOR_SHELL
	bool "Comparator shell"
	default y
	depends on SHELL
	help
	  Comparator device driver shell.

if COMPARATOR_SHELL

config COMPARATOR_SHELL_AWAIT_TRIGGER_DEFAULT_TIMEOUT
	int "Default timeout for await_trigger command in seconds"
	default 10

config COMPARATOR_SHELL_AWAIT_TRIGGER_MAX_TIMEOUT
	int "Max timeout for await_trigger command in seconds"
	default 60

endif # COMPARATOR_SHELL
```

## drivers/comparator/Kconfig.silabs_acmp
```kconfig
# Copyright (c) 2025 Silicon Laboratories Inc.
# SPDX-License-Identifier: Apache-2.0
config COMPARATOR_SILABS_ACMP
	bool "Silabs ACMP comparator driver"
	default y
	depends on DT_HAS_SILABS_ACMP_ENABLED
	select PINCTRL
	select SOC_SILABS_ACMP
	help
	  Enable the comparator driver for the Analog Comparator hardware block
	  present on Silicon Labs devices. This block is commonly used to
	  monitor the power supply.
```
