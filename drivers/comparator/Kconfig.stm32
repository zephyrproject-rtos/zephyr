## drivers/console/Kconfig.telnet
```kconfig
# Kconfig - console driver configuration options

#
# Copyright (c) 2017 Intel Corporation
#
# SPDX-License-Identifier: Apache-2.0
#

menuconfig TELNET_CONSOLE
	bool "Enable a super basic telnet console service"
	default n
	select NETWORKING
	select NET_TCP
	help
	This option enables telnet as a network console service. It is for
	now a very basic implementation of the telnet protocol. Currently,
	it is basically just a redirection of the Zephyr console through TCP.
	It nicely works along with another console driver (like uart), twist
	being that it will take over the output if only a successful
	connection to its port is done.

if TELNET_CONSOLE

config TELNET_CONSOLE_PORT
	int "Telnet console port number"
	default 23
	help
	This option is used to configure on which port telnet is going
	to be bound.

config TELNET_CONSOLE_LINE_BUF_SIZE
	int "Telnet console line buffer size"
	default 64
	help
	This option can be used to modify the size of the buffer storing
	console output line, prior to sending it through the network.
	Of course an output line can be longer than such size, it just
	means sending it will start as soon as it reaches this size.
	It really depends on what type of output is expected.
	A lot of short lines: better reduce this value. On the contrary,
	raise it.

config TELNET_CONSOLE_LINE_BUF_NUMBERS
	int "Telnet console line buffers"
	default 4
	help
	This option can be used to modify the amount of line buffers the
	driver can use. It really depends on how much output is meant to be
	sent, depending on the system load etc. You can play on both
	TELNET_CONSOLE_LINE_BUF_SIZE and this current option to get the
	best possible buffer settings you need.

config TELNET_CONSOLE_SEND_TIMEOUT
	int "Telnet console line send timeout"
	default 100
	help
	This option can be used to modify the duration of the timer that kick
	in when a line buffer is not empty but did not yet meet the line feed.

config TELNET_CONSOLE_SEND_THRESHOLD
	int "Telnet console line send threshold"
	default 5
	help
	This option can be used to modify the minimal amount of a line buffer
	that can be sent by the telnet server when nothing has happened for
	a little while (see TELNET_CONSOLE_SEND_TIMEOUT) and when the line
	buffer did not meet the line feed yet.

config TELNET_CONSOLE_SUPPORT_COMMAND
	bool "Add support for telnet commands (IAC) [Experimental]"
	default n
	help
	Current support is so limited it's not interesting to enable it.
	However, if proven to be needed at some point, it will be possible
	to extend such support.

config TELNET_CONSOLE_THREAD_STACK
	int "Telnet console inner thread stack size"
	default 1024
	help
	This option helps to fine-tune telnet's inner thread stack size.

config TELNET_CONSOLE_PRIO
	int "Telnet console inner thread priority"
	default 7
	help
	This option helps to fine-tune telnet's inner thread priority.

config SYS_LOG_TELNET_CONSOLE_LEVEL
	int "Telnet console log level"
	default 0
	depends on SYS_LOG
	help
	Sets log level for telnet console (for telnet console dev only)

	Levels are:

	- 0 OFF, do not write

	- 1 ERROR, only write SYS_LOG_ERR

	- 2 WARNING, write SYS_LOG_WRN in addition to previous level

	- 3 INFO, write SYS_LOG_INF in addition to previous levels

	- 4 DEBUG, write SYS_LOG_DBG in addition to previous levels

config TELNET_CONSOLE_DEBUG_DEEP
	bool "Forward output to original console handler"
	depends on UART_CONSOLE
	default n
	help
	For telnet developers only, this will forward each output to
	original console handler. So if by chance telnet seems silent,
	at least things will be printed to original handler, usually
	UART console.

config TELNET_CONSOLE_INIT_PRIORITY
	int "Telnet console init priority"
	default 99
	help
	Telnet console driver initialization priority. Note that Telnet works
	on application level. Usually, you won't have to tweak this.

endif
```

## drivers/console/shells/Kconfig
```kconfig
config ENABLE_SHELL
	bool
	prompt "Shell support"
	default n
	help
	  Enabling shell services. If it is enabled, kernel shell commands are
	  also available for use.
```

## drivers/cordic/Kconfig
```kconfig
# CORDIC configuration options
#
# Copyright (c) 2024 Alexander Kozhinov <ak.alexander.kozhinov@gmail.com>
# SPDX-License-Identifier: Apache-2.0

menuconfig CORDIC
	bool "CORDIC (Coordinate Rotation Digital Computer) drivers"
	help
	  Enable CORDIC driver support. CORDIC is a hardware accelerator for
	  trigonometric, hyperbolic, linear, and logarithmic functions.

if CORDIC

module = CORDIC
module-str = cordic
source "subsys/logging/Kconfig.template.log_config"

config CORDIC_INIT_PRIORITY
	int "CORDIC driver initialization priority"
	default 60
	help
	  CORDIC driver initialization priority.

source "drivers/cordic/Kconfig.stm32"

endif # CORDIC
```

## drivers/cordic/Kconfig.stm32
```kconfig
# STM32 CORDIC configuration options
#
# Copyright (c) 2024 Alexander Kozhinov <ak.alexander.kozhinov@gmail.com>
# SPDX-License-Identifier: Apache-2.0

config CORDIC_STM32
	bool "STM32 CORDIC driver"
	default y
	depends on DT_HAS_ST_STM32_CORDIC_ENABLED
	select CMSIS_DSP
	select CMSIS_DSP_BASICMATH
	help
	  Enable STM32 CORDIC driver.
```

## drivers/coredump/Kconfig
```kconfig
# Copyright Meta Platforms, Inc. and its affiliates.
# SPDX-License-Identifier: Apache-2.0

menuconfig COREDUMP_DEVICE
	bool "Coredump pseudo-device driver"
	help
	  Enable support for a pseudo-device to help capturing
	  desired data into core dumps.

if COREDUMP_DEVICE

config COREDUMP_DEVICE_INIT_PRIORITY
	int "Coredump device init priority"
	default KERNEL_INIT_PRIORITY_DEVICE
	help
	  Coredump pseudo-device driver initialization priority.

module = COREDUMP_DEVICE
module-str = coredump device
source "subsys/logging/Kconfig.template.log_config"

endif # COREDUMP_DEVICE
```

## drivers/counter/Kconfig
```kconfig
# Counter configuration options

# Copyright (c) 2016 Intel Corporation
# SPDX-License-Identifier: Apache-2.0

menuconfig COUNTER
	bool "Counter drivers"
	help
	  Enable support for counter and timer.

if COUNTER

config COUNTER_INIT_PRIORITY
	int "Counter init priority"
	default 60
	help
	  Counter driver device initialization priority.

config COUNTER_SHELL
	bool "Counter shell"
	depends on SHELL
	help
	  Enable Shell Commands for Counter and Timer

config COUNTER_64BITS_FREQ
	bool
	help
	  Select this option if the counter driver should use 64-bits for frequency.
	  This is typically set by drivers that have frequencies greater than
	  4,294,967,295 Hz.

config COUNTER_SUPPORTS_64BITS_TICKS
	bool
	help
	  Select this option if the counter driver supports 64-bits for ticks.
	  This is typically set by drivers that require extended
	  tick ranges beyond the 32-bit limit.

config COUNTER_64BITS_TICKS
	bool "API to support ticks longer than 32-bits"
	depends on COUNTER_SUPPORTS_64BITS_TICKS
	help
	  This enables APIs to handle ticks larger than 32-bits with a
	  64-bit typedef. It is up to the driver to implement the necessary
	  functions to supports.

module = COUNTER
module-str = counter
source "subsys/logging/Kconfig.template.log_config"

# zephyr-keep-sorted-start
source "drivers/counter/Kconfig.ace"
source "drivers/counter/Kconfig.ambiq"
source "drivers/counter/Kconfig.andes_atcpit100"
source "drivers/counter/Kconfig.cc23x0_lgpt"
source "drivers/counter/Kconfig.cc23x0_rtc"
source "drivers/counter/Kconfig.cmos"
source "drivers/counter/Kconfig.dtmr_cmsdk_apb"
source "drivers/counter/Kconfig.dw"
source "drivers/counter/Kconfig.esp32_rtc"
source "drivers/counter/Kconfig.esp32_tmr"
source "drivers/counter/Kconfig.gd32"
source "drivers/counter/Kconfig.gecko"
source "drivers/counter/Kconfig.imx_epit"
source "drivers/counter/Kconfig.infineon"
source "drivers/counter/Kconfig.infineon_tcpwm"
source "drivers/counter/Kconfig.ite_it51xxx"
source "drivers/counter/Kconfig.ite_it8xxx2"
source "drivers/counter/Kconfig.max32_rtc"
source "drivers/counter/Kconfig.max32_timer"
source "drivers/counter/Kconfig.max32_wut"
source "drivers/counter/Kconfig.maxim_ds3231"
source "drivers/counter/Kconfig.mchp"
source "drivers/counter/Kconfig.mchp_sam_pit64b"
source "drivers/counter/Kconfig.mcp7940n"
source "drivers/counter/Kconfig.mcux_ctimer"
source "drivers/counter/Kconfig.mcux_ftm"
source "drivers/counter/Kconfig.mcux_gpt"
source "drivers/counter/Kconfig.mcux_lpc_rtc"
source "drivers/counter/Kconfig.mcux_lpit"
source "drivers/counter/Kconfig.mcux_lptmr"
source "drivers/counter/Kconfig.mcux_qtmr"
source "drivers/counter/Kconfig.mcux_rtc"
source "drivers/counter/Kconfig.mcux_rtc_jdp"
source "drivers/counter/Kconfig.mcux_snvs"
source "drivers/counter/Kconfig.mcux_stm"
source "drivers/counter/Kconfig.mcux_tpm"
source "drivers/counter/Kconfig.mspm0"
source "drivers/counter/Kconfig.native_sim"
source "drivers/counter/Kconfig.neorv32"
source "drivers/counter/Kconfig.npcx"
source "drivers/counter/Kconfig.nrfx"
source "drivers/counter/Kconfig.nxp_mrt"
source "drivers/counter/Kconfig.nxp_pit"
source "drivers/counter/Kconfig.nxp_s32"
source "drivers/counter/Kconfig.renesas_ra"
source "drivers/counter/Kconfig.renesas_rz"
source "drivers/counter/Kconfig.rpi_pico"
source "drivers/counter/Kconfig.rpi_pico_pit"
source "drivers/counter/Kconfig.rts5912"
source "drivers/counter/Kconfig.rts5912_slwtmr"
source "drivers/counter/Kconfig.sam"
source "drivers/counter/Kconfig.sam0"
source "drivers/counter/Kconfig.smartbond_timer"
source "drivers/counter/Kconfig.stm32_rtc"
source "drivers/counter/Kconfig.stm32_timer"
source "drivers/counter/Kconfig.tmr_cmsdk_apb"
source "drivers/counter/Kconfig.xec"
source "drivers/counter/Kconfig.xlnx"
# zephyr-keep-sorted-stop

source "drivers/counter/Kconfig.rv3032_counter"

endif # COUNTER
```

## drivers/counter/Kconfig.ace
```kconfig
# Copyright (c) 2022 Intel Corporation
#
# SPDX-License-Identifier: Apache-2.0

config ACE_V1X_ART_COUNTER
	bool "DSP ART Wall Clock for ACE V1X"
	depends on DT_HAS_INTEL_ACE_ART_COUNTER_ENABLED
	default y
	help
	  DSP ART Wall Clock used by ACE V1X.

config ACE_V1X_RTC_COUNTER
	bool "DSP RTC Wall Clock for ACE V1X"
	depends on DT_HAS_INTEL_ACE_RTC_COUNTER_ENABLED
	default y
	help
	  DSP RTC Wall Clock used by ACE V1X.
```

## drivers/counter/Kconfig.ambiq
```kconfig
# SPDX-License-Identifier: Apache-2.0
#
# Copyright (c) 2023 Antmicro <www.antmicro.com>


config COUNTER_AMBIQ
	bool "Ambiq Counter Driver"
	default y
	depends on DT_HAS_AMBIQ_COUNTER_ENABLED
	select AMBIQ_HAL
	select AMBIQ_HAL_USE_TIMER
	help
	  Enables the Counter driver for Ambiq devices.
```

## drivers/counter/Kconfig.ameba_tmr
```kconfig
# AMEBA Basic Timer configuration

# Copyright (c) 2024 Realtek Semiconductor Corp.
# SPDX-License-Identifier: Apache-2.0

config COUNTER_TMR_AMEBA
	bool "AMEBA Counter Driver based on Basic-Timers"
	default y
	depends on DT_HAS_REALTEK_AMEBA_COUNTER_ENABLED
	help
	  Enables the Counter driver API based on realtek's Basic
	  Timers for AMEBA series devices.
```

## drivers/counter/Kconfig.andes_atcpit100
```kconfig
# Kconfig Andes ATCPIT100 configuration option
#
# Copyright (c) 2022 Andes Technology Corporation.
#
# SPDX-License-Identifier: Apache-2.0

config COUNTER_ANDES_ATCPIT100
	bool "Andes ATCPIT100 PIT driver"
	default y
	depends on DT_HAS_ANDESTECH_ATCPIT100_ENABLED
	help
	  Enable driver for the Andes ATCPIT100 PIT controller.
```

## drivers/counter/Kconfig.bee_rtc
```kconfig
# Copyright (c) 2026, Realtek Semiconductor Corporation
# SPDX-License-Identifier: Apache-2.0

config COUNTER_BEE_RTC
	bool "Realtek Bee series counter RTC driver"
	default y
	depends on DT_HAS_REALTEK_BEE_COUNTER_RTC_ENABLED
	select HAL_REALTEK_BEE_RTC
	help
	  This option enables the counter RTC driver for Realtek Bee SoCs.
```

## drivers/counter/Kconfig.bee_timer
```kconfig
# Copyright (c) 2026, Realtek Semiconductor Corporation
# SPDX-License-Identifier: Apache-2.0

config COUNTER_BEE_TIMER
	bool "Realtek Bee series counter timer driver"
	default y
	depends on DT_HAS_REALTEK_BEE_COUNTER_TIMER_ENABLED
	select HAL_REALTEK_BEE_TIM if DT_HAS_REALTEK_BEE_BASIC_TIMER_ENABLED
	select HAL_REALTEK_BEE_ENHTIM if DT_HAS_REALTEK_BEE_ENHANCED_TIMER_ENABLED
	help
	  This option enables the counter timer driver for Realtek Bee SoCs.
```

## drivers/counter/Kconfig.bflb
```kconfig
# Copyright The Zephyr Project Contributors
# SPDX-License-Identifier: Apache-2.0

config COUNTER_BFLB_TIMER
	bool "Bouffalo Lab timer counter driver"
	default y
	depends on DT_HAS_BFLB_TIMER_CHANNEL_ENABLED
	help
	  Enable general-purpose timer counter for Bouffalo Lab SoCs.

config COUNTER_BFLB_TIMER_HAS_CNT_CLR
	bool
	depends on COUNTER_BFLB_TIMER
	help
	  SoC has counter clear bits in the TCER register, enabling hardware
	  counter reset. When not set, the driver tracks a software cycle
	  offset to emulate counter reset in free-run mode.

config COUNTER_BFLB_RTC
	bool "Bouffalo Lab RTC counter driver"
	default y
	depends on DT_HAS_BFLB_RTC_ENABLED
	help
	  Enable RTC counter for Bouffalo Lab SoCs.
```

## drivers/counter/Kconfig.cc23x0_lgpt
```kconfig
# Copyright (c) 2024 BayLibre, SAS
# SPDX-License-Identifier: Apache-2.0

config COUNTER_CC23X0_LGPT
	bool "CC23x0 Counter driver based on the LGPT Timer"
	default y
	depends on DT_HAS_TI_CC23X0_LGPT_ENABLED
	help
	  Enable counter driver based on LGPT timer for cc23x0
```

## drivers/counter/Kconfig.cc23x0_rtc
```kconfig
# Copyright (c) 2024 BayLibre, SAS
# SPDX-License-Identifier: Apache-2.0

config COUNTER_CC23X0_RTC
	bool "CC23x0 Counter driver based on the RTC Timer"
	default y
	depends on DT_HAS_TI_CC23X0_RTC_ENABLED
	depends on CC23X0_SYSTIM_TIMER
	help
	  Enable counter driver based on RTC timer for cc23x0
```

## drivers/counter/Kconfig.cmos
```kconfig
# Counter driver for x86 "CMOS" clock

# Copyright (c) 2019 Intel Corp.
# SPDX-License-Identifier: Apache-2.0

config COUNTER_CMOS
	bool "Counter driver for x86 CMOS/RTC clock"
	default y if !RTC
	select MFD
	depends on DT_HAS_MOTOROLA_MC146818_ENABLED
```

## drivers/counter/Kconfig.crsas_ma2
```kconfig
# Copyright 2026 Google LLC
# SPDX-License-Identifier: Apache-2.0

config COUNTER_CRSAS_MA2
	bool "ARM CRSAS-MA2 System Counter driver"
	default y
	depends on DT_HAS_ARM_CRSAS_MA2_COUNTER_ENABLED
	help
	  Enable support for the ARM CRSAS-MA2 (Corstone Reference System Architecture Specification
	  Ma2) System Counter.

config COUNTER_CRSAS_MA2_TIMER
	bool "ARM CRSAS-MA2 System Timer driver"
	default y
	depends on DT_HAS_ARM_CRSAS_MA2_TIMER_ENABLED
	select COUNTER_CRSAS_MA2
	help
	  Enable support for the ARM CRSAS-MA2 (Corstone Reference System Architecture Specification
	  Ma2) System Timers. Note that despite the name assigned by ARM, its operation is closer to
	  what Zephyr counter interface provides.
```

## drivers/counter/Kconfig.dtmr_cmsdk_apb
```kconfig
# Counter and timer configuration options

# Copyright (c) 2016 Linaro Limited
# SPDX-License-Identifier: Apache-2.0

config TIMER_DTMR_CMSDK_APB
	bool "ARM CMSDK (Cortex-M System Design Kit) DTMR Timer driver"
	default y
	depends on DT_HAS_ARM_CMSDK_DTIMER_ENABLED
	help
	  The dualtimer (DTMR) present in the platform is used as a timer.
	  This option enables the support for the timer.
```

## drivers/counter/Kconfig.dw
```kconfig
# Synopsys DesignWare Timer configuration option

# Copyright (c) 2023, Intel Corporation.
# SPDX-License-Identifier: Apache-2.0

config COUNTER_SNPS_DW
	bool "Synopsys DesignWare Timer Driver"
	default y
	depends on DT_HAS_SNPS_DW_TIMERS_ENABLED
	help
	  Enable Timer driver
```

## drivers/counter/Kconfig.esp32
```kconfig
# ESP32 Timer configuration

# Copyright (c) 2020 Espressif Systems (Shanghai) Co., Ltd.
# SPDX-License-Identifier: Apache-2.0

DT_COMPAT_ESP32_TIMER := espressif,esp32-timer

config COUNTER_ESP32
	bool "ESP32 Counter Driver"
	depends on SOC_ESP32 || SOC_ESP32S2 || SOC_ESP32C3
	default $(dt_compat_enabled,$(DT_COMPAT_ESP32_TIMER))
	help
	  Enable Counter driver for ESP32 series devices.
```
