## drivers/mipi_dbi/Kconfig.rpi_pico
```kconfig
# Copyright 2025 Christoph Schnetzler
# SPDX-License-Identifier: Apache-2.0

config MIPI_DBI_RPI_PICO_PIO
	bool "MIPI DBI driver using PIO"
	default y
	depends on DT_HAS_RASPBERRYPI_PICO_MIPI_DBI_PIO_ENABLED
	select GPIO
	select PICOSDK_USE_PIO
	select PICOSDK_USE_DMA
	help
	  Enable support for MIPI DBI driver. This driver implements
	  a MIPI-DBI mode B compatible controller using PIO and DMA.
```

## drivers/mipi_dbi/Kconfig.sf32lb_lcdc
```kconfig
# Copyright (c) 2025, Qingsong Gou <gouqs@hotmail.com>
# SPDX-License-Identifier: Apache-2.0

config MIPI_DBI_SF32LB
	bool "SF32LB MIPI DBI driver"
	default y
	depends on DT_HAS_SIFLI_SF32LB_LCDC_MIPI_DBI_ENABLED
	help
	  Enable driver for SF32LB MIPI DBI controller.
```

## drivers/mipi_dbi/Kconfig.smartbond
```kconfig
# Smartbond MIPI DBI host configuration options

# Copyright (c) 2023 Renesas Electronics Corporation
# SPDX-License-Identifier: Apache-2.0

config MIPI_DBI_SMARTBOND
	bool "Smartbond MIPI DBI host controller driver"
	depends on DT_HAS_RENESAS_SMARTBOND_MIPI_DBI_ENABLED
	select PINCTRL
	default y
	help
	  Enable Smartbond MIPI DBI host controller.
```

## drivers/mipi_dbi/Kconfig.stm32_fmc
```kconfig
# Copyright (c) 2024 Bootlin
# SPDX-License-Identifier: Apache-2.0

config MIPI_DBI_STM32_FMC
	bool "MIPI DBI driver for STM32 FMC"
	default y
	depends on DT_HAS_ST_STM32_FMC_MIPI_DBI_ENABLED
	select MEMC
	help
	  Enable support for MIPI DBI driver for controller based on the stm32 FMC.

if MIPI_DBI_STM32_FMC

config MIPI_DBI_STM32_FMC_MEM_BARRIER
	bool "Adds memory barrier after every address and data register access"
	default y

endif # MIPI_DBI_STM32_FMC
```

## drivers/mipi_dsi/Kconfig
```kconfig
# Memory controller configuration options

# Copyright (c) 2020 Teslabs Engineering S.L.
# SPDX-License-Identifier: Apache-2.0

menuconfig MIPI_DSI
	bool "MIPI-DSI Host Controller drivers [EXPERIMENTAL]"
	select EXPERIMENTAL
	help
	  Add support for MIPI-DSI host controllers

if MIPI_DSI

module = MIPI_DSI
module-str = mipi_dsi
source "subsys/logging/Kconfig.template.log_config"

config MIPI_DSI_INIT_PRIORITY
	int "Initialization priority"
	default 86
	help
	  MIPI-DSI Host Controllers initialization priority.

source "drivers/mipi_dsi/Kconfig.mcux"
source "drivers/mipi_dsi/Kconfig.stm32"

endif
```

## drivers/mipi_dsi/Kconfig.ambiq
```kconfig
# Copyright (c) 2025 Ambiq Micro Inc.
# SPDX-License-Identifier: Apache-2.0

config MIPI_DSI_AMBIQ
	bool "AMBIQ MIPI-DSI Host Controller"
	default y
	depends on DT_HAS_AMBIQ_MIPI_DSI_ENABLED
	select AMBIQ_HAL_USE_DSI
	select AMBIQ_COMPONENT_USE_NEMADC if SOC_SERIES_APOLLO5X || SOC_SERIES_APOLLO4X
	help
	  AMBIQ MIPI DSI controller driver
```

## drivers/mipi_dsi/Kconfig.mcux
```kconfig
# Copyright 2022-2023 NXP
# SPDX-License-Identifier: Apache-2.0

config MIPI_DSI_MCUX
	bool "NXP MCUX MIPI-DSI Host Controller"
	default y
	depends on DT_HAS_NXP_IMX_MIPI_DSI_ENABLED
	help
	  NXP MIPI DSI controller driver

config MIPI_DSI_MCUX_2L
	bool "NXP MCUX MIPI-DSI 2L Controller"
	default y
	depends on DT_HAS_NXP_MIPI_DSI_2L_ENABLED
	help
	  NXP MIPI DSI 2L controller driver

if MIPI_DSI_MCUX_2L

config MIPI_DSI_MCUX_2L_SMARTDMA
	bool "Use smartDMA controller with MIPI DSI"
	default y
	depends on DMA_MCUX_SMARTDMA
	help
	  Use SMARTDMA. This accelerator will automatically
	  convert RGB565 input data to BGR565 (little endian to big endian),
	  and write it to the MIPI DSI.

config MIPI_DSI_MCUX_2L_SWAP16
	bool "Swap 16 byte color"
	help
	  Swap 16 byte color data from little to big endian format. When
	  this Kconfig is enabled, the DSI expects RGB565 data in little endian
	  format, which will then be byte swapped.


endif # MIPI_DSI_MCUX_2L
```

## drivers/mipi_dsi/Kconfig.renesas_ra
```kconfig
# Renesas RA Family

# Copyright (c) 2024 Renesas Electronics Corporation
# SPDX-License-Identifier: Apache-2.0

config MIPI_DSI_RENESAS_RA
	bool "Renesas RA MIPI-DSI Host Controller"
	default y
	depends on DT_HAS_RENESAS_RA_MIPI_DSI_ENABLED
	select USE_RA_FSP_MIPI_DSI
	help
	  Renesas RA MIPI DSI controller driver
```

## drivers/mipi_dsi/Kconfig.renesas_rz
```kconfig
# Renesas RZ Family

# Copyright (c) 2025 Renesas Electronics Corporation
# SPDX-License-Identifier: Apache-2.0

config MIPI_DSI_RENESAS_RZ
	bool "Renesas RZ MIPI-DSI Host Controller"
	default y
	depends on DT_HAS_RENESAS_RZ_MIPI_DSI_ENABLED
	select USE_RZ_FSP_MIPI_DSI
	help
	  Renesas RZ MIPI DSI controller driver
```

## drivers/mipi_dsi/Kconfig.stm32
```kconfig
# Copyright (c) 2023 bytes at work AG
# SPDX-License-Identifier: Apache-2.0

config MIPI_DSI_STM32
	bool "STM32 MIPI-DSI Host Controller"
	default y
	depends on DT_HAS_ST_STM32_MIPI_DSI_ENABLED
	depends on DT_HAS_ST_STM32_LTDC_ENABLED
	select RESET
	select USE_STM32_HAL_DSI
	help
	  STM32 MIPI DSI controller driver
```

## drivers/mipi_dsi/Kconfig.test
```kconfig
# Copyright (c) 2024 TOKITA Hiroshi
# SPDX-License-Identifier: Apache-2.0

config MIPI_DSI_TEST
	def_bool DT_HAS_VND_MIPI_DSI_ENABLED
	depends on DT_HAS_VND_MIPI_DSI_ENABLED
```

## drivers/misc/Kconfig
```kconfig
# Miscellaneous drivers not exposing Zephyr Device Driver API

# Copyright (c) 2021 Nordic Semiconductor
# SPDX-License-Identifier: Apache-2.0

menu "Miscellaneous Drivers"

source "drivers/misc/ethos_u/Kconfig"
source "drivers/misc/ft8xx/Kconfig"
source "drivers/misc/grove_lcd_rgb/Kconfig"
source "drivers/misc/pio_rpi_pico/Kconfig"
source "drivers/misc/nxp_flexram/Kconfig"
source "drivers/misc/nxp_s32_emios/Kconfig"
source "drivers/misc/timeaware_gpio/Kconfig"
source "drivers/misc/devmux/Kconfig"
source "drivers/misc/nordic_vpr_launcher/Kconfig"
source "drivers/misc/mcux_flexio/Kconfig"
source "drivers/misc/coresight/Kconfig"
source "drivers/misc/interconn/Kconfig"
source "drivers/misc/renesas_ra_external_interrupt/Kconfig"
source "drivers/misc/renesas_rx_external_interrupt/Kconfig"
source "drivers/misc/nxp_rtxxx_dsp_ctrl/Kconfig"
source "drivers/misc/stm32n6_axisram/Kconfig"
source "drivers/misc/nxp_inputmux/Kconfig"

endmenu
```

## drivers/misc/a4988/Kconfig
```kconfig
# A4988

# Copyright (c) 2023 Kindhome Sp z o.o
# SPDX-License-Identifier: Apache-2.0

config A4988
	bool "A4988"
	default y
	depends on DT_HAS_ALLEGROMICRO_A4988_ENABLED
	help
	  Enable driver for A4988.
```

## drivers/misc/addr_translation/Kconfig
```kconfig
# Address translation for OpenAMP

# Copyright 2025 NXP
# SPDX-License-Identifier: Apache-2.0

config OPENAMP_ADDR_TRANSLATION
	bool "Address translation support for OpenAMP"
	depends on DT_HAS_ZEPHYR_ADDR_TRANSLATION_ENABLED
	depends on OPENAMP
	help
	  Enable support for address translation from remote driver to device
```

## drivers/misc/adg1712/Kconfig
```kconfig
# Copyright (c) 2026 Analog Devices Inc.
# SPDX-License-Identifier: Apache-2.0

config ADG1712
	bool "Analog Devices ADG1712/ADG2712 quad SPST analog switch driver"
	default y
	depends on DT_HAS_ADI_ADG1712_ENABLED || \
		   DT_HAS_ADI_ADG2712_ENABLED
	depends on GPIO
	help
	  Enable driver for Analog Devices ADG1712/ADG2712 quad SPST
	  analog switch. Uses GPIO control for each of the 4 switches.

if ADG1712

config ADG1712_INIT_PRIORITY
	int "Init priority"
	default 90
	help
	  Analog Devices ADG1712/ADG2712 quad SPST analog switch driver
	  initialization priority.

module = ADG1712
module-str = adg1712
source "subsys/logging/Kconfig.template.log_config"

endif # ADG1712
```

## drivers/misc/adg1736/Kconfig
```kconfig
# Copyright (c) 2026 Analog Devices Inc.
# SPDX-License-Identifier: Apache-2.0

config ADG1736
	bool "Analog Devices ADG736/ADG1736 dual SPDT analog switch driver"
	default y
	depends on DT_HAS_ADI_ADG736_ENABLED || \
		   DT_HAS_ADI_ADG1736_ENABLED
	depends on GPIO
	help
	  Enable driver for Analog Devices ADG736/ADG1736 dual SPDT
	  analog switch. Uses GPIO control for each of the 2 switches and
	  an optional enable pin.

if ADG1736

config ADG1736_INIT_PRIORITY
	int "Init priority"
	default 90
	help
	  Analog Devices ADG736/ADG1736 dual SPDT analog switch driver
	  initialization priority.

module = ADG1736
module-str = adg1736
source "subsys/logging/Kconfig.template.log_config"

endif # ADG1736
```

## drivers/misc/adgm3121/Kconfig
```kconfig
# Copyright (c) 2026 Analog Devices Inc.
# SPDX-License-Identifier: Apache-2.0

config ADGM3121
	bool "Analog Devices ADGM3121 MEMS switch driver"
	default y
	depends on DT_HAS_ADI_ADGM3121_ENABLED || \
		   DT_HAS_ADI_ADGM3121_GPIO_ENABLED
	depends on SPI || GPIO
	help
	  Enable driver for Analog Devices ADGM3121 (DPDT MEMS switch,
	  DC-24GHz). Supports both SPI and parallel GPIO control modes.

if ADGM3121

config ADGM3121_INIT_PRIORITY
	int "Init priority"
	default 90
	help
	  Analog Devices ADGM3121 MEMS switch driver initialization
	  priority.

module = ADGM3121
module-str = adgm3121
source "subsys/logging/Kconfig.template.log_config"

endif # ADGM3121
```

## drivers/misc/anx7327/Kconfig
```kconfig
# Copyright (c) 2025, Applied Materials
# SPDX-License-Identifier: Apache-2.0

config ANX7327
	bool "Analogix 7327 USB power delivery Controller"
	help
	  USB Type-C™ Power Delivery v3.0 Controller with De-Mux

if ANX7327

config ANX7327_SHELL
	bool "Shell commands"
	depends on SHELL

config ANX7327_INIT_PRIORITY
	int "anx7327 init priority"
	default 55
	help
	  Init priority for the anx7327 driver.

module = ANX7327
module-str = ANX7327 USB PD Controller
source "subsys/logging/Kconfig.template.log_config"

endif
```

## drivers/misc/anx7533/Kconfig
```kconfig
# Copyright (c) 2025, Applied Materials
# SPDX-License-Identifier: Apache-2.0

config ANX7533
	bool "Analogix 7533 mobile HD reciever"
	depends on I2C
	help
	  Analogix 7533 mobile HD reciever

if ANX7533

config ANX7533_SHELL
	bool "Shell commands"
	depends on SHELL

config ANX7533_INIT_PRIORITY
	int "anx7533 init priority"
	default 65
	help
	  Init priority for the anx7533 driver.

module = ANX7533
module-str = ANX7533 mobile HD reciever
source "subsys/logging/Kconfig.template.log_config"

endif
```

## drivers/misc/bflb_wo/Kconfig
```kconfig
# Copyright (c) 2026 MASSDRIVER EI (massdriver.space)
# SPDX-License-Identifier: Apache-2.0

config BFLB_WO
	bool "Bouffalolab BL61x GPIO FIFO"
	depends on CLOCK_CONTROL
	depends on SOC_SERIES_BL61X
	select GPIO
	help
	  The GPIO FIFO / WO is an extension of the GPIO device, it enables outputting arbitrary
	  toggle waveforms over 16 pins or more at up to XCLK Hz (32MHz or crystal value).
```

## drivers/misc/c2h_nct/Kconfig
```kconfig
# NCT misc. driver options

# Copyright (c) 2024 Nuvoton
# SPDX-License-Identifier: Apache-2.0


config C2H_NCT
	bool "NCT core access to host modules driver"
	depends on DT_HAS_NUVOTON_NCT_C2H_ENABLED
	help
	  This option enables the c2h driver for NCT
	  SoCs.
	  Say y if you wish to access host modules
	  on NCT SMC.
```

## drivers/misc/c2h_npcm/Kconfig
```kconfig
# NPCM misc. driver options

# Copyright (c) 2024 Nuvoton
# SPDX-License-Identifier: Apache-2.0


config C2H_NPCM
	bool "NPCM core access to host modules driver"
	depends on DT_HAS_NUVOTON_NPCM_C2H_ENABLED
	help
	  This option enables the c2h driver for NPCM
	  SoCs.
	  Say y if you wish to access host modules
	  on NPCM SMC.
```
