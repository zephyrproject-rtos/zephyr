## drivers/misc/coresight/Kconfig
```kconfig
# Copyright (c) 2024 Nordic Semiconductor ASA
# SPDX-License-Identifier: Apache-2.0

DT_COMPAT_NORDIC_NRF_TBM := nordic,nrf-tbm

config NRF_ETR
	bool "Coresight ETR handler (with Nordic TBM)"
	depends on $(dt_compat_enabled,$(DT_COMPAT_NORDIC_NRF_TBM))
	select NRFX_TBM
	imply UART_ASYNC_API
	default y
	help
	  Module handles data stored in the ETR circular buffer (e.g. STM logging
	  data). Busyness is tracked using TBM (Trace Buffer Monitor) peripheral
	  which is specific to Nordic Semiconductor SoCs.

if NRF_ETR

config NRF_ETR_DECODE
	bool "Decode ETR content"
	default y if LOG_FRONTEND_STMESP_FSC
	select MIPI_STP_DECODER
	select CS_TRACE_DEFMT
	select LOG_FRONTEND_STMESP_DEMUX
	select LOG_OUTPUT
	imply LOG_BACKEND_SHOW_COLOR
	imply CBPRINTF_FP_SUPPORT
	help
	  In this mode, log messages stored by Coresight STM logging frontends are
	  decoded and printed in the human readable form.

config NRF_ETR_DECODE_DROP_PERIOD
	int "Period of dropped messages notification"
	default 5000
	help
	  Period (in milliseconds) how often it is checked if any dropped messages
	  have occurred.

config NRF_ETR_DEBUG
	bool "Debug mode"
	depends on !LOG_PRINTK
	select MIPI_STP_DECODER
	select CS_TRACE_DEFMT
	help
	  In debug mode STPv2 decoded data is printed.

config NRF_ETR_STACK_SIZE
	int "ETR thread stack size"
	default 2048 if NRF_ETR_DECODE || NRF_ETR_DEBUG
	default 1024

config NRF_ETR_BACKOFF
	int "Thread backoff time (ms)"
	default 10
	help
	  Determines how often attempt to dump the data is performed.

config NRF_ETR_FLUSH_TIMEOUT
	int "Backoff time during flushing (ms)"
	default 100
	help
	  When thread triggers flushing of ETR data, it periodically checks if
	  there is still a pending ETR data. This option specifies how often
	  thread is waking up to check. Given in milliseconds.

config NRF_ETR_SYNC_PERIOD
	int "Period of custom synchronization frame"
	default 0 if NRF_ETR_DECODE
	default 0 if NRF_ETR_DEBUG
	default 16
	help
	  To help find the synchronization when decoding the ETR content
	  by a host tool a synchronization pattern (16 bytes of 0xFF) can be
	  sent on regular intervals. This frame is sent between Coresight formatter
	  frames. Use 0 to disable.

config NRF_ETR_SHELL
	bool "Use shell"
	select UART_ASYNC_API
	select UART_ASYNC_RX_HELPER
	select SHELL_LOG_BACKEND_CUSTOM
	depends on NRF_ETR_DECODE
	default y if SHELL
	help
	  Enable shell with Coresight STM logging support.

if NRF_ETR_SHELL

config NRF_ETR_SHELL_PROMPT
	string "Displayed prompt name"
	default "uart:~$ "
	help
	  Displayed prompt name for UART shell with Coresight STM logging.

config NRF_ETR_SHELL_ASYNC_RX_BUFFER_SIZE
	int "Size of the RX buffer"
	default 16
	help
	  Size of a single RX buffer. Together with buffer count it defines the
	  space that can hold RX data. It may be decreased if shell input is
	  slow and may need to be increased if long messages are pasted directly
	  to the shell prompt.

config NRF_ETR_SHELL_ASYNC_RX_BUFFER_COUNT
	int "Number of RX buffers"
	default 4
	range 2 64
	help
	  Number of RX buffers.

endif # NRF_ETR_SHELL

endif # NRF_ETR

config NRF_CORESIGHT
	def_bool y
	depends on DT_HAS_NORDIC_NRF_CORESIGHT_ENABLED
	select PINCTRL
	select NRF_IRONSIDE_TDD_SERVICE
	help
	  Support CoreSight peripherals in Test and Debug Domain for ARM
	  CoreSight System Trace Macrocell (STM) trace support.

if NRF_CORESIGHT
config NRF_CORESIGHT_ATB_TRACE_ID_STM_GLOBAL
	def_hex 0x40
	help
	  Global trace ID used by STM.

config NRF_CORESIGHT_STM_SYNC_BYTE_COUNT
	int "CoreSight STM: Emit synhronization packet every N bytes"
	range 0 4095
	default 512

config NRF_CORESIGHT_TPIU_FFCR_TRIG
	bool "CoreSight TPIU: Use flush request trigger"
	default y
	help
	  Use CTI channel 1 for triggering flush request in TPIU.

config NRF_CORESIGHT_TPIU_SYNC_FRAME_COUNT
	int "CoreSight TPIU: Emit synhronization packet every N frames"
	default 8

config NRF_CORESIGHT_TPIU_PORTSIZE
	int "CoreSight TPIU: Size of the current TPIU port in bits"
	range 1 32
	default 4

config NRF_CORESIGHT_ATBFUNNEL_HOLD_TIME
	int "Hold time for the CoreSight ATB funnel transaction"
	range 1 15
	default 4
	help
	  Number of transactions that are output on the funnel master port from the
	  same slave.

config NRF_CORESIGHT_TDD_CLOCK_FREQUENCY
	int
	default 320000000 if SOC_SERIES_NRF54HX
	default 400000000

config NRF_CORESIGHT_TSGEN_CLK_DIV
	int
	default 8
	help
	  Clock division factor for generating trace timestamps. The timestamp
	  counter should not be slower than 10% of the fastest processor clock
	  frequency in the system, therefore its clock speed is divided by
	  eight.

config NRF_CORESIGHT_FW_CLAIM_BIT
	def_int 0
	help
	  Bit set in the CLAIMSET register of CoreSight peripherals by the driver to
	  indicate that it has configured the peripheral.

config NRF_CORESIGHT_RETRY_COUNT
	int "CoreSight: Number of retries for CoreSight peripheral status changes"
	range 1 255
	default 255
	help
	  Status changes can be lock/unlock attempts, enable/disable changes, etc.

module = NRF_CORESIGHT
module-str = CoreSight Trace
source "subsys/logging/Kconfig.template.log_config"

endif # NRF_CORESIGHT
```

## drivers/misc/devmux/Kconfig
```kconfig
# Copyright (c) 2023, Meta
# SPDX-License-Identifier: Apache-2.0

config DEVMUX
	bool "Device Multiplexer (devmux) [EXPERIMENTAL]"
	depends on DT_HAS_ZEPHYR_DEVMUX_ENABLED
	depends on DEVICE_MUTABLE
	select EXPERIMENTAL
	help
	  Devmux is a pseudo-device that operates as a device switch. It allows
	  software to select the data, config, and api from a number of linked
	  devices.

if DEVMUX

config DEVMUX_INIT_PRIORITY
	int "Devmux init priority"
	default 51
	help
	  Init priority for the devmux driver. It must be
	  greater than the priority of the initially selected muxed device.

endif
```

## drivers/misc/esp_hosted_mcu/Kconfig
```kconfig
# esp-hosted-mcu transport core options

# Copyright (c) 2026 Espressif Systems (Shanghai) CO LTD
# SPDX-License-Identifier: Apache-2.0

menuconfig ESP_HOSTED_MCU
	bool "esp-hosted-mcu transport core"
	depends on DT_HAS_ESPRESSIF_ESP_HOSTED_MCU_ENABLED || \
		DT_HAS_ESPRESSIF_ESP_HOSTED_MCU_SDIO_ENABLED
	select GPIO
	select NANOPB
	select NANOPB_ENABLE_MALLOC
	help
	  Generic host-side transport for an external Espressif coprocessor
	  running esp-hosted-mcu coprocessor firmware. Owns the SPI or SDIO link,
	  frame demultiplexing and the RPC round-trip machinery. Protocol
	  consumers such as the Wi-Fi netif driver or a Bluetooth HCI driver
	  build on top of it. Not selected directly; a consumer selects it.

if ESP_HOSTED_MCU

choice ESP_HOSTED_MCU_TRANSPORT
	prompt "esp-hosted-mcu transport"
	default ESP_HOSTED_MCU_SPI if DT_HAS_ESPRESSIF_ESP_HOSTED_MCU_ENABLED
	default ESP_HOSTED_MCU_SDIO

config ESP_HOSTED_MCU_SPI
	bool "SPI transport"
	depends on DT_HAS_ESPRESSIF_ESP_HOSTED_MCU_ENABLED
	select SPI
	help
	  Communicate with the coprocessor over SPI with reset, handshake and
	  data-ready GPIOs.

config ESP_HOSTED_MCU_SDIO
	bool "SDIO transport"
	depends on DT_HAS_ESPRESSIF_ESP_HOSTED_MCU_SDIO_ENABLED
	select SDHC
	select SDIO_STACK
	help
	  Communicate with the coprocessor over the SDIO bus, using the SLC
	  register window and a reset GPIO.

endchoice

config ESP_HOSTED_MCU_INIT_PRIORITY
	int "esp-hosted-mcu core init priority"
	default 86 if ESP_HOSTED_MCU_SDIO
	default 80
	help
	  POST_KERNEL init priority of the core device. Over SDIO the core is a
	  devicetree child of the SDHC controller, so it must init after it
	  (CONFIG_SDHC_INIT_PRIORITY) and before the consumer drivers (for
	  example CONFIG_WIFI_ESP_HOSTED_MCU_INIT_PRIORITY) so the link and the
	  receive thread exist before a consumer registers its handlers and
	  drives the coprocessor.

config ESP_HOSTED_MCU_EVENT_TASK_PRIORITY
	int "Event task priority"
	default 4
	help
	  Cooperative priority of the receive/event thread. It must stay
	  higher priority (numerically lower) than the consumer threads it
	  feeds, so a busy consumer cannot stall frame reception.

config ESP_HOSTED_MCU_EVENT_TASK_STACK_SIZE
	int "Event task stack size"
	default 4096
	help
	  Stack for the receive/event thread. RPC frames are decoded into a
	  stack-resident Rpc message, so this must accommodate the largest
	  response the driver handles.

config ESP_HOSTED_MCU_FW_VERSION_MAJOR
	int "Expected coprocessor firmware major version"
	default 3
	help
	  Major version of the esp-hosted-mcu coprocessor firmware this host is
	  built for. The firmware runs on a separate chip and is flashed
	  independently, so this cannot be enforced at build time: the driver
	  queries the running firmware and warns when the major version differs.
	  Nothing here changes the protocol the host speaks.

config ESP_HOSTED_MCU_FW_VERSION_MINOR
	int "Expected coprocessor firmware minor version"
	default 0
	help
	  Minor version of the expected coprocessor firmware. Reported in the
	  version log line; a difference is not warned about.

config ESP_HOSTED_MCU_FW_VERSION_PATCH
	int "Expected coprocessor firmware patch version"
	default 0
	help
	  Patch version of the expected coprocessor firmware. Reported in the
	  version log line; a difference is not warned about.

config ESP_HOSTED_MCU_EVENT_TASK_POLL_MS
	int "Event task poll rate in ms"
	default 20
	help
	  Bound on how long the receive thread waits for the coprocessor's
	  data-ready signal before checking anyway.

	  Over SPI the data-ready GPIO is the normal wake source and this
	  only bounds the wait, so sampling the line costs nothing on the
	  bus.

	  Over SDIO the coprocessor flags a pending frame in its status
	  register without driving DAT1, so the card interrupt does not
	  fire and this poll is what actually observes incoming data. Each
	  check is a single four-byte register read, so the interval sets
	  the worst-case receive latency: every request and response pays
	  up to one poll period.

module = ESP_HOSTED_MCU
module-str = esp-hosted-mcu
source "subsys/logging/Kconfig.template.log_config"

endif # ESP_HOSTED_MCU
```
