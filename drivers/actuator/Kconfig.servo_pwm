## drivers/actuator/Kconfig.servo_pwm
```kconfig
# Copyright (c) 2025 Nordic Semiconductor ASA
# SPDX-License-Identifier: Apache-2.0

config ACTUATOR_SERVO_PWM
	bool "PWM driven servo device driver"
	default y
	depends on DT_HAS_ZEPHYR_SERVO_PWM_ENABLED
	select PWM
```

## drivers/actuator/Kconfig.shell
```kconfig
# Copyright (c) 2025 Nordic Semiconductor ASA
# SPDX-License-Identifier: Apache-2.0

config ACTUATOR_SHELL
	bool "Actuator shell commands"
	depends on SHELL
```

## drivers/adc/Kconfig
```kconfig
# ADC configuration options

# Copyright (c) 2015 Intel Corporation
# SPDX-License-Identifier: Apache-2.0

#
# ADC options
#
menuconfig ADC
	bool "Analog-to-Digital Converter (ADC) drivers"
	# All platforms that implement the ADC driver are now required to
	# provide relevant DTS entries.
	help
	  Enable ADC (Analog to Digital Converter) driver configuration.

if ADC

config ADC_SHELL
	bool "ADC Shell"
	depends on SHELL
	help
	  Enable ADC Shell for testing.

# By selecting or not this option particular ADC drivers indicate if it is
# required to explicitly specify analog inputs when configuring channels or
# just the channel identifier is sufficient.
config ADC_CONFIGURABLE_INPUTS
	bool

# By selecting or not this option particular ADC drivers indicate if it is
# required to explicitly specify for the excitation current source the pin
# which should be used.
config ADC_CONFIGURABLE_EXCITATION_CURRENT_SOURCE_PIN
	bool

# By selecting or not this option particular ADC drivers indicate if they
# allow a configurable voltage bias pin.
config ADC_CONFIGURABLE_VBIAS_PIN
	bool

config ADC_ASYNC
	bool "Asynchronous call support"
	select POLL
	help
	  This option enables the asynchronous API calls.

config ADC_INIT_PRIORITY
	int "ADC init priority"
	default KERNEL_INIT_PRIORITY_DEVICE
	help
	  ADC driver device initialization priority.

config ADC_STREAM
	bool "ADC stream support"
	select RTIO
	select RTIO_SYS_MEM_BLOCKS
	select RTIO_CONSUME_SEM
	help
	  This option enables the stream API calls.

config ADC_DEFAULT_RTIO
	bool "Default RTIO support"
	select RTIO
	select RTIO_WORKQ
	select RTIO_SYS_MEM_BLOCKS
	select RTIO_CONSUME_SEM
	help
	  This option enables the default RTIO handler for ADC devices that do not
	  implement stream functionality.

module = ADC
module-str = ADC
source "subsys/logging/Kconfig.template.log_config"

source "drivers/adc/Kconfig.*"

endif # ADC
```

## drivers/adc/Kconfig.ad405x
```kconfig
# ADI SoC ADC configuration options

# Copyright (c) 2025 Analog Devices, Inc.
# SPDX-License-Identifier: Apache-2.0

config ADC_AD405X
	bool "AD405X ADC driver"
	depends on DT_HAS_ADI_AD4052_ADC_ENABLED || DT_HAS_ADI_AD4050_ADC_ENABLED
	select SPI
	default y
	help
	  Enable ADC driver for ADI AD405X.

config AD405X_STREAM
	bool "Use FIFO to stream data"
	depends on ADC_AD405X
	select AD405X_TRIGGER
	depends on SPI_RTIO
	help
	  Use this configuration option to enable streaming ADC data via RTIO.

config AD405X_TRIGGER
	bool "AD405X interrupts"
	depends on ADC_AD405X
	help
	  Enable interrupts for ADI AD405X.
```

## drivers/adc/Kconfig.ad4114
```kconfig
# Copyright (c) 2023 Grinn
# SPDX-License-Identifier: Apache-2.0

config ADC_AD4114
	bool "AD4114 ADC driver"
	default y
	depends on DT_HAS_ADI_AD4114_ADC_ENABLED
	select SPI
	help
	  Enable the AD4114 ADC driver.

config ADC_AD4114_ACQUISITION_THREAD_STACK_SIZE
	int "Stack size for the ADC data acquisition thread"
	depends on ADC_AD4114
	default 512
	help
	  Size of the stack used for the internal data acquisition
	  thread.

config ADC_AD4114_ACQUISITION_THREAD_PRIO
	int "Priority for the ADC data acquisition thread"
	depends on ADC_AD4114
	default 0
	help
	  Priority level for the internal ADC data acquisition thread.
```

## drivers/adc/Kconfig.ad4130
```kconfig
# Copyright (c) 2025 Analog Devices, Inc.
# SPDX-License-Identifier: Apache-2.0

config ADC_AD4130
	bool "ADI AD4130 Analog-to-Digital Converter"
	default y
	depends on DT_HAS_ADI_AD4130_ADC_ENABLED
	select SPI
	select ADC_CONFIGURABLE_INPUTS
	help
	  Enable the AD4130 ADC driver. It is SPI based
	  Ultra Low Power, 24-Bit Sigma-Delta ADC.

config ADI_AD4130_ADC_ACQUISITION_THREAD_PRIO
	int "ADC data acquisition thread priority"
	default 90
	depends on ADC_AD4130 && ADC_ASYNC

config ADI_AD4130_ADC_ACQUISITION_THREAD_STACK_SIZE
	int "Stack size for the ADC data acquisition thread"
	default 400
	depends on ADC_AD4130 && ADC_ASYNC
	help
	  Size of the stack used for the internal data acquisition
	  thread.
```

## drivers/adc/Kconfig.ad4170
```kconfig
# Copyright (c) 2025 Analog Devices, Inc.
# SPDX-License-Identifier: Apache-2.0

config ADC_AD4170
	bool "ADI AD4170 and Similar Analog-to-Digital Converters"
	default y
	depends on DT_HAS_ADI_AD4170_ADC_ENABLED || DT_HAS_ADI_AD4190_ADC_ENABLED || DT_HAS_ADI_AD4195_ADC_ENABLED
	select SPI
	select ADC_CONFIGURABLE_INPUTS
	help
	  Enable the AD4170 and Similar ADC driver. It is SPI based
	  Ultra Low Power, 24-Bit Sigma-Delta ADC.

config ADI_AD4170_ADC_ACQUISITION_THREAD_PRIO
	int "ADC data acquisition thread priority"
	default 0
	depends on ADC_AD4170 && ADC_ASYNC

config ADI_AD4170_ADC_ACQUISITION_THREAD_STACK_SIZE
	int "Stack size for the ADC data acquisition thread"
	default 400
	depends on ADC_AD4170 && ADC_ASYNC
	help
	  Size of the stack used for the internal data acquisition
	  thread.
```

## drivers/adc/Kconfig.ad5592
```kconfig
# Copyright (c) 2023 Grinn
# SPDX -License-Identifier: Apache-2.0

config ADC_AD5592
	bool "AD5592 ADC driver"
	default y
	depends on DT_HAS_ADI_AD5592_ADC_ENABLED
	select MFD
	help
	  Enable the AD5592 ADC driver.

config ADC_AD5592_ACQUISITION_THREAD_STACK_SIZE
	int "Stack size for the ADC data acquisition thread"
	depends on ADC_AD5592
	default 384
	help
	  Size of the stack used for the internal data acquisition
	  thread.

config ADC_AD5592_ACQUISITION_THREAD_PRIO
	int "Priority for the ADC data acquisition thread"
	depends on ADC_AD5592
	default 0
	help
	  Priority level for the internal ADC data acquisition thread.
```

## drivers/adc/Kconfig.ad559x
```kconfig
# Copyright (c) 2023 Grinn
# SPDX -License-Identifier: Apache-2.0

config ADC_AD559X
	bool "AD559x ADC driver"
	default y
	depends on DT_HAS_ADI_AD559X_ADC_ENABLED
	select MFD
	help
	  Enable the AD559x ADC driver.

config ADC_AD559X_ACQUISITION_THREAD_STACK_SIZE
	int "Stack size for the ADC data acquisition thread"
	depends on ADC_AD559X
	default 384
	help
	  Size of the stack used for the internal data acquisition
	  thread.

config ADC_AD559X_ACQUISITION_THREAD_PRIO
	int "Priority for the ADC data acquisition thread"
	depends on ADC_AD559X
	default 0
	help
	  Priority level for the internal ADC data acquisition thread.
```

## drivers/adc/Kconfig.ad7124
```kconfig
# Copyright (c) 2025 Analog Devices, Inc.
# SPDX-License-Identifier: Apache-2.0

config ADC_AD7124
	bool "ADI AD7124 Analog-to-Digital Converter"
	default y
	depends on DT_HAS_ADI_AD7124_ADC_ENABLED
	select SPI
	select CRC
	select ADC_CONFIGURABLE_INPUTS
	help
	  Enable the ad7124 adc

config ADI_AD7124_ADC_ACQUISITION_THREAD_INIT_PRIO
	int "ADC data acquisition thread priority"
	default 0
	depends on ADC_AD7124 && ADC_ASYNC

config ADI_AD7124_ADC_ACQUISITION_THREAD_STACK_SIZE
	int "Stack size for the ADC data acquisition thread"
	default 400
	depends on ADC_AD7124 && ADC_ASYNC
	help
	  Size of the stack used for the internal data acquisition
	  thread.
```

## drivers/adc/Kconfig.adc124s021
```kconfig
# Copyright (c) 2026 RBZ Embedded Logics
# SPDX-License-Identifier: Apache-2.0

config ADC_ADC124S021
	bool "TI ADC124S021 ADC driver"
	default y
	depends on DT_HAS_TI_ADC124S021_ENABLED
	select SPI
	help
	  Enable support for the Texas Instruments ADC124S021 4-channel,
	  12-bit SPI ADC.

if ADC_ADC124S021

config ADC_ADC124S021_ACQUISITION_THREAD_STACK_SIZE
	int "ADC124S021 acquisition thread stack size"
	default 512
	help
	  Stack size for the ADC124S021 acquisition thread.

config ADC_ADC124S021_ACQUISITION_THREAD_PRIO
	int "ADC124S021 acquisition thread priority"
	default 0
	help
	  Priority of the ADC124S021 acquisition thread.

endif # ADC_ADC124S021
```

## drivers/adc/Kconfig.adc_emul
```kconfig
# Copyright 2021 Google LLC
# SPDX-License-Identifier: Apache-2.0

config ADC_EMUL
	bool "ADC emulator"
	default y
	depends on DT_HAS_ZEPHYR_ADC_EMUL_ENABLED
	help
	  Enable the ADC emulator driver. This is a fake driver in that it
	  does not talk to real hardware. It pretends to be actual ADC. It
	  is used for testing higher-level API for ADC devices.

if ADC_EMUL

config ADC_EMUL_ACQUISITION_THREAD_STACK_SIZE
	int "Stack size for the ADC data acquisition thread"
	default 512
	help
	  Size of the stack used for the internal data acquisition
	  thread. Increasing size may be required when value function for
	  emulated ADC require a lot of memory.

config ADC_EMUL_ACQUISITION_THREAD_PRIO
	int "Priority for the ADC data acquisition thread"
	default 0
	help
	  Priority level for the internal ADC data acquisition thread.

endif # ADC_EMUL
```

## drivers/adc/Kconfig.adcxx1c
```kconfig
# TI ADCxx1C ADC configuration options

# Copyright (c) 2026 RAKwireless Technology Limited
# SPDX-License-Identifier: Apache-2.0

config ADC_ADCXX1C
	bool "TI ADC081C/ADC101C/ADC121C (ADCxx1C) I2C ADC family"
	default y
	depends on DT_HAS_TI_ADC081C021_ENABLED \
		|| DT_HAS_TI_ADC081C027_ENABLED \
		|| DT_HAS_TI_ADC101C021_ENABLED \
		|| DT_HAS_TI_ADC101C027_ENABLED \
		|| DT_HAS_TI_ADC121C021_ENABLED \
		|| DT_HAS_TI_ADC121C027_ENABLED
	select I2C
	help
	  Enable the driver for the Texas Instruments ADCxx1C family of
	  single-channel I2C ADCs: ADC081C021, ADC081C027, ADC101C021,
	  ADC101C027, ADC121C021 and ADC121C027.

	  The six devices share one register map and differ only in
	  resolution (8, 10 or 12 bit) and in the function of one package
	  pin, so they are all handled by a single driver.
```

## drivers/adc/Kconfig.ads101x
```kconfig
# ADS101x ADC configuration options

# Copyright (c) 2022 Matija Tudan
# SPDX-License-Identifier: Apache-2.0

config ADC_ADS101X
	bool "TI ADS1013/ADS1014/ADS1015 driver"
	depends on I2C
	help
	  Enable TI ADS1013/ADS1014/ADS1015 ADC driver.

	  The ADS1013, ADS1014, and ADS1015 devices (ADS101x)
	  are 12-bit I2C compatible analog-to-digital converters (ADCs).

if ADC_ADS101X

config ADC_ADS101X_INIT_PRIORITY
	int "Init priority"
	default 80
	help
	  ADS101x ADC device driver initialization priority.

config ADC_ADS101X_ACQUISITION_THREAD_STACK_SIZE
	int "Stack size for the ADC data acquisition thread"
	default 512
	help
	  Size of the stack used for the internal data acquisition
	  thread.

config ADC_ADS101X_ACQUISITION_THREAD_PRIO
	int "Priority for the ADC data acquisition thread"
	default 0
	help
	  Priority level for the internal ADC data acquisition thread.

endif # ADC_ADS101X
```

## drivers/adc/Kconfig.ads1112
```kconfig
# ADS1112 ADC configuration options

# Copyright (c) 2023 Cruise, LLC.
# SPDX-License-Identifier: Apache-2.0

config ADC_ADS1112
	bool "Texas Instruments ADS1112 ADC driver"
	depends on DT_HAS_TI_ADS1112_ENABLED
	select I2C
	select ADC_CONFIGURABLE_INPUTS
	help
	  Enable the driver implementation for the ADS1112
```

## drivers/adc/Kconfig.ads1118
```kconfig
# Copyright (c) 2025 Testo SE & Co. KGaA
#
# SPDX-License-Identifier: Apache-2.0

config ADC_ADS1118
	bool "Texas instruments ADS1118"
	depends on DT_HAS_TI_ADS1118_ENABLED
	select ADC_CONFIGURABLE_INPUTS
	select SPI
	select GPIO
	help
	 Enable the driver for ADS1118 ADC.

if ADC_ADS1118

config ADC_ADS1118_ASYNC_THREAD_INIT_PRIO
	int "ADC ADS1118 async thread priority"
	default 0

config ADC_ADS1118_ACQUISITION_THREAD_STACK_SIZE
	int "Stack size for the ADC data acquisition thread"
	default 400
	help
	  Size in bytes of the stack used for the internal data acquisition
	  thread.

endif
```

## drivers/adc/Kconfig.ads1119
```kconfig
# Copyright (c) 2020 Libre Solar Technologies GmbH
# Copyright (c) 2020 Innoseis B.V
#
# SPDX-License-Identifier: Apache-2.0

# Workaround for not being able to have commas in macro arguments
DT_COMPAT_TI_ADS1119_ADC := ti,ads1119

config ADC_ADS1119
	bool "Texas instruments ADS1119 I2C"
	default $(dt_compat_enabled,$(DT_COMPAT_TI_ADS1119_ADC))
	depends on I2C
	select ADC_CONFIGURABLE_INPUTS
	help
	  Enable the driver implementation for the ADS1119

if ADC_ADS1119

config ADC_ADS1119_ASYNC_THREAD_INIT_PRIO
	int "ADC ADS1119 async thread priority"
	default 0

config ADC_ADS1119_ACQUISITION_THREAD_STACK_SIZE
	int "Stack size for the ADC data acquisition thread"
	default 400
	help
	  Size of the stack used for the internal data acquisition
	  thread.

endif
```

## drivers/adc/Kconfig.ads114s0x
```kconfig
# Copyright (c) 2023 SILA  Embedded Solutions GmbH
#
# SPDX-License-Identifier: Apache-2.0

menuconfig ADC_ADS114S0X
	bool "Texas instruments ADS114S0x"
	default y
	depends on DT_HAS_TI_ADS114S08_ENABLED
	select SPI
	select ADC_CONFIGURABLE_INPUTS
	select ADC_CONFIGURABLE_EXCITATION_CURRENT_SOURCE_PIN
	help
	  Enable the driver implementation for the ADS114S0X family

config ADC_ADS114S0X_ASYNC_THREAD_INIT_PRIO
	int "ADC ADS114S0x async thread priority"
	default 0
	depends on ADC_ADS114S0X

config ADC_ADS114S0X_ACQUISITION_THREAD_STACK_SIZE
	int "Stack size for the ADC data acquisition thread"
	default 400
	depends on ADC_ADS114S0X
	help
	  Size of the stack used for the internal data acquisition
	  thread.

config ADC_ADS114S0X_GPIO
	bool "GPIO support"
	default n
	depends on GPIO && ADC_ADS114S0X
	help
	  Enable GPIO child device support in the ADS114S0x ADC driver.

	  The GPIO functionality is handled by the ADS114S0x GPIO
	  driver.

config ADC_ADS114S0X_WAIT_FOR_COMPLETION_TIMEOUT_MS
	int "Timeout for wait for completion of a read in ms"
	default 1000
	depends on ADC_ADS114S0X
	help
	  This is the wait time in ms until a read is completed.
```

## drivers/adc/Kconfig.ads1219
```kconfig
# Copyright (c) 2025 Exceenis SAS
# SPDX-License-Identifier: Apache-2.0

config ADC_ADS1219
	bool "Texas instruments ADS1219 I2C"
	default y
	depends on DT_HAS_TI_ADS1219_ENABLED
	select I2C
	select ADC_CONFIGURABLE_INPUTS
	help
	  Enable the driver implementation for the ADS1119

if ADC_ADS1219

config ADC_ADS1219_ASYNC_THREAD_INIT_PRIO
	int "ADC ADS1219 async thread priority"
	default 0

config ADC_ADS1219_ACQUISITION_THREAD_STACK_SIZE
	int "Stack size for the ADC data acquisition thread"
	default 400
	help
	  Size of the stack used for the internal data acquisition
	  thread.

endif
```

## drivers/adc/Kconfig.ads1220
```kconfig
# Copyright (c) 2025 Baumer Group
# SPDX-License-Identifier: Apache-2.0

menuconfig ADC_ADS1220
	bool "Texas Instruments ADS1220 ADC driver"
	default y
	depends on DT_HAS_TI_ADS1220_ENABLED
	select SPI
	select ADC_CONFIGURABLE_INPUTS
	help
	  Enable the driver for Texas Instruments ADS1220 24-bit, 4-channel,
	  low-power Delta-Sigma ADC with integrated PGA, VREF, SPI interface,
	  and two IDACs.

	  The ADS1220 is a precision ADC designed for high-resolution measurements
	  in sensor applications such as temperature, pressure, and strain sensing.

	  Features supported by this driver:
	  - 24-bit resolution with up to 2000 samples per second
	  - 4 multiplexed input channels (single-ended and differential)
	  - Programmable gain amplifier (1 to 128)
	  - Internal 2.048V reference or external reference
	  - Two matched excitation current sources (IDACs)
	  - Supply monitoring capabilities
	  - 50/60 Hz rejection filters
	  - Low power operation modes

config ADC_ADS1220_WAIT_FOR_COMPLETION_TIMEOUT_MS
	int "Timeout for wait for completion of a read in ms"
	default 250
	depends on ADC_ADS1220
	help
	  This is the wait time in ms until a read is completed.
```
