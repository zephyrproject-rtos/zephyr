## drivers/adc/Kconfig.ads131m02
```kconfig
# Copyright (c) 2024 Linumiz
#
# SPDX-License-Identifier: Apache-2.0

config ADC_ADS131M02
	bool "Texas instruments ADS131M02"
	default y
	depends on DT_HAS_TI_ADS131M02_ENABLED
	select ADC_CONFIGURABLE_INPUTS
	select SPI
	select GPIO
	help
	 Enable the driver for ADS131M02 ADC.
```

## drivers/adc/Kconfig.ads131m08
```kconfig
# Copyright (c) 2026 Siemens AG
#
# SPDX-License-Identifier: Apache-2.0

config ADC_ADS131M08
	bool "Texas instruments ADS131M08"
	default y
	depends on DT_HAS_TI_ADS131M08_ENABLED
	select ADC_CONFIGURABLE_INPUTS
	select SPI
	select GPIO
	select ADS131M08_STREAM if ADC_STREAM
	help
	 Enable the driver for ADS131M08 ADC.

config ADS131M08_STREAM
	bool "Use FIFO to stream data"
	depends on ADC_ADS131M08
	select SPI_RTIO
	select ADS131M08_TRIGGER
	help
	  Use this configuration option to enable streaming ADC data via RTIO.

config ADS131M08_TRIGGER
	bool "ADS131M08 interrupts"
	depends on ADC_ADS131M08
	help
	  Enable interrupts for Texas Instruments ADS131M08.
```

## drivers/adc/Kconfig.ads1x1x
```kconfig
# ADS1X1X ADC configuration options

# Copyright (c) 2021 Facebook, Inc.
# SPDX-License-Identifier: Apache-2.0

config ADC_ADS1X1X
	bool "ADS1X1X driver"
	default y
	depends on DT_HAS_TI_ADS1013_ENABLED || DT_HAS_TI_ADS1014_ENABLED || \
		   DT_HAS_TI_ADS1015_ENABLED || DT_HAS_TI_ADS1113_ENABLED || \
		   DT_HAS_TI_ADS1114_ENABLED || DT_HAS_TI_ADS1115_ENABLED || \
		   DT_HAS_TI_ADS1119_ENABLED

	depends on I2C
	select ADC_CONFIGURABLE_INPUTS
	help
	  Enable ADS1X1X ADC driver.

if ADC_ADS1X1X

config ADC_ADS1X1X_INIT_PRIORITY
	int "Init priority"
	default 80
	help
	  ADS1X1X ADC device driver initialization priority.

config ADC_ADS1X1X_ACQUISITION_THREAD_PRIO
	int "Priority for the ADC data acquisition thread"
	default 0
	help
	  Priority level for the internal ADC data acquisition thread.

config ADC_ADS1X1X_ACQUISITION_THREAD_STACK_SIZE
	int "Stack size for the ADC data acquisition thread"
	default 1024
	help
	  Size of the stack used for the internal data acquisition
	  thread.

endif # ADC_ADS1X1X
```

## drivers/adc/Kconfig.ads1x4s0x
```kconfig
# Copyright (c) 2023 SILA  Embedded Solutions GmbH
#
# SPDX-License-Identifier: Apache-2.0

menuconfig ADC_ADS1X4S0X
	bool "Texas instruments ADS1X4S0X"
	default y
	depends on DT_HAS_TI_ADS114S06_ENABLED || DT_HAS_TI_ADS114S08_ENABLED \
		|| DT_HAS_TI_ADS124S06_ENABLED || DT_HAS_TI_ADS124S08_ENABLED
	select SPI
	select ADC_CONFIGURABLE_INPUTS
	select ADC_CONFIGURABLE_EXCITATION_CURRENT_SOURCE_PIN
	select ADC_CONFIGURABLE_VBIAS_PIN
	help
	  Enable the driver implementation for the ADS1X4S0X family

config ADC_ADS1X4S0X_ASYNC_THREAD_INIT_PRIO
	int "ADC ADS1X4S0X async thread priority"
	default 0
	depends on ADC_ADS1X4S0X

config ADC_ADS1X4S0X_ACQUISITION_THREAD_STACK_SIZE
	int "Stack size for the ADC data acquisition thread"
	default 400
	depends on ADC_ADS1X4S0X
	help
	  Size of the stack used for the internal data acquisition
	  thread.

config ADC_ADS1X4S0X_GPIO
	bool "GPIO support"
	default n
	depends on GPIO && ADC_ADS1X4S0X
	help
	  Enable GPIO child device support in the ADS1X4S0X ADC driver.

	  The GPIO functionality is handled by the ADS1X4S0X GPIO
	  driver.

config ADC_ADS1X4S0X_WAIT_FOR_COMPLETION_TIMEOUT_MS
	int "Timeout for wait for completion of a read in ms"
	default 1000
	depends on ADC_ADS1X4S0X
	help
	  This is the wait time in ms until a read is completed.
```

## drivers/adc/Kconfig.ads7052
```kconfig
# Copyright (c) 2023 Google LLC
#
# SPDX-License-Identifier: Apache-2.0

config ADC_ADS7052
	bool "Texas instruments ADS7052 SPI"
	default y
	depends on DT_HAS_TI_ADS7052_ENABLED
	select SPI
	select ADC_CONFIGURABLE_INPUTS
	help
	  Enable the driver implementation for the ADS7052

if ADC_ADS7052

config ADC_ADS7052_INIT_PRIORITY
	int "ADS7052 init priority"
	default 80
	help
	  ADS7052 device initialization priority must come
	  after SPI initialization

config ADC_ADS7052_ACQUISITION_THREAD_STACK_SIZE
	int "Stack size for the ADC data acquisition thread"
	default 512
	help
	  Size of the stack used for the internal data acquisition
	  thread.

config ADC_ADS7052_ACQUISITION_THREAD_PRIO
	int "Priority for the ADC data acquisition thread"
	default 0
	help
	  Priority level for the internal ADC data acquisition thread.

endif # ADC_ADS7052
```
