## drivers/misc/nxp_rtxxx_adsp_ctl/Kconfig
```kconfig
# Copyright 2023 NXP
# SPDX-License-Identifier: Apache-2.0

config NXP_RTXXX_ADSP_CTL
	bool "NXP i.MX RTxxx DSP control"
	depends on DT_HAS_NXP_RTXXX_ADSP_CTL_ENABLED
	default y
	help
	  Enables a DSP control driver for NXP i.MX RTxxx devices.
```

## drivers/misc/nxp_rtxxx_dsp_ctrl/Kconfig
```kconfig
# Copyright 2025 NXP
# SPDX-License-Identifier: Apache-2.0

config NXP_RTXXX_DSP_CTRL
	bool "NXP i.MX RTxxx DSP control"
	depends on DT_HAS_NXP_RT600_DSP_CTRL_ENABLED || DT_HAS_NXP_RT700_DSP_CTRL_HIFI4_ENABLED
	default y
	help
	  Enables a DSP control driver for NXP i.MX RTxxx devices.
```

## drivers/misc/nxp_s32_emios/Kconfig
```kconfig
# Copyright 2023 NXP
# SPDX-License-Identifier: Apache-2.0

config NXP_S32_EMIOS
	bool "NXP S32 eMIOS drivers"
	depends on DT_HAS_NXP_S32_EMIOS_ENABLED
	help
	  Enable drivers for NXP S32 EMIOS

if NXP_S32_EMIOS

module = NXP_S32_EMIOS
module-str = NXP S32 eMIOS
source "subsys/logging/Kconfig.template.log_config"

config NXP_S32_EMIOS_INIT_PRIORITY
	int "NXP S32 eMIOS initialization priority"
	default KERNEL_INIT_PRIORITY_DEVICE
	help
	  System initialization priority for NXP S32 eMIOS drivers.

endif
```

## drivers/misc/rapidsi_ofe/Kconfig
```kconfig
# Copyright (c) 2023, Meta
# SPDX-License-Identifier: Apache-2.0

config RAPIDSI_OFE
	bool "Rapid Silicon One Flow Engine"
	depends on DT_HAS_RAPIDSI_OFE_ENABLED
	help
		Rapid Silicon One Flow Engine is used to set get the status of the FPGA.	

if RAPIDSI_OFE

	module = RAPIDSI_OFE
	module-str = rapidsi_ofe
	source "subsys/logging/Kconfig.template.log_config"

	config RAPIDSI_OFE_INIT_PRIORITY
		int "Provide initialization priority for one flow engine"
		default 60
endif
```

## drivers/misc/renesas_drw/Kconfig
```kconfig
# Copyright (c) 2025 Renesas Electronics Corporation
# SPDX-License-Identifier: Apache-2.0

# Renesas DRW (D/AVE 2D) config options

menuconfig RENESAS_DRW
	bool "Renesas DRW Driver"
	depends on SOC_FAMILY_RENESAS_RA
	help
	  Enable config options for Renesas DRW driver

if RENESAS_DRW

config RENESAS_DRW_INIT_PRIORITY
	int "Renesas DRW initialization priority"
	default KERNEL_INIT_PRIORITY_DEVICE
	help
	  System initialization priority for Renesas DRW drivers.

source "drivers/misc/renesas_drw/Kconfig.renesas_ra_drw"

endif # RENESAS_DRW
```

## drivers/misc/renesas_drw/Kconfig.renesas_ra_drw
```kconfig
# Copyright (c) 2025 Renesas Electronics Corporation
# SPDX-License-Identifier: Apache-2.0

config RENESAS_RA_DRW
	bool "Renesas RA DRW Driver"
	depends on DT_HAS_RENESAS_RA_DRW_ENABLED
	select USE_RA_FSP_DRW
	default y
	help
	  Enable config options for Renesas DRW driver

if RENESAS_RA_DRW
config RENESAS_DAVE2D_RUNTIME_HEAP_SIZE
	int "Renesas DAVE2D runtime heap size"
	default 8192
	help
	  Set the size of the runtime heap for DAVE2D driver.
	  This heap is used for dynamic memory allocation during runtime.

endif # RENESAS_RA_DRW
```

## drivers/misc/renesas_elc/Kconfig
```kconfig
# Copyright (c) 2025 Renesas Electronics Corporation
# SPDX-License-Identifier: Apache-2.0

# Renesas Event Link Controller config options

config RENESAS_ELC
	bool "Renesas Event Link Controller Driver"
	help
	  Enable config options for Renesas Event Link Controller

if RENESAS_ELC

config RENESAS_ELC_INIT_PRIORITY
	int "Renesas Event Link Controller initialization priority"
	default KERNEL_INIT_PRIORITY_DEVICE
	help
	System initialization priority for Renesas Event Link Controller drivers.

source "drivers/misc/renesas_elc/Kconfig.renesas_ra_elc"

endif # RENESAS_ELC
```

## drivers/misc/renesas_lvd/Kconfig
```kconfig
# Copyright (c) 2025 Renesas Electronics Corporation
# SPDX-License-Identifier: Apache-2.0

# Renesas Low/Programmable Voltage Detection driver

menuconfig RENESAS_LVD
	bool "Renesas Low/Programmable Voltage Detection Drivers"
	depends on SOC_FAMILY_RENESAS_RX
	help
	  Enable config options for Renesas Low/Programmable Voltage Detection

if RENESAS_LVD

config RENESAS_LVD_INIT_PRIORITY
	int "Renesas Low/Programmable Voltage Detection initialization priority"
	default KERNEL_INIT_PRIORITY_DEVICE
	help
	  System initialization priority for Renesas Low/Programmable Voltage Detection drivers.

source "drivers/misc/renesas_lvd/Kconfig.renesas_rx_lvd"

endif # RENESAS_LVD
```

## drivers/misc/renesas_lvd/Kconfig.renesas_rx_lvd
```kconfig
# Copyright (c) 2025 Renesas Electronics Corporation
# SPDX-License-Identifier: Apache-2.0

# Renesas RX Voltage Detection Circuit

config RENESAS_RX_LVD
	bool "Renesas RX Low-Voltage Detection Driver"
	depends on DT_HAS_RENESAS_RX_LVD_ENABLED
	default y
	select USE_RX_RDP_LVD
	select PINCTRL
	help
	  Enable Renesas RX low voltage detection driver
```

## drivers/misc/renesas_ra_external_interrupt/Kconfig
```kconfig
# Copyright (c) 2024 Renesas Electronics Corporation
# SPDX-License-Identifier: Apache-2.0

# Renesas RA External Interrupt Option

config RENESAS_RA_EXTERNAL_INTERRUPT
	bool "Renesas RA External Interrupt Driver"
	depends on DT_HAS_RENESAS_RA_EXTERNAL_INTERRUPT_ENABLED
	default y
	help
	  Enable config options for Renesas RA external interrupt
```

## drivers/misc/renesas_rx_dtc/Kconfig
```kconfig
# Copyright (c) 2025 Renesas Electronics Corporation
# SPDX-License-Identifier: Apache-2.0

# Renesas RX Data Transfer Controller (DTC) Option

config RENESAS_RX_DTC
	bool "Renesas RX Data Transfer Controller (DTC) Driver"
	depends on DT_HAS_RENESAS_RX_DTC_ENABLED
	help
	  Enable config options for Renesas RX Data Transfer Controller
```

## drivers/misc/renesas_rx_external_interrupt/Kconfig
```kconfig
# Copyright (c) 2025 Renesas Electronics Corporation
# SPDX-License-Identifier: Apache-2.0

# Renesas RX External Interrupt Option

config RENESAS_RX_EXTERNAL_INTERRUPT
	bool "Renesas RX External Interrupt Driver"
	depends on DT_HAS_RENESAS_RX_EXTERNAL_INTERRUPT_ENABLED
	default y
	help
	  Enable config options for Renesas RX external interrupt
```

## drivers/misc/renesas_rx_lvd/Kconfig
```kconfig
# Copyright (c) 2025 Renesas Electronics Corporation
# SPDX-License-Identifier: Apache-2.0

# Renesas RX Voltage Detection Circuit

config RENESAS_RX_LVD
	bool "Renesas RX Low-Voltage Detection Driver"
	depends on DT_HAS_RENESAS_RX_LVD_ENABLED
	default y
	select USE_RX_RDP_LVD
	select PINCTRL
	help
	  Enable Renesas RX low voltage detection driver

config RENESAS_RX_LVD_INIT_PRIORITY
	int "RX LVD initialization priority"
	default KERNEL_INIT_PRIORITY_DEVICE
	help
	  System initialization priority for RX LVD driver.
```

## drivers/misc/rp2_cpu1_launcher/Kconfig
```kconfig
# Copyright (c) 2024 Nordic Semiconductor ASA
# Copyright (c) 2025 Dmitrii Sharshakov <d3dx12.xx@gmail.com>
# SPDX-License-Identifier: Apache-2.0

config RP2_CPU1_LAUNCHER
	bool "RP2 series secondary CPU launcher"
	default y
	depends on DT_HAS_RASPBERRYPI_RP2_CPU1_ENABLED && \
		   $(dt_compat_any_has_prop,$(DT_COMPAT_RASPBERRYPI_RP2_CPU1),execution-memory)
	help
	  When enabled, the secondary processors will be automatically launched
	  during system initialization.

if RP2_CPU1_LAUNCHER

module = RP2_CPU1_LAUNCHER
module-str = RP2 series CPU1 Launcher
source "subsys/logging/Kconfig.template.log_config"

config RP2_CPU1_LAUNCHER_INIT_PRIORITY
	int "RP2 series CPU1 Launcher init priority"
	default 0
	help
	  The init priority of the CPU1 Launcher.

endif # RP2_CPU1_LAUNCHER
```

## drivers/misc/sky13317/Kconfig
```kconfig
# SKY13317 GaAs pHEMT single-pole, triple-throw (SP3T) antenna switch

# Copyright (c) 2024 Ayush Singh <ayushdevel1325@gmail.com>
# SPDX-License-Identifier: Apache-2.0

config SKY13317
	bool "SKY13317 GaAs pHEMT single-pole, triple-throw (SP3T) antenna switch"
	default y
	depends on DT_HAS_SKYWORKS_SKY13317_ENABLED
	help
	  Enable driver for SKY13317 antenna switch.

if SKY13317

config SKY13317_INIT_PRIO
	int "SKY13317 initialization priority"
	default 70
	help
	  Set the priority for board init, must be greater than
	  KERNEL_INIT_PRIORITY_DEVICE but smaller than
	  IEEE802154_CC13XX_CC26XX_SUB_GHZ_INIT_PRIO.

endif # SKY13317
```

## drivers/misc/stm32_bootloader/Kconfig
```kconfig
# STM32 system bootloader host driver
#
# Copyright (c) 2026 Alex Fabre
# SPDX-License-Identifier: Apache-2.0

config STM32_BOOTLOADER
	bool "STM32 system bootloader host driver"
	default y
	depends on DT_HAS_ST_STM32_BOOTLOADER_ENABLED
	select GPIO
	help
	  Drive a target STM32's built-in ROM bootloader (AN2606) from a host
	  MCU. The driver exposes the AN3155/ANxxxx command set through its
	  own API (see <zephyr/drivers/misc/stm32_bootloader/stm32_bootloader.h>).

	  To program the target as if it were a local flash device, enable
	  STM32_BOOTLOADER_FLASH and declare an st,stm32-bootloader-flash
	  child node under the bootloader node.

if STM32_BOOTLOADER

module = STM32_BOOTLOADER
module-str = stm32_bootloader
source "subsys/logging/Kconfig.template.log_config"

config STM32_BOOTLOADER_FLASH
	bool "Flash-adapter view of the target"
	default y
	depends on DT_HAS_ST_STM32_BOOTLOADER_FLASH_ENABLED
	depends on FLASH
	select FLASH_PAGE_LAYOUT
	help
	  Enable the thin flash_driver_api adapter that exposes target memory
	  regions declared as st,stm32-bootloader-flash child nodes. Lets
	  callers use flash_read/write/erase, stream_flash, flash_img and
	  mcumgr img_mgmt against the target.

if STM32_BOOTLOADER_FLASH

config STM32_BOOTLOADER_FLASH_INIT_PRIORITY
	int "Flash adapter init priority"
	default 91
	help
	  Must be initialised after the parent bootloader device (which uses
	  CONFIG_STM32_BOOTLOADER_UART_INIT_PRIORITY for the UART transport).

config STM32_BOOTLOADER_FLASH_MAX_PAGES_PER_ERASE
	int "Max pages per flash_erase call"
	default 256
	range 1 4080
	help
	  Upper bound on the number of page indices the adapter may send to
	  the parent in a single flash_erase call. The AN3155 Extended Erase
	  command accepts up to 0xFFF0 pages; 256 covers realistic STM32
	  flash layouts while keeping the on-stack buffer small.

endif # STM32_BOOTLOADER_FLASH

endif # STM32_BOOTLOADER

rsource "usart/Kconfig"
```

## drivers/misc/stm32_bootloader/usart/Kconfig
```kconfig
# STM32 system bootloader over USART (AN3155)
#
# Copyright (c) 2026 Alex Fabre
# SPDX-License-Identifier: Apache-2.0

config STM32_BOOTLOADER_UART
	bool "USART transport (AN3155)"
	default y
	depends on STM32_BOOTLOADER
	depends on $(dt_compat_on_bus,$(DT_COMPAT_ST_STM32_BOOTLOADER),uart)
	depends on SERIAL
	help
	  Program a target STM32 over UART using the AN3155 protocol.

if STM32_BOOTLOADER_UART

config STM32_BOOTLOADER_UART_INIT_PRIORITY
	int "USART transport init priority"
	default 90
	help
	  Must be after GPIO and UART.

module = STM32_BOOTLOADER_UART
module-str = stm32_bootloader_uart
source "subsys/logging/Kconfig.template.log_config"

endif # STM32_BOOTLOADER_UART
```

## drivers/misc/stm32_tsc/Kconfig
```kconfig
# Copyright (c) 2024 Arif Balik <arifbalik@outlook.com>
# SPDX-License-Identifier: Apache-2.0

config STM32_TSC
	bool "STM32 TSC driver"
	default y
	depends on DT_HAS_ST_STM32_TSC_ENABLED
	help
	  Enable driver for STM32 TSC peripheral.
```

## drivers/misc/stm32_xspim/Kconfig
```kconfig
# Copyright (c) 2025 STMicroelectronics
# SPDX-License-Identifier: Apache-2.0

config STM32_XSPIM
	bool
	select USE_STM32_HAL_XSPI
	depends on IS_BOOTLOADER
	default y if DT_HAS_ST_STM32_XSPIM_ENABLED
```

## drivers/misc/stm32n6_axisram/Kconfig
```kconfig
# Copyright (c) 2025 STMicroelectronics
# SPDX-License-Identifier: Apache-2.0

config STM32N6_AXISRAM
	bool
	select USE_STM32_HAL_RAMCFG
	default y if $(dt_nodelabel_enabled,axisram3) || \
		     $(dt_nodelabel_enabled,axisram4) || \
		     $(dt_nodelabel_enabled,axisram5) || \
		     $(dt_nodelabel_enabled,axisram6)
```

## drivers/misc/syna_aon_event_gpio/Kconfig
```kconfig
# Copyright (c) 2025 Synaptics, Inc.
# SPDX-License-Identifier: Apache-2.0

config SYNA_AON_EVENT_GPIO
	bool "Synaptics AON LP GPIO event driver"
	default y
	depends on DT_HAS_SYNA_AON_EVENT_GPIO_ENABLED
	depends on PINCTRL
	depends on GPIO
	help
	  Enable AON LP GPIO event driver for Synaptics SR1XX SoCs.
```

## drivers/misc/ti_tdp2004/Kconfig
```kconfig
# Copyright (c) 2026 BayLibre, SAS
# SPDX-License-Identifier: Apache-2.0

config TI_TDP2004
	bool "TDP2004 Four-Channel 20Gbps DisplayPort 2.1 and 12Gbps HDMI2.1 Linear Redriver"
	default y
	depends on DT_HAS_TI_TDP2004_ENABLED
	select GPIO
	select I2C
	help
	  The TDP2004 is a four-channel linear repeater or redriver designed
	  to support DisplayPort 2.1 up to 20Gbps and AC coupled HDMI2.1 source
	  up to 12Gbps.

if TI_TDP2004

module = TI_TDP2004
module-str = TI TDP2004 DisplayPort and HDMI linear redriver
source "subsys/logging/Kconfig.template.log_config"

config TI_TDP2004_INIT_PRIORITY
	int "TI TDP2004 init priority"
	default I2C_INIT_PRIORITY
	help
	  The init priority of the TI TDP2004 redriver.

endif # TI_TDP2004
```

## drivers/misc/timeaware_gpio/Kconfig
```kconfig
# Timeaware gpio config options

# Copyright (c) 2023 Intel Corporation
# SPDX-License-Identifier: Apache-2.0


menuconfig TIMEAWARE_GPIO
	bool "Timeaware GPIO driver"
	help
	  Enable config options for timeaware GPIO driver.

if TIMEAWARE_GPIO

module = TIMEAWARE_GPIO
module-str = timeaware_gpio
source "subsys/logging/Kconfig.template.log_config"

config TIMEAWARE_GPIO_INIT_PRIORITY
	int "Timeaware GPIO initialization priority"
	default KERNEL_INIT_PRIORITY_DEVICE
	help
	  System initialization priority for timeaware GPIO drivers.

source "drivers/misc/timeaware_gpio/Kconfig.timeaware_gpio_intel"

endif # TIMEAWARE_GPIO
```

## drivers/misc/timeaware_gpio/Kconfig.timeaware_gpio_ifx
```kconfig
# Copyright (c) 2025 Linumiz
#
# SPDX-License-Identifier: Apache-2.0

config TIMEAWARE_GPIO_IFX
	bool "IFX cat1 cyt4dn Time aware GPIO driver"
	default y
	depends on DT_HAS_INFINEON_TCPWM_TGPIO_ENABLED
	select USE_INFINEON_TIMER
	help
	  CAT1 IFX device tgpio functionality found on tcpwm block
```

## drivers/misc/tm1637/Kconfig
```kconfig
# SPDX-License-Identifier: Apache-2.0

config DISPLAY_TM1637
    bool "TM1637 driver"
    depends on GPIO
    default y
    help
      Enable support for TM1637 7-segment display module.
```
