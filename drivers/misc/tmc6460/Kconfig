## drivers/modem/Kconfig.quectel-bg95
```kconfig
config MODEM_QUECTEL_BG95
	bool "Enable QUECTEL BG95 modem driver"
	select MODEM_CONTEXT
	select MODEM_CMD_HANDLER
	select MODEM_IFACE_UART
	select MODEM_SOCKET
	select NET_OFFLOAD
	select NET_SOCKETS_OFFLOAD
	imply GPIO
	help
	  Choose this setting to enable bg95 quectel modem
	  driver.

if MODEM_QUECTEL_BG95

config MODEM_QUECTEL_BG95_NAME
	string "Driver name"
	default "MODEM_QUECTEL_BG95"

config MODEM_QUECTEL_BG95_RX_STACK_SIZE
	int "Stack size for the bg95 rda modem driver RX thread"
	default 4096
	help
	  This stack is used by the bg95 rda RX thread.

config MODEM_QUECTEL_BG95_APP_RESET
	bool "Modem reset is delayed to the app call"
	default n
	help
	  This setting is used to delay the modem reset call and
	  leave it upto the app to call it before using modem
	  functions, instead of the driver calling the reset.
	  This allows the app to boot up quickly without modem
	  delay and gives flexibility to the app to call it
	  whenever it needs modem functionality. NOTE: modem reset
	  has to be called before using any modem functions in the
	  app.
 
config MODEM_QUECTEL_BG95_RX_WORKQ_STACK_SIZE
	int "Stack size for the bg95 rda modem driver work queue"
	default 4096
	help
	  This stack is used by the work queue to pass off net_pkt data
	  to the rest of the network stack, letting the rx thread continue
	  processing data.

config MODEM_SOCKET_MAX_HST_LEN
	int "Socket maximum host url length"
	default 128
	help
	  This stack is used by the work queue to pass off net_pkt data
	  to the rest of the network stack, letting the rx thread continue
	  processing data.

config MODEM_MAXIMUM_TR_RC_SIZE
	int "Maximum uart send or recv buf"
    default 4096
    help
        This setting indicated the maximum buffer size used for transmit
        and receive buffers in HTTP tranfers.

config MODEM_QUECTEL_BG95_APN
	string "APN for establishing network connection"
	default "airtelgprs.com"
	help
	  This setting is used in the AT+CGDCONT command to set the APN name
	  for the network connection context.  This value is specific to
	  the network provider and may need to be changed.

config MODEM_QUECTEL_BG95_INIT_PRIORITY
	int "bg95 rda driver init priority"
	default 85
	help
	  bg95 device driver initialization priority.
	  Do not mess with it unless you know what you are doing.
	  Note that the priority needs to be lower than the net stack
	  so that it can start before the networking sub-system.

endif # MODEM_QUECTEL_BG95
```

## drivers/modem/Kconfig.quectel-bg9x
```kconfig
# Quectel BG9x driver options

# Copyright (c) 2020 Analog Life LLC
# SPDX-License-Identifier: Apache-2.0

config MODEM_QUECTEL_BG9X
	bool "Quectel modem driver [ DEPRECATED ]"
	select MODEM_CONTEXT
	select MODEM_CMD_HANDLER
	select MODEM_IFACE_UART
	select MODEM_SOCKET
	select NET_SOCKETS_OFFLOAD
	select DEPRECATED
	help
	  Choose this setting to enable quectel BG9x LTE-CatM1/NB-IoT modem
	  driver.

if MODEM_QUECTEL_BG9X

config MODEM_QUECTEL_BG9X_RX_STACK_SIZE
	int "Stack size for the quectel BG9X modem driver RX thread"
	default 1028
	help
	  This stack is used by the quectel BG9X RX thread.

config MODEM_QUECTEL_BG9X_RX_WORKQ_STACK_SIZE
	int "Stack size for the quectel BG9X modem driver work queue"
	default 2048
	help
	  This stack is used by the work queue to pass off net_pkt data
	  to the rest of the network stack, letting the rx thread continue
	  processing data.

config MODEM_QUECTEL_BG9X_APN
	string "APN for establishing network connection"
	default "internet"
	help
	  This setting is used to set the APN name for the network connection
	  context.  This value is specific to the network provider and may
	  need to be changed.

config MODEM_QUECTEL_BG9X_USERNAME
	string "Username for establishing network connection"
	default ""
	help
	  This setting is used to set the User name for the network connection
	  context.  This value is specific to the network provider and may
	  need to be changed.

config MODEM_QUECTEL_BG9X_PASSWORD
	string "Password for establishing network connection"
	default ""
	help
	  This setting is used to set the Password for the network connection
	  context.  This value is specific to the network provider and may
	  need to be changed.

config MODEM_QUECTEL_BG9X_UNSOL_RDY
	string "Unsolicited response string expected from the modem"
	default "RDY"
	help
	  This string is used to determine when modem powered and ready
	  to accept AT commands. If this value is not matching the modem
	  response, the init will fail with timeout.

config MODEM_QUECTEL_BG9X_INIT_PRIORITY
	int "quectel BG9X driver init priority"
	default 80
	help
	  quectel BG9X device driver initialization priority.
	  Do not mess with it unless you know what you are doing.
	  Note that the priority needs to be lower than the net stack
	  so that it can start before the networking sub-system.

endif
```

## drivers/modem/Kconfig.simcom-sim7080
```kconfig
# Simcom sim7080 driver options

# Copyright (C) 2021 metraTec GmbH
# SPDX-License-Identifier: Apache-2.0

config MODEM_SIM7080
	bool "Sim7080 Driver"
	select MODEM_CONTEXT
	select MODEM_CMD_HANDLER
	select MODEM_IFACE_UART
	select MODEM_SOCKET
	select NET_OFFLOAD
	select NET_SOCKETS_OFFLOAD
	imply GPIO
	help
	  Enables the driver for the Sim7080 modem.

if MODEM_SIM7080

config MODEM_SIMCOM_SIM7080_RX_STACK_SIZE
	int "Stack size for the simcom sim7080 modem driver rx thread"
	default 1028
	help
	  This stack is used by the simcom SIM7080 RX thread.

config MODEM_SIMCOM_SIM7080_RX_WORKQ_STACK_SIZE
	int "Stack size for the simcom sim7080 modem driver work queue"
	default 2048
	help
		This stack is used by the work queue.

config MODEM_SIMCOM_SIM7080_INIT_PRIORITY
	int "simcom sim7080 driver init priority"
	default 80
	help
	  simcom sim7080 driver initialization priority.

config MODEM_SIMCOM_SIM7080_LTE_BANDS
	string "LTE bands the driver can use"
	default "8,20,28"
	help
		Comma separated list of usable lte bands.

config MODEM_SIMCOM_SIM7080_APN
	string "APN for establishing a network connection"
	default "internet"
	help
	  This setting is used to set the APN name for the network connection
	  context. This value is specific to the network provider and may
	  need to be changed.

choice MODEM_SIMCOM_SIM7080_RAT
	bool "Radio Access Technology Mode"
	default MODEM_SIMCOM_SIM7080_RAT_NB1

config MODEM_SIMCOM_SIM7080_RAT_NB1
	bool "NB-IoT"
	help
		Enable LTE NB-IoT mode.

config MODEM_SIMCOM_SIM7080_RAT_M1
	bool "Cat-M1"
	help
		Enable Cat-M1 mode.

config MODEM_SIMCOM_SIM7080_RAT_GSM
	bool "GSM"
	help
	  Enable GSM mode.

endchoice

endif # MODEM_SIM7080
```

## drivers/modem/Kconfig.sms
```kconfig
# Modem SMS options

# Copyright (c) 2023 T-Moblie
# SPDX-License-Identifier: Apache-2.0

menuconfig MODEM_SMS
		bool "Modem SMS handler"
		default y
		depends on MODEM_CONTEXT
		help
		  Choose this setting to enable SMS functionality for
		  modems.

if MODEM_SMS

config MODEM_SMS_IN_MSG_MAX_LEN
		int "Maximum length of inbound SMS messages"
		default 160
		help
		  This is the maximum length of inbound (received) SMS messages.
		  Inbound SMS messages longer than this will be truncated.
		  The absolute maximum value may be network- and/or modem-dependent,
		  but a smaller value may be preferred in order to conserve memory.

config MODEM_SMS_OUT_MSG_MAX_LEN
		int "Maximum length of outbound SMS messages"
		default MODEM_SMS_IN_MSG_MAX_LEN
		help
		  This is the maximum length of outbound SMS messages (being sent).
		  SMS message send requests longer than this are not possible.
		  The absolute maximum value may be network- and/or modem-dependent,
		  but a smaller value may be preferred in order to conserve memory.

config MODEM_SMS_CALLBACK
		bool "Use SMS Receive callbacks"
		default n
		help
			This option allows a callback to be registered for SMS receive
			events. SMS messages reported via the callback will not be
			buffered, and therefore client code must handle buffering if
			required.

endif # MODEM_SMS
```

## drivers/modem/Kconfig.ublox-sara-n310
```kconfig
# u-blox SARA N310 driver options

# Copyright (c) 2021 Abel Sensors
# SPDX-License-Identifier: Apache-2.0

config MODEM_UBLOX_SARA_N310
	bool "Enable u-blox SARA N310 driver"
	select MODEM_CONTEXT
	select MODEM_CMD_HANDLER
	select MODEM_IFACE_UART
	select MODEM_SOCKET
	select NET_OFFLOAD
	select NET_SOCKETS_OFFLOAD
	imply GPIO
	help
	  Choose this setting to enable u-blox SARA-N310
	  driver.

if MODEM_UBLOX_SARA_N310

config MODEM_UBLOX_SARA_N310_INIT_PRIORITY
	int "u-blox SARA-N310 driver init priority"
	default 80
	help
	  u-blox SARA-N310 device driver initialization priority.
	  Do not mess with it unless you know what you are doing.
	  Note that the priority needs to be lower than the net stack
	  so that it can start before the networking sub-system.

endif # MODEM_UBLOX_SARA_N310
```

## drivers/modem/Kconfig.ublox-sara-r4
```kconfig
# u-blox SARA R4 driver options

# Copyright (c) 2019 Foundries.io
# SPDX-License-Identifier: Apache-2.0

config MODEM_UBLOX_SARA
	bool "Enable u-blox SARA modem driver"
	select MODEM_CONTEXT
	select MODEM_CMD_HANDLER
	select MODEM_IFACE_UART
	select MODEM_SOCKET
	select NET_OFFLOAD
	select NET_SOCKETS_OFFLOAD
	imply GPIO
	help
	  Choose this setting to enable u-blox SARA-R4 LTE-CatM1/NB-IoT modem
	  driver.

if MODEM_UBLOX_SARA

choice MODEM_UBLOX_SARA_VARIANT
	bool "u-blox SARA variant selection"
	default MODEM_UBLOX_SARA_R4

config MODEM_UBLOX_SARA_R4
	bool "u-blox SARA-R4"
	help
	  Enable support for SARA-R4 modem

config MODEM_UBLOX_SARA_U2
	bool "u-blox SARA-U2"
	help
	  Enable support for SARA-U2 modem

config MODEM_UBLOX_SARA_AUTODETECT_VARIANT
	bool "detect automatically"
	help
	  Enable automatic detection of modem variant (SARA-R4 or SARA-U2)

endchoice

config MODEM_UBLOX_SARA_R4_RX_STACK_SIZE
	int "Stack size for the u-blox SARA-R4 modem driver RX thread"
	default 1028
	help
	  This stack is used by the u-blox SARA-R4 RX thread.

config MODEM_UBLOX_SARA_R4_RX_WORKQ_STACK_SIZE
	int "Stack size for the u-blox SARA-R4 modem driver work queue"
	default 2048
	help
	  This stack is used by the work queue to pass off net_pkt data
	  to the rest of the network stack, letting the rx thread continue
	  processing data.

config MODEM_UBLOX_SARA_R4_APN
	string "APN for establishing network connection"
	default "hologram"
	help
	  This setting is used in the AT+CGDCONT command to set the APN name
	  for the network connection context.  This value is specific to
	  the network provider and may need to be changed.

config MODEM_UBLOX_SARA_AUTODETECT_APN
	bool "detect APN automatically"
	help
	  Enable automatic detection of the APN, based on the IMSI
	  If the detection fails, the configured APN will be used

config MODEM_UBLOX_SARA_AUTODETECT_APN_PROFILES
	string "list of profiles to search when autodetecting APN"
	default "hologram=23450, wm=20601 29505 29509 23450 53703 90143"
	help
	  Set a comma separated list of profiles, each containing of:
	  <apn>=<IMSI_1> ... <IMSI_n>

config MODEM_UBLOX_SARA_R4_MANUAL_MCCMNO
	string "MCC/MNOfor establishing network connection"
	help
	  This setting is used in the AT+COPS command to set the MCC/MNO
	  for the network connection context.  This value is specific to
	  the network provider and may need to be changed if auto is not
	  selected.

config MODEM_UBLOX_SARA_R4_INIT_PRIORITY
	int "u-blox SARA-R4 driver init priority"
	default 80
	help
	  u-blox SARA-R4 device driver initialization priority.
	  Do not mess with it unless you know what you are doing.
	  Note that the priority needs to be lower than the net stack
	  so that it can start before the networking sub-system.

config MODEM_UBLOX_SARA_R4_NET_STATUS
	bool "Enable support for network status indication"
	help
	  Choose this setting to use a modem GPIO pin as network indication.

if MODEM_UBLOX_SARA_R4_NET_STATUS

config MODEM_UBLOX_SARA_R4_NET_STATUS_PIN
	int "Network status indication GPIO ID"
	default 16
	help
	  This setting is used to configure one of the modem's GPIO pins
	  as a network status indication.  See the manual for the gpio ids
	  and how they map to pin numbers.

endif # MODEM_UBLOX_SARA_R4_NET_STATUS

config MODEM_UBLOX_SARA_RSSI_WORK
	bool "Enable RSSI polling work"
	default y
	help
	  u-blox SARA-R4 device is configured to poll for RSSI

config MODEM_UBLOX_SARA_RSSI_WORK_PERIOD
	int "Configure RSSI WORK polling frequency"
	depends on MODEM_UBLOX_SARA_RSSI_WORK
	default 30
	help
	  This settings is used to configure the period of RSSI polling

endif # MODEM_UBLOX_SARA
```

## drivers/modem/Kconfig.wncm14a2a
```kconfig
# Kconfig - WNCM 14A2A driver options

#
# Copyright (c) 2018 Foundries.io
#
# SPDX-License-Identifier: Apache-2.0
#

menuconfig MODEM_WNCM14A2A
	bool "Enable Wistron LTE-M modem driver"
	select MODEM_RECEIVER
	select NET_OFFLOAD
	imply GPIO
	help
	  Choose this setting to enable Wistron WNC-M14A2A LTE-M modem driver.
	  NOTE: Currently the pin settings only work with FRDM K64F shield.

if MODEM_WNCM14A2A

config MODEM_WNCM14A2A_RX_STACK_SIZE
	int "Size of the stack for the WNC-M14A2A modem driver RX thread"
	default 1028
	help
	  This stack is used by the WNCM14A2A RX thread.

config MODEM_WNCM14A2A_RX_WORKQ_STACK_SIZE
	int "Size of the stack for the WNC-M14A2A modem driver work queue"
	default 2048
	help
	  This stack is used by the work queue to pass off net_pkt data
	  to the rest of the network stack, letting the rx thread continue
	  processing data.

config MODEM_WNCM14A2A_APN_NAME
	string "APN name for establishing network connection"
	default "m2m.com.attz"
	help
	  This setting is used in the AT%PDNSET command to set the APN name
	  for the network connection context.  Normally, don't need to change
	  this value.

config MODEM_WNCM14A2A_INIT_PRIORITY
	int "WNC-M14A2A driver init priority"
	default 80
	help
	  WNC-M14A2A device driver initialization priority.
	  Do not mess with it unless you know what you are doing.
	  Note that the priority needs to be lower than the net stack
	  so that it can start before the networking sub-system.

endif # MODEM_WNCM14A2A
```

## drivers/modem/Kconfig.zephyr_modem_uart
```kconfig
# Copyright (c) 2024 Trackunit Corporation
# SPDX-License-Identifier: Apache-2.0

config MODEM_ZEPHYR_MODEM_UART
	bool "Generic device driver for modem on UART bus"
	select MODEM_MODULES
	select MODEM_PIPE
	select MODEM_PIPELINK
	select MODEM_BACKEND_UART
	depends on DT_HAS_ZEPHYR_MODEM_UART_ENABLED

if MODEM_ZEPHYR_MODEM_UART

config ZEPHYR_MODEM_UART_INIT_PRIORITY
	int "Device driver init priority"
	default 99

config ZEPHYR_MODEM_UART_BUFFER_SIZES
	int "Size of UART receive and transmit buffers in bytes"
	default 512

endif # MODEM_ZEPHYR_MODEM_UART
```
