## drivers/modem/Kconfig.cellular
```kconfig
# Copyright (c) 2023 Bjarki Arge Andreasen
# SPDX-License-Identifier: Apache-2.0

config MODEM_CELLULAR
	bool "Generic cellular modem support"
	select MODEM_MODULES
	select MODEM_PPP
	select MODEM_CMUX
	select MODEM_CHAT
	select MODEM_PIPE
	select MODEM_PIPELINK
	select MODEM_BACKEND_UART
	select RING_BUFFER
	select NET_L2_PPP_OPTION_MRU
	select NET_L2_PPP_PAP
	select NET_L2_PPP_MGMT
	depends on (DT_HAS_QUECTEL_BG95_ENABLED || DT_HAS_QUECTEL_BG96_ENABLED || \
				DT_HAS_SIMCOM_A76XX_ENABLED || DT_HAS_SIMCOM_SIM7080_ENABLED || \
				DT_HAS_U_BLOX_SARA_R4_ENABLED || DT_HAS_U_BLOX_SARA_R5_ENABLED || \
				DT_HAS_SWIR_HL7800_ENABLED || DT_HAS_TELIT_ME910G1_ENABLED || \
				DT_HAS_TELIT_ME310G1_ENABLED || DT_HAS_QUECTEL_EG25_G_ENABLED || \
				DT_HAS_NORDIC_NRF91_SLM_ENABLED || DT_HAS_SQN_GM02S_ENABLED || \
				DT_HAS_U_BLOX_LARA_R6_ENABLED || DT_HAS_QUECTEL_EG800Q_ENABLED)
	select MODEM_CMUX_DEFAULT_MTU_127 if \
		(DT_HAS_QUECTEL_BG95_ENABLED || DT_HAS_QUECTEL_BG96_ENABLED || \
		 DT_HAS_QUECTEL_EG25_G_ENABLED || DT_HAS_SIMCOM_SIM7080_ENABLED || \
		 DT_HAS_U_BLOX_SARA_R4_ENABLED || DT_HAS_U_BLOX_SARA_R5_ENABLED || \
		 DT_HAS_SWIR_HL7800_ENABLED || DT_HAS_TELIT_ME910G1_ENABLED || \
		 DT_HAS_TELIT_ME310G1_ENABLED || DT_HAS_SQN_GM02S_ENABLED || \
		 DT_HAS_QUECTEL_EG800Q_ENABLED || DT_HAS_SIMCOM_A76XX_ENABLED)
	help
	  This driver uses the generic 3gpp AT commands, along
	  with the standard protocols CMUX and PPP, to configure
	  cellular modems to establish a point-to-point
	  network connection. It is a template for tailored
	  drivers for the ublox, quectel and other modems, which
	  include power management and more complex device specific
	  features.

if MODEM_CELLULAR

config MODEM_CELLULAR_APN
	string "Static APN"
	default "internet"
	help
	  If left empty the driver will wait for the application to call
	  cellular_set_apn() before it proceeds to the dial phase.

config MODEM_CELLULAR_PERIODIC_SCRIPT_MS
	int "Periodic script interval in milliseconds"
	default 2000

config MODEM_CELLULAR_UART_BUFFER_SIZES
	int "The UART receive and transmit buffer sizes in bytes."
	default 512

config MODEM_CELLULAR_CHAT_BUFFER_SIZE
	int "The size of the buffer used for the chat scripts in bytes."
	default 128

config MODEM_CELLULAR_USER_PIPE_BUFFER_SIZES
	int "The size of the buffers used for each user pipe in bytes."
	default 128

config MODEM_CELLULAR_NEW_BAUDRATE
	int "New baudrate to configure modem to, if supported"
	range 9600 4000000
	default 3000000 if DT_HAS_U_BLOX_LARA_R6_ENABLED
	default 115200

config MODEM_CELLULAR_NEW_BAUDRATE_DELAY
	int "Time modem takes to change baudrate, in milliseconds"
	range 0 1000
	default 100 if DT_HAS_U_BLOX_LARA_R6_ENABLED
	default 300

if DT_HAS_U_BLOX_LARA_R6_ENABLED

choice MODEM_CELLULAR_RAT
	prompt "Which Radio Access Technology to use"
	default MODEM_CELLULAR_RAT_4G

config MODEM_CELLULAR_RAT_4G
	bool "Use only 4G"

config MODEM_CELLULAR_RAT_4G_3G
	bool "Use 4G & 3G"

config MODEM_CELLULAR_RAT_4G_3G_2G
	bool "Use 4G, 3G & 2G"

endchoice

config MODEM_CELLULAR_CLEAR_FORBIDDEN
	bool "Clear forbidden networks from SIM-card on boot"

endif #DT_HAS_U_BLOX_LARA_R6_ENABLED

endif #MODEM_CELLULAR
```

## drivers/modem/Kconfig.ehs6
```kconfig
# Kconfig - Gemalto EHS6 driver options

#
# Copyright (c) 2018 Song Qiang <songqiang1304521@gmail.com>
#
# SPDX-License-Identifier: Apache-2.0
#

menuconfig MODEM_EHS6
	bool "Enable Gemalto EHS6 modem driver"
	depends on MODEM
	select MODEM_RECEIVER
	select NET_OFFLOAD
	select NET_SOCKETS_OFFLOAD
	help
	  Choose this setting to enable Gemalto EHS6 modem driver.

if MODEM_EHS6

config MODEM_EHS6_RX_STACK_SIZE
	int "Size of the stack for the EHS6 modem driver RX thread"
	depends on MODEM_EHS6
	default 1028
	help
	  This stack is used by the EHS6 RX thread.

config MODEM_EHS6_APN_NAME
	string "APN name for establishing network connection"
	depends on MODEM_EHS6
	default "bjlenovo07.xfdz.njm2mapn"
	help
	  This setting is used in the AT^SICS=<n> command to set the APN name
	  for the network connection context. This value is provided by your
	  network provider.

config MODEM_EHS6_INIT_PRIORITY
	int "EHS6 driver init priority"
	depends on MODEM_EHS6
	default 80
	help
	  EHS6 device driver initialization priority.
	  Do not mess with it unless you know what you are doing.
	  Note that the priority needs to be lower than the net stack
	  so that it can start before the networking sub-system.

config MODEM_EHS6_TIMEOUT_TIME
	string "EHS6 driver init priority"
	depends on MODEM_EHS6
	default "80"
	help
	  Inactivity timeout value in seconds.

config MODEM_EHS6_DNS_SERVER_ADDRESS
	string "DNS Server address"
	depends on MODEM_EHS6
	default "8.8.8.8"
	  help
	  Primary DNS server address, supports IPv4 Only.

endif
```

## drivers/modem/Kconfig.gsm
```kconfig
# Copyright (c) 2020 Intel Corporation
# SPDX-License-Identifier: Apache-2.0

config MODEM_GSM_PPP
	bool "[DEPRECATED] Support GSM modems"
	select MODEM_CONTEXT
	select MODEM_CMD_HANDLER
	select MODEM_IFACE_UART
	select NET_MGMT
	select NET_MGMT_EVENT
	select DEPRECATED
	help
	  This driver is deprecated, use the MODEM_CELLULAR driver instead.

if MODEM_GSM_PPP

choice MODEM_GSM_TYPE
	prompt "Modem type"
	default MODEM_GSM_GENERIC
	help
	  Type/manufacturer of the GSM modem

config MODEM_GSM_GENERIC
	bool "Generic GSM modem"
	help
	  The modem does not need any special handling etc.

config MODEM_GSM_SIMCOM
	bool "SIMCOM modem"
	help
	  Use this if you have SIMCOM based modem like SIM800 etc.

config MODEM_GSM_QUECTEL
	bool "Quectel modem"
	help
	  Use this if you have Quectel based modem like EC2X etc.

endchoice

config MODEM_GSM_RX_STACK_SIZE
	int "Size of the stack allocated for receiving data from modem"
	default 512
	help
	  Sets the stack size which will be used by the GSM RX thread.

config MODEM_GSM_WORKQ_STACK_SIZE
	int "Size of the stack allocated for the dedicated gsm workqueue"
	default 768
	help
	  Sets the stack size which will be used by the dedicated GSM workqueue
	  thread.

config MODEM_GSM_INIT_PRIORITY
	int "Init priority for the GSM modem driver"
	default 60
	range 0 99
	help
	  The GSM modem is initialized in POST_KERNEL using priority in
	  the range 0-99.

config MODEM_GSM_APN
	string "Access Point Name"
	default "internet"
	help
	  Specify Access Point Name, i.e. the name to identify Internet IP
	  GPRS cellular data context.

config GSM_PPP_AUTOSTART
	bool "Auto-start PPP at boot"
	default y
	help
	  This setting lets driver connect to network and initialize PPP at
	  boot. Unselect this if you want to run application code before
	  modem connects to network. See contents of "drivers/gsm_ppp.h"
	  to get an idea of the API.

config MODEM_GSM_ATTACH_TIMEOUT
	int "Timeout for attaching to packet service"
	default 30
	help
	  Before activating PPP, attachment to packet service is checked
	  using AT+CGATT. This setting dictates how much time in seconds
	  we give the modem before giving up.

config MODEM_GSM_REGISTER_TIMEOUT
	int "Timeout for registering to cellular tower"
	default 300
	help
	  Before attachment to packet service, modem is checked if it is
	  connected to the cellular tower. This setting dictates how much
	  time in seconds we give the modem before giving up.

config MODEM_GSM_MANUAL_MCCMNO
	string "MCC/MNO for establishing network connection"
	help
	  This setting is used in the AT+COPS command to set the MCC/MNO
	  for the network connection context.  This value is specific to
	  the network provider and may need to be changed if auto is not
	  selected.

config MODEM_GSM_RSSI_POLLING_PERIOD
	int "Configure RSSI polling period (in seconds)"
	default 30
	help
	  This settings is used to configure the period of RSSI polling

config MODEM_GSM_ENABLE_CESQ_RSSI
	bool "+CESQ RSSI measurement"
	help
	   If this is enabled, RSRP, RSCP and RXREL values are read from the
	   modem with +CESQ. Otherwise only RSSI value is read with +CSQ
	   from the modem.

config MODEM_GSM_FACTORY_RESET_AT_BOOT
	bool "Factory reset modem at boot"
	help
	  If this is enabled, the modem will be reset to factory default
	  settings first thing in the initialization sequence. This is
	  helpful if your modem has a tendency to get stuck due to cached
	  state.

endif
```
