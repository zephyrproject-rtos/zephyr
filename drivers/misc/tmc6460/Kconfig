## drivers/misc/tmc6460/Kconfig
```kconfig
# SPDX-FileCopyrightText: Copyright (c) 2026 Cherrence Sarip <cherrence.sarip@analog.com>
# SPDX-License-Identifier: Apache-2.0

config TMC6460
	bool "Trinamic TMC6460 FOC motor controller"
	default y
	depends on DT_HAS_ADI_TMC6460_ENABLED
	help
	  Enable support for the Analog Devices / Trinamic TMC6460
	  Field Oriented Control (FOC) motor controller. The TMC6460
	  uses 48-bit (6-byte) datagrams with a 16-bit address space
	  and supports both SPI and UART interfaces. It exposes a
	  device-specific register access and motion control API.

if TMC6460

config TMC6460_SPI
	bool "TMC6460 SPI bus support"
	default y if $(dt_compat_on_bus,$(DT_COMPAT_ADI_TMC6460),spi)
	select SPI
	help
	  Enable SPI bus support for the TMC6460.

config TMC6460_UART
	bool "TMC6460 UART bus support"
	default y if $(dt_compat_on_bus,$(DT_COMPAT_ADI_TMC6460),uart)
	select SERIAL
	help
	  Enable UART bus support for the TMC6460.
	  The TMC6460 UART protocol uses a unique CRC8 polynomial
	  (0x100011011 reflected) and supports RTMI streaming.

config TMC6460_INIT_PRIORITY
	int "TMC6460 initialization priority"
	default 80
	help
	  Device driver initialization priority for the TMC6460.

module = TMC6460
module-str = tmc6460
source "subsys/logging/Kconfig.template.log_config"

endif # TMC6460
```

## drivers/misc/usb3803/Kconfig
```kconfig
# Copyright (c) 2025, Applied Materials
# SPDX-License-Identifier: Apache-2.0

config USB3803
	bool "USB3803 High Speed Hub Controller"
	help
	  USB3803 High Speed Hub Controller

if USB3803

config USB3803_INIT_PRIORITY
	int "usb3803 init priority"
	default 50
	help
	  Init priority for the usb3803 driver.

module = USB3803
module-str = USB3803 HSHC
source "subsys/logging/Kconfig.template.log_config"

endif
```

## drivers/misc/vnd7050aj/Kconfig
```kconfig
# SPDX-License-Identifier: Apache-2.0

config VND7050AJ
	bool "VND7050AJ driver"
	default n
	select ADC
	select GPIO
	help
	    Enable support for the VND7050AJ high-side driver.

if VND7050AJ
    config VND7050AJ_INIT_PRIORITY
        int "VND7050AJ initialization priority"
        default 80
        help
            VND7050AJ driver initialization priority. This should be set to a value
            that ensures the driver is initialized after the required subsystems
            (like GPIO, ADC) but before application code runs.

    config VND7050AJ_LOG_LEVEL
        int "VND7050AJ Log level"
        depends on LOG
        default 3
        range 0 4
        help
            Sets log level for VND7050AJ driver.
            Levels are:
            0 OFF, do not write
            1 ERROR, only write LOG_ERR
            2 WARNING, write LOG_WRN in addition to previous level
            3 INFO, write LOG_INF in addition to previous levels
            4 DEBUG, write LOG_DBG in addition to previous levels
endif # VND7050AJ
```

## drivers/misc/wiz550io/Kconfig
```kconfig
# WIZ550io (W5500 Ethernet) driver configuration options

# Copyright (c) 2024 Grant Ramsay
# SPDX-License-Identifier: Apache-2.0

menuconfig WIZ550IO
	bool "WIZ550io (W5500 Ethernet) driver"
	default y
	depends on DT_HAS_WIZNET_WIZ550IO_ENABLED && ETH_W5500
	help
	  This driver provides the initialsation sequence required for
	  WIZ550io to configure the W5500 Ethernet controller with its
	  embedded unique MAC address.

if WIZ550IO

config WIZ550IO_INIT_PRIORITY
	int "WIZ550io init priority"
	default 79
	help
	  WIZ550io init must occur before W5500 init.
	  The default is ETH_INIT_PRIORITY - 1.

endif # WIZ550IO
```

## drivers/mm/Kconfig
```kconfig
# Copyright (c) 2021 Intel Corporation
#
# SPDX-License-Identifier: Apache-2.0

menuconfig MM_DRV
	bool "Memory Management drivers [EXPERIMENTAL]"
	select EXPERIMENTAL
	select KERNEL_VM_SUPPORT
	help
	  Include Memory Management drivers in system config

if MM_DRV

config MM_DRV_PAGE_SIZE
	hex "Memory Page Size"
	default 0x1000
	help
	  Size of memory pages.

config MM_DRV_INTEL_ADSP_TLB_REMAP_UNUSED_RAM
	bool "Power off unused RAM"
	help
	  Allows TLB driver to remap unused RAM - unused
	  being defined as memory ranging from linker script
	  defined "unused_l2_sram_start_marke" to end of RAM.
	  Note that unused memory will be powered off by
	  default. Disable this option if dynamically
	  managing memory, such as by usinga heap allocator.

config MM_DRV_INTEL_ADSP_MTL_TLB
	bool "Intel Audio DSP TLB Driver for Meteor Lake"
	default y
	depends on DT_HAS_INTEL_ADSP_MTL_TLB_ENABLED
	imply SYS_MEM_BLOCKS
	help
	  Driver for the translation lookup buffer on
	  Intel Audio DSP hardware (Meteor Lake).

config MM_DRV_INTEL_ADSP_TLB
	bool "Intel Audio DSP TLB Driver"
	default y
	depends on DT_HAS_INTEL_ADSP_TLB_ENABLED
	help
	  Driver for the translation lookup buffer on
	  Intel Audio DSP hardware.

config MM_DRV_INTEL_VIRTUAL_REGION_COUNT
	int "Maximum number of regions defined in virtual memory"
	depends on MM_DRV_INTEL_ADSP_MTL_TLB
	default 1
	help
	  This options defines a table size keeping all virtual memory region

config EXTERNAL_ADDRESS_TRANSLATION
	bool "Support for external address translation modules"
	depends on !MMU
	help
	  This config is intended to support an external address
	  translation module if required for an SoC. Uses the
	  sys_mm_drv_page_phys_get() function from the system_mm API.

if EXTERNAL_ADDRESS_TRANSLATION

config MM_TI_RAT
	bool "Texas Instruments RAT module"
	depends on EXTERNAL_ADDRESS_TRANSLATION
	help
	  Enables Region based address translation support
	  functions specific to TI SoCs.

endif # EXTERNAL_ADDRESS_TRANSLATION

endif # MM_DRV
```

## drivers/modem/Kconfig
```kconfig
# Modem configuration options

# Copyright (c) 2018 Foundries.io
# SPDX-License-Identifier: Apache-2.0

menuconfig MODEM
	bool "Modem drivers"
	help
	  Enable config options for modem drivers.

if MODEM

module = MODEM
module-str = modem
source "subsys/logging/Kconfig.template.log_config"

config MODEM_RECEIVER
	bool "Modem receiver helper driver"
	depends on SERIAL_SUPPORT_INTERRUPT
	select UART_INTERRUPT_DRIVEN
	select RING_BUFFER
	help
	  This driver allows modem drivers to communicate over UART with custom
	  defined protocols. Driver doesn't inspect received data and all
	  aspects of received protocol data are handled by application via
	  work method provided.  This driver differs from the pipe UART driver
	  in that callbacks are executed in a different work queue and data is
	  passed around in k_pipe structures.

config MODEM_RECEIVER_MAX_CONTEXTS
	int "Maximum number of modem receiver contexts"
	depends on MODEM_RECEIVER
	range 1 10
	default 1
	help
	  Maximum number of modem receiver contexts to handle.  For most
	  purposes this should stay at 1.

config MODEM_CONTEXT
	bool "Modem context helper driver [EXPERIMENTAL]"
	select EXPERIMENTAL
	help
	  This driver allows modem drivers to communicate with an interface
	  using custom defined protocols. Driver doesn't inspect received data
	  and all aspects of received protocol data are handled by application
	  work method provided.  This driver combines abstractions for:
	  modem interface, command handler, pin config and socket handling each
	  of which will need to be configured.

if MODEM_CONTEXT

config MODEM_CONTEXT_MAX_NUM
	int "Maximum number of modem contexts"
	default 1
	help
	  Maximum number of modem contexts to handle.  For most
	  purposes this should stay at 1.

config MODEM_CONTEXT_VERBOSE_DEBUG
	bool "Verbose debug output in the modem context"
	help
	  Enabling this setting will turn on VERY heavy debugging from the
	  modem context helper.  Do NOT leave on for production.

config MODEM_IFACE_UART
	bool "UART-based modem interface"
	select RING_BUFFER
	help
	  To configure this layer for use, create a modem_iface_uart_data
	  object and pass it's reference to modem_iface_uart_init()
	  along with the modem_iface reference from your modem_context object
	  and the UART device name.

if MODEM_IFACE_UART

choice MODEM_IFACE_UART_BACKEND
	prompt "UART backend to use for modem interface"
	default MODEM_IFACE_UART_INTERRUPT

config MODEM_IFACE_UART_INTERRUPT
	bool "UART-based modem interface using interrupt API"
	depends on SERIAL_SUPPORT_INTERRUPT
	select UART_INTERRUPT_DRIVEN

config MODEM_IFACE_UART_ASYNC
	bool "UART-based modem interface using async API"
	depends on SERIAL_SUPPORT_ASYNC
	select UART_ASYNC_API

endchoice

if MODEM_IFACE_UART_ASYNC

config MODEM_IFACE_UART_ASYNC_RX_BUFFER_SIZE
	int "Size in bytes of the RX buffers provided to UART driver"
	default 64
	help
	  Increasing this value decreases the number of UART interrupts needed
	  to receive large packets.

config MODEM_IFACE_UART_ASYNC_RX_NUM_BUFFERS
	int "Number of RX buffers available to the UART driver"
	default 2
	help
	  This value needs to be twice the number of UART modems using the
	  driver to avoid buffer starvation.

config MODEM_IFACE_UART_ASYNC_RX_TIMEOUT_US
	int "Timeout for flushing RX buffers after receiving no additional data"
	default 278
	help
	  Decreasing this value can help increase data throughput when high
	  baudrates are used. 278us is 4 bytes at 115200 baud. Decreasing this
	  value too much can result in spurious interrupts. Leaving it too
	  high can reduce data throughput.

endif # MODEM_IFACE_UART_ASYNC

endif # MODEM_IFACE_UART

config MODEM_CMD_HANDLER
	bool "Generic modem command handler"
	select NET_BUF
	help
	  This generic command handler uses a modem interface to process
	  incoming data and hand it back to the modem driver via callbacks
	  defined for:
	  - modem responses
	  - unsolicited messages
	  - specified handlers for current operation
	  To configure this layer for use, create a modem_cmd_handler_data
	  object and pass it's reference to modem_cmd_handler_init() along with
	  the modem_cmd_handler reference from your modem_context object.

config MODEM_CMD_HANDLER_MAX_PARAM_COUNT
	int "Maximum number of params parsed per command"
	depends on MODEM_CMD_HANDLER
	default 6
	help
	  This option sets the maximum number of parameters which may be
	  parsed by the command handler.  This is also limited by the length
	  of the match_buf (match_buf_len) field as it needs to be large
	  enough to hold a single line of data (ending with /r).

endif # MODEM_CONTEXT

config MODEM_SOCKET
	bool "Generic modem socket support layer"
	help
	  This layer provides much of the groundwork for keeping track of
	  modem "sockets" throughout their lifecycle (from the initial offload
	  API calls through the command handler call back layers).
	  To configure this layer for use, create a modem_socket_config
	  object with your socket data and pass it's reference to
	  modem_socket_init().
	  Note that the modem socket uses runtime allocated file descriptors
	  reserved from the fdtable, for which the max count is set using the
	  Kconfig option ZVFS_OPEN_MAX. Make sure to update this value as both
	  the modem sockets and the POSIX_API, if used, share them.

config MODEM_SOCKET_PACKET_COUNT
	int "Maximum number of stored packet sizes per socket"
	depends on MODEM_SOCKET
	default 6
	help
	  As the modem indicates more data is available to be received,
	  these values are organized into "packets".  This setting limits
	  the maximum number of packet sizes the socket can keep track of.

config MODEM_SHELL
	bool "Modem shell utilities"
	select SHELL
	help
	  Activate shell module that provides modem utilities like
	  sending a command to the modem UART.

config MODEM_SIM_NUMBERS
	bool "Query the SIM for IMSI and ICCID"
	default y
	help
	  Query the SIM card for the IMSI and ICCID identifiers. This
	  can be disabled if the application does not use a SIM.

config MODEM_CELL_INFO
	bool "Query for operator and cell info"
	help
	  Query for numerical operator id, location area code and cell id.

source "drivers/modem/Kconfig.ublox-sara-r4"
source "drivers/modem/Kconfig.quectel-bg9x"
source "drivers/modem/Kconfig.wncm14a2a"
source "drivers/modem/Kconfig.cellular"
source "drivers/modem/Kconfig.at_shell"

source "drivers/modem/Kconfig.hl7800"
source "drivers/modem/Kconfig.simcom-sim7080"

endif # MODEM
```

## drivers/modem/Kconfig.a9grda
```kconfig
config MODEM_A9GRDA
	bool "Enable A9G RDA modem driver"
	select MODEM_CONTEXT
	select MODEM_CMD_HANDLER
	select MODEM_IFACE_UART
	select MODEM_SOCKET
	select NET_OFFLOAD
	select NET_SOCKETS_OFFLOAD
	imply GPIO
	help
	  Choose this setting to enable a9g rda modem
	  driver.

if MODEM_A9GRDA

config MODEM_A9GRDA_NAME
	string "Driver name"
	default "MODEM_A9G"

config MODEM_A9GRDA_RX_STACK_SIZE
	int "Stack size for the a9g rda modem driver RX thread"
	default 1028
	help
	  This stack is used by the a9g rda RX thread.

config MODEM_A9GRDA_RX_WORKQ_STACK_SIZE
	int "Stack size for the a9g rda modem driver work queue"
	default 2048
	help
	  This stack is used by the work queue to pass off net_pkt data
	  to the rest of the network stack, letting the rx thread continue
	  processing data.

config MODEM_SOCKET_MAX_HST_LEN
	int "Socket maximum host url length"
	default 128
	help
	  This stack is used by the work queue to pass off net_pkt data
	  to the rest of the network stack, letting the rx thread continue
	  processing data.

config MODEM_MAXIMUM_TR_RC_SIZE
	int "Maximum uart send or recv buf"
    default 2048
    help
        This setting indicated the maximum buffer size used for transmit
        and receive buffers in HTTP tranfers.

config MODEM_A9GRDA_APN
	string "APN for establishing network connection"
	default "airtelgprs.com"
	help
	  This setting is used in the AT+CGDCONT command to set the APN name
	  for the network connection context.  This value is specific to
	  the network provider and may need to be changed.

config MODEM_A9GRDA_INIT_PRIORITY
	int "a9g rda driver init priority"
	default 80
	help
	  a9g rda device driver initialization priority.
	  Do not mess with it unless you know what you are doing.
	  Note that the priority needs to be lower than the net stack
	  so that it can start before the networking sub-system.

endif # MODEM_A9G
```

## drivers/modem/Kconfig.at_shell
```kconfig
# Copyright (c) 2024 Trackunit Corporation
# SPDX-License-Identifier: Apache-2.0

config MODEM_AT_SHELL
	bool "AT command shell based on modem modules"
	select MODEM_MODULES
	select MODEM_CHAT
	select MODEM_PIPE
	select MODEM_PIPELINK
	depends on !MODEM_SHELL
	depends on !SHELL_WILDCARD
	depends on $(dt_alias_enabled,modem)

if MODEM_AT_SHELL

config MODEM_AT_SHELL_USER_PIPE
	int "User pipe number to use"
	default 0

config MODEM_AT_SHELL_RESPONSE_TIMEOUT_S
	int "Timeout waiting for response to AT command in seconds"
	default 5

config MODEM_AT_SHELL_COMMAND_MAX_SIZE
	int "Maximum size of AT command"
	default 32

config MODEM_AT_SHELL_RESPONSE_MAX_SIZE
	int "Maximum size of AT response"
	default 64

config MODEM_AT_SHELL_CHAT_RECEIVE_BUF_SIZE
	int "Size of modem chat receive buffer in bytes"
	default 128

endif # MODEM_AT_SHELL
```
