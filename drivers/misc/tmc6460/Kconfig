## drivers/modem/hl78xx/hl78xx_evt_monitor/Kconfig.hl78xx_evt_monitor
```kconfig
#
#  Copyright (c) 2025 Netfeasa Ltd.
#
#  SPDX-License-Identifier: Apache-2.0
#

menuconfig HL78XX_EVT_MONITOR
	bool "HL78XX AT notification monitor"

if HL78XX_EVT_MONITOR

config HL78XX_EVT_MONITOR_HEAP_SIZE
	int "Heap size for notifications"
	range 64 4096
	default 256

config HL78XX_EVT_MONITOR_APP_INIT_PRIORITY
	int "Sierra Wireless HL78XX event monitor app init priority"
	default 0
	help
	  Sierra Wireless HL78XX event monitor app initialization priority.
	  Do not mess with it unless you know what you are doing.

module=HL78XX_EVT_MONITOR
module-dep=LOG
module-str= Event notification monitor library
source "${ZEPHYR_BASE}/subsys/logging/Kconfig.template.log_config"

endif # HL78XX_EVT_MONITOR
```

## drivers/modem/hl78xx/mqtt_offload/Kconfig.mqtt_offload
```kconfig
# MQTT Offload Library for Zephyr

# Copyright (c) 2025 Netfeasa Ltd.
# SPDX-License-Identifier: Apache-2.0

config MQTT_OFFLOAD_LIB
	bool "MQTT Library Support [EXPERIMENTAL]"
	select EXPERIMENTAL
	help
	  Enable the Zephyr MQTT Offload Library

if MQTT_OFFLOAD_LIB

config MQTT_OFFLOAD_LIB_MAX_PAYLOAD_SIZE
	int "Maximum payload size of an MQTT message"
	default $(UINT8_MAX)
	range $(UINT8_MAX) 1024

config MQTT_OFFLOAD_LIB_MAX_MSGS
	int "Number of preallocated messages"
	default 10
	range 1 $(UINT8_MAX)

config MQTT_OFFLOAD_LIB_MAX_TOPICS
	int "Number of topics that can be managed"
	default 20
	range 1 $(UINT8_MAX)

config MQTT_OFFLOAD_LIB_MAX_TOPIC_SIZE
	int "Maximum topic length"
	default 64
	range 1 $(UINT16_MAX)

config MQTT_OFFLOAD_LIB_MAX_ADDR_SIZE
	int "Maximum address size for the transport"
	default 21
	range 1 $(UINT8_MAX)
	help
		The MQTT Offload Library stores addresses internally and thus
		needs to know how long your addresses are. Set this to the maximum
		length in bytes of the address data structure for your implemented transport.

config MQTT_OFFLOAD_LIB_MAX_PUBLISH
	int "Number of publishes that can be in-flight at the same time"
	default 5
	range 1 $(UINT8_MAX)

config MQTT_OFFLOAD_KEEPALIVE
	int "Maximum number of clients Keep alive time for MQTT (in seconds)"
	default 60
	range 0 $(UINT16_MAX)
	help
	  Keep alive time for MQTT (in seconds). Sending of Ping Requests to
	  keep the connection alive are governed by this value.

config MQTT_OFFLOAD_LIB_N_RETRY
	int "Number of times to retry messages"
	range 1 20
	default 5

config MQTT_OFFLOAD_LIB_T_RETRY
	int "Time (seconds) to wait for responses"
	default 10
	range 0 $(UINT8_MAX)

module=MQTT_OFFLOAD
module-dep=NET_LOG
module-str=Log level for MQTT-OFFLOAD
module-help=Enables mqtt-offload debug messages.
source "subsys/net/Kconfig.template.log_config.net"

endif # MQTT_OFFLOAD_LIB
```
