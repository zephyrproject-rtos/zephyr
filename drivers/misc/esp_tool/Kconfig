## drivers/misc/esp_tool/Kconfig
```kconfig
# Copyright (c) 2025 Espressif Systems (Shanghai) Co., Ltd.
# SPDX-License-Identifier: Apache-2.0

config ESP_TOOL
	bool "ESP Serial Flasher Loader using UART"
	depends on DT_HAS_ESPRESSIF_ESP_TOOL_ENABLED
	depends on SERIAL
	depends on GPIO
	help
	  Enable the Espressif ESP Tool driver.

if ESP_TOOL

config ESP_TOOL_SHELL
	bool "ESP tool shell"
	help
	  Enables the ESP tool shell

config ESP_TOOL_FW_ARRAYS
	bool "User provided firmware(s) array"
	help
	  Generates static arrays from provided binary files.

endif # ESP_TOOL
```

## drivers/misc/espressif_rmt/Kconfig
```kconfig
# SPDX-FileCopyrightText: Copyright The Zephyr Project Contributors
# SPDX-License-Identifier: Apache-2.0

menuconfig ESPRESSIF_RMT
	bool "ESP32 RMT driver"
	default y
	depends on DT_HAS_ESPRESSIF_ESP32_RMT_ENABLED
	select DMA if DT_HAS_ESPRESSIF_ESP32_GDMA_ENABLED && SOC_SERIES_ESP32S3
	help
	  Enables the ESP32 Remote Control Transceiver driver.

if ESPRESSIF_RMT

config ESPRESSIF_RMT_INIT_PRIORITY
	int "ESP32 RMT driver init priority"
	default KERNEL_INIT_PRIORITY_DEVICE
	help
	  ESP32 RMT driver initialization priority in POST_KERNEL.

config ESPRESSIF_RMT_TX_ISR_CACHE_SAFE
	bool "RMT TX ISR Cache Safe"
	help
	  Ensure the RMT interrupt is Cache-Safe by allowing the interrupt handler to be
	  executable when the cache is disabled (e.g. SPI Flash write).

config ESPRESSIF_RMT_RX_ISR_CACHE_SAFE
	bool "RMT RX ISR Cache Safe"
	help
	  Ensure the RMT interrupt is Cache-Safe by allowing the interrupt handler to be
	  executable when the cache is disabled (e.g. SPI Flash write).

module = ESPRESSIF_RMT
module-str = espressif_rmt
source "subsys/logging/Kconfig.template.log_config"

endif
```

## drivers/misc/ethos_u/Kconfig
```kconfig
# Copyright (c) 2025 Renesas Electronics Corporation
# SPDX-License-Identifier: Apache-2.0

choice
	prompt "Select vendor Ethos-U NPU driver"
	depends on ETHOS_U
	default ETHOS_U_ARM if DT_HAS_ARM_ETHOS_U_ENABLED
	default ETHOS_U_NUMAKER if DT_HAS_NUVOTON_NUMAKER_NPU_ENABLED

config ETHOS_U_ARM
	bool "Arm Ethos-U NPU driver"
	help
	  Enables Arm Ethos-U NPU driver.

config ETHOS_U_NUMAKER
	bool "Nuvoton NuMaker Ethos-U NPU driver"
	help
	  Enables Nuvoton NuMaker frontend of Arm Ethos-U NPU driver

endchoice

config ETHOS_U_DCACHE
	bool "Override Ethos-U driver DCache functions"
	depends on ETHOS_U
	default y if CACHE_MANAGEMENT
```

## drivers/misc/ethos_u/Kconfig.arm_mps3
```kconfig
# Copyright 2022 Arm Limited and/or its affiliates <open-source-office@arm.com>
#
# SPDX-License-Identifier: Apache-2.0

config ETHOS_U_ARM
	bool "Arm Ethos-U NPU driver"
	default y
	depends on DT_HAS_ARM_ETHOS_U_ENABLED
	help
	  Enables Arm Ethos-U NPU driver.

choice ARM_ETHOS_U_NPU_CONFIG
	default ARM_ETHOS_U55_128
endchoice # ARM_ETHOS_U_NPU_CONFIG
```

## drivers/misc/ft8xx/Kconfig
```kconfig
# FT8xx Embedded Video Engine configuration options

# Copyright (c) 2020-2021 Hubert Miś <hubert.mis@gmail.com>
# SPDX-License-Identifier: Apache-2.0

config FT800
	bool "FT800 Embedded Video Engine driver"
	default y
	depends on DT_HAS_FTDI_FT800_ENABLED
	select SPI
	help
	  Enable driver for FT800 controller.

config FT800_INIT_PRIORITY
	int "FT800 init priority"
	default 90
	depends on FT800
	help
	  FT800 driver initialization priority in POST_KERNEL.
```

## drivers/misc/grove_lcd_rgb/Kconfig
```kconfig
# Copyright (c) 2015 Intel Corporation
# SPDX-License-Identifier: Apache-2.0

config GROVE_LCD_RGB
	bool "Seeed Grove LCD RGB Backlight"
	default y
	depends on DT_HAS_SEEED_GROVE_LCD_RGB_ENABLED
	help
	  Setting this value will enable driver support for the Grove-LCD RGB
	  Backlight.

if GROVE_LCD_RGB
module = GROVE_LCD_RGB
module-str = grove_lcd_rgb
source "subsys/logging/Kconfig.template.log_config"
endif
```

## drivers/misc/interconn/Kconfig
```kconfig
# Interconn drivers not exposing Zephyr Device Driver API

# Copyright (c) 2025 Renesas Electronics Corporation
# SPDX-License-Identifier: Apache-2.0

menu "Interconn Drivers"

source "drivers/misc/interconn/renesas_elc/Kconfig"

endmenu
```

## drivers/misc/interconn/nxp_xbar/Kconfig
```kconfig
# Copyright 2026 NXP
# SPDX-License-Identifier: Apache-2.0

config NXP_XBAR
	bool "NXP Crossbar Switch (XBAR/XBARA/XBARB) driver"
	default y
	depends on DT_HAS_NXP_XBAR_ENABLED
	help
	  Enable the NXP Crossbar Switch (XBAR/XBARA/XBARB) driver.
	  The XBAR allows routing of signals between peripherals.

if NXP_XBAR

config NXP_XBAR_INIT_PRIORITY
	int "NXP XBAR driver initialization priority"
	default KERNEL_INIT_PRIORITY_DEVICE
	help
	  Initialization priority for the XBAR driver.

config NXP_XBAR_WRITE_PROTECT
	bool "Write protection support"
	help
	  Enable support for write-protecting XBAR SEL and CTRL registers.
	  This feature is only available on certain SoCs with 32-bit XBAR registers.

module = NXP_XBAR
module-str = nxp_xbar
source "subsys/logging/Kconfig.template.log_config"

endif # NXP_XBAR
```

## drivers/misc/interconn/renesas_elc/Kconfig
```kconfig
# Copyright (c) 2025 Renesas Electronics Corporation
# SPDX-License-Identifier: Apache-2.0

# Renesas Event Link Controller config options

menuconfig RENESAS_ELC
	bool "Renesas Event Link Controller Driver"
	depends on SOC_FAMILY_RENESAS_RA
	help
	  Enable config options for Renesas Event Link Controller

if RENESAS_ELC

config RENESAS_ELC_INIT_PRIORITY
	int "Renesas Event Link Controller initialization priority"
	default KERNEL_INIT_PRIORITY_DEVICE
	help
	  System initialization priority for Renesas Event Link Controller drivers.

source "drivers/misc/interconn/renesas_elc/Kconfig.renesas_ra_elc"

endif # RENESAS_ELC
```

## drivers/misc/interconn/renesas_elc/Kconfig.renesas_ra_elc
```kconfig
# Copyright (c) 2025 Renesas Electronics Corporation
# SPDX-License-Identifier: Apache-2.0

# Renesas RA Event Link Controller Option

config RENESAS_RA_ELC
	bool "Renesas RA Event Link Controller Driver"
	depends on DT_HAS_RENESAS_RA_ELC_ENABLED
	select USE_RA_FSP_ELC
	default y
	help
	  Enable config options for Renesas RA Event Link Controller
```

## drivers/misc/max2221x/Kconfig
```kconfig
# Copyright (c) 2025 Analog Devices Inc.
# SPDX-License-Identifier: Apache-2.0

config MISC_MAX2221X
	bool "Analog Devices MAX22216/MAX22217 Misc driver"
	default y
	depends on DT_HAS_ADI_MAX2221X_MISC_ENABLED
	select MFD
	help
	  Enable driver for MAX2221X MISC.

if MISC_MAX2221X

config MISC_MAX2221X_INIT_PRIORITY
	int "Init priority"
	default 90
	help
	  Analog Devices MAX22216/MAX22217 Misc driver initialization priority.

module = MISC_MAX2221X
module-str = misc_max2221x
source "subsys/logging/Kconfig.template.log_config"

endif # MISC_MAX2221X
```

## drivers/misc/mcux_flexio/Kconfig
```kconfig
# Copyright (c) 2024, STRIM, ALC
# SPDX-License-Identifier: Apache-2.0

config MCUX_FLEXIO
	bool
	depends on DT_HAS_NXP_FLEXIO_ENABLED
	depends on CLOCK_CONTROL
	help
	  Enable the FlexIO controller driver.
	  This driver is not user-selectable,
	  and should be enabled by other FlexIO drivers so
	  that they can use it to share the resources of the FlexIO device.

if MCUX_FLEXIO

config MCUX_FLEXIO_INIT_PRIORITY
	int "FlexIO controller driver init priority"
	default KERNEL_INIT_PRIORITY_DEVICE
	help
	  MCUX FlexIO device driver initialization priority.

module = MCUX_FLEXIO
module-str = mcux_flexio
source "subsys/logging/Kconfig.template.log_config"

endif # MCUX_FLEXIO
```

## drivers/misc/microbit_display/Kconfig
```kconfig
# Microbit display driver configuration options

# Copyright (c) 2017 Jan Van Winkel <jan.van_winkel@dxplore.eu>
# Copyright (c) 2021 Peter Niebert <peter.niebert@univ-amu.fr>
# SPDX-License-Identifier: Apache-2.0

config MICROBIT_DISPLAY
	bool "BBC micro:bit 5x5 LED Display support"
	depends on (BOARD_BBC_MICROBIT || BOARD_BBC_MICROBIT_V2)
	help
	  Enable this to be able to display images and text on the 5x5
	  LED matrix display on the BBC micro:bit.

if MICROBIT_DISPLAY

config MICROBIT_DISPLAY_STR_MAX
	int "Maximum length of strings that can be shown on the display"
	range 3 255
	default 40
	help
	  This value specifies the maximum length of strings that can
	  be displayed using the mb_display_string() and mb_display_print()
	  APIs.

config MICROBIT_DISPLAY_TIMER_PRIORITY
	int "NRFX Timer Interrupt priority"
	default 1
	help
		Priority of the refresh interrupt of the
		LED matrix. Can probably be low as it is not
		critical.



choice MICROBIT_DISPLAY_TIMER
		prompt "NRFX Hardware Timer"
		default MICROBIT_DISPLAY_TIMER3
		help
			Select the hardware timer instance used by this driver.
			Beware of conflicts with other drivers, e.g. for bluetooth.

# make sure the chosen timer is activated

config MICROBIT_DISPLAY_TIMER0
		bool "TIMER0"
		depends on HAS_HW_NRF_TIMER0
		imply NRFX_TIMER0

config MICROBIT_DISPLAY_TIMER1
		bool "TIMER1"
		depends on HAS_HW_NRF_TIMER1
		imply NRFX_TIMER1

config MICROBIT_DISPLAY_TIMER2
		bool "TIMER2"
		depends on HAS_HW_NRF_TIMER2
		imply NRFX_TIMER2

config MICROBIT_DISPLAY_TIMER3
		bool "TIMER3"
		depends on HAS_HW_NRF_TIMER3
		imply NRFX_TIMER3

config MICROBIT_DISPLAY_TIMER4
		bool "TIMER4"
		depends on HAS_HW_NRF_TIMER4
		imply NRFX_TIMER4

endchoice

if MICROBIT_DISPLAY_TIMER0 && !NRFX_TIMER0
	comment "Activate NRFX_TIMER0 to meet dependency"
endif

if MICROBIT_DISPLAY_TIMER1 && !NRFX_TIMER1
	comment "Activate NRFX_TIMER1 to meet dependency"
endif

if MICROBIT_DISPLAY_TIMER2 && !NRFX_TIMER2
	comment "Activate NRFX_TIMER2 to meet dependency"
endif

if MICROBIT_DISPLAY_TIMER3 && !NRFX_TIMER3
	comment "Activate NRFX_TIMER3 to meet dependency"
endif

if MICROBIT_DISPLAY_TIMER4 && !NRFX_TIMER4
	comment "Activate NRFX_TIMER4 to meet dependency"
endif



endif
```

## drivers/misc/morse_code/Kconfig
```kconfig
# Copyright (c) 2024 Freedom Veiculos Eletricos
# Copyright (c) 2024 OS Systems
# SPDX-License-Identifier: Apache-2.0

config MORSE_CODE
	bool "Morse Code driver"
	default y
	depends on COUNTER
	depends on DT_HAS_ZEPHYR_MORSE_CODE_ENABLED

if MORSE_CODE

module = MORSE_CODE
module-str = Morse Code
source "subsys/logging/Kconfig.template.log_config"

config MORSE_CODE_SHELL
	bool "Morse Code shell"
	depends on SHELL
	help
	  Enable Morse Code related shell commands.

endif # DAC
```

## drivers/misc/neochrom_gpu2d/Kconfig
```kconfig
# Copyright (c) 2026 Silicon Signals Pvt. Ltd.
#
# SPDX-License-Identifier: Apache-2.0

config NEOCHROM_GPU2D
	bool "STM32 NeoChrom GPU2D support"
	depends on DT_HAS_ST_NEOCHROM_GPU2D_ENABLED && LV_USE_NEMA_GFX
	select RESET
	select USE_STM32_HAL_GPU2D
	help
	  Enable support for STM32 NeoChrom GPU2D accelerator.
	  This driver provides low-level access to the GPU2D hardware
	  and is used by NemaGFX for hardware-accelerated rendering.

if NEOCHROM_GPU2D

config NEOCHROM_GPU2D_INIT_PRIORITY
	int "Neochrom gpu2d device init priority"
	default 90
	help
	  Neochrom gpu2d device initialization priority.

module = NEOCHROM_GPU2D
module-str = neochrom_gpu2d
source "subsys/logging/Kconfig.template.log_config"

endif # NEOCHROM_GPU2D
```

## drivers/misc/nordic/Kconfig
```kconfig
# Copyright (c) 2025 Nordic Semiconductor ASA
# SPDX-License-Identifier: Apache-2.0

config MISC_NORDIC
	bool

config NORDIC_NRF_POWER
	bool "Nordic nRF POWER driver"
	default y
	select NRFX_POWER
	select MISC_NORDIC
	depends on DT_HAS_NORDIC_NRF_POWER_ENABLED

config NORDIC_NRF_LRCCONF
	bool "Nordic nRF LRRCONF driver"
	default y
	select MISC_NORDIC
	depends on DT_HAS_NORDIC_NRF_LRCCONF_ENABLED
```

## drivers/misc/nordic_vpr_launcher/Kconfig
```kconfig
# Copyright (c) 2024 Nordic Semiconductor ASA
# SPDX-License-Identifier: Apache-2.0

config NORDIC_VPR_LAUNCHER
	bool "Nordic VPR coprocessor launcher"
	default y
	depends on DT_HAS_NORDIC_NRF_VPR_COPROCESSOR_ENABLED && \
		   $(dt_compat_any_has_prop,$(DT_COMPAT_NORDIC_NRF_VPR_COPROCESSOR),execution-memory)
	help
	  When enabled, the VPR coprocessors will be automatically launched
	  during system initialization.

if NORDIC_VPR_LAUNCHER

module = NORDIC_VPR_LAUNCHER
module-str = Nordic VPR Launcher
source "subsys/logging/Kconfig.template.log_config"

config NORDIC_VPR_LAUNCHER_INIT_PRIORITY
	int "Nordic VPR coprocessor launcher init priority"
	default 44 if DT_HAS_NORDIC_CORESIGHT_NRF_ENABLED
	default 0
	help
	  The init priority of the VPR coprocessor launcher.

config NORDIC_VPR_LAUNCHER_FROM_ARRAY
	bool "Use local array with VPR code instead of device tree partition"
	help
	  Use local array with VPR code instead of device tree partition.
	  Can only be used for a single VPR core.

config NORDIC_VPR_LAUNCHER_DECOMPRESS
	bool "Decompress LZ4-compressed VPR image"
	depends on NORDIC_VPR_LAUNCHER_FROM_ARRAY
	select LZ4
	help
	  Decompress the embedded VPR image with LZ4 before loading it into
	  execution memory. Requires the VPR application to be built with
	  CONFIG_COMPRESS_OUTPUT_BIN so that image.inc contains compressed data.

endif # NORDIC_VPR_LAUNCHER
```

## drivers/misc/nxp_evtg/Kconfig
```kconfig
# SPDX-FileCopyrightText: Copyright 2026 NXP
# SPDX-License-Identifier: Apache-2.0

config NXP_EVTG
	bool "NXP EVTG (Event Generator) driver"
	default y
	depends on DT_HAS_NXP_EVTG_ENABLED
	select CLOCK_CONTROL
	help
	  Enable the NXP EVTG (Event Generator) driver. The EVTG combines up to
	  four inputs through two AND/OR/INVERT blocks and an optional flip-flop
	  to produce an event-generator output on select NXP microcontrollers.
	  Each used EVTG instance is described by a devicetree child node and is
	  programmed statically at init time; the driver wraps the fsl_evtg HAL
	  and exposes no runtime API.
```

## drivers/misc/nxp_flexram/Kconfig
```kconfig
# Copyright (c) 2021 Basalte bv
# Copyright (c) 2023, ithinx GmbH
# Copyright (c) 2023, Tonies GmbH
# Copyright 2020-2023, 2025 NXP
# SPDX-License-Identifier: Apache-2.0

config NXP_FLEXRAM
	bool
	default y if DT_HAS_NXP_FLEXRAM_ENABLED

if NXP_FLEXRAM

config NXP_FLEXRAM_MAGIC_ADDR_API
	bool "NXP FlexRAM magic addr API"
	depends on SOC_SERIES_IMXRT11XX
	help
	  Enable API to use flexRAM magic address functionality

config NXP_FLEXRAM_ERROR_INTERRUPT
	bool "NXP FlexRAM error interrupt"
	help
	  Allow flexram to generate error interrupts

endif # NXP_FLEXRAM
```

## drivers/misc/nxp_gpu2d/Kconfig
```kconfig
# Copyright (c) 2026 Felipe Neves <ryukokki.felipe@gmail.com>
# SPDX-License-Identifier: Apache-2.0

config NXP_GPU2D_BRINGUP
	bool "GPU2D graphics accelerator bring-up driver"
	default y
	depends on DT_HAS_NXP_GPU2D_ENABLED
	help
		This option enables the GPU2D graphics accelerator bring-up
		code, it makes the GPU ready to be consumed by compatible
		specifications drivers like VGLite.
```

## drivers/misc/nxp_igf/Kconfig
```kconfig
# SPDX-FileCopyrightText: Copyright 2026 NXP
# SPDX-License-Identifier: Apache-2.0

config NXP_IGF
	bool "NXP IGF (Input Glitch Filter) driver"
	default y
	depends on DT_HAS_NXP_IMX_IGF_ENABLED
	help
	  Enable the NXP Input Glitch Filter (IGF) driver. The IGF filters
	  glitches out of input signals on i.MX SoCs (e.g. MIMX94398). Channels
	  are configured statically from devicetree child nodes and applied at
	  init time; the driver wraps the fsl_igf HAL and exposes only status
	  read/clear helpers at runtime.
```

## drivers/misc/nxp_imx93_mediamix/Kconfig
```kconfig
# Copyright 2025 NXP
# SPDX-License-Identifier: Apache-2.0

# NXP MEDIAMIX Block Control driver configuration options

config NXP_MEDIAMIX_BLK_CTRL
	bool "NXP MEDIAMIX Block Control driver"
	default y
	depends on DT_HAS_NXP_IMX93_MEDIAMIX_ENABLED
	help
	  Enable driver for MEDIAMIX Block Control.

if NXP_MEDIAMIX_BLK_CTRL

module = MEDIAMIX
module-str = mediamix
source "subsys/logging/Kconfig.template.log_config"

config MEDIAMIX_BLK_CTRL_INIT_PRIORITY
	int "MEDIAMIX initialization priority"
	default 50

endif # NXP_MEDIAMIX_BLK_CTRL
```
