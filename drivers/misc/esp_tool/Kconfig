## drivers/misc/nxp_imx93_video_pll/Kconfig
```kconfig
# Copyright 2025 NXP
# SPDX-License-Identifier: Apache-2.0

config NXP_IMX93_VIDEO_PLL
	bool "Initialize NXP iMX93 VIDEO PLL"
	default y
	depends on DT_HAS_NXP_IMX93_VIDEO_PLL_ENABLED
	help
	  Enable initialization of VIDEO PLL using device tree configuration.

if NXP_IMX93_VIDEO_PLL

module = VIDEO_PLL
module-str = video pll
source "subsys/logging/Kconfig.template.log_config"

config IMX93_VIDEO_PLL_INIT_PRIORITY
	int "i.MX93 video pll initialization priority"
	default 30

endif # NXP_IMX93_VIDEO_PLL
```

## drivers/misc/nxp_inputmux/Kconfig
```kconfig
# Copyright 2025 NXP
# SPDX-License-Identifier: Apache-2.0

config NXP_INPUTMUX
	bool "NXP INPUTMUX driver"
	default n
	depends on HAS_MCUX
	help
	  Includes a HAL driver for the INPUTMUX peripheral on select NXP
	  microcontrollers.
```

## drivers/misc/nxp_power_rail/Kconfig
```kconfig
# SPDX-FileCopyrightText: Copyright 2026 NXP
# SPDX-License-Identifier: Apache-2.0

config NXP_POWER_RAIL
	bool
	help
	  Selected by concrete NXP power-rail controller drivers.

config NXP_PMC_POWER_RAIL
	bool "NXP PMC power-rail controller driver"
	default y
	depends on DT_HAS_NXP_PMC_POWER_RAIL_CONTROLLER_ENABLED
	select NXP_POWER_RAIL
	help
	  Enable the NXP PMC power-rail controller driver.

if NXP_POWER_RAIL

config NXP_POWER_RAIL_INIT_PRIORITY
	int "NXP power-rail controller init priority"
	default KERNEL_INIT_PRIORITY_DEFAULT
	help
	  Initialization priority for the power-rail controllers. Must run
	  earlier than any peripheral driver that consumes a power rail.

endif # NXP_POWER_RAIL
```
