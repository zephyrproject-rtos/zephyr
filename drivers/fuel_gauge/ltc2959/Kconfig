## drivers/fuel_gauge/ltc2959/Kconfig
```kconfig
# Copyright (c) 2025 Nathan Winslow <natelostintimeandspace@gmail.com>
#
# SPDX-License-Identifier: Apache-2.0

config FUEL_GAUGE_LTC2959
	depends on DT_HAS_ADI_LTC2959_ENABLED
	bool "LTC2959 Fuel Gauge"
	default y
	select I2C
	help
	  Enable the LTC2959 fuel gauge driver from Analog Devices.

config EMUL_LTC2959
	bool "Emulate an LTC2959 fuel gauge"
	default y
	depends on EMUL
	depends on FUEL_GAUGE_LTC2959
	help
	  It provides readings which follow a simple sequence, thus allowing
	  test code to check that things are working as expected.
```

## drivers/fuel_gauge/max17043/Kconfig
```kconfig
# MAX17043 Li-Ion battery fuel gauge

# Copyright (c) 2025, Mohammed Billoo <mab@mab-labs.com>
# SPDX-License-Identifier: Apache-2.0


config MAX17043
	bool "MAX17043 Li-Po fuel gauge"
	default y
	depends on DT_HAS_MAXIM_MAX17043_ENABLED
	select I2C
	help
	  Enable driver for the MAX17043 fuel gauge device.
```

## drivers/fuel_gauge/max17048/Kconfig
```kconfig
# MAX17048 Li-Ion battery fuel gauge

# Copyright (c) 2023, Alvaro Garcia <maxpowel@gmail.com>
# SPDX-License-Identifier: Apache-2.0


config MAX17048
	bool "MAX17048 Li-Po fuel gauge"
	default y
	depends on DT_HAS_MAXIM_MAX17048_ENABLED
	select I2C
	help
	  Enable driver for the MAX17048 fuel gauge device.

config EMUL_MAX17048
	bool "Emulate an MAX17048 fuel gague"
	depends on EMUL
	help
	  It provides readings which follow a simple sequence, thus allowing
	  test code to check that things are working as expected.
```

## drivers/fuel_gauge/sbs_gauge/Kconfig.emul_sbs_gauge
```kconfig
# Copyright 2023 Google LLC
# SPDX-License-Identifier: Apache-2.0

# Keep this Kconfig separate from the fuel_gauge/sbs_gauge Kconfig so it may be shared with the
# sensor/sbs_gauge Kconfig.

config EMUL_SBS_GAUGE
	bool "Emulate an SBS 1.1 compliant smart battery fuel gauge"
	depends on EMUL
	help
	  It provides readings which follow a simple sequence, thus allowing
	  test code to check that things are working as expected.
```

## drivers/fuel_gauge/sy24561/Kconfig
```kconfig
# Copyright (c) 2025 Exceenis SAS
# SPDX-License-Identifier: Apache-2.0
#
# Zephyr sy24561 fuel-gauge device

config SY24561
	bool "SILERGY SY24561 fuel gauge"
	default y
	depends on DT_HAS_SILERGY_SY24561_ENABLED
	select I2C
	help
	  Enable driver for the silergy sy24561 fuel gauge device.

config EMUL_SY24561
	bool "Emulate a SY24561 fuel gauge"
	default y
	depends on EMUL
	depends on SY24561
	help
	  It provides readings which follow a simple sequence, thus allowing
	  test code to check that things are working as expected.
```

## drivers/fuse/Kconfig
```kconfig
# Fuse driver configuration options

# Copyright (c) 2025 STMicroelectronics
# SPDX-License-Identifier: Apache-2.0

menuconfig FUSE
	bool "One Time Programmable (OTPs/Fuses) handling drivers"
	help
	  Enable support for fuse hardware.

if FUSE

module = FUSE
module-str = fuse

source "subsys/logging/Kconfig.template.log_config"

source "drivers/fuse/Kconfig.stm32"

config FUSE_INIT_PRIORITY
	int "FUSE init priority"
	default KERNEL_INIT_PRIORITY_DEVICE
	help
	  FUSE device drivers initialization priority. This initialization
	  priority is used unless the driver implementation has its own
	  initialization priority.

config FUSE_PROGRAM
	bool "Yes if fuse programming through Zephyr is allowed"
	help
	  Allowing the programming of fuses may cause irreversible damage
	  to a platform. Use it very carefully and at your own risk.

endif # FUSE
```

## drivers/gnss/Kconfig
```kconfig
# Copyright (c) 2023 Trackunit Corporation
# SPDX-License-Identifier: Apache-2.0

menuconfig GNSS
	bool "GNSS drivers"
	select EXPERIMENTAL
	help
	  Enable GNSS drivers and configuration.

if GNSS

config GNSS_SATELLITES
	bool "GNSS satellites support"
	help
	  Enable GNSS sattelites callback.

config GNSS_DUMP
	bool "GNSS dump support"
	depends on LOG
	help
	  Enable GNSS dump library

config GNSS_DUMP_TO_LOG
	bool "Dump GNSS events to log"
	select GNSS_DUMP
	help
	  Enable GNSS dump to log.

if GNSS_DUMP_TO_LOG

config GNSS_DUMP_TO_LOG_BUF_SIZE
	int "GNSS log dump buffer size"
	default 128
	help
	  Size of GNSS log dump buffer

endif

config GNSS_PARSE
	bool "GNSS parsing utilities"
	help
	  Enable GNSS parsing utilities.

config GNSS_NMEA0183
	bool "NMEA0183 parsing utilities"
	select GNSS_PARSE
	help
	  Enable NMEA0183 parsing utilities.

config GNSS_NMEA0183_MATCH
	bool "GNSS NMEA0183 match utilities"
	select GNSS_NMEA0183
	help
	  Enable NMEA0183 match utilities.

config GNSS_INIT_PRIORITY
	int "GNSS driver initialization priority"
	default 80
	range 0 99
	help
	  Driver initialization priority for GNSS drivers.

config GNSS_U_BLOX_PROTOCOL
	bool "GNSS U-BLOX protocol"
	select MODEM_UBX
	help
	  Enable gnss u-blox protocol.

module = GNSS
module-str = gnss
source "subsys/logging/Kconfig.template.log_config"

rsource "Kconfig.emul"
rsource "Kconfig.generic"
rsource "Kconfig.quectel_lcx6g"
rsource "Kconfig.u_blox_m10"
rsource "Kconfig.luatos_air530z"

endif
```

## drivers/gnss/Kconfig.emul
```kconfig
# Copyright (c) 2024 Trackunit Corporation
# SPDX-License-Identifier: Apache-2.0

config GNSS_EMUL
	bool "Emulated GNSS driver"
	default y
	depends on DT_HAS_ZEPHYR_GNSS_EMUL_ENABLED
	depends on GNSS_REFERENCE_FRAME_WGS84
	select TIMEOUT_64BIT
	help
	  Enable emulated GNSS driver.

config GNSS_EMUL_MANUAL_UPDATE
	bool "Internal state manually updated through gnss_emul_set_data"
	depends on GNSS_EMUL
	help
	  The internal state of the GNSS emulator (location, time, etc)
	  must be updated through gnss_emul_set_data, instead of automatically
	  transitioning to hardcoded states at hardcoded times. Once the current
	  time is set, the published time automatically increments.
```

## drivers/gnss/Kconfig.ericsson_f5521gw
```kconfig
# Copyright (c) 2026 Muhammad Waleed Badar
# SPDX-License-Identifier: Apache-2.0

config GNSS_ERICSSON_F5521GW
	bool "Ericsson F5521gw GNSS driver"
	default y
	depends on GNSS
	depends on DT_HAS_ERICSSON_F5521GW_ENABLED
	depends on GNSS_REFERENCE_FRAME_WGS84
	select MODEM_MODULES
	select MODEM_BACKEND_UART
	select MODEM_CHAT
	select GNSS_PARSE
	select GNSS_NMEA0183
	select GNSS_NMEA0183_MATCH
	help
	  Ericsson F5521gw (HP HS2340) WWAN module GNSS driver.

if GNSS_ERICSSON_F5521GW

config GNSS_ERICSSON_F5521GW_SATELLITES_COUNT
	int "Maximum satellite count"
	depends on GNSS_SATELLITES
	default 24
	help
	  Maximum number of satellite that the driver that can be decoded from
	  the GNSS device. This does not affect the number of devices that the
	  device is actually tracking, just how many of those can be reported
	  in the satellites callback.

endif
```

## drivers/gnss/Kconfig.generic
```kconfig
# Copyright 2023 Google LLC
# SPDX-License-Identifier: Apache-2.0

config GNSS_NMEA_GENERIC
	bool "Generic GNSS NMEA device"
	default y
	depends on GNSS
	depends on DT_HAS_GNSS_NMEA_GENERIC_ENABLED
	select MODEM_MODULES
	select MODEM_BACKEND_UART
	select MODEM_CHAT
	select GNSS_PARSE
	select GNSS_NMEA0183
	select GNSS_NMEA0183_MATCH
	help
	  Generic NMEA based GNSS device.

if GNSS_NMEA_GENERIC

config GNSS_NMEA_GENERIC_SATELLITES_COUNT
	int "Maximum satellite count"
	depends on GNSS_SATELLITES
	default 24
	help
	  Maximum number of satellite that the driver that can be decoded from
	  the GNSS device. This does not affect the number of devices that the
	  device is actually tracking, just how many of those can be reported
	  in the satellites callback.

endif
```

## drivers/gnss/Kconfig.globaltop_pa6h
```kconfig
# Copyright 2026 Hong Nguyen
# SPDX-License-Identifier: Apache-2.0

config GNSS_GLOBALTOP_PA6H
	bool "GlobalTop PA6H GNSS device"
	default y
	depends on GNSS
	depends on DT_HAS_GLOBALTOP_PA6H_ENABLED
	depends on GNSS_REFERENCE_FRAME_WGS84
	select MODEM_MODULES
	select MODEM_BACKEND_UART
	select MODEM_CHAT
	select GNSS_PARSE
	select GNSS_NMEA0183
	select GNSS_NMEA0183_MATCH
	help
	  Enable GlobalTop PA6H GNSS driver.

if GNSS_GLOBALTOP_PA6H

if GNSS_SATELLITES

config GNSS_GLOBALTOP_PA6H_SATELLITES_COUNT
	int "Maximum satellite count"
	depends on GNSS_SATELLITES
	default 22
	help
	  Maximum number of satellites that can be decoded from the
	  GNSS device. This does not affect the number of satellites
	  that the device is actually tracking, only how many of them
	  can be reported in the satellites callback.

endif # GNSS_SATELLITES

endif # GNSS_GLOBALTOP_PA6H
```

## drivers/gnss/Kconfig.luatos_air530z
```kconfig
# Copyright 2024 Jerónimo Agulló
# SPDX-License-Identifier: Apache-2.0

config GNSS_LUATOS_AIR530Z
	bool "Luatos Air530z GNSS device"
	default y
	depends on GNSS
	depends on DT_HAS_LUATOS_AIR530Z_ENABLED
	select MODEM_MODULES
	select MODEM_BACKEND_UART
	select MODEM_CHAT
	select GNSS_PARSE
	select GNSS_NMEA0183
	select GNSS_NMEA0183_MATCH
	help
	  Enable Luatos Air530z GNSS driver.

config GNSS_LUATOS_AIR530Z_SATELLITES_COUNT
	int "Maximum satellite count"
	depends on GNSS_SATELLITES
	default 24
	help
	  Maximum number of satellites that can be decoded from the
	  GNSS device. This does not affect the number of devices that
	  the device is actually tracking, just how many of those can
	  be reported in the satellites callback.
```

## drivers/gnss/Kconfig.quectel_lcx6g
```kconfig
# Copyright (c) 2023 Trackunit Corporation
# Copyright (c) 2023 Bjarki Arge Andreasen
# SPDX-License-Identifier: Apache-2.0

config GNSS_QUECTEL_LCX6G
	bool "Quectel LCX6G GNSS modem driver"
	default y
	depends on GNSS
	depends on DT_HAS_QUECTEL_LC26G_ENABLED || DT_HAS_QUECTEL_LC76G_ENABLED || DT_HAS_QUECTEL_LC86G_ENABLED
	depends on GNSS_REFERENCE_FRAME_WGS84
	select MODEM_MODULES
	select MODEM_BACKEND_UART
	select MODEM_CHAT
	select GNSS_PARSE
	select GNSS_NMEA0183
	select GNSS_NMEA0183_MATCH
	help
	  Enable quectel LCX6G series GNSS modem driver.

if GNSS_QUECTEL_LCX6G

config GNSS_QUECTEL_LCX6G_UART_RX_BUF_SIZE
	int "Size of UART backend receive buffer"
	default 256

config GNSS_QUECTEL_LCX6G_UART_TX_BUF_SIZE
	int "Size of UART backend transmit buffer"
	default 64

if GNSS_SATELLITES

config GNSS_QUECTEL_LCX6G_SAT_ARRAY_SIZE
	int "Size of GNSS satellites array"
	default 24

endif # GNSS_SATELLITES

if GNSS_ACCURACY

config GNSS_QUECTEL_LCX6G_ENABLE_GST
	bool "Send PAIR062 to enable GST output at boot"
	help
	  When enabled, the driver appends a $PAIR062 command to the
	  resume script to enable GST sentence output on the chip at
	  boot. Default n: GST is parsed if the chip emits it, but the
	  driver does not actively enable it. The exact $PAIR062 index
	  used to enable GST varies by Quectel model and is not yet
	  confirmed for the LC76G — see catfish-team upstream PR for
	  issue #17 / PLAN.md Risks.

config GNSS_QUECTEL_LCX6G_PAIR062_GST_INDEX
	int "PAIR062 sentence index for GST"
	depends on GNSS_QUECTEL_LCX6G_ENABLE_GST
	default 6
	range 0 31
	help
	  Sentence-output-rate index passed in $PAIR062,<idx>,1 to enable
	  GST. The default 6 is a placeholder pending datasheet
	  confirmation; verify against the Quectel LC76G manual before
	  flipping this on.

endif # GNSS_ACCURACY

if GNSS_RAW_NMEA

config GNSS_QUECTEL_LCX6G_RAW_TAP_BUF_SIZE
	int "Size of the modem_chat raw-line capture buffer"
	default 128
	range 64 512
	help
	  Bytes reserved for the byte-faithful capture buffer used by the
	  modem_chat line_tap to forward raw NMEA sentences. Lines longer
	  than this are truncated. NMEA 0183 standard caps lines at 82
	  bytes, but proprietary $PQTM / $PAIR sentences can be longer.

endif # GNSS_RAW_NMEA

endif # GNSS_QUECTEL_LCX6G
```

## drivers/gnss/Kconfig.quectel_lx6
```kconfig
# Copyright (c) 2025 Nick Ward <nix.ward@gmail.com>
# SPDX-License-Identifier: Apache-2.0

config GNSS_QUECTEL_LX6
	bool "Quectel LX6 GNSS modem driver"
	default y
	depends on GNSS
	depends on DT_HAS_QUECTEL_L96_ENABLED
	depends on GNSS_REFERENCE_FRAME_WGS84
	select I2C if $(dt_compat_on_bus,$(DT_COMPAT_QUECTEL_L96),i2c)
	select SERIAL if $(dt_compat_on_bus,$(DT_COMPAT_QUECTEL_L96),uart)
	select MODEM_MODULES
	select MODEM_BACKEND_QUECTEL_I2C if $(dt_compat_on_bus,$(DT_COMPAT_QUECTEL_L96),i2c)
	select MODEM_BACKEND_UART if $(dt_compat_on_bus,$(DT_COMPAT_QUECTEL_L96),uart)
	select MODEM_CHAT
	select GNSS_PARSE
	select GNSS_NMEA0183
	select GNSS_NMEA0183_MATCH
	help
	  Enable Quectel LX6 series GNSS modem driver.

if GNSS_QUECTEL_LX6

config GNSS_QUECTEL_LX6_RX_BUF_SIZE
	int "Size of backend receive buffer"
	default 256

config GNSS_QUECTEL_LX6_TX_BUF_SIZE
	int "Size of backend transmit buffer"
	default 64

config GNSS_QUECTEL_LX6_I2C_POLL_MS
	int "GNSS I2C polling interval (ms)"
	range 2 500
	default 500
	depends on $(dt_compat_on_bus,$(DT_COMPAT_QUECTEL_L96),i2c)
	help
	  The interval in milliseconds at which the GNSS module is polled via I2C
	  to read NMEA data. This value should be less than the GNSS fix interval
	  to avoid data loss.

if GNSS_SATELLITES

config GNSS_QUECTEL_LX6_SAT_ARRAY_SIZE
	int "Size of GNSS satellites array"
	default 24

endif # GNSS_SATELLITES

config GNSS_QUECTEL_LX6_RESET_ON_INIT
	bool "Reset Quectel lx6 module during initialization"
	depends on GPIO
	help
	  If enabled, the driver will toggle the reset pin during initialization.
	  The reset pin must be defined in the device tree as reset-gpios.
	  This will issue a hardware reset to the lx6 module by pulling the
	  RESET pin low for at least 10ms, then releasing it. This may clear
	  volatile RAM data but will preserve backup RAM content, allowing
	  faster TTFF after reset.

endif # GNSS_QUECTEL_LX6
```

## drivers/gnss/Kconfig.u_blox_f9p
```kconfig
# Copyright (c) 2025 Croxel Inc.
# Copyright (c) 2025 CogniPilot Foundation
# SPDX-License-Identifier: Apache-2.0

config GNSS_U_BLOX_F9P
	bool "U-BLOX F9P High precision GNSS Module"
	default y
	depends on GNSS
	depends on DT_HAS_U_BLOX_F9P_ENABLED
	select MODEM_MODULES
	select MODEM_BACKEND_UART
	select MODEM_UBX
	help
	  Enable U-BLOX F9P High precision GNSS modem driver.

if GNSS_U_BLOX_F9P

choice GNSS_U_BLOX_F9P_NAV_MODE_HIGH_DYN
	prompt "High Dynamics mode setting"
	default GNSS_U_BLOX_F9P_NAV_MODE_HIGH_DYN_AIRBORNE_2G
	help
	  Choose what the High Dynamics Navigation mode should be for your
	  application use-case.

config GNSS_U_BLOX_F9P_NAV_MODE_HIGH_DYN_AIRBORNE_1G
	bool "Consider High Dynamics mode as 1G Airborne"

config GNSS_U_BLOX_F9P_NAV_MODE_HIGH_DYN_AIRBORNE_2G
	bool "Consider High Dynamics mode as 2G Airborne"

config GNSS_U_BLOX_F9P_NAV_MODE_HIGH_DYN_AIRBORNE_4G
	bool "Consider High Dynamics mode as 4G Airborne"

config GNSS_U_BLOX_F9P_NAV_MODE_HIGH_DYN_AUTOMOTIVE
	bool "Consider High Dynamics mode as Automotive mode"

config GNSS_U_BLOX_F9P_NAV_MODE_HIGH_DYN_SEA
	bool "Consider High Dynamics mode as Sea mode"

config GNSS_U_BLOX_F9P_NAV_MODE_HIGH_DYN_BIKE
	bool "Consider High Dynamics mode as Bike mode"

endchoice

if GNSS_SATELLITES

config GNSS_U_BLOX_F9P_SATELLITES_COUNT
	int "Maximum satellite count"
	default 24

endif # GNSS_SATELLITES

if GNSS_RTK

config GNSS_U_BLOX_F9P_RTK
	bool "Use RTK to improve fix accuracy"
	default y
	depends on GNSS_RTK_PROTOCOL_RTCM3

endif # GNSS_RTK

endif # GNSS_U_BLOX_F9P
```

## drivers/gnss/Kconfig.u_blox_m10
```kconfig
# Copyright 2024 NXP
# SPDX-License-Identifier: Apache-2.0

config GNSS_U_BLOX_M10
	bool "U-BLOX M10 GNSS Module"
	default y
	depends on GNSS
	depends on DT_HAS_U_BLOX_M10_ENABLED
	select MODEM_MODULES
	select MODEM_BACKEND_UART
	select MODEM_CHAT
	select MODEM_UBX
	select GNSS_PARSE
	select GNSS_NMEA0183
	select GNSS_NMEA0183_MATCH
	select GNSS_U_BLOX_PROTOCOL
	select UART_USE_RUNTIME_CONFIGURE
	help
	  Enable U-BLOX M10 GNSS modem driver.

config GNSS_U_BLOX_M10_SATELLITES_COUNT
	int "Maximum satellite count"
	depends on GNSS_SATELLITES
	default 24
	help
	  Maximum number of satellite that the driver that can be decoded from
	  the GNSS device. This does not affect the number of devices that the
	  device is actually tracking, just how many of those can be reported
	  in the satellites callback.
```
