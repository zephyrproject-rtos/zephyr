## drivers/gnss/Kconfig.u_blox_m8
```kconfig
# Copyright 2024 NXP
# SPDX-License-Identifier: Apache-2.0

config GNSS_U_BLOX_M8
	bool "U-BLOX M8 GNSS Module"
	default y
	depends on GNSS
	depends on DT_HAS_U_BLOX_M8_ENABLED
	depends on GNSS_REFERENCE_FRAME_WGS84
	select MODEM_MODULES
	select MODEM_BACKEND_UART
	select GNSS_PARSE
	select GNSS_U_BLOX
	select GNSS_U_BLOX_PROTOCOL
	select UART_USE_RUNTIME_CONFIGURE
	help
	  Enable U-BLOX M8 GNSS modem driver.
```

## drivers/gnss/u_blox/Kconfig
```kconfig
# Copyright (c) 2023 Trackunit Corporation
# SPDX-License-Identifier: Apache-2.0

# zephyr-keep-sorted-start
rsource "Kconfig.u_blox_common"
rsource "Kconfig.u_blox_f9p"
rsource "Kconfig.u_blox_m8"
# zephyr-keep-sorted-stop
```

## drivers/gnss/u_blox/Kconfig.u_blox_common
```kconfig
# Copyright 2024 NXP
# Copyright (c) 2025 Croxel Inc.
# Copyright (c) 2025 CogniPilot Foundation
# SPDX-License-Identifier: Apache-2.0

if GNSS_U_BLOX

if GNSS_SATELLITES

config GNSS_U_BLOX_SATELLITES_COUNT
	int "U-Blox maximum satellite count"
	default 24
	help
	  Maximum number of satellites that the U-Blox drivers can decode.
	  This does not affect the number of satellites the device is tracking,
	  only how many are reported in the satellites callback.

endif # GNSS_SATELLITES

config GNSS_U_BLOX_RESET_ON_INIT
	bool "Reset GNSS on init using reset pin"

endif # GNSS_U_BLOX
```

## drivers/gnss/u_blox/Kconfig.u_blox_m10
```kconfig
# Copyright 2026 CampOS
# SPDX-License-Identifier: Apache-2.0

config GNSS_U_BLOX_M10
	bool "U-BLOX M10 GNSS Module"
	default y
	depends on GNSS
	depends on DT_HAS_U_BLOX_M10_ENABLED
	depends on GNSS_REFERENCE_FRAME_WGS84
	select MODEM_MODULES
	select MODEM_BACKEND_UART
	select GNSS_PARSE
	select GNSS_U_BLOX
	select GNSS_U_BLOX_PROTOCOL
	select UART_USE_RUNTIME_CONFIGURE
	help
		Enable U-BLOX M10 GNSS modem driver.

if GNSS_U_BLOX_M10

choice GNSS_U_BLOX_M10_NAV_MODE_HIGH_DYN
	prompt "High Dynamics mode setting"
	default GNSS_U_BLOX_M10_NAV_MODE_HIGH_DYN_AIRBORNE_2G
	help
	  Choose what the High Dynamics Navigation mode should be for your
	  application use-case.

config GNSS_U_BLOX_M10_NAV_MODE_HIGH_DYN_AIRBORNE_1G
	bool "Consider High Dynamics mode as 1G Airborne"

config GNSS_U_BLOX_M10_NAV_MODE_HIGH_DYN_AIRBORNE_2G
	bool "Consider High Dynamics mode as 2G Airborne"

config GNSS_U_BLOX_M10_NAV_MODE_HIGH_DYN_AIRBORNE_4G
	bool "Consider High Dynamics mode as 4G Airborne"

config GNSS_U_BLOX_M10_NAV_MODE_HIGH_DYN_AUTOMOTIVE
	bool "Consider High Dynamics mode as Automotive mode"

config GNSS_U_BLOX_M10_NAV_MODE_HIGH_DYN_SEA
	bool "Consider High Dynamics mode as Sea mode"

config GNSS_U_BLOX_M10_NAV_MODE_HIGH_DYN_BIKE
	bool "Consider High Dynamics mode as Bike mode"

endchoice

endif # GNSS_U_BLOX_M10
```

## drivers/gnss/ublox-neo-m8/Kconfig
```kconfig
# ublox NEO-M8 GNSS module configuration options

# Copyright (c) 2022 Abel Sensors
# SPDX-License-Identifier: Apache-2.0

menuconfig NEOM8
	bool "u-blox NEO-M8 GNSS Module"
	depends on I2C
	help
	  Enable the driver for u-blox NEO-M8 GNSS Module.

if NEOM8

module = NEOM8
module-str = neom8
source "subsys/logging/Kconfig.template.log_config"

config NEOM8_INIT_PRIORITY
	int "Counter init priority"
	default 80
	help
		NEO-M8 driver device initialization priority.

endif # NEOM8
```

## drivers/gpio/Kconfig
```kconfig
# GPIO configuration options

# Copyright (c) 2015 Intel Corporation
# SPDX-License-Identifier: Apache-2.0

menuconfig GPIO
	bool "General-Purpose Input/Output (GPIO) drivers"
	help
	  Include GPIO drivers in system config

if GPIO

module = GPIO
module-str = gpio
source "subsys/logging/Kconfig.template.log_config"

config GPIO_SHELL
	bool "GPIO Shell"
	depends on SHELL
	help
	  Enable GPIO Shell for testing.

config GPIO_SHELL_INFO_CMD
	bool "GPIO Shell info command"
	default y
	depends on GPIO_SHELL
	help
	  Enable GPIO Shell information command.
	  This command provides a shell user extra information about gpio
	  controller reserved pins and line names.

config GPIO_SHELL_TOGGLE_CMD
	bool "GPIO Shell toggle command"
	default y
	depends on GPIO_SHELL
	help
	  Enable GPIO Shell toggle command.

config GPIO_SHELL_BLINK_CMD
	bool "GPIO Shell blink command"
	default y
	depends on GPIO_SHELL
	help
	  Enable GPIO Shell blink command.
	  This command provides a shell user the ability to 'blink' a pin
	  at 1Hz.

config GPIO_INIT_PRIORITY
	int "GPIO init priority"
	default KERNEL_INIT_PRIORITY_DEFAULT
	help
	  GPIO driver device initialization priority.

config GPIO_GET_DIRECTION
	bool "Support for querying GPIO direction [EXPERIMENTAL]"
	select EXPERIMENTAL
	help
	  Enable this option if the application does not maintain its own GPIO
	  direction state.

	  With this option enabled, the application may query GPIO direction
	  via gpio_port_get_direction(), gpio_pin_is_input(), and
	  gpio_pin_is_output().

config GPIO_GET_CONFIG
	bool "Support for get configuration function [EXPERIMENTAL]"
	select EXPERIMENTAL
	help
	  This option enables the support for getting the current configurations
	  of GPIOs. The driver must implement it to work.

config GPIO_HOGS
	bool "Support for GPIO hogs"
	default $(dt_gpio_hogs_enabled)
	help
	  Enable support for GPIO hogs. GPIO hogging is a mechanism for providing
	  automatic GPIO configuration via devicetree.

config GPIO_HOGS_INIT_PRIORITY
	int "GPIO hogs init priority"
	default 41
	depends on GPIO_HOGS
	help
	  GPIO hogs initialization priority. GPIO hogs must be initialized after the
	  GPIO controller drivers.

config GPIO_ENABLE_DISABLE_INTERRUPT
	bool "Support for enable/disable interrupt without re-config [EXPERIMENTAL]"
	select EXPERIMENTAL
	help
	  This option enables the support for enabling/disabling interrupt with
	  previous configuration, and enabling/disabling the interrupt only turns
	  on/off the interrupt signal without changing other registers, such as
	  pending register, etc. The driver must implement it to work.

source "drivers/gpio/Kconfig.*"

endif # GPIO
```

## drivers/gpio/Kconfig.ad5592
```kconfig
# Copyright (c) 2023 Grinn
# SPDX-License-Identifier: Apache-2.0

config GPIO_AD5592
	bool "AD5592 GPIO driver"
	default y
	depends on DT_HAS_ADI_AD5592_GPIO_ENABLED
	select MFD
	help
	  Enable the AD5592 GPIO driver.
```

## drivers/gpio/Kconfig.ad559x
```kconfig
# Copyright (c) 2023 Grinn
# SPDX-License-Identifier: Apache-2.0

config GPIO_AD559X
	bool "AD559x GPIO driver"
	default y
	depends on DT_HAS_ADI_AD559X_GPIO_ENABLED
	select MFD
	help
	  Enable the AD559x GPIO driver.
```

## drivers/gpio/Kconfig.adi_max22017
```kconfig
# Copyright (c) 2024 Analog Devices Inc.
# Copyright (c) 2024 BayLibre SAS
# SPDX-License-Identifier: Apache-2.0

config GPIO_MAX22017
	bool "Analog devices MAX22017 DAC gpio support"
	default y
	depends on DAC_MAX22017 && DT_HAS_ADI_MAX22017_ENABLED
	help
	  Enable GPIO support for the Analog devices MAX22017 DAC

if GPIO_MAX22017

config GPIO_MAX22017_INIT_PRIORITY
	int "Init priority"
	default 81
	help
	  Analog devices MAX22017 DAC gpio device driver initialization priority.

endif # GPIO_MAX22017
```
