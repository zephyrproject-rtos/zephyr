## drivers/hwinfo/Kconfig.native
```kconfig
# Copyright (c) 2025 Henrik Brix Andersen <henrik@brixandersen.dk>
# SPDX-License-Identifier: Apache-2.0

config HWINFO_NATIVE
	bool "HWINFO driver for native_sim"
	default y
	depends on ARCH_POSIX
	select HWINFO_HAS_DRIVER
	help
	  Enable native_sim HWINFO driver.
```

## drivers/hwinfo/Kconfig.nrf
```kconfig
# Copyright The Zephyr Project Contributors
# SPDX-License-Identifier: Apache-2.0

config HWINFO_NRF
	bool "NRF device ID"
	default y
	depends on SOC_FAMILY_NORDIC_NRF
	depends on SOC_SERIES_NRF54HX || NRF_SOC_SECURE_SUPPORTED
	select HWINFO_HAS_DRIVER
	help
	  Enable Nordic NRF hwinfo driver.
```

## drivers/hwinfo/Kconfig.numaker
```kconfig
# Copyright The Zephyr Project Contributors
# SPDX-License-Identifier: Apache-2.0

config HWINFO_NUMAKER
	bool "NuMaker hwinfo"
	default y
	depends on DT_HAS_NUVOTON_NUMAKER_FMC_ENABLED
	select HWINFO_HAS_DRIVER
	select HAS_NUMAKER_FMC
	help
	  Enable Nuvoton NuMaker hwinfo driver
```

## drivers/hwinfo/Kconfig.numaker_rmc
```kconfig
# Copyright The Zephyr Project Contributors
# SPDX-License-Identifier: Apache-2.0

config HWINFO_NUMAKER_RMC
	bool "NuMaker hwinfo backed up by RMC"
	default y
	depends on DT_HAS_NUVOTON_NUMAKER_RMC_ENABLED
	select HWINFO_HAS_DRIVER
	select HAS_NUMAKER_RMC
	help
	  Enable Nuvoton NuMaker hwinfo driver backed up by RMC
```

## drivers/hwinfo/Kconfig.nxp_otp_uid
```kconfig
# Copyright 2026 NXP
# SPDX-License-Identifier: Apache-2.0

config HWINFO_NXP_OTP_UID
	bool "NXP OTP unique chip identifier"
	default y
	depends on DT_HAS_NXP_OTP_UID_ENABLED
	select HWINFO_HAS_DRIVER
	help
	  Enable the hwinfo device-id backend that reads the unique chip
	  identifier stored in the NXP OTP flash memory area, as described by the
	  nxp,otp-uid devicetree node.
```

## drivers/hwinfo/Kconfig.psoc6
```kconfig
# Copyright The Zephyr Project Contributors
# SPDX-License-Identifier: Apache-2.0

config HWINFO_PSOC6
	bool "Cypress PSOC 6 unique device ID"
	default y
	depends on SOC_FAMILY_PSOC6_LEGACY
	select HWINFO_HAS_DRIVER
	help
	  Enable Cypress PSOC 6 hwinfo driver.
```

## drivers/hwinfo/Kconfig.renesas_ra
```kconfig
# Copyright The Zephyr Project Contributors
# SPDX-License-Identifier: Apache-2.0

config HWINFO_RENESAS_RA
	bool "Renesas RA device ID"
	default y
	depends on SOC_FAMILY_RENESAS_RA
	select HWINFO_HAS_DRIVER
	help
	  Enable RENESAS RA hwinfo driver
```

## drivers/hwinfo/Kconfig.rpi_pico
```kconfig
# Copyright The Zephyr Project Contributors
# SPDX-License-Identifier: Apache-2.0

config HWINFO_RPI_PICO
	bool "Raspberry Pi Pico hwinfo driver"
	default y
	depends on SOC_FAMILY_RPI_PICO
	select HWINFO_HAS_DRIVER
	select PICOSDK_USE_FLASH
	help
	  Enable Raspberry Pi Pico hwinfo driver.

config HWINFO_RPI_PICO_CHIP_ID
	bool "Use chip ID as device ID for RP2350"
	default n
	depends on SOC_SERIES_RP2350
	depends on HWINFO_RPI_PICO
	help
	  Use the chip ID as device ID for RP2350 instead of the default
	  flash RUID. This is useful for RP2350 boards that do not have a
	  flash, or when OTP ID is preferred over flash RUID.
	  This option is recommended for new RP2350 designs, but defaults to n
	  to prevent existing devices from changing their serial numbers.
```

## drivers/hwinfo/Kconfig.rw61x
```kconfig
# Copyright The Zephyr Project Contributors
# SPDX-License-Identifier: Apache-2.0

config HWINFO_RW61X
	bool "RW61X hwinfo"
	default y
	depends on SOC_SERIES_RW6XX
	select HWINFO_HAS_DRIVER
	help
	  Enable RW61X hwinfo driver
```

## drivers/hwinfo/Kconfig.sam
```kconfig
# Copyright The Zephyr Project Contributors
# SPDX-License-Identifier: Apache-2.0

config HWINFO_SAM
	bool "Atmel SAM device ID"
	default y
	depends on SOC_FAMILY_ATMEL_SAM && !SOC_SERIES_SAM4L
	select HWINFO_HAS_DRIVER
	help
	  Enable Atmel SAM device ID hwinfo driver.
```

## drivers/hwinfo/Kconfig.sam0
```kconfig
# Copyright The Zephyr Project Contributors
# SPDX-License-Identifier: Apache-2.0

config HWINFO_SAM0
	bool "Atmel SAM0 device ID"
	default y
	depends on SOC_FAMILY_ATMEL_SAM0
	select HWINFO_HAS_DRIVER
	help
	  Enable Atmel SAM0 hwinfo driver.
```

## drivers/hwinfo/Kconfig.sam4l
```kconfig
# Copyright The Zephyr Project Contributors
# SPDX-License-Identifier: Apache-2.0

config HWINFO_SAM4L
	bool "Atmel SAM4L device ID"
	default y
	depends on SOC_SERIES_SAM4L
	select HWINFO_HAS_DRIVER
	help
	  Enable Atmel SAM4L hwinfo driver.
```

## drivers/hwinfo/Kconfig.sam_rstc
```kconfig
# Copyright The Zephyr Project Contributors
# SPDX-License-Identifier: Apache-2.0

config HWINFO_SAM_RSTC
	bool "Atmel SAM reset cause"
	default y
	depends on SOC_FAMILY_ATMEL_SAM && !SOC_SERIES_SAM4L
	select HWINFO_HAS_DRIVER
	help
	  Enable Atmel SAM reset cause hwinfo driver.
```

## drivers/hwinfo/Kconfig.sifli
```kconfig
# Copyright (c) 2026 SiFli Technologies(Nanjing) Co., Ltd.
# SPDX-License-Identifier: Apache-2.0

config HWINFO_SIFLI_SF32LB52X
	bool "SiFli SF32LB52X device ID"
	default y
	depends on SOC_SERIES_SF32LB52X
	depends on OTP && OTP_SIFLI_EFUSE
	select HWINFO_HAS_DRIVER
	help
	  Enable the hwinfo device ID implementation for SiFli SF32LB52X.
	  The device ID is read from the eFuse OTP controller.
```

## drivers/hwinfo/Kconfig.silabs_series2
```kconfig
# Copyright The Zephyr Project Contributors
# SPDX-License-Identifier: Apache-2.0

config HWINFO_SILABS_S2
	bool "Silabs Series 2 hwinfo"
	default y
	depends on SOC_FAMILY_SILABS_S2
	select HWINFO_HAS_DRIVER
	select SILABS_SISDK_RMU
	help
	  Enable Silabs Series 2 hwinfo driver.
```

## drivers/hwinfo/Kconfig.smartbond
```kconfig
# Copyright The Zephyr Project Contributors
# SPDX-License-Identifier: Apache-2.0

config HWINFO_SMARTBOND
	bool "Smartbond device reset cause"
	default y
	depends on SOC_FAMILY_RENESAS_SMARTBOND
	select HWINFO_HAS_DRIVER
	help
	  Enable Smartbond reset cause hwinfo driver.
```

## drivers/hwinfo/Kconfig.stm32
```kconfig
# Copyright The Zephyr Project Contributors
# SPDX-License-Identifier: Apache-2.0

config HWINFO_STM32
	bool "STM32 hwinfo"
	default y
	depends on SOC_FAMILY_STM32
	select HWINFO_HAS_DRIVER
	help
	  Enable STM32 hwinfo driver.
```

## drivers/hwinfo/Kconfig.sunxi
```kconfig
# SPDX-FileCopyrightText: Copyright The Zephyr Project Contributors
# SPDX-FileCopyrightText: Copyright (c) 2026 Khai Do
# SPDX-License-Identifier: Apache-2.0

config HWINFO_SUNXI
	bool "Allwinner sunXi hwinfo driver"
	default y
	select HWINFO_HAS_DRIVER
	depends on SOC_SUN50I_H618
	depends on $(dt_nodelabel_enabled,sid)
	depends on OTP
	help
	  Enable Allwinner sunXi hwinfo driver.
```

## drivers/hwspinlock/Kconfig
```kconfig
# HW spinlock configuration options

# Copyright (c) 2023 Sequans Communications.
# SPDX-License-Identifier: Apache-2.0

menuconfig HWSPINLOCK
	bool "Hardware spinlock drivers"
	help
	  Include support for HW spinlock.

if HWSPINLOCK

module = HWSPINLOCK
module-str = hwspinlock
source "subsys/logging/Kconfig.template.log_config"

config HWSPINLOCK_INIT_PRIORITY
	int "HW spinlock init priority"
	default KERNEL_INIT_PRIORITY_DEFAULT
	help
	  HW spinlock driver device initialization priority.

# zephyr-keep-sorted-start
source "drivers/hwspinlock/Kconfig.sqn"
source "drivers/hwspinlock/Kconfig.test"
# zephyr-keep-sorted-stop

endif
```

## drivers/hwspinlock/Kconfig.nxp_sema42
```kconfig
# Copyright 2025 NXP
# SPDX-License-Identifier: Apache-2.0

config HWSPINLOCK_NXP_SEMA42
	bool "NXP SEMA42 HW spinlock driver"
	default y
	depends on DT_HAS_NXP_SEMA42_ENABLED
	help
	  This option enables the SEMA42 driver.
```

## drivers/hwspinlock/Kconfig.shell
```kconfig
# Copyright 2026
# SPDX-License-Identifier: Apache-2.0

config HWSPINLOCK_SHELL
	bool "HW spinlock shell"
	depends on SHELL
	help
	  Adds a 'hwspinlock' shell command for interacting with HWSPINLOCK
	  controller devices at runtime. Useful for manual testing when the
	  remote side is not running Zephyr.
```

## drivers/hwspinlock/Kconfig.sqn
```kconfig
# Sequans HW spinlock configuration

# Copyright (c) 2023 Sequans Communications.
# SPDX-License-Identifier: Apache-2.0

config SQN_HWSPINLOCK
	bool "Sequans HW spinlock Driver"
	default y
	depends on DT_HAS_SQN_HWSPINLOCK_ENABLED
	help
	  Enable HW spinlock for SQN

if SQN_HWSPINLOCK
config SQN_HWSPINLOCK_RELAX_TIME
	int "Sequans HW spinlock relax time"
	default 50
	help
	  Default HW spinlock relax time in microseconds.

endif #SQN_HWSPINLOCK
```

## drivers/hwspinlock/Kconfig.test
```kconfig
# Copyright (c) 2025 Analog Devices, Inc.
# SPDX-License-Identifier: Apache-2.0
#
config HWSPINLOCK_TEST
	def_bool DT_HAS_VND_HWSPINLOCK_ENABLED
	depends on DT_HAS_VND_HWSPINLOCK_ENABLED
```

## drivers/hwtrig/Kconfig
```kconfig
# HWTRIG configuration options

# Copyright (c) 2021 Shlomi Vaknin
# SPDX-License-Identifier: Apache-2.0

#
# HWTRIG options
#
menuconfig HWTRIG
	bool "HWTRIG Drivers"
	help
	  Enable Hardware Trigger Driver Configuration

if HWTRIG

source "drivers/hwtrig/Kconfig.stm32"

module = HWTRIG
module-str = hwtrig
source "subsys/logging/Kconfig.template.log_config"

endif # HWTRIG
```

## drivers/hwtrig/Kconfig.stm32
```kconfig
# HWTRIG configuration options

# Copyright (c) 2021 Shlomi Vaknin
# SPDX-License-Identifier: Apache-2.0

DT_COMPAT_ST_STM32_TIMER_TRIGGER := st,stm32-timer-trigger

config HWTRIG_STM32
	bool "Enable STM32 hardware timer trigger driver"
    default y if $(dt_compat_enabled,$(DT_COMPAT_ST_STM32_TIMER_TRIGGER))
	depends on SOC_FAMILY_STM32
    select USE_STM32_LL_TIM
	select USE_STM32_LL_RCC if SOC_SERIES_STM32F4X || SOC_SERIES_STM32F7X || SOC_SERIES_STM32H7X
	help
	  hardware timer trigger driver for STM32 series SoCs.
```
