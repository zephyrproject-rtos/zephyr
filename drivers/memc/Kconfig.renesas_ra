## drivers/memc/Kconfig.renesas_ra
```kconfig
# Renesas RA Family

# Copyright (c) 2024 Renesas Electronics Corporation
# SPDX-License-Identifier: Apache-2.0

config MEMC_RENESAS_RA_SDRAM
	bool "Renesas RA sdram controller"
	default y
	depends on DT_HAS_RENESAS_RA_SDRAM_ENABLED
	select USE_RA_FSP_SDRAM
	help
	  Enable Renesas RA sdram controller
```

## drivers/memc/Kconfig.sam
```kconfig
# Copyright (c) 2022 Basalte bv
# SPDX-License-Identifier: Apache-2.0

config MEMC_SAM_SMC
	bool "Atmel Static Memory Controller (SMC)"
	default y
	depends on DT_HAS_ATMEL_SAM_SMC_ENABLED
	select PINCTRL
	help
	  Enable Atmel Static Memory Controller.
```

## drivers/memc/Kconfig.sifive
```kconfig
# Copyright (c) 2023 Antmicro <www.antmicro.com>
# SPDX-License-Identifier: Apache-2.0

config MEMC_HIFIVE_UNMATCHED_DRAM
	bool "HiFive Unmatched DRAM Memory Controller"
	default y
	depends on DT_HAS_SIFIVE_FU740_C000_DDR_ENABLED
	help
	  Enable HiFive Unmatched Memory Controller.
```

## drivers/memc/Kconfig.siwx91x_qspi
```kconfig
# Copyright (c) 2025 Silicon Laboratories Inc.
# SPDX-License-Identifier: Apache-2.0

config MEMC_SILABS_SIWX91X_QSPI
	bool "Silabs SiWx91x QSPI memory controller"
	default y
	depends on DT_HAS_SILABS_SIWX91X_QSPI_MEMORY_ENABLED
	depends on CLOCK_CONTROL
	select PINCTRL
	help
	  Enable Silabs SiWx91x QSPI (Quad Serial Peripheral Interface) memory
	  controller.

	  If you want to rely on the linker to place symbols in this memory
	  (using`zephyr_code_relocate() or Z_GENERIC_SECTION()), you have to
	  ensure this driver in initialized before KERNEL_INIT_PRIORITY_OBJECTS
	  (=30). In addition, this driver may depends on a clock. Then, you have
	  to ensure the clock will be started before this driver (see
	  CLOCK_CONTROL_INIT_PRIORITY)
```

## drivers/memc/Kconfig.smartbond
```kconfig
# Smartbond Cryptographic Accelerator configuration options

# Copyright (c) 2023 Renesas Electronics Corporation
# SPDX-License-Identifier: Apache-2.0

config MEMC_SMARTBOND
	bool "Smartbond NOR/PSRAM memory controller"
	depends on DT_HAS_RENESAS_SMARTBOND_NOR_PSRAM_ENABLED
	default y
	help
		Enable Smartbond NOR/PSRAM memory controller.
```

## drivers/memc/Kconfig.stm32
```kconfig
# Copyright (c) 2020 Teslabs Engineering S.L.
# SPDX-License-Identifier: Apache-2.0

config MEMC_STM32
	bool "STM32 Flexible Memory Controller (FMC)"
	default y
	depends on DT_HAS_ST_STM32_FMC_ENABLED || DT_HAS_ST_STM32H7_FMC_ENABLED
	select PINCTRL
	help
	  Enable STM32 Flexible Memory Controller.

if MEMC_STM32

config MEMC_STM32_SDRAM
	bool "STM32 FMC SDRAM controller"
	default y
	depends on DT_HAS_ST_STM32_FMC_SDRAM_ENABLED
	select USE_STM32_LL_FMC
	select USE_STM32_HAL_SDRAM
	help
	  Enable STM32 FMC SDRAM controller.

config MEMC_STM32_NOR_PSRAM
	bool "STM32 FMC NOR/PSRAM controller"
	default y
	depends on DT_HAS_ST_STM32_FMC_NOR_PSRAM_ENABLED
	select USE_STM32_LL_FMC
	select USE_STM32_HAL_NOR
	select USE_STM32_HAL_SRAM
	help
	  Enable STM32 FMC NOR/PSRAM controller.

endif

config MEMC_STM32_XSPI_PSRAM
	bool "STM32 XSPI PSRAM"
	default y
	depends on DT_HAS_ST_STM32_XSPI_PSRAM_ENABLED
	select USE_STM32_HAL_XSPI
	select PINCTRL
	help
	  Enable STM32 XSPI Memory Controller.
```

## drivers/memc/Kconfig.xmc4xxx
```kconfig
# Copyright (c) 2022 Schlumberger
# SPDX-License-Identifier: Apache-2.0

config MEMC_XMC4XXX_EBU
	bool "XMC4XXX External Bus Unit"
	default y
	depends on DT_HAS_INFINEON_XMC4XXX_EBU_ENABLED
	help
	  Enable XMC4XXX External Bus Unit.
```

## drivers/mfd/Kconfig
```kconfig
# Copyright 2023 Nordic Semiconductor ASA
# SPDX-License-Identifier: Apache-2.0

menuconfig MFD
	bool "Multi-function device (MFD) drivers"
	help
	  Include drivers for multi-function devices

if MFD

module = MFD
module-str = mfd
source "subsys/logging/Kconfig.template.log_config"

config MFD_INIT_PRIORITY
	int "Initialization priority"
	default 80
	help
	  Multi-function devices initialization priority.

# zephyr-keep-sorted-start
source "drivers/mfd/Kconfig.ad559x"
source "drivers/mfd/Kconfig.adp5585"
source "drivers/mfd/Kconfig.aw9523b"
source "drivers/mfd/Kconfig.axp192"
source "drivers/mfd/Kconfig.axp2101"
source "drivers/mfd/Kconfig.bd8lb600fs"
source "drivers/mfd/Kconfig.ds3231"
source "drivers/mfd/Kconfig.it8801"
source "drivers/mfd/Kconfig.lpflexcomm"
source "drivers/mfd/Kconfig.max20335"
source "drivers/mfd/Kconfig.max22017"
source "drivers/mfd/Kconfig.max31790"
source "drivers/mfd/Kconfig.maxq10xx"
source "drivers/mfd/Kconfig.mc146818"
source "drivers/mfd/Kconfig.mchp_sam"
source "drivers/mfd/Kconfig.nct38xx"
source "drivers/mfd/Kconfig.npm13xx"
source "drivers/mfd/Kconfig.npm2100"
source "drivers/mfd/Kconfig.npm6001"
source "drivers/mfd/Kconfig.pca9422"
source "drivers/mfd/Kconfig.pf1550"
source "drivers/mfd/Kconfig.rv3032_mfd"
source "drivers/mfd/Kconfig.tle9104"
# zephyr-keep-sorted-stop

endif # MFD
```

## drivers/mfd/Kconfig.ad5592
```kconfig
# Copyright (c) 2023 Grinn
# SPDX -License-Identifier: Apache-2.0

config MFD_AD5592
	bool "Analog AD5592 SPI configurable ADC/DAC/GPIO chip"
	default y
	depends on DT_HAS_ADI_AD5592_ENABLED
	depends on SPI
	help
	  Enable driver for Analog AD5592.
```

## drivers/mfd/Kconfig.ad559x
```kconfig
# Copyright (c) 2023 Grinn
# SPDX -License-Identifier: Apache-2.0

menuconfig MFD_AD559X
	bool "Analog AD559x I2C/SPI configurable ADC/DAC/GPIO chip"
	default y
	depends on DT_HAS_ADI_AD559X_ENABLED
	help
	  Enable driver for Analog AD5592 or Analog AD5593.

if MFD_AD559X

config MFD_AD559X_BUS_I2C
	bool "Analog AD559x I2C bus support"
	default y
	depends on $(dt_compat_on_bus,$(DT_COMPAT_ADI_AD559X),i2c)
	depends on I2C

config MFD_AD559X_BUS_SPI
	bool "Analog AD559x SPI bus support"
	default y
	depends on $(dt_compat_on_bus,$(DT_COMPAT_ADI_AD559X),spi)
	depends on SPI

endif # MFD_AD559X
```

## drivers/mfd/Kconfig.adp5360
```kconfig
# Copyright 2026 Analog Devices, Inc.
# SPDX-License-Identifier: Apache-2.0

menuconfig MFD_ADP5360
	bool "ADP5360 Battery Management PMIC With Buck and Buck Boost"
	default y
	depends on DT_HAS_ADI_ADP5360_ENABLED
	select I2C
	help
	  Enable driver for ADI ADP5360.

if MFD_ADP5360

config MFD_ADP5360_TRIGGER
	bool

choice ADP5360_TRIGGER_MODE
	prompt "Set option of interrupt handling"
	default ADP5360_TRIGGER_NONE
	help
	  Choose how interrupt handling for the ADP5360 mfd driver should be implemented.
	  This allows selecting between different interrupt handling mechanisms based
	  on the application requirements.

config ADP5360_TRIGGER_NONE
	bool "No trigger"

config ADP5360_TRIGGER_GLOBAL_THREAD
	bool "Use global thread"
	depends on GPIO
	select MFD_ADP5360_TRIGGER
	help
	  Use global thread for the interrupt handler

config ADP5360_TRIGGER_OWN_THREAD
	bool "Use own thread"
	depends on GPIO
	select MFD_ADP5360_TRIGGER
	help
	  Use own thread for the interrupt handler

endchoice # ADP5360_TRIGGER_MODE

config ADP5360_THREAD_PRIORITY
	int "thread priority"
	depends on ADP5360_TRIGGER_OWN_THREAD
	default 10
	help
	  Set the priority of the thread used for handling interrupts when using own thread.
	  A higher value indicates a higher priority.

config ADP5360_THREAD_STACK_SIZE
	int "thread stack size"
	depends on ADP5360_TRIGGER_OWN_THREAD
	default 1024
	help
	  Specify the stack size (in bytes) for the thread used to handle interrupts when
	  "Use own thread" is selected. Ensure the stack size is sufficient for the interrupt
	  handling logic to avoid stack overflows.

config MFD_ADP5360_INIT_PRIORITY
	int "MFD ADP5360 Init Priority"
	default 70
	depends on MFD_ADP5360
	help
	  Init priority for the Analog Devices ADP5360 MFD Subsystem.

endif # MFD_ADP5360
```

## drivers/mfd/Kconfig.aw9523b
```kconfig
# Copyright (c) 2024 TOKITA Hiroshi
# SPDX-License-Identifier: Apache-2.0

config MFD_AW9523B
	bool "Awinic AW9523B GPIO/LED controller device driver"
	default y
	depends on DT_HAS_AWINIC_AW9523B_ENABLED
	select I2C
	help
	  Enable the Awinic AW9523B GPIO/LED controller device driver
```

## drivers/mfd/Kconfig.axp192
```kconfig
# Copyright (c) 2023 Martin Kiepfer <mrmarteng@teleschirm.org>
# SPDX-License-Identifier: Apache-2.0

config MFD_AXP192_AXP2101
	bool "AXP192/AXP2101 PMIC multi-function device driver"
	default y
	depends on DT_HAS_X_POWERS_AXP192_ENABLED || DT_HAS_X_POWERS_AXP2101_ENABLED
	select I2C
	help
	  Enable the X-Powers AXP192/AXP2101 PMIC multi-function device driver
```

## drivers/mfd/Kconfig.axp2101
```kconfig
# Copyright (c) 2025 BayLibre SAS
# SPDX-License-Identifier: Apache-2.0

config MFD_AXP2101
	bool "AXP2101 PMIC multi-function device driver"
	default y
	depends on DT_HAS_X_POWERS_AXP2101_ENABLED
	select I2C
	help
	  Enable the X-Powers AXP2101 PMIC multi-function device driver

config MFD_AXP2101_POWER_BUTTON
	bool "AXP2101 power button"
	depends on INPUT
	depends on MFD_AXP2101
	default y if $(dt_compat_any_has_prop,$(DT_COMPAT_X_POWERS_AXP2101),int-gpios)
	help
	  Enable support for the Power Button available on the AXP2101. This
	  feature is based on IRQ support from AXP2101 which requires "int-gpios"
	  device-tree property to be defined in AXP2101 device node.
```

## drivers/mfd/Kconfig.bd8lb600fs
```kconfig
# Copyright (c) 2024 SILA Embedded Solutions GmbH
# SPDX -License-Identifier: Apache-2.0

config MFD_BD8LB600FS
	bool "BD8LB600FS low side switch multi-function device driver"
	default y
	depends on DT_HAS_ROHM_BD8LB600FS_ENABLED
	# using select SPI at this point introduces a cyclic dependency
	depends on SPI
	help
	  Enable the Rohm BD8LB600FS low side switch multi-function device driver
```

## drivers/mfd/Kconfig.ds3231
```kconfig
# Copyright (c) 2024 Gergo Vari <work@gergovari.com>
# SPDX-License-Identifier: Apache-2.0

config MFD_DS3231
	bool "DS3231 multi-function device driver"
	default y
	depends on DT_HAS_MAXIM_DS3231_MFD_ENABLED
	select I2C
	help
	  Enable the Maxim DS3231 multi-function device driver
```

## drivers/mfd/Kconfig.infineon_autanalog
```kconfig
# Copyright (c) 2026 Infineon Technologies AG,
# or an affiliate of Infineon Technologies AG.
#
# SPDX-License-Identifier: Apache-2.0

config MFD_INFINEON_AUTANALOG
	bool "Infineon AutAnalog multi-function device driver"
	default y
	depends on DT_HAS_INFINEON_AUTANALOG_ENABLED
	select USE_INFINEON_AUTANALOG_SAR_ADC
	help
	  Enable the Infineon AutAnalog MFD driver.  The AutAnalog subsystem
	  contains multiple analog peripherals (SAR ADC, DAC, comparators)
	  sharing common resources including a shared interrupt and the
	  Autonomous Controller (AC) state machine.  This driver manages the
	  shared resources and provides APIs for child peripheral drivers.

config MFD_INFINEON_AUTANALOG_INIT_PRIORITY
	int "Infineon AutAnalog MFD init priority"
	default 41
	depends on MFD_INFINEON_AUTANALOG
	help
	  Initialization priority for the AutAnalog MFD driver.  This must be
	  lower (earlier) than the init priority of child drivers such as
	  CONFIG_ADC_INIT_PRIORITY to ensure the MFD parent is ready before
	  children attempt to use it.
```

## drivers/mfd/Kconfig.infineon_autanalog_ctb
```kconfig
# Copyright (c) 2026 Infineon Technologies AG,
# or an affiliate of Infineon Technologies AG.
#
# SPDX-License-Identifier: Apache-2.0

config MFD_INFINEON_AUTANALOG_CTB
	bool "Infineon AutAnalog CTB multi-function device driver"
	default y
	depends on DT_HAS_INFINEON_AUTANALOG_CTB_ENABLED
	depends on MFD_INFINEON_AUTANALOG
	help
	  Enable the Infineon AutAnalog CTB (Continuous Time Block) MFD driver.
	  The CTB contains two opamps (OA0, OA1) that share a combined PDL
	  configuration.  This driver aggregates both opamps and manages
	  the shared config structure.

config MFD_INFINEON_AUTANALOG_CTB_INIT_PRIORITY
	int "Infineon AutAnalog CTB MFD init priority"
	default 42
	depends on MFD_INFINEON_AUTANALOG_CTB
	help
	  Init priority for the CTB MFD.  Must be higher (later) than the
	  AutAnalog MFD init priority (default 41).
```

## drivers/mfd/Kconfig.infineon_autanalog_prb
```kconfig
# Copyright (c) 2026 Infineon Technologies AG,
# or an affiliate of Infineon Technologies AG.
#
# SPDX-License-Identifier: Apache-2.0

config MFD_INFINEON_AUTANALOG_PRB
	bool "Infineon AutAnalog PRB multi-function device driver"
	default y
	depends on DT_HAS_INFINEON_AUTANALOG_PRB_ENABLED
	depends on MFD_INFINEON_AUTANALOG
	help
	  Enable the Infineon AutAnalog PRB (Programmable Reference Block) MFD
	  driver.  The PRB contains two voltage references (Vref0, Vref1) that
	  share a combined configuration.  This driver aggregates both references
	  and manages the shared PDL config structure.

config MFD_INFINEON_AUTANALOG_PRB_INIT_PRIORITY
	int "Infineon AutAnalog PRB MFD init priority"
	default 42
	depends on MFD_INFINEON_AUTANALOG_PRB
	help
	  Init priority for the PRB MFD.  Must be higher (later) than the
	  AutAnalog MFD init priority (default 41).
```

## drivers/mfd/Kconfig.infineon_autanalog_ptcomp
```kconfig
# Copyright (c) 2026 Infineon Technologies AG,
# or an affiliate of Infineon Technologies AG.
#
# SPDX-License-Identifier: Apache-2.0

config MFD_INFINEON_AUTANALOG_PTCOMP
	bool "Infineon AutAnalog PTComp multi-function device driver"
	default y
	depends on DT_HAS_INFINEON_AUTANALOG_PTCOMP_ENABLED
	depends on MFD_INFINEON_AUTANALOG
	help
	  Enable the Infineon AutAnalog PTComp (Programmable Threshold
	  Comparator) MFD driver.  The PTComp contains two comparators
	  (Comp0, Comp1) that share a combined configuration.  This driver
	  aggregates both comparators and manages the shared PDL config
	  structure.

config MFD_INFINEON_AUTANALOG_PTCOMP_INIT_PRIORITY
	int "Infineon AutAnalog PTComp MFD init priority"
	default 42
	depends on MFD_INFINEON_AUTANALOG_PTCOMP
	help
	  Init priority for the PTComp MFD.  Must be higher (later) than the
	  AutAnalog MFD init priority (default 41).
```

## drivers/mfd/Kconfig.infineon_hppass
```kconfig
# SPDX-FileCopyrightText: <text>Copyright (c) 2026 Infineon Technologies AG,
# or an affiliate of Infineon Technologies AG. All rights reserved.</text>
#
# SPDX-License-Identifier: Apache-2.0

config MFD_INFINEON_HPPASS
	bool "Infineon HPPASS multi-function device driver"
	default y
	depends on DT_HAS_INFINEON_HPPASS_ANALOG_ENABLED
	select USE_INFINEON_HPPASS_SAR_ADC
	help
	  Enable the Infineon HPPASS MFD driver.  The High Performance
	  Programmable Analog Subsystem (HPPASS) contains analog peripherals
	  including a SAR ADC and Comparator and Slope Generator (CSG) which
	  are coordinated by an Autonomous Controller (AC) state machine.
	  This driver manages the shared resources including AC management,
	  trigger configuration, and the combined MCPASS interrupt, providing
	  APIs for child peripheral drivers.

config MFD_INFINEON_HPPASS_INIT_PRIORITY
	int "Infineon HPPASS MFD init priority"
	default 41
	depends on MFD_INFINEON_HPPASS
	help
	  Initialization priority for the HPPASS MFD driver.  This must be
	  lower (earlier) than the init priority of child drivers such as
	  CONFIG_ADC_INIT_PRIORITY to ensure the MFD parent is ready before
	  children attempt to use it.

config MFD_INFINEON_HPPASS_AC_START_PRIORITY
	int "Infineon HPPASS AC start priority (APPLICATION level)"
	default 0
	range 0 99
	depends on MFD_INFINEON_HPPASS
	help
	  APPLICATION-level init priority for the one-shot AC start sweep
	  (ifx_hppass_late_start).  Runs after all POST_KERNEL device
	  inits — including the MFD parent and every HPPASS child driver —
	  so the AC unlock window sees the children's CFG writes.  Lower
	  values run earlier within APPLICATION level.  The default of 0
	  starts the AC as early as possible so that any application-level
	  init that depends on HPPASS being live can run after it.
```
