## drivers/mfd/Kconfig.infineon_hppass_csg
```kconfig
# SPDX-FileCopyrightText: <text>Copyright (c) 2026 Infineon Technologies AG,
# or an affiliate of Infineon Technologies AG. All rights reserved.</text>
#
# SPDX-License-Identifier: Apache-2.0

config MFD_INFINEON_HPPASS_CSG
	bool "Infineon HPPASS CSG (Comparator Slope Generator) MFD driver"
	default y
	depends on DT_HAS_INFINEON_HPPASS_CSG_ENABLED
	depends on MFD_INFINEON_HPPASS
	help
	  Enable the Infineon HPPASS CSG MFD driver.  The CSG block contains
	  five identical slices, each pairing a 10-bit, 30 Msps DAC with a
	  high-speed comparator.  This MFD owns the combined comparator
	  interrupt and dispatches it to per-slice comparator child devices,
	  and applies per-slice CMP_CFG / DAC_CFG configuration from devicetree
	  at init time.

config MFD_INFINEON_HPPASS_CSG_INIT_PRIORITY
	int "Infineon HPPASS CSG MFD init priority"
	default 45
	depends on MFD_INFINEON_HPPASS_CSG
	help
	  Initialization priority for the HPPASS CSG MFD driver.  Must be
	  higher (later) than CONFIG_MFD_INFINEON_HPPASS_INIT_PRIORITY so the
	  HPPASS parent is ready when this driver runs, and lower (earlier)
	  than the per-slice comparator and DAC child driver init priorities
	  so the slice CMP_CFG / DAC_CFG registers are programmed before any
	  child attempts to use them.
```

## drivers/mfd/Kconfig.infineon_mxcryptolite
```kconfig
# SPDX-FileCopyrightText: Copyright (c) 2026 Infineon Technologies AG,
# SPDX-FileCopyrightText: or an affiliate of Infineon Technologies AG. All rights reserved.
#
# SPDX-License-Identifier: Apache-2.0

config MFD_INFINEON_MXCRYPTOLITE
	bool "Infineon MXCRYPTOLITE multi-function device driver"
	default y
	depends on DT_HAS_INFINEON_MXCRYPTOLITE_ENABLED
	help
	  Enable the Infineon MXCRYPTOLITE MFD driver.  The MXCRYPTOLITE block is a
	  single hardware crypto engine shared by a True Random Number Generator
	  (TRNG) and AES / SHA-256 acceleration.  This driver owns the shared
	  register base address and the mutex that serialises access between the
	  TRNG and crypto child function drivers.

config MFD_INFINEON_MXCRYPTOLITE_INIT_PRIORITY
	int "Infineon MXCRYPTOLITE MFD init priority"
	default 40
	depends on MFD_INFINEON_MXCRYPTOLITE
	help
	  Initialization priority for the MXCRYPTOLITE MFD driver.  This must be
	  lower (earlier) than the init priority of the child drivers
	  (CONFIG_ENTROPY_INIT_PRIORITY and CONFIG_CRYPTO_INIT_PRIORITY) so the
	  shared resources are ready before a child uses them.
```

## drivers/mfd/Kconfig.lpflexcomm
```kconfig
# Copyright 2024 NXP
#
# SPDX-License-Identifier: Apache-2.0

config NXP_LP_FLEXCOMM
	bool "Driver for the NXP Low Power FlexComm Interface"
	default y
	depends on DT_HAS_NXP_LP_FLEXCOMM_ENABLED
	help
	  Enabled the Low Power FlexComm shim driver.
	  LP FLexcomm allows enablement of LPUART and LPI2C
	  at the same time with reduced interface. This driver
	  checks concurrent enablement and returns and error for
	  unsupported concurrent enablement.
```

## drivers/mfd/Kconfig.m5pm1
```kconfig
# Copyright (c) 2026 The Zephyr Project Contributors
# SPDX-License-Identifier: Apache-2.0

config MFD_M5PM1
	bool "M5Stack M5PM1 PMIC"
	default y
	depends on DT_HAS_M5STACK_M5PM1_ENABLED
	select I2C
	help
	  Enable the M5Stack M5PM1 multi-function PMIC driver.
```
