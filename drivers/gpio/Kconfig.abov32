## drivers/gpio/Kconfig.abov32
```kconfig
# Copyright (c) 2026 ABOV Semiconductor Co., Ltd.
# SPDX-License-Identifier: Apache-2.0

config GPIO_ABOV32
	bool "ABOV32 GPIO driver"
	default y
	depends on DT_HAS_ABOV_ABOV32_GPIO_ENABLED
	help
	  Enable the GPIO driver for the ABOV32 Port Control Unit (PCU), built
	  on the ABOV HAL PCU API (hal_pcu.h).
```

## drivers/gpio/Kconfig.bk7258
```kconfig
# Copyright (c) 2026 Beken Corporation
# SPDX-License-Identifier: Apache-2.0

config GPIO_BK7258
	bool "Beken BK7258 GPIO driver"
	default y
	depends on DT_HAS_BEKEN_BK7258_GPIO_ENABLED
	select GPIO
	help
	  GPIO driver for the Beken BK7258.

	  Two BK7258 specifics set this apart from other SoCs' GPIO drivers; both
	  are documented in the driver source with their references:

	    1) Interrupts are two-level: besides the NVIC (IRQ 55) the driver must
	       set bit 23 of cpu1_int_32_63_en in the SYSTEM domain, or the
	       interrupt never reaches the CPU and nothing is reported. (This is
	       the vendor sys_drv_int_group2_enable(GPIO_INTERRUPT_CTRL_BIT).)

	    2) The interrupt type is only 2 bits (low level / high level / rising
	       edge / falling edge) with no both-edges mode, so
	       GPIO_INT_TRIG_BOTH returns -ENOTSUP.

	  Resource boundary: GPIO lives in the AON domain and the register file is
	  shared with the peer, with no arbitration between the two (the vendor
	  SDK calls amp_res_init(AMP_RES_ID_GPIO) for that). The driver therefore
	  only writes pins that were explicitly operated on, and the devicetree
	  additionally protects UART0's GPIO10/11 with gpio-reserved-ranges.

	  The NVIC priority comes from devicetree (the second cell of interrupts),
	  as in other Zephyr GPIO drivers; no extra Kconfig option is added.
```

## drivers/gpio/Kconfig.cc27xx
```kconfig
# Copyright (c) 2025 Texas Instruments Incorporated
# Copyright (c) 2024 BayLibre, SAS
#
# SPDX-License-Identifier: Apache-2.0

config GPIO_CC27XX
	bool "TI SimpleLink CC27XX GPIO driver"
	default y
	depends on DT_HAS_TI_CC27XX_GPIO_ENABLED
	help
	  Enable the TI SimpleLink CC27XX  GPIO driver.
```

## drivers/gpio/Kconfig.cc35xx
```kconfig
# CC35XX GPIO configuration options

# SPDX-License-Identifier: Apache-2.0

config GPIO_CC35XX
	bool "TI CC35XX GPIO driver"
	default y
	depends on DT_HAS_TI_CC35XX_GPIO_PORT_ENABLED
	help
	  Enable the TI CC35XX GPIO driver
```

## drivers/gpio/Kconfig.cs47l63
```kconfig
# SPDX-FileCopyrightText: Copyright The Zephyr Project Contributors
# SPDX-License-Identifier: Apache-2.0

config GPIO_CS47L63
	bool "CS47L63 GPIO driver"
	default y
	depends on DT_HAS_CIRRUS_CS47L63_GPIO_ENABLED && AUDIO_CODEC_CS47L63_GPIO
	help
	  GPIO1 to GPIO12 of the Cirrus Logic CS47L63 as a GPIO controller,
	  without interrupts. The first access boots the part, so a GPIO hog
	  on this controller does that at GPIO hogs init, and a failure there
	  stops the remaining hogs of the board.

config GPIO_CS47L63_INIT_PRIORITY
	int "CS47L63 GPIO driver init priority"
	default 70
	depends on GPIO_CS47L63
	help
	  Must be greater than AUDIO_CODEC_INIT_PRIORITY. A board that uses GPIO
	  hogs on this controller sets GPIO_HOGS_INIT_PRIORITY above it.
```

## drivers/gpio/Kconfig.dw
```kconfig
# DesignWare GPIO configuration options

# Copyright (c) 2016 Intel Corporation
# SPDX-License-Identifier: Apache-2.0

config GPIO_DW
	bool "Designware GPIO"
	default y
	depends on DT_HAS_SNPS_DESIGNWARE_GPIO_ENABLED
	select PINCTRL if $(dt_compat_any_has_prop,$(DT_COMPAT_SNPS_DESIGNWARE_GPIO),pinctrl-0)
	help
	  Enable driver for Designware GPIO
```

## drivers/gpio/Kconfig.hpmicro
```kconfig
# Copyright (c) 2024 HPMicro
# Copyright (c) 2026 Cody Gu <gujiaqi@iscas.ac.cn>
# SPDX-License-Identifier: Apache-2.0

config GPIO_HPMICRO
	bool "HPMicro GPIO driver"
	default y
	depends on DT_HAS_HPMICRO_HPM_GPIO_ENABLED
	depends on HAS_HPMSDK_GPIO
	help
	  Enable the GPIO driver for the HPMicro GPIO controller.
```

## drivers/gpio/Kconfig.infineon
```kconfig
# Infineon GPIO configuration options

# Copyright (c) 2022-2025 Cypress Semiconductor Corporation (an Infineon company) or
# an affiliate of Cypress Semiconductor Corporation
# SPDX-License-Identifier: Apache-2.0

config GPIO_INFINEON
	bool "Infineon GPIO driver"
	default y
	depends on DT_HAS_INFINEON_GPIO_ENABLED
	help
	  Enable GPIO driver for Infineon MCUs using the "infineon,gpio"
	  compatible.

config GPIO_INFINEON_IOSS
	bool "Infineon IOSS GPIO driver"
	default y
	depends on DT_HAS_INFINEON_IOSS_GPIO_ENABLED
	help
	  Enable the register level GPIO driver for the Infineon IOSS GPIO
	  ports using the "infineon,ioss-gpio" compatible.

config GPIO_INFINEON_IOSS_MXS22
	bool
	default y if DT_HAS_INFINEON_MXS22_IOSS_GPIO_ENABLED
	depends on GPIO_INFINEON_IOSS
	help
	  The IOSS is the MXS22IOSS variant, which has the CFG_OUT3 drive
	  mode register.
```

## drivers/gpio/Kconfig.infineon_aurix
```kconfig
# SPDX-FileCopyrightText: Copyright (c) 2024 Infineon Technologies AG,
# SPDX-FileCopyrightText: or an affiliate of Infineon Technologies AG. All rights reserved.
# SPDX-FileCopyrightText: Copyright (c) 2026 Linumiz
#
# SPDX-License-Identifier: Apache-2.0

config GPIO_INFINEON_AURIX_TC4X
	bool "Infineon AURIX TC4x GPIO driver"
	default y
	depends on DT_HAS_INFINEON_AURIX_TC4X_GPIO_ENABLED
	help
	  GPIO driver for the ports of Infineon AURIX TC4x devices, without
	  interrupt support.
```

## drivers/gpio/Kconfig.it8300
```kconfig
# Copyright (c) 2026 ITE Corporation. All Rights Reserved.
# SPDX-License-Identifier: Apache-2.0

config GPIO_ITE_IT8300
	bool "ITE IT8300 GPIO expander driver"
	default y
	depends on DT_HAS_ITE_IT8300_ENABLED
	select I2C
	help
	  Enable GPIO support for the ITE IT8300 via I2C.
	  The IT8300 exposes 34 GPIO pins over 5 groups (A..E); each group
	  is instantiated as its own GPIO controller (child devicetree node),
	  sharing one I2C bus connection owned by the parent "ite,it8300" node.

if GPIO_ITE_IT8300

config GPIO_ITE_IT8300_EMUL
	bool "ITE IT8300 GPIO expander emulator"
	depends on EMUL
	depends on GPIO_EMUL
	depends on I2C_EMUL
	help
	  Enable the ITE IT8300 GPIO expander emulator. The emulator models
	  register access, GPIO input changes, and the active-low ALERT signal
	  for driver tests running on emulated I2C and GPIO controllers.

config IT8300_INIT_PRIORITY
	int "IT8300 init priority"
	default I2C_INIT_PRIORITY
	help
	  Initialization priority for the parent IT8300 device.
	  GPIO child devices initialize at the next priority level.

	  Must be greater than I2C_INIT_PRIORITY and, if an alert-gpios
	  pin is used, greater than the init priority of that GPIO
	  controller driver.

endif # GPIO_ITE_IT8300
```

## drivers/gpio/Kconfig.max20356
```kconfig
# Copyright (c) 2026 Analog Devices, Inc.
# SPDX-License-Identifier: Apache-2.0

config GPIO_MAX20356
	bool "MAX20356/MAX20358 PMIC GPIO driver"
	default y
	depends on DT_HAS_ADI_MAX20356_GPIO_ENABLED
	select MFD
	help
	  Enable the GPIO driver for the MAX20356/MAX20358 PMIC multi-purpose
	  control (MPC0..MPC7) pins. Register access goes through the MAX20356 MFD
	  parent driver.

config GPIO_MAX20356_INIT_PRIORITY
	int "MAX20356 GPIO driver initialization priority"
	depends on GPIO_MAX20356
	default 85
	help
	  Initialization priority for the MAX20356 GPIO driver. It must be greater
	  than the MFD parent (CONFIG_MFD_INIT_PRIORITY).
```

## drivers/gpio/Kconfig.max96717
```kconfig
# Copyright (c) 2026 Charles Dias
# SPDX-License-Identifier: Apache-2.0

config GPIO_MAX96717
	bool "MAX96717 serializer GPIO controller"
	default y
	depends on DT_HAS_ADI_MAX96717_GPIO_ENABLED
	depends on GPIO && VIDEO_MAX96717
	help
	  GPIO controller for the MFP pins of the MAX96717 serializer, reached
	  through the GMSL2 link.

if GPIO_MAX96717

config GPIO_MAX96717_INIT_PRIORITY
	int "MAX96717 GPIO controller init priority"
	default 59
	help
	  Must be after the serializer (VIDEO_MAX96717_INIT_PRIORITY, default
	  58) and before the camera sensors that use the pins
	  (VIDEO_INIT_PRIORITY, default 60).

endif # GPIO_MAX96717
```

## drivers/gpio/Kconfig.mcux_gpio
```kconfig
# NXP i.MX GPIO driver (nxp,imx-gpio-v2)

# Copyright 2026 NXP
# SPDX-License-Identifier: Apache-2.0

config GPIO_MCUX_GPIO
	bool "NXP i.MX GPIO driver"
	default y
	depends on DT_HAS_NXP_IMX_GPIO_V2_ENABLED
	select PINCTRL
	help
	  Enable the NXP i.MX GPIO driver for SoCs that use the
	  nxp,imx-gpio-v2 compatible. Handles IOMUXC-based pin mux and
	  optional LPCG clock gating.
```

## drivers/gpio/Kconfig.mtk
```kconfig
# Copyright (c) 2026 MediaTek Inc.
# SPDX-License-Identifier: Apache-2.0

config GPIO_MT8188
	bool "MediaTek MT8188 GPIO driver"
	default y
	depends on DT_HAS_MEDIATEK_MT8188_GPIO_ENABLED
	help
	  Enable the GPIO driver for MediaTek MT8188.

	  Interrupts on these pins are delivered by the external interrupt
	  controller, so INTC_MT8188_EINT is needed as well.  Both are enabled
	  by the same devicetree, which requires every bank to name a
	  controller.

config GPIO_MT8188_INIT_PRIORITY
	int "MediaTek MT8188 GPIO init priority"
	default 41
	depends on GPIO_MT8188
	help
	  Device driver initialization priority.

	  Must be greater than INTC_INIT_PRIORITY: each bank registers with the
	  external interrupt controller from its own init, so the controller has
	  to have been initialised already.  The subsystem defaults for the two
	  are both KERNEL_INIT_PRIORITY_DEFAULT, which would leave the order
	  between them down to link order.
```

## drivers/gpio/Kconfig.nct38xx
```kconfig
# NPCX GPIO driver configuration options

# Copyright (c) 2021 Nuvoton Technology Corporation.
# SPDX-License-Identifier: Apache-2.0

config GPIO_NCT38XX
	bool "NCT38XX I2C-based GPIO chip"
	default y
	depends on DT_HAS_NUVOTON_NCT38XX_GPIO_PORT_ENABLED
	select I2C
	select MFD
	help
	  Enable driver for NCT38XX I2C-based GPIO chip.

if GPIO_NCT38XX

config GPIO_NCT38XX_INIT_PRIORITY
	int "NCT38XX GPIO init priority"
	default MFD_INIT_PRIORITY
	help
	  NCT38xx GPIO driver initialization priority.

config GPIO_NCT38XX_ALERT
	bool "NCT38XX GPIO interrupt"
	default y
	depends on DT_HAS_NUVOTON_NCT38XX_GPIO_ALERT_ENABLED
	help
	  Enable interrupt support in NCT38XX driver.

endif # GPIO_NCT38XX
```

## drivers/gpio/Kconfig.opentitan
```kconfig
# SPDX-FileCopyrightText: 2026 Yousef Kitaneh
# SPDX-License-Identifier: Apache-2.0

config GPIO_OPENTITAN
	bool "lowRISC OpenTitan GPIO driver"
	default y
	depends on DT_HAS_LOWRISC_OPENTITAN_GPIO_ENABLED
	help
	  Enable the GPIO driver for the lowRISC OpenTitan GPIO controller.
```

## drivers/gpio/Kconfig.pcf857x
```kconfig
# PCF857x GPIO configuration options

# Copyright (c) 2022 Ithinx
# Copyright (c) 2023 Mr Beam Lasers GmbH
# Copyright (c) 2023 Amrith Venkat Kesavamoorthi <amrith@mr-beam.org>
# SPDX-License-Identifier: Apache-2.0

menuconfig GPIO_PCF857X
	bool "PCF857X I2C GPIO chip"
	default y
	depends on DT_HAS_NXP_PCF857X_ENABLED || DT_HAS_ADI_MAX7321_ENABLED
	select I2C
	help
	  Enable driver for PCF857X I2C GPIO chip.
	  This driver also supports the Analog Devices MAX7321 I2C port
	  expander, which uses a compatible communication protocol.

config GPIO_PCF857X_INIT_PRIORITY
	int "Init priority"
	default I2C_INIT_PRIORITY
	depends on GPIO_PCF857X
	help
	  Device driver initialization priority.
```

## drivers/gpio/Kconfig.py32
```kconfig
# SPDX-FileCopyrightText: Copyright The Zephyr Project Contributors
# SPDX-License-Identifier: Apache-2.0

config GPIO_PY32
	bool "Puya PY32 GPIO driver"
	default y
	depends on DT_HAS_PUYA_PY32_GPIO_ENABLED
	help
	  Enable the GPIO driver for Puya PY32 microcontrollers.
```

## drivers/gpio/Kconfig.renesas_rafw
```kconfig
# SPDX-FileCopyrightText: 2026 Renesas Electronics Corporation
# SPDX-License-Identifier: Apache-2.0

config GPIO_RAFW
	bool "Renesas RAFW GPIO driver"
	default y
	depends on DT_HAS_RENESAS_RAFW_GPIO_ENABLED
	help
	  Enable GPIO driver for Renesas RAFW MCU family.
```

## drivers/gpio/Kconfig.renesas_rx_ioport
```kconfig
# Copyright (c) 2026 Renesas Electronics Corporation
# SPDX-License-Identifier: Apache-2.0

config GPIO_RX_IOPORT
	bool "Renesas RX GPIO IO port driver"
	default y
	depends on DT_HAS_RENESAS_RX_GPIO_IOPORT_ENABLED
	select PINCTRL
	help
	  Enable the Renesas RX GPIO IO port driver.
```

## drivers/gpio/Kconfig.rpi_panel_mcu
```kconfig
# Copyright (c) 2026 Texas Instruments Incorporated
# SPDX-License-Identifier: Apache-2.0

menuconfig GPIO_RPI_PANEL_MCU
	bool "Raspberry Pi Touch Display 2 panel-regulator MCU GPIO driver"
	default y
	depends on DT_HAS_RASPBERRYPI_TOUCHSCREEN_PANEL_REGULATOR_V2_ENABLED
	select I2C
	help
	  Enable the GPIO controller + backlight driver for the on-board MCU
	  found on the Raspberry Pi Touch Display 2 (compatible:
	  raspberrypi,touchscreen-panel-regulator-v2). Used to sequence the
	  panel and touch-controller reset lines and drive the backlight.

if GPIO_RPI_PANEL_MCU

config GPIO_RPI_PANEL_MCU_INIT_PRIORITY
	int "Init priority"
	default I2C_INIT_PRIORITY
	help
	  Device driver initialization priority.

endif
```

## drivers/gpio/Kconfig.sam0
```kconfig
# Atmel SAM0 GPIO configuration options

# Copyright (c) 2017 Google LLC.
# SPDX-License-Identifier: Apache-2.0

config GPIO_SAM0
	bool "Atmel SAM0 GPIO (PORT) driver"
	default y
	depends on DT_HAS_ATMEL_SAM0_GPIO_ENABLED
	help
	  Enable support for the Atmel SAM0 'PORT' GPIO controllers.

config GPIO_SAM0_HW_DEBOUNCE
	bool "SAM0 EIC hardware debounce support (DPRESCALER + DEBOUNCEN)"
	depends on GPIO_SAM0
	help
	  Enable hardware debounce on the External Interrupt Controller (EIC).
	  This configures GCLK1 @ OSCULP32K as slow clock for the EIC and
	  enables the DPRESCALER and DEBOUNCEN registers for per-line hardware
	  filtering. Use the 'microchip,debounce-time-us' devicetree property
	  on the EIC node to set the target debounce time.
	  Only effective on SoC variants with DPRESCALER registers
	  (SAMC2xN, SAMD5x/E5x series).
```

## drivers/gpio/Kconfig.sc18is60x
```kconfig
# Copyright (c) 2026 tinyvision.ai
# SPDX-License-Identifier: Apache-2.0

config GPIO_SC18IS60X
	bool "NXP SC18IS602/SC18IS606 GPIO Controller driver"
	default y
	select MFD
	depends on DT_HAS_NXP_SC18IS60X_GPIO_ENABLED || DT_HAS_NXP_SC18IS606_GPIO_ENABLED
	help
	  Enables NXP SC18IS60x gpio controller driver

config GPIO_SC18IS60X_INIT_PRIORITY
	int "SC18IS60x GPIO Init Priority"
	default 81
	depends on GPIO_SC18IS60X
	help
	  SC18IS60x GPIO Controller Init priority

	  Note: Has to be greater than the parent SC18IS60x bridge init priority
```

## drivers/gpio/Kconfig.tlc6c59xx
```kconfig
# Copyright (c) 2026 iomico
# SPDX-License-Identifier: Apache-2.0

config GPIO_TLC6C59XX
	bool "TLC6C59XX GPIO driver"
	default y
	depends on DT_HAS_TI_TLC6C59XX_GPIO_ENABLED
	depends on DT_HAS_TI_TLC6C59XX_ENABLED
	depends on SPI
	select MFD
	select MFD_TLC6C59XX
	help
	  Enable output-only GPIO ports for TLC6C59XX chips. Each chip is
	  a separate GPIO controller backed by the TLC6C59XX MFD driver.

config GPIO_TLC6C59XX_INIT_PRIORITY
	int "TLC6C59XX GPIO initialization priority"
	default 85
	depends on GPIO_TLC6C59XX
	help
	  Device driver initialization priority. Must run after the parent
	  MFD instance (MFD_INIT_PRIORITY, default 80).
```

## drivers/gpio/Kconfig.virtio
```kconfig
# SPDX-FileCopyrightText: Copyright The Zephyr Project Contributors
# SPDX-License-Identifier: Apache-2.0

config GPIO_VIRTIO
	bool "VIRTIO GPIO driver"
	default y
	depends on DT_HAS_VIRTIO_GPIO_ENABLED
	select VIRTIO
	help
	  Enable driver for VIRTIO GPIO devices.
```
