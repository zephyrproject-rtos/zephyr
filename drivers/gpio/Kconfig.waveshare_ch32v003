## drivers/gpio/Kconfig.waveshare_ch32v003
```kconfig
# Copyright (c) 2026 Kim Bøndergaard
# SPDX-License-Identifier: Apache-2.0

menuconfig GPIO_CH32V003
	bool "Waveshare CH32V003 I2C IO-Expander"
	default y
	depends on DT_HAS_WAVESHARE_CH32V003_ENABLED
	depends on I2C
	help
	  Enable the driver for the Waveshare CH32V003 I2C GPIO expander.

if GPIO_CH32V003

config GPIO_CH32V003_INIT_PRIORITY
	int "Init priority"
	default 70
	help
	  Device driver initialization priority.

endif # GPIO_CH32V003
```

## drivers/haptics/cirrus/Kconfig.cs40l5x
```kconfig
# Copyright 2025 Cirrus Logic, Inc.
# SPDX-License-Identifier: Apache-2.0

menuconfig HAPTICS_CS40L5X
	bool "CS40L5x Haptics Driver"
	default y
	depends on DT_HAS_CIRRUS_CS40L50_ENABLED || \
		   DT_HAS_CIRRUS_CS40L51_ENABLED || \
		   DT_HAS_CIRRUS_CS40L52_ENABLED || \
		   DT_HAS_CIRRUS_CS40L53_ENABLED
	help
	  Enable CS40L5x haptics driver.

if HAPTICS_CS40L5X

CIRRUS_EXTERNAL_BOOST := cirrus,external-boost
CIRRUS_FLASH_STORAGE := cirrus,flash-storage

config HAPTICS_CS40L5X_RESET
	def_bool $(dt_compat_any_has_prop,$(DT_COMPAT_CIRRUS_CS40L50),reset-gpios) || \
		 $(dt_compat_any_has_prop,$(DT_COMPAT_CIRRUS_CS40L51),reset-gpios) || \
		 $(dt_compat_any_has_prop,$(DT_COMPAT_CIRRUS_CS40L52),reset-gpios) || \
		 $(dt_compat_any_has_prop,$(DT_COMPAT_CIRRUS_CS40L53),reset-gpios)
	select GPIO

config HAPTICS_CS40L5X_INTERRUPT
	def_bool $(dt_compat_any_has_prop,$(DT_COMPAT_CIRRUS_CS40L50),int-gpios) || \
		 $(dt_compat_any_has_prop,$(DT_COMPAT_CIRRUS_CS40L51),int-gpios) || \
		 $(dt_compat_any_has_prop,$(DT_COMPAT_CIRRUS_CS40L52),int-gpios) || \
		 $(dt_compat_any_has_prop,$(DT_COMPAT_CIRRUS_CS40L53),int-gpios)
	select GPIO

config HAPTICS_CS40L5X_TRIGGER
	def_bool $(dt_compat_any_has_prop,$(DT_COMPAT_CIRRUS_CS40L50),trigger-gpios) || \
		 $(dt_compat_any_has_prop,$(DT_COMPAT_CIRRUS_CS40L51),trigger-gpios) || \
		 $(dt_compat_any_has_prop,$(DT_COMPAT_CIRRUS_CS40L52),trigger-gpios) || \
		 $(dt_compat_any_has_prop,$(DT_COMPAT_CIRRUS_CS40L53),trigger-gpios)
	select GPIO

config HAPTICS_CS40L5X_EXTERNAL_BOOST
	def_bool $(dt_compat_any_has_prop,$(DT_COMPAT_CIRRUS_CS40L50),$(CIRRUS_EXTERNAL_BOOST)) || \
		$(dt_compat_any_has_prop,$(DT_COMPAT_CIRRUS_CS40L51),$(CIRRUS_EXTERNAL_BOOST)) || \
		$(dt_compat_any_has_prop,$(DT_COMPAT_CIRRUS_CS40L52),$(CIRRUS_EXTERNAL_BOOST)) || \
		$(dt_compat_any_has_prop,$(DT_COMPAT_CIRRUS_CS40L53),$(CIRRUS_EXTERNAL_BOOST))
	select REGULATOR

config HAPTICS_CS40L5X_FLASH
	def_bool $(dt_compat_any_has_prop,$(DT_COMPAT_CIRRUS_CS40L50),$(CIRRUS_FLASH_STORAGE)) || \
		$(dt_compat_any_has_prop,$(DT_COMPAT_CIRRUS_CS40L51),$(CIRRUS_FLASH_STORAGE)) || \
		$(dt_compat_any_has_prop,$(DT_COMPAT_CIRRUS_CS40L52),$(CIRRUS_FLASH_STORAGE)) || \
		$(dt_compat_any_has_prop,$(DT_COMPAT_CIRRUS_CS40L53),$(CIRRUS_FLASH_STORAGE))
	select FLASH

config HAPTICS_CS40L5X_CALIBRATION
	bool "Calibration"
	default y
	help
	  Allow the device to run its calibration routine and optionally
	  write calibration data to flash memory if flash storage is provided.

config HAPTICS_CS40L5X_CLICK_COMPENSATION
	bool "Click Compensation"
	default y
	help
	  Enable click compensation for haptic effects.

config HAPTICS_CS40L5X_RTH_EFFECTS
	bool "PCM and PWLE effects"
	default y
	help
	  Enable upload and playback of PCM and PWLE waveforms.

config HAPTICS_CS40L5X_DYNAMIC_F0
	bool "Dynamic F0"
	default y
	help
	  Enable dynamic F0 compensation for haptic effects.

config HAPTICS_CS40L5X_PM_ACTIVE_TIMEOUT_MS
	int "Active Timeout"
	default 0
	range 0 10000
	help
	  After the device has finished playing an effect, wait the specified amount
	  of time in milliseconds before entering the standby state.

config HAPTICS_CS40L5X_PM_STDBY_TIMEOUT_MS
	int "Standby Timeout"
	default 100
	range 0 10000
	help
	  When the device enters the standby state with hibernation enabled, wait the
	  specified amount of time in milliseconds before entering hibernation.

endif #HAPTICS_CS40L5X
```

## drivers/hwinfo/Kconfig
```kconfig
# HW Info driver configuration options

# Copyright (c) 2019 Alexander Wachter
# SPDX-License-Identifier: Apache-2.0

menuconfig HWINFO
	bool "Hardware information drivers"
	help
	  Enable hwinfo driver.

if HWINFO

module = HWINFO
module-str = HWINFO
source "subsys/logging/Kconfig.template.log_config"

config HWINFO_HAS_DRIVER
	bool
	help
	  This is an option enabled by individual drivers to signal that there is a hwinfo driver.

config HWINFO_SHELL
	bool "HWINFO Shell"
	depends on SHELL
	help
	  Enable hwinfo Shell for testing.

# zephyr-keep-sorted-start
rsource "Kconfig.ambiq"
rsource "Kconfig.andes"
rsource "Kconfig.bflb"
rsource "Kconfig.cc13xx_cc26xx"
rsource "Kconfig.cc23x0"
rsource "Kconfig.esp32"
rsource "Kconfig.gd32"
rsource "Kconfig.gecko"
rsource "Kconfig.infineon"
rsource "Kconfig.litex"
rsource "Kconfig.max32"
rsource "Kconfig.mchp"
rsource "Kconfig.mspm0"
rsource "Kconfig.native"
rsource "Kconfig.nrf"
rsource "Kconfig.numaker"
rsource "Kconfig.numaker_rmc"
rsource "Kconfig.nxp"
rsource "Kconfig.psoc6"
rsource "Kconfig.renesas_ra"
rsource "Kconfig.rpi_pico"
rsource "Kconfig.sam"
rsource "Kconfig.sam0"
rsource "Kconfig.sam4l"
rsource "Kconfig.sam_rstc"
rsource "Kconfig.silabs_series2"
rsource "Kconfig.smartbond"
rsource "Kconfig.stm32"
rsource "Kconfig.wch"
# zephyr-keep-sorted-stop

endif
```

## drivers/hwinfo/Kconfig.bcm283x
```kconfig
# Copyright (c) 2026 Process Mission
# SPDX-License-Identifier: Apache-2.0

config HWINFO_BCM283X
	bool "Broadcom BCM283x firmware hwinfo driver"
	default y
	depends on DT_HAS_RASPBERRYPI_BCM283X_FIRMWARE_ENABLED
	depends on RASPBERRYPI_FIRMWARE
	select HWINFO_HAS_DRIVER
	help
	  Read the board serial number and MAC address through the Broadcom
	  VideoCore firmware interface and expose them as the hwinfo device ID
	  and EUI-64.
```

## drivers/hwinfo/Kconfig.bflb
```kconfig
# SPDX-FileCopyrightText: Copyright The Zephyr Project Contributors
# SPDX-License-Identifier: Apache-2.0

config HWINFO_BFLB
	bool "Bouffalo Lab hwinfo driver"
	default y
	depends on SOC_FAMILY_BFLB
	depends on OTP_BFLB
	select HWINFO_HAS_DRIVER
	select RETAINED_MEM if SOC_SERIES_BL60X
	help
	  Enable Bouffalo Lab hwinfo driver.
	  Uses the factory-programmed MAC address from efuse as a unique
	  device ID.
```

## drivers/hwinfo/Kconfig.infineon
```kconfig
# SPDX-FileCopyrightText: Copyright (c) 2026 Infineon Technologies AG,
# SPDX-FileCopyrightText: or an affiliate of Infineon Technologies AG. All rights reserved.
#
# SPDX-License-Identifier: Apache-2.0

# Verified on Edge and CAT1B (PSC3).
config HWINFO_INFINEON
	bool "Infineon unique device ID"
	default y
	depends on SOC_FAMILY_INFINEON_EDGE || \
		(SOC_FAMILY_INFINEON_CAT1B && !SOC_SERIES_CYW20829)
	select HWINFO_HAS_DRIVER
	help
	  Enable Infineon hwinfo driver.
```

## drivers/hwinfo/Kconfig.lpf3
```kconfig
# Copyright The Zephyr Project Contributors
# SPDX-License-Identifier: Apache-2.0

config HWINFO_LPF3
	bool "CC23X0 and CC27XX hwinfo"
	default y
	depends on SOC_SERIES_CC23X0 || SOC_SERIES_CC27XX
	select HWINFO_HAS_DRIVER
	help
	  Enable CC23X0 and CC27XX hwinfo driver.
```

## drivers/hwinfo/Kconfig.mcux_pmc
```kconfig
# Copyright 2026 NXP
# SPDX-License-Identifier: Apache-2.0

config HWINFO_MCUX_PMC
	bool "NXP LPC PMC reset cause"
	default y
	depends on DT_HAS_NXP_LPC_PMC_HWINFO_ENABLED
	select HWINFO_HAS_DRIVER
	help
	  Enable the NXP LPC PMC (AOREG1) reset-cause hwinfo driver.
```

## drivers/hwinfo/Kconfig.nvmem
```kconfig
# SPDX-FileCopyrightText: Copyright (c) 2026 Basalte bv
# SPDX-License-Identifier: Apache-2.0

config HWINFO_NVMEM
	bool "NVMEM device ID"
	default y
	depends on DT_HAS_ZEPHYR_HWINFO_NVMEM_ENABLED
	select NVMEM
	select HWINFO_HAS_DRIVER
	help
	  Generic hwinfo backend reading the device unique identifier (and
	  optionally the EUI-64) from NVMEM cells described by a
	  zephyr,hwinfo-nvmem devicetree node.

	  Only one hwinfo device-id backend can be linked into an image;
	  disable any SoC-specific backend (and HWINFO_NATIVE on native_sim)
	  when enabling this one. The backing provider class (e.g. EEPROM,
	  OTP) must be enabled separately.
```

## drivers/hwinfo/Kconfig.nxp
```kconfig
# Copyright 2026 NXP
# SPDX-License-Identifier: Apache-2.0

config HWINFO_NXP_CMC
	bool "NXP MCX CMC reset cause"
	default y
	depends on DT_HAS_NXP_CMC_ENABLED
	select HWINFO_HAS_DRIVER
	help
	  Enable NXP Kinetis CMC hwinfo driver.

config HWINFO_NXP_IMXRT
	bool "NXP i.MX RT device ID"
	default y
	depends on SOC_SERIES_IMXRT10XX || SOC_SERIES_IMXRT11XX || SOC_SERIES_IMXRT118X
	select HWINFO_HAS_DRIVER
	help
	  Enable NXP i.MX RT hwinfo driver.

config HWINFO_NXP_OTP_UID
	bool "NXP OTP unique chip identifier"
	default y
	depends on DT_HAS_NXP_OTP_UID_ENABLED
	select HWINFO_HAS_DRIVER
	help
	  Enable the hwinfo device-id backend that reads the unique chip
	  identifier stored in the NXP OTP flash memory area, as described by the
	  nxp,otp-uid devicetree node.

config HWINFO_NXP_PMC
	bool "NXP LPC PMC reset cause"
	default y
	depends on DT_HAS_NXP_LPC_PMC_HWINFO_ENABLED
	select HWINFO_HAS_DRIVER
	help
	  Enable the NXP LPC PMC (AOREG1) reset-cause hwinfo driver.

config HWINFO_NXP_RCM
	bool "NXP Kinetis reset cause"
	default y
	depends on DT_HAS_NXP_RCM_HWINFO_ENABLED
	select HWINFO_HAS_DRIVER
	help
	  Enable NXP Kinetis RCM hwinfo driver.

config HWINFO_NXP_RGM
	bool "NXP MC_RGM reset cause"
	default y
	depends on DT_HAS_NXP_MC_RGM_ENABLED
	select HWINFO_HAS_DRIVER
	help
	  Enable the NXP MC_RGM (Reset Generation Module) hwinfo driver for
	  reset cause reporting on NXP MCUs with the MC_RGM module, such as the
	  MCXE family.

config HWINFO_NXP_RSTCTL
	bool "NXP RSTCTL reset cause"
	default y
	depends on DT_HAS_NXP_RSTCTL_HWINFO_ENABLED
	select HWINFO_HAS_DRIVER
	help
	  Enable NXP RSTCTL hwinfo driver.

config HWINFO_NXP_RW61X
	bool "NXP RW61X hwinfo"
	default y
	depends on SOC_SERIES_RW6XX
	select HWINFO_HAS_DRIVER
	help
	  Enable NXP RW61X hwinfo driver

config HWINFO_NXP_SIM
	bool "NXP Kinetis SIM device ID"
	default y
	depends on DT_HAS_NXP_SIM_UUID_ENABLED
	select HWINFO_HAS_DRIVER
	help
	  Enable NXP Kinetis SIM hwinfo driver.

config HWINFO_NXP_SRC
	bool "NXP SRC reset cause"
	default y
	depends on HAS_MCUX_SRC
	select HWINFO_HAS_DRIVER
	help
	  Enable NXP i.MX SRC hwinfo driver.

config HWINFO_NXP_SRC_V2
	bool "NXP SRC reset cause (multicore devices)"
	default y
	depends on DT_HAS_NXP_IMX_SRC_REV2_ENABLED
	select HWINFO_HAS_DRIVER
	help
	  Enable version 2 multicore NXP i.MX SRC hwinfo driver.

config HWINFO_NXP_SYSCON
	bool "NXP LPC device ID"
	default y
	depends on DT_HAS_NXP_LPC_UID_ENABLED
	select HWINFO_HAS_DRIVER
	help
	  Enable NXP LPC ID hwinfo driver.
```

## drivers/hwinfo/Kconfig.silabs
```kconfig
# Copyright The Zephyr Project Contributors
# SPDX-License-Identifier: Apache-2.0

config HWINFO_SILABS_S2
	bool "Silabs Series 2 hwinfo"
	default y
	depends on SOC_FAMILY_SILABS_S2
	select HWINFO_HAS_DRIVER
	select SILABS_SISDK_RMU
	help
	  Enable Silabs Series 2 hwinfo driver.

config HWINFO_SILABS_S3
	bool "Silabs Series 3 hwinfo"
	default y
	depends on SOC_FAMILY_SILABS_S3
	select HWINFO_HAS_DRIVER
	select SILABS_SISDK_EMU
	select SILABS_SISDK_SYSTEM
	help
	  Enable Silabs Series 3 hwinfo driver.
```

## drivers/hwinfo/Kconfig.ti_k3
```kconfig
# SPDX-FileCopyrightText: 2026 Texas Instruments Incorporated
# SPDX-License-Identifier: Apache-2.0

config HWINFO_TI_K3
	bool "TI K3 hwinfo"
	default y
	depends on DT_HAS_TI_K3_JTAGID_ENABLED
	depends on DT_HAS_TI_K3_RST_SRC_ENABLED
	select HWINFO_HAS_DRIVER
	select SYSCON
	help
	  Enable the TI K3 hwinfo driver. The device ID is read from the
	  JTAGID register and the reset cause from the RST_SRC register of
	  the wakeup MMR, both through the parent syscon.
```

## drivers/hwinfo/Kconfig.tle927x
```kconfig
# SPDX-FileCopyrightText: Copyright (c) 2026 Deere & Company
# SPDX-FileCopyrightText: Copyright (c) 2026 Linumiz
# SPDX-License-Identifier: Apache-2.0

config HWINFO_TLE927X
	bool "Infineon TLE927x SBC reset cause"
	default y
	depends on DT_HAS_INFINEON_TLE927X_HWINFO_ENABLED
	select MFD
	select HWINFO_HAS_DRIVER
	help
	  Enable the hwinfo reset cause driver for the Infineon TLE927x System
	  Basis Chip. The reset cause is decoded from the SUP_STAT, THERM_STAT
	  and DEV_STAT registers, which the driver reads and clears at init.

if HWINFO_TLE927X

config HWINFO_TLE927X_INIT_PRIORITY
	int "TLE927x hwinfo driver init priority"
	default 76
	help
	  Init priority for the TLE927x hwinfo driver. It must be greater
	  than MFD_TLE927X_INIT_PRIORITY and lower than the init priority of
	  the other TLE927x child drivers.

endif # HWINFO_TLE927X
```

## drivers/hwinfo/Kconfig.wch
```kconfig
# SPDX-FileCopyrightText: Copyright Michael Hope <michaelh@juju.nz>
# SPDX-License-Identifier: Apache-2.0

config HWINFO_WCH
	bool "WCH CH32V Electronic Signature (ESIG)"
	default y
	depends on DT_HAS_WCH_ESIG_ENABLED
	select HWINFO_HAS_DRIVER
	help
	  Enable the WCH CH32V series Electronic Signature (ESIG) driver.
```

## drivers/hwinfo/Kconfig.xmc4xxx
```kconfig
# SPDX-FileCopyrightText: Copyright (c) 2026 Marcelo Roberto Jimenez
# SPDX-License-Identifier: Apache-2.0

config HWINFO_XMC4XXX
	bool "Infineon XMC4xxx unique chip ID and reset cause"
	default y
	depends on SOC_SERIES_XMC4XXX
	select HWINFO_HAS_DRIVER
	help
	  Enable the hwinfo driver for Infineon XMC4xxx: the 16-byte unique
	  chip ID written by the boot ROM and the reset cause from SCU RSTSTAT.
```

## drivers/hwspinlock/Kconfig.k3
```kconfig
# Copyright (c) 2026 Dhruv Menon <dhruvmenon1104@gmail.com>
# SPDX-License-Identifier: Apache-2.0

config HWSPINLOCK_K3
	bool "TI K3 SPINLOCK HW spinlock driver"
	default y
	depends on DT_HAS_TI_K3_HWSPINLOCK_ENABLED
	help
	  Enable the TI K3 SPINLOCK hardware spinlock driver.
```

## drivers/i2c/Kconfig.bee
```kconfig
# Copyright (c) 2026, Realtek Semiconductor Corporation
# SPDX-License-Identifier: Apache-2.0

config I2C_BEE
	bool "Realtek Bee series I2C driver"
	default y
	depends on DT_HAS_REALTEK_BEE_I2C_ENABLED
	select HAL_REALTEK_BEE_I2C
	select PINCTRL
	select I2C_TRANSFER_TIMEOUT_SUPPORTED
	help
	  This option enables the I2C driver for Realtek Bee SoCs.

config I2C_BEE_BUS_RECOVERY
	bool "Bus recovery support"
	depends on I2C_BEE
	default y if I2C_BUS_RECOVERY
	select I2C_BITBANG
	help
	  Enable I2C bus recovery on Realtek Bee SoCs by bit-banging the SCL/SDA
	  lines through GPIO. Requires GPIO to be enabled and the scl-gpios and
	  sda-gpios properties on the I2C node.
```

## drivers/i2c/Kconfig.cc23xx_cc27xx
```kconfig
# Copyright (c) 2024 Baylibre, SAS
#
# SPDX-License-Identifier: Apache-2.0

config I2C_CC23XX_CC27XX
	bool "TI SimpleLink CC23xx/CC27xx I2C driver"
	default y
	depends on DT_HAS_TI_CC23XX_CC27XX_I2C_ENABLED
	select PINCTRL
	help
	  Enable support for I2C on the TI SimpleLink CC23xx/CC27xx series.
```
