## drivers/i2c/Kconfig.gmsl_gate
```kconfig
# Copyright (c) 2026 Charles Dias
# SPDX-License-Identifier: Apache-2.0

config I2C_GMSL_GATE
	bool "ADI GMSL2 I2C gates"
	default y
	depends on DT_HAS_ADI_MAX96724_I2C_GATE_ENABLED || DT_HAS_ADI_MAX96717_I2C_GATE_ENABLED
	depends on VIDEO_MAX96724 || VIDEO_MAX96717
	help
	  I2C controllers that model the I2C path behind a GMSL2 link. The
	  deserializer's gate carries the serializer; the serializer's gate
	  carries the camera-side bus.

if I2C_GMSL_GATE

config I2C_GMSL_GATE_RETRY_NUM
	int "Retries of a transfer the deserializer refused"
	default 0
	help
	  On some board paths the deserializer refuses a transfer to the far
	  side that starts right after the previous one ended. The
	  deserializer's gate then retries the transfer this many times; a
	  board sets the count that matches its path.

config I2C_GMSL_GATE_MAX96724_INIT_PRIORITY
	int "MAX96724 I2C gate init priority"
	default 57
	help
	  Must run after the MAX96724 deserializer (default 56) and before the
	  MAX96717 serializer (default 58), which is reached through this gate.

config I2C_GMSL_GATE_MAX96717_INIT_PRIORITY
	int "MAX96717 I2C gate init priority"
	default 59
	help
	  Must run after the MAX96717 serializer (default 58) and before the
	  camera sensors (VIDEO_INIT_PRIORITY, default 60), which are reached
	  through this gate.

endif # I2C_GMSL_GATE
```

## drivers/i2c/Kconfig.infineon
```kconfig
# Infineon CAT1 I2C configuration options

# Copyright (c) 2023 Cypress Semiconductor Corporation (an Infineon company) or
# an affiliate of Cypress Semiconductor Corporation
#
# SPDX-License-Identifier: Apache-2.0

config I2C_INFINEON_CAT1_HAL
	bool "Infineon CAT1 I2C HAL based driver"
	default y
	depends on DT_HAS_INFINEON_I2C_ENABLED
	depends on USE_INFINEON_LEGACY_HAL
	select USE_INFINEON_I2C
	select PINCTRL
	help
	  This option enables the HAL based I2C driver for Infineon CAT1 family.

config I2C_INFINEON_CAT1_PDL
	bool "Infineon CAT1 I2C PDL based driver"
	default y
	depends on DT_HAS_INFINEON_I2C_ENABLED
	depends on !USE_INFINEON_LEGACY_HAL
	select USE_INFINEON_I2C
	select PINCTRL
	select I2C_TRANSFER_TIMEOUT_SUPPORTED
	help
	  This option enables the PDL based I2C driver for the Infineon CAT1 family.

config I2C_INFINEON_BUS_RECOVERY
	bool "Bus recovery support"
	default y
	depends on USE_INFINEON_I2C
	depends on $(dt_compat_any_has_prop,$(DT_COMPAT_INFINEON_I2C),scl-gpios)
	depends on $(dt_compat_any_has_prop,$(DT_COMPAT_INFINEON_I2C),sda-gpios)
	select I2C_BITBANG
	help
	  Enable Infineon I2C driver bus recovery support via GPIO bitbanging.

config I2C_INFINEON_CAT1_TARGET_BUF
	int "I2C Target data buffer length"
	depends on USE_INFINEON_I2C
	range 1 1024
	default 64
	help
	  Buffer to receive data as an I2C Target.

config I2C_INFINEON_SCB
	bool "Infineon SCB I2C driver"
	default y
	depends on DT_HAS_INFINEON_SCB_I2C_ENABLED
	depends on DT_HAS_INFINEON_PERI_CLK_ENABLED
	depends on CLOCK_CONTROL
	select PINCTRL
	select I2C_TRANSFER_TIMEOUT_SUPPORTED
	help
	  Enable the native driver for the Serial Communication Block of
	  Infineon TRAVEO T2G devices in I2C controller and target mode.

config I2C_INFINEON_SCB_BUS_RECOVERY
	bool "Infineon SCB I2C bus recovery"
	default y
	depends on I2C_INFINEON_SCB
	depends on GPIO
	depends on $(dt_compat_any_has_prop,$(DT_COMPAT_INFINEON_SCB_I2C),scl-gpios)
	depends on $(dt_compat_any_has_prop,$(DT_COMPAT_INFINEON_SCB_I2C),sda-gpios)
	select I2C_BITBANG
	help
	  Recover a stuck bus by clocking SCL through the scl-gpios and
	  sda-gpios pins of the instance.
```

## drivers/i2c/Kconfig.mchp_xec
```kconfig
# Microchip XEC I2C configuration options

# Copyright (c) 2019 Intel Corporation
# SPDX-License-Identifier: Apache-2.0

config I2C_XEC
	bool "XEC Microchip I2C driver"
	default y
	depends on DT_HAS_MICROCHIP_XEC_I2C_ENABLED
	select PINCTRL
	help
	  Enable the Microchip XEC I2C driver.

config I2C_XEC_V2
	bool "XEC Microchip I2C driver"
	default y
	depends on DT_HAS_MICROCHIP_XEC_I2C_V2_ENABLED
	select PINCTRL
	help
	  Enable the Microchip XEC I2C V2 driver.

config I2C_MCHP_XEC_V3_BM
	bool "XEC Microchip I2Cv3 byte mode driver"
	default y
	depends on DT_HAS_MICROCHIP_XEC_I2C_V3_BM_ENABLED && HAS_MCHP_MEC_I2C_SMB_V38
	select PINCTRL
	help
	  Enable the Microchip XEC I2C version 3 byte mode driver.

config I2C_MCHP_XEC_V3_TRANSFER_TIMEOUT_MS
	int "Per-transfer timeout (milliseconds)"
	default 1000
	depends on I2C_MCHP_XEC_V3_BM
	help
	  Upper bound on how long the driver waits for a controller
	  transaction to complete before returning -ETIMEDOUT.

config I2C_MCHP_XEC_V3_BM_KWQ_STACK_SIZE
	int "Microchip XEC I2C V3 custom kernel work queue stack size"
	default 320
	depends on I2C_MCHP_XEC_V3_BM
	help
	  Stack size in bytes of the I2Cv3 byte mode driver's custom kernel
	  work queue.

if I2C_MCHP_XEC_V3_BM

config I2C_MCHP_XEC_V3_BM_KWQ_PRIORITY
	int "Microchip XEC I2C V3 custom kernel work queue priority"
	default 10
	help
	  Custom kernel work queue priority. Default is 10. Higher
	  positive numbers are lower priority.

config I2C_MCHP_XEC_V3_BM_STATE_CAPTURE
	bool "MCHP XEC I2Cv3-BM driver state capture"
	help
	  Enable driver state capture for helping diagnosing I2C issues

config I2C_MCHP_XEC_V3_BM_STATE_CAPTURE_SIZE
	int
	default 256
	depends on I2C_MCHP_XEC_V3_BM_STATE_CAPTURE
	help
	  Size of state capture buffer in bytes. Default is 256.

endif # I2C_MCHP_XEC_V3_BM
```

## drivers/i2c/Kconfig.msp432p4xx
```kconfig
# Copyright (c) 2026 Gail Rojas <gailroco@gmail.com>
# SPDX-License-Identifier: Apache-2.0

config I2C_MSP432P4XX
	bool "MSP432P4xx eUSCI_B I2C driver"
	default y
	depends on DT_HAS_TI_MSP432P4XX_I2C_ENABLED
	help
	  I2C master driver for the TI MSP432P4xx eUSCI_B module.
	  Supports standard (100 kHz) and fast (400 kHz) modes.
	  Note: pin muxing for SDA and SCL is hardcoded for eUSCI_B0 on
	  P1.6/P1.7 (MSP-EXP432P401R LaunchPad).  A pinctrl driver for
	  MSP432P4xx is not yet available.
```

## drivers/i2c/Kconfig.mspm0
```kconfig
# SPDX-License-Identifier: Apache-2.0
# Copyright (c) 2026 Texas Instruments Incorporated

config I2C_MSPM0
	bool "MSPM0 I2C driver"
	default y
	depends on DT_HAS_TI_MSPM0_I2C_ENABLED
	select PINCTRL
	select I2C_TRANSFER_TIMEOUT_SUPPORTED
	help
	  This option enables the TI MSPM0 I2C driver.

if I2C_MSPM0

config MSPM0_I2C_SCL_LOW_TIMEOUT_MS
	int "I2C SCL Timeout"
	default 1000
	help
	  Timeout in milliseconds that reflects acceptable
	  cumulative low period in a transaction. Note this
	  can be a restriction on very long SCL stretch

config MSPM0_I2C_FIFO_DEPTH
	int "TX/RX FIFO depth; can be overridden by SoC defconfig"
	default 8

config MSPM0_I2C_MAX_DISPATCH_MSGS
	int "Upper bound on number of dispatchable messages"
	default 8
	help
	  Dispatchable messages are created by combining continuous
	  messages that have the same direction and no STOP/RESTART
	  conditions in between. This is a configurable upper limit
	  on the number of dispatchable messages supported by the
	  driver.

endif # I2C_MSPM0
```

## drivers/i2c/Kconfig.native_linux
```kconfig
# SPDX-FileCopyrightText: 2026 Muhammad Waleed Badar
# SPDX-License-Identifier: Apache-2.0

config I2C_NATIVE_LINUX
	bool "Native Linux I2C controller"
	default y
	depends on DT_HAS_ZEPHYR_NATIVE_LINUX_I2C_ENABLED
	depends on ARCH_POSIX
	select NATIVE_USE_NSI_ERRNO
	select NATIVE_SIMULATOR_PREFER_REAL_TIME
	help
	  native_sim I2C controller backed by a host i2c-dev node.

if I2C_NATIVE_LINUX

config I2C_NATIVE_LINUX_IRQ
	int "Interrupt number of the native Linux I2C controller"
	default 4
	help
	  Raised when a transfer is done, shared by all instances. Must differ
	  from the other interrupts of the board, such as NSOS_IRQ.

config I2C_NATIVE_LINUX_POLL_PERIOD
	int "Transfer completion poll period of the native Linux I2C controller"
	default 250
	range 1 1000000
	help
	  Simulated microseconds between checks for a finished transfer. A
	  value much shorter than the real time period (--rt-period) gains
	  nothing.

config I2C_NATIVE_LINUX_BOUNCE_SIZE
	int "Bounce buffer size of the native Linux I2C controller"
	default 1024
	range 2 65535
	help
	  Per-instance buffer for joining messages sent without RESTART.

endif # I2C_NATIVE_LINUX
```

## drivers/i2c/Kconfig.omap
```kconfig
# Copyright (C) 2024 BeagleBoard.org Foundation
# Copyright (C) 2024 Dhruv Menon <dhruvmenon1104@gmail.com>
#
# SPDX-License-Identifier: Apache-2.0

config I2C_OMAP
	bool "TI OMAP I2C Driver"
	default y
	depends on DT_HAS_TI_OMAP_I2C_ENABLED
	select PINCTRL
	select I2C_OMAP_INTERRUPT if I2C_TARGET || I2C_RTIO
	help
	  Enable the I2C driver for TI OMAP SoCs.

	  When CONFIG_I2C_TARGET is also enabled, the driver exposes I2C
	  target (slave) register/unregister callbacks. Target mode and
	  native RTIO both require interrupt-driven operation
	  (CONFIG_I2C_OMAP_INTERRUPT).

config I2C_OMAP_INTERRUPT
	bool "Interrupt-driven transfers"
	default y
	depends on I2C_OMAP
	help
	  Handle I2C events in the ISR and block the caller on a completion
	  semaphore. When disabled, status is polled in thread context.
	  Required for CONFIG_I2C_TARGET and CONFIG_I2C_RTIO support on this
	  driver.

config I2C_OMAP_BUS_RECOVERY
	bool "Bus recovery support"
	default y if I2C_BUS_RECOVERY
	depends on I2C_OMAP
	select I2C_BITBANG
	help
	  Enable OMAP I2C driver bus recovery support via bitbanging.
```
