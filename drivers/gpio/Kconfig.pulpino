## drivers/gpio/Kconfig.pulpino
```kconfig
# Kconfig.pulpino - pulpino GPIO configuration option
#
# Copyright (c) 2016 Jean-Paul Etienne <fractalclone@gmail.com>
#
# SPDX-License-Identifier: Apache-2.0
#

menuconfig GPIO_PULPINO
	bool "Pulpino GPIO controller driver"
	depends on GPIO && SOC_RISCV32_PULPINO
	help
	  Enable driver for the Pulpino GPIO controller.

	  Says n if not sure.
```

## drivers/gpio/Kconfig.qmsi
```kconfig
# Kconfig.qmsi - QMSI GPIO configuration options
#
#
# Copyright (c) 2016 Intel Corporation
#
# SPDX-License-Identifier: Apache-2.0
#

menuconfig GPIO_QMSI
	bool "QMSI GPIO driver"
	depends on QMSI
	select HAS_DTS_GPIO
	help
	  Enable the GPIO driver found on Intel Microcontroller
	  boards, using the QMSI library.

if GPIO_QMSI

config GPIO_QMSI_INIT_PRIORITY
	int "Init priority"
	default 60
	depends on GPIO_QMSI
	help
	  Device driver initialization priority.

config GPIO_QMSI_API_REENTRANCY
	bool "GPIO driver API reentrancy"
	depends on GPIO_QMSI
	help
	  Enable support for QMSI GPIO driver API reentrancy.

config GPIO_QMSI_0
	bool "QMSI GPIO block 0"
	help
	  Include support for the GPIO port 0 using QMSI.

config GPIO_QMSI_1
	bool "QMSI GPIO block 1"
	help
	  Include support for the GPIO port 1 using QMSI.

endif # GPIO_QMSI
```

## drivers/gpio/Kconfig.qmsi_ss
```kconfig
# Kconfig.qmsi_ss - QMSI SENSOR GPIO configuration options
#
#
# Copyright (c) 2016 Intel Corporation
#
# Licensed under the Apache License, Version 2.0 (the "License");
# you may not use this file except in compliance with the License.
# You may obtain a copy of the License at
#
#     http://www.apache.org/licenses/LICENSE-2.0
#
# Unless required by applicable law or agreed to in writing, software
# distributed under the License is distributed on an "AS IS" BASIS,
# WITHOUT WARRANTIES OR CONDITIONS OF ANY KIND, either express or implied.
# See the License for the specific language governing permissions and
# limitations under the License.
#

menuconfig GPIO_QMSI_SS
	bool "QMSI SENSOR GPIO driver"
	depends on GPIO && QMSI && ARC
	default n
	help
	  Enable the driver for GPIO found on sensor system,
	  using the QMSI library.

if GPIO_QMSI_SS

config GPIO_QMSI_SS_0
	bool
	prompt "QMSI GPIO block 0"
	default n
	help
	  Include support for the GPIO port 0 using QMSI.

config GPIO_QMSI_SS_0_NAME
	string "Driver name"
	depends on GPIO_QMSI_SS_0
	default "GPIO_0"

config GPIO_QMSI_SS_0_PRI
	int "Controller interrupt priority"
	depends on GPIO_QMSI_SS_0
	help
	  IRQ priority

config GPIO_QMSI_SS_1
	bool
	prompt "QMSI GPIO block 1"
	default n
	help
	  Include support for the GPIO port 1 using QMSI.

config GPIO_QMSI_SS_1_NAME
	string "Driver name"
	depends on GPIO_QMSI_SS_1
	default "GPIO_1"

config GPIO_QMSI_SS_1_PRI
	int "Controller interrupt priority"
	depends on GPIO_QMSI_SS_1
	help
	  IRQ priority

config GPIO_QMSI_SS_API_REENTRANCY
	bool
	prompt "GPIO driver API reentrancy"
	default n
	help
	Enable support for QMSI GPIO driver API reentrancy.

endif # GPIO_QMSI_SS
```

## drivers/gpio/Kconfig.rcar
```kconfig
# Renesas RCAR configuration options

# Copyright (c) 2020 IoT.bzh
# SPDX-License-Identifier: Apache-2.0

DT_COMPAT_RENESAS_RCAR_GPIO := renesas,rcar-gpio

config GPIO_RCAR
	bool "Renesas R-Car GPIO"
	depends on SOC_FAMILY_RCAR
	default $(dt_compat_enabled,$(DT_COMPAT_RENESAS_RCAR_GPIO))
	help
	  Enable Renesas RCAR GPIO driver.
```

## drivers/gpio/Kconfig.rda5981a
```kconfig
#
# Copyright (c) 2017 RDA
# Copyright (c) 2016-2017 Linaro Limited
#
# SPDX-License-Identifier: Apache-2.0
#

menuconfig GPIO_RDA5981A
	bool "GPIO Driver for RDA5981 family of MCUs"
	depends on GPIO && SOC_FAMILY_RDA5981
	default n
	help
	Enable GPIO driver for RDA5981 line of MCUs

if GPIO_RDA5981A

config GPIO_RDA5981A_DEV_NAME
	string "GPIO Device Name"
	default "RDA_GPIO"
	help
	  Specify the device name to be used for the GPIO port.

config GPIO_RDA5981A_PORT_PRI
	int "GPIO interrupt priority"
	default 1

endif
```

## drivers/gpio/Kconfig.renesas_ra
```kconfig
# Copyright (c) 2023 TOKITA Hiroshi <tokita.hiroshi@fujitsu.com>
# SPDX-License-Identifier: Apache-2.0

config GPIO_RENESAS_RA
	bool "Renesas RA Series GPIO driver"
	default y
	select GPIO_GET_CONFIG
	select PINCTRL
	depends on DT_HAS_RENESAS_RA_GPIO_ENABLED
	help
	  Enable Renesas RA series GPIO driver.
```

## drivers/gpio/Kconfig.renesas_ra2
```kconfig
# Copyright (c) 2023-204 MUNIC SA
# SPDX-License-Identifier: Apache-2.0

config GPIO_RENESAS_RA2
	bool "Renesas RA2 series GPIO driver"
	default y
	select GPIO_GET_CONFIG
	depends on DT_HAS_RENESAS_RA2_GPIO_ENABLED
	help
	  Enable Renesas RA series GPIO driver.
```

## drivers/gpio/Kconfig.renesas_ra8
```kconfig
# Copyright (c) 2024 Renesas Electronics Corporation
# SPDX-License-Identifier: Apache-2.0

config GPIO_RA8
	bool "Renesas RA8 GPIO driver"
	default y
	depends on DT_HAS_RENESAS_RA8_GPIO_ENABLED
	help
	  Enable the Renesas RA8 GPIO driver.
```

## drivers/gpio/Kconfig.renesas_ra_ioport
```kconfig
# Copyright (c) 2024 Renesas Electronics Corporation
# SPDX-License-Identifier: Apache-2.0

config GPIO_RA_IOPORT
	bool "Renesas RA GPIO IO port driver"
	default y
	depends on DT_HAS_RENESAS_RA_GPIO_IOPORT_ENABLED
	select PINCTRL
	help
	  Enable the Renesas RA GPIO IO port driver.

if GPIO_RA_IOPORT

config GPIO_RA_HAS_VBTICTLR
	bool "Support VBATT input control"
	help
	  Enable for Renesas RA which support VBATT input control.

endif # GPIO_RA_IOPORT
```

## drivers/gpio/Kconfig.renesas_rx
```kconfig
# Copyright (c) 2024 Renesas Electronics Corporation
# SPDX-License-Identifier: Apache-2.0

config GPIO_RENESAS_RX
	bool "Renesas RX GPIO driver"
	default y
	depends on DT_HAS_RENESAS_RX_GPIO_ENABLED
	select PINCTRL
	help
	  Enable the Renesas RX GPIO driver.
```

## drivers/gpio/Kconfig.renesas_rz
```kconfig
# Copyright (c) 2024-2025 Renesas Electronics Corporation
# SPDX-License-Identifier: Apache-2.0

config GPIO_RENESAS_RZ
	bool "Renesas RZ series gpio driver"
	default y
	depends on DT_HAS_RENESAS_RZ_GPIO_ENABLED
	select USE_RZ_FSP_IOPORT
	help
	  Enable Renesas RZ series gpio driver.

config GPIO_RENESAS_RZ_TYPE1
	bool
	default y
	depends on DT_HAS_RENESAS_RZ_GPIO_COMMON_ENABLED

config GPIO_RENESAS_RZ_TYPE2
	bool
	default y
	depends on DT_HAS_RENESAS_RZ_GPIO_COMMON_V2_ENABLED
```

## drivers/gpio/Kconfig.renesas_rza2m
```kconfig
# Copyright (c) 2025 Renesas Electronics Corporation
# SPDX-License-Identifier: Apache-2.0

config GPIO_RENESAS_RZA2M
	bool "Renesas RZ/A2M GPIO"
	default y
	depends on DT_HAS_RENESAS_RZA2M_GPIO_ENABLED
	select PINCTRL
	help
	  Enable Renesas RZ/A2M GPIO driver.
```

## drivers/gpio/Kconfig.rh850
```kconfig
# Copyright (c) 2026 Renesas Electronics Corporation
# SPDX-License-Identifier: Apache-2.0

config GPIO_RH850
	bool "Renesas RH850 GPIO"
	default y
	depends on DT_HAS_RENESAS_RH850_GPIO_ENABLED
	select USE_RH850_FSP_IOPORT
	help
	  Enable Renesas RH850 GPIO driver.
```

## drivers/gpio/Kconfig.rp1
```kconfig
# Copyright (c) 2024 Junho Lee <junho@tsnlab.com>
# SPDX-License-Identifier: Apache-2.0

config GPIO_RP1
	bool "RP1 peripheral controller GPIO Driver"
	default y
	depends on DT_HAS_RASPBERRYPI_RP1_GPIO_ENABLED
	help
	  Enable Driver for GPIO banks on RP1 peripheral controller.
```

## drivers/gpio/Kconfig.rpi_bcm283x
```kconfig
# Copyright (c) 2026 Muhammad Waleed Badar
# SPDX-License-Identifier: Apache-2.0

config GPIO_RASPBERRYPI_BCM283X
	bool "Raspberry Pi BCM283x GPIO Expander driver"
	default y
	depends on DT_HAS_RASPBERRYPI_BCM283X_GPIO_ENABLED
	help
	  Enable driver for Raspberry Pi BCM283x GPIO Expander


if GPIO_RASPBERRYPI_BCM283X

config GPIO_RASPBERRYPI_BCM283X_INIT_PRIORITY
	int "Raspberry Pi BCM283x GPIO Expander driver init priority"
	default 46
	help
	  Must be higher (later) than CONFIG_RASPBERRYPI_FIRMWARE_INIT_PRIORITY so the
	  firmware interface is ready before this drivers initialization runs.

endif
```

## drivers/gpio/Kconfig.rpi_pico
```kconfig
# Copyright (c) 2021 Yonatan Schachter
# SPDX-License-Identifier: Apache-2.0

config GPIO_RPI_PICO
	default y
	depends on DT_HAS_RASPBERRYPI_PICO_GPIO_PORT_ENABLED
	select PICOSDK_USE_GPIO
	select PINCTRL
	bool "Raspberry Pi Pico GPIO driver"
```

## drivers/gpio/Kconfig.rt1718s
```kconfig
# RT1718S driver configuration options

# Copyright 2022 Google LLC
# SPDX-License-Identifier: Apache-2.0

menuconfig GPIO_RT1718S
	bool "RT1718S I2C-based TCPC chip with GPIOs"
	default y
	depends on DT_HAS_RICHTEK_RT1718S_GPIO_PORT_ENABLED
	help
	  Enable driver GPIO for RT1718S I2C-based TCPC chip.

if GPIO_RT1718S

config RT1718S_INIT_PRIORITY
	int "RT1718S GPIO init priority"
	default 60
	help
	  RT1718S device driver initialization priority. The priority should be
	  lower than I2C device.

config GPIO_RT1718S_PORT_INIT_PRIORITY
	int "RT1718S GPIO port init priority"
	default 61
	help
	  RT1718S GPIO driver initialization priority. The priority should be lower
	  than I2C & RT1718S_INIT_PRIORITY device.

config GPIO_RT1718S_INTERRUPT
	bool "RT1718S alert handler"
	help
	  Enable support for handling RT1718S Alert with a GPIO interrupt connected
	  from the chip.

endif # GPIO_RT1718S
```

## drivers/gpio/Kconfig.rts5817
```kconfig
# Copyright (c) 2026 Realtek Semiconductor, Inc.
# SPDX-License-Identifier: Apache-2.0

config GPIO_RTS5817
	bool "RTS5817 gpio driver"
	depends on DT_HAS_REALTEK_RTS5817_GPIO_ENABLED
	default y
	help
	  Enable driver for RTS5817 gpio.
```

## drivers/gpio/Kconfig.rts5912
```kconfig
# SPDX-License-Identifier: Apache-2.0
#
# Copyright (c) 2024 Realtek Semiconductor Corporation, SIBG-SD7
#

config GPIO_RTS5912
	bool "Realtek embedded controller (EC) gpio driver"
	depends on SOC_SERIES_RTS5912
	default y if DT_HAS_REALTEK_RTS5912_GPIO_ENABLED
	help
	  Enable support for Realtek GPIO controller.
```

## drivers/gpio/Kconfig.rv32m1
```kconfig
# RV32M1 GPIO configuration options

# Copyright (c) 2018 Foundries.io
# SPDX-License-Identifier: Apache-2.0

config GPIO_RV32M1
	bool "RV32M1 GPIO driver"
	default y
	depends on DT_HAS_OPENISA_RV32M1_GPIO_ENABLED
	help
	  Enable the RV32M1 GPIO driver.
```

## drivers/gpio/Kconfig.rzt2m
```kconfig
# Copyright (c) 2023 Antmicro <www.antmicro.com>
# SPDX-License-Identifier: Apache-2.0

config GPIO_RZT2M
	bool "Renesas RZT2M GPIO"
	default y
	depends on DT_HAS_RENESAS_RZT2M_GPIO_ENABLED
	help
	  Enable Renesas RZT2M GPIO driver.
```

## drivers/gpio/Kconfig.sam
```kconfig
# Atmel SAM GPIO configuration options

# Copyright (c) 2018 Justin Watson
# Copyright (c) 2020 Gerson Fernando Budke <nandojve@gmail.com>
# SPDX-License-Identifier: Apache-2.0

config GPIO_SAM
	bool "Atmel SAM GPIO (PORT) driver"
	default y
	depends on DT_HAS_ATMEL_SAM_GPIO_ENABLED
	help
	  Enable support for the Atmel SAM 'PORT' GPIO controllers.

config GPIO_SAM4L
	bool "Atmel SAM4L GPIO (PORT) driver"
	default y
	depends on DT_HAS_ATMEL_SAM4L_GPIO_ENABLED
	help
	  Enable support for the Atmel SAM4L 'PORT' GPIO controllers.

config GPIO_SAM_PIO4
	bool "Microchip SAM PIO4 GPIO driver"
	default y
	depends on DT_HAS_MICROCHIP_SAM_PIO4_ENABLED
	help
	  Microchip Parallel Input/Output Controller is used on SAMA5D2 and
	  SAMA7G5 SoC series
```

## drivers/gpio/Kconfig.sc18im704
```kconfig
# Copyright (c) 2023 Basalte bv
# SPDX-License-Identifier: Apache-2.0

config GPIO_SC18IM704
	bool "NXP SC18IM704 GPIO controller driver"
	default y
	depends on I2C_SC18IM704
	depends on DT_HAS_NXP_SC18IM704_GPIO_ENABLED
	help
	  Enables NXP SC18IM704 GPIO controller driver

config GPIO_SC18IM704_INIT_PRIORITY
	int "SC18IM704 GPIO init priority"
	default 52
	depends on GPIO_SC18IM704
	help
	  SC18IM704 GPIO controller initialization priority.

	  Note: Has to be greater than the parent SC18IM704 bridge initialization priority.
```

## drivers/gpio/Kconfig.sc18is606
```kconfig
# Copyright (c) 2025 tinyvision.ai
# SPDX-License-Identifier: Apache-2.0

config GPIO_SC18IS606
	bool "NXP SC18IS606 GPIO Controller driver"
	default y
	select MFD
	depends on DT_HAS_NXP_SC18IS606_GPIO_ENABLED
	help
	   Enables NXP SC18IS606 gpio controller driver

config GPIO_SC18IS606_INIT_PRIORITY
	int "SC18IS606 GPIO Init Priority"
	default 80
	depends on GPIO_SC18IS606
	help
	   SC18IS606 GPIO Controller Init priority

	   Note: Has to be greater than the parent SC18IS606 bridge init priority
```

## drivers/gpio/Kconfig.sedi
```kconfig
#
# Copyright (c) 2023 Intel Corporation
#
# SPDX-License-Identifier: Apache-2.0
#

config GPIO_SEDI
	bool "SEDI GPIO driver"
	default y
	depends on DT_HAS_INTEL_SEDI_GPIO_ENABLED
	help
	  This option enables Intel SEDI GPIO driver.
	  This driver is simply a shim driver built upon the SEDI
	  bare metal GPIO driver in hal-intel module.
```
