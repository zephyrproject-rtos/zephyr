## drivers/gpio/Kconfig.cc2650
```kconfig
# SPDX-License-Identifier: Apache-2.0
#
# GPIO configuration options for the CC2650 SoC (Texas Instruments).

menuconfig GPIO_CC2650
	bool "TI CC2650 GPIO driver"
	depends on GPIO && SOC_SERIES_CC2650
	help
	  Enable the GPIO driver on boards equipped with TI CC2650.

if GPIO_CC2650

# A single block of GPIO exist.

config GPIO_CC2650_NAME
	string "GPIO driver name."
	default "GPIO_0"

config GPIO_CC2650_INIT_PRIO
	int "GPIO driver initialization priority."
	default 40

endif # GPIO_CC2650
```

## drivers/gpio/Kconfig.cc32xx
```kconfig
# CC32XX GPIO configuration options

# SPDX-License-Identifier: Apache-2.0

config GPIO_CC32XX
	bool "TI CC32XX GPIO driver"
	default y
	depends on DT_HAS_TI_CC32XX_GPIO_ENABLED
	help
	  Enable the GPIO driver on TI SimpleLink CC32xx boards
```

## drivers/gpio/Kconfig.ch32v
```kconfig
# Copyright (c) 2023-2024 Chen Xingyu <hi@xingrz.me>
# SPDX-License-Identifier: Apache-2.0

config GPIO_CH56X
	bool "WCH CH56x GPIO driver"
	default y
	depends on DT_HAS_WCH_CH56X_GPIO_ENABLED
	select SHARED_INTERRUPTS
	help
	  Enable WCH CH56x GPIO driver.
```

## drivers/gpio/Kconfig.cmsdk_ahb
```kconfig
# ARM CMSDK (Cortex-M System Design Kit) AHB GPIO cfg

# Copyright (c) 2016 Linaro Limited
# SPDX-License-Identifier: Apache-2.0

config GPIO_CMSDK_AHB
	bool "ARM CMSDK (Cortex-M System Design Kit) AHB GPIO Controllers"
	default y
	depends on DT_HAS_ARM_CMSDK_GPIO_ENABLED
	help
	  Enable config options to support the ARM CMSDK GPIO controllers.

	  Says n if not sure.
```

## drivers/gpio/Kconfig.creg_gpio
```kconfig
# Synopsys GPIO via CREG (Control REGisters) driver

# Copyright (c) 2021 Synopsys
# SPDX-License-Identifier: Apache-2.0

config GPIO_SNPS_CREG
	bool "SNPS CREG GPIO"
	default y
	depends on DT_HAS_SNPS_CREG_GPIO_ENABLED
	help
	  Enable driver for SNPS CREG GPIO.
```

## drivers/gpio/Kconfig.cy8c95xx
```kconfig
# CY8C95XX GPIO configuration options

# Copyright (c) 2021 Synopsys
# SPDX-License-Identifier: Apache-2.0

menuconfig GPIO_CY8C95XX
	bool "CY8C95XX I2C GPIO chip"
	default y
	depends on DT_HAS_CYPRESS_CY8C95XX_GPIO_PORT_ENABLED
	depends on I2C
	help
	  Enable driver for CY8C95XX I2C GPIO chip.

if GPIO_CY8C95XX

config GPIO_CY8C95XX_INIT_PRIORITY
	int "Init priority"
	default I2C_INIT_PRIORITY
	help
	  Device driver initialization priority.

endif # GPIO_CY8C95XX
```

## drivers/gpio/Kconfig.cyw43
```kconfig
# Copyright (c) 2025 John Lin
# SPDX-License-Identifier: Apache-2.0

config GPIO_CYW43
	bool "Infineon CYW43 GPIO driver"
	default y
	depends on DT_HAS_INFINEON_CYW43_GPIO_ENABLED
	depends on WIFI_AIROC
	help
	  Enable GPIO driver for the Infineon CYW43 WiFi chip.
	  Exposes WL_GPIO0-2 as standard Zephyr GPIO pins.
	  Pin 0 is the onboard LED on Pico W / Pico 2 W.

if GPIO_CYW43

config GPIO_CYW43_INIT_PRIORITY
	int "CYW43 GPIO initialization priority"
	default 82
	help
	  CYW43 GPIO initialization priority. Must be higher than
	  the WiFi driver initialization priority.

endif # GPIO_CYW43
```

## drivers/gpio/Kconfig.davinci
```kconfig
# Copyright (C) 2023 BeagleBoard.org Foundation
# Copyright (C) 2023 S Prashanth
#
# SPDX-License-Identifier: Apache-2.0

config GPIO_DAVINCI
	bool "Davinci GPIO Driver"
	default y
	depends on DT_HAS_TI_DAVINCI_GPIO_ENABLED
	select PINCTRL
	help
		Enable the Davinci GPIO controller support.
```

## drivers/gpio/Kconfig.dspic
```kconfig
#Enable GPIO driver for dsPIC33A
config GPIO_DSPIC
	bool "dsPIC33A GPIO driver"
	help
	  Enable support for the dsPIC33A GPIO driver.
```

## drivers/gpio/Kconfig.efinix_sapphire
```kconfig
# Copyright (c) 2023 Efinix Inc.
# SPDX-License-Identifier: Apache-2.0

config GPIO_EFINIX_SAPPHIRE
	bool "Efinx sapphire GPIO driver"
	default y
	depends on DT_HAS_EFINIX_SAPPHIRE_GPIO_ENABLED
	help
	  Enable Efinix sapphire GPIO driver.
```

## drivers/gpio/Kconfig.em32
```kconfig
# SPDX-FileCopyrightText: 2026 ELAN Microelectronics Corp.
# SPDX-License-Identifier: Apache-2.0

# EMC32F967 GPIO driver configuration

config GPIO_EM32
	bool "ELAN EMC32Fxxx GPIO driver"
	default y
	depends on SOC_EM32F967
	depends on DT_HAS_ELAN_EM32_GPIO_ENABLED
	depends on CLOCK_CONTROL_EM32_AHB
	select SYSCON
	help
	  Enable GPIO driver for ELAN EM32F967 microcontroller.

	  The EM32F967 has two GPIO ports (GPIOA and GPIOB), each with 16 pins.
	  Each port supports:
	  - Input/output direction control
	  - Pull-up/pull-down resistors
	  - Interrupt generation (edge/level triggered)
	  - Alternate function selection

config GPIO_EM32_INIT_PRIORITY
	int "EM32 GPIO initialization priority"
	default 55
	depends on GPIO_EM32
	help
	  Initialization priority for the EM32 GPIO driver.
	  This must be greater than CONFIG_SYSCON_INIT_PRIORITY since the
	  GPIO driver depends on syscon for pull-up/pull-down and open-drain
	  register access. It must also be greater than the clock control
	  priority since GPIO requires clock gating.
```

## drivers/gpio/Kconfig.emul
```kconfig
# Emulated GPIO configuration options

# Copyright (c) 2020 Friedt Professional Engineering Services, Inc
# SPDX-License-Identifier: Apache-2.0

config GPIO_EMUL
	bool "Emulated GPIO driver"
	default y
	depends on DT_HAS_ZEPHYR_GPIO_EMUL_ENABLED
	help
	  Enable the emulated GPIO driver. Mainly used for testing, this
	  driver allows for an arbitrary number of emulated GPIO controllers
	  to be instantiated. Furthermore, the emulated pins can be "wired"
	  using the regular GPIO callback API and the additional API
	  available in drivers/gpio/gpio_emul.h . Configuration for each
	  GPIO instance is accomplished using device tree and an example of
	  such a configuration is in
	  tests/drivers/gpio/gpio_basic_api/boards/native_sim.overlay
	  If unsure, say N.
```

## drivers/gpio/Kconfig.emul_sdl
```kconfig
# GPIO emulation using SDL keyboard events
#
# Copyright (c) 2022, Basalte bv
# SPDX-License-Identifier: Apache-2.0

config GPIO_EMUL_SDL
	bool "SDL GPIO emulation"
	default y
	depends on DT_HAS_ZEPHYR_GPIO_EMUL_SDL_ENABLED
	depends on GPIO_EMUL
	depends on HAS_SDL
	help
	  Enable GPIO emulation using SDL keyboard events.
```

## drivers/gpio/Kconfig.ene
```kconfig
# Copyright (c) 2024 ENE Technology Inc.
# SPDX-License-Identifier: Apache-2.0

config GPIO_ENE_KB1200
	bool "ENE KB1200 GPIO Driver"
	default y
	depends on DT_HAS_ENE_KB1200_GPIO_ENABLED
	help
	  Enable support for the kb1200 GPIO controllers.
```

## drivers/gpio/Kconfig.eos_s3
```kconfig
# EOS_S3 GPIO configuration options

# Copyright (c) 2020 Antmicro <www.antmicro.com>
# SPDX-License-Identifier: Apache-2.0

config GPIO_EOS_S3
	bool "EOS_S3 GPIO driver"
	default y
	depends on DT_HAS_QUICKLOGIC_EOS_S3_GPIO_ENABLED
	help
	  Enable the EOS S3 gpio driver.
```

## drivers/gpio/Kconfig.esp32
```kconfig
# ESP32 GPIO configuration options

# Copyright (c) 2017 Intel Corporation
# SPDX-License-Identifier: Apache-2.0

config GPIO_ESP32
	bool "ESP32 GPIO"
	default y
	depends on DT_HAS_ESPRESSIF_ESP32_GPIO_ENABLED
	help
	  Enables the ESP32 GPIO driver
```

## drivers/gpio/Kconfig.fake
```kconfig
# Copyright (c) 2026 Nordic Semiconductor ASA
# SPDX-License-Identifier: Apache-2.0

config GPIO_FAKE
	bool "Fake GPIO driver"
	default y
	depends on DT_HAS_ZEPHYR_GPIO_FAKE_ENABLED
	depends on ZTEST
```

## drivers/gpio/Kconfig.fast
```kconfig
# SPDX-FileCopyrightText: Copyright (c) 2026 Gerson Fernando Budke
# SPDX-FileCopyrightText: Copyright (c) 2026 Perry Naseck, MIT Media Lab <pnaseck@media.mit.edu>
# SPDX-License-Identifier: Apache-2.0

menuconfig GPIO_FAST
	bool "Fast GPIO API for timing-critical operations"
	depends on GPIO
	help
	  Enable the fast GPIO API extension. This provides sub-microsecond
	  GPIO operations via vendor-specific ALWAYS_INLINE functions that
	  bypass the standard GPIO driver indirection.

	  Required for bit-bang protocols with tight timing constraints
	  such as WS2812 LED strips. Vendor-specific implementations are
	  automatically selected based on the GPIO driver in use.

if GPIO_FAST

config GPIO_FAST_OUT_OF_TREE_BACKEND
	bool "Include out-of-tree fast GPIO backend"
	help
	  Enable inclusion of an out-of-tree fast GPIO backend header.
	  The OOT module must provide zephyr_gpio_fast_impl_oot.h on
	  the include path (via zephyr_include_directories in its
	  CMakeLists.txt). The dispatch macros resolve to the OOT
	  backend automatically via token-paste on the DT compatible.

endif # GPIO_FAST
```

## drivers/gpio/Kconfig.fe310
```kconfig
# Kconfig.fe310 - SiFive Freedom E310 GPIO configuration option
#
# Copyright (c) 2017 Jean-Paul Etienne <fractalclone@gmail.com>
#
# SPDX-License-Identifier: Apache-2.0
#

menuconfig GPIO_FE310
	bool "SiFive Freedom E310 Processor GPIO driver"
	depends on GPIO && SOC_RISCV32_FE310
	help
	  Enable driver for the SiFive Freedom E310 GPIO controller.

	  Says n if not sure.

if GPIO_FE310

config GPIO_FE310_GPIO_NAME
	string "GPIO driver name"
	default "gpio0"

config GPIO_FE310_0_PRIORITY
	int "GPIO 0 interrupt priority"
	default 1

config GPIO_FE310_1_PRIORITY
	int "GPIO 1 interrupt priority"
	default 1

config GPIO_FE310_2_PRIORITY
	int "GPIO 2 interrupt priority"
	default 1

config GPIO_FE310_3_PRIORITY
	int "GPIO 3 interrupt priority"
	default 1

config GPIO_FE310_4_PRIORITY
	int "GPIO 4 interrupt priority"
	default 1

config GPIO_FE310_5_PRIORITY
	int "GPIO 5 interrupt priority"
	default 1

config GPIO_FE310_6_PRIORITY
	int "GPIO 6 interrupt priority"
	default 1

config GPIO_FE310_7_PRIORITY
	int "GPIO 7 interrupt priority"
	default 1

config GPIO_FE310_8_PRIORITY
	int "GPIO 8 interrupt priority"
	default 1

config GPIO_FE310_9_PRIORITY
	int "GPIO 9 interrupt priority"
	default 1

config GPIO_FE310_10_PRIORITY
	int "GPIO 10 interrupt priority"
	default 1

config GPIO_FE310_11_PRIORITY
	int "GPIO 11 interrupt priority"
	default 1

config GPIO_FE310_12_PRIORITY
	int "GPIO 12 interrupt priority"
	default 1

config GPIO_FE310_13_PRIORITY
	int "GPIO 13 interrupt priority"
	default 1

config GPIO_FE310_14_PRIORITY
	int "GPIO 14 interrupt priority"
	default 1

config GPIO_FE310_15_PRIORITY
	int "GPIO 15 interrupt priority"
	default 1

config GPIO_FE310_16_PRIORITY
	int "GPIO 16 interrupt priority"
	default 1

config GPIO_FE310_17_PRIORITY
	int "GPIO 17 interrupt priority"
	default 1

config GPIO_FE310_18_PRIORITY
	int "GPIO 18 interrupt priority"
	default 1

config GPIO_FE310_19_PRIORITY
	int "GPIO 19 interrupt priority"
	default 1

config GPIO_FE310_20_PRIORITY
	int "GPIO 20 interrupt priority"
	default 1

config GPIO_FE310_21_PRIORITY
	int "GPIO 21 interrupt priority"
	default 1

config GPIO_FE310_22_PRIORITY
	int "GPIO 22 interrupt priority"
	default 1

config GPIO_FE310_23_PRIORITY
	int "GPIO 23 interrupt priority"
	default 1

config GPIO_FE310_24_PRIORITY
	int "GPIO 24 interrupt priority"
	default 1

config GPIO_FE310_25_PRIORITY
	int "GPIO 25 interrupt priority"
	default 1

config GPIO_FE310_26_PRIORITY
	int "GPIO 26 interrupt priority"
	default 1

config GPIO_FE310_27_PRIORITY
	int "GPIO 27 interrupt priority"
	default 1

config GPIO_FE310_28_PRIORITY
	int "GPIO 28 interrupt priority"
	default 1

config GPIO_FE310_29_PRIORITY
	int "GPIO 29 interrupt priority"
	default 1

config GPIO_FE310_30_PRIORITY
	int "GPIO 30 interrupt priority"
	default 1

config GPIO_FE310_31_PRIORITY
	int "GPIO 31 interrupt priority"
	default 1

endif # GPIO_FE310
```

## drivers/gpio/Kconfig.fxl6408
```kconfig
# Copyright (c) 2021 Abel Sensors
# SPDX-License-Identifier: Apache-2.0

menuconfig GPIO_FXL6408
	bool "FXL6408 I2C-based GPIO chip"
	default y
	depends on DT_HAS_FCS_FXL6408_ENABLED
	depends on I2C
	help
	  Enable driver for FXL6408 I2C-based GPIO chip.

config GPIO_FXL6408_INIT_PRIORITY
	int "Init priority"
	default 80
	depends on GPIO_FXL6408
	help
	  Device driver initialization priority.

module = FXL6408
module-str = fxl6408
source "subsys/logging/Kconfig.template.log_config"
```

## drivers/gpio/Kconfig.gd32
```kconfig
# Copyright (c) 2021 Teslabs Engineering S.L.
# SPDX-License-Identifier: Apache-2.0

config GPIO_GD32
	bool "GD32 GPIO driver"
	default y
	depends on DT_HAS_GD_GD32_GPIO_ENABLED
	select GD32_EXTI
	help
	  Enable the GD32 GPIO driver.
```

## drivers/gpio/Kconfig.gecko
```kconfig
# Gecko GPIO configuration options

# Copyright (c) 2017 Christian Taedcke
# SPDX-License-Identifier: Apache-2.0

menuconfig GPIO_GECKO
	bool "Gecko GPIO driver"
	default y
	depends on DT_HAS_SILABS_GECKO_GPIO_PORT_ENABLED
	select SOC_GECKO_GPIO
	help
	  Enable the Gecko gpio driver.

config GPIO_GECKO_COMMON_INIT_PRIORITY
	int "Common initialization priority"
	depends on GPIO_GECKO
	default 39
```

## drivers/gpio/Kconfig.gotham
```kconfig
#
# SPDX-License-Identifier: Apache-2.0
#

menuconfig GPIO_GOTHAM
	bool "Gotham SoC GPIO driver"
	depends on GPIO && SOC_RISCV32_GOTHAM
	default n
	help
	  Enable driver for the Gotham SoC GPIO controller.

	  Says n if not sure.

if GPIO_GOTHAM

config GPIO_GOTHAM_GPIO_NAME
	string "GPIO driver name"
	default "gpio0"

endif # GPIO_GOTHAM
```

## drivers/gpio/Kconfig.grgpio
```kconfig
# Copyright (c) 2023 Frontgrade Gaisler AB
# SPDX-License-Identifier: Apache-2.0

config GPIO_GRGPIO2
	bool "GRLIB GRGPIO revision 2"
	default y
	depends on DT_HAS_GAISLER_GRGPIO_ENABLED
	help
	  Enable driver for GRLIB GRGPIO revision 2.
```

## drivers/gpio/Kconfig.hc32
```kconfig
# Copyright (C) 2024-2025, Xiaohua Semiconductor Co., Ltd.
# SPDX-License-Identifier: Apache-2.0

config GPIO_HC32
	bool "GPIO Driver for HC32 MCUs"
	default y
	depends on DT_HAS_XHSC_HC32_GPIO_ENABLED
	select HC32_LL_GPIO
	help
	  Enable GPIO driver for HC32 line of MCUs
```
