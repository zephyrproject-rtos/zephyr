## drivers/gpio/Kconfig.sf32lb
```kconfig
# Copyright (c) 2025 Core Devices LLC
# SPDX-License-Identifier: Apache-2.0

config GPIO_SF32LB
	bool "SiFli SF32LB GPIO driver"
	default y
	depends on DT_HAS_SIFLI_SF32LB_GPIO_ENABLED
	help
	  Enable GPIO driver for SiFli SF32LB
```

## drivers/gpio/Kconfig.shakti
```kconfig
# Copyright (c) 2026 RISE Lab, IIT Madras
# SPDX-License-Identifier: Apache-2.0

config GPIO_SHAKTI
	bool "Shakti GPIO driver"
	default y
	depends on DT_HAS_SHAKTI_GPIO_ENABLED
	help
	  Enable the Shakti GPIO driver.
```

## drivers/gpio/Kconfig.si32
```kconfig
# Copyright (c) 2024 GARDENA GmbH
#
# SPDX-License-Identifier: Apache-2.0

config GPIO_SI32
	bool "GPIO driver for Si32 family of MCUs"
	default y
	depends on DT_HAS_SILABS_SI32_GPIO_ENABLED
	help
	  Enable GPIO driver for Si32 line of MCUs
```

## drivers/gpio/Kconfig.sifive
```kconfig
# SiFive Freedom GPIO configuration option

# Copyright (c) 2017 Jean-Paul Etienne <fractalclone@gmail.com>
# SPDX-License-Identifier: Apache-2.0

config GPIO_SIFIVE
	bool "SiFive Freedom Processor GPIO driver"
	depends on SOC_SERIES_RISCV_SIFIVE_FREEDOM
	help
	  Enable driver for the SiFive Freedom GPIO controller.

	  Says n if not sure.
```

## drivers/gpio/Kconfig.silabs
```kconfig
# Copyright (c) 2025 Silicon Laboratories Inc.
# SPDX-License-Identifier: Apache-2.0

menuconfig GPIO_SILABS
	bool "Silabs GPIO driver"
	default y
	depends on DT_HAS_SILABS_GPIO_ENABLED
	select SILABS_SISDK_GPIO
	help
	  Enable the Silabs gpio driver.

if GPIO_SILABS

config GPIO_SILABS_COMMON_INIT_PRIORITY
	int "Common initialization priority"
	default 39
	help
	  Main GPIO controller has to initialized before the GPIO themselves.
	  "GPIO_INIT_PRIORITY - 1" is usually the right value.

endif # GPIO_SILABS
```

## drivers/gpio/Kconfig.siwx91x
```kconfig
# Copyright (c) 2024 Silicon Laboratories Inc.
# SPDX-License-Identifier: Apache-2.0

menuconfig GPIO_SILABS_SIWX91X
	bool "Silabs SiWx91x GPIO driver"
	default y
	depends on DT_HAS_SILABS_SIWX91X_GPIO_ENABLED
	help
	  Enable the HP/ULP GPIO driver for the Silabs SiWx91x SoC series.

config GPIO_SILABS_SIWX91X_COMMON_INIT_PRIORITY
	int "Common initialization priority"
	depends on GPIO_SILABS_SIWX91X
	default 39

config GPIO_SILABS_SIWX91X_UULP
	bool "Silabs SiWx91x UULP GPIO driver"
	default y
	depends on DT_HAS_SILABS_SIWX91X_GPIO_UULP_ENABLED
	help
	  Enable the UULP GPIO driver for the Silabs SiWx91x SoC series.
```

## drivers/gpio/Kconfig.smartbond
```kconfig
# Copyright (c) 2022 Renesas Electronics Corporation
# SPDX-License-Identifier: Apache-2.0

config GPIO_SMARTBOND
	bool "Renesas SmartBond(tm) GPIO driver"
	default y
	depends on DT_HAS_RENESAS_SMARTBOND_GPIO_ENABLED
	select PM_DEVICE if PM
	help
	  Enable GPIO driver for Renesas SmartBond(tm) MCU family.
```

## drivers/gpio/Kconfig.sn74hc595
```kconfig
# Copyright (c) 2022 Matthias Freese
# SPDX-License-Identifier: Apache-2.0

config GPIO_SN74HC595
	bool "SN74HC595 shift register as GPIO extender"
	default y
	depends on DT_HAS_TI_SN74HC595_ENABLED
	depends on SPI
	help
	  Use SN74HC595 as GPIO extender

if GPIO_SN74HC595

config GPIO_SN74HC595_INIT_PRIORITY
	int "Init priority"
	default 71
	help
	  Device driver initialization priority.

endif
```

## drivers/gpio/Kconfig.stellaris
```kconfig
# Stellaris

# Copyright (c) 2018 Zilogic Systems
# SPDX-License-Identifier: Apache-2.0

config GPIO_STELLARIS
	bool "TI Stellaris GPIO Driver"
	default y
	depends on DT_HAS_TI_STELLARIS_GPIO_ENABLED
	help
	  Enable support for the Stellaris GPIO controllers.
```

## drivers/gpio/Kconfig.stm32
```kconfig
# STM32 GPIO configuration

# Copyright (c) 2016 Open-RnD Sp. z o.o.
# SPDX-License-Identifier: Apache-2.0

config GPIO_STM32
	bool "GPIO Driver for STM32 family of MCUs"
	default y
	depends on DT_HAS_ST_STM32_GPIO_ENABLED
	help
	  Enable GPIO driver for STM32 line of MCUs
```

## drivers/gpio/Kconfig.stmpe1600
```kconfig
# STMPE1600 GPIO configuration options

# Copyright (c) 2021 Titouan Christophe
# SPDX-License-Identifier: Apache-2.0

menuconfig GPIO_STMPE1600
	bool "STMPE1600 I2C-based GPIO chip"
	default y
	depends on DT_HAS_ST_STMPE1600_ENABLED
	depends on I2C
	help
	  Enable driver for STMPE1600 I2C-based GPIO chip.

config GPIO_STMPE1600_INIT_PRIORITY
	int "Init priority"
	default 70
	depends on GPIO_STMPE1600
	help
	  Device driver initialization priority.
```

## drivers/gpio/Kconfig.sx1509b
```kconfig
# SX1509B GPIO configuration options

# Copyright (c) 2018 Aapo Vienamo
# SPDX-License-Identifier: Apache-2.0

menuconfig GPIO_SX1509B
	bool "SX1509B I2C GPIO chip"
	default y
	depends on DT_HAS_SEMTECH_SX1509B_ENABLED
	select I2C
	help
	  Enable driver for SX1509B I2C GPIO chip.

if GPIO_SX1509B

config GPIO_SX1509B_INIT_PRIORITY
	int "Init priority"
	default 70
	help
	  Device driver initialization priority.

config GPIO_SX1509B_INTERRUPT
	bool "Interrupt enable"
	help
	  Enable support for interrupts on GPIO pins.

config GPIO_SX1509B_DEBOUNCE_TIME
	int "Debounce time interval"
	range 0 7
	default 0
	help
	  Debounce time interval when debounce enabled.

	  A value V produces a multiplier of 0.5 ms * 2^V, which is
	  then scaled by 2 MHz / fOSC.  See the datasheet for details.

endif # GPIO_SX1509B
```

## drivers/gpio/Kconfig.sy1xx
```kconfig
# Copyright (c) 2024 sensry.io
# SPDX-License-Identifier: Apache-2.0

config GPIO_SY1XX
	bool "SY1XX GPIO driver"
	default y
	depends on DT_HAS_SENSRY_SY1XX_GPIO_ENABLED
	help
	  Enable the SY1XX GPIO driver.
```

## drivers/gpio/Kconfig.syna_aon
```kconfig
# SPDX-FileCopyrightText: Copyright (c) 2026 Synaptics Incorporated
# SPDX-License-Identifier: Apache-2.0

config GPIO_SYNA_AON
	bool "Synaptics AON GPIO driver"
	default y
	depends on DT_HAS_SYNA_AON_GPIO_ENABLED
	help
	  Enable the Synaptics AON GPIO driver.
```

## drivers/gpio/Kconfig.tc3x
```kconfig
# Infineon TC4X GPIO configuration options

# Copyright (c) 2024 Infineon Technologies AG
# SPDX-License-Identifier: Apache-2.0

config GPIO_TC3X
	bool "Infineon TC3X GPIO driver"
	default y
	depends on DT_HAS_INFINEON_TC3X_GPIO_ENABLED
	help
	  Enable Infineon TC3X GPIO driver.
```

## drivers/gpio/Kconfig.tc4x
```kconfig
# Copyright (c) 2024 Infineon Technologies AG
# SPDX-License-Identifier: Apache-2.0

config GPIO_TC4X
	bool "Infineon TC4X GPIO driver"
	default y
	depends on DT_HAS_INFINEON_TC4X_GPIO_ENABLED
	help
	  Enable Infineon TC4X GPIO driver.
```

## drivers/gpio/Kconfig.tca6408a
```kconfig
# Copyright (c) 2020 Innoseis BV
# SPDX-License-Identifier: Apache-2.0


menuconfig GPIO_TCA6408A
	bool "TCA6408A I2C GPIO expander driver"
	depends on I2C
	help
		Enable TCA6408A GPIO expander driver


if GPIO_TCA6408A
	config GPIO_TCA6408A_INIT_PRIORITY
	int "Initialization priority of TCA6408A driver"
	default I2C_INIT_PRIORITY
endif
```

## drivers/gpio/Kconfig.tca6424a
```kconfig
# TCA6424A configuration options

# Copyright (c) 2022 Chromium OS Authors
# SPDX-License-Identifier: Apache-2.0

menuconfig GPIO_TCA6424A
	bool "TCA6424A driver"
	default y
	depends on DT_HAS_TI_TCA6424A_ENABLED
	depends on I2C
	help
	  Enable driver for TCA6424A IO expander chip.

config GPIO_TCA6424A_INIT_PRIORITY
	int "Init priority"
	default I2C_INIT_PRIORITY
	depends on GPIO_TCA6424A
	help
	  Device driver initialization priority.
```

## drivers/gpio/Kconfig.tca9538
```kconfig
# TCA9538 GPIO configuration options

# Copyright (c) 2018 Aapo Vienamo
# Copyright (c) 2021 Laird Connectivity
# SPDX-License-Identifier: Apache-2.0

# Workaround for not being able to have commas in macro arguments
DT_COMPAT_TI_TCA9538 := ti,tca9538

menuconfig GPIO_TCA9538
	bool "TCA9538 I2C GPIO chip"
	default $(dt_compat_enabled,$(DT_COMPAT_TI_TCA9538))
	depends on I2C
	help
	  Enable driver for TCA9538 I2C GPIO chip.

if GPIO_TCA9538

config GPIO_TCA9538_INIT_PRIORITY
	int "Init priority"
	default 70
	help
	  Device driver initialization priority.

endif # GPIO_TCA9538
```

## drivers/gpio/Kconfig.tca9554
```kconfig
# Copyright (c) 2026 Leica Geosystems AG
# SPDX-License-Identifier: Apache-2.0

config GPIO_TCA9554
	bool "Texas Instruments TCA9554 IO-Expander"
	default y
	depends on DT_HAS_TI_TCA9554_ENABLED
	depends on I2C
	help
	  Enable the driver implementation for the TCA9554

config GPIO_TCA9554_INIT_PRIO
	int "Init priority"
	default 70
	depends on GPIO_TCA9554
	help
	  Device driver initialization priority.
```

## drivers/gpio/Kconfig.tccvcp
```kconfig
# Copyright (c) 2024 Hounjoung Rim <hounjoung@tsnlab.com>
# SPDX-License-Identifier: Apache-2.0

config GPIO_TCCVCP
	bool "Telechips TOPST VCP SoC GPIO Driver"
	default y
	depends on DT_HAS_TCC_TCCVCP_GPIO_ENABLED
	help
	  Enable Driver for Telechips TOPST VCP SoC GPIO Banks.
```

## drivers/gpio/Kconfig.test
```kconfig
# Copyright (c) 2021, Commonwealth Scientific and Industrial Research
# Organisation (CSIRO) ABN 41 687 119 230.
# SPDX-License-Identifier: Apache-2.0

# Hidden option for turning on the dummy driver for vnd,gpio devices
# used in testing.
config GPIO_TEST
	def_bool DT_HAS_VND_GPIO_ENABLED
	depends on DT_HAS_VND_GPIO_ENABLED
```

## drivers/gpio/Kconfig.thejas32
```kconfig
# Copyright (c) 2026 Anuj Deshpande
# SPDX-License-Identifier: Apache-2.0

config GPIO_THEJAS32
	bool "C-DAC THEJAS32 GPIO driver"
	default y
	depends on DT_HAS_CDAC_THEJAS32_GPIO_ENABLED
	help
	  Enable the GPIO driver for the C-DAC THEJAS32 SoC.
```

## drivers/gpio/Kconfig.tla2528
```kconfig
# Copyright (c) 2026 Leica Geosystems AG
# SPDX-License-Identifier: Apache-2.0

config GPIO_TLA2528
	bool "Texas Instruments TLA2528 ADC with GPIOs"
	default y
	depends on DT_HAS_TI_TLA2528_GPIO_ENABLED
	select MFD
	help
	  Enable the gpio driver implementation for the TLA2528

config GPIO_TLA2528_INIT_PRIO
	int "Init priority"
	default 70
	depends on GPIO_TLA2528
	help
	  Device driver initialization priority.
	  Priority has to be lower (=higher value) than the TLA2528 mfd driver prio.
```

## drivers/gpio/Kconfig.tle9104
```kconfig
# TLE9104 GPIO configuration options

# Copyright (c) 2024 SILA Embedded Solutions GmbH
# SPDX-License-Identifier: Apache-2.0

menuconfig GPIO_TLE9104
	bool "TLE9104 SPI-based powertrain switch"
	default y
	depends on DT_HAS_INFINEON_TLE9104_GPIO_ENABLED
	select MFD
	help
	  Enable GPIO driver for TLE9104 SPI-based powertrain switch.

config GPIO_TLE9104_INIT_PRIORITY
	int "Init priority"
	default 75
	depends on GPIO_TLE9104
	help
	  Device driver initialization priority.
```
