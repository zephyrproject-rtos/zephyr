## drivers/gpio/Kconfig.tlx
```kconfig
# Copyright (c) 2024 Telink Semiconductor
# SPDX-License-Identifier: Apache-2.0

# Telink TLx-series GPIO configuration options

config GPIO_TELINK_TLX
	bool "Telink TLx-series GPIO driver"
	default y
	depends on DT_HAS_TELINK_TLX_GPIO_ENABLED
	help
	  Enables the TLx-series GPIO driver.
```

## drivers/gpio/Kconfig.tms570
```kconfig
# Copyright (c) 2025 ispace, inc.
# SPDX-License-Identifier: Apache-2.0

config GPIO_TMS570
	bool "TMS570 GPIO driver"
	default y
	depends on DT_HAS_TI_TMS570_GPIO_ENABLED
	help
	  Enable driver for the TI TMS570 GPIO controller.
```

## drivers/gpio/Kconfig.w91
```kconfig
# Copyright (c) 2024 Telink Semiconductor
# SPDX-License-Identifier: Apache-2.0

# Telink W91-series GPIO configuration options

config GPIO_TELINK_W91
	bool "Telink W91-series GPIO driver"
	default y
	depends on DT_HAS_TELINK_W91_GPIO_ENABLED && TELINK_W91_IPC_DISPATCHER
	help
		Enables the W91-series GPIO driver.
```

## drivers/gpio/Kconfig.wch_ch32v00x
```kconfig
# Copyright (c) 2024 Michael Hope
# SPDX-License-Identifier: Apache-2.0

config GPIO_WCH_GPIO
	bool "WCH CH32V00x GPIO driver"
	depends on DT_HAS_WCH_GPIO_ENABLED
	default y

config GPIO_WCH_GPIO_INTERRUPTS
	bool "Interrupt support"
	depends on GPIO_WCH_GPIO
	depends on DT_HAS_WCH_EXTI_ENABLED
	default y
	help
	  Support triggering an interrupt on pin change. Uses approximately
	  700 bytes of flash and 60 bytes of RAM.
```

## drivers/gpio/Kconfig.wch_ch5xx
```kconfig
# SPDX-FileCopyrightText: 2026 SMILE (smile.eu)
# SPDX-License-Identifier: Apache-2.0

config GPIO_WCH_CH5XX
	bool "WCH CH5xx GPIO driver"
	depends on DT_HAS_WCH_CH5XX_GPIO_ENABLED
	default y

config GPIO_WCH_CH5XX_INTERRUPTS
	bool "Interrupt support"
	depends on GPIO_WCH_CH5XX
	depends on DT_HAS_WCH_PFIC_ENABLED
	default y
	help
	  Support triggering an interrupt on pin change.
```

## drivers/gpio/Kconfig.xec
```kconfig
# Microchip XEC GPIO configuration options

# Copyright (c) 2019 Intel Corporation
# SPDX-License-Identifier: Apache-2.0

config GPIO_XEC
	bool "XEC Microchip GPIO driver"
	default y
	depends on DT_HAS_MICROCHIP_XEC_GPIO_ENABLED
	help
	  Enable the Microchip XEC gpio driver.
```

## drivers/gpio/Kconfig.xlnx
```kconfig
# Xilinx GPIO configuration options

# Copyright (c) 2020 Henrik Brix Andersen <henrik@brixandersen.dk>
# SPDX-License-Identifier: Apache-2.0

config GPIO_XLNX_AXI
	bool "Xilinx AXI GPIO driver"
	default y
	depends on DT_HAS_XLNX_XPS_GPIO_1_00_A_ENABLED
	help
	  Enable Xilinx AXI GPIO v2 driver.
```

## drivers/gpio/Kconfig.xlnx_ps
```kconfig
#
# Xilinx Processor System MIO / EMIO GPIO controller driver
# configuration options
#
# Copyright (c) 2022, Weidmueller Interface GmbH & Co. KG
# SPDX-License-Identifier: Apache-2.0
#

config GPIO_XLNX_PS
	bool "Xilinx Processor System MIO / EMIO GPIO controller driver"
	default y
	depends on DT_HAS_XLNX_PS_GPIO_ENABLED
	depends on !QEMU_TARGET
	help
	  Enable the Xilinx Processor System MIO / EMIO GPIO controller driver.
```

## drivers/gpio/Kconfig.xmc4xxx
```kconfig
# XMC4XXX GPIO configuration
#
# Copyright (c) 2022 Schlumberger
# SPDX-License-Identifier: Apache-2.0

config GPIO_XMC4XXX
	bool "XMC4XXX GPIO driver"
	default y
	depends on DT_HAS_INFINEON_XMC4XXX_GPIO_ENABLED
	help
	  Enable GPIO driver for XMC4XXX line of MCUs
```

## drivers/gpio/Kconfig.zephyr
```kconfig
# Copyright (c) 2022 Google LLC
# SPDX-License-Identifier: Apache-2.0

config GPIO_KEYS_ZEPHYR
	bool "Zephyr GPIO Keys"
	default y
	depends on DT_HAS_ZEPHYR_GPIO_KEYS_ENABLED
	help
	  Enable support for Zephyr GPIO Keys.
```

## drivers/gpu/Kconfig
```kconfig
# GPU driver configuration options

# Copyright (c) 2022, Basalte bv
# SPDX-License-Identifier: Apache-2.0

#
# GPU Drivers
#
menuconfig GPU
	bool "GPU hardware support"
	help
	  Enable support for the GPU.

if GPU

source "drivers/gpu/Kconfig.mcux_pxp"

endif # GPU
```

## drivers/gpu/Kconfig.mcux_pxp
```kconfig
# NXP MCUX PXP driver configuration options

# Copyright (c) 2022, Basalte bv
# SPDX-License-Identifier: Apache-2.0

config GPU_MCUX_PXP
	bool "NXP MCUX PXP driver"
	depends on HAS_MCUX_PXP
```

## drivers/graphic/Kconfig
```kconfig
# SPDX-FileCopyrightText: Copyright (c) 2026 STMicroelectronics
# SPDX-License-Identifier: Apache-2.0

menuconfig GRAPHIC_DRIVERS
	bool "Graphic drivers"
	help
	  Enable support for graphic drivers

if GRAPHIC_DRIVERS

module = GRAPHIC_DRIVERS
module-str = graphic_drivers
source "subsys/logging/Kconfig.template.log_config"

config GRAPHIC_INIT_PRIORITY
	int "Graphic initialization priority"
	default 60
	help
	  System initialization priority for graphic drivers.

# zephyr-keep-sorted-start
source "drivers/graphic/Kconfig.stm32_dma2d"
# zephyr-keep-sorted-stop

endif # GRAPHIC_DRIVERS
```

## drivers/graphic/Kconfig.stm32_dma2d
```kconfig
# STM32 DMA2D HW

# SPDX-FileCopyrightText: Copyright (c) 2026 STMicroelectronics
# SPDX-License-Identifier: Apache-2.0

config GRAPHIC_STM32_DMA2D
	bool "STM32 DMA2D HW graphic accelerator"
	default y
	depends on DT_HAS_ST_STM32_DMA2D_ENABLED
	select RESET
	select USE_STM32_HAL_DMA2D
	help
	  Enable driver for STM32 DMA2D graphic accelerator

config GRAPHIC_STM32_DMA2D_POOL_SIZE
	int "Operation pool size"
	default 4
	depends on GRAPHIC_STM32_DMA2D
	help
	  Size of the operation pool correspond to the amount
	  of operation allocated at the same time by the DMA2D
```

## drivers/graphics_accelerator/Kconfig
```kconfig
# Copyright (c) 2026 Silicon Signals Pvt. Ltd.
#
# SPDX-License-Identifier: Apache-2.0

config GRAPHICS_ACCELERATOR
	bool "Graphic accelerator drivers"
	help
		Enable graphic accelerator drivers.

if GRAPHICS_ACCELERATOR

config GRAPHICS_ACCELERATOR_INIT_PRIORITY
	int "graphic accelerator devices init priority"
	default 90
	help
		graphic accelerator devices initialization priority.

module = GRAPHICS_ACCELERATOR
module-str = graphics_accelerator
source "subsys/logging/Kconfig.template.log_config"

# zephyr-keep-sorted-start
source "drivers/graphics_accelerator/Kconfig.neocheom_gpu2d"
# zephyr-keep-sorted-stop

endif # GRAPHICS_ACCELERATOR
```

## drivers/graphics_accelerator/Kconfig.neochrom_gpu2d
```kconfig
# Copyright (c) 2026 Silicon Signals Pvt. Ltd.
#
# SPDX-License-Identifier: Apache-2.0

config NEOCHROM_GPU2D
	bool "STM32 NeoChrom GPU2D support"
	default y if DT_HAS_ST_NEOCHROM_GPU2D_ENABLED
	select RESET
	select USE_STM32_HAL_GPU2D
	help
	  Enable support for STM32 NeoChrom GPU2D accelerator.
	  This driver provides low-level access to the GPU2D hardware
	  and is used by NemaGFX for hardware-accelerated rendering.
```

## drivers/grove/Kconfig
```kconfig
# Kconfig - drivers configuration options for SeeedStudio Grove Devices

#
# Copyright (c) 2015 Intel Corporation
#
# SPDX-License-Identifier: Apache-2.0
#


menuconfig GROVE
	bool "Grove Device Drivers"
	help
	  Check this box to enable the Seeed Grove device drivers


config SYS_LOG_GROVE_LEVEL
	int "Grove Log level"
	depends on SYS_LOG && GROVE
	default 0
	range 0 4
	help
	  Sets log level for Grove Device Drivers.
	  Levels are:
	  0 OFF, do not write
	  1 ERROR, only write SYS_LOG_ERR
	  2 WARNING, write SYS_LOG_WRN in addition to previous level
	  3 INFO, write SYS_LOG_INF in addition to previous levels
	  4 DEBUG, write SYS_LOG_DBG in addition to previous levels

config GROVE_LCD_RGB
	bool "Enable the Seeed Grove LCD RGB Backlight"
	depends on GROVE
	help
	  Setting this value will enable driver support for the Groove-LCD RGB
	  Backlight.

config GROVE_LCD_RGB_I2C_MASTER_DEV_NAME
	string "I2C Master where Grove LCD is connected"
	depends on GROVE_LCD_RGB
	default "I2C_0"
	help
	  Specify the device name of the I2C master device to which the
	  Grove LCD is connected.

config GROVE_LIGHT_SENSOR
	bool "Enable the Seeed Grove Light Sensor"
	depends on SENSOR && GROVE && ADC && NEWLIB_LIBC
	help
	  Setting this value will enable driver support for the Grove Light
	  Sensor.

config GROVE_LIGHT_SENSOR_NAME
	string "Driver name"
	depends on GROVE_LIGHT_SENSOR
	default "GROVE_LIGHT_SENSOR"
	help
	  Specify the device name with which the sensor is identified.

config GROVE_LIGHT_SENSOR_ADC_DEV_NAME
	string "ADC where Grove Light Sensor is connected"
	depends on GROVE_LIGHT_SENSOR
	default "ADC_0"
	help
	  Specify the device name of the ADC to which the Grove Light Sensor
	  is connected.

config GROVE_LIGHT_SENSOR_ADC_CHANNEL
	int "ADC channel used by Grove Light Sensor"
	depends on GROVE_LIGHT_SENSOR
	default 10
	help
	  Specify the channel of the ADC to which the Grove Light Sensor is
	  connected.

config GROVE_TEMPERATURE_SENSOR
	bool "Enable the Seeed Grove Temperature Sensor"
	depends on SENSOR && GROVE && ADC && NEWLIB_LIBC
	help
	  Setting this value will enable driver support for the Grove
	  Temperature Sensor.

config GROVE_TEMPERATURE_SENSOR_NAME
	string "Driver name"
	depends on GROVE_TEMPERATURE_SENSOR
	default "GROVE_TEMPERATURE_SENSOR"
	help
	  Specify the device name with which the Grove Temperature Sensor
	  is identified.

choice
	prompt "Sensor version"
	depends on GROVE_TEMPERATURE_SENSOR
	default GROVE_TEMPERATURE_SENSOR_V1_0
	help
	  Choose the version of the Grove Temperature Sensor.

config GROVE_TEMPERATURE_SENSOR_V1_0
	bool "v1.0"
	help
	  Version 1.0

config GROVE_TEMPERATURE_SENSOR_V1_X
	bool "v1.1/v1.2"
	help
	  Version 1.1 or 1.2

endchoice

config GROVE_TEMPERATURE_SENSOR_ADC_DEV_NAME
	string "ADC where Grove Temperature Sensor is connected"
	depends on GROVE_TEMPERATURE_SENSOR
	default "ADC_0"
	help
	  Specify the device name of the ADC to which the Grove Temperature
	  Sensor is connected.

config GROVE_TEMPERATURE_SENSOR_ADC_CHANNEL
	int "ADC channel used by Grove Temperature Sensor"
	depends on GROVE_TEMPERATURE_SENSOR
	default 10
	help
	  Specify the channel of the ADC to which the Grove Temperature Sensor
	  is connected.
```

## drivers/haptics/Kconfig
```kconfig
# Copyright 2024 Cirrus Logic, Inc.
#
# SPDX-License-Identifier: Apache-2.0

menuconfig HAPTICS
	bool "Haptic feedback drivers"
	help
	  Enable haptics driver configuration.

if HAPTICS

module = HAPTICS
module-str = haptics
source "subsys/logging/Kconfig.template.log_config"

config HAPTICS_INIT_PRIORITY
	int "Haptic driver init priority"
	default 90
	help
	  Haptic driver initialization priority.

config HAPTICS_SHELL
	bool "Haptics shell"
	depends on SHELL
	help
	  Enable Haptics-related shell commands.

config HAPTICS_SHELL_BUFFER_SIZE
	int "Haptics shell buffer size"
	depends on HAPTICS_SHELL
	default 16
	help
	  Size of the buffer in bytes used when streaming samples to a haptic
	  driver. Note that the buffer is allocated on the stack.

# zephyr-keep-sorted-start
source "drivers/haptics/cirrus/Kconfig"
source "drivers/haptics/ti/Kconfig"
source "drivers/haptics/titanmec/Kconfig"
# zephyr-keep-sorted-stop

endif # HAPTICS
```

## drivers/haptics/Kconfig.cs40l50
```kconfig
# Copyright 2024 Cirrus Logic, Inc.
# SPDX-License-Identifier: Apache-2.0

config HAPTICS_CS40L50
	bool "CS40L50 Haptics Driver"
	default y
	depends on DT_HAS_CIRRUS_CS40L50_ENABLED
	select I2C
	help
	  Enable I2C-based driver for the Cirrus CS40L50 Haptics Driver.
```

## drivers/haptics/Kconfig.drv2605
```kconfig
# Copyright 2024 Cirrus Logic, Inc.
# SPDX-License-Identifier: Apache-2.0

config HAPTICS_DRV2605
	bool "DRV2605 Haptics Driver"
	default y
	depends on DT_HAS_TI_DRV2605_ENABLED
	select I2C
	help
	  Enable I2C-based driver for the Texas Instruments DRV2605 Haptics
	  Driver.
```

## drivers/haptics/cirrus/Kconfig
```kconfig
# Copyright (c) 2026 Cirrus Logic, Inc.
# SPDX-License-Identifier: Apache-2.0

# zephyr-keep-sorted-start
source "drivers/haptics/cirrus/Kconfig.cs40l26"
source "drivers/haptics/cirrus/Kconfig.cs40l5x"
source "drivers/haptics/cirrus/Kconfig.cs40lxx"
# zephyr-keep-sorted-stop
```

## drivers/haptics/cirrus/Kconfig.cs40l26
```kconfig
# Copyright 2026 Cirrus Logic, Inc.
# SPDX-License-Identifier: Apache-2.0

menuconfig HAPTICS_CS40L26
	bool "CS40L26/27 Haptics Driver"
	default y
	depends on DT_HAS_CIRRUS_CS40L26_ENABLED || \
		   DT_HAS_CIRRUS_CS40L27_ENABLED
	help
	  Enable CS40L26/27 haptics driver.

if HAPTICS_CS40L26

config HAPTICS_CS40L26_I2C
	def_bool $(dt_compat_on_bus,$(DT_COMPAT_CIRRUS_CS40L26),i2c) || \
		 $(dt_compat_on_bus,$(DT_COMPAT_CIRRUS_CS40L27),i2c)
	select I2C

config HAPTICS_CS40L26_SPI
	def_bool $(dt_compat_on_bus,$(DT_COMPAT_CIRRUS_CS40L26),spi) || \
		 $(dt_compat_on_bus,$(DT_COMPAT_CIRRUS_CS40L27),spi)
	select SPI

config HAPTICS_CS40L26_A1
	def_bool $(dt_compat_on_bus,$(DT_COMPAT_CIRRUS_CS40L26),i2c) || \
		 $(dt_compat_on_bus,$(DT_COMPAT_CIRRUS_CS40L26),spi)

config HAPTICS_CS40L27_B2
	def_bool $(dt_compat_on_bus,$(DT_COMPAT_CIRRUS_CS40L27),i2c) || \
		 $(dt_compat_on_bus,$(DT_COMPAT_CIRRUS_CS40L27),spi)

config HAPTICS_CS40L26_RESET
	def_bool $(dt_compat_any_has_prop,$(DT_COMPAT_CIRRUS_CS40L26),reset-gpios) || \
		 $(dt_compat_any_has_prop,$(DT_COMPAT_CIRRUS_CS40L27),reset-gpios)

config HAPTICS_CS40L26_INTERRUPT
	def_bool $(dt_compat_any_has_prop,$(DT_COMPAT_CIRRUS_CS40L26),int-gpios) || \
		 $(dt_compat_any_has_prop,$(DT_COMPAT_CIRRUS_CS40L27),int-gpios)

config HAPTICS_CS40L26_FLASH
	def_bool $(dt_compat_any_has_prop,$(DT_COMPAT_CIRRUS_CS40L26),flash-storage) || \
		 $(dt_compat_any_has_prop,$(DT_COMPAT_CIRRUS_CS40L27),flash-storage)

config HAPTICS_CS40L26_CALIBRATION
	bool "Calibration"
	default y
	help
	  Allow the device to run its calibration routine and optionally
	  write calibration data to flash memory if flash storage is provided.

config HAPTICS_CS40L26_CLICK_COMPENSATION
	bool "Click Compensation"
	default y
	help
	  Enable click compensation for haptic effects.

config HAPTICS_CS40L26_DYNAMIC_F0
	bool "Dynamic F0"
	default y
	help
	  Enable dynamic F0 compensation for haptic effects.

config HAPTICS_CS40L26_PM_ACTIVE_TIMEOUT
	int "Active Timeout"
	default 8000
	range 0 327680
	help
	  After the device has finished playing an effect, wait the specified amount
	  of time (in units of 1/32768 seconds) before entering the standby state.

config HAPTICS_CS40L26_PM_STDBY_TIMEOUT
	int "Standby Timeout"
	default 160000
	range 0 327680
	help
	  When the device enters the standby state with hibernation enabled, wait the
	  specified amount of time (in units of 1/32768 seconds) before entering hibernation.

endif #HAPTICS_CS40L26
```

## drivers/haptics/cirrus/Kconfig.cs40lxx
```kconfig
# Copyright 2026 Cirrus Logic, Inc.
# SPDX-License-Identifier: Apache-2.0

config HAPTICS_CS40LXX
	def_bool DT_HAS_CIRRUS_CS40L26_ENABLED || \
		 DT_HAS_CIRRUS_CS40L27_ENABLED || \
		 DT_HAS_CIRRUS_CS40L50_ENABLED || \
		 DT_HAS_CIRRUS_CS40L51_ENABLED || \
		 DT_HAS_CIRRUS_CS40L52_ENABLED || \
		 DT_HAS_CIRRUS_CS40L53_ENABLED

if HAPTICS_CS40LXX

config HAPTICS_CS40LXX_I2C
	def_bool $(dt_compat_on_bus,$(DT_COMPAT_CIRRUS_CS40L26),i2c) || \
		 $(dt_compat_on_bus,$(DT_COMPAT_CIRRUS_CS40L27),i2c) || \
		 $(dt_compat_on_bus,$(DT_COMPAT_CIRRUS_CS40L50),i2c) || \
		 $(dt_compat_on_bus,$(DT_COMPAT_CIRRUS_CS40L51),i2c) || \
		 $(dt_compat_on_bus,$(DT_COMPAT_CIRRUS_CS40L52),i2c) || \
		 $(dt_compat_on_bus,$(DT_COMPAT_CIRRUS_CS40L53),i2c)
	select I2C

config HAPTICS_CS40LXX_SPI
	def_bool $(dt_compat_on_bus,$(DT_COMPAT_CIRRUS_CS40L26),spi) || \
		 $(dt_compat_on_bus,$(DT_COMPAT_CIRRUS_CS40L27),spi) || \
		 $(dt_compat_on_bus,$(DT_COMPAT_CIRRUS_CS40L50),spi) || \
		 $(dt_compat_on_bus,$(DT_COMPAT_CIRRUS_CS40L51),spi) || \
		 $(dt_compat_on_bus,$(DT_COMPAT_CIRRUS_CS40L52),spi) || \
		 $(dt_compat_on_bus,$(DT_COMPAT_CIRRUS_CS40L53),spi)
	select SPI

endif #HAPTICS_CS40LXX
```

## drivers/haptics/ti/Kconfig
```kconfig
# Copyright (c) 2026 Cirrus Logic, Inc.
# SPDX-License-Identifier: Apache-2.0

# zephyr-keep-sorted-start
source "drivers/haptics/ti/Kconfig.drv2605"
# zephyr-keep-sorted-stop
```

## drivers/haptics/titanmec/Kconfig
```kconfig
# Copyright (c) 2026 Anuj Deshpande
# SPDX-License-Identifier: Apache-2.0

# zephyr-keep-sorted-start
source "drivers/haptics/titanmec/Kconfig.tm6605"
# zephyr-keep-sorted-stop
```
