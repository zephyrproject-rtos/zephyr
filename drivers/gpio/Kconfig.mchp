## drivers/gpio/Kconfig.mchp
```kconfig
# Copyright (c) 2025 Microchip Technology Inc.
# SPDX-License-Identifier: Apache-2.0

config GPIO_MCHP_PORT_G1
	bool "Microchip PORT G1 GPIO driver"
	default y
	depends on DT_HAS_MICROCHIP_PORT_G1_GPIO_ENABLED
	help
	  This option enables GPIO driver for group (g1) of PORT peripherals.
```

## drivers/gpio/Kconfig.mchp_dspic
```kconfig
# Copyright (c) 2025, Microchip Technology Inc.
# SPDX-License-Identifier: Apache-2.0

#Enable GPIO driver for dsPIC33A
config GPIO_DSPIC
	bool "dsPIC33A GPIO driver"
	default y
	depends on DT_HAS_MICROCHIP_DSPIC_GPIO_ENABLED
	help
	  Enable support for the dsPIC33A GPIO driver.
```

## drivers/gpio/Kconfig.mchp_mss
```kconfig
# Microchip PolarFire SoC Icicle Kit GPIO configuration options

# Copyright (c) 2022 Microchip Technology Inc.
# SPDX-License-Identifier: Apache-2.0

config GPIO_MCHP_MSS
	bool "Microchip PolarFire SoC GPIO driver"
	default y
	depends on DT_HAS_MICROCHIP_MPFS_GPIO_ENABLED
	help
	  Enable PolarFire SoC Icicle Kit GPIO driver.
```

## drivers/gpio/Kconfig.mcp23008
```kconfig
# MCP23008 I2C GPIO expander configuration options

# Copyright (c) 2020 Ioannis Papamanoglou
# SPDX-License-Identifier: Apache-2.0

menuconfig GPIO_MCP23008
	bool "MCP23008 I2C GPIO chip"
	depends on I2C
	help
	  Enable driver for MCP23008 I2C GPIO chip.

config GPIO_MCP23008_INIT_PRIORITY
	int "Init priority"
	depends on GPIO_MCP23008
	default 70
	help
	  Device driver initialization priority.
```

## drivers/gpio/Kconfig.mcp230xx
```kconfig
# MCP23S17 GPIO configuration options

# Copyright (c) 2021 metraTec GmbH
# SPDX-License-Identifier: Apache-2.0

# Workaround for not being able to have commas in macro arguments
DT_COMPAT_MICROCHIP_MCP23008 := microchip,mcp23008
DT_COMPAT_MICROCHIP_MCP23017 := microchip,mcp23017

menuconfig GPIO_MCP230XX
	bool "MCP230XX I2C-based GPIO chip"
	default $(dt_compat_enabled,$(DT_COMPAT_MICROCHIP_MCP23008)) || \
			$(dt_compat_enabled,$(DT_COMPAT_MICROCHIP_MCP23017))
	depends on I2C
	help
	  Enable driver for MCP230XX I2C-based GPIO chip.

if GPIO_MCP230XX

config GPIO_MCP230XX_INIT_PRIORITY
	int "Init priority"
	default 75
	help
	  Device driver initialization priority.

endif #GPIO_MCP230XX
```

## drivers/gpio/Kconfig.mcp23s17
```kconfig
# MCP23S17 GPIO configuration options

# Copyright (c) 2020 Geanix ApS
# SPDX-License-Identifier: Apache-2.0

menuconfig GPIO_MCP23S17
	bool "MCP23S17 SPI-based GPIO chip"
	default y
	depends on DT_HAS_MICROCHIP_MCP23S17_ENABLED
	depends on SPI
	help
	  Enable driver for MCP23S17 SPI-based GPIO chip.

if GPIO_MCP23S17

config GPIO_MCP23S17_INIT_PRIORITY
	int "Init priority"
	default 75
	help
	  Device driver initialization priority.

endif #GPIO_MCP23S17
```

## drivers/gpio/Kconfig.mcp23x17
```kconfig
# MCP23X17 GPIO configuration options

# Copyright (c) 2020 Geanix ApS
# Copyright (c) 2021 Prevas A/S
# SPDX-License-Identifier: Apache-2.0

menuconfig GPIO_MCP23X17
	bool "MCP23017/MCP23S17 GPIO expander chip"
	depends on (SPI || I2C)
	select HAS_DTS_GPIO
	help
	  Enable driver for MCP23017/MCP23S17 GPIO expander chip for either I2C or SPI.

if GPIO_MCP23X17

config GPIO_MCP23X17_INIT_PRIORITY
	int "Init priority"
	default 75
	help
	  Device driver initialization priority.

endif #GPIO_MCP23X17
```

## drivers/gpio/Kconfig.mcp23xxx
```kconfig
# MCP23S17 GPIO configuration options

# Copyright (c) 2021 metraTec GmbH
# SPDX-License-Identifier: Apache-2.0

config GPIO_MCP23XXX
	bool
	help
	  Enable support for the Microchip 23xxx I2C/SPI IO
	  expanders.

menuconfig GPIO_MCP230XX
	bool "MCP230XX I2C-based GPIO chip"
	default y
	depends on DT_HAS_MICROCHIP_MCP23008_ENABLED || \
	           DT_HAS_MICROCHIP_MCP23009_ENABLED || \
	           DT_HAS_MICROCHIP_MCP23016_ENABLED || \
	           DT_HAS_MICROCHIP_MCP23017_ENABLED || \
	           DT_HAS_MICROCHIP_MCP23018_ENABLED
	select I2C
	select GPIO_MCP23XXX
	help
	  Enable driver for MCP230XX I2C-based GPIO chip.

if GPIO_MCP230XX

config GPIO_MCP230XX_INIT_PRIORITY
	int "MCP230XX GPIO expander init priority"
	default I2C_INIT_PRIORITY
	help
	  Device driver initialization priority.

endif #GPIO_MCP230XX

menuconfig GPIO_MCP23SXX
	bool "MCP23SXX SPI-based GPIO chip"
	default y
	depends on DT_HAS_MICROCHIP_MCP23S08_ENABLED || \
	           DT_HAS_MICROCHIP_MCP23S09_ENABLED || \
	           DT_HAS_MICROCHIP_MCP23S17_ENABLED || \
	           DT_HAS_MICROCHIP_MCP23S18_ENABLED
	depends on SPI
	select GPIO_MCP23XXX
	help
	  Enable driver for MCP23SXX SPI-based GPIO chip.

if GPIO_MCP23SXX

config GPIO_MCP23SXX_INIT_PRIORITY
	int "MCP23SXX GPIO expander init priority"
	default 75
	help
	  Device driver initialization priority.

endif #GPIO_MCP23SXX
```

## drivers/gpio/Kconfig.mcux
```kconfig
# MCUX GPIO configuration options

# Copyright (c) 2016 Freescale Semiconductor, Inc.
# Copyright (c) 2017, NXP
# SPDX-License-Identifier: Apache-2.0

config GPIO_MCUX
	bool "MCUX GPIO driver"
	default y
	depends on DT_HAS_NXP_KINETIS_GPIO_ENABLED
	help
	  Enable the MCUX pinmux driver.
```

## drivers/gpio/Kconfig.mcux_igpio
```kconfig
# MCUX IGPIO configuration options

# Copyright (c) 2017, NXP
# SPDX-License-Identifier: Apache-2.0

config GPIO_MCUX_IGPIO
	bool "MCUX IGPIO driver"
	default y
	depends on HAS_MCUX_IGPIO
	depends on DT_HAS_NXP_IMX_GPIO_ENABLED
	select PINCTRL
	help
	  Enable the MCUX IGPIO driver.
```

## drivers/gpio/Kconfig.mcux_lpc
```kconfig
# MCUX LPC GPIO configuration options

# Copyright (c) 2017, NXP
# SPDX-License-Identifier: Apache-2.0

config GPIO_MCUX_LPC
	bool "MCUX LPC GPIO driver"
	default y
	depends on DT_HAS_NXP_LPC_GPIO_PORT_ENABLED
	select PINCTRL
	help
	  Enable the MCUX LPC pinmux driver.
```

## drivers/gpio/Kconfig.mcux_rgpio
```kconfig
# MCUX RGPIO configuration options

# Copyright 2023, NXP
# SPDX-License-Identifier: Apache-2.0

config GPIO_MCUX_RGPIO
	bool "MCUX RGPIO driver"
	default y
	depends on DT_HAS_NXP_IMX_RGPIO_ENABLED
	select PINCTRL
	help
	  Enable the MCUX RGPIO driver.
```

## drivers/gpio/Kconfig.mec5
```kconfig
# Microchip MEC5 GPIO configuration options

# Copyright (c) 2024 Microchip Technology Inc.
# SPDX-License-Identifier: Apache-2.0

config GPIO_MCHP_MEC5
	bool "Microchip MEC5 GPIO driver"
	default y
	depends on DT_HAS_MICROCHIP_MEC5_GPIO_ENABLED
	help
	  Enable the Microchip MEC5 gpio driver.
```

## drivers/gpio/Kconfig.mfxstm32l152
```kconfig
# MFXSTM32L152 GPIO configuration options

# Copyright (c) 2024 STMicroelectronics
# SPDX-License-Identifier: Apache-2.0

menuconfig GPIO_MFXSTM32L152
	bool "MFXSTM32L152 I2C-based GPIO chip"
	default y
	depends on DT_HAS_ST_MFXSTM32L152_ENABLED
	select I2C
	help
	  Enable driver for MFXSTM32L152 I2C-based GPIO chip.

config GPIO_MFXSTM32L152_INIT_PRIORITY
	int "Init priority"
	default 70
	depends on GPIO_MFXSTM32L152
	help
	  Device driver initialization priority.
```

## drivers/gpio/Kconfig.mmio
```kconfig
# Kconfig.mmio - MMIO-based GPIO configuration options
#
#
# Copyright (c) 2016 Intel Corporation
#
# Licensed under the Apache License, Version 2.0 (the "License");
# you may not use this file except in compliance with the License.
# You may obtain a copy of the License at
#
#     http://www.apache.org/licenses/LICENSE-2.0
#
# Unless required by applicable law or agreed to in writing, software
# distributed under the License is distributed on an "AS IS" BASIS,
# WITHOUT WARRANTIES OR CONDITIONS OF ANY KIND, either express or implied.
# See the License for the specific language governing permissions and
# limitations under the License.
#

menuconfig GPIO_MMIO
	bool "MMIO-based GPIO driver"
	depends on GPIO
	default n
	help
	  Enable driver for MMIO-based GPIOs.

if GPIO_MMIO

config GPIO_MMIO_INIT_PRIORITY
	int
	depends on GPIO_MMIO
	default 60
	prompt "Init priority"
	help
	  Device driver initialization priority.

config GPIO_MMIO_0
	bool "MMIO-based GPIO Port #0"
	depends on GPIO_MMIO
	default n
	help
	  Enable config options for MMIO-based GPIO port #0.

config GPIO_MMIO_0_DEV_NAME
	string "MMIO-based GPIO Port #0 Device Name"
	depends on GPIO_MMIO_0
	default "GPIO_0"
	help
	  Specify the device name.

choice
	prompt "MMIO-based GPIO Port #0 Access Method"
	default GPIO_MMIO_0_ACCESS_MM
	depends on GPIO_MMIO_0

config GPIO_MMIO_0_ACCESS_MM
	bool "Direct Memory Access"

config GPIO_MMIO_0_ACCESS_IO
	bool "I/O Port"

endchoice

config GPIO_MMIO_0_CFG
	hex "MMIO-based GPIO Port #0 Configuration"
	depends on GPIO_MMIO_0
	default 0x0
	help
	  Configuration for this GPIO port.

	  Refer to <drivers/gpio/gpio-mmio.h> for more information.

config GPIO_MMIO_0_EN
	hex "MMIO-based GPIO Port #0 Enable Register Address"
	depends on GPIO_MMIO_0
	default 0x0
	help
	  The memory address for enable register.

config GPIO_MMIO_0_DIR
	hex "MMIO-based GPIO Port #0 Direction Register Address"
	depends on GPIO_MMIO_0
	default 0x0
	help
	  The memory address for direction register.

config GPIO_MMIO_0_INPUT
	hex "MMIO-based GPIO Port #0 Input Pin Level Register Address"
	depends on GPIO_MMIO_0
	default 0x0
	help
	  The memory address for input pin level register.

config GPIO_MMIO_0_OUTPUT
	hex "MMIO-based GPIO Port #0 Output Pin Level Register Address"
	depends on GPIO_MMIO_0
	default 0x0
	help
	  The memory address for output pin level register.

config GPIO_MMIO_1
	bool "MMIO-based GPIO Port #1"
	depends on GPIO_MMIO
	default n
	help
	  Enable config options for MMIO-based GPIO port #1.

config GPIO_MMIO_1_DEV_NAME
	string "MMIO-based GPIO Port #1 Device Name"
	depends on GPIO_MMIO_1
	default "GPIO_1"
	help
	  Specify the device name.

choice
	prompt "MMIO-based GPIO Port #1 Access Method"
	default GPIO_MMIO_1_ACCESS_MM
	depends on GPIO_MMIO_1

config GPIO_MMIO_1_ACCESS_MM
	bool "Direct Memory Access"

config GPIO_MMIO_1_ACCESS_IO
	bool "I/O Port"

endchoice

config GPIO_MMIO_1_CFG
	hex "MMIO-based GPIO Port #1 Configuration"
	depends on GPIO_MMIO_1
	default 0x0
	help
	  Configuration for this GPIO port.

	  Refer to <drivers/gpio/gpio-mmio.h> for more information.

config GPIO_MMIO_1_EN
	hex "MMIO-based GPIO Port #1 Enable Register Address"
	depends on GPIO_MMIO_1
	default 0x0
	help
	  The memory address for enable register.

config GPIO_MMIO_1_DIR
	hex "MMIO-based GPIO Port #1 Direction Register Address"
	depends on GPIO_MMIO_1
	default 0x0
	help
	  The memory address for direction register.

config GPIO_MMIO_1_INPUT
	hex "MMIO-based GPIO Port #1 Input Pin Level Register Address"
	depends on GPIO_MMIO_1
	default 0x0
	help
	  The memory address for input pin level register.

config GPIO_MMIO_1_OUTPUT
	hex "MMIO-based GPIO Port #1 Output Pin Level Register Address"
	depends on GPIO_MMIO_1
	default 0x0
	help
	  The memory address for output pin level register.

endif # GPIO_MMIO
```

## drivers/gpio/Kconfig.mmio32
```kconfig
# Copyright (c) 2017 Linaro Ltd.
# SPDX-License-Identifier: Apache-2.0

config GPIO_MMIO32
	bool
	help
	  This is a driver for accessing a simple, fixed purpose, 32-bit
	  memory-mapped i/o register using the same APIs as GPIO drivers. This
	  is useful when an SoC or board has registers that aren't part of a
	  GPIO IP block and these registers are used to control things that
	  Zephyr normally expects to be specified using a GPIO pin, e.g. for
	  driving an LED, or chip-select line for an SPI device.
```

## drivers/gpio/Kconfig.mmio_latch
```kconfig
# Copyright (c) 2026 Zhaoming Li
# SPDX-License-Identifier: Apache-2.0

config GPIO_MMIO_LATCH
	bool "Memory-mapped latch GPIO driver"
	default y
	depends on DT_HAS_GPIO_MMIO_LATCH_ENABLED
	help
	  Enable support for a generic GPIO controller implemented as a
	  memory-mapped output latch register.
```

## drivers/gpio/Kconfig.msp432p4xx
```kconfig
# MSP432P4XX GPIO configuration options

# SPDX-License-Identifier: Apache-2.0

config GPIO_MSP432PXX
	bool "TI CC32XX GPIO driver"
	default y
	depends on DT_HAS_TI_MSP432P4XX_GPIO_ENABLED
	help
	  Enable the GPIO driver on TI SimpleLink MSP432P4XX boards
```

## drivers/gpio/Kconfig.mspm0
```kconfig
# TI MSPM0 GPIO configuration options

# Copyright (c) 2025 Texas Instruments
# SPDX-License-Identifier: Apache-2.0

config GPIO_MSPM0
	bool "TI MSPM0 GPIO driver"
	default y
	depends on DT_HAS_TI_MSPM0_GPIO_ENABLED
	select USE_MSPM0_DL_GPIO
	help
	  Enable the TI MSPM0 GPIO driver.
```

## drivers/gpio/Kconfig.mspm0g3xxx
```kconfig
# TI MSPM0G3XXX GPIO configuration options

# Copyright (c) 2024 Texas Instruments
# SPDX-License-Identifier: Apache-2.0

config GPIO_MSPM0G3XXX
	bool "TI SimpleLink MSPM0G3XXX GPIO driver"
	default y
	depends on DT_HAS_TI_MSPM0G3XXX_GPIO_ENABLED
	help
	  Enable the TI MSPM0G3XXX GPIO driver.
```

## drivers/gpio/Kconfig.nct
```kconfig
# NPCX GPIO driver configuration options

# Copyright (c) 2024 Nuvoton Technology Corporation.
# SPDX-License-Identifier: Apache-2.0

config GPIO_NCT
	bool "Nuvoton NCT enhance Super I/O (eSIO) gpio driver"
	default y
	depends on DT_HAS_NUVOTON_NCT_GPIO_ENABLED
	help
	  This option enables the GPIO driver for NCT family of
	  processors.
	  Say y if you wish to use serial port on NCT MCU.
```

## drivers/gpio/Kconfig.neorv32
```kconfig
# NEORV32 GPIO configuration options

# Copyright (c) 2021 Henrik Brix Andersen <henrik@brixandersen.dk>
# SPDX-License-Identifier: Apache-2.0

config GPIO_NEORV32
	bool "NEORV32 GPIO driver"
	default y
	depends on DT_HAS_NEORV32_GPIO_ENABLED
	depends on SYSCON
	help
	  Enable NEORV32 GPIO driver.
```

## drivers/gpio/Kconfig.npcm
```kconfig
# NPCX GPIO driver configuration options

# Copyright (c) 2024 Nuvoton Technology Corporation.
# SPDX-License-Identifier: Apache-2.0

config GPIO_NPCM
	bool "Nuvoton NPCM enhance Super I/O (eSIO) gpio driver"
	default y
	depends on DT_HAS_NUVOTON_NPCM_GPIO_ENABLED
	help
	  This option enables the GPIO driver for NPCM family of
	  processors.
	  Say y if you wish to use serial port on NPCM MCU.
```

## drivers/gpio/Kconfig.npcx
```kconfig
# NPCX GPIO driver configuration options

# Copyright (c) 2020 Nuvoton Technology Corporation.
# SPDX-License-Identifier: Apache-2.0

config GPIO_NPCX
	bool "Nuvoton NPCX embedded controller (EC) gpio driver"
	default y
	depends on DT_HAS_NUVOTON_NPCX_GPIO_ENABLED
	help
	  This option enables the GPIO driver for NPCX family of
	  processors.
	  Say y if you wish to use serial port on NPCX MCU.
```

## drivers/gpio/Kconfig.npm10xx
```kconfig
# Copyright (c) 2026 Nordic Semiconductor ASA
# SPDX-License-Identifier: Apache-2.0

config GPIO_NPM10XX
	bool "nPM10xx GPIO driver"
	default y
	depends on DT_HAS_NORDIC_NPM10XX_GPIO_ENABLED
	select I2C
	help
	  Enable the nPM10xx GPIO driver.

config GPIO_NPM10XX_INIT_PRIORITY
	int "nPM10xx GPIO driver initialization priority"
	depends on GPIO_NPM10XX
	default 85
	help
	  Initialization priority for the nPM10xx GPIO driver. It must be
	  greater than the I2C controller init priority.
```
