## drivers/gpio/Kconfig.rockchip
```kconfig
# SPDX-FileCopyrightText: Copyright (c) 2026 Process Mission
# SPDX-License-Identifier: Apache-2.0

config GPIO_ROCKCHIP
	bool "Rockchip RK3588 GPIO driver"
	default y
	depends on DT_HAS_ROCKCHIP_RK3588_GPIO_ENABLED
	help
	  Enable the Rockchip RK3588 GPIO controller driver.
```

## drivers/gpio/Kconfig.sc18is60x
```kconfig
# Copyright (c) 2026 Alif Semiconductor
# SPDX-License-Identifier: Apache-2.0

config GPIO_SC18IS60X
	bool "NXP SC18IS602/SC18IS606 GPIO Controller driver"
	default y
	select MFD
	depends on DT_HAS_NXP_SC18IS60X_GPIO_ENABLED
	help
	  Enables NXP SC18IS60x gpio controller driver

config GPIO_SC18IS60X_INIT_PRIORITY
	int "SC18IS60x GPIO Init Priority"
	default MFD_INIT_PRIORITY
	depends on GPIO_SC18IS60X
	help
	  SC18IS60x GPIO controller init priority.

	  The controller and the MFD parent both use POST_KERNEL. The same
	  priority as MFD_INIT_PRIORITY is enough, because the parent is
	  initialized first. A higher value delays devices that use these pins.
```

## drivers/gpio/Kconfig.tps6521x
```kconfig
# SPDX-FileCopyrightText: Copyright The Zephyr Project Contributors
# SPDX-License-Identifier: Apache-2.0

config GPIO_TPS6521X
	bool "TI TPS65214/TPS65215 PMIC GPIO driver"
	default y
	depends on DT_HAS_TI_TPS6521X_GPIO_ENABLED
	select MFD
	help
	  Enable the GPIO driver for the GPO and GPIO pins of the TI TPS65214
	  and TPS65215 PMICs.

config GPIO_TPS6521X_INIT_PRIORITY
	int "TPS6521x GPIO driver init priority"
	default 85
	depends on GPIO_TPS6521X
	help
	  Init priority for the TPS6521x GPIO driver. It must be greater than
	  MFD_INIT_PRIORITY.
```

## drivers/gpio/Kconfig.vni8200xp
```kconfig
# Copyright (c) 2026 Sebastian Balling
# SPDX-License-Identifier: Apache-2.0

config GPIO_VNI8200XP
	bool "ST VNI8200XP octal high-side switch"
	default y
	depends on DT_HAS_ST_VNI8200XP_ENABLED
	depends on SPI
	help
	  GPIO driver for the ST VNI8200XP octal high-side power switch
	  (8 digital outputs, 16-bit SPI frames with parity).

config GPIO_VNI8200XP_INIT_PRIORITY
	int "VNI8200XP init priority"
	default 75
	depends on GPIO_VNI8200XP
	help
	  Device driver initialization priority. Must be higher than
	  SPI_INIT_PRIORITY.
```

## drivers/hwinfo/Kconfig.rockchip
```kconfig
# SPDX-FileCopyrightText: Copyright The Zephyr Project Contributors
# SPDX-License-Identifier: Apache-2.0

config HWINFO_RK3588
	bool "Rockchip RK3588 device ID"
	default y
	depends on SOC_RK3588
	depends on DT_HAS_ROCKCHIP_RK3588_OTP_ENABLED
	select HWINFO_HAS_DRIVER
	help
	  Enable Rockchip RK3588 hwinfo driver via OTP.
```

## drivers/i2s/Kconfig.ameba
```kconfig
# AMEBA I2S driver configuration options

# Copyright (c) 2026 Realtek Semiconductor Corp.
# SPDX-License-Identifier: Apache-2.0

menuconfig I2S_AMEBA
	bool "AMEBA MCU I2S controller driver"
	default y
	depends on DT_HAS_REALTEK_AMEBA_I2S_ENABLED
	select PINCTRL
	select DMA
	help
	  Enable I2S support on the AMEBA family of processors.

if I2S_AMEBA

config I2S_AMEBA_RX_BLOCK_COUNT
	int "RX queue length"
	default 4

config I2S_AMEBA_TX_BLOCK_COUNT
	int "TX queue length"
	default 4

config I2S_AMEBA_CHANNEL_EXT
	bool "AMEBA I2S controller support for more channels"
	help
	  Enable I2S support for 6~8 channels

config I2S_AMEBA_CHANNEL_EXT_MAX_BLOCK_SIZE
	int "Largest block size with more than 4 channels"
	depends on I2S_AMEBA_CHANNEL_EXT
	default 4096
	help
	  With 5 to 8 channels the samples are split over two FIFOs, and each
	  block is reordered through a static scratch buffer of two thirds of
	  this size per direction. Configuring such a stream with a larger
	  block_size fails. 1 to 4 channels use a single FIFO, need no reorder
	  and are not limited by this option.

endif # I2S_AMEBA
```

## drivers/i2s/Kconfig.nrfx
```kconfig
# Copyright (c) 2021 Nordic Semiconductor ASA
# SPDX-License-Identifier: Apache-2.0

menuconfig I2S_NRFX
	bool "nRF I2S nrfx driver"
	default y
	depends on DT_HAS_NORDIC_NRF_I2S_ENABLED
	select NRFX_I2S
	select PINCTRL
	help
	  Enable support for nrfx I2S driver for nRF MCU series.

if I2S_NRFX

config I2S_NRFX_RX_BLOCK_COUNT
	int "RX queue length"
	default 4

config I2S_NRFX_TX_BLOCK_COUNT
	int "TX queue length"
	default 4

config I2S_NRFX_ALLOW_MCK_BYPASS
	bool "Allow MCK bypass if a ratio exists"
	depends on SOC_SERIES_NRF53
	help
	  Search for a supported ratio directly from MCK and LRCK
	  and enable bypass if a ratio exists. If not, fallback to
	  the standard MCK selection mechanism.

endif # I2S_NRFX

menuconfig I2S_NRF_TDM
	bool "nRF TDM driver"
	default y
	depends on DT_HAS_NORDIC_NRF_TDM_ENABLED
	select CLOCK_CONTROL
	select PINCTRL
	help
	  Enable support for TDM driver for nRF MCU series.

if I2S_NRF_TDM

config I2S_NRF_TDM_RX_BLOCK_COUNT
	int "RX queue length"
	default 4

config I2S_NRF_TDM_TX_BLOCK_COUNT
	int "TX queue length"
	default 4

config I2S_NRF_TDM_CHANNEL_MASK_WORKAROUND
	bool "Duplex channel masking workaround"
	default y
	help
	  In duplex with channel masking, when TX finishes each block before
	  RX, the TDM transmits the CONFIG.ORS value instead of TX data after
	  each buffer switch, and when TX starts after RX, TX data moves to
	  other slots. This was measured on nRF54H20.

	  Compensate when TX starts no later than RX, or ends on the same
	  channel as RX. i2s_configure() returns -EINVAL for a direction whose
	  channel mask, together with the mask of the other configured
	  direction, gives a layout that cannot be compensated: TX starting
	  after RX within the RX channel range without ending on the last RX
	  channel. When changing the masks of both directions, unconfigure
	  them first (frame_clk_freq of 0) so that the old mask of one
	  direction is not checked against the new mask of the other.

endif # I2S_NRF_TDM
```

## drivers/i2s/Kconfig.silabs_usart
```kconfig
# Copyright (c) 2026 Silicon Laboratories Inc.
# SPDX-License-Identifier: Apache-2.0

menuconfig I2S_SILABS_USART
	bool "Silicon Labs USART I2S (Series 2)"
	default y
	depends on DT_HAS_SILABS_USART_I2S_ENABLED
	depends on DT_HAS_SILABS_LDMA_ENABLED
	depends on CLOCK_CONTROL
	select DMA
	select PINCTRL
	select SILABS_SISDK_USART
	help
	  I2S over USART synchronous mode with I2SCTRL enabled (Series 2+ and
	  similar). Audio data is transferred using the SoC LDMA controller
	  (requires ``dmas`` / ``dma-names`` on the USART I2S devicetree node).
	  TX (stereo and mono) and stereo RX are supported with a
	  ``word_size`` of 16, in 16-bit slots (W16D16) or, with the
	  ``silabs,slot-width`` devicetree property set to 32, in 32-bit
	  slots (W32D16). On this USART master, BCLK/LRCLK run
	  only while TX is shifting; while RX is running without TX data the
	  driver shifts silence to keep the bus clocked.
	  ``i2s_configure()`` must set ``I2S_OPT_BIT_CLK_GATED``
	  (``I2S_OPT_BIT_CLK_CONT`` returns ``-EINVAL``).

if I2S_SILABS_USART

config I2S_SILABS_USART_TX_BLOCK_COUNT
	int "TX queue depth (memory blocks)"
	default 4
	range 2 16

config I2S_SILABS_USART_RX_BLOCK_COUNT
	int "RX queue depth (memory blocks)"
	default 4
	range 2 16
	help
	  Number of completed RX blocks the driver may hold for i2s_read().

endif # I2S_SILABS_USART
```

## drivers/i2s/Kconfig.ti_mcasp
```kconfig
# SPDX-FileCopyrightText: Copyright The Zephyr Project Contributors
# SPDX-License-Identifier: Apache-2.0

menuconfig I2S_TI_MCASP
	bool "TI McASP I2S driver"
	default y
	depends on DT_HAS_TI_AM33XX_MCASP_AUDIO_ENABLED
	select CLOCK_CONTROL
	select PINCTRL
	help
	  Enable the I2S driver for the TI Multichannel Audio Serial Port
	  (McASP) of the TI AM62L, whose clock is an SCMI clock with one cell.
	  By default the CPU moves the data from interrupts; I2S_TI_MCASP_DMA
	  moves it with the DMA instead.

if I2S_TI_MCASP

config I2S_TI_MCASP_AFIFO
	bool "Move data through the McASP audio FIFO"
	default y
	help
	  Feed the 64-word write and read FIFOs through the DATA port from a
	  start-of-frame interrupt. A stream then survives interrupts masked
	  for up to 64 words per direction (about 0.6 ms at 48 kHz stereo on
	  one serializer). A frame may hold at most 32 words. Without it, the
	  data-ready interrupt of every slot moves one word, and a delay of one
	  slot is an underrun or overrun.

config I2S_TI_MCASP_DMA
	bool "Move data with the DMA [EXPERIMENTAL]"
	depends on I2S_TI_MCASP_AFIFO
	select DMA
	select EXPERIMENTAL
	help
	  Move the blocks between memory and the audio FIFO with the DMA
	  channels named "tx" and "rx" in the dmas property, one AFIFO event
	  per frame. A direction uses DMA when it starts together with the
	  serial port; a direction started while the other one runs, and the
	  tail after the last DMA block, use the interrupt path. Instances
	  without dmas use the interrupt path, and so does RX when its slab
	  blocks are not aligned to the 64-byte cache line, because the
	  driver invalidates them.

config I2S_TI_MCASP_TX_BLOCK_COUNT
	int "TX queue length"
	default 8
	help
	  Number of memory blocks the TX queue holds.

config I2S_TI_MCASP_RX_BLOCK_COUNT
	int "RX queue length"
	default 8
	help
	  Number of received memory blocks the RX queue holds until they are
	  read.

endif # I2S_TI_MCASP
```

## drivers/input/Kconfig.mcux_tsi
```kconfig
# Copyright 2026 NXP
# SPDX-License-Identifier: Apache-2.0

config INPUT_MCUX_TSI
	bool "NXP TSI input driver"
	default y
	depends on DT_HAS_NXP_TSI_INPUT_ENABLED
	help
	  Enable input driver for NXP TSI (Touch Sensing Input).
	  This driver reports touch events through the input subsystem.

choice INPUT_MCUX_TSI_VERSION
	prompt "NXP TSI IP version"
	default INPUT_MCUX_TSI_V5 if SOC_FAMILY_KINETIS
	default INPUT_MCUX_TSI_V6
	depends on INPUT_MCUX_TSI

config INPUT_MCUX_TSI_V5
	bool "TSI version 5"

config INPUT_MCUX_TSI_V6
	bool "TSI version 6"

endchoice
```

## drivers/input/Kconfig.tps6521x
```kconfig
# SPDX-FileCopyrightText: Copyright The Zephyr Project Contributors
# SPDX-License-Identifier: Apache-2.0

config INPUT_TPS6521X
	bool "TI TPS65214/TPS65215 PMIC power button"
	default y
	depends on DT_HAS_TI_TPS6521X_POWER_BUTTON_ENABLED
	select MFD
	help
	  Enable the power-button input driver of the TI TPS65214 and
	  TPS65215 PMICs. It reports press and release events from the
	  INT_PB register and needs int-gpios on the PMIC node.
```

## drivers/interrupt_controller/Kconfig.brcm
```kconfig
# Copyright (c) 2026 Jonathan Elliot Peace <jep@alphabetiq.com>
# SPDX-License-Identifier: Apache-2.0

config BCM2836_L1_INTC
	bool "BCM2836 ARM-local interrupt controller"
	default y
	depends on DT_HAS_BRCM_BCM2836_L1_INTC_ENABLED
	help
	  Driver for the BCM2836 ARM-local interrupt controller (also
	  present on BCM2710 / Pi Zero 2 W). Routes per-core ARM
	  generic timer IRQs, four mailbox IRQs per core, the per-core
	  PMU IRQ, and the cascaded GPU IRQ to the parent controller of
	  the ARM CPU IRQ line.

config BCM2835_ARMCTRL_IC
	bool "BCM2835 ARMC peripheral interrupt controller"
	default y
	depends on DT_HAS_BRCM_BCM2835_ARMCTRL_IC_ENABLED
	help
	  Driver for the BCM2835 ARMC peripheral interrupt controller --
	  the "GPU IRQ" side of the BCM283x family. On BCM2710 (Pi Zero
	  2 W) it cascades under the BCM2836 ARM-local intc; on BCM2835
	  (Pi 1 / Pi Zero W) it is the root controller wired directly to
	  the ARM core IRQ line.

config BCM2712_MIP
	bool "Broadcom BCM2712 MSI-X Interrupt Peripheral (MIP)"
	default y
	depends on DT_HAS_BRCM_BCM2712_MIP_ENABLED
	select MSI_PROXY
	help
	  Driver for the Broadcom BCM2712 MSI-X Interrupt Peripheral (MIP).
	  The MIP converts endpoint MSI writes into host interrupts and is
	  consumed through the generic MSI proxy API.

config BCM2712_MIP_INIT_PRIORITY
	int "BCM2712 MIP init priority"
	default 40
	depends on BCM2712_MIP
	help
	  Initialisation priority of the Broadcom BCM2712 MSI-X Interrupt
	  Peripheral (MIP). It must run before the RP1 interrupt controller.

config RP1_IRQ
	bool "Raspberry Pi RP1 MSI-X interrupt controller"
	default y
	depends on DT_HAS_RASPBERRYPI_RP1_INTC_ENABLED
	depends on PCIE && MSI_PROXY
	help
	  Driver for the interrupt controller of the RP1 PCIe south
	  bridge found on the Raspberry Pi 5. The driver programs one
	  MSI-X vector per internal source using messages supplied by
	  an MSI proxy. The platform controls the host interrupt path.

config RP1_IRQ_INIT_PRIORITY
	int "RP1 interrupt controller init priority"
	default 42
	depends on RP1_IRQ
	help
	  Initialisation priority of the RP1 interrupt controller. It
	  must run after the PCIe root complex (CONFIG_PCIE_INIT_PRIORITY)
	  because it reads the RP1 configuration space, and before the
	  serial drivers that enable RP1 UART interrupts.
```

## drivers/interrupt_controller/Kconfig.npcm
```kconfig
# NPCM MIWU driver configuration options

# Copyright (c) 2026 Nuvoton Technology Corporation.
# SPDX-License-Identifier: Apache-2.0

config NPCM_MIWU
	bool "Nuvoton NPCM Multi-Input Wake-Up Unit (MIWU) driver"
	default y
	depends on DT_HAS_NUVOTON_NPCM_MIWU_ENABLED
	help
	  This option enables the Multi-Input Wake-Up Unit (MIWU) driver
	  for NPCM family of processors. The MIWU is an interrupt
	  controller in front of the NVIC. It detects events on its
	  wake-up inputs and forwards them to the NVIC as group
	  interrupts.
```

## drivers/interrupt_controller/Kconfig.ti_sci_intr
```kconfig
# Copyright (c) 2026 Dhruv Menon <dhruvmenon1104@gmail.com>
# SPDX-License-Identifier: Apache-2.0

config TI_SCI_INTR
	bool "TI K3 TISCI Interrupt Router"
	default y
	depends on DT_HAS_TI_SCI_INTR_ENABLED
	depends on DT_HAS_TI_SCI_INTR_OUT_ENABLED
	depends on TISCI
	depends on SYS_CLOCK_EXISTS
	depends on GEN_SW_ISR_TABLE
	depends on TI_VIM
	select MULTI_LEVEL_INTERRUPTS
	select 2ND_LEVEL_INTERRUPTS
	help
	  Let peripherals on TI K3 use an interrupt router the same way they
	  use any other interrupt parent: IRQ_CONNECT and irq_enable.

	  Turn this on when the board or SoC describes a ti,sci-intr router
	  with ti,sci-intr-out outputs (for example the MAIN or MCU GPIO mux
	  routers on J722S). The SoC or board must also set up the usual
	  multilevel IRQ layout for those outputs.

if TI_SCI_INTR

config TI_SCI_INTR_WORKQ_INIT_PRIORITY
	int
	default 41
	help
	  POST_KERNEL priority for starting the router workqueue.
	  Must be greater than INTC_INIT_PRIORITY so the workqueue starts
	  after the router device (INTC_INIT_PRIORITY defaults to 40).

endif # TI_SCI_INTR
```

## drivers/led/Kconfig.lp5815
```kconfig
# Copyright (c) 2026 Kristina Kisiuk, Aliensense
# SPDX-License-Identifier: Apache-2.0

config LP5815
	bool "LP5815 LED driver"
	default y
	depends on DT_HAS_TI_LP5815_ENABLED
	select I2C
	help
	  Enable the driver for the Texas Instruments LP5815, a 3-channel
	  I2C RGB LED driver.
```

## drivers/lora/native/common/Kconfig
```kconfig
# Copyright (c) 2026 Carlo Caione <ccaione@baylibre.com>
# SPDX-License-Identifier: Apache-2.0

config LORA_NATIVE_RADIO
	bool
	help
	  Operation handling shared by the native radio drivers.
```

## drivers/lora/native/sx128x/Kconfig
```kconfig
# Copyright (c) 2026 Giuseppe Fabiano <gfabiano40@gmail.com>
# SPDX-License-Identifier: Apache-2.0

config LORA_SX128X_NATIVE
	bool "Semtech SX128x native driver (experimental)"
	default y
	depends on LORA_MODULE_BACKEND_NATIVE
	depends on DT_HAS_SEMTECH_SX1280_ENABLED || DT_HAS_SEMTECH_SX1281_ENABLED
	select SPI
	select GPIO
	select LORA_HAS_GFSK_MODEM
	select LORA_HAS_RSSI
	select LORA_NATIVE_RADIO
	help
	  Driver for the Semtech SX1280 and SX1281 2.4 GHz transceivers,
	  talking to the chip over SPI directly. LoRa is always available;
	  the GFSK modem is added by LORA_GFSK.
```
