## drivers/mbox/Kconfig.aspeed
```kconfig
# Copyright (c) 2026 ASPEED Technology Inc.
# SPDX-License-Identifier: Apache-2.0

menuconfig MBOX_ASPEED
	bool "ASPEED mailbox driver"
	default y
	depends on DT_HAS_ASPEED_AST2700_MAILBOX_ENABLED
	help
	  Enable the ASPEED inter-processor mailbox controller. A mailbox with
	  an interrupt in the devicetree runs its callbacks in interrupt
	  context. Mailboxes without one share a polling thread, which runs
	  their callbacks; those callbacks may use blocking APIs and delay
	  polling of all channels until they return.

if MBOX_ASPEED

config MBOX_ASPEED_POLL_INTERVAL_MS
	int "Polling interval in milliseconds"
	default 1
	range 1 1000
	help
	  Interval between checks of the mailboxes without an interrupt while
	  any of their receive channels is enabled. The polling thread sleeps
	  when none is enabled.

config MBOX_ASPEED_THREAD_STACK_SIZE
	int "Polling thread stack size"
	default 1024
	help
	  Stack size in bytes for the polling thread and the callbacks it runs.

config MBOX_ASPEED_THREAD_PRIORITY
	int "Polling thread priority"
	default 0
	help
	  Priority of the polling thread.

endif # MBOX_ASPEED
```

## drivers/mfd/Kconfig.tps6521x
```kconfig
# SPDX-FileCopyrightText: Copyright The Zephyr Project Contributors
# SPDX-License-Identifier: Apache-2.0

config MFD_TPS6521X
	bool "TI TPS65214/TPS65215 PMIC multi-function device driver"
	default y
	depends on DT_HAS_TI_TPS65214_ENABLED || DT_HAS_TI_TPS65215_ENABLED
	select I2C
	help
	  Enable the TI TPS65214 and TPS65215 PMIC multi-function device
	  driver.
```

## drivers/mipi_dsi/designware/Kconfig
```kconfig
# Alif MIPI-DSI driver configuration options

# Copyright (C) 2024 Alif Semiconductor
# SPDX-License-Identifier: Apache-2.0

config MIPI_DSI_DW
	bool "MIPI-DSI Host Controller"
	help
	  Enable MIPI DSI Host controller driver

config MIPI_DSI_DW_ALIF
	bool "Alif MIPI-DSI Host Controller"
	default y
	select MIPI_DSI_DW
	select REGULATOR
	depends on DT_HAS_ALIF_MIPI_DSI_ENABLED
	help
	  Enable Alif-specific MIPI DSI Host controller glue code
```

## drivers/misc/litex/Kconfig
```kconfig
# SPDX-FileCopyrightText: Copyright The Zephyr Project Contributors
# SPDX-License-Identifier: Apache-2.0

config LITEX_SOC_CTRL
	bool "LiteX SoC controller"
	default y
	depends on DT_HAS_LITEX_SOC_CONTROLLER_ENABLED
	depends on REBOOT
	help
	  The LiteX SoC controller CSR, used to reset the SoC. This lives outside
	  the LiteX SoC family so that it is also available when the LiteX
	  peripherals are attached to a hardcore such as the Gowin AE350.

choice LITEX_CSR_ORDERING
	prompt "Select Control/Status register ordering"
	default LITEX_CSR_ORDERING_BIG

config LITEX_CSR_ORDERING_BIG
	bool "Big-endian ordering"
	help
	  Use big-endian ordering for CSR accesses

config LITEX_CSR_ORDERING_LITTLE
	bool "Little-endian ordering"
	help
	  Use little-endian ordering for CSR accesses

endchoice
```

## drivers/misc/nordic_cracen/Kconfig
```kconfig
# Copyright (c) 2026 Embeint Pty Ltd
# SPDX-License-Identifier: Apache-2.0

config NORDIC_CRACEN
	bool "Nordic CRACEN peripheral"
	default y if DT_HAS_NORDIC_NRF_CRACEN_CTRDRBG_ENABLED
	depends on DT_HAS_NORDIC_NRF_CRACEN_ENABLED
	select NRFX_CRACEN
	help
	  Nordic CRACEN peripheral driver. Initialises the nrfx CRACEN library
	  and synchronises access to the CRACEN hardware between its users.

	  Enabled by default only when a CRACEN user, such as the CTR_DRBG
	  entropy node, is enabled in devicetree. Disabling all CRACEN user nodes
	  in devicetree, or disabling this option, leaves the CRACEN hardware
	  untouched by Zephyr, for example so that it can be used exclusively by
	  the PSA crypto CRACEN driver.

if NORDIC_CRACEN

config NORDIC_CRACEN_INIT_PRIORITY
	int "Nordic CRACEN init priority"
	default 40
	help
	  Initialisation priority of the CRACEN peripheral. Must be lower than
	  the priorities of the CRACEN users, such as ENTROPY_INIT_PRIORITY.
	  This is checked at build time by the users.

choice NORDIC_CRACEN_SYNC
	prompt "CRACEN access synchronisation"
	default NORDIC_CRACEN_SYNC_NONE if !MULTITHREADING
	default NORDIC_CRACEN_SYNC_IRQ_LOCK

config NORDIC_CRACEN_SYNC_NONE
	bool "None"
	help
	  Perform no synchronisation when the CRACEN is acquired. The
	  application must guarantee that the CRACEN is never used from more
	  than one context at a time, for example by never using it from
	  interrupt context when multithreading is disabled.

config NORDIC_CRACEN_SYNC_IRQ_LOCK
	bool "Interrupt lock"
	help
	  Lock interrupts while the CRACEN is in use. Access is possible from
	  any context, including interrupts and before the kernel has started,
	  at the cost of interrupt latency for the duration of each operation.

config NORDIC_CRACEN_SYNC_SEMAPHORE
	bool "Semaphore"
	depends on MULTITHREADING
	help
	  Take a semaphore while the CRACEN is in use. Interrupts remain enabled
	  during CRACEN operations. Access from interrupt context, or before the
	  kernel has started, fails with -EBUSY if the CRACEN is in use.

	  Waiting is not possible in these contexts, as the CRACEN can only be
	  held by the thread that was interrupted, so the failure occurs even
	  when a caller requests ENTROPY_BUSYWAIT. Only select this option if
	  every user of the CRACEN from interrupt context, such as a Bluetooth
	  controller requesting entropy, handles these errors.

endchoice

endif # NORDIC_CRACEN
```

## drivers/misc/ti_k3_esm/Kconfig
```kconfig
# Copyright (c) 2026 BeagleBoard.org Foundation
# SPDX-License-Identifier: Apache-2.0

config TI_K3_ESM
	bool "TI K3 Error Signaling Module (ESM)"
	default y
	depends on DT_HAS_TI_K3_ESM_ENABLED
	help
	  Driver for the TI K3 Error Signaling Module. Aggregates SoC error
	  events (e.g. DCC ERR) and delivers high/low priority CPU interrupts.

if TI_K3_ESM

module = TI_K3_ESM
module-str = TI K3 ESM
source "subsys/logging/Kconfig.template.log_config"

config TI_K3_ESM_INIT_PRIORITY
	int "TI K3 ESM init priority"
	default KERNEL_INIT_PRIORITY_DEVICE

endif # TI_K3_ESM
```

## drivers/mspi/Kconfig.aspeed
```kconfig
# Copyright (c) 2026 ASPEED Technology Inc.
#
# SPDX-License-Identifier: Apache-2.0

menuconfig MSPI_ASPEED
	bool "ASPEED SPI memory controller driver"
	default y
	depends on DT_HAS_ASPEED_AST2700_FMC_ENABLED || DT_HAS_ASPEED_AST2700_SPI_ENABLED
	select CLOCK_CONTROL
	select PINCTRL if $(dt_compat_any_has_prop,$(DT_COMPAT_ASPEED_AST2700_FMC),pinctrl-0)
	select PINCTRL if $(dt_compat_any_has_prop,$(DT_COMPAT_ASPEED_AST2700_SPI),pinctrl-0)
	select RESET if $(dt_compat_any_has_prop,$(DT_COMPAT_ASPEED_AST2700_FMC),resets)
	select RESET if $(dt_compat_any_has_prop,$(DT_COMPAT_ASPEED_AST2700_SPI),resets)
	help
	  Enable polled transfers through the ASPEED firmware SPI flash
	  controller (FMC) and SPI memory controllers, on every chip select
	  that has a flash, in single, dual (1-1-2, 1-2-2) and quad (1-1-4,
	  1-4-4) I/O with 3-byte or 4-byte addresses.

if MSPI_ASPEED

config MSPI_ASPEED_DMA
	bool "DMA reads"
	default y
	depends on MSPI_DMA
	help
	  Use the controller's internal DMA engine for aligned reads larger than
	  128 bytes. Other transfers use programmed I/O, including DMA requests
	  that do not meet the controller's constraints. Completion is polled.

endif # MSPI_ASPEED
```

## drivers/opamp/Kconfig.am13_pga
```kconfig
# Copyright (c) 2026 Texas Instruments Incorporated
# SPDX-License-Identifier: Apache-2.0

config OPAMP_AM13_PGA
	bool "TI AM13 PGA driver"
	default y
	select PINCTRL
	select SYSCON
	depends on DT_HAS_TI_AM13_PGA_ENABLED
	help
	  Enable driver for the TI AM13E Programmable Gain Amplifier
	  (PGA). Allows for runtime gain changes.
	  Mux topology, filter resistor, and output routing are configured
	  statically via devicetree properties.
```
