## drivers/gpio/Kconfig.pcal95xx
```kconfig
# Kconfig.pcal9535a - PCAL9535A GPIO configuration options
#
#
# Copyright (c) 2016 Intel Corporation
#
# SPDX-License-Identifier: Apache-2.0
#

menuconfig GPIO_PCAL95XX
	bool "PCAL9535A I2C-based GPIO chip"
	depends on I2C
	help
	  Enable driver for PCAL9535A I2C-based GPIO chip.

if GPIO_PCAL95XX

config GPIO_PCAL95XX_INIT_PRIORITY
	int "Init priority"
	default 70
	help
	  Device driver initialization priority.

config GPIO_PCAL95XX_PUD
	bool "GPIO chip pull-up/down support"
	default y
	help
	  Compatible chips support for pull-up/down registers.

config GPIO_PCAL95XX_0
	bool "PCAL9535A GPIO chip #0"
	help
	  Enable config options for the PCAL9535A I2C-based GPIO chip #0.

config GPIO_PCAL95XX_0_DEV_NAME
	string "PCAL9535A GPIO chip #0 Device Name"
	depends on GPIO_PCAL95XX_0
	default "GPIO_P0"
	help
	  Specify the device name for the PCAL9535A I2C-based GPIO chip #0.

config GPIO_PCAL95XX_0_I2C_ADDR
	hex "PCAL9535A GPIO chip #0 I2C slave address"
	depends on GPIO_PCAL95XX_0
	help
	  Specify the I2C slave address for the PCAL9535A I2C-based GPIO chip #0.

config GPIO_PCAL95XX_0_I2C_MASTER_DEV_NAME
	string "I2C Master where PCAL9535A GPIO chip #0 is connected"
	depends on GPIO_PCAL95XX_0
	help
	  Specify the device name of the I2C master device to which this
	  PCAL9535A chip #0 is binded.

config GPIO_PCAL95XX_1
	bool "PCAL9535A GPIO chip #1"
	help
	  Enable config options for the PCAL9535A I2C-based GPIO chip #1.

config GPIO_PCAL95XX_1_DEV_NAME
	string "PCAL9535A GPIO chip #1 Device Name"
	depends on GPIO_PCAL95XX_1
	default "GPIO_P1"
	help
	  Specify the device name for the PCAL9535A I2C-based GPIO chip #1.

config GPIO_PCAL95XX_1_I2C_ADDR
	hex "PCAL9535A GPIO chip #1 I2C slave address"
	depends on GPIO_PCAL95XX_1
	help
	  Specify the I2C slave address for the PCAL9535A I2C-based GPIO chip #1.

config GPIO_PCAL95XX_1_I2C_MASTER_DEV_NAME
	string "I2C Master where PCAL9535A GPIO chip #1 is connected"
	depends on GPIO_PCAL95XX_1
	help
	  Specify the device name of the I2C master device to which this
	  PCAL9535A chip #1 is binded.

config GPIO_PCAL95XX_2
	bool "PCAL9535A GPIO chip #2"
	help
	  Enable config options for the PCAL9535A I2C-based GPIO chip #2.

config GPIO_PCAL95XX_2_DEV_NAME
	string "PCAL9535A GPIO chip #2 Device Name"
	depends on GPIO_PCAL95XX_2
	default "GPIO_P2"
	help
	  Specify the device name for the PCAL9535A I2C-based GPIO chip #2.

config GPIO_PCAL95XX_2_I2C_ADDR
	hex "PCAL9535A GPIO chip #2 I2C slave address"
	depends on GPIO_PCAL95XX_2
	help
	  Specify the I2C slave address for the PCAL9535A I2C-based GPIO chip #2.

config GPIO_PCAL95XX_2_I2C_MASTER_DEV_NAME
	string "I2C Master where PCAL9535A GPIO chip #2 is connected"
	depends on GPIO_PCAL95XX_2
	help
	  Specify the device name of the I2C master device to which this
	  PCAL9535A chip #2 is binded.

config GPIO_PCAL95XX_3
	bool "PCAL9535A GPIO chip #3"
	help
	  Enable config options for the PCAL9535A I2C-based GPIO chip #3.

config GPIO_PCAL95XX_3_DEV_NAME
	string "PCAL9535A GPIO chip #3 Device Name"
	depends on GPIO_PCAL95XX_3
	default "GPIO_P3"
	help
	  Specify the device name for the PCAL9535A I2C-based GPIO chip #3.

config GPIO_PCAL95XX_3_I2C_ADDR
	hex "PCAL9535A GPIO chip #3 I2C slave address"
	depends on GPIO_PCAL95XX_3
	help
	  Specify the I2C slave address for the PCAL9535A I2C-based GPIO chip #3.

config GPIO_PCAL95XX_3_I2C_MASTER_DEV_NAME
	string "I2C Master where PCAL9535A GPIO chip #3 is connected"
	depends on GPIO_PCAL95XX_3
	help
	  Specify the device name of the I2C master device to which this
	  PCAL9535A chip #3 is binded.

endif # GPIO_PCAL95XX
```

## drivers/gpio/Kconfig.pcal9722
```kconfig
# PCAL9722 GPIO configuration options

# Copyright 2025 Michael Estes
# SPDX-License-Identifier: Apache-2.0

menuconfig GPIO_PCAL9722
	bool "PCAL9722 SPI GPIO chip"
	default y
	depends on DT_HAS_NXP_PCAL9722_ENABLED
	depends on SPI
	help
	  Enable driver for PCAL9722 SPI GPIO chip.

if GPIO_PCAL9722

config GPIO_PCAL9722_INIT_PRIORITY
	int "Init priority"
	default 70
	help
	  PCAL9722 Device driver initialization priority.

endif # GPIO_PCAL9722
```

## drivers/gpio/Kconfig.pcf8574
```kconfig
# PCF8574 GPIO configuration options

# Copyright (c) 2022 Ithinx
# SPDX-License-Identifier: Apache-2.0

menuconfig GPIO_PCF8574
	bool "PCF8574 I2C GPIO chip"
	default y
	depends on DT_HAS_NXP_PCF8574_ENABLED
	select I2C
	help
	  Enable driver for PCF8574 I2C GPIO chip.

config GPIO_PCF8574_INIT_PRIORITY
	int "Init priority"
	default 70
	depends on GPIO_PCF8574
	help
	  Device driver initialization priority.
```

## drivers/gpio/Kconfig.pcf8575
```kconfig
# PCF8575 GPIO configuration options

# Copyright (c)
# 2023 Amrith Venkat Kesavamoorthi <amrith@mr-beam.org>
# 2023 Mr Beam Lasers GmbH
# SPDX-License-Identifier: Apache-2.0

menuconfig GPIO_PCF8575
	bool "PCF8575 I2C GPIO chip"
	default y
	depends on DT_HAS_NXP_PCF8575_ENABLED
	select I2C
	help
	  Enable driver for PCF8575 I2C GPIO chip.

config GPIO_PCF8575_INIT_PRIORITY
	int "Init priority"
	default 70
	depends on GPIO_PCF8575
	help
	  Device driver initialization priority.
```

## drivers/gpio/Kconfig.pi4ioe5v6408
```kconfig
# PI4IOE5V6408 GPIO configuration options

# Copyright (c) 2026 Carlo Caione <ccaione@baylibre.com>
# SPDX-License-Identifier: Apache-2.0

menuconfig GPIO_PI4IOE5V6408
	bool "PI4IOE5V6408 I2C GPIO expander"
	default y
	depends on DT_HAS_DIODES_PI4IOE5V6408_ENABLED
	select I2C
	help
	  Enable driver for the Diodes/Pericom PI4IOE5V6408 8-bit
	  I2C-bus I/O expander.

if GPIO_PI4IOE5V6408

config GPIO_PI4IOE5V6408_INIT_PRIORITY
	int "Init priority"
	default 70
	help
	  Device driver initialization priority. Must be higher than
	  CONFIG_I2C_INIT_PRIORITY so the I2C bus is available, and
	  higher than any GPIO controller hosting the INT line.

endif # GPIO_PI4IOE5V6408
```

## drivers/gpio/Kconfig.pic32cxsg
```kconfig
# Microchip PIC32CXSG GPIO configuration options

# Copyright (c) 2024 Microchip

# SPDX-License-Identifier: Apache-2.0

config GPIO_PIC32CXSG
	bool "Microchip PIC32CXSG GPIO (PORT) driver"
	default y
	depends on DT_HAS_PIC32CXSG_GPIO_ENABLED
	help
	  Enable support for the Microchip PIC32CXSG 'PORT' GPIO controllers.
```

## drivers/gpio/Kconfig.psoc6
```kconfig
# Copyright (c) 2020 ATL Electronics
# SPDX-License-Identifier: Apache-2.0

config GPIO_PSOC6
	bool "Cypress PSOC 6 GPIO driver"
	default y
	depends on DT_HAS_CYPRESS_PSOC6_GPIO_ENABLED
	help
	  Enable support for the Cypress PSOC 6 GPIO controllers.
```
