## drivers/gpio/Kconfig.npm1300
```kconfig
# Copyright (c) 2023 Nordic Semiconductor ASA
# SPDX-License-Identifier: Apache-2.0

config GPIO_NPM1300
	bool "nPM1300 GPIO driver"
	default y
	depends on DT_HAS_NORDIC_NPM1300_GPIO_ENABLED
	select I2C
	select MFD
	help
	  Enable the nPM1300 GPIO driver.

config GPIO_NPM1300_INIT_PRIORITY
	int "nPM1300 GPIO driver initialization priority"
	depends on GPIO_NPM1300
	default 70
	help
	  Initialization priority for the nPM1300 GPIO driver. It must be
	  greater than the I2C controller init priority.
```

## drivers/gpio/Kconfig.npm13xx
```kconfig
# Copyright (c) 2023 Nordic Semiconductor ASA
# SPDX-License-Identifier: Apache-2.0

config GPIO_NPM13XX
	bool "nPM13xx GPIO driver"
	default y
	depends on DT_HAS_NORDIC_NPM1300_GPIO_ENABLED || DT_HAS_NORDIC_NPM1304_GPIO_ENABLED
	select I2C
	select MFD
	help
	  Enable the nPM13xx GPIO driver.

config GPIO_NPM13XX_INIT_PRIORITY
	int "nPM13xx GPIO driver initialization priority"
	depends on GPIO_NPM13XX
	default 85
	help
	  Initialization priority for the nPM13xx GPIO driver. It must be
	  greater than the I2C controller init priority.
```

## drivers/gpio/Kconfig.npm2100
```kconfig
# Copyright (c) 2024 Nordic Semiconductor ASA
# SPDX-License-Identifier: Apache-2.0

config GPIO_NPM2100
	bool "nPM2100 GPIO driver"
	default y
	depends on DT_HAS_NORDIC_NPM2100_GPIO_ENABLED
	select I2C
	select MFD
	help
	  Enable the nPM2100 GPIO driver.

config GPIO_NPM2100_INIT_PRIORITY
	int "nPM2100 GPIO driver initialization priority"
	depends on GPIO_NPM2100
	default 80
	help
	  Initialization priority for the nPM2100 GPIO driver. It must be
	  greater than the I2C controller init priority.
```

## drivers/gpio/Kconfig.npm6001
```kconfig
# Copyright (c) 2022 Nordic Semiconductor ASA
# SPDX-License-Identifier: Apache-2.0

config GPIO_NPM6001
	bool "nPM6001 GPIO driver"
	default y
	depends on DT_HAS_NORDIC_NPM6001_GPIO_ENABLED
	select I2C
	select MFD
	help
	  Enable the nPM6001 GPIO driver.

config GPIO_NPM6001_INIT_PRIORITY
	int "nPM6001 GPIO driver initialization priority"
	depends on GPIO_NPM6001
	default 85
	help
	  Initialization priority for the nPM6001 GPIO driver.
```

## drivers/gpio/Kconfig.nrf5
```kconfig
# Kconfig.nrf5 - Nordic Semiconductor nRF5x GPIO configuration options
#
# Copyright (c) 2016-2018 Nordic Semiconductor ASA
#
# SPDX-License-Identifier: Apache-2.0
#

menuconfig GPIO_NRF5
	bool "Nordic Semiconductor nRF5x-based GPIO driver"
	depends on GPIO && SOC_FAMILY_NRF
	select HAS_DTS_GPIO
	help
	  Enable GPIO driver for nRF5 line of MCUs.

if GPIO_NRF5

config GPIO_NRF5_P0
	bool "nRF5x GPIO Port P0"
	help
	  Enable nRF5 GPIO port P0 config options.

config GPIO_NRF5_P1
	bool "nRF5x GPIO Port P1"
	depends on SOC_NRF52840
	help
	  Enable nRF5 GPIO port P1 config options.

config GPIO_NRF5_INIT_PRIORITY
	int "nRF5 GPIO initialization priority"
	default 40
	help
	  Initialization priority for nRF5 GPIO.

config GPIO_NRF5_GPIOTE_CHAN_BASE
	# hidden
	int
	default 4 if (BT_CTLR_GPIO_PA || BT_CTLR_GPIO_LNA) && PWM_NRF5_SW
	default 3 if PWM_NRF5_SW
	default 1 if (BT_CTLR_GPIO_PA || BT_CTLR_GPIO_LNA)
	default 0

endif # GPIO_NRF5
```

## drivers/gpio/Kconfig.nrfx
```kconfig
# Copyright (c) 2018 Nordic Semiconductor ASA
# SPDX-License-Identifier: Apache-2.0

menuconfig GPIO_NRFX
	bool "nRF GPIO driver"
	default y
	depends on DT_HAS_NORDIC_NRF_GPIO_ENABLED
	help
	  Enable GPIO driver for nRF line of MCUs.

config GPIO_NRFX_INTERRUPT
	bool "Interrupt support"
	depends on GPIO_NRFX
	select NRFX_GPIOTE
	default y
	help
	  The option can be used to disable the GPIO interrupt support to
	  significantly reduce memory footprint in case of application that does
	  not need GPIO interrupts.
```

## drivers/gpio/Kconfig.numaker
```kconfig
# NUMAKER GPIO driver configuration options

# Copyright (c) 2023 Nuvoton Technology Corporation.
# SPDX-License-Identifier: Apache-2.0

config GPIO_NUMAKER
	bool "Nuvoton NUMAKER MCU gpio driver"
	default y
	select HAS_NUMAKER_GPIO
	depends on DT_HAS_NUVOTON_NUMAKER_GPIO_ENABLED
	help
	  This option enables the GPIO driver for Nuvoton NUMAKER family of
	  processors.
```

## drivers/gpio/Kconfig.numicro
```kconfig
# NuMicro GPIO configuration options

# Copyright (c) 2022 SEAL AG
# SPDX-License-Identifier: Apache-2.0

config GPIO_NUMICRO
	bool "Nuvoton NuMicro GPIO driver"
	default y
	select PINCTRL
	depends on DT_HAS_NUVOTON_NUMICRO_GPIO_ENABLED
	help
	  Enable the GPIO driver for the NuMicro family of processors.
```

## drivers/gpio/Kconfig.nxp_s32
```kconfig
# Copyright 2022 NXP
# SPDX-License-Identifier: Apache-2.0

config GPIO_NXP_S32
	bool "NXP S32 GPIO driver"
	default y
	depends on DT_HAS_NXP_S32_GPIO_ENABLED
	select NOCACHE_MEMORY if ARCH_HAS_NOCACHE_MEMORY_SUPPORT
	help
	  Enable the GPIO driver for NXP S32 processors.
```

## drivers/gpio/Kconfig.nxp_siul2
```kconfig
# Copyright 2022, 2025 NXP
# SPDX-License-Identifier: Apache-2.0

config GPIO_NXP_SIUL2
	bool "NXP SIUL2 GPIO driver"
	default y
	depends on DT_HAS_NXP_SIUL2_GPIO_ENABLED
	select NOCACHE_MEMORY if ARCH_HAS_NOCACHE_MEMORY_SUPPORT
	help
	  Enable the GPIO driver for NXP SIUL2.
```

## drivers/gpio/Kconfig.pca6416
```kconfig
# PCA6416 GPIO configuration options

# Copyright 2024 NXP
# SPDX-License-Identifier: Apache-2.0

menuconfig GPIO_PCA6416
	bool "PCA6416 I2C GPIO chip"
	default y
	depends on DT_HAS_NXP_PCA6416_ENABLED
	select I2C
	help
	  Enable driver for PCA6416 I2C GPIO chip.

if GPIO_PCA6416

config GPIO_PCA6416_INIT_PRIORITY
	int "Init priority"
	default 70
	help
	  PCA6416 Device driver initialization priority.

endif # GPIO_PCA6416
```

## drivers/gpio/Kconfig.pca9536
```kconfig
# PCA95XX GPIO configuration options

# Copyright (c) 2016 Intel Corporation
# Copyright (C) 2020, Riedo Networks Ltd
# SPDX-License-Identifier: Apache-2.0

menuconfig GPIO_PCA9536
	bool "PCA9536 I2C-based GPIO chip (4bits)"
	depends on I2C
	help
	  Enable driver for PCA95XX I2C-based GPIO chip.

config GPIO_PCA9536_INIT_PRIORITY
	int "Init priority"
	default 70
	depends on GPIO_PCA9536
	help
	  Device driver initialization priority.
```

## drivers/gpio/Kconfig.pca953x
```kconfig
# PCA953X GPIO configuration options

# Copyright (c) 2018 Aapo Vienamo
# Copyright (c) 2021 Laird Connectivity
# SPDX-License-Identifier: Apache-2.0

menuconfig GPIO_PCA953X
	bool "PCA953X I2C GPIO chip"
	default y
	depends on DT_HAS_TI_TCA9538_ENABLED
	select I2C
	help
	  Enable driver for PCA953X I2C GPIO chip.

if GPIO_PCA953X

config GPIO_PCA953X_INIT_PRIORITY
	int "Init priority"
	default 70
	help
	  Device driver initialization priority.

endif # GPIO_PCA953X
```

## drivers/gpio/Kconfig.pca95xx
```kconfig
# PCA95XX GPIO configuration options

# Copyright (c) 2016 Intel Corporation
# SPDX-License-Identifier: Apache-2.0

menuconfig GPIO_PCA95XX
	bool "PCA95XX I2C-based GPIO chip"
	default y
	depends on DT_HAS_NXP_PCA95XX_ENABLED
	depends on I2C
	help
	  Enable driver for PCA95XX I2C-based GPIO chip.

if GPIO_PCA95XX

config GPIO_PCA95XX_INIT_PRIORITY
	int "Init priority"
	default I2C_INIT_PRIORITY
	help
	  Device driver initialization priority.

config GPIO_PCA95XX_INTERRUPT
	bool "Interrupt enable"
	help
	  Enable interrupt support in PCA95XX driver.
	  Note that the PCA95XX cannot reliably detect
	  short-pulse interrupts due to its design.

endif # GPIO_PCA95XX
```

## drivers/gpio/Kconfig.pca_series
```kconfig
# PCA_SERIES GPIO configuration options

# Copyright 2024 NXP
# SPDX-License-Identifier: Apache-2.0

menuconfig GPIO_PCA_SERIES
	bool "PCA_SERIES I2C-based GPIO chip"
	default y
	depends on DT_HAS_NXP_PCA9538_ENABLED || DT_HAS_NXP_PCA9539_ENABLED || \
			DT_HAS_NXP_PCA9554_ENABLED || DT_HAS_NXP_PCA9555_ENABLED || \
			DT_HAS_NXP_PCA6408_ENABLED || DT_HAS_NXP_PCA6416_ENABLED || \
			DT_HAS_NXP_PCAL9538_ENABLED || DT_HAS_NXP_PCAL9539_ENABLED || \
			DT_HAS_NXP_PCAL6408_ENABLED || DT_HAS_NXP_PCAL6416_ENABLED || \
			DT_HAS_NXP_PCAL6524_ENABLED || DT_HAS_NXP_PCAL6534_ENABLED
	select I2C
	help
	  Enable driver for PCA_SERIES I2C-based GPIO chip.

config GPIO_PCA_SERIES_INIT_PRIORITY
	int "Init priority"
	default 70
	depends on GPIO_PCA_SERIES
	help
	  Device driver initialization priority.

config GPIO_PCA_SERIES_INTERRUPT
	bool "Interrupt enable"
	default y
	depends on GPIO_PCA_SERIES
	help
	  Enable interrupt support in PCA_SERIES driver.
	  Note that the PCA_SERIES cannot reliably detect
	  short-pulse interrupts due to its design.

config GPIO_PCA_SERIES_CACHE_ALL
	bool "Cache all registers"
	default y
	depends on GPIO_PCA_SERIES
	help
	  Cache all registers in RAM for faster configuration.
	  Enabled by default.
	  When disabled, only output registers will be cached.
	  On devices w/o interrupt status, it will also cache
	  input state.
```

## drivers/gpio/Kconfig.pcal6408a
```kconfig
# PCAL6408a GPIO configuration options

# Copyright (c) 2021 Nordic Semiconductor ASA
# SPDX-License-Identifier: Apache-2.0

menuconfig GPIO_PCAL6408A
	bool "PCAL6408A I2C GPIO chip"
	default y
	depends on DT_HAS_NXP_PCAL6408A_ENABLED
	depends on I2C
	help
	  Enable driver for PCAL6408A I2C GPIO chip.

config GPIO_PCAL6408A_INIT_PRIORITY
	int "Init priority"
	default 70
	depends on GPIO_PCAL6408A
	help
	  Device driver initialization priority.
```

## drivers/gpio/Kconfig.pcal64xxa
```kconfig
# PCAL6408a GPIO configuration options

# Copyright (c) 2021 Nordic Semiconductor ASA
# Copyright (c) 2023 SILA Embedded Solutions GmbH
# SPDX-License-Identifier: Apache-2.0

menuconfig GPIO_PCAL64XXA
	bool "PCAL64XXA I2C GPIO chip"
	default y
	depends on DT_HAS_NXP_PCAL6408A_ENABLED || DT_HAS_NXP_PCAL6416A_ENABLED
	select I2C
	help
	  Enable driver for PCAL64XXA I2C GPIO chip.

config GPIO_PCAL64XXA_INIT_PRIORITY
	int "Init priority"
	default 70
	depends on GPIO_PCAL64XXA
	help
	  Device driver initialization priority.
```

## drivers/gpio/Kconfig.pcal9535a
```kconfig
# Kconfig.pcal9535a - PCAL9535A GPIO configuration options
#
#
# Copyright (c) 2016 Intel Corporation
#
# SPDX-License-Identifier: Apache-2.0
#

menuconfig GPIO_PCAL9535A
	bool "PCAL9535A I2C-based GPIO chip"
	depends on I2C
	help
	  Enable driver for PCAL9535A I2C-based GPIO chip.

if GPIO_PCAL9535A

config GPIO_PCAL9535A_INIT_PRIORITY
	int "Init priority"
	default 70
	help
	  Device driver initialization priority.

config GPIO_PCAL9535A_0
	bool "PCAL9535A GPIO chip #0"
	help
	  Enable config options for the PCAL9535A I2C-based GPIO chip #0.

config GPIO_PCAL9535A_0_DEV_NAME
	string "PCAL9535A GPIO chip #0 Device Name"
	depends on GPIO_PCAL9535A_0
	default "GPIO_P0"
	help
	  Specify the device name for the PCAL9535A I2C-based GPIO chip #0.

config GPIO_PCAL9535A_0_I2C_ADDR
	hex "PCAL9535A GPIO chip #0 I2C slave address"
	depends on GPIO_PCAL9535A_0
	help
	  Specify the I2C slave address for the PCAL9535A I2C-based GPIO chip #0.

config GPIO_PCAL9535A_0_I2C_MASTER_DEV_NAME
	string "I2C Master where PCAL9535A GPIO chip #0 is connected"
	depends on GPIO_PCAL9535A_0
	help
	  Specify the device name of the I2C master device to which this
	  PCAL9535A chip #0 is binded.

config GPIO_PCAL9535A_1
	bool "PCAL9535A GPIO chip #1"
	help
	  Enable config options for the PCAL9535A I2C-based GPIO chip #1.

config GPIO_PCAL9535A_1_DEV_NAME
	string "PCAL9535A GPIO chip #1 Device Name"
	depends on GPIO_PCAL9535A_1
	default "GPIO_P1"
	help
	  Specify the device name for the PCAL9535A I2C-based GPIO chip #1.

config GPIO_PCAL9535A_1_I2C_ADDR
	hex "PCAL9535A GPIO chip #1 I2C slave address"
	depends on GPIO_PCAL9535A_1
	help
	  Specify the I2C slave address for the PCAL9535A I2C-based GPIO chip #1.

config GPIO_PCAL9535A_1_I2C_MASTER_DEV_NAME
	string "I2C Master where PCAL9535A GPIO chip #1 is connected"
	depends on GPIO_PCAL9535A_1
	help
	  Specify the device name of the I2C master device to which this
	  PCAL9535A chip #1 is binded.

config GPIO_PCAL9535A_2
	bool "PCAL9535A GPIO chip #2"
	help
	  Enable config options for the PCAL9535A I2C-based GPIO chip #2.

config GPIO_PCAL9535A_2_DEV_NAME
	string "PCAL9535A GPIO chip #2 Device Name"
	depends on GPIO_PCAL9535A_2
	default "GPIO_P2"
	help
	  Specify the device name for the PCAL9535A I2C-based GPIO chip #2.

config GPIO_PCAL9535A_2_I2C_ADDR
	hex "PCAL9535A GPIO chip #2 I2C slave address"
	depends on GPIO_PCAL9535A_2
	help
	  Specify the I2C slave address for the PCAL9535A I2C-based GPIO chip #2.

config GPIO_PCAL9535A_2_I2C_MASTER_DEV_NAME
	string "I2C Master where PCAL9535A GPIO chip #2 is connected"
	depends on GPIO_PCAL9535A_2
	help
	  Specify the device name of the I2C master device to which this
	  PCAL9535A chip #2 is binded.

config GPIO_PCAL9535A_3
	bool "PCAL9535A GPIO chip #3"
	help
	  Enable config options for the PCAL9535A I2C-based GPIO chip #3.

config GPIO_PCAL9535A_3_DEV_NAME
	string "PCAL9535A GPIO chip #3 Device Name"
	depends on GPIO_PCAL9535A_3
	default "GPIO_P3"
	help
	  Specify the device name for the PCAL9535A I2C-based GPIO chip #3.

config GPIO_PCAL9535A_3_I2C_ADDR
	hex "PCAL9535A GPIO chip #3 I2C slave address"
	depends on GPIO_PCAL9535A_3
	help
	  Specify the I2C slave address for the PCAL9535A I2C-based GPIO chip #3.

config GPIO_PCAL9535A_3_I2C_MASTER_DEV_NAME
	string "I2C Master where PCAL9535A GPIO chip #3 is connected"
	depends on GPIO_PCAL9535A_3
	help
	  Specify the device name of the I2C master device to which this
	  PCAL9535A chip #3 is binded.

endif # GPIO_PCAL9535A
```
