## drivers/gpio/Kconfig.adp5585
```kconfig
# Copyright 2024 NXP
# SPDX-License-Identifier: Apache-2.0

menuconfig GPIO_ADP5585
	bool "ADP5585_GPIO I2C GPIO chip"
	default y
	depends on DT_HAS_ADI_ADP5585_GPIO_ENABLED
	select MFD
	select I2C
	help
	  Enable the ADP5585 GPIO driver.

config GPIO_ADP5585_INIT_PRIORITY
	int "Init priority"
	default 70
	depends on GPIO_ADP5585
	help
	  Device driver initialization priority.
```

## drivers/gpio/Kconfig.ads114s0x
```kconfig
# ADS114S0x GPIO configuration options

# Copyright (c) 2023 SILA Embedded Solutions GmbH
# SPDX-License-Identifier: Apache-2.0

menuconfig GPIO_ADS114S0X
	bool "ADS114S0x GPIO driver"
	default y
	depends on DT_HAS_TI_ADS114S0X_GPIO_ENABLED
	depends on ADC_ADS114S0X_GPIO
	help
	  Enable GPIO driver for ADS114S0x.

	  The ADS114S0x is a multi-channel analog frontend (AFE).

	  The GPIO port of the ADS114S0x (GPIO0 to GPIO3) is exposed as a
	  GPIO controller driver with read/write support.

config GPIO_ADS114S0X_INIT_PRIORITY
	int "Driver init priority"
	default 99
	depends on GPIO_ADS114S0X
	help
	  Device driver initialization priority. This driver must be
	  initialized after the ADS114S0x ADC driver.
```

## drivers/gpio/Kconfig.ads1x4s0x
```kconfig
# ADS1X4S0X GPIO configuration options

# Copyright (c) 2023 SILA Embedded Solutions GmbH
# SPDX-License-Identifier: Apache-2.0

menuconfig GPIO_ADS1X4S0X
	bool "ADS1X4S0X GPIO driver"
	default y
	depends on DT_HAS_TI_ADS1X4S0X_GPIO_ENABLED
	depends on ADC_ADS1X4S0X_GPIO
	help
	  Enable GPIO driver for ADS1X4S0X.

	  The ADS1X4S0X is a multi-channel analog frontend (AFE).

	  The GPIO port of the ADS1X4S0X (GPIO0 to GPIO3) is exposed as a
	  GPIO controller driver with read/write support.

config GPIO_ADS1X4S0X_INIT_PRIORITY
	int "Driver init priority"
	default 99
	depends on GPIO_ADS1X4S0X
	help
	  Device driver initialization priority. This driver must be
	  initialized after the ADS1X4S0X ADC driver.
```

## drivers/gpio/Kconfig.aesc
```kconfig
# Copyright (c) 2025 Aesc Silicon
# SPDX-License-Identifier: Apache-2.0

config GPIO_AESC
	bool "Aesc Silicon GPIO driver"
	default y
	depends on DT_HAS_AESC_GPIO_ENABLED
	help
	  Enable the Aesc Silicon GPIO driver.
```

## drivers/gpio/Kconfig.airoc
```kconfig
# Copyright (c) 2025 Beechwoods Software, Inc.
# SPDX-License-Identifier: Apache-2.0

config GPIO_AIROC
	bool "Infineon AIROC GPIO driver"
	default y
	depends on DT_HAS_INFINEON_AIROC_GPIO_ENABLED
	depends on NETWORKING
	depends on WIFI
	depends on CYW43439
	help
	  Enable support for Infineon AIROC GPIO controllers.
```

## drivers/gpio/Kconfig.allwinner
```kconfig
# Copyright (c) 2026 Khai Do
# SPDX-License-Identifier: Apache-2.0

config GPIO_ALLWINNER
	bool "Allwinner GPIO driver"
	default y
	depends on DT_HAS_ALLWINNER_SUNXI_GPIO_ENABLED
	help
	  Enable the Allwinner GPIO driver for H618.
```

## drivers/gpio/Kconfig.altera
```kconfig
# Copyright (c) 2023 Intel Corporation
# SPDX-License-Identifier: Apache-2.0

config GPIO_ALTERA_PIO
	bool "Altera PIO"
	default y
	depends on DT_HAS_ALTR_PIO_1_0_ENABLED
	help
	  Enable driver for Altera PIO
```

## drivers/gpio/Kconfig.altera_nios2
```kconfig
# Kconfig.altera_nios2 - Altera Nios-II GPIO configuration options
#
#
# Copyright (c) 2017 Intel Corporation
#
# SPDX-License-Identifier: Apache-2.0
#

menuconfig GPIO_ALTERA_NIOS2
	bool "Altera Nios-II PIO Controllers"
	depends on GPIO && HAS_ALTERA_HAL
	help
	  Enable config options to support the PIO controllers
	  on Altera Nios-II family processors.

	  Says n if not sure.

if GPIO_ALTERA_NIOS2

config GPIO_ALTERA_NIOS2_OUTPUT
	bool "Enable driver for Altera Nios-II PIO Output Port"
	help
	  Build the driver to utilize PIO controller Output Port.

config GPIO_ALTERA_NIOS2_OUTPUT_DEV_NAME
	string "Device name for Output Port"
	depends on GPIO_ALTERA_NIOS2_OUTPUT
	default "PIO_OUTPUT"
	help
	  Device name for Output Port.

endif # GPIO_ALTERA_NIOS2
```

## drivers/gpio/Kconfig.ambiq
```kconfig
# Ambiq SDK GPIO
#
# Copyright (c) 2023 Antmicro <www.antmicro.com>
#
# SPDX-License-Identifier: Apache-2.0
#

config GPIO_AMBIQ
	bool "AMBIQ GPIO driver"
	default y
	depends on DT_HAS_AMBIQ_GPIO_ENABLED
	select AMBIQ_HAL
	help
	  Enable driver for Ambiq gpio.
```

## drivers/gpio/Kconfig.ameba
```kconfig
# Copyright (c) 2024 Realtek Semiconductor Corp.
# SPDX-License-Identifier: Apache-2.0

config GPIO_AMEBA
	bool "GPIO controller driver for Realtek Ameba series SoC"
	default y
	depends on DT_HAS_REALTEK_AMEBA_GPIO_ENABLED
	help
	  Enable GPIO controller driver for Realtek Ameba series SoC

config GPIO_DEBOUNCE_EN
	bool "Ameba GPIO Interrupt Debounce Enable"
	depends on GPIO_AMEBA
	default y
	help
	  When Enable GPIO Interrupt Debounce, the external signal can be debounced to
	  remove any spurious glitches that are less than one period(about 32us) of
	  the external debouncing clock.
```

## drivers/gpio/Kconfig.andes_atcgpio100
```kconfig
# Kconfig Andes ATCGPIO100 configuration option
#
# Copyright (c) 2021 Andes Technology Corporation.
#
# SPDX-License-Identifier: Apache-2.0
#

config GPIO_ANDES_ATCGPIO100
	bool "Andes ATCGPIO100 GPIO driver"
	default y
	depends on DT_HAS_ANDESTECH_ATCGPIO100_ENABLED
	help
	  Enable driver for the Andes ATCGPIO100 GPIO controller.

	  Says n if not sure.
```

## drivers/gpio/Kconfig.at32
```kconfig
# AT32 GPIO configuration

# Copyright (c) 2016 Open-RnD Sp. z o.o.
# SPDX-License-Identifier: Apache-2.0

config GPIO_AT32
	bool "GPIO Driver for AT32 family of MCUs"
	default y
	depends on DT_HAS_ARTERY_AT32_GPIO_ENABLED
	help
	  Enable GPIO driver for AT32 line of MCUs
```

## drivers/gpio/Kconfig.atmel_sam3
```kconfig
# Kconfig.atmel_sam3 - Atmel SAM3 GPIO configuration options
#
#
# Copyright (c) 2016 Intel Corporation
#
# SPDX-License-Identifier: Apache-2.0
#

menuconfig GPIO_ATMEL_SAM3
	bool "Atmel SAM3 PIO Controllers"
	depends on GPIO && SOC_SERIES_SAM3X
	help
	  Enable config options to support the PIO controllers
	  on Atmel SAM3 family processors.

	  Says n if not sure.

if GPIO_ATMEL_SAM3

config GPIO_ATMEL_SAM3_PORTA
	bool "Enable driver for Atmel SAM3 PIO Port A"
	help
	  Build the driver to utilize PIO controller Port A.

config GPIO_ATMEL_SAM3_PORTA_DEV_NAME
	string "Device name for Port A"
	depends on GPIO_ATMEL_SAM3_PORTA
	default "PIOA"
	help
	  Device name for Port A.

config GPIO_ATMEL_SAM3_PORTA_IRQ_PRI
	int "Interrupt Priority for Port A"
	depends on GPIO_ATMEL_SAM3_PORTA
	default 3
	help
	  Interrupt priority for Port A.

config GPIO_ATMEL_SAM3_PORTB
	bool "Enable driver for Atmel SAM3 PIO Port B"
	help
	  Build the driver to utilize PIO controller Port B.

config GPIO_ATMEL_SAM3_PORTB_DEV_NAME
	string "Device name for Port B"
	depends on GPIO_ATMEL_SAM3_PORTB
	default "PIOB"
	help
	  Device name for Port B.

config GPIO_ATMEL_SAM3_PORTB_IRQ_PRI
	int "Interrupt Priority for Port B"
	depends on GPIO_ATMEL_SAM3_PORTB
	default 3
	help
	  Interrupt priority for Port B.

config GPIO_ATMEL_SAM3_PORTC
	bool "Enable driver for Atmel SAM3 PIO Port C"
	help
	  Build the driver to utilize PIO controller Port C.

config GPIO_ATMEL_SAM3_PORTC_DEV_NAME
	string "Device name for Port C"
	depends on GPIO_ATMEL_SAM3_PORTC
	default "PIOC"
	help
	  Device name for Port C.

config GPIO_ATMEL_SAM3_PORTC_IRQ_PRI
	int "Interrupt Priority for Port C"
	depends on GPIO_ATMEL_SAM3_PORTC
	default 3
	help
	  Interrupt priority for Port C.

config GPIO_ATMEL_SAM3_PORTD
	bool "Enable driver for Atmel SAM3 PIO Port D"
	help
	  Build the driver to utilize PIO controller Port D.

config GPIO_ATMEL_SAM3_PORTD_DEV_NAME
	string "Device name for Port D"
	depends on GPIO_ATMEL_SAM3_PORTD
	default "PIOD"
	help
	  Device name for Port D.

config GPIO_ATMEL_SAM3_PORTD_IRQ_PRI
	int "Interrupt Priority for Port D"
	depends on GPIO_ATMEL_SAM3_PORTD
	default 3
	help
	  Interrupt priority for Port D.

endif # GPIO_ATMEL_SAM3
```

## drivers/gpio/Kconfig.aw9523b
```kconfig
# Copyright (c) 2024 TOKITA Hiroshi
# SPDX-License-Identifier: Apache-2.0

config GPIO_AW9523B
	bool "AW9523B GPIO driver"
	default y
	depends on DT_HAS_AWINIC_AW9523B_GPIO_ENABLED
	select I2C
	select MFD
	help
	  Enable the AW9523B GPIO controller.
```

## drivers/gpio/Kconfig.axp192
```kconfig
# Copyright (c) 2023 Martin Kiepfer
# SPDX-License-Identifier: Apache-2.0

config GPIO_AXP192
	bool "AXP192 GPIO driver"
	default y
	depends on DT_HAS_X_POWERS_AXP192_GPIO_ENABLED
	depends on DT_HAS_X_POWERS_AXP192_ENABLED
	select I2C
	select MFD
	help
	  Enable the AXP192 GPIO driver.

config GPIO_AXP192_INIT_PRIORITY
	int "AXP192 GPIO driver initialization priority"
	depends on GPIO_AXP192
	default 81
	help
	  Initialization priority for the AXP192 GPIO driver. It must be
	  greater than the I2C controller init priority and the mfd driver
	  init priority.
```

## drivers/gpio/Kconfig.b91
```kconfig
# Copyright (c) 2021 Telink Semiconductor
# SPDX-License-Identifier: Apache-2.0

# Telink B91 GPIO configuration options

config GPIO_TELINK_B91
	bool "Telink B91 GPIO driver"
	default y
	depends on DT_HAS_TELINK_B91_GPIO_ENABLED
	help
	  Enable the B91 GPIO driver.
```

## drivers/gpio/Kconfig.b9x
```kconfig
# Copyright (c) 2021-2023 Telink Semiconductor
# SPDX-License-Identifier: Apache-2.0

# Telink B9x-series GPIO configuration options

config GPIO_TELINK_B9X
	bool "Telink B9x-series GPIO driver"
	default y
	depends on DT_HAS_TELINK_B9X_GPIO_ENABLED
	help
	  Enables the B9x-series GPIO driver.
```

## drivers/gpio/Kconfig.bcm2711
```kconfig
# Copyright (c) 2023 Chen Xingyu <hi@xingrz.me>
# SPDX-License-Identifier: Apache-2.0

config GPIO_BCM2711
	bool "BCM2711 GPIO driver"
	default y
	depends on DT_HAS_BRCM_BCM2711_GPIO_ENABLED
	help
	  Enable BCM2711 GPIO driver.
```

## drivers/gpio/Kconfig.bcm2835
```kconfig
# Copyright (c) 2026
# SPDX-License-Identifier: Apache-2.0

config GPIO_BCM2835
	bool "BCM2835 GPIO driver"
	default y
	depends on DT_HAS_BRCM_BCM2835_GPIO_ENABLED
	help
	  Enable BCM2835 GPIO driver.
```

## drivers/gpio/Kconfig.bd8lb600fs
```kconfig
# BD8LB600FS GPIO configuration options

# Copyright (c) 2022 SILA Embedded Solutions GmbH
# SPDX-License-Identifier: Apache-2.0

menuconfig GPIO_BD8LB600FS
	bool "BD8LB600FS SPI-based GPIO chip"
	default y
	depends on DT_HAS_ROHM_BD8LB600FS_ENABLED
	depends on SPI
	help
	  Enable driver for BD8LB600FS SPI-based GPIO chip.

if GPIO_BD8LB600FS

config GPIO_BD8LB600FS_INIT_PRIORITY
	int "Init priority"
	default 75
	help
	  Device driver initialization priority.

endif #GPIO_BD8LB600FS
```

## drivers/gpio/Kconfig.bee
```kconfig
# Copyright (c) 2026, Realtek Semiconductor Corporation
# SPDX-License-Identifier: Apache-2.0

config GPIO_BEE
	bool "Realtek Bee series GPIO driver"
	default y
	depends on DT_HAS_REALTEK_BEE_GPIO_ENABLED
	select HAL_REALTEK_BEE_GPIO
	select PINCTRL
	help
	  This option enables the GPIO driver for Realtek Bee SoCs.
```

## drivers/gpio/Kconfig.bflb
```kconfig
# Copyright (c) 2024-2025 MASSDRIVER EI (massdriver.space)
# SPDX-License-Identifier: Apache-2.0

config GPIO_BFLB_BL60X_70X
	bool "Bouffalo Lab BL60x and BL70x GPIO driver"
	depends on DT_HAS_BFLB_BL60X_70X_GPIO_ENABLED
	default y
	help
	  Bouffalo Lab BL60x and BL70x GPIO driver

config GPIO_BFLB_BL61X
	bool "Bouffalo Lab BL61X GPIO driver"
	depends on DT_HAS_BFLB_BL61X_GPIO_ENABLED
	default y
	help
	  Bouffalo Lab BL61X GPIO driver

if GPIO_BFLB_BL61X

config GPIO_BFLB_BL61X_CACHE_WRITE
	bool "Cache BL61x GPIO writes"
	depends on DT_HAS_BFLB_BL61X_GPIO_ENABLED
	default y
	help
	  Cache last written value to GPIO register, this doubles GPIO toggle speed by
	  avoiding a nonrequired read operation on the speed-limited peripheral.

endif # GPIO_BFLB_BL61X
```

## drivers/gpio/Kconfig.brcmstb
```kconfig
# Copyright (c) 2024 Junho Lee <junho@tsnlab.com>
# SPDX-License-Identifier: Apache-2.0

config GPIO_BRCMSTB
	bool "Broadcom Set-top box SoC GPIO Driver"
	default y
	depends on DT_HAS_BRCM_BRCMSTB_GPIO_ENABLED
	help
	  Enable Driver for Broadcom Set-top box SoC GPIO Banks.
```

## drivers/gpio/Kconfig.cc13xx_cc26xx
```kconfig
# TI CC13xx / CC26xx GPIO configuration options

# Copyright (c) 2019 Brett Witherspoon
# SPDX-License-Identifier: Apache-2.0

config GPIO_CC13XX_CC26XX
	bool "TI SimpleLink CC13xx / CC26xx GPIO driver"
	default y
	depends on DT_HAS_TI_CC13XX_CC26XX_GPIO_ENABLED
	help
	  Enable the TI SimpleLink CC13xx / CC26xx GPIO driver.
```

## drivers/gpio/Kconfig.cc23x0
```kconfig
# Copyright (c) 2024 Texas Instruments Incorporated
# Copyright (c) 2024 BayLibre, SAS
#
# SPDX-License-Identifier: Apache-2.0

config GPIO_CC23X0
	bool "TI SimpleLink CC23X0 GPIO driver"
	default y
	depends on DT_HAS_TI_CC23X0_GPIO_ENABLED
	help
	  Enable the TI SimpleLink CC23x0  GPIO driver.
```
