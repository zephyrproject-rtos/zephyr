## drivers/gpio/Kconfig.hi3861
```kconfig
# Copyright (c) 2023 Chen Xingyu <hi@xingrz.me>
# SPDX-License-Identifier: Apache-2.0

config GPIO_HI3861
	bool "Hi3861 GPIO"
	default y
	depends on DT_HAS_HISILICON_HI3861_GPIO_ENABLED
	help
	  Enable support for Hi3861 GPIO.
```

## drivers/gpio/Kconfig.ht16k33
```kconfig
#
# Copyright (c) 2019 Henrik Brix Andersen <henrik@brixandersen.dk>
#
# SPDX-License-Identifier: Apache-2.0
#

menuconfig GPIO_HT16K33
	bool "HT16K33 keyscan driver"
	depends on HT16K33_KEYSCAN
	help
	  Enable keyscan driver for HT16K33.

	  The HT16K33 is a memory mapping, multifunction LED
	  controller driver. The controller supports matrix key scan
	  circuit of up to 13x3 keys.

	  The keyscan functionality is exposed as up to 3 GPIO
	  controller drivers, each supporting GPIO callbacks for
	  keyscan event notifications.

if GPIO_HT16K33

config GPIO_HT16K33_INIT_PRIORITY
	int "Driver init priority"
	default 99
	help
	  Device driver initialization priority. This driver must be
	  initialized after the HT16K33 LED driver.

endif # GPIO_HT16K33
```

## drivers/gpio/Kconfig.ifx_cat1
```kconfig
# ==================================================================================================
# Copyright (c) 2025 Cypress Semiconductor Corporation (an Infineon company) or
# an affiliate of Cypress Semiconductor Corporation
#
# SPDX-License-Identifier: Apache-2.0
# ==================================================================================================

# Infineon CAT1 GPIO configuration options

config GPIO_INFINEON_CAT1
	bool "Infineon CAT1 GPIO driver"
	default y
	depends on DT_HAS_INFINEON_CAT1_GPIO_ENABLED
	help
	  Enable support for Infineon CAT1 GPIO controllers.
```

## drivers/gpio/Kconfig.imx
```kconfig
# IMX GPIO configuration options

# Copyright (c) 2018, NXP
# SPDX-License-Identifier: Apache-2.0

config GPIO_IMX
	bool "IMX GPIO driver"
	default y
	depends on DT_HAS_NXP_IMX_GPIO_ENABLED
	depends on SOC_SERIES_IMX6SX || SOC_SERIES_IMX7D
	select PINCTRL
	help
	  Enable the IMX GPIO driver.
```

## drivers/gpio/Kconfig.intel
```kconfig
# Intel SoC GPIO configuration options

# Copyright (c) 2018 Intel Corporation
# SPDX-License-Identifier: Apache-2.0

config GPIO_INTEL
	bool "Intel Soc GPIO"
	default y
	depends on DT_HAS_INTEL_GPIO_ENABLED
	help
	  Enable driver for Intel SoC GPIO

config GPIO_INTEL_CHECK_PERMS
	bool "Check permissions before manipulating GPIO"
	default y
	depends on GPIO_INTEL
	help
	  This option enables the checks to make sure the GPIO
	  pin can be manipulated. Only if the pin is owned by
	  the host software and its functioning as GPIO, then
	  the driver allows manipulating the pin.

	  Say y if unsure.
```

## drivers/gpio/Kconfig.intel_socfpga
```kconfig
# Intel SoCFPGA GPIO configuration options

# Copyright (C) 2022-2023 Intel Corporation
# SPDX-License-Identifier: Apache-2.0

config GPIO_INTEL_SOCFPGA
	bool "Intel SoC FPGA GPIO"
	default y
	depends on DT_HAS_INTEL_SOCFPGA_GPIO_ENABLED
	help
	  Enable driver for Intel SoC FPGA GPIO
```

## drivers/gpio/Kconfig.iproc
```kconfig
# Copyright 2020 Broadcom
# Copyright 2024 Meta
# SPDX-License-Identifier: Apache-2.0

config GPIO_IPROC
	bool "Broadcom iProc GPIO controller driver"
	default y
	depends on DT_HAS_BRCM_IPROC_GPIO_ENABLED
	help
	  This option enables the GPIO driver for iProc family
	  of GPIO controller.
```

## drivers/gpio/Kconfig.it51xxx
```kconfig
# Copyright (c) 2025 ITE Corporation. All Rights Reserved.
# SPDX-License-Identifier: Apache-2.0

config GPIO_ITE_IT51XXX
	bool "ITE IT51XXX GPIO driver"
	default y
	depends on DT_HAS_ITE_IT51XXX_GPIO_ENABLED
	help
	  Enable driver for the IT51XXX series GPIO controller.
```

## drivers/gpio/Kconfig.it8801
```kconfig
# Copyright (c) 2024 ITE Corporation. All Rights Reserved.
# SPDX-License-Identifier: Apache-2.0

config GPIO_ITE_IT8801
	bool "ITE IT8801 GPIO device driver"
	default y
	depends on DT_HAS_ITE_IT8801_GPIO_ENABLED
	select I2C
	select MFD
	help
	  Enable driver for ITE IT8801 I2C-based GPIO.
```

## drivers/gpio/Kconfig.it8xxx2
```kconfig
# Copyright (c) 2020 ITE Corporation. All Rights Reserved.
# SPDX-License-Identifier: Apache-2.0

config GPIO_ITE_IT8XXX2
	bool "ITE IT8XXX2 GPIO driver"
	default y
	depends on DT_HAS_ITE_IT8XXX2_GPIO_ENABLED
	help
	  Enable driver for the ite GPIO controller.

config GPIO_KSCAN_ITE_IT8XXX2
	bool "ITE IT8XXX2 GPIO KSCAN driver"
	default y
	depends on DT_HAS_ITE_IT8XXX2_GPIOKSCAN_ENABLED
	help
	  Enable GPIO KSCAN driver for ITE chip it8xxx2.
	  IT8XXX2 support 8 KSI pins and 18 KSO pins, all of them can be configured
	  to GPIO mode.
	  KSI[7:0] and KSO[15:0] pins are configured to GPIO mode by
	  this GPIO_KSCAN_ITE_IT8XXX2 driver.
	  KSO[17:16] corresponds to GPC5 and GPC3 pin, so they can be configured to
	  gpio mode by original GPIO_ITE_IT8XXX2 driver.
```

## drivers/gpio/Kconfig.k64
```kconfig
# Kconfig.k64 - K64 GPIO configuration options
#
#
# Copyright (c) 2016 Intel Corporation
# Copyright (c) 2016 Wind River Systems, Inc.
#
# Licensed under the Apache License, Version 2.0 (the "License");
# you may not use this file except in compliance with the License.
# You may obtain a copy of the License at
#
#     http://www.apache.org/licenses/LICENSE-2.0
#
# Unless required by applicable law or agreed to in writing, software
# distributed under the License is distributed on an "AS IS" BASIS,
# WITHOUT WARRANTIES OR CONDITIONS OF ANY KIND, either express or implied.
# See the License for the specific language governing permissions and
# limitations under the License.
#

menuconfig GPIO_K64
	bool "Freescale K64-based GPIO driver"
	depends on GPIO && SOC_MK64F12
	default n
	help
	  Enable driver for Freescale K64-based GPIOs.

if GPIO_K64

config PORT_K64_INT_STATUS_OFFSET
	hex "Freescale K64-based Port Control interrupt status register offset"
	depends on GPIO_K64
	default 0xA0

config GPIO_K64_A
	bool "Freescale K64-based GPIO Port A"
	depends on GPIO_K64
	default n
	help
	  Enable config options for Freescale K64-based GPIO port A.

config GPIO_K64_A_DEV_NAME
	string "Freescale K64-based GPIO Port A Device Name"
	depends on GPIO_K64_A
	default "GPIO_0"
	help
	  Specify the device name.

config GPIO_K64_PORTA_PRI
	int "Freescale K64-based Port A interrupt priority"
	depends on GPIO_K64_A
	default 2
	help
	  K64 Port A IRQ priority

config GPIO_K64_B
	bool "Freescale K64-based GPIO Port B"
	depends on GPIO_K64
	default n
	help
	  Enable config options for Freescale K64-based GPIO port B.

config GPIO_K64_B_DEV_NAME
	string "Freescale K64-based GPIO Port B Device Name"
	depends on GPIO_K64_B
	default "GPIO_1"
	help
	  Specify the device name.

config GPIO_K64_PORTB_PRI
	int "Freescale K64-based Port B interrupt priority"
	depends on GPIO_K64_B
	default 2
	help
	  K64 Port B IRQ priority

config GPIO_K64_C
	bool "Freescale K64-based GPIO Port B"
	depends on GPIO_K64
	default n
	help
	  Enable config options for Freescale K64-based GPIO port C.

config GPIO_K64_C_DEV_NAME
	string "Freescale K64-based GPIO Port C Device Name"
	depends on GPIO_K64_C
	default "GPIO_2"
	help
	  Specify the device name.

config GPIO_K64_PORTC_PRI
	int "Freescale K64-based Port C interrupt priority"
	depends on GPIO_K64_C
	default 2
	help
	  K64 Port C IRQ priority

config GPIO_K64_D
	bool "Freescale K64-based GPIO Port D"
	depends on GPIO_K64
	default n
	help
	  Enable config options for Freescale K64-based GPIO port D.

config GPIO_K64_D_DEV_NAME
	string "Freescale K64-based GPIO Port D Device Name"
	depends on GPIO_K64_D
	default "GPIO_3"
	help
	  Specify the device name.

config GPIO_K64_PORTD_PRI
	int "Freescale K64-based Port D interrupt priority"
	depends on GPIO_K64_D
	default 2
	help
	  K64 Port D IRQ priority

config GPIO_K64_E
	bool "Freescale K64-based GPIO Port E"
	depends on GPIO_K64
	default n
	help
	Enable config options for Freescale K64-based GPIO port E.

config GPIO_K64_E_DEV_NAME
	string "Freescale K64-based GPIO Port E Device Name"
	depends on GPIO_K64_E
	default "GPIO_4"
	help
	  Specify the device name.

config GPIO_K64_PORTE_PRI
	int "Freescale K64-based Port E interrupt priority"
	depends on GPIO_K64_E
	default 2
	help
	  K64 Port E IRQ priority

endif # GPIO_K64
```

## drivers/gpio/Kconfig.kb1200
```kconfig
# GPIO configuration options

# Copyright (c) 2023 ENE Technology


config GPIO_KB1200
	bool "ENE KB1200 GPIO Driver"
	depends on SOC_ENE_KB1200
	help
	  Enable support for the kb1200 GPIO controllers.
```

## drivers/gpio/Kconfig.kts162x
```kconfig
# Copyright (c) 2025 Atmosic
#
# SPDX-License-Identifier: Apache-2.0

menuconfig GPIO_KTS162X
	bool "KTS162X I2C GPIO chip"
	default y
	depends on DT_HAS_KINETIC_KTS162X_ENABLED
	select I2C
	help
	  Enable driver for KTS162X I2C GPIO expander.

config GPIO_KTS162X_INIT_PRIORITY
	int "Init priority"
	default 70
	depends on GPIO_KTS162X
	help
	  Device driver initialization priority.

config GPIO_KTS1620
	bool "KTS1620"
	default y
	depends on GPIO_KTS162X
	help
	  Select KTS1620 register map
```

## drivers/gpio/Kconfig.litex
```kconfig
# Litex VexRiscV GPIO configuration options

# Copyright (c) 2019 Antmicro <www.antmicro.com>
# SPDX-License-Identifier: Apache-2.0

config GPIO_LITEX
	bool "Litex GPIO driver"
	default y
	depends on DT_HAS_LITEX_GPIO_ENABLED
	help
	  Enable Litex GPIO driver.
```

## drivers/gpio/Kconfig.lmp90xxx
```kconfig
# LMP90xxx GPIO configuration options

# Copyright (c) 2019 Vestas Wind Systems A/S
# SPDX-License-Identifier: Apache-2.0

menuconfig GPIO_LMP90XXX
	bool "LMP90xxx GPIO driver"
	default y
	depends on DT_HAS_TI_LMP90XXX_GPIO_ENABLED
	depends on ADC_LMP90XXX_GPIO
	help
	  Enable GPIO driver for LMP90xxx.

	  The LMP90xxx is a multi-channel, low power sensor analog
	  frontend (AFE).

	  The GPIO port of the LMP90xxx (D6 to D0) is exposed as a
	  GPIO controller driver with read/write support.

config GPIO_LMP90XXX_INIT_PRIORITY
	int "Driver init priority"
	default 99
	depends on GPIO_LMP90XXX
	help
	  Device driver initialization priority. This driver must be
	  initialized after the LMP90xxx ADC driver.
```

## drivers/gpio/Kconfig.lpc11u6x
```kconfig
# LPC11U6x GPIO configuration options

# Copyright (c) 2020 Seagate Technology LLC
# SPDX-License-Identifier: Apache-2.0

config GPIO_LPC11U6X
	bool "LPC11U6x GPIO driver"
	default y
	depends on DT_HAS_NXP_LPC11U6X_GPIO_ENABLED
	depends on CLOCK_CONTROL_LPC11U6X
	depends on PINMUX_LPC11U6X
	help
	  Enable GPIO driver for LPC11U6x MCUs.
```

## drivers/gpio/Kconfig.lpc84x
```kconfig
# Copyright (c) 2026 Aerlync Labs Inc.
# SPDX-License-Identifier: Apache-2.0

config GPIO_LPC84X
	bool "LPC84X GPIO driver"
	default y
	select PINCTRL
	depends on DT_HAS_NXP_LPC84X_GPIO_ENABLED
	help
	  Enable GPIO driver for LPC84x.
```

## drivers/gpio/Kconfig.m5pm1
```kconfig
# Copyright (c) 2026 The Zephyr Project Contributors
# SPDX-License-Identifier: Apache-2.0

config GPIO_M5PM1
	bool "M5Stack M5PM1 GPIO driver"
	default y
	depends on DT_HAS_M5STACK_M5PM1_GPIO_ENABLED
	select MFD
	help
	  Enable the GPIO controller driver for the M5Stack M5PM1.

config GPIO_M5PM1_INIT_PRIORITY
	int "M5PM1 GPIO driver initialization priority"
	depends on GPIO_M5PM1
	default 82
	help
	  Initialization priority for the M5PM1 GPIO driver. It must be
	  greater than the MFD initialization priority.
```

## drivers/gpio/Kconfig.max14906
```kconfig
# Copyright (c) 2024 Analog Devices Inc.
# Copyright (c) 2024 BayLibre SAS
# SPDX-License-Identifier: Apache-2.0

# MAX14906 GPIO configuration options

menuconfig GPIO_MAX14906
	bool "MAX14906 GPIO driver"
	default y
	depends on DT_HAS_ADI_MAX14906_GPIO_ENABLED && SPI
	help
	  Enabe MAX14906 quad industrial digital
	  input/output with diagnostics

config GPIO_MAX14906_INIT_PRIORITY
	int "Driver init priority"
	default 99
	depends on GPIO_MAX14906
	help
	  Device driver initialization priority.
```

## drivers/gpio/Kconfig.max14916
```kconfig
# Copyright (c) 2024 Analog Devices Inc.
# Copyright (c) 2024 BayLibre SAS
# SPDX-License-Identifier: Apache-2.0

# MAX14916 GPIO configuration options

menuconfig GPIO_MAX14916
	bool "MAX14916 GPIO driver"
	default y
	depends on DT_HAS_ADI_MAX14916_GPIO_ENABLED && SPI
	help
	  Enabe MAX1416 octal industrial digital
	  output with diagnostics

config GPIO_MAX14916_INIT_PRIORITY
	int "Driver init priority"
	default 99
	depends on GPIO_MAX14916
	help
	  Device driver initialization priority.
```

## drivers/gpio/Kconfig.max14917
```kconfig
# Copyright (c) 2025 Analog Devices Inc.
# SPDX-License-Identifier: Apache-2.0

# MAX14917 GPIO configuration options

menuconfig GPIO_MAX14917
	bool "MAX14917 GPIO driver"
	default y
	select CRC
	depends on DT_HAS_ADI_MAX14917_GPIO_ENABLED && SPI
	help
	  Enable MAX14917 octal industrial digital
	  output with diagnostics

config GPIO_MAX14917_INIT_PRIORITY
	int "Driver init priority"
	default 99
	depends on GPIO_MAX14917
	help
	  Device driver initialization priority.
```

## drivers/gpio/Kconfig.max22017
```kconfig
# Copyright (c) 2024 Analog Devices Inc.
# Copyright (c) 2024 BayLibre SAS
# SPDX-License-Identifier: Apache-2.0

config GPIO_MAX22017
	bool "Analog Devices MAX22017 GPIO support"
	default y
	depends on DT_HAS_ADI_MAX22017_GPIO_ENABLED
	select MFD
	help
	  Enable GPIO support for the Analog Devices MAX22017

if GPIO_MAX22017

config GPIO_MAX22017_INIT_PRIORITY
	int "Init priority"
	default 81
	help
	  Analog Devices MAX22017 gpio device driver initialization priority.

config GPIO_MAX22017_INT_QUIRK
	bool "MAX22017 GPIO Interrupt quirk"
	help
	  The GPIO controller will not report any new GPI interrupt as long as its interrupt status
	  register hasn't been read.
	  Reading the interrupt status register happens on a falling edge of the INT pin.
	  There seems to be a condition when the GPIO controller detects an interrupt but it's INT
	  pin stays high which masks any subsequent interrupts.
	  To avoid being stuck in that state, fire a timer to periodically check the interrupt status
	  register.

endif # GPIO_MAX22017
```

## drivers/gpio/Kconfig.max2219x
```kconfig
# Copyright (c) 2024 Analog Devices Inc.
# Copyright (c) 2024 BayLibre SAS
# SPDX-License-Identifier: Apache-2.0

# MAX22190 GPIO configuration options

menuconfig GPIO_MAX2219X
	bool "MAX2219X GPIO driver"
	default y
	depends on SPI
	depends on DT_HAS_ADI_MAX22190_GPIO_ENABLED || DT_HAS_ADI_MAX22199_GPIO_ENABLED
	help
	  Enabe MAX2219X Octal industrial digital
	  input with diagnostics

config GPIO_MAX22190_INIT_PRIORITY
	int "Driver init priority"
	default 99
	depends on GPIO_MAX2219X
	help
	  Device driver initialization priority.
```

## drivers/gpio/Kconfig.max32
```kconfig
# Copyright (c) 2023-2024 Analog Devices, Inc.
# SPDX-License-Identifier: Apache-2.0

config GPIO_MAX32
	bool "GPIO Driver for MAX32 family of MCUs"
	default y
	depends on DT_HAS_ADI_MAX32_GPIO_ENABLED
	help
	  Enable GPIO driver for MAX32 line of MCUs
```

## drivers/gpio/Kconfig.max7321
```kconfig
# MAX7321 GPIO configuration options

# Copyright (c) 2025 Analog Devices, Inc.
# SPDX-License-Identifier: Apache-2.0

menuconfig GPIO_MAX7321
	bool "MAX7321 I2C GPIO chip"
	default y
	depends on DT_HAS_ADI_MAX7321_ENABLED
	select I2C
	help
	  Enable driver for MAX7321 I2C GPIO chip.

config GPIO_MAX7321_INIT_PRIORITY
	int "Init priority"
	default I2C_INIT_PRIORITY
	depends on GPIO_MAX7321
	help
	  Device driver initialization priority.
```
