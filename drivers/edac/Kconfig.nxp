## drivers/edac/Kconfig.nxp
```kconfig
# Copyright 2025 NXP
#
# SPDX-License-Identifier: Apache-2.0

config EDAC_NXP_ERM
	bool "NXP ERM driver"
	default y
	depends on DT_HAS_NXP_ERM_ENABLED
	help
	  Enable the NXP Error Reporting Module driver.

config EDAC_NXP_ERM_DEFAULT_CHANNEL
	int "NXP ERM default channel"
	default 0
	depends on EDAC_NXP_ERM
	help
	  Set the NXP Error Reporting Module default channel.

config EDAC_NXP_EIM
	bool "NXP EIM driver"
	default y
	depends on DT_HAS_NXP_EIM_ENABLED
	select EDAC_ERROR_INJECT
	help
	  Enable the NXP Error Injection Module driver.
```

## drivers/edac/edac_ibecc/Kconfig
```kconfig
# Copyright (c) 2023 Intel Corp.
# SPDX-License-Identifier: Apache-2.0
#


config EDAC_IBECC
	bool "In-Band ECC (IBECC)"
	depends on X86 && PCIE
	help
	  This option selects In-Band ECC (IBECC) IP support.

if EDAC_IBECC

config EDAC_SHELL_IBECC
	bool "EDAC Shell"
	depends on SHELL
	default y if SHELL
	help
	  Enable EDAC shell for debugging EDAC.

endif #EDAC_IBECC
```

## drivers/edac/edac_intel_socfpga/Kconfig
```kconfig
# Copyright (c) 2023 Intel Corporation
# SPDX-License-Identifier: Apache-2.0
#
# EDAC (Error Detection And Correction) Agilex5 configuration options
config EDAC_INTEL_SOCFPGA
	bool "Intel SoC FPGA EDAC module"
	default n
	help
	 Enable the EDAC module for Intel SoC FPGA device

config EDAC_SHELL_INTEL_SOCFPGA
	bool "EDAC Shell"
	default y if (SHELL && EDAC_INTEL_SOCFPGA)
	help
	  Enable EDAC shell for debugging EDAC.

config EDAC_INTEL_SOC_FPGA_INIT_PRIORITY
	int "EDAC init function priority. This value must be more than HPS ECC and IO96B drivers init priority"
	default 57

module = EDAC_INTEL_SOCFPGA
module-str = edac_intel_socfpga
source "subsys/logging/Kconfig.template.log_config"

source "drivers/edac/edac_intel_socfpga/Kconfig.hps_ecc"
source "drivers/edac/edac_intel_socfpga/Kconfig.io96b_ecc"
```

## drivers/edac/edac_intel_socfpga/Kconfig.hps_ecc
```kconfig
# Copyright (c) 2023, Intel Corporation
# SPDX-License-Identifier: Apache-2.0

config HPS_ECC_INTEL_SOCFPGA
	bool "Intel SoC FPGA HPS ECC driver"
	depends on (DT_HAS_INTEL_SOCFPGA_HPS_ECC_ENABLED && EDAC_INTEL_SOCFPGA)
	default y
	help
	 Enable the HPS ECC driver for Intel SoC FPGA device

config HPS_ECC_INIT_PRIORITY
	int "HPS ECC init function priority. This value must be more than SIP SVC subsystem init priority"
	default 56

module = HPS_ECC
module-str = hps_ecc
source "subsys/logging/Kconfig.template.log_config"
```

## drivers/edac/edac_intel_socfpga/Kconfig.io96b_ecc
```kconfig
# Copyright (c) 2023 Intel Corporation
# SPDX-License-Identifier: Apache-2.0
#
# IO96B configuration options

menuconfig IO96B_INTEL_SOCFPGA
	bool "in/out subsystem manager"
	depends on (DT_HAS_INTEL_IO96B_ENABLED && EDAC_INTEL_SOCFPGA)
	help
	  Enable IO96B driver.

if IO96B_INTEL_SOCFPGA

config SHELL_IO96B_INTEL_SOCFPGA
	bool "IO96B Shell"
	depends on SHELL
	default n
	help
	  Enable IO96B shell for debugging IO96B driver.

module = IO96B
module-str = io96b
source "subsys/logging/Kconfig.template.log_config"

endif #IO96B
```

## drivers/eeprom/Kconfig
```kconfig
# EEPROM driver configuration options

# Copyright (c) 2019 Vestas Wind Systems A/S
# SPDX-License-Identifier: Apache-2.0

menuconfig EEPROM
	bool "Electrically Erasable Programmable Read-Only Memory (EEPROM) drivers"
	help
	  Enable support for EEPROM hardware.

if EEPROM

module = EEPROM
module-str = eeprom
source "subsys/logging/Kconfig.template.log_config"

config EEPROM_INIT_PRIORITY
	int "EEPROM init priority"
	default KERNEL_INIT_PRIORITY_DEVICE
	help
	  EEPROM driver device initialization priority. This initialization
	  priority is used unless the driver implementation has its own
	  initialization priority.

config EEPROM_SHELL
	bool "EEPROM shell"
	depends on SHELL
	help
	  Enable the EEPROM shell with EEPROM related commands.

config EEPROM_SHELL_BUFFER_SIZE
	int "EEPROM shell buffer size"
	default 256
	depends on EEPROM_SHELL
	help
	  Size of the buffer used for EEPROM read/write commands in
	  the EEPROM shell.

config EEPROM_AT2X_EMUL
	bool "Emulate an Atmel AT24 I2C chip"
	depends on EMUL
	help
	  This is an emulator for the Atmel AT24 series of I2C-attached EEPROMs.

	  At present it only supports 8-bit addressing. The size of the EEPROM
	  is given by the 'size' property. See the binding for further details.

source "drivers/eeprom/Kconfig.lpc11u6x"
source "drivers/eeprom/Kconfig.stm32"
source "drivers/eeprom/Kconfig.eeprom_emu"
source "drivers/eeprom/Kconfig.tmp116"
source "drivers/eeprom/Kconfig.xec"
source "drivers/eeprom/Kconfig.mb85rcxx"
source "drivers/eeprom/Kconfig.at2x"

config EEPROM_SIMULATOR
	bool "Simulated EEPROM driver"
	default y
	depends on DT_HAS_ZEPHYR_SIM_EEPROM_ENABLED
	select STATS
	select STATS_NAMES
	help
	  Enable Simulated EEPROM driver.

config EEPROM_SIMULATOR_SIMULATE_TIMING
	bool "Hardware timing simulation"
	depends on EEPROM_SIMULATOR
	help
	  Enable Simulated hardware timing.

if EEPROM_SIMULATOR_SIMULATE_TIMING

config EEPROM_SIMULATOR_MIN_READ_TIME_US
	int
	prompt "Minimum read time (µS)"
	default 2
	range 1 1000000

config EEPROM_SIMULATOR_MIN_WRITE_TIME_US
	int
	prompt "Minimum write time (µS)"
	default 100
	range 1 1000000

endif # EEPROM_SIMULATOR_SIMULATE_TIMING

config EEPROM_FAKE
	bool "Fake EEPROM driver"
	default y
	depends on DT_HAS_ZEPHYR_FAKE_EEPROM_ENABLED
	help
	  Enable support for the FFF-based fake EEPROM driver.

endif # EEPROM
```

## drivers/eeprom/Kconfig.24aa02xexx
```kconfig
# Copyright (c) 2021 Benjamin S. Scarlet
# SPDX-License-Identifier: Apache-2.0

config EEPROM_24AA02XEXX
	bool "Microchip 24AA02XEXX I2C EEPROM with EUI node identity driver"
	default n
	help
	  Enable support for the Microchip 24AA02XEXX family of EEPROMs with EUI node identity.

config EEPROM_24AA02XEXX_INIT_PRIORITY
	int "Microchip 24AA02XEXX I2C EEPROM init priority"
	default 75
	depends on EEPROM_24AA02XEXX

config EEPROM_24AA02XEXX_MAX_WRITE_RETRIES
	int "Maximum number of times to check for completion when writing to a 24AA02XEXX"
	default 3
	help
	  At present, the Zephyr I2C API does not distinguish between NACK, which the
	  24AA02XEXX uses to communicate a write is not yet completed, from other I2C
	  error conditions. When waiting for write completion, this driver will retry
	  on any error up to this many times. Usually, the first or second check will
	  pass. In case of some other real, persistent error, this limit keeps the
	  driver from retrying forever.
```

## drivers/eeprom/Kconfig.24xx01
```kconfig
# Copyright (c) 2024 Basalte bv
# SPDX-License-Identifier: Apache-2.0

config EEPROM_24XX01
	bool "Microchip 24XX01 I2C EEPROM support"
	default y
	depends on DT_HAS_MICROCHIP_24XX01_EEPROM_ENABLED
	select I2C
	help
	  Enable support for the Microchip 24XX01 I2C EEPROMs.
```

## drivers/eeprom/Kconfig.at25xv021a
```kconfig
# Copyright (c) 2025 Cirrus Logic, Inc.
# SPDX-License-Identifier: Apache-2.0

config EEPROM_AT25XV021A
	bool "AT25 SPI EEPROMs variants with protect sector functionality"
	default y
	depends on DT_HAS_ATMEL_AT25XV021A_ENABLED
	select SPI
	help
		Enable support for the AT25 variants with protect sector functions.

		Vendors that have manufactured such variants include:
		- Renesas Electronics
		- Adesto Technologies
```

## drivers/eeprom/Kconfig.at2x
```kconfig
# Copyright (c) 2019 Vestas Wind Systems A/S
# Copyright (c) 2024 SILA Embedded Solutions GmbH
# SPDX-License-Identifier: Apache-2.0

config EEPROM_AT2X
	bool
	help
	  Enable support for Atmel AT2x (and compatible) I2C/SPI
	  EEPROMs.

config EEPROM_AT2X_I2C
	bool "I2C EEPROMs compatible with Atmel's AT24 family"
	select I2C
	select EEPROM_AT2X
	help
	  Enable support for I2C EEPROMs compatible with Atmel's AT24 family.

	  There are multiple vendors manufacturing I2C EEPROMs compatible with
	  the programming model of the Atmel AT24.

	  Examples of compatible EEPROM families:
	  - Microchip AT24xxx
	  - ST M24xxx

config EEPROM_AT2X_SPI
	bool "SPI EEPROMs compatible with Atmel's AT25 family"
	select SPI
	select EEPROM_AT2X
	help
	  Enable support for SPI EEPROMs compatible with Atmel's AT25 family.

	  There are multiple vendors manufacturing SPI EEPROMs compatible with
	  the programming model of the Atmel AT25.

	  Examples of compatible EEPROM families:
	  - Microchip AT25xxx
	  - ST M95xxx

config EEPROM_AT24
	bool "Atmel AT24 I2C EEPROM support"
	default y
	depends on DT_HAS_ATMEL_AT24_ENABLED
	select EEPROM_AT2X_I2C
	help
	  Enable support for Atmel AT24 I2C EEPROMs.

config EEPROM_AT25
	bool "Atmel AT25 SPI EEPROM support"
	default y
	depends on DT_HAS_ATMEL_AT25_ENABLED
	select EEPROM_AT2X_SPI
	help
	  Enable support for Atmel AT25 SPI EEPROMs.

config EEPROM_M24
	bool "ST M24 I2C EEPROM support"
	default y
	depends on DT_HAS_ST_M24XXX_ENABLED
	select EEPROM_AT2X_I2C
	help
	  Enable support for ST M24 I2C EEPROMs.

config EEPROM_AT2X_INIT_PRIORITY
	int "AT2X EEPROM init priority"
	default 80
	depends on EEPROM_AT2X
	help
	  AT2X EEPROM driver device initialization priority.

	  The EEPROM is connected to I2C or SPI bus and has to be initialized
	  after I2C/SPI driver.
```

## drivers/eeprom/Kconfig.ateccx08
```kconfig
# Microchip ATECCx08 eeprom driver configuration

# Copyright (c) 2024 Vogl Electronic GmbH
# SPDX-License-Identifier: Apache-2.0

config EEPROM_ATECCX08_OTP
	bool "Microchip ATECCx08 otp eeprom driver"
	default y
	depends on DT_HAS_MICROCHIP_ATECCX08_OTP_ENABLED
	depends on MFD_ATECCX08
	help
	  This option enables the Microchip ATECCx08 otp eeprom driver.

config EEPROM_ATECCX08_OTP_INIT_PRIORITY
	int "Microchip ATECCx08 otp eeprom driver initialization priority"
	default MFD_ATECCX08_SUBDEVICE_INIT_PRIORITY
	depends on EEPROM_ATECCX08_OTP
	help
	  Microchip ATECCx08 otp eeprom device initialization priority.
```

## drivers/eeprom/Kconfig.eeprom_emu
```kconfig
# Copyright (c) 2020 Laczen
# SPDX-License-Identifier: Apache-2.0

config EEPROM_EMULATOR
	bool "Emulated EEPROM driver"
	default y
	depends on DT_HAS_ZEPHYR_EMU_EEPROM_ENABLED
	select FLASH
	help
	  Enable emulated (on flash) EEPROM support. This mimics an external
	  EEPROM on a flash partition. The number of writes that can be
	  performed to the EEPROM is maximized by using a flash area that is
	  larger than the EEPROM area and by storing only changes to the EEPROM
	  data.
```

## drivers/eeprom/Kconfig.fm24w256
```kconfig
# Copyright (c) 2021 Caspar Friedrich <c.s.w.friedrich@gmail.com>
# SPDX-License-Identifier: Apache-2.0

config EEPROM_FM24W256
	bool "Cypress FM24W256 EEPROM driver"
	depends on I2C
```

## drivers/eeprom/Kconfig.fm25w256
```kconfig
# Copyright (c) 2021 Caspar Friedrich <c.s.w.friedrich@gmail.com>
# SPDX-License-Identifier: Apache-2.0

config EEPROM_FM25W256
	bool "Cypress FM25W256 EEPROM driver"
	depends on SPI
```

## drivers/eeprom/Kconfig.fm25xxx
```kconfig
# Copyright (c) 2025 Luna Pes <zephyr@orangemurker.com>
# SPDX-License-Identifier: Apache-2.0

config EEPROM_FM25XXX
	bool "Infineon FM25XXX SPI FRAM"
	default y
	depends on DT_HAS_INFINEON_FM25XXX_ENABLED
	select SPI
	help
	  Enable Infineon FM25XXX SPI FRAM
```

## drivers/eeprom/Kconfig.lpc11u6x
```kconfig
# Copyright (c) 2020 Seagate Technology LLC
# SPDX-License-Identifier: Apache-2.0

config EEPROM_LPC11U6X
	bool "LPC11U6x EEPROM driver"
	default y
	depends on DT_HAS_NXP_LPC11U6X_EEPROM_ENABLED
	help
	  Enable support for the on-chip EEPROM found on NXP LPC11U6x MCUs.
```

## drivers/eeprom/Kconfig.m24xxx
```kconfig
# Copyright (c) 2024 SILA Embedded Solutions GmbH
# SPDX-License-Identifier: Apache-2.0

config EEPROM_M24XXX
	bool "ST Automotive I2C EEPROM"
	default y
	depends on DT_HAS_ST_M24M02_A125_ENABLED || \
		   DT_HAS_ST_M24M01_A125_ENABLED || \
		   DT_HAS_ST_M24C64_A125_ENABLED || \
		   DT_HAS_ST_M24C32_A125_ENABLED || \
		   DT_HAS_ST_M24C16_A125_ENABLED || \
		   DT_HAS_ST_M24C08_A125_ENABLED || \
		   DT_HAS_ST_M24C04_A125_ENABLED
	select I2C
	help
	  Enable ST Automotive I2C EEPROM
```

## drivers/eeprom/Kconfig.mb85rcxx
```kconfig
# Copyright (c) 2023 Antmicro <www.antmicro.com>
# SPDX-License-Identifier: Apache-2.0

config EEPROM_MB85RCXX
	bool "FUJITSU mb85rcxx i2c FRAM"
	default y
	depends on DT_HAS_FUJITSU_MB85RCXX_ENABLED
	select I2C
	help
	  Enable FUJITSU mb85rcxx i2c FRAM
```

## drivers/eeprom/Kconfig.microchip_47l16
```kconfig
# Microchip 47L16 EERAM driver configuration
# Copyright (c) 2025, Ambiq Micro Inc. <www.ambiq.com>
# SPDX-License-Identifier: Apache-2.0

config EEPROM_MICROCHIP_47L16
	bool "Microchip 47L16 I2C SRAM with EEPROM backup"
	default y
	depends on DT_HAS_MICROCHIP_47L16_ENABLED
	select I2C
	help
	  Enable support for Microchip 47L16 2KB I2C SRAM with EEPROM
	  backup (EERAM).

	  The device provides 2048 bytes of SRAM accessible over I2C with
	  immediate write capability (no write cycle delays). SRAM contents
	  are automatically backed up to internal EEPROM on power loss for
	  non-volatile storage.

	  A second I2C address (0x18) provides access to control registers
	  for manual backup/restore (not implemented).

config EEPROM_MICROCHIP_47L16_INIT_PRIORITY
	int "Microchip 47L16 EERAM init priority"
	default 80
	depends on EEPROM_MICROCHIP_47L16
	help
	  Microchip 47L16 EERAM driver device initialization priority.

	  The EERAM is connected to I2C bus and must be initialized after
	  the I2C driver.
```

## drivers/eeprom/Kconfig.s3axx04
```kconfig
# Copyright (c) 2025 MASSDRIVER EI (massdriver.space)
# SPDX-License-Identifier: Apache-2.0

config EEPROM_S3AXX04
	bool "Netsol S3Axx04 MRAM"
	default y
	depends on DT_HAS_NETSOL_S3AXX04_ENABLED
	select SPI
	help
	  Enable Netsol S3Axx04 SPI MRAM
```

## drivers/eeprom/Kconfig.st25dv
```kconfig
# Copyright (c) 2023 Kickmaker
# SPDX-License-Identifier: Apache-2.0

config EEPROM_ST25DV
	bool "ST25DV NFC as EEPROM"
	default y
	depends on DT_HAS_ST_ST25DV_ENABLED
	select I2C
	help
	  Enable support for ST25DV NFC tag for use as an EEPROM.

if EEPROM_ST25DV

config EEPROM_ST25DV_ENABLE_ADVANCED_FEATURES
	bool "ST25DV advanced features"
	default n
	help
	  Enable advanced features of the ST25DV like mailbox access, password, zone definition.

endif
```

## drivers/eeprom/Kconfig.stm32
```kconfig
# Copyright (c) 2019 Kwon Tae-young <tykwon@m2i.co.kr>
# SPDX-License-Identifier: Apache-2.0

config EEPROM_STM32
	bool "STM32 EEPROM driver"
	default y
	depends on DT_HAS_ST_STM32_EEPROM_ENABLED
	select USE_STM32_HAL_FLASH
	select USE_STM32_HAL_FLASH_EX
	help
	  Enable EEPROM support on the STM32 L0, L1 family of processors.
```

## drivers/eeprom/Kconfig.tmp116
```kconfig
# Copyright (c) 2021 Innoseis B.V.
# SPDX-License-Identifier: Apache-2.0

config EEPROM_TMP116
	bool "TMP116 EEPROM driver"
	default y
	depends on DT_HAS_TI_TMP116_EEPROM_ENABLED
	depends on TMP116
	help
	  Enable support for the on-chip EEPROM found on
	  Texas instrument TMP116 temperature sensor
```

## drivers/eeprom/Kconfig.xec
```kconfig
# Microchip XEC EEPROM

# Copyright (c) 2022 Microchip Technology Inc.
# SPDX-License-Identifier: Apache-2.0

config EEPROM_XEC
	bool "MCHP XEC EEPROM driver"
	default y
	depends on DT_HAS_MICROCHIP_XEC_EEPROM_ENABLED
	select PINCTRL
	help
	  Enable support for Microchip XEC EEPROM driver.
```

## drivers/eeprom/ateccx08/Kconfig
```kconfig
# Microchip ATECCx08 EEPROM

# Copyright (c) 2024 Vogl Electronic GmbH
# SPDX-License-Identifier: Apache-2.0

config EEPROM_ATECCX08
	bool
	help
	  Enable support for Microchip ATECCx08 I2C EEPROMs.

config EEPROM_ATECC608
	bool "Microchip ATECC608 I2C EEPROM support"
	default y
	depends on DT_HAS_MICROCHIP_ATECC608_ENABLED
	select I2C
	select EEPROM_ATECCX08
	help
	  Enable support for Microchip ATECC608 I2C EEPROMs.

config EEPROM_ATECC508
	bool "Microchip ATECC508 I2C EEPROM support"
	default y
	depends on DT_HAS_MICROCHIP_ATECC508_ENABLED
	select I2C
	select EEPROM_ATECCX08
	help
	  Enable support for Microchip ATECC508 I2C EEPROMs.
```
