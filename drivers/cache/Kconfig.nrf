## drivers/cache/Kconfig.nrf
```kconfig
# Copyright (c) 2024 Carlo Caione <ccaione@baylibre.com>
# SPDX-License-Identifier: Apache-2.0

config CACHE_NRF_CACHE
	bool "nRF cache driver"
	select CACHE_HAS_DRIVER
	depends on HAS_NRFX && CACHE_MANAGEMENT
	help
	  Enable support for the nRF cache driver.

config CACHE_NRF_PATCH_LINEADDR
	bool "Patch lineaddr"
	default y if SOC_NRF54H20 || SOC_NRF54H20_ENGB
	help
	  Manually set 28th bit in the LINEADDR in Trustzone Secure build.
```

## drivers/cache/Kconfig.nxp_cache64
```kconfig
# Copyright 2025 NXP
# SPDX-License-Identifier: Apache-2.0

config CACHE_NXP_CACHE64_INIT
	bool "NXP CACHE64 POLSEL init for FlexSPI/XSPI"
	default y
	depends on HAS_MCUX_CACHE64 && CACHE_INIT_ONLY
	help
	  Initialize CACHE64 policy selector (POLSEL) from Devicetree and optionally
	  enable write buffer and cache. No system cache maintenance API is provided.

config CACHE_NXP_CACHE64_INIT_PRIORITY
	int "NXP CACHE64 init priority (POST_KERNEL)"
	default 10
	help
	  Initialization priority for the CACHE64 POLSEL setup. This driver must
	  run after the FlexSPI NOR flash driver, which typically uses
	  CONFIG_FLASH_INIT_PRIORITY (often 80). Choose a value greater than the
	  flash init priority to ensure FlexSPI reset does not wipe cache settings.
```

## drivers/cache/Kconfig.nxp_lmem_cache
```kconfig
# Copyright 2025 NXP
# SPDX-License-Identifier: Apache-2.0

config CACHE_NXP_LMEM_CACHE
	bool "NXP LMEM cache driver"
	default y
	select CACHE_HAS_DRIVER
	depends on HAS_MCUX_LMEM_CACHE
	help
	  This option enables the LMEM cache driver for NXP SOCs.
```

## drivers/cache/Kconfig.nxp_mcm_lpcac
```kconfig
# Copyright 2026 NXP
# SPDX-License-Identifier: Apache-2.0

config CACHE_NXP_MCM_LPCAC
	bool "NXP MCM LPCAC code cache driver"
	default y
	select CACHE_HAS_DRIVER
	depends on HAS_MCUX_MCM_LPCAC
	help
	  This option enables the LPCAC code cache driver for NXP SoCs whose
	  Low Power Cache Controller is configured through the Miscellaneous
	  Control Module (MCM) CPCR2 register (for example MCX W7x / KW45 /
	  KW47), as opposed to the SYSCON LPCAC_CTRL register handled by
	  CACHE_NXP_SYSCON_LPCAC.
```

## drivers/cache/Kconfig.nxp_syscon_lpcac
```kconfig
# Copyright 2025 NXP
# SPDX-License-Identifier: Apache-2.0

config CACHE_NXP_SYSCON_LPCAC
	bool "NXP external cache driver for NXP syscon lpcac controller"
	default y
	select CACHE_HAS_DRIVER
	depends on HAS_MCUX_SYSCON_LPCAC
	help
	  This option enables the syscon lpcac driver for NXP SoCs.
```

## drivers/cache/Kconfig.nxp_xcache
```kconfig
# Copyright 2025 NXP
# SPDX-License-Identifier: Apache-2.0

config CACHE_NXP_XCACHE
	bool "NXP external cache driver for xcache controller"
	default y
	select CACHE_HAS_DRIVER
	depends on HAS_MCUX_XCACHE
	help
	  This option enables the XCACHE driver for NXP SOC's.
```

## drivers/cache/Kconfig.pl310
```kconfig
# Copyright (c) 2026 Analog Devices, Inc.
# SPDX-License-Identifier: Apache-2.0

config CACHE_PL310
	bool "ARM L2C-310 (PL310) outer-cache driver"
	default y
	depends on DT_HAS_ARM_PL310_CACHE_ENABLED
	depends on DCACHE && CACHE_MANAGEMENT
	select OUTER_CACHE
	help
	  Enable the driver for the ARM L2C-310 (PL310) outer (L2) cache
	  controller. On a Cortex-A/R core it provides the z_arm_outer_cache_*
	  hooks so that every L1 data-cache maintenance operation is paired with
	  the matching outer-cache operation, keeping DMA buffers coherent across
	  both cache levels.

	  This is the outer cache level only: it selects OUTER_CACHE but
	  deliberately does not select CACHE_HAS_DRIVER, because the
	  CPU-integrated L1 cache keeps owning the cache_data_* API.
```

## drivers/cache/Kconfig.siwx91x
```kconfig
# SPDX-FileCopyrightText: Copyright (c) 2026 Silicon Laboratories Inc.
# SPDX-License-Identifier: Apache-2.0

config CACHE_SILABS_SIWX91X
	bool "Silabs SiWx91x instruction cache driver"
	select CACHE_HAS_DRIVER
	depends on SOC_FAMILY_SILABS_SIWX91X
	depends on CACHE_MANAGEMENT
	default y
	help
	  Enable support for the SiWx91x external AHB instruction cache.

	  The SiWx91x has a read-only instruction cache for the QSPI flash. It
	  has no data cache. Full invalidation is performed by toggling the cache
	  clock gate. There is no per-line (range) invalidation.
```

## drivers/cache/Kconfig.stm32
```kconfig
# Copyright (c) 2025 Henrik Lindblom <henrik.lindblom@vaisala.com>
# SPDX-License-Identifier: Apache-2.0

menuconfig CACHE_STM32
	bool "STM32 cache driver"
	select CACHE_HAS_DRIVER
	depends on CACHE_MANAGEMENT
	help
	  Enable support for the STM32 ICACHE / DCACHE peripheral present in some STM32 chips.

if CACHE_STM32

# "default n" for L5 is legacy - could be removed?
config CACHE_STM32_ICACHE_DIRECT_MAPPING
	bool "Use 1-way associative mapping for ICACHE"
	default n if SOC_SERIES_STM32L5X
	default y
	help
	  Use ICACHE in direct mapping (1-way associative) mode instead of the default n-way
	  associative cache mode.

	  This option reduces power consumption but slightly reduces cache's performance.

endif # CACHE_STM32
```

## drivers/cache/Kconfig.vexriscv
```kconfig
# Copyright The Zephyr Project Contributors
# SPDX-License-Identifier: Apache-2.0

config CACHE_VEXRISCV
	bool "VexRiscv cache driver"
	select CACHE_HAS_DRIVER
	help
	  Enable support for the VexRiscv cache driver.
```

## drivers/cache/Kconfig.xuantie
```kconfig
# Copyright (c) 2025 MASSDRIVER EI <massdriver.space>
# SPDX-License-Identifier: Apache-2.0

config CACHE_XTHEADCMO
	bool "Xuantie T-HEAD xtheadcmo extension cache control driver"
	default y
	select CACHE_HAS_DRIVER
	depends on DT_HAS_XUANTIE_XTHEADCMO_ENABLED
	help
	  This option enables the CACHE driver for xuantie cores using the xtheadcmo extension

if CACHE_XTHEADCMO

config CACHE_XTHEADCMO_E907
	bool "Additional xtheadcmo cache functions for E907 core"
	default y
	depends on SOC_SERIES_BL61X
	help
	  This option enables the additional xtheadcmo cache functions for the E907 cores

endif # CACHE_XTHEADCMO
```

## drivers/camera/Kconfig
```kconfig
# Kconfig - Camera drivers

#
# Copyright (c) 2019 NXP Corporation
#
# SPDX-License-Identifier: Apache-2.0
#

menuconfig CAMERA
	bool "Camera Drivers"
	help
	  Enable camera drivers

if CAMERA

module = CAMERA
module-str = camera

config CAMERA_DISPLAY_DEV_NAME
	string "Camera display device name"
	default "CAMERA DISPLAY"
	help
	  Name of the display device to display camera.

config IMAGE_SENSOR_INIT_PRIO
	int "Image sensor initalization priority level"
	default 70
	range 70 80
	help
	  Image sensor initialization priority level.
	  This number tells how early in the boot
	  the image sensor driver and image sensor vendor
	  driver are initialized.

config CAMERA_INIT_PRIO
	int "Camera initalization priority level"
	default 81
	range 81 90
	help
	  Camera initialization priority level.
	  This number tells how early in the boot
	  the camera vendor drivers are initialized.
	  Camera initalization depneds on image sensors,
	  so CAMERA_INIT_PRIO must be greater than
	  IMAGE_SENSOR_INIT_PRIO.

endif
```

## drivers/camera/mt9m114/Kconfig
```kconfig
# Kconfig - MT9M114 image sensor configuration options

#
# Copyright (c) 2019 NXP Corporation
#
# SPDX-License-Identifier: Apache-2.0
#

if MT9M114

config MT9M114_NAME
	string "Driver name"
	default "MT9M114"
	help
	  Device name to identify the MT9M114 image sensor.

endif
```

## drivers/can/Kconfig
```kconfig
# CAN configuration options

# Copyright (c) 2018 Alexander Wachter
# SPDX-License-Identifier: Apache-2.0

#
# CAN options
#
menuconfig CAN
	bool "Controller Area Network (CAN) drivers"
	help
	  Enable CAN Driver Configuration

if CAN

module = CAN
module-str = CAN
source "subsys/logging/Kconfig.template.log_config"

config CAN_INIT_PRIORITY
	int "CAN driver init priority"
	default 80
	help
	  CAN driver device initialization priority.

config CAN_DEFAULT_BITRATE
	int "Default CAN bitrate"
	default 125000
	help
	  Default initial CAN bitrate in bits/s. This can be overridden per CAN controller using the
	  "bitrate" devicetree property.

config CAN_DEFAULT_BITRATE_DATA
	int "Default CAN data phase bitrate"
	default 1000000
	depends on CAN_FD_MODE
	help
	  Default initial CAN data phase bitrate in bits/s. This can be overridden per CAN controller
	  using the "bitrate-data" devicetree property.

config CAN_SHELL
	bool "CAN shell"
	depends on SHELL
	select POLL
	help
	  Enable CAN Shell for testing.

if CAN_SHELL

config CAN_SHELL_TX_QUEUE_SIZE
	int "CAN shell transmit queue size"
	default 5
	range 1 256
	help
	  Maximum number of events in the CAN shell transmit queue.

config CAN_SHELL_RX_QUEUE_SIZE
	int "CAN shell receive queue size"
	default 5
	range 1 256
	help
	  Maximum number of CAN frames in the CAN shell receive queue.

config CAN_SHELL_SCRIPTING_FRIENDLY
	bool "Produce scripting-friendly output"
	help
	  Enable scripting-friendly/machine-readable output from the CAN shell. Enabling this
	  bypasses the shell when printing certain outputs to ensure the output is not interleaved
	  with the shell prompt.

endif # CAN_SHELL

config CAN_STATS
	bool "CAN controller device statistics"
	depends on STATS
	help
	  Enable CAN controller device statistics.

config CAN_ACCEPT_RTR
	bool "Accept Remote Transmission Requests (RTR) frames"
	help
	  Accept incoming Remote Transmission Request (RTR) frames matching CAN RX filters. Unless
	  enabled, all incoming Remote Transmission Request (RTR) frames are rejected at the driver
	  level.

config CAN_FD_MODE
	bool "CAN FD support"
	help
	  Enable CAN FD support. Not all CAN controllers support CAN FD.

config CAN_MANUAL_RECOVERY_MODE
	bool "Manual bus-off recovery support"
	help
	  Enable support for manual (non-automatic) recovery from bus-off state. Not all CAN
	  controllers support manual recovery mode.

config CAN_RX_TIMESTAMP
	bool "Receiving timestamps"
	help
	  This option enables a timestamp value of the CAN free running timer.
	  The value is incremented every bit time and starts when the controller
	  is initialized. Not all CAN controllers support timestamps.

config CAN_QEMU_IFACE_NAME
	string "SocketCAN interface name for QEMU"
	default ""
	depends on QEMU_TARGET
	help
	  The SocketCAN interface name for QEMU. This value, if set, is given as "if" parameter to
	  the "-object can-host-socketcan" qemu command line option. The CAN interface must be
	  configured before starting QEMU.

source "drivers/can/Kconfig.sam"
source "drivers/can/Kconfig.sam0"
source "drivers/can/Kconfig.pic32cxsg"
source "drivers/can/Kconfig.stm32"
source "drivers/can/Kconfig.mcux"
source "drivers/can/Kconfig.mcp2515"
source "drivers/can/Kconfig.mcan"
source "drivers/can/Kconfig.rcar"
source "drivers/can/Kconfig.numaker"
source "drivers/can/Kconfig.loopback"
source "drivers/can/Kconfig.native_linux"
source "drivers/can/Kconfig.sja1000"
source "drivers/can/Kconfig.esp32"
source "drivers/can/Kconfig.kvaser"
source "drivers/can/Kconfig.fake"
source "drivers/can/Kconfig.nxp_s32"
source "drivers/can/Kconfig.tcan4x5x"
source "drivers/can/Kconfig.mcp251xfd"
source "drivers/can/Kconfig.xmc4xxx"
source "drivers/can/Kconfig.nrf"

source "drivers/can/transceiver/Kconfig"

endif # CAN
```

## drivers/can/Kconfig.bee
```kconfig
# Copyright (c) 2026, Realtek Semiconductor Corporation
# SPDX-License-Identifier: Apache-2.0

config CAN_BEE
	bool "CAN driver for Realtek Bee series SoC"
	default y
	depends on DT_HAS_REALTEK_BEE_CAN_ENABLED
	select HAL_REALTEK_BEE_CAN
	select PINCTRL
	help
	  This option enables the CAN driver for Realtek Bee SoCs.

if CAN_BEE

config CAN_BEE_TX_MSG_BUF_NUM
	int "Number of message buffers used for tx"
	default 6
	range 0 15
	help
	  Defines the number of message buffers used for tx in the application.
	  The tx and rx share 16 message buffers in total.
	  Each rx message buffer can filter one standard or extended ID.
	  The following equation determines the maximum total number for tx and rx:
	    CAN_BEE_TX_MSG_BUF_NUM + CAN_BEE_RX_MSG_BUF_NUM <= 16

config CAN_BEE_RX_MSG_BUF_NUM
	int "Number of message buffers used for rx"
	default 10
	range 0 15
	help
	  Defines the number of message buffers used for rx in the application.
	  The tx and rx share 16 message buffers in total.
	  Each rx message buffer can filter one standard or extended ID.
	  The following equation determines the maximum total number for tx and rx:
	    CAN_BEE_TX_MSG_BUF_NUM + CAN_BEE_RX_MSG_BUF_NUM <= 16

endif # CAN_BEE
```

## drivers/can/Kconfig.bflb
```kconfig
# SPDX-FileCopyrightText: Copyright The Zephyr Project Contributors
# SPDX-License-Identifier: Apache-2.0

config CAN_BFLB_BL61X
	bool "Bouffalo Lab BL61x CAN driver"
	default y
	depends on DT_HAS_BFLB_BL61X_CAN_ENABLED
	select CAN_SJA1000
	select PINCTRL
	help
	  Enable support for the Bouffalo Lab BL61x ISO11898 (SJA1000 compatible)
	  classic CAN 2.0 controller.
```

## drivers/can/Kconfig.cast
```kconfig
# Copyright (C) 2025 Alif Semiconductor
# SPDX-License-Identifier: Apache-2.0

config CAN_CAST
	bool "CAST CAN driver for Alif Boards"
	default y
	depends on DT_HAS_CAST_CAN_ENABLED
	help
	  Enable CAN module for Alif Board

if CAN_CAST
config CAN_MAX_FILTER
	int "Set Maximum number of Acceptance filters supported"
	default 3
	range 1 16
	help
	  Set Maximum number of Acceptance filters supported by hardware

config CAN_RBUF_AFWL
	int "Set CAN Rx buf almost full warning limit"
	default 8
	range 1 15
	help
	  Set Rx buffer almost full warning
endif # CAN_CAST
```

## drivers/can/Kconfig.esp32
```kconfig
# Espressif ESP32 TWAI configuration options

# Copyright (c) 2022 Henrik Brix Andersen <henrik@brixandersen.dk>
# Copyright (c) 2026 Espressif Systems (Shanghai) Co., Ltd.
# SPDX-License-Identifier: Apache-2.0

config CAN_ESP32_TWAI
	bool "Espressif TWAI CAN driver"
	default y
	depends on DT_HAS_ESPRESSIF_ESP32_TWAI_ENABLED
	select CAN_SJA1000
	select PINCTRL
	help
	  This enables support for the Espressif Two-Wire Automotive Interface
	  (TWAI) CAN driver.

config CAN_ESP32_TWAIFD
	bool "Espressif TWAI-FD CAN driver"
	default y
	depends on DT_HAS_ESPRESSIF_ESP32_TWAIFD_ENABLED
	select PINCTRL
	help
	  Enables the Espressif TWAI-FD (CAN FD capable Two-Wire Automotive
	  Interface) controller driver.

if CAN_ESP32_TWAIFD

config CAN_ESP32_TWAIFD_MAX_FILTERS
	int "Maximum number of RX filters per TWAI-FD controller"
	default 16
	help
	  Maximum number of RX filters concurrently installable via
	  can_add_rx_filter() on a TWAI-FD controller instance. Filters
	  are matched in software; each slot is a few words of RAM, so
	  reduce this to conserve RAM if fewer filters are needed.

endif # CAN_ESP32_TWAIFD
```

## drivers/can/Kconfig.fake
```kconfig
# Fake CAN configuration options

# Copyright (c) 2022 Vestas Wind Systems A/S
# SPDX-License-Identifier: Apache-2.0

config CAN_FAKE
	bool "Fake CAN driver"
	default y
	depends on DT_HAS_ZEPHYR_FAKE_CAN_ENABLED
	help
	  Enable support for the FFF-based fake CAN driver.
```
