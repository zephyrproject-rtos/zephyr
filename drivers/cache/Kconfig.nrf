## drivers/can/Kconfig.gd32
```kconfig
# STM32 CAN configuration options

# Copyright (c) 2022 YuLong Yao <feilongphone@gmail.com>
# SPDX-License-Identifier: Apache-2.0

DT_COMPAT_GD_GD32_CAN := gd,gd32-can
DT_COMPAT_GD_GD32_FDCAN := gd,gd32-can-fd

config CAN_GD32
	bool "GD32 CAN Driver"
	default $(dt_compat_enabled,$(DT_COMPAT_GD_GD32_CAN)) || $(dt_compat_enabled,$(DT_COMPAT_GD_GD32_FDCAN))
	select CAN_HAS_RX_TIMESTAMP
	select CAN_HAS_CANFD if $(dt_compat_enabled,$(DT_COMPAT_GD_GD32_FDCAN))
	select CAN_AUTO_BUS_OFF_RECOVERY
	help
	  Enable GD32 CAN Driver.

if CAN_GD32

config CAN_MAX_FILTER
	int "Maximum number of concurrent active filters"
	default 28
	range 1 28
	help
	  Defines the array size of the callback/msgq pointers.
	  Must be at least the size of concurrent reads.

config CAN_GD32_DEBUG_FREEZE
	bool "CAN Debug freeze"
	#todo: select CAN_GD32_DBG_CTL_CANx_HOLD
	default n
	help
	  Freeze CAN when debug enable.

config CAN_FILTER_SPLIT_DEFAULT
	int "Maximum number of concurrent active filters"
	default 14
	range 1 28
	help
	  Default split location between main controller and secondary controller.

endif # CAN_GD32
```

## drivers/can/Kconfig.ifx
```kconfig
# Copyright (c) 2026 Linumiz
# SPDX-License-Identifier: Apache-2.0

config CAN_IFX_MCAN
	bool "Infineon MCAN driver"
	default y
	depends on DT_HAS_INFINEON_CAT1_CAN_ENABLED
	depends on CLOCK_CONTROL
	select CAN_MCAN
	select PINCTRL
	help
	  Enable support for infineon cat1 family can driver.
```

## drivers/can/Kconfig.infineon_cat1
```kconfig
# Copyright (c) 2026 Infineon Technologies AG,
# or an affiliate of Infineon Technologies AG.
#
# SPDX-License-Identifier: Apache-2.0

config CAN_INFINEON
	bool "Infineon CAT1 CAN FD driver"
	default y
	depends on DT_HAS_INFINEON_CAN_ENABLED
	select USE_INFINEON_CANFD
	select PINCTRL
	help
	  Enable CAN FD driver for Infineon CAT1 devices using Cy_CANFD PDL.

if CAN_INFINEON

config CAN_INFINEON_MAX_TX_QUEUE
	int "Maximum number of queued messages"
	default 16
	range 1 32
	help
	  Defines the array size of transmit callback pointers and semaphores,
	  as well as the number of messages in the TX queue.

config CAN_INFINEON_RX_FIFO_ITEMS
	int "Number of CAN messages allocated to each RX FIFO"
	default 16
	range 1 64
	help
	  Defines the number of CAN messages in each RX FIFO. A separate RX FIFO
	  is created for each RX filter.

config CAN_INFINEON_MAX_FILTER
	int "Maximum number of concurrent active filters"
	default 16
	range 1 64
	help
	  Maximum number of filters supported by the can_add_rx_callback() API call.

config CAN_INFINEON_MRAM_SIZE
	int "Message RAM size"
	default 4096
	range 80 4096

config CAN_INFINEON_NUMBER_FIFO0_ELEMENTS
	int "Message RAM size"
	default 8
	range 0 64
	help
	  Number Of FIFO elements.

config CAN_INFINEON_NUMBER_FIFO1_ELEMENTS
	int "Message RAM size"
	default 8
	range 0 64
	help
	  Number Of FIFO elements.

endif # CAN_INFINEON
```

## drivers/can/Kconfig.kvaser
```kconfig
# Kvaser PCIcan configuration options

# Copyright (c) 2022 Henrik Brix Andersen <henrik@brixandersen.dk>
# SPDX-License-Identifier: Apache-2.0

config CAN_KVASER_PCI
	bool "Kvaser PCIcan driver"
	default y
	depends on DT_HAS_KVASER_PCICAN_ENABLED
	select PCIE
	select CAN_SJA1000
	help
	  This enables support for the Kvaser PCIcan.
```

## drivers/can/Kconfig.loopback
```kconfig
# CAN loopback device configuration options

# Copyright (c) 2019 Alexander Wachter
# SPDX-License-Identifier: Apache-2.0

DT_COMPAT_ZEPHYR_CAN_LOOPBACK := zephyr,can-loopback

config CAN_LOOPBACK
	bool "Emulated CAN loopback driver"
	default $(dt_compat_enabled,$(DT_COMPAT_ZEPHYR_CAN_LOOPBACK))
	help
	  This is an emulated driver that can only loopback messages.

if CAN_LOOPBACK

config CAN_MAX_FILTER
	int "Maximum number of concurrent active filters"
	default 16
	range 1 1024
	help
	  Defines the array size of the filters.
	  Must be at least the size of concurrent reads.

config CAN_LOOPBACK_TX_THREAD_STACK_SIZE
	int "TX thread stack size"
	default 256
	help
	  Stack size of the TX thread.
	  The TX thread calls the callbacks of the receiver
	  if the filter matches.

config CAN_LOOPBACK_TX_THREAD_PRIORITY
	int "TX thread priority"
	default 2
	help
	  Priority of the TX thread.
	  The TX thread calls the callbacks of the receiver
	  if the filter matches.

config CAN_LOOPBACK_TX_MSGQ_SIZE
	int "TX message queue size"
	default 16
	help
	  Number of TX frames that can be buffered.
	  The send functions puts frame int this queue and TX thread takes the
	  messages from this msgq and calls the respective receiver if the
	  filter matches.

endif # CAN_LOOPBACK
```
