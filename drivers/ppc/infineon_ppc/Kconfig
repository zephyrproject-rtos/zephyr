## drivers/ppc/infineon_ppc/Kconfig
```kconfig
# SPDX-FileCopyrightText: Copyright (c) 2026 Infineon Technologies AG,
# SPDX-FileCopyrightText: or an affiliate of Infineon Technologies AG. All rights reserved.
#
# SPDX-License-Identifier: Apache-2.0

config INFINEON_PPC
	bool "Infineon Peripheral Protection Controller driver"
	depends on ARM_SECURE_FIRMWARE
	default y if DT_HAS_INFINEON_PPC_ENABLED
	select PPC
	help
	  Enables the devicetree-driven driver for the Infineon Peripheral
	  Protection Controller.  ppc_configure_ns_all() opens the peripheral
	  protection regions listed on each enabled "infineon,ppc" node for
	  Non-Secure access.
```

## drivers/ps2/Kconfig.xec
```kconfig
# Microchip XEC PS2 configuration options

# Copyright (c) 2019 Intel Corporation
# SPDX-License-Identifier: Apache-2.0

config PS2_XEC
	bool "XEC Microchip PS2 driver"
	depends on DT_HAS_MICROCHIP_XEC_PS2_ENABLED
	select PINCTRL
	default y
	help
	  Enable the Microchip XEC PS2 IO driver. The driver also
	  depends on the KBC 8042 keyboard controller. Note, MEC15xx,
	  MEC174x, MEC175x series have two controllers, MEC172x series
	  has one.
```

## drivers/ptp_clock/Kconfig.nxp_enet
```kconfig
# Copyright 2023 NXP
# SPDX-License-Identifier: Apache-2.0

config PTP_CLOCK_NXP_ENET
	bool "NXP ENET PTP Clock driver"
	default y
	depends on DT_HAS_NXP_ENET_PTP_CLOCK_ENABLED
	depends on ETH_NXP_ENET
	select NET_L2_PTP_TIMESTAMPING
	select PINCTRL
	help
	  Enable NXP ENET PTP clock to support Ethernet timestamping.

config PTP_CLOCK_NXP_ENET_MAX_RATIO_PPM
	int "Largest rate adjustment accepted, in ppm"
	default 50000
	range 1 100000
	depends on PTP_CLOCK_NXP_ENET
	help
	  Largest difference from the nominal rate that the rate adjustment of the
	  timer accepts. A larger request is rejected with -EINVAL, so a servo that
	  went out of control does not reach the timer. The default of 5% is the
	  limit that a 100 MHz timer clock had before this symbol existed. A
	  servo that follows a crystal needs a few hundred ppm at most.
```

## drivers/pulse_io/Kconfig.esp32
```kconfig
# Copyright (c) 2026 Espressif Systems (Shanghai) Co., Ltd.
# SPDX-License-Identifier: Apache-2.0

config PULSE_IO_ESP32_RMT
	bool "Espressif RMT Pulse IO backend"
	default y
	depends on DT_HAS_ESPRESSIF_ESP32_RMT_ENABLED
	help
	  Enable the Espressif RMT (Remote Control Transceiver) Pulse IO
	  backend.

if PULSE_IO_ESP32_RMT

config PULSE_IO_ESP32_RMT_DMA
	def_bool SOC_SERIES_ESP32S3
	select DMA if DT_HAS_ESPRESSIF_ESP32_GDMA_ENABLED
	help
	  Compile the RMT DMA path on SoCs whose RMT DMA generation the
	  backend supports.

config PULSE_IO_ESP32_RMT_DMA_WORDS
	int "RMT DMA buffer size in RMT words"
	depends on PULSE_IO_ESP32_RMT_DMA
	default 256
	help
	  Size of the static transmit and receive DMA bounce buffers,
	  in RMT symbol words (4 bytes each). Only used by the last
	  transmit and receive channels when DMA is enabled through the
	  dmas devicetree property.

endif # PULSE_IO_ESP32_RMT
```

## drivers/pulse_io/Kconfig.loopback
```kconfig
# Copyright (c) 2026 Espressif Systems (Shanghai) Co., Ltd.
# SPDX-License-Identifier: Apache-2.0

config PULSE_IO_LOOPBACK
	bool "Software loopback Pulse IO backend"
	default y
	depends on DT_HAS_ZEPHYR_PULSE_IO_LOOPBACK_ENABLED
	help
	  Enable the software loopback Pulse IO backend. It loops
	  transmitted symbols back on receive so the subsystem API can
	  be tested without hardware.
```

## drivers/pulse_io/Kconfig.nrf_pwm
```kconfig
# SPDX-FileCopyrightText: Copyright The Zephyr Project Contributors
# Copyright (c) 2026 Dev It Wise
# SPDX-License-Identifier: Apache-2.0

config PULSE_IO_NRF_PWM
	bool "nRF PWM Pulse IO backend"
	default y
	depends on DT_HAS_NORDIC_NRF_PWM_PULSE_IO_ENABLED
	select NRFX_PWM
	select PINCTRL
	help
	  Enable the Pulse IO backend on the nRF PWM peripheral. It
	  transmits CELL mode streams on one line, one EasyDMA word per
	  cell.

config PULSE_IO_NRF_PWM_CELLS
	int "Maximum cells per nRF PWM transmit"
	depends on PULSE_IO_NRF_PWM
	default 768
	range 1 32766
	help
	  Size of the static per-instance EasyDMA buffer, in cells
	  (2 bytes each). A transmit request with more cells fails with
	  -ENOMEM. The default holds 32 RGB LEDs.
```

## drivers/pulse_io/Kconfig.stm32
```kconfig
# SPDX-FileCopyrightText: Copyright The Zephyr Project Contributors
# SPDX-License-Identifier: Apache-2.0

config PULSE_IO_STM32_TIMER
	bool "STM32 timer Pulse IO driver"
	default y
	depends on DT_HAS_ST_STM32_PULSE_IO_ENABLED
	select USE_STM32_LL_TIM
	select DMA
	select CACHE_MANAGEMENT if DCACHE
	help
	  Enable the Pulse IO driver for STM32 timers. It transmits fixed-period
	  cells on a timer channel in PWM mode, a DMA transfer loading the duty
	  cycle of each period.
```

## drivers/pwm/Kconfig.adi_axi_pwmgen
```kconfig
# Copyright (c) 2026 Analog Devices, Inc.
# SPDX-License-Identifier: Apache-2.0

config PWM_ADI_AXI_PWMGEN
	bool "Analog Devices AXI PWM Generator driver"
	default y
	depends on DT_HAS_ADI_AXI_PWMGEN_ENABLED
	help
	  Enable the driver for the Analog Devices AXI PWM Generator core.
	  Generates periodic trigger pulses (e.g. ADC conversion CNV signals).
```

## drivers/pwm/Kconfig.cc27xx_timer
```kconfig
# Copyright (c) 2025 Texas Instruments Incorporated
# SPDX-License-Identifier: Apache-2.0

config PWM_CC27XX_TIMER
	bool "TI SimpleLink CC27XX LGPT PWM driver"
	default y
	depends on DT_HAS_TI_CC27XX_LGPT_PWM_ENABLED
	select PINCTRL
	select DYNAMIC_INTERRUPTS if PWM_CAPTURE
	help
	  Enables TI SimpleLink CC27XX LGPT PWM driver.
```

## drivers/pwm/Kconfig.cc35xx_timer
```kconfig
# Copyright (c) 2025 Conclusive Engineering Sp. z o.o.
# SPDX-License-Identifier: Apache-2.0

config PWM_CC35XX_TIMER
	bool "TI SimpleLink CC35XX LGPT PWM driver"
	default y
	depends on DT_HAS_TI_CC35XX_LGPT_PWM_ENABLED
	select PINCTRL
	help
	  Enables TI SimpleLink CC35XX LGPT PWM driver.
```

## drivers/pwm/Kconfig.imx
```kconfig
# i.MX PWM Config

# Copyright (c) 2018, Diego Sueiro
# SPDX-License-Identifier: Apache-2.0

menuconfig PWM_IMX
	bool "i.MX PWM Driver"
	default y
	depends on DT_HAS_FSL_IMX27_PWM_ENABLED
	select PINCTRL
	help
	  Enable support for i.MX pwm driver.

config PWM_IMX_MCUX
	bool
	default y
	depends on PWM_IMX
	depends on SOC_MIMX8ML8_A53
	help
	  Use the MCUXpresso SDK register layout and clock API for the i.MX
	  PWM driver. This is required on i.MX8M family Cortex-A cores, which
	  provide the classic i.MX PWM IP through the MCUXpresso SDK device
	  headers (fsl_device_registers.h / fsl_clock.h) instead of the legacy
	  device_imx.h HAL used by the i.MX6/i.MX7 Cortex-M ports.

config PWM_PWMSWR_LOOP
	int "Loop count for PWM Software Reset"
	default 5
	depends on PWM_IMX
	help
	  Loop count for PWM Software Reset when disabling PWM channel.
```

## drivers/pwm/Kconfig.mspm0
```kconfig
# Copyright (c) 2024 Linumiz GmbH
# Copyright (c) 2026 Texas Instruments Incorporated
# SPDX-License-Identifier: Apache-2.0

config PWM_MSPM0
	bool "TI MSPM0 MCU family PWM driver"
	default y
	depends on DT_HAS_TI_MSPM0_TIMER_PWM_ENABLED
	select PINCTRL
	help
	  Enable TI MSPM0 MCU family PWM driver.
```

## drivers/pwm/Kconfig.nxp_emios
```kconfig
# SPDX-FileCopyrightText: Copyright 2026 NXP
# SPDX-License-Identifier: Apache-2.0

config PWM_NXP_EMIOS
	bool "NXP PWM-eMIOS driver"
	default y
	depends on DT_HAS_NXP_EMIOS_PWM_ENABLED
	select PINCTRL
	help
	  Enable support for the NXP PWM-eMIOS.
```

## drivers/pwm/Kconfig.nxp_ipwm
```kconfig
# Copyright 2026 Toradex
# SPDX-License-Identifier: Apache-2.0

config PWM_NXP_IPWM
	bool "NXP i.MX PWM driver"
	default y
	depends on DT_HAS_NXP_IPWM_ENABLED
	select PINCTRL
	help
	  Enable the driver for the i.MX PWM block found on the i.MX8M family.
	  This is not the FlexPWM block covered by PWM_MCUX.
```

## drivers/pwm/Kconfig.sf32lb
```kconfig
# Copyright (c) 2025, Qingsong Gou <gouqs@hotmail.com>
# SPDX-License-Identifier: Apache-2.0

config PWM_SF32LB_GPT
	bool "SF32LB GPT PWM driver"
	default y
	depends on DT_HAS_SIFLI_SF32LB_GPT_PWM_ENABLED
	help
	  Enable PWM driver for SF32LB series of MCUs. This driver uses
	  the timer peripheral to implement PWM functionality.

config PWM_SF32LB_ATIM
	bool "SF32LB ATIM PWM driver"
	default y
	depends on DT_HAS_SIFLI_SF32LB_ATIM_PWM_ENABLED
	help
	  Enable PWM driver for SF32LB series of MCUs. This driver uses
	  the advanced timer peripheral to implement PWM functionality.
```

## drivers/pwm/Kconfig.ti_am3352_ecap
```kconfig
# SPDX-FileCopyrightText: Copyright (c) 2026 Texas Instruments
# SPDX-License-Identifier: Apache-2.0

config PWM_TI_AM3352_ECAP
	bool "TI ECAP PWM driver"
	default y
	depends on DT_HAS_TI_AM3352_ECAP_ENABLED
	depends on CLOCK_CONTROL
	select PINCTRL
	help
	  Enable ECAP controller for TI SoCs

if PWM_TI_AM3352_ECAP
config PWM_TI_AM3352_ECAP_VARIANT_AM13
	bool "TI ECAP AM13E variant"
	depends on SOC_SERIES_AM13E
	default y
	select MUX
	select SYSCON
	help
	  Enable AM13E ECAP support : mux-states xbar routing
	  and sysctl for setting PWREN bits.
endif
```

## drivers/pwm/Kconfig.waveshare_ch32v003
```kconfig
# Copyright (c) 2026 Kim Bøndergaard
# SPDX-License-Identifier: Apache-2.0

if GPIO_CH32V003

config PWM_WAVESHARE_CH32V003
	bool "Waveshare CH32V003 PWM output"
	default y
	depends on PWM
	help
	  Enable PWM output support for the Waveshare CH32V003.

config PWM_WAVESHARE_CH32V003_INIT_PRIORITY
	int "PWM init priority"
	default 71
	depends on PWM_WAVESHARE_CH32V003
	help
	  Device driver initialization priority for CH32V003 PWM.

endif # GPIO_CH32V003
```

## drivers/pwr_profile_mgr/Kconfig
```kconfig
# Power profile manager configuration options

# SPDX-License-Identifier: Apache-2.0

menuconfig PWR_PROFILE_MGR
	bool "Power profile manager"
	help
	  Enable the Active/Sleep power profile manager. Requires a
	  board-specific backend providing pwr_profile_backend.

if PWR_PROFILE_MGR

config PWR_PROFILE_MGR_MAX_RETRIES
	int "Per-driver rollback retry bound"
	default 3
	range 0 255
	help
	  Number of times a driver's rollback is retried after it fails before
	  the transition is latched as a fault.

config PWR_PROFILE_MGR_STEP_TIMEOUT_MS
	int "Per-step hardware operation timeout in milliseconds"
	default 100
	range 1 60000
	help
	  Timeout passed to every backend callback. A callback that cannot
	  finish in time must return -ETIMEDOUT.

module = PWR_PROFILE_MGR
module-str = pwr_profile_mgr
source "subsys/logging/Kconfig.template.log_config"

endif # PWR_PROFILE_MGR
```

## drivers/pwr_profile_mgr/tests/core/testcase.yaml
```yaml
tests:
  drivers.pwr_profile_mgr.core:
    platform_allow:
      - native_sim
    tags: pwr_profile_mgr
```

## drivers/radio/Kconfig
```kconfig
# Radio configuration options

# Copyright (c) 2026 Shontal Biton
# SPDX-License-Identifier: Apache-2.0

#
# Radio options
menuconfig RADIO
	bool "Radio drivers"
	# All platforms that implement the radio driver are now required to
	# provide relevant DTS entries.
	help
	  Enable radio driver configuration.

if RADIO

config RADIO_INIT_PRIORITY
	int "Radio driver init priority"
	default KERNEL_INIT_PRIORITY_DEVICE
	help
	  This option controls the priority of the radio device
	  initialization. Higher priority ensures that the device is
	  initialized earlier in the startup cycle. If unsure, leave at default
	  value

module = RADIO
module-str = Radio
source "subsys/logging/Kconfig.template.log_config"

# zephyr-keep-sorted-start
source "drivers/radio/Kconfig.silabs"
# zephyr-keep-sorted-stop

endif
```

## drivers/radio/Kconfig.silabs
```kconfig
config RADIO_SILABS
	bool "EFR32 radio driver"
	default y
	depends on DT_HAS_SILABS_SERIES2_RADIO_ENABLED
    select SOC_GECKO_CUSTOM_RADIO_PHY
	help
	  Enables EFR32 radio driver.

if RADIO_SILABS

config RADIO_SILABS_TX_BUFFER_SIZE
    int "EFR32 radio TX FIFO size"
    default 256
    help
        Size of the TX FIFO, must be a power of 2 from 64 to 4096

config RADIO_SILABS_RX_BUFFER_SIZE
    int "EFR32 radio RX FIFO size"
    default 256
    help
        Size of the RX FIFO, must be a power of 2 from 64 to 4096

endif
```

## drivers/rc/Kconfig
```kconfig
# SPDX-FileCopyrightText: Copyright (c) 2026 Linumiz
# SPDX-License-Identifier: Apache-2.0

if RC

menu "Remote control drivers"

# zephyr-keep-sorted-start
source "drivers/rc/Kconfig.gpio_ir_receiver"
source "drivers/rc/Kconfig.loopback"
# zephyr-keep-sorted-stop

endmenu

endif # RC
```

## drivers/rc/Kconfig.gpio_ir_receiver
```kconfig
# SPDX-FileCopyrightText: Copyright (c) 2026 Linumiz
# SPDX-License-Identifier: Apache-2.0

config RC_GPIO_IR_RECEIVER
	bool "GPIO infrared receiver"
	default y
	depends on DT_HAS_GPIO_IR_RECEIVER_ENABLED && GPIO
	help
	  Receive driver for a demodulating infrared receiver on a GPIO. The
	  edges are timed by the rc core.
```

## drivers/rc/Kconfig.loopback
```kconfig
# SPDX-FileCopyrightText: Copyright (c) 2026 Linumiz
# SPDX-License-Identifier: Apache-2.0

config RC_LOOPBACK
	bool "Software loopback remote control driver"
	default y
	depends on DT_HAS_ZEPHYR_RC_LOOPBACK_ENABLED
	select RC_TX if $(dt_compat_any_has_prop,$(DT_COMPAT_ZEPHYR_RC_LOOPBACK),rx-only,False)
	help
	  Enable the software loopback remote control driver, used to test
	  the remote control subsystem without hardware.

config RC_LOOPBACK_TX_WORDS
	int "Words kept from the last loopback transmission"
	default 64
	depends on RC_LOOPBACK && RC_TX
	help
	  Also the maximum words per transmission the loopback driver
	  reports in its capabilities.
```

## drivers/regulator/Kconfig.bq2589x
```kconfig
# SPDX-FileCopyrightText: Copyright The Zephyr Project Contributors
# SPDX-License-Identifier: Apache-2.0

config REGULATOR_BQ2589X
	bool "BQ2589X USB OTG boost regulator driver"
	default y
	depends on DT_HAS_TI_BQ25896_REGULATOR_ENABLED || DT_HAS_SILERGY_SY6970_REGULATOR_ENABLED
	depends on DT_HAS_TI_BQ25896_ENABLED || DT_HAS_SILERGY_SY6970_ENABLED
	select I2C
	select MFD
	help
	  Enable the driver for the USB OTG boost regulator of the TI BQ2589X
	  family of single cell switching battery chargers.

	  Supported devices include:
	    - BQ25896
	    - SY6970

if REGULATOR_BQ2589X

config REGULATOR_BQ2589X_INIT_PRIORITY
	int "BQ2589X USB OTG boost regulator driver init priority"
	default 85
	help
	  Init priority for the BQ2589X USB OTG boost regulator driver. It must
	  be greater than MFD_INIT_PRIORITY.

endif
```
