## drivers/sdio_dc/Kconfig
```kconfig
# Copyright 2026 Nordic Semiconductor ASA
# SPDX-License-Identifier: Apache-2.0

menuconfig SDIO_DC
	bool "SDIO device controller drivers"
	help
	  Enable the SDIO device controller (slave/peripheral side) driver
	  class. SDIO device controllers answer commands from a remote SDIO
	  host and are the counterpart of SD host controllers (SDHC).

if SDIO_DC

module = SDIO_DC
module-str = SDIO device controller
source "subsys/logging/Kconfig.template.log_config"

config SDIO_DEVICE_INIT_PRIORITY
	int "SDIO device controller init priority"
	default 70
	help
	  Device initialization priority for SDIO device controllers.

config SDIO_DC_VIRTUAL
	bool "Virtual (loopback) SDIO device controller"
	default y
	depends on DT_HAS_ZEPHYR_SDIO_DEVICE_VIRTUAL_ENABLED
	help
	  Software-only SDIO device controller that also exposes an in-process
	  loopback transport for a host-role endpoint. Intended for tests and
	  samples on platforms without SDIO hardware.

endif # SDIO_DC
```

## drivers/sdmmc/Kconfig
```kconfig
# Kconfig - SD Card configuration options

#
# Copyright (c) 2019 Yurii Hamann
#
# SPDX-License-Identifier: Apache-2.0
#

menuconfig SDMMC
	bool "SD/MMC Drivers"
	help
	  Enable config options for SD/MMC drivers.

if SDMMC

module = SDMMC
module-str = sdmmc
source "subsys/logging/Kconfig.template.log_config"

config SDMMC_1
	bool "Enable SDMMC Interface 1"

endif # SDMMC
```

## drivers/sdmmc/Kconfig.stm32
```kconfig
# Kconfig - SD Card configuration options

#
# Copyright (c) 2019 Yurii Hamann
#
# SPDX-License-Identifier: Apache-2.0
#

menuconfig SDMMC_STM32
	bool "SD/MMC Drivers for STM32 MCU families"
	depends on SOC_FAMILY_STM32
	help
	  Enable config options for SD/MMC driver for STM32 MCU families.
```

## drivers/secure_boot/Kconfig
```kconfig
# Copyright (c) 2024 VCI Development - LPC54S018J4MET180E
# Private Porting , by David Hor - Xtooltech 2025, david.hor@xtooltech.com
# SPDX-License-Identifier: Apache-2.0

config LPC54S018_SECURE_BOOT
	bool "LPC54S018 secure boot support"
	depends on SOC_LPC54S018
	help
	  Enable secure boot support for LPC54S018.
	  This includes boot image verification using CMAC or ECDSA signatures.

if LPC54S018_SECURE_BOOT

config LPC54S018_DEV_KEYS
	bool "Use development keys for secure boot"
	default y
	help
	  Use hardcoded development keys for testing secure boot.
	  MUST be disabled for production!

config LPC54S018_SECURE_BOOT_ECDSA
	bool "Enable ECDSA signature verification"
	default y
	help
	  Enable ECDSA P-256 signature verification for secure boot.

config LPC54S018_SECURE_BOOT_ENCRYPTED
	bool "Enable encrypted image support"
	default n
	help
	  Enable support for encrypted boot images using PUF-derived keys.

config SECURE_BOOT_LOG_LEVEL
	int "Secure boot log level"
	default 3
	range 0 4
	help
	  Set the log level for secure boot modules.

endif # LPC54S018_SECURE_BOOT
```

## drivers/sensor/Kconfig
```kconfig
# Sensor configuration options

# Copyright (c) 2016 Intel Corporation
# Copyright (c) 2024 Croxel Inc
# SPDX-License-Identifier: Apache-2.0

menuconfig SENSOR
	bool "Sensor drivers"
	help
	  Include sensor drivers in system config

if SENSOR

module = SENSOR
module-str = sensor
source "subsys/logging/Kconfig.template.log_config"

config SENSOR_INIT_PRIORITY
	int "Sensor init priority"
	default 90
	help
	  Sensor initialization priority.

config SENSOR_ASYNC_API
	bool "Async Sensor API"
	select RTIO
	select RTIO_SYS_MEM_BLOCKS
	select RTIO_CONSUME_SEM
	select RTIO_WORKQ
	help
	  Enables the asynchronous sensor API by leveraging the RTIO subsystem.

config SENSOR_SHELL
	bool "Sensor shell"
	depends on SHELL
	select CBPRINTF_FP_SUPPORT
	select SENSOR_ASYNC_API
	help
	  This shell provides access to basic sensor data.

config SENSOR_SHELL_STREAM
	bool "Sensor shell 'stream' command"
	depends on SENSOR_SHELL
	help
	  Add the 'stream' subcommand to the sensor shell. When run on drivers that
	  support streaming (usually hardware FIFO backed), the shell will continue
	  to print new values as they come until the stream is closed.

config SENSOR_SHELL_THREAD_STACK_SIZE
	int "Stack size for the sensor shell data processing thread"
	depends on SENSOR_SHELL_STREAM
	default 1024
	help
	  The sensor shell uses a dedicated thread to process data coming from the
	  sensors in either one-shot or streaming mode. Use this config to control
	  the size of that thread's stack.

config SENSOR_SHELL_BATTERY
	bool "Sensor shell 'battery' command"
	depends on SHELL
	help
	  This enables the 'battery' command which reports charging information
	  in a convenient format. It makes use of a fuel gauge to read its
	  information.

config SENSOR_SHELL_TRIG_PRINT_TIMEOUT_MS
	int "Timeout for printing the average sensor sample value"
	default 5000
	depends on SENSOR_SHELL
	help
	  Control the frequency of the sampling window over which the sensor
	  interrupt handler will collect data.

config SENSOR_SHELL_MAX_TRIGGER_DEVICES
	int "Maximum number of sensor devices that can have enabled triggers in shell"
	default 1
	depends on SENSOR_SHELL
	help
	  Maximum number of sensor devices that the shell cmd can have
	  enabled triggers for.

config SENSOR_INFO
	bool "Sensor Info iterable section"

source "drivers/sensor/Kconfig.sensor_clock"
source "drivers/sensor/*/Kconfig"

endif # SENSOR
```

## drivers/sensor/Kconfig.bma280
```kconfig
# Kconfig.bma280 - BMA280 Three Axis Accelerometer configuration options

#
# Copyright (c) 2016 Intel Corporation
#
# Licensed under the Apache License, Version 2.0 (the "License");
# you may not use this file except in compliance with the License.
# You may obtain a copy of the License at
#
#     http://www.apache.org/licenses/LICENSE-2.0
#
# Unless required by applicable law or agreed to in writing, software
# distributed under the License is distributed on an "AS IS" BASIS,
# WITHOUT WARRANTIES OR CONDITIONS OF ANY KIND, either express or implied.
# See the License for the specific language governing permissions and
# limitations under the License.
#

menuconfig BMA280
	bool
	prompt "BMA280 Three Axis Accelerometer"
	depends on SENSOR && I2C
	default n
	help
	  Enable driver for BMA280 I2C-based triaxial accelerometer sensor.

config BMA280_NAME
	string
	prompt "Driver name"
	default "BMA280"
	depends on BMA280
	help
	  Device name with which the BMA280 sensor is identified.

config BMA280_INIT_PRIORITY
	int
	prompt "Init priority"
	depends on BMA280
	default 70
	help
	  Device driver initialization priority.

choice
	prompt "I2C address"
	depends on BMA280
	default BMA280_I2C_ADDR_0x18
	help
	  I2C address of the BMA280 sensor.

config BMA280_I2C_ADDR_0x18
	bool
	prompt "0x18"
	help
	  Choose this option if the SDO pin is pulled to GND.

config BMA280_I2C_ADDR_0x19
	bool
	prompt "0x19"
	help
	  Choose this option if the SDO pin is pulled to VDDIO.

endchoice

config BMA280_I2C_MASTER_DEV_NAME
	string
	prompt "I2C master where BMA280 is connected"
	depends on BMA280
	default "I2C0"
	help
	  Specify the device name of the I2C master device to which BMA280 is
	  connected.

choice
	prompt "Trigger mode"
	depends on BMA280
	default BMA280_TRIGGER_GLOBAL_FIBER
	help
	  Specify the type of triggering to be used by the driver.

config BMA280_TRIGGER_NONE
	bool
	prompt "No trigger"

config BMA280_TRIGGER_GLOBAL_FIBER
	bool
	prompt "Use global fiber"
	depends on GPIO
	select BMA280_TRIGGER
	select SENSOR_DELAYED_WORK

config BMA280_TRIGGER_OWN_FIBER
	bool
	prompt "Use own fiber"
	depends on GPIO
	select BMA280_TRIGGER

endchoice

config BMA280_TRIGGER
	bool
	depends on BMA280

config BMA280_GPIO_DEV_NAME
	string
	prompt "GPIO device"
	default "GPIO_0"
	depends on BMA280 && BMA280_TRIGGER
	help
	  The device name of the GPIO device to which the BMA280 interrupt pins
	  are connected.

config BMA280_GPIO_PIN_NUM
	int
	prompt "Interrupt GPIO pin number"
	default 0
	depends on BMA280 && BMA280_TRIGGER
	help
	  The number of the GPIO on which the interrupt signal from the BMA280
	  chip will be received.

config BMA280_FIBER_PRIORITY
	int
	prompt "Fiber priority"
	depends on BMA280 && BMA280_TRIGGER_OWN_FIBER
	default 10
	help
	  Priority of fiber used by the driver to handle interrupts.

config BMA280_FIBER_STACK_SIZE
	int
	prompt "Fiber stack size"
	depends on BMA280 && BMA280_TRIGGER_OWN_FIBER
	default 1024
	help
	  Stack size of fiber used by the driver to handle interrupts.

choice
	prompt "Acceleration measurement range"
	depends on BMA280
	default BMA280_PMU_RANGE_2G
	help
	  Measurement range for acceleration values.

config BMA280_PMU_RANGE_2G
	bool
	prompt "+/-2g"

config BMA280_PMU_RANGE_4G
	bool
	prompt "+/-4g"

config BMA280_PMU_RANGE_8G
	bool
	prompt "+/-8g"

config BMA280_PMU_RANGE_16G
	bool
	prompt "+/-16g"

endchoice

choice
	prompt "Acceleration data filter bandwidth"
	depends on BMA280
	default BMA280_PMU_BW_7
	help
	  Bandwidth of filtered acceleration data.

config BMA280_PMU_BW_1
	bool
	prompt "7.81Hz"

config BMA280_PMU_BW_2
	bool
	prompt "15.63HZ"

config BMA280_PMU_BW_3
	bool
	prompt "31.25Hz"

config BMA280_PMU_BW_4
	bool
	prompt "62.5Hz"

config BMA280_PMU_BW_5
	bool
	prompt "125Hz"

config BMA280_PMU_BW_6
	bool
	prompt "250HZ"

config BMA280_PMU_BW_7
	bool
	prompt "500Hz"

config BMA280_PMU_BW_8
	bool
	prompt "unfiltered"

endchoice
```
