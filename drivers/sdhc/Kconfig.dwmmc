## drivers/sdhc/Kconfig.dwmmc
```kconfig
# Copyright (c) 2016 Intel Corporation
# SPDX-License-Identifier: Apache-2.0

DT_COMPAT_SNPS_DW_SDHC := snps,designware-sdmmc

config DW_SDHC
	bool "SNPS DW SDHC"
	default y
	depends on DT_HAS_SNPS_DESIGNWARE_SDMMC_ENABLED
	select SDHC_SUPPORTS_NATIVE_MODE
	help
		Enable Synopsys Designware SDMMC Host Controller.
```

## drivers/sdhc/Kconfig.emul
```kconfig
# Copyright 2026 Alif Semiconductor
# SPDX-License-Identifier: Apache-2.0

config SDHC_EMUL
	bool "SDHC emulator driver (standalone)"
	default n
	depends on SDHC
	depends on DT_HAS_ZEPHYR_SDHC_EMUL_ENABLED
	select SDHC_SUPPORTS_NATIVE_MODE
	help
	  Standalone software emulator for the SDHC host controller API.
	  Supports SD, SDHC, SDXC, eMMC, and SDIO card personalities.
	  Intended for native_sim testing and CI pipelines.

config SDHC_EMUL_CONTROLLER
	bool "SDHC emulation controller (emul framework)"
	default n
	depends on SDHC
	depends on DT_HAS_ZEPHYR_SDHC_EMUL_CONTROLLER_ENABLED
	select SDHC_SUPPORTS_NATIVE_MODE
	help
	  SDHC emulation controller using the Zephyr emul framework.
	  Hosts emulated card peripheral devices as children on the SD bus.

config SDHC_EMUL_CARD
	bool "SDHC emulated card peripheral"
	default n
	depends on SDHC_EMUL_CONTROLLER
	depends on DT_HAS_ZEPHYR_SDHC_EMUL_CARD_ENABLED
	help
	  Emulated SD/SDHC/SDXC/eMMC/SDIO card peripheral that registers
	  on the SDHC emulation controller bus.

config SDHC_EMUL_SDIO_NET
	bool "SDIO network function emulation"
	default n
	depends on SDHC_EMUL && NET_L2_ETHERNET
	help
	  Expose a virtual Ethernet interface through the SDIO emulator.
	  Packets written to SDIO function 1 loop back via the Zephyr
	  net stack.

config SDHC_EMUL_BACKEND_FILE
	bool "Back SDHC emulator onto a host filesystem file"
	default n
	depends on SDHC_EMUL && ARCH_POSIX
	help
	  Block reads/writes go to a file on the host OS instead of RAM.
	  Data persists across test runs.

config SDHC_EMUL_BACKEND_FILE_PATH
	string "Host file path for the emulator backing store"
	default "/tmp/zephyr_sdhc_emul.img"
	depends on SDHC_EMUL_BACKEND_FILE
```

## drivers/sdhc/Kconfig.esp32
```kconfig
# Copyright (c) 2024 Espressif Systems (Shanghai) Co., Ltd.
# SPDX-License-Identifier: Apache-2.0

config SDHC_ESP32
	bool "ESP32 SDHC Driver"
	default y
	depends on DT_HAS_ESPRESSIF_ESP32_SDHC_SLOT_ENABLED
	select SDHC_SUPPORTS_NATIVE_MODE
	select PINCTRL
	help
	  Enables the ESP32 SD Host controller driver

if SDHC_ESP32

# DMA buffers must be cache-line aligned on SoCs with L1 data cache
config SDHC_BUFFER_ALIGNMENT
	default DCACHE_LINE_SIZE if DCACHE
	default 4

endif
```

## drivers/sdhc/Kconfig.imx
```kconfig
# Copyright (c) 2022, NXP
# SPDX-License-Identifier: Apache-2.0

config IMX_USDHC
	bool "NXP IMX USDHC Driver"
	default y
	depends on DT_HAS_NXP_IMX_USDHC_ENABLED
	select SDHC_SUPPORTS_UHS
	select SDHC_SUPPORTS_NATIVE_MODE
	select SDHC_SUPPORTS_SCATTER_GATHER_TRANSFER if IMX_USDHC_DMA_SUPPORT
	select PINCTRL
	help
	  Enable the NXP IMX SD Host controller driver

if IMX_USDHC

config IMX_USDHC_DAT3_PWR_TOGGLE
	bool "Toggle power when pulling DAT3 line low"
	default y
	help
	  Toggle power to SD card to clear DAT3 pull when pulling line low

config IMX_USDHC_DAT3_DETECT_RETRY
	int "Number of retries for DAT3-based card detection"
	default 1
	help
	  Number of retries for DAT3 card detection to reduce false negatives

config IMX_USDHC_DMA_SUPPORT
	bool "DMA support for USDHC"
	default y
	select NOCACHE_MEMORY if ARCH_HAS_NOCACHE_MEMORY_SUPPORT
	help
	  Enable DMA support for USDHC

if IMX_USDHC_DMA_SUPPORT

# USDHC DMA needs 32 bit aligned buffers
config SDHC_BUFFER_ALIGNMENT
	default 4

config IMX_USDHC_DMA_BUFFER_SIZE
	int "Size of DMA descriptor buffer in bytes"
	default 128
	help
	  Size of USDHC ADMA descriptor buffer in bytes

config IMX_USDHC_DMA_SCATTER_GATHER_BUF_COUNT
	int "Scatter-Gather buffers count allocated"
	default 36
	depends on SDHC_SCATTER_GATHER_TRANSFER
	help
	  Count of USDHC Scatter-Gather buffers allocated.

endif # IMX_USDHC_DMA_SUPPORT

endif
```

## drivers/sdhc/Kconfig.infineon
```kconfig
# Copyright (c) 2025 Infineon Technologies AG,
# or an affiliate of Infineon Technologies AG.
#
# SPDX-License-Identifier: Apache-2.0


config SDHC_INFINEON_CAT1_PDL
	bool "Infineon SDHC driver"
	default y
	depends on DT_HAS_INFINEON_SDHC_SDIO_ENABLED
	select USE_INFINEON_SDIO
	select SDHC_SUPPORTS_NATIVE_MODE
	select SDHC_SUPPORTS_UHS
	select PINCTRL
	help
	  This option enables the PDL based SDHC driver for Infineon family.

if SDHC_INFINEON_CAT1_PDL

config SDHC_INIT_PRIORITY
	default 70

config SDHC_BUFFER_ALIGNMENT
	default DCACHE_LINE_SIZE if DCACHE
	default 1
	help
	  SDHC buffer should aligned to the value of DCACHE_LINE_SIZE when placed in a cacheable region.

endif #SDHC_INFINEON_CAT1_PDL
```

## drivers/sdhc/Kconfig.intel
```kconfig
# Copyright (c) 2023 Intel Corporation
# SPDX-License-Identifier: Apache-2.0

config INTEL_EMMC_HOST
	bool "EMMC driver"
	select SDHC_SUPPORTS_NATIVE_MODE
	select EVENTS
	default y
	depends on DT_HAS_INTEL_EMMC_HOST_ENABLED
	help
	  EMMC driver support. Though this driver can be easily port to
	  any HW which is complaint to eMMC spec, currently it is only
	  validated using intel's EMMC host controller.

if INTEL_EMMC_HOST
config INTEL_EMMC_HOST_INTR
	bool "EMMC host controller interrupt mode"
	default y
	help
	  EMMC host controller interrupt mode support.

config INTEL_EMMC_HOST_DMA
	bool "EMMC host controller DMA mode"
	select DCACHE
	help
	  EMMC host controller DMA mode support.

config INTEL_EMMC_HOST_ADMA
	bool "EMMC host controller ADMA mode"
	depends on INTEL_EMMC_HOST_DMA
	help
	  EMMC host controller ADMA mode support.

config INTEL_EMMC_HOST_ADMA_DESC_SIZE
	int "EMMC host controller ADMA Descriptor size"
	depends on INTEL_EMMC_HOST_ADMA
	default 32
	help
	  EMMC host controller ADMA Descriptor size.

config INTEL_EMMC_HOST_AUTO_STOP
	bool "auto stop command mode"
	default y
	help
	  Auto stop command mode support.

config INTEL_EMMC_HOST_BLOCK_GAP
	bool "Block gap mode"
	depends on INTEL_EMMC_HOST_DMA
	help
	  Block gap mode support.

config INTEL_EMMC_HOST_TUNING
	bool "Host tuning"
	help
	  Host tuning support.

endif
```

## drivers/sdhc/Kconfig.litex
```kconfig
# SPDX-FileCopyrightText: Copyright The Zephyr Project Contributors
# SPDX-License-Identifier: Apache-2.0

config SDHC_LITEX_LITESDCARD
	bool "LiteX LiteSDCard SDHC driver"
	default y
	depends on DT_HAS_LITEX_MMC_ENABLED
	select SDHC_SUPPORTS_NATIVE_MODE
	select EVENTS
	help
	  sdhc driver for LiteX LiteSDCard.

if SDHC_LITEX_LITESDCARD

configdefault SDHC_BUFFER_ALIGNMENT
	default 4

config SDHC_LITEX_LITESDCARD_NO_COHERENT_DMA
	bool
	select CACHE_MANAGEMENT
	depends on DCACHE
	depends on $(dt_compat_any_has_prop,$(DT_COMPAT_LITEX_MMC),dma-coherent,False)
	default y
	help
	  This needs to be enabled if the LiteSDCard Module is not connected
	  to a coherent DMA bus, meaning that the cache needs to be managed
	  before and after DMA operations.

endif # SDHC_LITEX_LITESDCARD
```

## drivers/sdhc/Kconfig.max32
```kconfig
# Copyright (c) 2024 Analog Devices, Inc.
# SPDX-License-Identifier: Apache-2.0

config SDHC_MAX32
	bool "Analog Devices MAX32 SDHC driver"
	default y
	depends on DT_HAS_ADI_MAX32_SDHC_ENABLED
	select SDHC_SUPPORTS_NATIVE_MODE
	help
	  sdhc driver for max32 family.
```

## drivers/sdhc/Kconfig.mchp
```kconfig
# Copyright (C) 2026 Microchip Technology Inc. and its subsidiaries
# SPDX-License-Identifier: Apache-2.0

config SDHC_MCHP_G1
	bool "Microchip SDHC G1 driver"
	default y
	depends on DT_HAS_MICROCHIP_SDHC_G1_ENABLED
	select PINCTRL
	select SDHC_SUPPORTS_NATIVE_MODE
	help
	  Enable the Microchip SDHC MMC/SD card G1 driver.
```

## drivers/sdhc/Kconfig.mcux_sdif
```kconfig
# Copyright 2022, NXP
# SPDX-License-Identifier: Apache-2.0

config MCUX_SDIF
	bool "NXP MCUX SDIF Driver"
	default y
	depends on DT_HAS_NXP_LPC_SDIF_ENABLED
	select SDHC_SUPPORTS_NATIVE_MODE
	select PINCTRL
	help
	  Enable the NXP SDIF Host controller driver

if MCUX_SDIF

config MCUX_SDIF_DMA_SUPPORT
	bool "DMA support for MCUX SDIF driver"
	default y
	help
	  Enable DMA support for MCUX SDIF driver. May be disabled to reduce
	  footprint of driver.

if MCUX_SDIF_DMA_SUPPORT

# SDIF DMA needs 32 bit aligned buffers
config SDHC_BUFFER_ALIGNMENT
	default 4

config MCUX_SDIF_DMA_BUFFER_SIZE
	int "Size of DMA descriptor buffer in bytes"
	default 256
	help
	  Size of MCUX SDIF DMA descriptor buffer in bytes

endif #MCUX_SDIF_DMA_SUPPORT

endif #MCUX_SDIF
```

## drivers/sdhc/Kconfig.numaker
```kconfig
# SPDX-FileCopyrightText: Copyright (c) 2026 Nuvoton Technology Corporation
# SPDX-License-Identifier: Apache-2.0

config SDHC_NUMAKER
	bool "Nuvoton NuMaker SDHC driver"
	default y
	depends on DT_HAS_NUVOTON_NUMAKER_SDHC_ENABLED
	select PINCTRL
	select SDHC_SUPPORTS_NATIVE_MODE
	help
	  Enable SDHC driver for Nuvoton NuMaker family of processors

if SDHC_NUMAKER

config SDHC_BUFFER_ALIGNMENT
	default DCACHE_LINE_SIZE if CACHE_MANAGEMENT
	default 4

config SDHC_NUMAKER_CMD_TIMEOUT
	int "Timeout for SD commands (in ms)"
	default 200
	help
	  Default timeout in milliseconds for SD commands

config SDHC_NUMAKER_CMD_RETRIES
	int "Number of times to retry sending command to card"
	default 0
	help
	  Number of times to retry sending command to SD card in case of failure

endif # SDHC_NUMAKER
```

## drivers/sdhc/Kconfig.rcar
```kconfig
# Copyright (c) 2023 EPAM Systems
# SPDX-License-Identifier: Apache-2.0

config RCAR_MMC
	bool "Renesas Rcar MMC driver"
	default y
	depends on DT_HAS_RENESAS_RCAR_MMC_ENABLED
	select SDHC_SUPPORTS_NATIVE_MODE
	select REGULATOR
	select GPIO
	select SDHC_SUPPORTS_UHS if SDMMC_STACK
	help
	  Renesas Rcar MMC driver.

if RCAR_MMC

config RCAR_MMC_DMA_SUPPORT
	bool "Internal DMA support for Renesas Rcar MMC driver"
	select CACHE_MANAGEMENT
	select DCACHE
	default y
	help
	  Internal DMA support for Renesas Rcar MMC driver.

config RCAR_MMC_SCC_SUPPORT
	bool "Support of SCC"
	default y
	help
	  Enable support of Sampling Clock Controller for Renesas Rcar MMC driver.

if RCAR_MMC_DMA_SUPPORT

config SDHC_BUFFER_ALIGNMENT
	default 128

config RCAR_MMC_DMA_IRQ_DRIVEN_SUPPORT
	bool "Internal DMA IRQ driven support for Renesas Rcar MMC driver"
	default y

endif # RCAR_MMC_DMA_SUPPORT

endif # RCAR_MMC
```

## drivers/sdhc/Kconfig.renesas_ra
```kconfig
# Copyright (c) 2024 Renesas Electronics Corporation
# SPDX-License-Identifier: Apache-2.0

config SDHC_RENESAS_RA
	bool "Renesas RA SDHI driver"
	default y
	depends on DT_HAS_RENESAS_RA_SDHC_ENABLED
	select SDHC_SUPPORTS_NATIVE_MODE
	select USE_RA_FSP_SDHI
	select USE_RA_FSP_DTC
	select PINCTRL
	help
	  Enables Renesas SD Host controller driver
```

## drivers/sdhc/Kconfig.sam_hsmci
```kconfig
# Copyright 2023 Nikhef
# SPDX-License-Identifier: Apache-2.0

config SAM_HSMCI
	bool "ATMEL SAM HSMCI driver"
	default y
	depends on DT_HAS_ATMEL_SAM_HSMCI_ENABLED
	select PINCTRL
	select SDHC_SUPPORTS_NATIVE_MODE
	help
	  Enable the ATMEL SAM HSMCI MMC/SD card driver.

if SAM_HSMCI

config SAM_HSMCI_PDCMODE
	bool "Use PDC if available"
	default y if SOC_SERIES_SAM4E
	help
	  Use peripheral DMA controller, if supported

config SAM_HSMCI_PWRSAVE
	bool "Power save during card inactive"
	default y
	help
	  Power-save mode reduces the clock-speed during SD card
	  inactivity.

if SAM_HSMCI_PWRSAVE

config SAM_HSMCI_PWRSAVE_DIV
	int "Divisor value of clock when in power-save mode"
	default 7
	help
	  SD clock freqeuncy is divided by 2**(N+1) where N
	  is the divisor value. Valid values are 0 to 7.

endif # SAM_HSMCI_PWRSAVE

endif # SAM_HSMCI
```

## drivers/sdhc/Kconfig.sam_sdmmc
```kconfig
# Copyright (C) 2025 Microchip Technology Inc. and its subsidiaries
#
# SPDX-License-Identifier: Apache-2.0
#

config SAM_SDMMC
	bool "Microchip SAM SDMMC driver"
	default y
	depends on DT_HAS_MICROCHIP_SAMA7G5_SDMMC_ENABLED
	select CACHE_MANAGEMENT
	select PINCTRL
	select SDHC_SUPPORTS_NATIVE_MODE
	help
	  Enable the Microchip SAM SDMMC MMC/SD card driver.
```

## drivers/sdhc/Kconfig.sdhc_cdns
```kconfig
# Copyright (c) 2023 Intel Corporation
# SPDX-License-Identifier: Apache-2.0

config CDNS_SDHC
	bool "CDNS SDHC"
	default y
	depends on DT_HAS_CDNS_SDHC_ENABLED
	select SDHC_SUPPORTS_NATIVE_MODE
	help
		Enable Cadence SDMMC Host Controller.

if CDNS_SDHC

# Cadence SDHC DMA needs 64 bit aligned buffers
config SDHC_BUFFER_ALIGNMENT
	default 8

config CDNS_DESC_COUNT
	int "Allocate number of descriptors"
	default 8
	help
		SD host controllers require DMA preparation for read and write operation.
		Creates static descriptors which can be used by ADMA. Devices should
		configure this flag if they require to transfer more than 8*64Kb of data.

endif # CDNS_SDHC
```

## drivers/sdhc/Kconfig.spi
```kconfig
# Copyright (c) 2022, NXP
# SPDX-License-Identifier: Apache-2.0

config SPI_SDHC
	bool "SD protocol over SPI bus"
	default y
	depends on DT_HAS_ZEPHYR_SDHC_SPI_SLOT_ENABLED
	select SPI
	select CRC
	select SDHC_SUPPORTS_SPI_MODE
	help
	  Enable the SPI SD host controller driver
```

## drivers/sdhc/Kconfig.ti
```kconfig
# SPDX-FileCopyrightText: Copyright (c) 2026 Texas Instruments
# SPDX-License-Identifier: Apache-2.0

config SDHC_TI_AM654
	bool "TI AM654 SDHC driver"
	select SDHC_SUPPORTS_NATIVE_MODE
	select SDHC_SUPPORTS_UHS
	select EVENTS
	select REGULATOR
	default y
	depends on DT_HAS_TI_AM654_SDHCI_ENABLED

	help
	  Interrupt based TI AM654 SD/eMMC Host controller

if SDHC_TI_AM654
config SDHC_TI_AM654_ENABLE_ADMA
	bool "ADMA2"
	default y
	select CACHE_MANAGEMENT if CPU_HAS_DCACHE
	help
	  Enable ADMA2 for TI AM654 SDHC driver

config SDHC_TI_AM654_ENABLE_AUTO_STOP
	bool "Auto-stop commands"
	default y
	help
	  Enable auto-CMD12/CMD23 during multi-block transactions

config SDHC_TI_AM654_ADMA_DESC_LEN
	int "Maximum ADMA descriptor lines"
	default 8
	help
	  Maximum number of ADMA descriptor lines allowed

config SDHC_TI_AM654_LEGACY_PHY
	bool "Legacy PHY configuration"
	help
	  Enable legacy PHY configuration for older IP versions.

	  Early TI SDHC IP implementations use narrower register fields:
	  - DLL frequency register field is 2-bit wide (vs 3-bit in newer IP)
	  - Strobe select field is 4-bit wide (vs 8-bit in newer IP)

	  Enable this for older hardware, disable for newer implementations
	  like J721E which use wider register fields.
endif
```

## drivers/sdhc/Kconfig.zynq
```kconfig
config XLNX_ZYNQ_SDHC
    bool "XLNX Zynq SDHC Driver"
    select SDHC_SUPPORTS_NATIVE_MODE
    depends on DT_HAS_XLNX_ZYNQ_SDHC_ENABLED
    help
	    Enable the XLNX Zynq SDHC Host Controller Driver.

if XLNX_ZYNQ_SDHC
config XLNX_ZYNQ_SDHC_HOST_INTR
	bool "Xlnx Zynq SDHC host controller interrupt mode"
	default y
    select EVENTS
	help
	  Xlnx Zynq SDHC host controller interrupt mode support.

config XLNX_ZYNQ_SDHC_HOST_DMA
	bool "Xlnx Zynq SDHC host controller DMA mode"
	help
	  Xlnx Zynq SDHC host controller DMA mode support.

config XLNX_ZYNQ_SDHC_HOST_ADMA
	bool "Xlnx Zynq SDHC host controller ADMA mode"
	depends on XLNX_ZYNQ_SDHC_HOST_DMA
	help
	  Xlnx Zynq SDHC host controller ADMA mode support.

config XLNX_ZYNQ_SDHC_HOST_ADMA_DESC_SIZE
	int "Xlnx Zynq SDHC host controller ADMA Descriptor size"
	depends on XLNX_ZYNQ_SDHC_HOST_ADMA
	default 32 
	help
	  Xlnx Zynq SDHC host controller ADMA Descriptor size.

config XLNX_ZYNQ_SDHC_HOST_BLOCK_GAP
	bool "Block gap mode"
	depends on XLNX_ZYNQ_SDHC_HOST_DMA
	default y
	help
	  Block gap mode support.

config XLNX_ZYNQ_SDHC_HOST_AUTO_STOP
	bool "auto stop command mode"
	default y
	help
	  Auto stop command mode support.

config XLNX_ZYNQ_SDHC_HOST_TUNING
	bool "Host tuning"
	help
	  Host tuning support.

endif
```
