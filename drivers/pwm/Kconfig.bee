## drivers/pwm/Kconfig.bee
```kconfig
# Copyright (c) 2026, Realtek Semiconductor Corporation
# SPDX-License-Identifier: Apache-2.0

config PWM_BEE
	bool "Realtek Bee series PWM driver"
	default y
	depends on DT_HAS_REALTEK_BEE_PWM_ENABLED
	select HAL_REALTEK_BEE_TIM if DT_HAS_REALTEK_BEE_BASIC_TIMER_ENABLED
	select HAL_REALTEK_BEE_ENHTIM if DT_HAS_REALTEK_BEE_ENHANCED_TIMER_ENABLED
	select PINCTRL
	help
	  This option enables the PWM driver for Realtek Bee SoCs.
```

## drivers/pwm/Kconfig.bflb
```kconfig
# Copyright (c) 2025 MASSDRIVER EI (massdriver.space)
# SPDX-License-Identifier: Apache-2.0

config PWM_BFLB_1
	bool "BFLB PWM 1 (BL60x, BL70x, BL70xL)"
	default y
	depends on DT_HAS_BFLB_PWM_1_ENABLED
	help
	  This option enables the PWM driver for Bouffalolab BL60x, BL70x and some of BL70xL

config PWM_BFLB_2
	bool "BFLB PWM 2 (BL61x, BL70xL)"
	default y
	depends on DT_HAS_BFLB_PWM_2_ENABLED
	help
	  This option enables the PWM driver for Bouffalolab BL61x and some of BL70xL
```

## drivers/pwm/Kconfig.bitbang
```kconfig
# SPDX-FileCopyrightText: Copyright (c) 2026 Siemens
# SPDX-License-Identifier: Apache-2.0

config PWM_BITBANG
	bool "Bitbang PWM driver"
	default y
	depends on DT_HAS_ZEPHYR_PWM_BITBANG_ENABLED
	depends on GPIO
	depends on COUNTER
	help
	  Generic software-based PWM driver using hardware timer interrupts.
	  Use this as a fallback only if you don't have dedicated hardware PWM
	  pins left and understand the CPU overhead implications.
	  The period is the same for all channels.

config PWM_BITBANG_INIT_PRIORITY
	int "PWM bitbang initialization priority"
	default COUNTER_INIT_PRIORITY
	depends on PWM_BITBANG
	help
	  System initialization priority for the bitbang PWM driver.
	  Must be equal or larger than CONFIG_COUNTER_INIT_PRIORITY.
```

## drivers/pwm/Kconfig.cc13xx_cc26xx_timer
```kconfig
# Copyright (c) 2023 Zephyr Project
# SPDX-License-Identifier: Apache-2.0

config PWM_CC13XX_CC26XX_TIMER
	bool "TI SimpleLink CC13xx/CC26xx GPT timer PWM driver"
	default y
	depends on DT_HAS_TI_CC13XX_CC26XX_TIMER_PWM_ENABLED
	select PINCTRL
	help
	  Enables TI SimpleLink CC13xx/CC26xx GPT timer PWM driver.
```

## drivers/pwm/Kconfig.cc23x0_timer
```kconfig
# Copyright (c) 2024 BayLibre, SAS
# SPDX-License-Identifier: Apache-2.0

config PWM_CC23X0_TIMER
	bool "TI SimpleLink CC23x0 LGPT PWM driver"
	default y
	depends on DT_HAS_TI_CC23X0_LGPT_PWM_ENABLED
	select PINCTRL
	help
	  Enables TI SimpleLink CC23x0 LGPT PWM driver.
```

## drivers/pwm/Kconfig.dw
```kconfig
# Kconfig.dw - DesignWare PWM configuration options
#
#
# Copyright (c) 2016 Intel Corporation
#
# SPDX-License-Identifier: Apache-2.0
#

menuconfig PWM_DW
	bool "DesignWare PWM"
	help
	  Enable driver to utilize PWM on the DesignWare Timer IP block.
	  Care must be taken if one is also to use the timer feature, as
	  they both use the same set of registers.

if PWM_DW

config PWM_DW_0_DRV_NAME
	string "DesignWare PWM Device Name"
	default "PWM_0"
	help
	  Specify the device name for the DesignWare PWM driver.

endif # PWM_DW
```

## drivers/pwm/Kconfig.ene
```kconfig
# Copyright (c) 2024 ENE Technology Inc.
# SPDX-License-Identifier: Apache-2.0

config PWM_ENE_KB1200
	bool "ENE KB1200 PWM driver"
	default y
	depends on DT_HAS_ENE_KB1200_PWM_ENABLED
	select PINCTRL
	help
	  This option enables the PWM driver for KB1200 processors.
```

## drivers/pwm/Kconfig.esp32
```kconfig
# ESP32 PWM LED configuration options

# Copyright (c) 2017 Vitor Massaru Iha <vitor@massaru.org>
# Copyright (c) 2022 Espressif Systems (Shanghai) Co., Ltd.
# SPDX-License-Identifier: Apache-2.0

config PWM_LED_ESP32
	bool "ESP32 PWM LED driver"
	default y
	depends on DT_HAS_ESPRESSIF_ESP32_LEDC_ENABLED
	help
	  This option enables the PWM LED driver for ESP32 family of
	  processors.

config MCPWM_ESP32
	bool "ESP32 MCPWM driver"
	default y
	depends on DT_HAS_ESPRESSIF_ESP32_MCPWM_ENABLED
	help
	  This option enables the MCPWM driver for ESP32 family of
	  processors.
```

## drivers/pwm/Kconfig.fake
```kconfig
# Fake PWM configuration options

# Copyright (c) 2024 Kickmaker
# SPDX-License-Identifier: Apache-2.0

config PWM_FAKE
	bool "Fake PWM driver"
	default y
	depends on DT_HAS_ZEPHYR_FAKE_PWM_ENABLED
	help
	  Enable support for the FFF-based fake PWM driver.
```

## drivers/pwm/Kconfig.gd32
```kconfig
# Copyright (c) 2021 Teslabs Engineering S.L.
# SPDX-License-Identifier: Apache-2.0

config PWM_GD32
	bool "GigaDevice GD32 PWM driver"
	default y
	depends on DT_HAS_GD_GD32_PWM_ENABLED
	help
	  Enable the GigaDevice GD32 PWM driver.
```

## drivers/pwm/Kconfig.gecko
```kconfig
# GECKO PWM configuration options

# Copyright (c) 2021 Sun Amar.
# SPDX-License-Identifier: Apache-2.0

config PWM_GECKO
	bool "GECKO MCU PWM driver"
	default y
	depends on DT_HAS_SILABS_GECKO_PWM_ENABLED
	select SOC_GECKO_TIMER
	help
	  This option enables the PWM driver for EXX32 GECKO family of
	  processors. Say y if you wish to use PWM port on EXX32
	  MCU.
```

## drivers/pwm/Kconfig.ifx_cat1
```kconfig
# ==================================================================================================
# Copyright (c) 2025 Cypress Semiconductor Corporation (an Infineon company) or
# an affiliate of Cypress Semiconductor Corporation
#
# SPDX-License-Identifier: Apache-2.0
# ==================================================================================================

# Infineon CAT1 PWM configuration options

config PWM_INFINEON_CAT1
	bool "Infineon CAT1 PWM driver"
	default y
	depends on DT_HAS_INFINEON_CAT1_PWM_ENABLED
	depends on SOC_FAMILY_INFINEON_CAT1B
	select USE_INFINEON_PWM
	select PINCTRL
	help
	  This option enables the PWM driver for Infineon CAT1 family.
```

## drivers/pwm/Kconfig.ifx_tcpwm
```kconfig
# Infineon TCPWM PWM configuration options

# Copyright (c) 2024 Cypress Semiconductor Corporation (an Infineon company) or
# an affiliate of Cypress Semiconductor Corporation
#
# SPDX-License-Identifier: Apache-2.0

config PWM_INFINEON_TCPWM
	bool "Infineon TCPWM driver"
	default y
	depends on DT_HAS_INFINEON_TCPWM_PWM_ENABLED
	depends on SOC_FAMILY_INFINEON_CAT1B
	select USE_INFINEON_PWM
	select PINCTRL
	help
	  This option enables the PWM driver for Infineon TCPWM peripheral.
```

## drivers/pwm/Kconfig.infineon_tcpwm
```kconfig
# Copyright (c) 2025 Infineon Technologies AG,
# or an affiliate of Infineon Technologies AG.
#
# SPDX-License-Identifier: Apache-2.0
#
# Infineon TCPWM PWM configuration options

config PWM_INFINEON_TCPWM
	bool "Infineon TCPWM driver"
	default y
	depends on DT_HAS_INFINEON_TCPWM_PWM_ENABLED
	depends on !SOC_FAMILY_INFINEON_PSOC4
	select USE_INFINEON_PWM
	select PINCTRL
	help
	  This option enables the PWM driver in the Infineon TCPWM peripheral.

config PWM_INFINEON_TCPWM_PSOC4
	bool "Infineon TCPWM driver for PSOC4"
	default y
	depends on DT_HAS_INFINEON_TCPWM_PWM_ENABLED
	depends on SOC_FAMILY_INFINEON_PSOC4
	select USE_INFINEON_PWM
	select PINCTRL
	help
	  This option enables the PWM driver in the Infineon TCPWM peripheral for PSOC4 family.
```

## drivers/pwm/Kconfig.intel_blinky
```kconfig
# Intel Blinky PWM configuration options

# Copyright (c) 2023 Intel Corporation
# SPDX-License-Identifier: Apache-2.0

config PWM_INTEL_BLINKY
	bool "Blinky PWM driver"
	default y
	depends on DT_HAS_INTEL_BLINKY_PWM_ENABLED
	help
	  Enable the INTEL PCH PWM driver found on Intel SoCs
```

## drivers/pwm/Kconfig.it8801
```kconfig
# Copyright (c) 2024 ITE Corporation. All Rights Reserved.
# SPDX-License-Identifier: Apache-2.0

config PWM_ITE_IT8801
	bool "ITE IT8801 PWM device driver"
	default y
	depends on DT_HAS_ITE_IT8801_PWM_ENABLED
	select I2C
	select MFD
	help
	   Enable driver for ITE IT8801 I2C-based PWM.
	   Supports 7 open-drain/push-pull outputs.
```

## drivers/pwm/Kconfig.it8xxx2
```kconfig
# IT8XXX2 PWM configuration options

# Copyright (c) 2021 ITE Corporation. All Rights Reserved.
# SPDX-License-Identifier: Apache-2.0

config PWM_ITE_IT8XXX2
	bool "ITE IT8XXX2 embedded controller (EC) PWM driver"
	default y
	depends on DT_HAS_ITE_IT8XXX2_PWM_ENABLED
	help
	   Enable PWM driver for it8xxx2_evb.
	   Supports three 16-bit prescalers each with 8-bit cycle timer, and
	   eight PWM channels each with 8-bit duty cycle.
```
