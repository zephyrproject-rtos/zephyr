## drivers/pwm/Kconfig.mcux_ctimer
```kconfig
# (c) Meta Platforms, Inc. and affiliates.
# Copyright 2026 NXP
# SPDX-License-Identifier: Apache-2.0

config PWM_MCUX_CTIMER
	bool "MCUX CTimer PWM driver"
	default y
	depends on DT_HAS_NXP_CTIMER_PWM_ENABLED
	select PINCTRL
	select NXP_INPUTMUX if PWM_CAPTURE
	help
	  Enable ctimer based pwm driver.
```

## drivers/pwm/Kconfig.mcux_ftm
```kconfig
# MCUXpresso SDK FTM PWM

# Copyright (c) 2017, NXP
# SPDX-License-Identifier: Apache-2.0

config PWM_MCUX_FTM
	bool "MCUX FTM PWM driver"
	default y
	depends on DT_HAS_NXP_KINETIS_FTM_PWM_ENABLED
	select PINCTRL
	help
	  Enable support for mcux ftm pwm driver.

config PWM_CAPTURE_MCUX_FTM_FILTER_VALUE
	int "MCUX FTM PWM capture filter value"
	depends on PWM_MCUX_FTM && PWM_CAPTURE
	range 0 15
	default 0
	help
	  PWM capture filter value for channels 0 and 2.
```

## drivers/pwm/Kconfig.mcux_pwt
```kconfig
# Copyright 2021 Vestas Wind Systems A/S
# SPDX-License-Identifier: Apache-2.0

# MCUX PWT PWM

config PWM_MCUX_PWT
	bool "MCUX PWT PWM capture driver"
	default y
	depends on DT_HAS_NXP_KINETIS_PWT_ENABLED
	depends on CLOCK_CONTROL && PWM_CAPTURE
	select PINCTRL
	help
	  Enable the MCUX Pulse Width Timer (PWT) PWM capture driver.
```

## drivers/pwm/Kconfig.mcux_qtmr
```kconfig
# Copyright 2024-2025 NXP
# SPDX-License-Identifier: Apache-2.0

config PWM_MCUX_QTMR
	bool "MCUX QMTR PWM driver"
	default y
	depends on DT_HAS_NXP_QTMR_PWM_ENABLED
	depends on CLOCK_CONTROL
	select PINCTRL
	help
	  Enable QTMR based pwm driver.

config PWM_CAPTURE_MCUX_QTMR_FILTER_PERIOD
	int "MCUX QMTR PWM Input Filter Sample Period"
	depends on PWM_MCUX_QTMR && PWM_CAPTURE
	range 0 255
	default 0
	help
	  Indicates the sampling period (in IP bus clock cycles) of
	  the TMR input signals. If the value is 0x00 (default), then
	  the input filter is bypassed.

config PWM_CAPTURE_MCUX_QTMR_FILTER_COUNT
	int "MCUX QMTR PWM Input Filter Sample Count"
	depends on PWM_MCUX_QTMR && PWM_CAPTURE
	range 0 7
	default 0
	help
	  Indicates the number of consecutive samples that must agree prior to the
	  input filter accepting an input transition. The real number of samples is
	  (value +3). For example, a value of 0x0 indicates 3 samples.
```

## drivers/pwm/Kconfig.mcux_sctimer
```kconfig
# Copyright 2021 NXP
# SPDX-License-Identifier: Apache-2.0

config PWM_MCUX_SCTIMER
	bool "MCUX SCTimer PWM driver"
	default y
	depends on DT_HAS_NXP_SCTIMER_PWM_ENABLED
	depends on CLOCK_CONTROL
	select PINCTRL
	select MUX if PWM_CAPTURE
	help
	  Enable sctimer based pwm driver.
```

## drivers/pwm/Kconfig.mcux_tpm
```kconfig
# Copyright 2020, 2025 NXP
# SPDX-License-Identifier: Apache-2.0

# MCUX TPM PWM

config PWM_MCUX_TPM
	bool "MCUX TPM PWM driver"
	default y
	depends on DT_HAS_NXP_KINETIS_TPM_ENABLED
	depends on CLOCK_CONTROL
	select PINCTRL
	help
	  Enable the MCUX TPM PWM driver.

config PWM_CAPTURE_MCUX_TPM_FILTER_VALUE
	int "MCUX TPM PWM capture filter value"
	depends on PWM_MCUX_TPM && PWM_CAPTURE
	range 0 15
	default 0
	help
	  PWM capture filter value for channels.
	  The filter is disabled when the value is zero, otherwise
	  the filter is configured as (CHxFVAL * 4) clock cycles.
```

## drivers/pwm/Kconfig.mec5
```kconfig
# Microchip MEC5 HAL based PWM configuration options

# Copyright (c) 2024 Microchip Technology Inc.
# SPDX-License-Identifier: Apache-2.0

config PWM_MEC5
	bool "Microchip MEC5 PWM"
	default y
	depends on DT_HAS_MICROCHIP_MEC5_PWM_ENABLED
	select PINCTRL
	help
	  Enable driver to utilize PWM using the Microchip MEC5 HAL.
```

## drivers/pwm/Kconfig.nct
```kconfig
# NCT PWM driver configuration options

# Copyright (c) 2024 Nuvoton Technology Corporation.
# SPDX-License-Identifier: Apache-2.0

config PWM_NCT
	bool "Nuvoton NCT Enhanced Super I/O (eSIO) PWM driver"
	default y
	depends on DT_HAS_NUVOTON_NCT_PWM_ENABLED
	help
	  This option enables the PWM driver for NCT family of
	  processors.
	  Say y if you wish to use pwm ports on NCT MCU.
```

## drivers/pwm/Kconfig.neorv32
```kconfig
# NEORV32 PWM configuration options

# Copyright (c) 2025 Henrik Brix Andersen <henrik@brixandersen.dk>
# SPDX-License-Identifier: Apache-2.0

config PWM_NEORV32
	bool "NEORV32 PWM driver"
	default y
	depends on DT_HAS_NEORV32_PWM_ENABLED
	depends on SYSCON
	help
	  Enable NEORV32 PWM driver.
```

## drivers/pwm/Kconfig.npcm
```kconfig
# NPCM PWM driver configuration options

# Copyright (c) 2024 Nuvoton Technology Corporation.
# SPDX-License-Identifier: Apache-2.0

config PWM_NPCM
	bool "Nuvoton NPCM Enhanced Super I/O (eSIO) PWM driver"
	default y
	depends on DT_HAS_NUVOTON_NPCM_PWM_ENABLED
	help
	  This option enables the PWM driver for NPCM family of
	  processors.
	  Say y if you wish to use pwm ports on NPCM MCU.
```

## drivers/pwm/Kconfig.npcx
```kconfig
# NPCX PWM driver configuration options

# Copyright (c) 2020 Nuvoton Technology Corporation.
# SPDX-License-Identifier: Apache-2.0

config PWM_NPCX
	bool "Nuvoton NPCX embedded controller (EC) PWM driver"
	default y
	depends on DT_HAS_NUVOTON_NPCX_PWM_ENABLED
	select PINCTRL
	help
	  This option enables the PWM driver for NPCX family of
	  processors.
	  Say y if you wish to use pwm ports on NPCX MCU.
```

## drivers/pwm/Kconfig.nrf5_sw
```kconfig
# Nordic Semiconductor nRF5x s/w PWM configuration options

# Copyright (c) 2017 Nordic Semiconductor ASA
# SPDX-License-Identifier: Apache-2.0

config PWM_NRF5_SW
	bool "Nordic Semiconductor nRF5x series S/W PWM"
	default y if !PWM_NRFX
	depends on DT_HAS_NORDIC_NRF_SW_PWM_ENABLED
	depends on DT_HAS_NORDIC_NRF_PPI_ENABLED
	select NRFX_GPIOTE
	select NRFX_PPI
	help
	  Enable driver to utilize PWM on the Nordic Semiconductor nRF5x series.

	  When used with HF timer it provides up to 3 pins, utilizing two PPI
	  channels per pin and one GPIOTE config per pin.

	  When used with RTC it provides up to 3 pins, utilizing three PPI
	  channels per pin and one GPIOTE config per pin.
```

## drivers/pwm/Kconfig.nrf_sw
```kconfig
# Nordic Semiconductor nRF5x s/w PWM configuration options

# Copyright (c) 2017 Nordic Semiconductor ASA
# SPDX-License-Identifier: Apache-2.0

config PWM_NRF_SW
	bool "Nordic Semiconductor nRF family S/W PWM"
	default y
	depends on DT_HAS_NORDIC_NRF_SW_PWM_ENABLED
	select NRFX_GPIOTE
	select NRFX_PPI if HAS_HW_NRF_PPI
	select NRFX_DPPI if HAS_HW_NRF_DPPIC
	help
	  Enable driver to utilize PWM on the Nordic Semiconductor nRF SoCs.

	  When used with HF timer, it provides up to 5 pins, utilizing one
	  GPIOTE channel and two PPI/DPPI channels and per pin.

	  When used with RTC, it provides up to 3 pins, utilizing one GPIOTE
	  channel and two or three (when the fork feature is not available)
	  PPI/DPPI channels per pin.
```

## drivers/pwm/Kconfig.nrfx
```kconfig
# Copyright (c) 2018, Cue Health Inc
# SPDX-License-Identifier: Apache-2.0

config PWM_NRFX
	bool "nRF PWM nrfx driver"
	default y
	depends on DT_HAS_NORDIC_NRF_PWM_ENABLED
	select NRFX_PWM
	select PINCTRL
	help
	  Enable support for nrfx Hardware PWM driver for nRF52 MCU series.

config PWM_NRFX_NO_GLITCH_DUTY_100
	bool "No glitches when using 100% duty"
	depends on $(dt_compat_any_has_prop,$(DT_COMPAT_NORDIC_NRF_PWM),idleout-supported,True)
	default y
	help
	  Due to how IDLEOUT feature in PWM works it is possible to see a glitch on a channel
	  with 100% duty cycle when all other channels switches to 0% or 100%. Enabling this
	  option ensures that there are no glitches but it also means that 100% duty cycle
	  on any channels requires PWM peripheral to be active.
```

## drivers/pwm/Kconfig.numaker
```kconfig
# NUMAKER PWM Driver configuration options

# Copyright (c) 2023 Nuvoton Technology Corporation.
# SPDX-License-Identifier: Apache-2.0

config PWM_NUMAKER
	bool "Nuvoton NuMaker MCU PWM driver"
	default y
	select HAS_NUMAKER_PWM
	select PINCTRL
	depends on DT_HAS_NUVOTON_NUMAKER_PWM_ENABLED
	help
	  This option enables the PWM driver for Nuvoton NuMaker family of
	  processors.
	  Say y if you wish to enable NuMaker PWM.
```

## drivers/pwm/Kconfig.nxp_flexio
```kconfig
# Copyright 2024 NXP
# SPDX-License-Identifier: Apache-2.0

config PWM_NXP_FLEXIO
	bool "NXP Flexio PWM driver"
	default y
	depends on DT_HAS_NXP_FLEXIO_ENABLED
	depends on CLOCK_CONTROL
	depends on DT_HAS_NXP_FLEXIO_PWM_ENABLED
	select MCUX_FLEXIO
	help
	  Enable flexio based pwm driver.
```

## drivers/pwm/Kconfig.nxp_s32_emios
```kconfig
# Copyright 2023 NXP
# SPDX-License-Identifier: Apache-2.0

config PWM_NXP_S32_EMIOS
	bool "NXP S32 PWM-eMIOS driver"
	default y
	depends on DT_HAS_NXP_S32_EMIOS_PWM_ENABLED
	select NXP_S32_EMIOS
	select NOCACHE_MEMORY if ARCH_HAS_NOCACHE_MEMORY_SUPPORT
	help
	  Enable support for the NXP S32 PWM-eMIOS.
```

## drivers/pwm/Kconfig.pca9685
```kconfig
#
# Copyright (c) 2022 Nick Ward <nix.ward@gmail.com>
#
# SPDX-License-Identifier: Apache-2.0
#

config PWM_PCA9685
	bool "PCA9685 16-channel, 12-bit PWM Fm+ I2C-bus LED controller"
	default y
	depends on DT_HAS_NXP_PCA9685_PWM_ENABLED
	select I2C
	help
	  Enable driver for PCA9685 16-channel, 12-bit PWM Fm+ I2C-bus LED
	  controller.
```

## drivers/pwm/Kconfig.pch_blinky
```kconfig
# Kconfig.blinky_intel - Blinky PWM configuration options
#
# Copyright (c) 2023 Intel Corporation
#
# SPDX-License-Identifier: Apache-2.0
#

menuconfig PWM_BLINKY_INTEL
	bool "Blinky PWM driver"
	default y
	depends on DT_HAS_INTEL_BLINKY_PWM_ENABLED
	help
	  Enable the BK PWM driver found on Intel SoCs
```

## drivers/pwm/Kconfig.pic32cxsg
```kconfig
# Microchip PIC32CXSG TCC as PWM configuration

# Copyright (c) 2024 Microchip
# SPDX-License-Identifier: Apache-2.0

config PWM_PIC32CXSG_TCC
	bool "Microchip PIC32CXSG MCU Family TCC PWM Driver"
	default y
	depends on DT_HAS_PIC32CXSG_TCC_PWM_ENABLED
	help
	  Enable PWM driver for Microchip PIC32CXSG MCUs using the TCC timer/counter.
```

## drivers/pwm/Kconfig.qmsi
```kconfig
# Kconfig.qmsi - QMSI PWM configuration options
#
#
# Copyright (c) 2016 Intel Corporation
#
# SPDX-License-Identifier: Apache-2.0
#

menuconfig PWM_QMSI
	bool "QMSI PWM Driver"
	depends on QMSI && PWM
	help
	  Enable QMSI PWM driver. This driver will use the QMSI library to
	  access the SOC underlying timer IP block. This driver uses the
	  DesignWare IP block that can be also handled by the PWM_DW driver

config PWM_QMSI_DEV_NAME
	string "QMSI PWM Device Name"
	depends on PWM_QMSI
	default "PWM_0"
	help
	  Specify the device name for the PWM driver.

config PWM_QMSI_NUM_PORTS
	int "Number of PWM ports for PWM"
	depends on PWM_QMSI
	default 1
	help
	  Specify how many PWM ports on the IP block.

config PWM_QMSI_API_REENTRANCY
	bool "PWM shim driver API reentrancy"
	depends on PWM_QMSI
	help
	  Enable support for PWM shim driver API reentrancy.
```

## drivers/pwm/Kconfig.rcar
```kconfig
# Reneas R-Car PWM configuration options

# Copyright (c) 2022 IoT.bzh
# SPDX-License-Identifier: Apache-2.0

config PWM_RCAR
	bool "Renesas R-Car PWM Driver"
	default y
	depends on SOC_FAMILY_RENESAS_RCAR
	depends on DT_HAS_RENESAS_PWM_RCAR_ENABLED
	help
	  Enable Renesas R-Car PWM Driver.
```

## drivers/pwm/Kconfig.renesas_ra
```kconfig
# Copyright (c) 2024 Renesas Electronics Corporation
# SPDX-License-Identifier: Apache-2.0

config PWM_RENESAS_RA
	bool "Renesas RA PWM driver"
	default y
	depends on DT_HAS_RENESAS_RA_PWM_ENABLED
	select USE_RA_FSP_GPT
	select PINCTRL
	help
	  Enable Renesas RA PWM Driver.
```

## drivers/pwm/Kconfig.renesas_ra8
```kconfig
# Copyright (c) 2024 Renesas Electronics Corporation
# SPDX-License-Identifier: Apache-2.0

config PWM_RENESAS_RA8
	bool "Renesas RA8 PWM driver"
	default y
	depends on DT_HAS_RENESAS_RA8_PWM_ENABLED
	select USE_RA_FSP_GPT
	help
	  Enable Renesas RA8 PWM Driver.
```

## drivers/pwm/Kconfig.renesas_rx_mtu
```kconfig
# Copyright (c) 2025 Renesas Electronics Corporation
# SPDX-License-Identifier: Apache-2.0

config PWM_RENESAS_RX_MTU
	bool "Renesas RX MTU PWM driver"
	default y
	depends on DT_HAS_RENESAS_RX_MTU_PWM_ENABLED
	help
	  Enable the Renesas RX PWM driver.
```
