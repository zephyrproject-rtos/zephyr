## drivers/pwm/Kconfig.renesas_rz
```kconfig
# Copyright (c) 2024 Renesas Electronics Corporation
# SPDX-License-Identifier: Apache-2.0

config PWM_RENESAS_RZ_GPT
	bool "Renesas RZ General PWM Timer (GPT) PWM driver"
	default y
	depends on DT_HAS_RENESAS_RZ_GPT_PWM_ENABLED
	select USE_RZ_FSP_GPT
	help
	  Enable the PWM driver for the Renesas RZ General PWM Timer (GPT).
```

## drivers/pwm/Kconfig.renesas_rza2m
```kconfig
# Copyright (c) 2025 Renesas Electronics Corporation
# SPDX-License-Identifier: Apache-2.0

config PWM_RENESAS_RZA2M_GPT
	bool "Renesas RZA2M General PWM Timer (GPT) PWM driver"
	default y
	depends on DT_HAS_RENESAS_RZA2M_GPT_PWM_ENABLED
	help
	  Enable the PWM driver for the Renesas RZA2M General PWM Timer (GPT).
```

## drivers/pwm/Kconfig.rpi_pico
```kconfig
# Copyright (c) 2022, Joep Buruma
# SPDX-License-Identifier: Apache-2.0

config PWM_RPI_PICO
	bool "RPi Pico PWM"
	default y
	depends on DT_HAS_RASPBERRYPI_PICO_PWM_ENABLED
	depends on RESET
	select PICOSDK_USE_PWM
	select PINCTRL
	help
	  Enable PWM driver for RPi Pico family of MCUs
```

## drivers/pwm/Kconfig.rts5912
```kconfig
# Copyright (c) 2025, Realtek, SIBG-SD7
# SPDX-License-Identifier: Apache-2.0

config PWM_REALTEK_RTS5912
	bool "Realtek RTS5912 PWM Driver"
	default y
	depends on DT_HAS_REALTEK_RTS5912_PWM_ENABLED
	help
	  Enable PWM driver for Realtek RTS5912 EC.
```

## drivers/pwm/Kconfig.rv32m1_tpm
```kconfig
# RV32M1 TPM PWM

# Copyright (c) 2019 Henrik Brix Andersen <henrik@brixandersen.dk>
# SPDX-License-Identifier: Apache-2.0

config PWM_RV32M1_TPM
	bool "RV32M1 TPM PWM driver"
	default y
	depends on DT_HAS_OPENISA_RV32M1_TPM_ENABLED
	depends on CLOCK_CONTROL
	help
	  Enable the RV32M1 TPM PWM driver.
```

## drivers/pwm/Kconfig.sam
```kconfig
# Atmel SAM TRNG configuration

# Copyright (c) 2019 Aurelien Jarno
# SPDX-License-Identifier: Apache-2.0

config PWM_SAM
	bool "Atmel SAM MCU Family PWM Driver"
	default y
	depends on DT_HAS_ATMEL_SAM_PWM_ENABLED
	help
	  Enable PWM driver for Atmel SAM MCUs.
```

## drivers/pwm/Kconfig.sam0
```kconfig
# Atmel SAM0 TCC as PWM configuration

# Copyright (c) 2020 Google LLC
# SPDX-License-Identifier: Apache-2.0

config PWM_SAM0_TCC
	bool "Atmel SAM0 MCU Family TCC PWM Driver"
	depends on SOC_FAMILY_SAM0
	help
	  Enable PWM driver for Atmel SAM0 MCUs using the TCC timer/counter.
```

## drivers/pwm/Kconfig.sam0_tc
```kconfig
# Atmel SAM0 TCC as PWM configuration

# Copyright (c) 2020 Google LLC
# SPDX-License-Identifier: Apache-2.0

config PWM_SAM0_TC
	bool "Atmel SAM0 MCU Family TC PWM Driver"
	default y
	depends on DT_HAS_ATMEL_SAM0_TC_PWM_ENABLED
	help
	  Enable PWM driver for Atmel SAM0 MCUs using the TC timer/counter.

config PWM_TC_INIT_PRIORITY
	int "Init Priority"
	default 50
	help
	  Device driver initialization priority
```

## drivers/pwm/Kconfig.shakti
```kconfig
# Copyright (c) 2026 RISE Lab, IIT Madras
# SPDX-License-Identifier: Apache-2.0

config PWM_SHAKTI
	bool "Shakti PWM driver"
	default y
	depends on DT_HAS_SHAKTI_PWM_ENABLED
	help
	  Enable the Shakti PWM driver.
```

## drivers/pwm/Kconfig.sifive
```kconfig
# SiFive Freedom PWM configuration options

# Copyright (c) 2018 SiFive Inc.
# SPDX-License-Identifier: Apache-2.0

config PWM_SIFIVE
	bool "SiFive Freedom PWM driver"
	default y
	depends on DT_HAS_SIFIVE_PWM0_ENABLED
	select PINCTRL if SOC_SERIES_SIFIVE_FREEDOM_FE300
	help
	  Enable the PWM driver for the SiFive Freedom platform
```

## drivers/pwm/Kconfig.silabs
```kconfig
# Copyright (c) 2025 Silicon Laboratories Inc.
# SPDX-License-Identifier: Apache-2.0

config PWM_SILABS_LETIMER
	bool "Silabs LETIMER PWM driver"
	default y
	depends on DT_HAS_SILABS_LETIMER_PWM_ENABLED
	select SILABS_SISDK_LETIMER
	help
	  Enable the PWM driver for the LETIMER peripheral on Silabs Series 2 SoCs.

	  The LETIMER peripheral has two channels which share PWM period configuration. The last
	  configured period will apply to both channels. The output may glitch when updating the
	  PWM pulse and period, as the new values will take effect immediately.

config PWM_SILABS_TIMER
	bool "Silabs TIMER PWM driver"
	default y
	depends on DT_HAS_SILABS_TIMER_PWM_ENABLED
	select SILABS_SISDK_TIMER
	help
	  Enable the PWM driver for the TIMER peripheral on Silabs Series 2 SoCs.

	  The TIMER peripheral has three or more channels which share PWM period configuration.
	  The last configured period will apply to all channels.
```

## drivers/pwm/Kconfig.siwx91x
```kconfig
# Copyright (c) 2025 Silicon Laboratories Inc.
# SPDX-License-Identifier: Apache-2.0

config PWM_SILABS_SIWX91X
	bool "Silabs SiWx91x PWM driver"
	default y
	depends on DT_HAS_SILABS_SIWX91X_PWM_ENABLED
	help
	  Enable the PWM driver for the Silabs SiWx91x SoC series.
```

## drivers/pwm/Kconfig.sophgo
```kconfig
# Copyright (c) 2023-2024 Chen Xingyu <hi@xingrz.me>
# SPDX-License-Identifier: Apache-2.0

config PWM_SOPHGO_CVI
	bool "SOPHGO CVI series PWM driver"
	default y
	depends on DT_HAS_SOPHGO_CVI_PWM_ENABLED
	help
	  Enables support for the SOPHGO CVI series PWM.
```

## drivers/pwm/Kconfig.stm32
```kconfig
# STM32 PWM configuration options

# Copyright (c) 2016 Linaro Limited.
# SPDX-License-Identifier: Apache-2.0

config PWM_STM32
	bool "STM32 MCU PWM driver"
	default y
	depends on DT_HAS_ST_STM32_PWM_ENABLED
	select RESET
	select PINCTRL
	help
	  This option enables the PWM driver for STM32 family of
	  processors. Say y if you wish to use PWM port on STM32
	  MCU.
```

## drivers/pwm/Kconfig.test
```kconfig
# Copyright (c) 2022, Commonwealth Scientific and Industrial Research
# Organisation (CSIRO) ABN 41 687 119 230.
# SPDX-License-Identifier: Apache-2.0

# Hidden option for turning on the dummy driver for vnd,pwm devices
# used in testing.
config PWM_TEST
	def_bool DT_HAS_VND_PWM_ENABLED
	depends on DT_HAS_VND_PWM_ENABLED
```

## drivers/pwm/Kconfig.ti_am3352_ehrpwm
```kconfig
# SPDX-FileCopyrightText: Copyright (c) 2026 Texas Instruments
# SPDX-License-Identifier: Apache-2.0

config PWM_TI_AM3352_EHRPWM
	bool "TI EHRPWM based PWM controller"
	default y
	depends on DT_HAS_TI_AM3352_EHRPWM_ENABLED
	depends on CLOCK_CONTROL
	select PINCTRL
	select SYSCON
	help
	  Enable EHRPWM controller for TI SoCs
```

## drivers/pwm/Kconfig.tlx
```kconfig
# Copyright (c) 2021-2023 Telink Semiconductor
# SPDX-License-Identifier: Apache-2.0

config PWM_TELINK_TLX
	bool "Telink Semiconductor TLx PWM driver"
	default y
	depends on DT_HAS_TELINK_TLX_PWM_ENABLED
	help
	  Enables Telink TLx PWM driver.
```

## drivers/pwm/Kconfig.w91
```kconfig
# Copyright (c) 2024 Telink Semiconductor
# SPDX-License-Identifier: Apache-2.0

config PWM_TELINK_W91
	bool "Telink Semiconductor W91 PWM driver"
	default y
	depends on DT_HAS_TELINK_W91_PWM_ENABLED
	help
	  Enables Telink W91 PWM driver.
```

## drivers/pwm/Kconfig.wch
```kconfig
# Copyright (c) 2025 Michael Hope <michaelh@juju.nz>
# SPDX-License-Identifier: Apache-2.0

config PWM_WCH_GPTM
	bool "WCH General-purpose Timer (GPTM) for PWM"
	default y
	depends on DT_HAS_WCH_GPTM_PWM_ENABLED
	select PINCTRL
	help
	  PWM driver for the WCH GPTM, such as TIM2 on the CH32V003.
```

## drivers/pwm/Kconfig.xec
```kconfig
# Microchip XEC PWM configuration options

# Copyright (c) 2019 Intel Corporation
# SPDX-License-Identifier: Apache-2.0

config PWM_XEC
	bool "Microchip XEC PWM"
	default y
	depends on DT_HAS_MICROCHIP_XEC_PWM_ENABLED
	select PINCTRL
	help
	  Enable driver to utilize PWM on the Microchip XEC IP block.

config PWM_BBLED_XEC
	bool "Microchip XEC PWM-BBLED"
	default y
	depends on DT_HAS_MICROCHIP_XEC_PWMBBLED_ENABLED
	select PINCTRL
	help
	  Enable driver to utilize the Microchip XEC Breathing-Blinking LED
	  as a PWM
```

## drivers/pwm/Kconfig.xlnx
```kconfig
# Xilinx AXI Timer

# Copyright (c) 2020 Henrik Brix Andersen <henrik@brixandersen.dk>
# SPDX-License-Identifier: Apache-2.0

config PWM_XLNX_AXI_TIMER
	bool "Xilinx AXI Timer driver"
	default y
	depends on DT_HAS_XLNX_XPS_TIMER_1_00_A_PWM_ENABLED
	help
	  Enable PWM support for the Xilinx AXI Timer v2.0 IP.
```

## drivers/pwm/Kconfig.xmc4xxx_ccu4
```kconfig
# Copyright (c) 2023 SLB
# SPDX-License-Identifier: Apache-2.0

config PWM_XMC4XXX_CCU4
	bool "Infineon XMC4XXX CCU4 driver"
	default y
	depends on DT_HAS_INFINEON_XMC4XXX_CCU4_PWM_ENABLED
	select PINCTRL
	help
	  Enables Infineon XMC4XXX CCU4 PWM driver.
```

## drivers/pwm/Kconfig.xmc4xxx_ccu8
```kconfig
# Copyright (c) 2023 SLB
# SPDX-License-Identifier: Apache-2.0

config PWM_XMC4XXX_CCU8
	bool "Infineon XMC4XXX CCU4 driver"
	default y
	depends on DT_HAS_INFINEON_XMC4XXX_CCU8_PWM_ENABLED
	select PINCTRL
	help
	  Enables Infineon XMC4XXX CCU8 PWM driver.
```

## drivers/pxp/Kconfig
```kconfig
# PXP driver configuration options

# Copyright (c) 2019 Linaro Limited
# SPDX-License-Identifier: Apache-2.0

#
# PXP Drivers
#
menuconfig PXP
	bool "NXP PXP hardware support"
	help
	  Enable support for the PXP.

if PXP

source "drivers/pxp/Kconfig.mcux_pxp"

endif # PXP
```

## drivers/pxp/Kconfig.mcux_pxp
```kconfig
# NXP MCUX PXP driver configuration options

# Copyright (c) 2019, Linaro Limited
# SPDX-License-Identifier: Apache-2.0

config PXP_MCUX_PXP
	bool "NXP MCUX PXP driver"
	depends on HAS_MCUX_PXP
```
