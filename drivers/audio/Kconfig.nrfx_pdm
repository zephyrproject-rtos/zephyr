## drivers/audio/Kconfig.nrfx_pdm
```kconfig
# Copyright (c) 2020, Oticon A/S
# SPDX-License-Identifier: Apache-2.0

# Workaround for not being able to have commas in macro arguments
DT_COMPAT_NORDIC_NRF_PDM   := nordic,nrf-pdm

config PDM_NRFX
	bool "nRF PDM nrfx driver"
	default y
	depends on HAS_HW_NRF_PDM && $(dt_nodelabel_has_compat,pdm,$(DT_COMPAT_NORDIC_NRF_PDM))
	select NRFX_PDM
	help
		Enable support for nrfx Hardware PDM driver for nRF52 MCU series.
```

## drivers/audio/Kconfig.sf32lb
```kconfig
# Copyright (c) 2025 SiFli Technologies(Nanjing) Co., Ltd
# SPDX-License-Identifier: Apache-2.0

config AUDIO_CODEC_SF32LB
	bool "sf32lb audio codec"
	select DMA
	default y
	depends on DT_HAS_SIFLI_SF32LB_AUDCODEC_ENABLED
```

## drivers/audio/Kconfig.sma1303
```kconfig
# Copyright (c) 2025 Iron Device Corporation
# SPDX-License-Identifier: Apache-2.0

config AUDIO_CODEC_SMA1303
	bool "Iron Device SMA1303 codec support"
	depends on DT_HAS_IRON_SMA1303_ENABLED
	default y
	select I2C if $(dt_compat_on_bus,$(DT_COMPAT_IRON_SMA1303),i2c)
	help
	  Enable driver for SMA1303 amplifier
```

## drivers/audio/Kconfig.taa3020
```kconfig
# SPDX-FileCopyrightText: Copyright 2026 sevenlab engineering GmbH
# SPDX-License-Identifier: Apache-2.0

config AUDIO_CODEC_TAA3020
	bool "TI TAA3020 ADC support"
	default y
	depends on DT_HAS_TI_TAA3020_ENABLED
	select I2C
	depends on GPIO
	help
	  Enable support for the TI TAA3020 audio ADC.
```

## drivers/audio/Kconfig.tas2563
```kconfig
# Copyright (c) 2026 Linumiz
# SPDX-License-Identifier: Apache-2.0

config AUDIO_TAS2563
	bool "TAS2563 audio amplifier support"
	default y
	depends on DT_HAS_TI_TAS2563_ENABLED
	select I2C
	help
	  Enable TAS2563 support on the selected board
```

## drivers/audio/Kconfig.tas6422dac
```kconfig
# Copyright (c) 2023 Centralp
# SPDX-License-Identifier: Apache-2.0

config AUDIO_TAS6422DAC
	bool "TAS6422 audio amplifier support"
	default y
	depends on DT_HAS_TI_TAS6422DAC_ENABLED
	select I2C
	depends on GPIO
	help
	  Enable TAS6422 support on the selected board
```

## drivers/audio/Kconfig.tlv320aic26
```kconfig
# Copyright (c) 2026 Linumiz
#
# SPDX-License-Identifier: Apache-2.0

config AUDIO_CODEC_TLV320AIC26
	bool "TLV320AIC26 Audio Codec"
	default y
	depends on DT_HAS_TI_TLV320AIC26_ENABLED
	select SPI
	help
	  Enable the TI TLV320AIC26 low power stereo audio codec driver.
	  Uses SPI for register control and I2S for audio data.
```

## drivers/audio/Kconfig.tlv320aic3110
```kconfig
# Copyright (c) 2025 PHYTEC America LLC
# SPDX-License-Identifier: Apache-2.0

config AUDIO_TLV320AIC3110
	bool "TLV320AIC3110 AIC support"
	default y
	depends on DT_HAS_TI_TLV320AIC3110_ENABLED
	select I2C
	help
	  Enable TLV320AIC3110 support on the selected board
```

## drivers/audio/Kconfig.tlv320dac
```kconfig
# Copyright (c) 2019 Intel Corporation
# SPDX-License-Identifier: Apache-2.0

config AUDIO_TLV320DAC
	bool "TLV320DAC310x DAC support"
	default y
	depends on DT_HAS_TI_TLV320DAC_ENABLED
	select I2C
	depends on GPIO
	help
	  Enable TLV320DAC support on the selected board
```

## drivers/audio/Kconfig.wm8904
```kconfig
# Copyright 2024 NXP
# SPDX-License-Identifier: Apache-2.0

config AUDIO_CODEC_WM8904
	bool "Wolfson WM8904 codec support"
	select I2C
	depends on DT_HAS_WOLFSON_WM8904_ENABLED
	help
	  Enable support for the Wolfson WM8904 codec
```

## drivers/audio/Kconfig.wm8960
```kconfig
# Copyright 2026 NXP
# SPDX-License-Identifier: Apache-2.0

config AUDIO_CODEC_WM8960
	bool "Wolfson WM8960 Audio Codec"
	default y
	select I2C
	depends on DT_HAS_WOLFSON_WM8960_ENABLED
	help
		Enable Wolfson WM8960 audio codec driver.

		This driver supports the WM8960 stereo audio codec with headphone
		and line outputs, and microphone inputs.
```

## drivers/audio/Kconfig.wm8962
```kconfig
# Copyright 2025 NXP
# SPDX-License-Identifier: Apache-2.0

config AUDIO_CODEC_WM8962
	bool "Wolfson WM8962 codec support"
	default y
	select I2C
	depends on DT_HAS_WOLFSON_WM8962_ENABLED
	help
	  Enable support for the Wolfson WM8962 codec
```

## drivers/audio/codec/Kconfig
```kconfig
# Audio Codec configuration options

# Copyright (c) 2018 Intel Corporation
# SPDX-License-Identifier: Apache-2.0

menuconfig AUDIO_CODEC
	bool "Audio Codec Drivers"
	help
	  Enable Audio Codec Driver Configuration

if AUDIO_CODEC

config AUDIO_CODEC_INIT_PRIORITY
	int "Init priority"
	default 60
	help
	  Audio codec device driver initialization priority.

config AUDIO_CODEC_SHELL
	bool "Audio Codec shell"
	depends on SHELL
	help
	  Enable the Audio Codec shell with Audio Codec related commands.

module = AUDIO_CODEC
module-str = audio codec
source "subsys/logging/Kconfig.template.log_config"

# zephyr-keep-sorted-start
source "drivers/audio/codec/Kconfig.cs43l22"
source "drivers/audio/codec/Kconfig.da7212"
source "drivers/audio/codec/Kconfig.max98091"
source "drivers/audio/codec/Kconfig.pcm1681"
source "drivers/audio/codec/Kconfig.tas6422dac"
source "drivers/audio/codec/Kconfig.tlv320aic3110"
source "drivers/audio/codec/Kconfig.tlv320dac"
source "drivers/audio/codec/Kconfig.wm8904"
source "drivers/audio/codec/Kconfig.wm8962"
# zephyr-keep-sorted-stop

endif # AUDIO_CODEC
```

## drivers/audio/codec/Kconfig.pcm1681
```kconfig
# Copyright (c) 2025 Basalte bv
# SPDX-License-Identifier: Apache-2.0

config AUDIO_CODEC_PCM1681_I2C
	bool
	default y
	depends on $(dt_compat_on_bus,$(DT_COMPAT_TI_PCM1681),i2c)
	help
	  I2C version of pcm1681xx driver

config AUDIO_CODEC_PCM1681_SPI
	bool
	default y
	depends on $(dt_compat_on_bus,$(DT_COMPAT_TI_PCM1681),spi)
	help
	  SPI version of pcm1681xx driver

config AUDIO_CODEC_PCM1681
	bool "PCM1681(-Q1) DAC support"
	default y
	depends on DT_HAS_TI_PCM1681_ENABLED
	select I2C if AUDIO_CODEC_PCM1681_I2C
	select SPI if AUDIO_CODEC_PCM1681_SPI
	help
	  Enable PCM1681 or PCM1681-Q1 support
```

## drivers/audio/dmic/Kconfig
```kconfig
# Digital Microphone (Audio) configuration options

# Copyright (c) 2018 Intel Corporation
# SPDX-License-Identifier: Apache-2.0

menuconfig AUDIO_DMIC
	bool "Digital Microphone (Audio) Drivers"
	help
	  Enable Digital Microphone Driver Configuration

if AUDIO_DMIC

config AUDIO_DMIC_INIT_PRIORITY
	int "Init priority"
	default 80
	help
	  Audio Digital Microphone device driver initialization priority.

module = AUDIO_DMIC
module-str = audio_dmic
source "subsys/logging/Kconfig.template.log_config"

# zephyr-keep-sorted-start
source "drivers/audio/dmic/Kconfig.dmic_ambiq_pdm"
source "drivers/audio/dmic/Kconfig.dmic_mcux"
source "drivers/audio/dmic/Kconfig.dmic_nxp_micfil"
source "drivers/audio/dmic/Kconfig.dmic_pdm_nrfx"
source "drivers/audio/dmic/Kconfig.mpxxdtyy"
# zephyr-keep-sorted-stop

endif # AUDIO_DMIC
```

## drivers/audio/i2s/Kconfig.litex
```kconfig
#
# Copyright (c) 2020 Antmicro <www.antmicro.com>
#
# SPDX-License-Identifier: Apache-2.0
#

menuconfig I2S_LITEX
	bool "Litex I2S driver"
	default y
	depends on DT_HAS_LITEX_I2S_ENABLED
	help
		Enable Litex Inter Sound (I2S) bus driver.

if I2S_LITEX

config I2S_LITEX_RX_BLOCK_COUNT
	int "RX queue length"
	default 500

config I2S_LITEX_TX_BLOCK_COUNT
	int "TX queue length"
	default 500

config I2S_LITEX_CHANNELS_CONCATENATED
	bool "Channels placed without padding in fifo"

config I2S_LITEX_DATA_BIG_ENDIAN
	bool "Received data will be stored as big endian"

endif
```

## drivers/audio/mic_privacy/intel/Kconfig.mic_privacy
```kconfig
# SOF Microphone Privacy configuration options

# Copyright (c) 2025 Intel Corporation
# SPDX-License-Identifier: Apache-2.0

config INTEL_ADSP_MIC_PRIVACY
	bool "MIC PRIVACY device driver support"
	default y
	depends on DT_HAS_INTEL_ADSP_MIC_PRIVACY_ENABLED
	help
	  Enable MIC PRIVACY device driver
```

## drivers/auxdisplay/Kconfig
```kconfig
# Auxiliary Display drivers

# Copyright (c) 2022 Jamie McCrae
# SPDX-License-Identifier: Apache-2.0

menuconfig AUXDISPLAY
	bool "Auxiliary (textual) Display Drivers"
	help
	  Enable auxiliary/texual display drivers (e.g. alphanumerical displays)

if AUXDISPLAY

config AUXDISPLAY_INIT_PRIORITY
	int "Auxiliary display devices init priority"
	default 85
	help
	  Auxiliary (textual) display devices initialization priority.

module = AUXDISPLAY
module-str = auxdisplay
source "subsys/logging/Kconfig.template.log_config"

source "drivers/auxdisplay/Kconfig.hd44780"
source "drivers/auxdisplay/Kconfig.itron"
source "drivers/auxdisplay/Kconfig.jhd1313"
source "drivers/auxdisplay/Kconfig.pt6314"
source "drivers/auxdisplay/Kconfig.serlcd"

endif # AUXDISPLAY
```

## drivers/auxdisplay/Kconfig.gh08172t
```kconfig
# Copyright (c) 2026 Renato Mauro
# SPDX-License-Identifier: Apache-2.0

config AUXDISPLAY_GH08172T
	bool "STMicroelectronics GH08172T LCD driver"
	default y
	depends on DT_HAS_ST_GH08172T_ENABLED
	select RTC
	select GPIO
	select CLOCK_CONTROL
	help
	  Enable driver for STMicroelectronics GH08172T LCD.
```

## drivers/auxdisplay/Kconfig.gpio
```kconfig
# Copyright (c) 2024-2025 Chen Xingyu <hi@xingrz.me>
# SPDX-License-Identifier: Apache-2.0

config AUXDISPLAY_GPIO_7SEG
	bool "Common GPIO-driven 7-Segment Display"
	default y
	depends on DT_HAS_GPIO_7_SEGMENT_ENABLED
	select GPIO
```

## drivers/auxdisplay/Kconfig.hd44780
```kconfig
# Copyright (c) 2023 Jamie McCrae
# SPDX-License-Identifier: Apache-2.0

config AUXDISPLAY_HD44780
	bool "Hitachi HD44780 LCD driver"
	default y
	depends on DT_HAS_HIT_HD44780_ENABLED
	help
	  Enable driver for Hitachi HD44780 and compatible LCDs.
```

## drivers/auxdisplay/Kconfig.itron
```kconfig
# Copyright (c) 2022 Jamie McCrae
# SPDX-License-Identifier: Apache-2.0

config AUXDISPLAY_ITRON
	bool "Noritake Itron VFD driver"
	default y
	select GPIO
	select SERIAL
	depends on DT_HAS_NORITAKE_ITRON_ENABLED
	help
	  Enable driver for Noritake Itron VFD.
```

## drivers/auxdisplay/Kconfig.jhd1313
```kconfig
# Copyright (c) 2022 Jamie McCrae
# SPDX-License-Identifier: Apache-2.0

config AUXDISPLAY_JHD1313
	bool "Jinghua Display JHD1313 driver"
	default y
	select I2C
	depends on DT_HAS_JHD_JHD1313_ENABLED
	help
	  Enable driver for Jinghua Display JHD1313 display.
```

## drivers/auxdisplay/Kconfig.max7219
```kconfig
# Copyright (c) 2025 Maksim Salau <maksim.salau@gmail.com>
# SPDX-License-Identifier: Apache-2.0

config AUXDISPLAY_MAX7219_7SEG
	bool "MAX7219 8-Digit LED Display Driver"
	default y
	depends on DT_HAS_MAXIM_MAX7219_7SEG_ENABLED
	select SPI
	help
	  Enable driver for the Maxim MAX7219 SPI LED display driver.
	  It is supporting up to 64 individual LEDs per MAX7219.
```

## drivers/auxdisplay/Kconfig.mcux_slcd
```kconfig
# Copyright NXP 2026
# SPDX-License-Identifier: Apache-2.0

config AUXDISPLAY_MCUX_SLCD
	bool "NXP MCUX SLCD segment LCD"
	default y
	depends on DT_HAS_NXP_SLCD_ENABLED
	select PINCTRL
	help
	  Enables the NXP MCUX SLCD (Segment LCD) controller driver.

	  The specific LCD glass/panel wiring is selected per devicetree instance
	  via the "panel" property of the "nxp,slcd" devicetree binding.
```
