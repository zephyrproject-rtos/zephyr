## drivers/mspi/Kconfig.mcux
```kconfig
# NXP MSPI drivers configuration options
#
# Copyright 2026 NXP
#
# SPDX-License-Identifier: Apache-2.0

config MSPI_MCUX_FLEXSPI
	bool "MCUX FlexSPI MSPI controller driver"
	depends on DT_HAS_NXP_FLEXSPI_MSPI_CONTROLLER_ENABLED
	default y
	select USE_MCUX_FLEXSPI
	select PINCTRL
	help
	  Enable MSPI controller support on NXP FlexSPI instances.
```

## drivers/mspi/Kconfig.mspi_emul
```kconfig
# Copyright (c) 2024, Ambiq Micro Inc. <www.ambiq.com>
# SPDX-License-Identifier: Apache-2.0

config MSPI_EMUL
	bool "MSPI emulator"
	default y
	depends on DT_HAS_ZEPHYR_MSPI_EMUL_CONTROLLER_ENABLED
	depends on EMUL
	select MSPI_XIP
	select MSPI_SCRAMBLE
	select MSPI_TIMING
	select GPIO
	help
	  Enable the MSPI emulator driver. This is a fake driver in that it
	  does not talk to real hardware. Instead it talks to emulation
	  drivers that pretend to be devices on the emulated MSPI bus. It is
	  used for testing drivers for MSPI devices.
```

## drivers/mspi/Kconfig.mxicy
```kconfig
#Copyright (c) 2025-2026 Macronix International Co., Ltd.
#SPDX-License-Identifier: Apache-2.0

config MSPI_MXICY
	bool "MXIC MSPI controller driver"
	default y
	depends on DT_HAS_MXICY_MSPI_CONTROLLER_ENABLED
```

## drivers/mspi/Kconfig.nxp_flexspi
```kconfig
# Copyright 2024 NXP
# SPDX-License-Identifier: Apache-2.0

config MSPI_NXP_FLEXSPI
	bool "NXP FlexSPI MSPI driver"
	default y
	depends on DT_HAS_NXP_FLEXSPI_ENABLED
	select MSPI_XIP
	select GPIO
	help
	  Enable MSPI driver for NXP FlexSPI
```

## drivers/mspi/Kconfig.stm32
```kconfig
# STM32 MSPI drivers configuration options

# Copyright (c) 2025 STMicroelectronics
# SPDX-License-Identifier: Apache-2.0

config MSPI_STM32_CONTROLLER
	bool "STM32 MSPI Controller drivers"
	depends on DT_HAS_ST_STM32_OSPI_CONTROLLER_ENABLED || \
	           DT_HAS_ST_STM32_QSPI_CONTROLLER_ENABLED || \
	           DT_HAS_ST_STM32_XSPI_CONTROLLER_ENABLED
	select EXPERIMENTAL
	default y
	help
	  This top-level option enables all STM32 MSPI controllers
	  if at least one of OSPI, QSPI or XSPI controllers is present
	  in the device tree.

if MSPI_STM32_CONTROLLER

config MSPI_STM32_BUFFER_ALIGNMENT
	int
	default 32
	help
	  Some MSPI host controllers require alignment of their data buffers
	  in order for DMA to work correctly. This represents the alignment
	  of buffers required in bytes.

config MSPI_STM32_OSPI
	bool "STM32 OSPI Controller driver"
	depends on DT_HAS_ST_STM32_OSPI_CONTROLLER_ENABLED
	default y
	select USE_STM32_HAL_OSPI if !SOC_SERIES_STM32H5X
	select USE_STM32_LL_DLYB if (SOC_SERIES_STM32H5X || SOC_SERIES_STM32U5X)
	select USE_STM32_HAL_MDMA if SOC_SERIES_STM32H7X
	select USE_STM32_HAL_DMA
	select USE_STM32_HAL_DMA_EX
	help
	  Enable OSPI driver for STM32 family of processors.

config MSPI_STM32_QSPI
	bool "STM32 QSPI Controller driver"
	depends on DT_HAS_ST_STM32_QSPI_CONTROLLER_ENABLED
	default y
	select USE_STM32_HAL_QSPI
	select USE_STM32_HAL_MDMA if SOC_SERIES_STM32H7X
	select USE_STM32_HAL_DMA
	select USE_STM32_HAL_DMA_EX
	help
	  Enable QSPI driver for STM32 family of processors.

config MSPI_STM32_XSPI
	bool "STM32 XSPI Controller driver"
	depends on DT_HAS_ST_STM32_XSPI_CONTROLLER_ENABLED
	default y
	select USE_STM32_HAL_XSPI
	select USE_STM32_LL_DLYB
	select USE_STM32_HAL_DMA
	select USE_STM32_HAL_DMA_EX
	help
	  Enable XSPI driver for STM32 family of processors.

endif # MSPI_STM32_CONTROLLER
```

## drivers/mspi/Kconfig.ti_k3
```kconfig
# Copyright (c) 2025 Siemens Mobility GmbH
# SPDX-License-Identifier: Apache-2.0

config MSPI_TI_K3
	bool "TI K3 MSPI driver"
	default y
	depends on DT_HAS_TI_K3_MSPI_CONTROLLER_ENABLED
	# GPIO is required for ce_gpios despite the field being ignored
	select GPIO
	select PINCTRL
	select MSPI_TIMING
	help
	  Enable driver for Ti Keystone 3 devices
```

## drivers/mux/Kconfig
```kconfig
# MUX (multiplexer) controller drivers configuration

# Copyright 2026 NXP
# SPDX-License-Identifier: Apache-2.0

menuconfig MUX
	bool "Multiplexer (MUX) drivers"
	help
	  Generic multiplexer controller subsystem. Provides a unified API
	  (mux_control_set, mux_state_apply) for software and hardware signal
	  routers.

if MUX

config MUX_INIT_PRIORITY
	int "MUX driver init priority"
	default 60
	help
	  Initialization priority for MUX controller drivers.

config MUX_MAX_CELLS
	int "Maximum number of addressing cells in a mux specifier"
	default 4
	help
	  Upper bound on the addressing-cells length of a single mux-controls
	  or mux-states specifier. Used by the userspace syscall handlers to
	  allocate a fixed-size kernel-side copy of the cells array, avoiding
	  VLAs and capping the trusted-memory copy from userspace. Increase if
	  any controller binding requires more than this many addressing cells.

module = MUX
module-str = mux
source "subsys/logging/Kconfig.template.log_config"

comment "MUX Drivers"

# zephyr-keep-sorted-start
rsource "Kconfig.gpio"
rsource "Kconfig.nxp_inputmux"
rsource "Kconfig.nxp_trgmux"
rsource "Kconfig.nxp_xbar"
# zephyr-keep-sorted-stop

endif # MUX
```

## drivers/mux/Kconfig.adi_adgm3121
```kconfig
# SPDX-FileCopyrightText: 2026 NXP
# SPDX-FileCopyrightText: 2026 Analog Devices Inc.
# SPDX-License-Identifier: Apache-2.0

config MUX_ADI_ADGM3121
	bool "ADI ADGM3121 MEMS switch MUX driver"
	default y
	depends on DT_HAS_ADI_ADGM3121_ENABLED || DT_HAS_ADI_ADGM3121_GPIO_ENABLED
	select SPI if DT_HAS_ADI_ADGM3121_ENABLED
	select GPIO if DT_HAS_ADI_ADGM3121_GPIO_ENABLED
	help
	  Enable the ADI ADGM3121 DPDT MEMS switch as a MUX controller. The four
	  switches are exposed as a single control line whose state is a 4-bit
	  switch bitmask (bit i = SW(i+1)). Both SPI (adi,adgm3121) and parallel
	  GPIO (adi,adgm3121-gpio) control modes are supported.

if MUX_ADI_ADGM3121

config MUX_ADI_ADGM3121_INIT_PRIORITY
	int "ADGM3121 init priority"
	default 60
	help
	  Device initialization priority. Unlike on-chip MUX backends, the
	  ADGM3121 sits on a bus, so it must initialize later than its SPI or
	  GPIO controller (SPI_INIT_PRIORITY defaults to
	  KERNEL_INIT_PRIORITY_DEVICE) while still being earlier than any MUX
	  consumer that references it.

endif # MUX_ADI_ADGM3121
```

## drivers/mux/Kconfig.gpio
```kconfig
# GPIO MUX driver

# Copyright 2026 NXP
# SPDX-License-Identifier: Apache-2.0

config MUX_GPIO
	bool "GPIO-based MUX driver"
	default y
	depends on DT_HAS_GPIO_MUX_ENABLED
	depends on GPIO
	help
	  Enable the GPIO-based multiplexer driver. The state value is
	  encoded as a binary pattern across the GPIO lines listed in
	  the mux-gpios property.
```

## drivers/mux/Kconfig.gpio_mux
```kconfig
# Copyright NXP 2025
# SPDX-License-Identifier: Apache-2.0

config MUX_GPIO_MUX
	bool "GPIO-based External multiplexor driver"
	default y
	depends on DT_HAS_GPIO_MUX_ENABLED
	select GPIO
	help
	  This driver uses GPIOs to control the select lines of
	  an external multiplexor circuit.
```

## drivers/mux/Kconfig.nxp_inputmux
```kconfig
# NXP INPUTMUX driver

# Copyright 2026 NXP
# SPDX-License-Identifier: Apache-2.0

config MUX_NXP_INPUTMUX
	bool "NXP INPUTMUX MUX driver"
	default y
	depends on DT_HAS_NXP_INPUTMUX_ENABLED
	select NXP_INPUTMUX
	help
	  Enable the NXP INPUTMUX-based multiplexer driver.
```

## drivers/mux/Kconfig.nxp_trgmux
```kconfig
# NXP TRGMUX driver

# Copyright 2026 NXP
# SPDX-License-Identifier: Apache-2.0

config MUX_NXP_TRGMUX
	bool "NXP TRGMUX MUX driver"
	default y
	depends on DT_HAS_NXP_TRGMUX_ENABLED
	help
	  Enable the NXP TRGMUX-based multiplexer driver.
```

## drivers/mux/Kconfig.nxp_xbar
```kconfig
# NXP MCUX XBAR MUX driver

# Copyright 2026 NXP
# SPDX-License-Identifier: Apache-2.0

config MUX_NXP_XBAR
	bool "NXP MCUX XBAR MUX driver"
	default y
	depends on DT_HAS_NXP_MCUX_XBAR_ENABLED
	help
	  Enable the NXP MCUX XBAR (cross-bar switch) multiplexer driver.
```
