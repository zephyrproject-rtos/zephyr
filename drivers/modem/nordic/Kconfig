## drivers/modem/nordic/Kconfig
```kconfig
# Copyright 2025 Nova Dynamics LLC
# SPDX-License-Identifier: Apache-2.0

config MODEM_NRF91_SLM
	bool "Nordic nRF91x SLM Driver"
	select MODEM_SOCKET
	select NET_OFFLOAD
	select NET_SOCKETS_OFFLOAD
	select MODEM_MODULES
	select MODEM_CHAT
	select MODEM_PIPE
	select MODEM_BACKEND_UART
	select RING_BUFFER
	depends on DT_HAS_NORDIC_NRF91_SLM_ENABLED
	imply GPIO
	help
	  Enables the offloaded driver for the Nordic nRF91 Serial LTE Modem.

if MODEM_NRF91_SLM

config MODEM_NRF91_SLM_PERIODIC_SCRIPT_MS
	int "Periodic script interval in milliseconds"
	default 2000

config MODEM_NRF91_SLM_UART_BUFFER_SIZES
	int "The UART receive and transmit buffer sizes in bytes."
	default 512

config MODEM_NRF91_SLM_CHAT_BUFFER_SIZES
	int "The size of the buffers used for the chat scripts in bytes."
	default 128

endif
```

## drivers/modem/simcom/Kconfig
```kconfig
# Copyright (c) 2025 Metratec GmbH.
# SPDX-License-Identifier: Apache-2.0

source "drivers/modem/simcom/*/Kconfig"
```

## drivers/modem/simcom/sim7080/Kconfig
```kconfig
# Simcom sim7080 driver options

# Copyright (C) 2021 metraTec GmbH
# SPDX-License-Identifier: Apache-2.0

config MODEM_SIM7080
	bool "Sim7080 Driver"
	select MODEM_CONTEXT
	select MODEM_CMD_HANDLER
	select MODEM_IFACE_UART
	select MODEM_SOCKET
	select NET_OFFLOAD
	select NET_SOCKETS_OFFLOAD
	imply GPIO
	help
	  Enables the driver for the Sim7080 modem.

if MODEM_SIM7080

config MODEM_SIMCOM_SIM7080_RX_STACK_SIZE
	int "Stack size for the simcom sim7080 modem driver rx thread"
	default 1028
	help
	  This stack is used by the simcom SIM7080 RX thread.

config MODEM_SIMCOM_SIM7080_RX_WORKQ_STACK_SIZE
	int "Stack size for the simcom sim7080 modem driver work queue"
	default 2048
	help
		This stack is used by the work queue.

config MODEM_SIMCOM_SIM7080_INIT_PRIORITY
	int "simcom sim7080 driver init priority"
	default 80
	help
	  simcom sim7080 driver initialization priority.

config MODEM_SIMCOM_SIM7080_LTE_BANDS
	string "LTE bands the driver can use"
	default "8,20,28"
	help
		Comma separated list of usable lte bands.

config MODEM_SIMCOM_SIM7080_APN
	string "APN for establishing a network connection"
	default "internet"
	help
	  This setting is used to set the APN name for the network connection
	  context. This value is specific to the network provider and may
	  need to be changed.

config MODEM_SIMCOM_SIM7080_BAUDRATE
	int "Baudrate for modem UART"
	default 115200
	help
		Set this to the baudrate the uart is using. On first startup
		the modem is configured to use autobaud. The driver will then
		configure the modem to use a fixed baudrate for faster startups.

config MODEM_SIMCOM_SIM7080_DNS_DEFAULT_RECOUNT
	int "Retry count for a DNS query"
	range 0 10
	default 10
	help
		The number of retries for a DNS lookup

config MODEM_SIMCOM_SIM7080_DNS_DEFAULT_TIMEOUT
	int "Timeout for a DNS query"
	range 0 60000
	default 20000
	help
		The timeout for DNS queries in milliseconds

choice MODEM_SIMCOM_SIM7080_RAT
	bool "Radio Access Technology Mode"
	default MODEM_SIMCOM_SIM7080_RAT_NB1

config MODEM_SIMCOM_SIM7080_RAT_NB1
	bool "NB-IoT"
	help
		Enable LTE NB-IoT mode.

config MODEM_SIMCOM_SIM7080_RAT_M1
	bool "Cat-M1"
	help
		Enable Cat-M1 mode.

config MODEM_SIMCOM_SIM7080_RAT_GSM
	bool "GSM"
	help
	  Enable GSM mode.

endchoice

choice
	bool "Modem Boot Type"
	default MODEM_SIMCOM_SIM7080_BOOT_TYPE_NORMAL

config MODEM_SIMCOM_SIM7080_BOOT_TYPE_NORMAL
	bool "Normal boot"
	help
		Boot the modem and attach to network

config MODEM_SIMCOM_SIM7080_BOOT_TYPE_CONSTRAINED
	bool "Constrained boot"
	help
		Check if the modem is operational and then power off

endchoice

endif # MODEM_SIM7080
```

## drivers/modem/vendor_standalone/Kconfig
```kconfig
# Standalone modem driver configuration options

# Copyright (c) 2026 Embeint Inc
# SPDX-License-Identifier: Apache-2.0

# zephyr-keep-sorted-start
source "drivers/modem/vendor_standalone/hl7800-legacy/Kconfig.hl7800"
source "drivers/modem/vendor_standalone/hl78xx/Kconfig.hl78xx"
source "drivers/modem/vendor_standalone/quectel-bg9x/Kconfig.quectel-bg9x"
source "drivers/modem/vendor_standalone/simcom/Kconfig.simcom"
source "drivers/modem/vendor_standalone/st87mxx/Kconfig.st87mxx"
source "drivers/modem/vendor_standalone/ublox-sara/Kconfig.ublox-sara-r4"
source "drivers/modem/vendor_standalone/wncm14a2a/Kconfig.wncm14a2a"
# zephyr-keep-sorted-stop
```

## drivers/modem/vendor_standalone/Kconfig.st87mxx
```kconfig
# Copyright (c) 2025 STMicroelectronics
# SPDX-License-Identifier: Apache-2.0

# ST87MXX driver options

config MODEM_ST87MXX
	bool "ST87MXX modem driver"
	select MODEM_RECEIVER
	select MODEM_CONTEXT
	select MODEM_CMD_HANDLER
	select MODEM_IFACE_UART
	select MODEM_SOCKET
	select NET_OFFLOAD
	select NET_SOCKETS_OFFLOAD
	imply GPIO
	help
	  Enable ST87M01 NB-IoT modem driver.

if MODEM_ST87MXX
	config MODEM_ST87MXX_INIT_PRIORITY
	int "ST87M01 driver init priority"
	default 80
	help
	  ST87M01 device driver initialization priority.
	  Do not mess with it unless you know what you are doing.
	  Note that the priority needs to be lower than the net stack
	  so that it can start before the networking sub-system.

config MODEM_ST87MXX_MAX_RX_DATA_LENGTH
	int "Size of the receive buffer for the ST87M01 modem"
	default 1024
	help
	  This buffer is used by the ST87M01 RX AT command logic.

config MODEM_ST87MXX_MAX_TX_DATA_LENGTH
	int "Size of the transmit buffer for the ST87M01 modem"
	default 1024
	help
	  This buffer is used by the ST87M01 TX AT command logic.

config MODEM_ST87MXX_RX_STACK_SIZE
	int "Size of the stack for the ST87M01 modem driver RX thread"
	default 1024
	help
	  This stack is used by the ST87M01 RX thread.

endif # MODEM_ST87MXX
```

## drivers/modem/vendor_standalone/hl78xx/hl78xx_evt_monitor/Kconfig.hl78xx_evt_monitor
```kconfig
# SPDX-FileCopyrightText: Copyright The Zephyr Project Contributors
# SPDX-FileCopyrightText: Copyright (c) 2025 Netfeasa Ltd.
# SPDX-License-Identifier: Apache-2.0

menuconfig HL78XX_EVT_MONITOR
	bool "HL78XX AT notification monitor"

if HL78XX_EVT_MONITOR

config HL78XX_EVT_MONITOR_HEAP_SIZE
	int "Heap size for notifications"
	range 64 4096
	default 256
	help
	  Heap size used to copy and queue HL78xx event notifications for
	  deferred monitor dispatch in the system workqueue.
	  Direct runtime monitor dispatch does not use this heap.


config HL78XX_EVT_MONITOR_MAX_INSTANCE_MONITORS
	int "Maximum number of runtime HL78xx event monitors"
	default 8
	range 1 64
	help
	  Maximum number of runtime event monitors that can be registered.
	  This bound allows event monitor dispatch to snapshot runtime monitors
	  without allocating memory, including when dispatch is called from ISR
	  context.

config HL78XX_EVT_MONITOR_APP_INIT_PRIORITY
	int "Sierra Wireless HL78XX event monitor app init priority"
	default 0
	help
	  Sierra Wireless HL78XX event monitor app initialization priority.
	  Do not mess with it unless you know what you are doing.

module=HL78XX_EVT_MONITOR
module-dep=LOG
module-str= Event notification monitor library
source "subsys/logging/Kconfig.template.log_config"

endif # HL78XX_EVT_MONITOR
```

## drivers/modem/vendor_standalone/quectel/bc66x/Kconfig.quectel-bc66x
```kconfig
# SPDX-License-Identifier: Apache-2.0
#
# SPDX-FileCopyrightText: Copyright The Zephyr Project Contributors
# SPDX-FileCopyrightText: Copyright 2026 Giovanni Piccari <giopiccari@outlook.com>
# SPDX-FileCopyrightText: Copyright 2026 M31 srl <info@m31.com>

config MODEM_QUECTEL_BC66X
	bool "Quectel BC66 / BC660K NB-IoT modem driver"
	depends on MODEM
	depends on MODEM_CHAT
	depends on MODEM_BACKEND_UART
	depends on MODEM_PIPE

	# Networking
	depends on NETWORKING
	depends on NET_OFFLOAD
	depends on NET_SOCKETS_OFFLOAD

	depends on GPIO

	help
	  Driver for the Quectel BC66 / BC660K-GL NB-IoT modem.
	  Uses modem_chat and modem_backend_uart from the Zephyr
	  modem subsystem for AT command exchange.

if MODEM_QUECTEL_BC66X

config MODEM_QUECTEL_BC660K
	bool "Quectel BC660K-GL"
	default y if DT_HAS_QUECTEL_BC660K_ENABLED
	help
	  Enable support for the Quectel BC660K-GL modem.

config MODEM_QUECTEL_BC66
	bool "Quectel BC66"
	default y if DT_HAS_QUECTEL_BC66_ENABLED
	help
	  Enable support for the Quectel BC66 modem.

config MODEM_QUECTEL_BC66X_CHAT_BUF_SIZE
	int "AT chat RX buffer size"
	default 512

config MODEM_QUECTEL_BC66X_UART_RX_BUF_SIZE
	int "UART RX ring buffer size"
	default 512

config MODEM_QUECTEL_BC66X_UART_TX_BUF_SIZE
	int "UART TX buffer size"
	default 256

config MODEM_QUECTEL_BC66X_WORKQ_STACK_SIZE
	int "Stack size for the deferred work thread"
	default 1024

config MODEM_QUECTEL_BC66X_WORKQ_PRIORITY
	int "Workq priority. Note that also init work is scheduled here"
	default 80

config MODEM_QUECTEL_BC66X_INIT_PRIORITY
	int "Quectel BC66x modem driver initialization priority"
	default 91
	range 0 99
	help
	  This priority must be < MODEM_QUECTEL_BC66X_NET_INIT_PRIORITY

config MODEM_QUECTEL_BC66X_NET_INIT_PRIORITY
	int "Net device init priority"
	default 92
	range 0 99
	help
	  This priority must be > MODEM_QUECTEL_BC66X_INIT_PRIORITY

config BC66X_INIT_DELAY
	int "Driver initialization delay (ms)"
	default 1200

config BC66X_INIT_RETRIES
	int "Initialization retries"
	default 10
	help
	  Number of times to retry the modem initialization.

config BC66X_INIT_TIMEOUT
	int "Driver initialization timeout (seconds)"
	default 10

config BC66X_WAIT_FOR_HW_DELAY
	int "Wait for hardware delay (ms)"
	default 2500
	help
	  Delay to allow the modem hardware to power up before communicating.

config MODEM_QUECTEL_BC66X_APN_PROFILES
	string "List of profiles to search when autodetecting APN"
	default "tim=893901, 1nce=8988228"
	help
	  Set a comma separated list of profiles, each containing of:
	  <apn>=<ICCID_1> ... <ICCID_n>

config MODEM_QUECTEL_BC66X_DNS_ADDRESS_1
	string "Primary DNS server address"
	default "8.8.8.8"

config MODEM_QUECTEL_BC66X_DNS_ADDRESS_2
	string "Secondary DNS server address"
	default "1.1.1.1"

config MODEM_QUECTEL_BC66X_DNS_TIMEOUT
	int "DNS resolution timeout (seconds)"
	default 15

module = MODEM_QUECTEL_BC66X
module-str = modem-quectel-bc66x
source "subsys/logging/Kconfig.template.log_config"

endif # MODEM_QUECTEL_BC66X
```

## drivers/modem/vendor_standalone/simcom/Kconfig.simcom
```kconfig
# Copyright (c) 2025 Metratec GmbH.
# SPDX-License-Identifier: Apache-2.0

# zephyr-keep-sorted-start
source "drivers/modem/vendor_standalone/simcom/sim7080/Kconfig"
# zephyr-keep-sorted-stop
```

## drivers/mspi/Kconfig
```kconfig
# MSPI driver configuration options

# Copyright (c) 2024 Ambiq Micro Inc. <www.ambiq.com>
# SPDX-License-Identifier: Apache-2.0

#
# MSPI Drivers
#
menuconfig MSPI
	bool "Multi-bit Serial Peripheral Interface (MSPI) bus drivers"
	help
	  Enable support for the MSPI hardware bus.

if MSPI

config MSPI_ASYNC
	bool "Asynchronous call support"
	select POLL
	help
	  This option enables the asynchronous API calls.

config MSPI_PERIPHERAL
	bool "Peripheral support"
	help
	  Enables Driver MSPI peripheral mode operations. Peripheral mode
	  support depends on the driver and the hardware it runs on.

config MSPI_INIT_PRIORITY
	int "Init priority"
	default 70
	help
	  Device driver initialization priority.

config MSPI_COMPLETION_TIMEOUT_TOLERANCE
	int "Completion timeout tolerance (ms)"
	default 200
	help
	  The tolerance value in ms for the MSPI completion timeout logic.

config MSPI_XIP
	bool "XIP eXecute In Place"
	help
	  Describes controller hardware XIP capability and
	  enables mspi_xip_config calls in device drivers.

config MSPI_SCRAMBLE
	bool "Scrambling support"
	help
	  Describes controller hardware scrambling capability and
	  enables mspi_scramble_config calls in device drivers.

config MSPI_TIMING
	bool "Timing support"
	help
	  Enables mspi_timing_config calls in device drivers for those
	  controllers that need this to proper function at high frequencies.

module = MSPI
module-str = mspi
source "subsys/logging/Kconfig.template.log_config"

source "drivers/mspi/Kconfig.ambiq"
source "drivers/mspi/Kconfig.mspi_emul"

endif # MSPI
```

## drivers/mspi/Kconfig.ambiq
```kconfig
# Copyright (c) 2025, Ambiq Micro Inc. <www.ambiq.com>
# SPDX-License-Identifier: Apache-2.0

config MSPI_AMBIQ_CONTROLLER
	bool "Ambiq MSPI Controller driver"
	depends on DT_HAS_AMBIQ_MSPI_CONTROLLER_ENABLED
	select AMBIQ_HAL
	select AMBIQ_HAL_USE_MSPI
	select GPIO
	help
	  Ambiq MSPI controller driver is enabled.

if MSPI_AMBIQ_CONTROLLER

config MSPI_AMBIQ_AP3
	bool "Ambiq Apollo3 series MSPI Controller driver"
	default y
	depends on SOC_SERIES_APOLLO3X
	imply MSPI_XIP
	imply MSPI_SCRAMBLE
	imply MSPI_TIMING
	help
	  Enable driver for Ambiq MSPI.

config MSPI_AMBIQ_AP5
	bool "Ambiq Apollo5 series MSPI Controller driver"
	default y
	depends on SOC_SERIES_APOLLO5X
	imply MSPI_XIP
	imply MSPI_SCRAMBLE
	imply MSPI_TIMING
	help
	  Enable driver for Ambiq MSPI.

config MSPI_AMBIQ_BUFF_RAM_LOCATION
	hex "Byte offset to SRAM_BASE_ADDRESS"
	default SOC_AMBIQ_DMA_BUFF_LOCATION if SOC_SERIES_APOLLO5X
	default 0x50000
	help
	  This option specifies the mspi buffer/heap start address

config MSPI_AMBIQ_BUFF_ALIGNMENT
	int "Byte alignment of the MSPI buffer"
	default 8 if MSPI_AMBIQ_AP3
	default SOC_AMBIQ_DMA_BUFF_ALIGNMENT if SOC_SERIES_APOLLO5X
	help
	  This option specifies the mspi buffer alignment

config MSPI_AMBIQ_TIMING_SCAN
	bool "Turn on Ambiq timing scan utility"
	depends on MSPI_TIMING
	help
	  Enable timing scan will cost time and space during init

if MSPI_AMBIQ_TIMING_SCAN

config MSPI_AMBIQ_TIMING_SCAN_BUFFER_SIZE
	int "Timing scan buffer size in bytes"
	default 131072
	help
	  This option specifies the memory buffer size used for timing scan,
	  carefully adjust this size between a few KBs to hundreds of KBs to achieve
	  balance between time and accurary

config MSPI_AMBIQ_TIMING_SCAN_DATA_SIZE
	int "Total data sizes in bytes used in timing scan"
	default 131072
	help
	  This option specifies the total data size used in timing scan,
	  it must be divisible by MSPI_AMBIQ_TIMING_SCAN_BUFFER_SIZE

endif # MSPI_AMBIQ_TIMING_SCAN

endif # MSPI_AMBIQ_CONTROLLER
```

## drivers/mspi/Kconfig.cadence
```kconfig
# Copyright (c) 2025 Siemens Mobility GmbH
# SPDX-License-Identifier: Apache-2.0

config MSPI_CDNS
	bool "Cadence MSPI driver"
	default y
	depends on DT_HAS_CDNS_MSPI_CONTROLLER_ENABLED
	# GPIO is required for ce_gpios despite the field being ignored
	select GPIO
	select PINCTRL
	select MSPI_TIMING
	help
	  Enable driver for Cadence MSPI peripheral
```

## drivers/mspi/Kconfig.dw
```kconfig
# Copyright (c) 2024 Nordic Semiconductor ASA
# Copyright (c) 2025 Tenstorrent AI ULC
# SPDX-License-Identifier: Apache-2.0

config MSPI_DW
	bool "DesignWare SSI controller driver"
	default y
	depends on DT_HAS_SNPS_DESIGNWARE_SSI_ENABLED
	select PINCTRL if $(dt_compat_any_has_prop,$(DT_COMPAT_SNPS_DESIGNWARE_SSI),pinctrl-0)
	imply MSPI_XIP
	imply MSPI_TIMING

if MSPI_DW

config MSPI_DW_HANDLE_FIFOS_IN_SYSTEM_WORKQUEUE
	bool "Handle FIFO in system workqueue"
	help
	  When the driver does not use DMA for transferring data to/from the
	  SSI FIFOs, handling of those may take a significant amount of time.
	  It may be destructive for some applications if that time is spent
	  in the interrupt context. This option allows offloading the job to
	  the system workqueue.

config MSPI_DW_TXD_DIV
	int "Designware SSI TX Drive edge divisor"
	default 4
	help
	  Division factor to apply to calculated BAUDR value when writing it
	  to the TXD_DRIVE_EDGE register in DDR mode. Note that the maximum
	  value of this register is (BAUDR / 2) - 1.

config MSPI_DW_TXD_MUL
	int "Designware SSI TX Drive edge multiplier"
	default 1
	help
	  Multiplication factor to apply to calculated BAUDR value when writing
	  it to the TXD_DRIVE_EDGE register in DDR mode. Note that the maximum
	  value of this register is (BAUDR / 2) - 1.

endif # MSPI_DW
```
