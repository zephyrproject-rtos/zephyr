## drivers/mfd/Kconfig.infineon_mxcrypto
```kconfig
# SPDX-FileCopyrightText: Copyright (c) 2026 Infineon Technologies AG,
# SPDX-FileCopyrightText: or an affiliate of Infineon Technologies AG. All rights reserved.
#
# SPDX-License-Identifier: Apache-2.0

config MFD_INFINEON_MXCRYPTO
	bool "Infineon MXCRYPTO multi-function device driver"
	default y if ENTROPY_INFINEON_MXCRYPTO_TRNG || CRYPTO_INFINEON_MXCRYPTO
	depends on DT_HAS_INFINEON_MXCRYPTO_ENABLED
	select USE_INFINEON_MXCRYPTO_CORE
	help
	  Enable the Infineon MXCRYPTO MFD driver.  The MXCRYPTO block is a
	  single hardware crypto engine shared by a True Random Number Generator
	  (TRNG) and AES / SHA acceleration.  This driver owns the shared
	  register base address and the mutex that serialises access between the
	  TRNG and crypto child function drivers, and enables the block through
	  the MXCRYPTO PDL.

	  Enabled by default when a child function driver is enabled.

config MFD_INFINEON_MXCRYPTO_INIT_PRIORITY
	int "Infineon MXCRYPTO MFD init priority"
	default 40
	depends on MFD_INFINEON_MXCRYPTO
	help
	  Initialization priority for the MXCRYPTO MFD driver.  This must be
	  lower (earlier) than the init priority of the child drivers
	  (CONFIG_ENTROPY_INIT_PRIORITY and CONFIG_CRYPTO_INIT_PRIORITY) so the
	  shared resources are ready before a child uses them.
```

## drivers/mfd/Kconfig.it8801
```kconfig
# Copyright (c) 2024 ITE Corporation. All Rights Reserved.
# SPDX-License-Identifier: Apache-2.0

config MFD_ITE_IT8801
	bool "ITE IT8801 ioexpander multi-function device driver"
	default y
	depends on DT_HAS_ITE_IT8801_MFD_ENABLED
	select I2C
	help
	  Enable the ITE IT8801 ioexpander multi-function device driver.
	  This ioexpander provides a GPIO/PWM/Keyboard function via I2C bus.

config EMUL_MFD_ITE_IT8801
	bool "Emulate an ITE IT8801 multi-function device"
	default y
	depends on ZTEST && DT_HAS_ITE_IT8801_MFD_ENABLED
	depends on EMUL
	select I2C_EMUL
	help
	  Enable the register-level I2C emulator for the ITE IT8801
	  multi-function device. The backend API lets test code seed register
	  state and inject I2C read/write failures so the IT8801 sub-drivers
	  (keyboard, GPIO, PWM) can be exercised without real hardware.

if MFD_ITE_IT8801

config MFD_ITE_IT8801_ALTCTRL
	bool "ITE IT8801 MFD alternate controller"
	default y

endif # MFD_ITE_IT8801
```

## drivers/mfd/Kconfig.ite_it51xxx
```kconfig
# Copyright (c) 2026 ITE Corporation.
# SPDX-License-Identifier: Apache-2.0

config MFD_ITE_IT51XXX
	bool "ITE IT51XXX multi-function device driver"
	default y if CRYPTO_IT51XXX_SHA || IT51XXX_HW_RSA_CALCULATION
	depends on DT_HAS_ITE_IT51XXX_MFD_ENABLED
	help
	  Enable the ITE IT51XXX MFD driver.

if MFD_ITE_IT51XXX

config MFD_ITE_IT51XXX_INIT_PRIORITY
	int "ITE IT51XXX MFD init priority"
	default 40
	help
	  Initialization priority for the ITE IT51XXX MFD driver.  This must be
	  lower (earlier) than the init priority of the child driver
	  (CONFIG_CRYPTO_INIT_PRIORITY and CONFIG_IT51XXX_RSA_INIT_PRIORITY)
	  so the shared resources are ready before child uses them.

endif # MFD_ITE_IT51XXX
```

## drivers/mfd/Kconfig.max20356
```kconfig
# Copyright (c) 2026 Analog Devices, Inc.
# SPDX-License-Identifier: Apache-2.0

config MFD_MAX20356
	bool "MAX20356/MAX20358 PMIC multi-function device driver"
	default y
	depends on DT_HAS_ADI_MAX20356_ENABLED || DT_HAS_ADI_MAX20358_ENABLED
	select I2C
	help
	  Enable the Analog Devices MAX20356/MAX20358 wearable PMIC
	  multi-function device driver.

	  SPI dynamic voltage scaling (a buck child with adi,dvs-mode = "spi" and
	  the parent's spi-dvs phandle) additionally requires CONFIG_SPI; when it
	  is not set, mfd_max20356_dvs_spi_write() returns -ENOTSUP.

config MFD_MAX20356_TRIGGER
	bool "MAX20356/MAX20358 INTB trigger support"
	default y
	depends on MFD_MAX20356
	depends on GPIO
	depends on $(dt_compat_any_has_prop,$(DT_COMPAT_ADI_MAX20356),int-gpios) || \
		$(dt_compat_any_has_prop,$(DT_COMPAT_ADI_MAX20358),int-gpios) || \
		$(dt_compat_any_has_prop,$(DT_COMPAT_ADI_MAX20356),adi_buck1_pgood_int_gpios) || \
		$(dt_compat_any_has_prop,$(DT_COMPAT_ADI_MAX20358),adi_buck1_pgood_int_gpios) || \
		$(dt_compat_any_has_prop,$(DT_COMPAT_ADI_MAX20356),adi_buck2_pgood_int_gpios) || \
		$(dt_compat_any_has_prop,$(DT_COMPAT_ADI_MAX20358),adi_buck2_pgood_int_gpios) || \
		$(dt_compat_any_has_prop,$(DT_COMPAT_ADI_MAX20356),adi_buck3_pgood_int_gpios) || \
		$(dt_compat_any_has_prop,$(DT_COMPAT_ADI_MAX20358),adi_buck3_pgood_int_gpios) || \
		$(dt_compat_any_has_prop,$(DT_COMPAT_ADI_MAX20356),adi_usbok_int_gpios) || \
		$(dt_compat_any_has_prop,$(DT_COMPAT_ADI_MAX20358),adi_usbok_int_gpios)
	help
	  Enable INTB interrupt handling for the MAX20356/MAX20358 PMIC. The
	  parent installs a GPIO callback on the INTB line, decodes the pending
	  Int0-5 sources in a workqueue, and dispatches them to consumers that
	  registered through mfd_max20356_add_callback().

if MFD_MAX20356_TRIGGER

choice MAX20356_TRIGGER_MODE
	prompt "MAX20356/MAX20358 INTB trigger mode"
	default MAX20356_TRIGGER_GLOBAL_THREAD
	help
	  Select the context in which INTB source decode runs.

config MAX20356_TRIGGER_GLOBAL_THREAD
	bool "Use global thread"
	help
	  Dispatch INTB handling to the system workqueue.

config MAX20356_TRIGGER_OWN_THREAD
	bool "Use own thread"
	help
	  Dispatch INTB handling to a dedicated driver thread.

endchoice # MAX20356_TRIGGER_MODE

config MAX20356_THREAD_PRIORITY
	int "INTB own-thread priority"
	depends on MAX20356_TRIGGER_OWN_THREAD
	default 10
	help
	  Cooperative priority of the dedicated INTB handling thread.

config MAX20356_THREAD_STACK_SIZE
	int "INTB own-thread stack size"
	depends on MAX20356_TRIGGER_OWN_THREAD
	default 1024
	help
	  Stack size (bytes) of the dedicated INTB handling thread. Size it for
	  the registered callbacks, which run in this thread's context.

endif # MFD_MAX20356_TRIGGER
```

## drivers/mfd/Kconfig.mc146818
```kconfig
# Intel SoC RTC configuration options

# Copyright (c) 2025 Intel Corporation
# SPDX-License-Identifier: Apache-2.0

config MFD_MOTOROLA_MC146818
	bool "MOTOROLA MC146818 multi-function device driver"
	default y
	depends on DT_HAS_MOTOROLA_MC146818_MFD_ENABLED
	help
	  common code required by bbram and rtc, which will likely be a locking mechanism
	  so both RTC and BBRAM can set/get regs safely and independently.
```

## drivers/mfd/Kconfig.rv3032_mfd
```kconfig
# Copyright (c) 2025 Baylibre SAS
# SPDX-License-Identifier: Apache-2.0

config MFD_RV3032
	bool "MFD driver for RV3032"
	default y
	depends on DT_HAS_MICROCRYSTAL_RV3032_MFD_ENABLED
	depends on GPIO
	select I2C
	help
	  Enable MFD driver for RV3032 RTC
```
