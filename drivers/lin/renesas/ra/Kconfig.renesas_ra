## drivers/lin/renesas/ra/Kconfig.renesas_ra
```kconfig
# Copyright (c) 2025 Renesas Electronics Corporation
# SPDX-License-Identifier: Apache-2.0

config LIN_RENESAS_RA
	bool
	help
	  Enable support LIN driver for Renesas RA family.

config LIN_RENESAS_RA_SCI_B
	bool "Renesas RA LIN SCI_B"
	default y
	depends on DT_HAS_RENESAS_RA_LIN_SCI_B_ENABLED
	select LIN_RENESAS_RA
	select USE_RA_FSP_SCI_B_LIN
	select PINCTRL
	help
	  Enable Renesas RA LIN SCI B driver.
```

## drivers/lora/Kconfig
```kconfig
#
# Copyright (c) 2019 Manivannan Sadhasivam
#
# SPDX-License-Identifier: Apache-2.0
#

# Top-level configuration file for LORA drivers.

menuconfig LORA
	bool "LoRa drivers"
	select POLL
	help
	  Include LoRa drivers in the system configuration.

if LORA

choice LORA_MODULE_BACKEND
	prompt "Low-level LoRa modem integration to use"
	default LORA_MODULE_BACKEND_LORA_BASICS_MODEM if DT_HAS_SEMTECH_SX1268_ENABLED \
		|| DT_HAS_SEMTECH_LLCC68_ENABLED || DT_HAS_SEMTECH_SX1278_ENABLED

config LORA_MODULE_BACKEND_LORAMAC_NODE
	bool "loramac-node backend"
	depends on ZEPHYR_LORAMAC_NODE_MODULE

config LORA_MODULE_BACKEND_LORA_BASICS_MODEM
	bool "LoRa Basic modem backend"
	depends on ZEPHYR_LORA_BASICS_MODEM_MODULE
	depends on DT_HAS_SEMTECH_SX1262_ENABLED || DT_HAS_SEMTECH_SX1261_ENABLED \
		|| DT_HAS_SEMTECH_SX1272_ENABLED || DT_HAS_SEMTECH_SX1276_ENABLED \
		|| DT_HAS_SEMTECH_SX1268_ENABLED || DT_HAS_SEMTECH_LLCC68_ENABLED \
		|| DT_HAS_SEMTECH_SX1278_ENABLED
	select USE_LORA_BASICS_MODEM_DRIVERS
	help
	  LoRa API support using the LoRa Basics Modem module.

config LORA_MODULE_BACKEND_NATIVE
	bool "Native Zephyr backend"
	help
	  Use Zephyr's built-in LoRa drivers without external modules.
	  Currently supports SX1261/SX1262 transceivers.

endchoice

module = LORA
module-str = lora
source "subsys/logging/Kconfig.template.log_config"

config LORA_SHELL
	bool "LoRa Shell"
	depends on SHELL
	help
	  Enable LoRa Shell for testing.

config LORA_RSSI_SETTLE_US
	int "RSSI settling time in microseconds"
	default 500 if LORA_MODULE_BACKEND_LORAMAC_NODE
	default 500 if LORA_MODULE_BACKEND_NATIVE
	default 10000
	help
	  Time to wait after entering receive mode before the RSSI is read,
	  to let the receiver settle. How long a radio needs varies with the
	  driver: one that sleeps between accesses spends part of this time
	  in its wake-up calibration, and reads taken too early report the
	  noise floor. The defaults come from an SX1262: loramac-node and the
	  native driver are ready in 0.5 ms, the Basics Modem glue needs 7 ms.

config LORA_ENERGY_DETECT_SAMPLE_INTERVAL_US
	int "Energy detection sample interval in microseconds"
	default 500
	help
	  Time to sleep between two RSSI samples while sensing the channel.

config LORA_INIT_PRIORITY
	int "LoRa initialization priority"
	default 90
	help
	  System initialization priority for LoRa drivers.

rsource "Kconfig.sx12xx"
rsource "Kconfig.rylrxxx"
rsource "lora-basics-modem/Kconfig"
rsource "native/Kconfig"

endif # LORA
```

## drivers/lora/Kconfig.rui3
```kconfig
# SPDX-FileCopyrightText: Copyright (c) 2026 RAKwireless Technology Limited
# SPDX-License-Identifier: Apache-2.0

config LORA_RUI3
	bool "RAKwireless RUI3 AT modem driver"
	default y
	depends on DT_HAS_RAKWIRELESS_RUI3_ENABLED
	select LORA_HAS_LBT
	select MODEM_MODULES
	select MODEM_CHAT
	select MODEM_PIPE
	select MODEM_BACKEND_UART
	select GPIO
	help
	  Drive a RAKwireless module running the RUI3 firmware over its AT
	  command interface, in LoRa P2P mode.

if LORA_RUI3

config LORA_RUI3_CMD_BUF_SIZE
	int "Command buffer size"
	default 560
	range 32 65535
	help
	  Size of the buffer holding one AT command. The longest command is
	  AT+PSEND with a full payload, 239 bytes carried as 478 hexadecimal
	  digits.

config LORA_RUI3_MODEM_BUF_SIZE
	int "Modem pipe buffer size"
	default 576
	range 64 65535
	help
	  Size of each of the UART backend and chat buffers. A received packet
	  arrives as one line holding the payload in hexadecimal, so this bounds
	  the payload the driver can take in.

config LORA_RUI3_CMD_TIMEOUT_MS
	int "Command response timeout in milliseconds"
	default 3000
	help
	  Time to wait for the module to answer an AT command.

config LORA_RUI3_TX_TIMEOUT_MS
	int "Transmission completion timeout in milliseconds"
	default 10000
	help
	  Time to wait for the transmission done event after the module has
	  taken the send command. This bounds the airtime rather than the
	  command exchange, so it is longer than the command timeout: a full
	  payload at spreading factor 12 takes seconds to leave the radio.

config LORA_RUI3_RESET_TIMEOUT_MS
	int "Reset and mode switch timeout in milliseconds"
	default 10000
	help
	  Time to wait for the module to come back after a reset or a change of
	  network work mode, both of which reboot it.

config LORA_RUI3_RX_MSGQ_SIZE
	int "Number of received packets to queue"
	default 2
	help
	  Packets held for lora_recv() while no caller is waiting.

config LORA_RUI3_FW_VERSION_MAJOR
	int "Expected RUI3 firmware major version"
	default 4
	help
	  Major version of the RUI3 firmware this driver is written against.
	  The firmware runs on the module and is flashed independently, so this
	  cannot be enforced at build time: the driver queries the running
	  firmware and warns when it is older. Nothing here changes the
	  commands the driver sends.

config LORA_RUI3_FW_VERSION_MINOR
	int "Expected RUI3 firmware minor version"
	default 2
	help
	  Minor version of the expected RUI3 firmware.

config LORA_RUI3_FW_VERSION_PATCH
	int "Expected RUI3 firmware patch version"
	default 2
	help
	  Patch version of the expected RUI3 firmware. The default is the
	  oldest release the driver has been run against, 4.2.2; 4.3.0 was
	  exercised the same way.

endif # LORA_RUI3
```

## drivers/lora/native/Kconfig
```kconfig
# Copyright (c) 2026 Carlo Caione <ccaione@baylibre.com>
# SPDX-License-Identifier: Apache-2.0

rsource "Kconfig.fake"

config LORA_SX12XX_NATIVE_COMMON
	bool
	help
	  Code shared by the native SX12xx drivers.

rsource "lr11xx/Kconfig"
rsource "sx126x/Kconfig"
```

## drivers/lora/native/Kconfig.fake
```kconfig
# Copyright Embeint Inc
# SPDX-License-Identifier: Apache-2.0

config LORA_FAKE
	bool "Fake LoRa driver"
	default y
	depends on LORA_MODULE_BACKEND_NATIVE
	depends on DT_HAS_ZEPHYR_FAKE_LORA_ENABLED
	help
	  Enable support for the FFF-based fake LoRa driver.

config LORA_FAKE_OPTIONAL_API
	bool "Optional API support in the fake LoRa driver"
	default y
	depends on LORA_FAKE
	help
	  Compile support for all optional LoRa driver API functions into the
	  fake driver. Disable this to test application behavior when a LoRa
	  driver implements only the mandatory API functions.
```

## drivers/lora/native/lr20xx/Kconfig
```kconfig
# Copyright (c) 2026 MASSDRIVER EI (massdriver.space)
# SPDX-License-Identifier: Apache-2.0

config LORA_LR20XX_NATIVE
	bool "Semtech LR20XX native driver (experimental)"
	default y
	depends on LORA_MODULE_BACKEND_NATIVE
	depends on DT_HAS_SEMTECH_LR2021_ENABLED || DT_HAS_SEMTECH_LR2022_ENABLED \
		|| DT_HAS_SEMTECH_LR2012_ENABLED
	select SPI
	select GPIO
	help
	  Enable native driver for Semtech LR20xx LoRa transceivers.
	  This is an experimental driver that does not depend on loramac-node
	  or lora-basics-modem external modules.

config LORA_LR20XX_NATIVE_SLEEP
	bool "Sleep mode power management"
	default y
	depends on LORA_LR20XX_NATIVE
	help
	  Place the LR20xx radio into sleep mode when idle to reduce
	  power consumption (~0.65 uA vs ~1.21 mA in standby). Disable
	  to keep the radio in standby for faster response times.
```

## drivers/lora/native/sx128x/Kconfig
```kconfig
# Copyright (c) 2026 Giuseppe Fabiano <gfabiano40@gmail.com>
# SPDX-License-Identifier: Apache-2.0

config LORA_SX128X_NATIVE
	bool "Semtech SX128x native driver (experimental)"
	default y
	depends on LORA_MODULE_BACKEND_NATIVE
	depends on DT_HAS_SEMTECH_SX1280_ENABLED || DT_HAS_SEMTECH_SX1281_ENABLED
	select SPI
	select GPIO
	select LORA_SX12XX_NATIVE_COMMON
	help
	  Driver for the Semtech SX1280 and SX1281 2.4 GHz transceivers,
	  talking to the chip over SPI directly. LoRa is always available;
	  the GFSK modem is added by LORA_GFSK.

if LORA_SX128X_NATIVE

config LORA_SX128X_NATIVE_IRQ_THREAD_STACK_SIZE
	int "IRQ work thread stack size"
	default 1536
	help
	  Stack for the thread that drains radio interrupts: reading a
	  reception out of the chip and waking blocked send and receive
	  calls. One thread serves every SX128x instance.

config LORA_SX128X_NATIVE_IRQ_THREAD_PRIO
	int "IRQ work thread cooperative priority"
	default 2
	help
	  Cooperative priority of the IRQ work thread. A reception has to be
	  read out quickly: in single receive mode the radio is deaf until
	  then, in continuous mode the next packet lands at the same buffer
	  offset, a few hundred microseconds later with GFSK at 2 Mb/s. This
	  thread should outrank the application threads that consume the
	  packets.

config LORA_SX128X_NATIVE_AUTO_FS
	bool "Stay in frequency synthesis between operations"
	help
	  After a transmission or reception, leave the radio in FS mode with
	  the PLL locked instead of returning to standby. The next operation
	  then starts 27 us after its command rather than 80 us, which is a
	  visible share of the gap between back-to-back packets at 2 Mb/s, at
	  the cost of the synthesizer's supply current while idle.

config LORA_SX128X_NATIVE_RX_CONTINUOUS
	bool "Asynchronous receive in continuous mode"
	help
	  Keep the chip in its continuous receive mode instead of restarting
	  reception from the driver after each packet. No packet is missed
	  while the previous one is read out, but SX1280 datasheet rev 3.3,
	  errata 16.1: under heavy co-channel traffic (above about 220
	  packets per second) continuous receive can stop working until the
	  chip is reset. Off, the radio is deaf from the end of a packet until
	  it has been read out, a few hundred microseconds.

endif # LORA_SX128X_NATIVE
```

## drivers/mbox/Kconfig.gic_sw
```kconfig
# SPDX-FileCopyrightText: 2026 Muhammad Waleed Badar
# SPDX-License-Identifier: Apache-2.0

config MBOX_GIC_SW
	bool "GIC software interrupt MBOX driver"
	default y
	depends on DT_HAS_ZEPHYR_MBOX_GIC_SW_ENABLED
	depends on GIC
	help
	  Signal-only mailbox that sets GIC SPIs pending, for operating
	  systems on different cores sharing one GIC distributor.
```

## drivers/mbox/Kconfig.infineon
```kconfig
# SPDX-FileCopyrightText: Copyright (c) 2026 Infineon Technologies AG,
# SPDX-FileCopyrightText: or an affiliate of Infineon Technologies AG. All rights reserved.
#
# SPDX-License-Identifier: Apache-2.0

config MBOX_INFINEON
	bool "Infineon IPC mailbox driver"
	default y
	depends on DT_HAS_INFINEON_MBOX_ENABLED
	help
	  Enable the mailbox (MBOX) driver for the Infineon inter-processor
	  communication (IPC) block using direct register access.
```

## drivers/mbox/Kconfig.realtek_ameba_ipc
```kconfig
# Copyright (c) 2026 Realtek Semiconductor Corp.
# SPDX-License-Identifier: Apache-2.0

config MBOX_REALTEK_AMEBA_IPC
	bool "Realtek RTL8730E (AmebaSmart) IPC mailbox driver"
	default y
	depends on DT_HAS_REALTEK_RTL8730E_IPC_ENABLED
	help
	  RTL8730E IPC doorbell as an MBOX controller; the mbox cell is the
	  absolute IPC register bit (0..31). Carries the CA32 <-> KM4 and
	  CA32 <-> KM0 rpmsg links.
```

## drivers/mbox/Kconfig.sunxi_msgbox
```kconfig
# SPDX-FileCopyrightText: Copyright The Zephyr Project Contributors
# SPDX-License-Identifier: Apache-2.0

config MBOX_SUNXI_MSGBOX
	bool "Allwinner V851S MSGBOX (RISC/E907 side) driver"
	default y
	depends on DT_HAS_ALLWINNER_SUNXI_MSGBOX_RISCV_ENABLED
	help
	  Enable the Allwinner V851S MSGBOX controller driver for the RISC
	  (E907) co-processor. Provides the mailbox transport used by IPM /
	  OpenAMP / rpmsg to signal the Cortex-A7.
```

## drivers/memc/Kconfig.mchp
```kconfig
# Copyright (c) 2026 Microchip Technology Inc.
# SPDX-License-Identifier: Apache-2.0

config MEMC_MCHP_SMC_G1
	bool "Microchip Static Memory Controller (SMC) G1"
	default y
	depends on DT_HAS_MICROCHIP_SMC_G1_MEMC_ENABLED
	help
	  Enable driver for Microchip Static Memory Controller G1.

config MEMC_MCHP_HSMC_G1
	bool "Microchip HSMC G1"
	default y
	depends on MEMC_MCHP_SMC_G1
	depends on SOC_FAMILY_MICROCHIP_SAMA7
	help
	  This is an HSMC memory controller G1.
```

## drivers/memc/Kconfig.nxp_ahb_sramc
```kconfig
# Copyright 2026 NXP
# SPDX-License-Identifier: Apache-2.0

config MEMC_NXP_AHB_SRAMC
	bool "NXP AHB SRAM Controller (AHB_SRAMC)"
	default y
	depends on DT_HAS_NXP_AHB_SRAMC_ENABLED
	select PINCTRL
	help
	  Enable the NXP AHB SRAM Controller driver. The AHB SRAM Controller is a
	  memory controller for asynchronous SRAM or SRAM-like FPGA devices.

config MEMC_NXP_AHB_SRAMC_INIT_PRIORITY
	int "NXP AHB SRAMC driver initialization priority"
	default MEMC_INIT_PRIORITY
	depends on MEMC_NXP_AHB_SRAMC
	help
	  Initialization priority for the AHB SRAM controller. The controller must
	  be initialized before the devices attached to its chip selects, so this
	  value must not exceed MEMC_INIT_PRIORITY. Equal priorities use devicetree
	  dependency ordering.

if MEMC_NXP_AHB_SRAMC

config MEMC_NXP_AHB_SRAMC_SRAM
	bool "NXP AHB SRAMC SRAM device driver"
	default y
	depends on DT_HAS_NXP_AHB_SRAMC_SRAM_ENABLED
	help
	  Enable the driver for external asynchronous SRAM attached to the NXP AHB
	  SRAM Controller. Each enabled devicetree node with the
	  nxp,ahb-sramc-sram compatible has its chip select programmed during
	  driver initialization and is registered as a memory controller device
	  of its own.

endif # MEMC_NXP_AHB_SRAMC
```

## drivers/memc/Kconfig.nxp_sramc
```kconfig
# Copyright 2026 NXP
# SPDX-License-Identifier: Apache-2.0

config MEMC_NXP_SRAMC
	bool "NXP AHB SRAM Controller (SRAMC)"
	default y
	depends on DT_HAS_NXP_SRAMC_ENABLED
	select PINCTRL
	help
	  Enable the NXP AHB SRAM Controller (SRAMC) driver. This init-only
	  driver configures the external asynchronous parallel SRAM bus timing
	  by calling the MCUXpresso SDK fsl_sramc HAL, so the external SRAM is
	  usable as a memory-mapped region. Used on i.MX RT118x (e.g.
	  MIMXRT1189).
```

## drivers/mfd/Kconfig.adp5585
```kconfig
# Copyright 2024 NXP
# SPDX-License-Identifier: Apache-2.0

config MFD_ADP5585
	bool "Analog ADP5585 I2C configurable GPIO/PWM/KeyScan chip"
	default y
	depends on DT_HAS_ADI_ADP5585_ENABLED
	depends on I2C
	help
	  Enable driver for Analog ADP5585.
```

## drivers/mfd/Kconfig.atecc608a
```kconfig
# Copyright (c) 2026 RAKwireless Technology Limited
# SPDX-License-Identifier: Apache-2.0

config MFD_ATECC608A
	bool "Microchip ATECC608A multi-function device driver"
	default y
	depends on DT_HAS_MICROCHIP_ATECC608A_ENABLED
	select I2C
	help
	  Enable the Microchip ATECC608A I2C parent driver. Child drivers use
	  this node for wake, command framing, and bus access.
```

## drivers/mfd/Kconfig.bq25620
```kconfig
# Copyright (c) 2026 Testo SE & Co. KGaA
# SPDX-License-Identifier: Apache-2.0

config MFD_BQ25620
	bool "TI BQ25620 multi-function device driver"
	default y
	depends on DT_HAS_TI_BQ25620_ENABLED
	select I2C
	help
	  Enable the TI BQ25620 battery charger multi-function device driver.

config EMUL_BQ25620
	bool "TI BQ25620 emulator"
	default y
	depends on EMUL
	depends on MFD_BQ25620
	help
	  Enable the I2C emulator of the TI BQ25620 battery charger.
```

## drivers/mfd/Kconfig.bq2589x
```kconfig
# SPDX-FileCopyrightText: Copyright The Zephyr Project Contributors
# SPDX-License-Identifier: Apache-2.0

config MFD_BQ2589X
	bool "BQ2589X multi-function device driver"
	default y
	depends on DT_HAS_TI_BQ25896_ENABLED || DT_HAS_SILERGY_SY6970_ENABLED
	select I2C
	help
	  Enable the multi-function device driver for the TI BQ2589X family of
	  single cell switching battery chargers.

	  Supported devices include:
	    - BQ25896
	    - SY6970
```
