## drivers/can/Kconfig.max32
```kconfig
# Copyright (c) 2024 Analog Devices, Inc.
# SPDX-License-Identifier: Apache-2.0

config CAN_MAX32
	bool "ADI MAX32 CAN Driver"
	default y
	depends on DT_HAS_ADI_MAX32_CAN_ENABLED
	select PINCTRL
	help
	  Enable ADI MAX32 CAN Driver

if CAN_MAX32

config CAN_MAX32_MAX_FILTERS
	int "Maximum number of concurrent active filters"
	default 16
	range 1 32
	help
	  Maximum number of filters supported by the can_add_rx_callback() API call.

endif # CAN_MAX32
```

## drivers/can/Kconfig.mcan_platform
```kconfig
# MCAN Platform configuration options
# Copyright (c) 2025 Texas Instruments
# SPDX-License-Identifier: Apache-2.0

config CAN_MCAN_PLATFORM
	bool "Bosch M_CAN driver"
	default y
	depends on DT_HAS_BOSCH_M_CAN_ENABLED
	select CAN_MCAN
	select PINCTRL
```

## drivers/can/Kconfig.mchp_mss
```kconfig
# Copyright (C) 2025 embedded brains GmbH & Co. KG
# SPDX-License-Identifier: Apache-2.0

config CAN_MCHP_MSS
	bool "Microchip PolarFire SoC CAN driver"
	depends on DT_HAS_MICROCHIP_MPFS_CAN_ENABLED
	help
	  This option enables the CAN driver for Microchip's PolarFire SoC
	  platform.

if CAN_MCHP_MSS

config CAN_MCHP_MSS_SWAP_ENDIANNESS
	bool "Force little endian on transmit and receive buffers"
	help
	  This option sets the SWAP_ENDIAN bit of CAN_CONFIG register.
	  By setting this bit, the values of [TX|RX]_MSGx_DATA_[LOW|HIGH] 
	  will operate in little endian mode. For example, either field set 
	  to 0x01020304 will result in 0x01 -> 0x02 -> 0x03 -> 0x04 being written on the bus.

	  Conversely, when operating in the (default) big endian mode, the inverse
	  sequence will be transmitted on the bus, i.e. in network order.

endif # CAN_MCHP_MSS
```

## drivers/can/Kconfig.mcp2515
```kconfig
# MCP2515 CAN configuration options

# Copyright (c) 2018 Karsten Koenig
# SPDX-License-Identifier: Apache-2.0

config CAN_MCP2515
	bool "MCP2515 CAN Driver"
	default y
	depends on DT_HAS_MICROCHIP_MCP2515_ENABLED
	select SPI
	help
	  Enable MCP2515 CAN Driver

if CAN_MCP2515

config CAN_MCP2515_INT_THREAD_STACK_SIZE
	int "Stack size for interrupt handler"
	default 512
	help
	  Size of the stack used for internal thread which is ran for
	  interrupt handling and incoming packets.

config CAN_MCP2515_INT_THREAD_PRIO
	int "Priority for interrupt handler"
	default 2
	help
	  Priority level of the internal thread which is ran for
	  interrupt handling and incoming packets.

config CAN_MAX_FILTER
	int "Maximum number of concurrent active filters"
	default 5
	range 1 32
	help
	  Defines the array size of the callback/msgq pointers.
	  Must be at least the size of concurrent reads.

endif # CAN_MCP2515
```

## drivers/can/Kconfig.mcp251xfd
```kconfig
# MCP25XXFD CAN configuration options

# Copyright (c) 2020 Abram Early
# Copyright (c) 2023 Andriy Gelman
# SPDX-License-Identifier: Apache-2.0

config CAN_MCP251XFD
	bool "MCP25XXFD CAN Driver"
	default y
	depends on DT_HAS_MICROCHIP_MCP251XFD_ENABLED
	select CRC
	select SPI
	help
	  Enable MCP25XXFD CAN Driver

if CAN_MCP251XFD

config CAN_MCP251XFD_MAX_TX_QUEUE
	int "Maximum number of queued messages"
	default 8
	range 1 32
	help
	  Defines the array size of transmit callback pointers and semaphores,
	  as well as the number of messages in the TX queue.

config CAN_MCP251XFD_RX_FIFO_ITEMS
	int "Number of CAN messages in the RX fifo"
	default 16
	range 1 32
	help
	  Defines the number of CAN messages in the RX fifo.

config CAN_MCP251XFD_INT_THREAD_STACK_SIZE
	int "Stack size for interrupt handler"
	default 768
	help
	  Size of the stack used for internal thread which is ran for
	  interrupt handling and incoming packets.

config CAN_MCP251XFD_INT_THREAD_PRIO
	int "Priority for interrupt handler"
	default 2
	help
	  Thread priority of the interrupt handler. A higher number implies a
	  higher priority. The thread is cooperative and will not be interrupted by
	  another thread until execution is released.

config CAN_MCP251XFD_READ_CRC_RETRIES
	int "Number of retries during SFR register read"
	default 5
	help
	  Number of retries during SFR register read if CRC fails.

config CAN_MAX_FILTER
	int "Maximum number of concurrent active filters"
	default 5
	range 1 32
	help
	  Maximum number of filters supported by the can_add_rx_callback() API call.

endif # CAN_MCP251XFD
```

## drivers/can/Kconfig.mcp25xxfd
```kconfig
# MCP25XXFD CAN configuration options

# Copyright (c) 2020 Abram Early
# SPDX-License-Identifier: Apache-2.0

DT_COMPAT_MICROCHIP_MCP25XXFD_CAN := microchip,mcp25xxfd

config CAN_MCP25XXFD
	bool "MCP25XXFD CAN Driver"
	default $(dt_compat_enabled,$(DT_COMPAT_MICROCHIP_MCP25XXFD_CAN))
	depends on SPI
	select CAN_AUTO_BUS_OFF_RECOVERY
	select CAN_HAS_CANFD
	select CAN_HAS_RX_TIMESTAMP
	help
	  Enable MCP25XXFD CAN Driver

if CAN_MCP25XXFD

config CAN_MCP25XXFD_MAX_TX_QUEUE
	int "Maximum number of queued messages"
	default 4
	range 1 31
	help
		Defines the array size of transmit callback pointers and semaphores,
		as well as the number of TX FIFOs allocated on the MCP25XXFD.

config CAN_MCP25XXFD_INT_THREAD_STACK_SIZE
	int "Stack size for interrupt handler"
	default 768
	help
	  Size of the stack used for internal thread which is ran for
	  interrupt handling and incoming packets.

config CAN_MCP25XXFD_INT_THREAD_PRIO
	int "Priority for interrupt handler"
	default 2
	help
	  Priority level of the internal thread which is ran for
	  interrupt handling and incoming packets.

config CAN_MAX_FILTER
	int "Maximum number of concurrent active filters"
	default 5
	range 1 31
	help
	  Defines the array size of the callback/msgq pointers.
	  Must be at least the size of concurrent reads.

config CAN_MCP25XXFD_INIT_PRIORITY
	int "Init priority"
	default 80
	help
	  MCP25XXFD driver initialization priority, must be higher than SPI.

endif # CAN_MCP25XXFD
```

## drivers/can/Kconfig.mcux
```kconfig
# NXP MCUX CAN configuration options

# Copyright (c) 2019 Vestas Wind Systems A/S
# SPDX-License-Identifier: Apache-2.0

config CAN_MCUX_FLEXCAN
	bool "NXP FlexCAN driver"
	default y
	depends on DT_HAS_NXP_FLEXCAN_ENABLED
	depends on CLOCK_CONTROL
	select PINCTRL
	help
	  Enable support for the NXP FlexCAN driver.

if CAN_MCUX_FLEXCAN

config CAN_MCUX_FLEXCAN_FD
	bool # hidden
	default y
	depends on DT_HAS_NXP_FLEXCAN_FD_ENABLED && CAN_FD_MODE
	help
	  Enable support for CAN FD capable NXP FlexCAN devices.

config CAN_MCUX_FLEXCAN_WAIT_TIMEOUT
	int "Maximum number of wait loop iterations"
	default 10000
	help
	  Maximum number of wait loop iterations for the MCUX FlexCAN HAL when entering/leaving
	  freeze mode.

config CAN_MCUX_FLEXCAN_MAX_FILTERS
	int "Maximum number of concurrently active RX filters"
	range 0 128
	default 5 if CAN_MCUX_FLEXCAN_FD
	default 13
	help
	  Default maximum number of concurrently active RX filters. The maximum value depends on the
	  number of available message buffers for each FlexCAN instance.

	  This default can be overridden on a per-instance basis via the "max-filters" devicetree
	  property.

	  CAN FD mode uses larger message buffers, resulting in fewer available filters.

endif # CAN_MCUX_FLEXCAN
```

## drivers/can/Kconfig.mspm0
```kconfig
# Copyright (c) 2026 Texas Instruments
# SPDX-License-Identifier: Apache-2.0

config CAN_MSPM0_CANFD
	bool "MSPM0 CANFD driver"
	default y
	depends on DT_HAS_TI_MSPM0_CANFD_ENABLED
	select CAN_MCAN
	select USE_MSPM0_DL_MCAN
	select PINCTRL
	help
	  Enable support for CANFD on the TI MSPM0 series.
```

## drivers/can/Kconfig.native_posix
```kconfig
# Native posix CAN configuration options

# Copyright (c) 2019 Intel Corporation
# SPDX-License-Identifier: Apache-2.0

config CAN_NATIVE_POSIX
	bool "native_posix CAN Driver"
	depends on ARCH_POSIX && NETWORKING
	help
	  Enable native_posix CAN driver

if CAN_NATIVE_POSIX

config CAN_MAX_FILTER
	int "Maximum number of concurrent active filters"
	depends on CAN_NATIVE_POSIX
	default 32
	range 1 56
	help
	  Defines the array size of the callback/msgq pointers.
	  Must be at least the size of concurrent reads.

## Interface 1
config CAN_NATIVE_POSIX_INTERFACE_1_ENABLED
	bool "CANBUS interface 1"
	default y
	depends on CAN_NATIVE_POSIX
	help
	  This option enables the CANBUS network interface for Native POSIX board.

config CAN_NATIVE_POSIX_INTERFACE_1_NAME
	string "CANBUS interface 1 name on Linux side"
	depends on CAN_NATIVE_POSIX_INTERFACE_1_ENABLED
	default "vcan0"
	help
	  This option sets the CANBUS network interface 1 name in host system.

config CAN_NATIVE_POSIX_INTERFACE_1_SOCKETCAN_NAME
	string "Network device name"
	depends on CAN_NATIVE_POSIX_INTERFACE_1_ENABLED
	default "SOCKET_CAN_1"
	help
	  Name of the network device driver for SocketCAN.

## Interface 2
config CAN_NATIVE_POSIX_INTERFACE_2_ENABLED
	bool "CANBUS interface 2"
	default n
	depends on CAN_NATIVE_POSIX
	help
	  This option enables the CANBUS network interface for Native POSIX board.

if CAN_NATIVE_POSIX_INTERFACE_2_ENABLED

config CAN_NATIVE_POSIX_INTERFACE_2_NAME
	string "CANBUS interface 2 name on Linux side"
	depends on CAN_NATIVE_POSIX_INTERFACE_2_ENABLED
	default "vcan1"
	help
	  This option sets the CANBUS network interface 2 name in host system.

config CAN_NATIVE_POSIX_INTERFACE_2_SOCKETCAN_NAME
	string "Network device name"
	depends on CAN_NATIVE_POSIX_INTERFACE_2_ENABLED
	default "SOCKET_CAN_2"
	help
	  Name of the network device driver for SocketCAN.

endif #CAN_NATIVE_POSIX_INTERFACE_2_ENABLED

endif #CAN_NATIVE_POSIX
```

## drivers/can/Kconfig.native_posix_linux
```kconfig
# Native Linux SocketCAN configuration options

# Copyright (c) 2022 Martin Jäger <martin@libre.solar>
# SPDX-License-Identifier: Apache-2.0

config CAN_NATIVE_POSIX_LINUX
	bool "Native Linux SocketCAN Driver"
	default y
	depends on DT_HAS_ZEPHYR_NATIVE_POSIX_LINUX_CAN_ENABLED
	help
	  Enable native Linux SocketCAN Driver

if CAN_NATIVE_POSIX_LINUX

config CAN_NATIVE_POSIX_LINUX_RX_THREAD_PRIORITY
	int "Priority for internal RX thread"
	default 2
	help
	  Priority level of the internal thread which is run for
	  handling of incoming packets.

config CAN_MAX_FILTER
	int "Maximum number of concurrent active filters"
	default 5
	range 1 32
	help
	  Defines the array size of the callback/msgq pointers.
	  Must be at least the size of concurrent reads.

endif # CAN_NATIVE_POSIX_LINUX
```

## drivers/can/Kconfig.net
```kconfig
# Kconfig.net - Configuration options for IPv6 over CAN

#
# Copyright (c) 2019 Alexander Wachter
#
# SPDX-License-Identifier: Apache-2.0
#

config CAN_NET
	bool "Enable 6loCAN network interface [EXPERIMENTAL]"
	help
	  Enable IPv6 Networking over can (6loCAN)

if CAN_NET

module = CAN_NET
module-dep = NET_LOG
module-str = Log level for Network CAN
module-help = Enables logging for CAN L2 networking
source "subsys/net/Kconfig.template.log_config.net"

config CAN_NET_NAME
	string "Network device name"
	default "NET_CAN"
	help
	  Name of the network device driver for IPv6 over CAN.

config CAN_NET_INIT_PRIORITY
	int "CAN NET driver init priority"
	default 80
	help
	  CAN NET device driver initialization priority.
	  Do not mess with it unless you know what you are doing.
	  Note that the priority needs to be lower than the net stack
	  so that it can start before the networking sub-system.

endif #CAN_NET
```

## drivers/can/Kconfig.nrf
```kconfig
# Copyright (c) 2024 Nordic Semiconductor ASA
# SPDX-License-Identifier: Apache-2.0

config CAN_NRF
	bool "nRF CAN driver"
	default y
	depends on DT_HAS_NORDIC_NRF_CAN_ENABLED
	select CAN_MCAN
	select CLOCK_CONTROL
	help
	  Driver for nRF CAN.
```

## drivers/can/Kconfig.numaker
```kconfig
# NuMaker CAN(-FD) driver configuration options

# Copyright (c) 2023 Nuvoton Technology Corporation
# SPDX-License-Identifier: Apache-2.0

config CAN_NUMAKER
	bool "Nuvoton NuMaker CAN FD driver"
	default y
	select CAN_MCAN
	depends on DT_HAS_NUVOTON_NUMAKER_CANFD_ENABLED
	depends on SOC_SERIES_M46X || SOC_SERIES_M2L31X
	help
	  Enables Nuvoton NuMaker CAN FD driver, using Bosch M_CAN
```

## drivers/can/Kconfig.nxp_lpc_mcan
```kconfig
# NXP LPC family MCAN configuration options

# Copyright (c) 2019-2026 Vestas Wind Systems A/S
# SPDX-License-Identifier: Apache-2.0

config CAN_NXP_LPC_MCAN
	bool "NXP LPC family MCAN driver"
	default y
	depends on DT_HAS_NXP_LPC_MCAN_ENABLED
	depends on CLOCK_CONTROL
	select CAN_MCAN
	select PINCTRL
	select RESET
	help
	  Enable support for the NXP LPC family MCAN driver.
```

## drivers/can/Kconfig.nxp_s32
```kconfig
# Copyright 2022-2024 NXP
# SPDX-License-Identifier: Apache-2.0

config CAN_NXP_S32_CANXL
	bool "NXP S32 CANXL driver"
	default y
	depends on DT_HAS_NXP_S32_CANXL_ENABLED
	select CLOCK_CONTROL
	help
	  Enable support for NXP S32 CANXL driver.

if CAN_NXP_S32_CANXL
config CAN_NXP_S32_RX_FIFO
	bool "NXP S32 CANXL uses RX FIFO"
	default y
	help
	  If this is enabled, NXP S32 CANXL uses RX FIFO.
	  Otherwise NXP S32 CANXL uses RX Message Descriptor.

config CAN_NXP_S32_MAX_RX
	int "Maximum number of RX descriptors"
	default 16
	range 1 32 if CAN_NXP_S32_RX_FIFO
	range 1 128 if !CAN_NXP_S32_RX_FIFO
	help
	  Maximum number of RX descriptors.

config CAN_NXP_S32_MAX_TX
	int "Maximum number of TX descriptors"
	default 16
	range 1 128
	help
	  Maximum number of TX descriptors.
endif # CAN_NXP_S32_CANXL
```

## drivers/can/Kconfig.pic32cxsg
```kconfig
# Microchip PIC32CXSG CAN configuration options
# Copyright (c) 2024 Microchip
# SPDX-License-Identifier: Apache-2.0

config CAN_PIC32CXSG
	bool "Microchip PIC32CXSG CAN driver"
	default y
	depends on DT_HAS_PIC32CXSG_CAN_ENABLED
	select CAN_MCAN
```

## drivers/can/Kconfig.rcar
```kconfig
# Renesas R-Car CAN configuration options

# Copyright (c) 2021 IoT.bzh
# SPDX-License-Identifier: Apache-2.0

config CAN_RCAR
	bool "Renesas R-Car CAN Driver"
	default y
	depends on DT_HAS_RENESAS_RCAR_CAN_ENABLED
	select PINCTRL
	help
	  Enable Renesas R-Car CAN Driver.

config CAN_RCAR_MAX_FILTERS
	int "Maximum number of concurrent active filters"
	depends on CAN_RCAR
	default 16
	range 1 32
	help
	  Defines the array size of the callback/msgq pointers.
	  Must be at least the size of concurrent reads.

config CAN_RCAR_RSCANFD
	bool "Renesas R-Car RS-CANFD Driver"
	default y
	depends on DT_HAS_RENESAS_RCAR_RSCANFD_GLOBAL_ENABLED
	select PINCTRL
	help
	  Enable Renesas R-Car CAN Driver for the RS-CANFD controller,
	  found in Gen 4 and more recent platforms.

config CAN_RCAR_RSCANFD_MAX_FILTERS
	int "Maximum number of concurrent active reception filters"
	depends on CAN_RCAR_RSCANFD
	default 16
	range 1 32
	help
	  Defines the array size of the callback/msgq pointers.
	  Must be at least the size of concurrent reads.
```

## drivers/can/Kconfig.renesas_ra
```kconfig
# Copyright (c) 2024 Renesas Electronics Corporation
# SPDX-License-Identifier: Apache-2.0

config CAN_RENESAS_RA_CANFD
	bool "Renesas RA CANFD"
	default y
	depends on DT_HAS_RENESAS_RA_CANFD_ENABLED
	select USE_RA_FSP_CANFD
	select PINCTRL
	help
	  Enable Renesas RA CANFD driver
```

## drivers/can/Kconfig.renesas_rz
```kconfig
# Copyright (c) 2025 Renesas Electronics Corporation
# SPDX-License-Identifier: Apache-2.0

config CAN_RENESAS_RZ_CANFD
	bool "Renesas RZ CANFD"
	default y
	depends on DT_HAS_RENESAS_RZ_CANFD_ENABLED
	select USE_RZ_FSP_CANFD
	select CLOCK_CONTROL
	help
	  Enable Renesas RZ CANFD driver
```

## drivers/can/Kconfig.sam
```kconfig
# SAM CAN configuration options
# Copyright (c) 2021 Alexander Wachter
# SPDX-License-Identifier: Apache-2.0

config CAN_SAM
	bool "Atmel SAM CAN driver"
	default y
	depends on DT_HAS_ATMEL_SAM_CAN_ENABLED
	select CAN_MCAN
```

## drivers/can/Kconfig.sam0
```kconfig
# SAM CAN configuration options
# Copyright (c) 2022 Kamil Serwus
# SPDX-License-Identifier: Apache-2.0

config CAN_SAM0
	bool "Atmel SAM0 CAN driver"
	default y
	depends on DT_HAS_ATMEL_SAM0_CAN_ENABLED
	select CAN_MCAN
```
