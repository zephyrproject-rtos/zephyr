## drivers/can/Kconfig.sam_mcan
```kconfig
# Kconfig.sam_mcan - SAM mCAN configuration options
#
#
# Copyright (c) 2017 Erwin Rol <erwin@erwinrol.com>
#
# SPDX-License-Identifier: Apache-2.0
#

menuconfig CAN_SAM_MCAN
	bool "Sam MCU mCAN driver"
	default n
	depends on SOC_FAMILY_STM32
	help
	  This option enables the CAN driver for STM32 family of
	  processors. Say y if you wish to use CAN ports on STM32
	  MCU.

if CAN_SAM_MCAN
			
endif
```

## drivers/can/Kconfig.sja1000
```kconfig
# NXP SJA1000 configuration options

# Copyright (c) 2022 Henrik Brix Andersen <henrik@brixandersen.dk>
# SPDX-License-Identifier: Apache-2.0

config CAN_SJA1000
	bool
	help
	  This enables support for the shared NXP SJA1000 CAN driver.

config CAN_MAX_FILTER
	int "Maximum number of concurrent active RX filters"
	depends on CAN_SJA1000
	default 5
	range 1 32
	help
	  As the NXP SJA1000 only supports one full-width RX filter, filtering of received CAN
	  frames are done in software.
```

## drivers/can/Kconfig.stm32
```kconfig
# STM32 CAN configuration options

# Copyright (c) 2022 Blue Clover
# Copyright (c) 2018-2020 Alexander Wachter
# SPDX-License-Identifier: Apache-2.0

config CAN_STM32_BXCAN
	bool "STM32 bxCAN driver"
	default y
	depends on DT_HAS_ST_STM32_BXCAN_ENABLED
	select PINCTRL
	help
	  Enable STM32 bxCAN Driver.

if CAN_STM32_BXCAN

config CAN_STM32_BXCAN_MAX_STD_ID_FILTERS
	int "Maximum number of standard (11-bit) ID filters"
	default 14
	range 0 28
	help
	  Defines the maximum number of filters with standard ID (11-bit)
	  that can be added by the application.

	  One standard ID filter with mask occupies 1/2 of the 14 available
	  filter banks.

	  The following equation determines the maximum total number of
	  filters:

	  CAN_STM32_BXCAN_MAX_STD_ID_FILTERS + CAN_STM32_BXCAN_MAX_EXT_ID_FILTERS * 2 <= 28

config CAN_STM32_BXCAN_MAX_EXT_ID_FILTERS
	int "Maximum number of extended (29-bit) ID filters"
	default 7
	range 0 14
	help
	  Defines the maximum number of filters with extended ID (29-bit)
	  that can be added by the application.

	  One extended ID filter with mask occupies 1 of the 14 available
	  filter banks.

	  The following equation determines the maximum total number of
	  filters:

	  CAN_STM32_BXCAN_MAX_STD_ID_FILTERS + CAN_STM32_BXCAN_MAX_EXT_ID_FILTERS * 2 <= 28

endif # CAN_STM32_BXCAN

config CAN_STM32_FDCAN
	bool "STM32 FDCAN driver"
	default y
	depends on DT_HAS_ST_STM32_FDCAN_ENABLED
	select CAN_MCAN
	select PINCTRL

if CAN_STM32_FDCAN

config CAN_STM32_FDCAN_MAX_STD_ID_FILTERS
	int "Maximum number of standard (11-bit) ID filters"
	default 28
	range 0 28
	help
	  Defines the maximum number of filters with standard ID (11-bit)
	  that can be added by the application.

config CAN_STM32_FDCAN_MAX_EXT_ID_FILTERS
	int "Maximum number of extended (29-bit) ID filters"
	default 8
	range 0 8
	help
	  Defines the maximum number of filters with extended ID (29-bit)
	  that can be added by the application.

endif # CAN_STM32_FDCAN

config CAN_STM32H7_FDCAN
	bool "STM32H7 FDCAN driver"
	default y
	depends on DT_HAS_ST_STM32H7_FDCAN_ENABLED
	select CAN_MCAN
	select PINCTRL
```

## drivers/can/Kconfig.stm32_bxcan
```kconfig
# Kconfig.stm32_bxcan - STM32 bxCAN configuration options
#
#
# Copyright (c) 2017 Erwin Rol <erwin@erwinrol.com>
#
# SPDX-License-Identifier: Apache-2.0
#

menuconfig CAN_STM32_BXCAN
	bool "STM32 MCU bxCAN driver"
	default n
	depends on SOC_FAMILY_STM32
	help
	  This option enables the bxCAN driver for STM32 family of
	  processors. Say y if you wish to use CAN ports on STM32
	  MCU.

if CAN_STM32_BXCAN

config CAN_STM32_BXCAN_PORT_1
	bool "STM32 CAN port 1"
	depends on CAN_STM32_BXCAN
	default n
	help
	  Enable CAN port 1.

config CAN_STM32_BXCAN_PORT_1_DEV_NAME
	string "STM32 CAN Port 1 Device Name"
	default "CAN_1"
	depends on CAN_STM32_BXCAN_PORT_1
	help
	  Specify the device name for CAN port 1.

config CAN_STM32_BXCAN_PORT_2
	bool "STM32 CAN port 2"
	depends on CAN_STM32_BXCAN
	select CAN_STM32_BXCAN_PORT_1
	default n
	help
	  Enable CAN port 2.

config CAN_STM32_BXCAN_PORT_2_DEV_NAME
	string "STM32 CAN Port 2 Device Name"
	default "CAN_2"
	depends on CAN_STM32_BXCAN_PORT_2
	help
	  Specify the device name for CAN port 2.

config CAN_STM32_BXCAN_PORT_2_FILTER_BANK_COUNT
	int "Number of filters banks for port 2"
	default 14
	depends on CAN_STM32_BXCAN_PORT_2
	help
	  Specify the number of filter banks for port 2.
	

menu "bitrates"
	menuconfig CAN_STM32_BXCAN_BITRATE_1MBIT
		bool "1Mbit/s"
		default y
		
	if CAN_STM32_BXCAN_BITRATE_1MBIT
		config CAN_STM32_BXCAN_BITRATE_1MBIT_PRESCALER
			int "Prescaler"
			default 7
		config CAN_STM32_BXCAN_BITRATE_1MBIT_SJW
			int "SJW"
			default 1
		config CAN_STM32_BXCAN_BITRATE_1MBIT_BS1
			int "BS1"
			default 4
		config CAN_STM32_BXCAN_BITRATE_1MBIT_BS2
			int "BS2"
			default 1
	endif
	
	menuconfig CAN_STM32_BXCAN_BITRATE_800KBIT
		bool "800kbit/s"
		default n
		
	if CAN_STM32_BXCAN_BITRATE_800KBIT
		config CAN_STM32_BXCAN_BITRATE_800KBIT_PRESCALER
			int "Prescaler"
			default 3
		config CAN_STM32_BXCAN_BITRATE_800KBIT_SJW
			int "SJW"
			default 1
		config CAN_STM32_BXCAN_BITRATE_800KBIT_BS1
			int "BS1"
			default 13
		config CAN_STM32_BXCAN_BITRATE_800KBIT_BS2
			int "BS2"
			default 4
	endif
	

	menuconfig CAN_STM32_BXCAN_BITRATE_500KBIT
		bool "500kbit/s"
		default y
		
	if CAN_STM32_BXCAN_BITRATE_500KBIT
		config CAN_STM32_BXCAN_BITRATE_500KBIT_PRESCALER
			int "Prescaler"
			default 14
		config CAN_STM32_BXCAN_BITRATE_500KBIT_SJW
			int "SJW"
			default 1
		config CAN_STM32_BXCAN_BITRATE_500KBIT_BS1
			int "BS1"
			default 4
		config CAN_STM32_BXCAN_BITRATE_500KBIT_BS2
			int "BS2"
			default 1
	endif
	
	menuconfig CAN_STM32_BXCAN_BITRATE_250KBIT
		bool "250kbit/s"
		default y
		
	if CAN_STM32_BXCAN_BITRATE_250KBIT
		config CAN_STM32_BXCAN_BITRATE_250KBIT_PRESCALER
			int "Prescaler"
			default 28
		config CAN_STM32_BXCAN_BITRATE_250KBIT_SJW
			int "SJW"
			default 1
		config CAN_STM32_BXCAN_BITRATE_250KBIT_BS1
			int "BS1"
			default 4
		config CAN_STM32_BXCAN_BITRATE_250KBIT_BS2
			int "BS2"
			default 1
	endif
	
	menuconfig CAN_STM32_BXCAN_BITRATE_125KBIT
		bool "125kbit/s"
		default y
		
	if CAN_STM32_BXCAN_BITRATE_125KBIT
		config CAN_STM32_BXCAN_BITRATE_125KBIT_PRESCALER
			int "Prescaler"
			default 56
		config CAN_STM32_BXCAN_BITRATE_125KBIT_SJW
			int "SJW"
			default 1
		config CAN_STM32_BXCAN_BITRATE_125KBIT_BS1
			int "BS1"
			default 4
		config CAN_STM32_BXCAN_BITRATE_125KBIT_BS2
			int "BS2"
			default 1
	endif
	
	menuconfig CAN_STM32_BXCAN_BITRATE_50KBIT
		bool "50kbit/s"
		default y
		
	if CAN_STM32_BXCAN_BITRATE_50KBIT
		config CAN_STM32_BXCAN_BITRATE_50KBIT_PRESCALER
			int "Prescaler"
			default 140
		config CAN_STM32_BXCAN_BITRATE_50KBIT_SJW
			int "SJW"
			default 1
		config CAN_STM32_BXCAN_BITRATE_50KBIT_BS1
			int "BS1"
			default 4
		config CAN_STM32_BXCAN_BITRATE_50KBIT_BS2
			int "BS2"
			default 1
	endif
	
	menuconfig CAN_STM32_BXCAN_BITRATE_20KBIT
		bool "20kbit/s"
		default y
		
	if CAN_STM32_BXCAN_BITRATE_20KBIT
		config CAN_STM32_BXCAN_BITRATE_20KBIT_PRESCALER
			int "Prescaler"
			default 350
		config CAN_STM32_BXCAN_BITRATE_20KBIT_SJW
			int "SJW"
			default 1
		config CAN_STM32_BXCAN_BITRATE_20KBIT_BS1
			int "BS1"
			default 4
		config CAN_STM32_BXCAN_BITRATE_20KBIT_BS2
			int "BS2"
			default 1
	endif
	
	menuconfig CAN_STM32_BXCAN_BITRATE_10KBIT
		bool "10kbit/s"
		default y
		
	if CAN_STM32_BXCAN_BITRATE_10KBIT
		config CAN_STM32_BXCAN_BITRATE_10KBIT_PRESCALER
			int "Prescaler"
			default 700
		config CAN_STM32_BXCAN_BITRATE_10KBIT_SJW
			int "SJW"
			default 1
		config CAN_STM32_BXCAN_BITRATE_10KBIT_BS1
			int "BS1"
			default 4
		config CAN_STM32_BXCAN_BITRATE_10KBIT_BS2
			int "BS2"
			default 1
	endif
		
endmenu
			
endif
```
