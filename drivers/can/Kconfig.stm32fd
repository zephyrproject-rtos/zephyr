## drivers/can/Kconfig.stm32fd
```kconfig
# STM32 CAN configuration options

# Copyright (c) 2020 Alexander Wachter
# SPDX-License-Identifier: Apache-2.0

config CAN_STM32FD
	bool "STM32 FDCAN driver"
	default y
	depends on DT_HAS_ST_STM32_FDCAN_ENABLED
	select CAN_MCAN
	select USE_STM32_LL_RCC

if CAN_STM32FD

config CAN_MAX_STD_ID_FILTER
	int "Maximum number of std ID filters"
	default 28
	range 0 28
	help
	  Defines the maximum number of filters with standard ID (11-bit)
	  that can be attached.

config CAN_MAX_EXT_ID_FILTER
	int "Maximum number of ext ID filters"
	default 8
	range 0 8
	help
	  Defines the maximum number of filters with extended ID (29-bit)
	  that can be attached.

endif # CAN_STM32FD
```

## drivers/can/Kconfig.stm32h7
```kconfig
# STM32H7 FD-CAN configuration options

# Copyright (c) 2022 Blue Clover
# SPDX-License-Identifier: Apache-2.0

config CAN_STM32H7
	bool "STM32H7 FDCAN driver"
	default y
	depends on DT_HAS_ST_STM32H7_FDCAN_ENABLED
	select CAN_MCAN
	select USE_STM32_LL_RCC
```

## drivers/can/Kconfig.tcan4x5x
```kconfig
# TCAN4x5x configuration options

# Copyright (c) 2023 Vestas Wind Systems A/S
# SPDX-License-Identifier: Apache-2.0

config CAN_TCAN4X5X
	bool "TI TCAN4x5x"
	default y
	depends on DT_HAS_TI_TCAN4X5X_ENABLED
	select CAN_MCAN
	select SPI
	help
	  Enable support for the Texas Instruments TCAN4x5x.

if CAN_TCAN4X5X

config CAN_TCAN4X5X_THREAD_STACK_SIZE
	int "Stack size for the TCAN4x5x interrupt thread"
	default 1024
	help
	  Size of the stack used for the thread handling interrupts and dispatching callbacks.

config CAN_TCAN4X5X_THREAD_PRIO
	int "Priority for the TCAN4x5x interrupt thread"
	default 0
	help
	  Priority level for the thread handling interrupts and dispatching callbacks.

endif # CAN_TCAN4X5X
```

## drivers/can/Kconfig.ti_mcan
```kconfig
# Copyright (c) 2026 Texas Instruments
# SPDX-License-Identifier: Apache-2.0

config CAN_TI_MCAN
	bool "TI M_CAN driver"
	default y
	depends on DT_HAS_TI_MCAN_ENABLED
	depends on CLOCK_CONTROL
	select CAN_MCAN
	select PINCTRL
	help
	  Enable support for Texas Instruments MCAN controller.
```

## drivers/can/Kconfig.xilinx_canfd
```kconfig
# Copyright (c) 2025 Advanced Micro Devices, Inc.
# SPDX-License-Identifier: Apache-2.0

config CAN_XILINX_CANFD
	bool "Xilinx CANFD driver"
	default y
	depends on DT_HAS_XLNX_CANFD_2_0_ENABLED
	help
	  Support for Xilinx CANFD
```

## drivers/can/Kconfig.xlnx_zynq
```kconfig
#
# Xilinx Processor System CAN controller driver
# configuration options
#
# Copyright (c) 2024, Immo Birnbaum
# SPDX-License-Identifier: Apache-2.0
#

config CAN_XLNX_ZYNQ
	bool "Xilinx Processor System CAN controller driver"
	default y
	depends on DT_HAS_XLNX_ZYNQ_CAN_1_0_ENABLED
	depends on !QEMU_TARGET
	help
	  Enable the Xilinx Processor System CAN controller driver.

config CAN_MAX_FILTER
	int "Maximum number of concurrent active RX filters"
	depends on CAN_XLNX_ZYNQ
	default 5
	range 1 32
	help
	  RX filters are implemented in software as the Xilinx Processor
	  System CAN controller only provides four filters in hardware,
	  therefore, the number of RX filters can be configured here.
```

## drivers/can/Kconfig.xmc4xxx
```kconfig
# Infineon XMC4xxx CAN configuration options
# Copyright (c) 2023 Andriy Gelman
# SPDX-License-Identifier: Apache-2.0

config CAN_XMC4XXX
	bool "Infineon XMC4xxx CAN Driver"
	default y
	depends on DT_HAS_INFINEON_XMC4XXX_CAN_NODE_ENABLED
	select PINCTRL
	help
	  Enable Infineon XMC4xxx CAN Driver

if CAN_XMC4XXX

config CAN_XMC4XXX_MAX_TX_QUEUE
	int "Maximum number of queued messages"
	default 8
	range 1 32
	help
	  Defines the array size of transmit callback pointers and semaphores,
	  as well as the number of messages in the TX queue.

config CAN_XMC4XXX_RX_FIFO_ITEMS
	int "Number of CAN messages allocated to each RX FIFO"
	default 8
	range 1 32
	help
	  Defines the number of CAN messages in each RX FIFO. A separate RX FIFO
	  is created for each RX filter.

config CAN_XMC4XXX_INTERNAL_BUS_MODE
	bool "Internal bus mode"
	select PINCTRL
	help
	  Connects all XMC4XXX CAN devices to an internal bus. Enables
	  message exchange between MCU CAN devices without any external connectors.

config CAN_MAX_FILTER
	int "Maximum number of concurrent active filters"
	default 4
	range 1 32
	help
	  Maximum number of filters supported by the can_add_rx_callback() API call.

endif # CAN_XMC4XXX
```

## drivers/can/transceiver/Kconfig
```kconfig
# CAN transceiver configuration options

# Copyright (c) 2022 Vestas Wind Systems A/S
# SPDX-License-Identifier: Apache-2.0

menu "CAN transceiver drivers"

config CAN_TRANSCEIVER_INIT_PRIORITY
	int "CAN transceiver driver init priority"
	default 45
	help
	  CAN transceiver device driver initialization priority.

config CAN_TRANSCEIVER_GPIO
	bool "GPIO controlled CAN transceiver"
	default y
	depends on DT_HAS_CAN_TRANSCEIVER_GPIO_ENABLED
	select GPIO
	help
	  Enable support for GPIO controlled CAN transceivers.

endmenu
```

## drivers/charger/Kconfig
```kconfig
# Copyright 2023 Cirrus Logic, Inc.
#
# SPDX-License-Identifier: Apache-2.0

menuconfig CHARGER
	bool "Battery charger drivers"
	help
	  Enable battery charger driver configuration.

if CHARGER

module = CHARGER
module-str = charger
source "subsys/logging/Kconfig.template.log_config"

config CHARGER_INIT_PRIORITY
	int "Battery charger init priority"
	default 90
	help
	  Battery charger initialization priority.

config CHARGER_HAS_DISCHARGE_CURRENT_NOTIFICATIONS
	bool
	help
	  This symbol is y if the charger supports discharge
	  current notifications.

config CHARGER_HAS_SYSTEM_VOLTAGE_NOTIFICATIONS
	bool
	help
	  This symbol is y if the charger supports system
	  voltage notifications.

menu "Discharge current notifications"

config CHARGER_DISCHARGE_CURRENT_NOTIFICATIONS
	bool "Support discharge current notifications"
	depends on CHARGER_HAS_DISCHARGE_CURRENT_NOTIFICATIONS
	help
	  Enables support for discharge current notifications

endmenu

menu "System voltage notification"

config CHARGER_SYSTEM_VOLTAGE_NOTIFICATIONS
	bool "Support system voltage notifications"
	depends on CHARGER_HAS_SYSTEM_VOLTAGE_NOTIFICATIONS
	help
	  Enables support for system voltage notifications
endmenu

source "drivers/charger/Kconfig.sbs_charger"
source "drivers/charger/Kconfig.bq24190"
source "drivers/charger/Kconfig.bq25180"
source "drivers/charger/Kconfig.max20335"
source "drivers/charger/Kconfig.pf1550"

endif # CHARGER
```

## drivers/charger/Kconfig.adp5360
```kconfig
# Copyright (c) 2026 Analog Devices, Inc.
# SPDX-License-Identifier: Apache-2.0

config CHARGER_ADP5360
	bool "ADI ADP5360 battery charger driver"
	default y
	depends on DT_HAS_ADI_ADP5360_CHARGER_ENABLED
	select MFD
	help
	  Enable the ADI ADP5360 battery charger driver.

if CHARGER_ADP5360

config CHARGER_ADP5360_INIT_PRIORITY
	int "Charger ADP5360 Init Priority"
	default 89
	help
	  Init priority for the Analog Devices ADP5360 Charger Subsystem.

endif #CHARGER_ADP5360
```

## drivers/charger/Kconfig.axp2101
```kconfig
# Copyright (c) 2025 BayLibre SAS
# SPDX-License-Identifier: Apache-2.0

config CHARGER_AXP2101
	bool "X-Powers AXP2101 PMIC charger driver"
	default y
	depends on DT_HAS_X_POWERS_AXP2101_CHARGER_ENABLED
	depends on DT_HAS_X_POWERS_AXP2101_ENABLED
	select I2C
	select MFD
	help
	  Enable the AXP2101 PMIC charger driver
```

## drivers/charger/Kconfig.bq2407x
```kconfig
# Copyright (c) 2023 Bjarki Arge Andreasen
# SPDX-License-Identifier: Apache-2.0

config CHARGER_BQ2407X
	bool "TI BQ2407X charging chip"
	default y
	depends on DT_HAS_TI_BQ2407X_ENABLED
	depends on GPIO
```

## drivers/charger/Kconfig.bq24190
```kconfig
# Copyright 2023 Cirrus Logic, Inc.
# SPDX-License-Identifier: Apache-2.0

config CHARGER_BQ24190
	bool "BQ24190 Battery Charger"
	default y
	depends on DT_HAS_TI_BQ24190_ENABLED
	select I2C
	help
	  Enable I2C-based driver for the TI BQ24190 Battery Charger.
```

## drivers/charger/Kconfig.bq25180
```kconfig
# Copyright 2024 Google LLC
#
# SPDX-License-Identifier: Apache-2.0

config CHARGER_BQ25180
	bool "BQ25180 Battery Charger"
	default y
	depends on DT_HAS_TI_BQ25180_ENABLED
	select I2C
	help
	  Enable BQ25180 battery charger driver.
```

## drivers/charger/Kconfig.bq2518x
```kconfig
# Copyright 2024 Google LLC
#
# SPDX-License-Identifier: Apache-2.0

config CHARGER_BQ2518X
	bool "BQ2518x Battery Charger"
	default y
	depends on DT_HAS_TI_BQ25180_ENABLED || DT_HAS_TI_BQ25186_ENABLED || \
		DT_HAS_TI_BQ25188_ENABLED
	select I2C
	help
	  Enable BQ2518x battery charger driver.
```

## drivers/charger/Kconfig.bq2562x
```kconfig
# Copyright 2025 Linumiz
# SPDX-License-Identifier: Apache-2.0

config CHARGER_BQ2562X
	bool "BQ2562X Battery Charger"
	default y
	depends on DT_HAS_TI_BQ2562X_ENABLED
	select I2C
	help
	  Enable I2C-based driver for the TI BQ2562X Battery Charger.
```

## drivers/charger/Kconfig.bq25713
```kconfig
# Copyright 2025 Palta Tech, S.A
#
# SPDX-License-Identifier: Apache-2.0

config CHARGER_BQ25713
	bool "BQ25713 Battery Charger"
	default y
	depends on DT_HAS_TI_BQ25713_ENABLED
	select I2C
	help
	  Enable BQ25713 battery charger driver.
```

## drivers/charger/Kconfig.gpio
```kconfig
# Copyright 2026 Embeint Inc
#
# SPDX-License-Identifier: Apache-2.0

config CHARGER_GPIO
	bool "GPIO controlled battery charger"
	default y
	depends on DT_HAS_ZEPHYR_CHARGER_GPIO_ENABLED
	select GPIO
	help
	  Enable GPIO battery charger driver.
```

## drivers/charger/Kconfig.max20335
```kconfig
# Copyright 2023 Grinn
# SPDX-License-Identifier: Apache-2.0

config CHARGER_MAX20335
	bool "MAX20335 battery charger driver"
	default y
	depends on DT_HAS_MAXIM_MAX20335_CHARGER_ENABLED
	select GPIO
	select I2C
	select MFD
	help
	  Enable the MAX20335 battery charger driver.
```

## drivers/charger/Kconfig.npm10xx
```kconfig
# Copyright (c) 2026 Nordic Semiconductor
# SPDX-License-Identifier: Apache-2.0

config CHARGER_NPM10XX
	bool "nPM10xx battery charger driver"
	default y
	depends on DT_HAS_NORDIC_NPM10XX_CHARGER_ENABLED
	select I2C
	help
	  Enable the nPM10xx charger driver.
```

## drivers/charger/Kconfig.pca9422
```kconfig
# Copyright 2025 NXP
# SPDX-License-Identifier: Apache-2.0

config CHARGER_PCA9422
	bool "PCA9422 battery charger driver"
	default y
	depends on DT_HAS_NXP_PCA9422_CHARGER_ENABLED
	select I2C
	select MFD
	help
	  Enable the PCA9422 battery charger driver.
```

## drivers/charger/Kconfig.pf1550
```kconfig
# Copyright 2024 Arduino SA
# SPDX-License-Identifier: Apache-2.0

config CHARGER_PF1550
	bool "NXP PF1550 battery charger driver"
	default y
	depends on DT_HAS_NXP_PF1550_CHARGER_ENABLED
	select GPIO
	select I2C
	select MFD
	help
	  Enable the NXP PF1550 battery charger driver.
```

## drivers/charger/Kconfig.sbs_charger
```kconfig
# Copyright 2023 Cirrus Logic, Inc.
# SPDX-License-Identifier: Apache-2.0

config SBS_CHARGER
	bool "Smart Battery Charger"
	default y
	depends on DT_HAS_SBS_SBS_CHARGER_ENABLED
	select I2C
	help
	  Enable I2C-based/SMBus-based driver for a Smart Battery Charger.

config EMUL_SBS_CHARGER
	bool "Emulate an SBS 1.1 compliant smart battery charger"
	default y
	depends on EMUL
	depends on SBS_CHARGER
	help
	  It provides reading which follow a simple sequence, thus allowing
	  test code to check that things are working as expected.
```

## drivers/charger/Kconfig.sy6974b
```kconfig
# SPDX-FileCopyrightText: Copyright The Zephyr Project Contributors
# SPDX-License-Identifier: Apache-2.0

config CHARGER_SY6974B
	bool "Silergy SY6974B battery charger"
	default y
	depends on DT_HAS_SILERGY_SY6974B_ENABLED
	select I2C
	help
	  Enable the I2C driver for the Silergy SY6974B 3A single-cell
	  Li-Ion switching battery charger.
```

## drivers/clock_control/Kconfig
```kconfig
# Clock controller driver configuration options

# Copyright (c) 2015 Intel Corporation
# SPDX-License-Identifier: Apache-2.0

#
# Clock controller drivers
#
menuconfig CLOCK_CONTROL
	bool "Clock controller drivers"
	help
	  Enable support for hardware clock controller. Such hardware can
	  provide clock for other subsystem, and thus can be also used for
	  power efficiency by controlling their clock. Note that this has
	  nothing to do with RTC.

if CLOCK_CONTROL

config CLOCK_CONTROL_INIT_PRIORITY
	int "Clock control init priority"
	default KERNEL_INIT_PRIORITY_OBJECTS
	help
	  Clock control driver device initialization priority.

module = CLOCK_CONTROL
module-str = clock control
source "subsys/logging/Kconfig.template.log_config"

source "drivers/clock_control/Kconfig.*"

endif # CLOCK_CONTROL
```
