## drivers/flash/Kconfig.nand
```kconfig
# Copyright (c) 2025 Embeint Pty Ltd
#
# SPDX-License-Identifier: Apache-2.0

menuconfig SPI_NAND
	bool "SPI NAND Flash"
	default y
	depends on DT_HAS_JEDEC_SPI_NAND_ENABLED
	select FLASH_HAS_DRIVER_ENABLED
	select FLASH_HAS_EXPLICIT_ERASE
	select FLASH_HAS_PAGE_LAYOUT
	select FLASH_HAS_EX_OP
	select SPI
	select CRC

if SPI_NAND

config SPI_NAND_INIT_PRIORITY
	int "Init priority"
	default 80
	help
	  Device driver initialization priority. Device is connected to
	  SPI bus, it has to be initialized after SPI driver.

config SPI_NAND_BAD_BLOCK_CACHE
	bool "Bad block cache"
	depends on FLASH_EX_OP_ENABLED
	default y
	help
	  Enable bad block cache by keeping a bad block table in memory.
	  This will speed up bad block checking at the cost of slightly
	  increased memory usage.

endif # SPI_NAND

menuconfig MSPI_NAND
	bool "MSPI NAND Flash"
	default y
	depends on DT_HAS_JEDEC_MSPI_NAND_ENABLED
	select FLASH_HAS_DRIVER_ENABLED
	select FLASH_HAS_EXPLICIT_ERASE
	select FLASH_HAS_PAGE_LAYOUT
	select FLASH_HAS_EX_OP
	select MSPI
	select CRC

if MSPI_NAND

config MSPI_NAND_INIT_PRIORITY
	int "Init priority"
	default 80
	help
	  Device driver initialization priority. Device is connected to
	  MSPI bus, it has to be initialized after MSPI driver.

config MSPI_NAND_BAD_BLOCK_CACHE
	bool "Bad block cache"
	depends on FLASH_EX_OP_ENABLED
	default y
	help
	  Enable bad block cache by keeping a bad block table in memory.
	  This will speed up bad block checking at the cost of slightly
	  increased memory usage.

config MSPI_NAND_DMA_DATA_XFER
	bool "Use DMA for Flash MSPI NAND data transfers"
	depends on MSPI_DMA
	default y
	help
	  Transfer mode for cache read and program load MSPI transactions.
	  Since these transfer whole pages, it is generally recommended to use
	  MSPI_DMA to reduce CPU load and improve throughput. Will default to
	  MSPI_DMA if CONFIG_MSPI_DMA is enabled, otherwise it will default to
	  MSPI_PIO.

config MSPI_NAND_DMA_CONTROL_XFER
	bool "Use DMA for Flash MSPI NAND control transfers"
	depends on MSPI_DMA
	default n
	help
	  Transfer mode for feature register reads/writes and command MSPI
	  transactions. Since these are shorter transfers, it is generally
	  recommended to use MSPI_PIO (programmed I/O) due to there being less
	  overhead compared to setting up a DMA transfer.

endif # MSPI_NAND
```

## drivers/flash/Kconfig.npcm_nor
```kconfig
# NPCM SPI-NOR driver configuration options

# Copyright (c) 2024 Nuvoton Technology Corporation.
# SPDX-License-Identifier: Apache-2.0

config FLASH_NPCM_NOR
	bool "Nuvoton NPCM QSPI NOR Flash driver"
	default y
	depends on DT_HAS_NUVOTON_NPCM_NOR_ENABLED
	depends on FLASH_NPCM_FIU_QSPI
	select FLASH_HAS_DRIVER_ENABLED
	select FLASH_HAS_PAGE_LAYOUT
	select FLASH_HAS_EXPLICIT_ERASE
	select FLASH_JESD216
	select FLASH_HAS_EX_OP
	help
	  This option enables the SPI-NOR Flash driver for NPCM family of
	  processors.
```

## drivers/flash/Kconfig.nrf_mram
```kconfig
#
# Copyright (c) 2024 Nordic Semiconductor ASA
#
# SPDX-License-Identifier: Apache-2.0
#

config SOC_FLASH_NRF_MRAM
	bool "Nordic Semiconductor flash driver for MRAM"
	default y
	depends on DT_HAS_NORDIC_MRAM_ENABLED
	depends on HAS_NRFX
	select FLASH_HAS_DRIVER_ENABLED
	select FLASH_HAS_PAGE_LAYOUT
	select FLASH_HAS_NO_EXPLICIT_ERASE
	imply NRFS
	imply MRAM_LATENCY
	imply MPU_ALLOW_FLASH_WRITE if ARM_MPU
	help
	  Enables Nordic Semiconductor flash driver for MRAM in direct write mode.

	  Note that MRAM words are auto-erased when written to, but writing to a
	  pre-erased area is faster. Hence, the erase API is not required, but
	  it can be used to amortize write performance for some use cases.

if SOC_FLASH_NRF_MRAM

config NRF_MRAM_MAX_RETRIES
	int "Maximum number of retries for MRAM write/erase operations"
	default 20
	range 1 255
	help
	  This option sets the maximum number of retry attempts for MRAM
	  write and erase operations when verification fails. Each retry
	  attempts to rewrite or re-erase the data to ensure reliability.
	  Higher values increase reliability but may impact performance
	  in case of persistent failures.

config NRF_MRAM_CHECK_READY_BIT
	bool "Check MRAMC READY bit before write or erase operation"
	default y if MRAM_LATENCY && (SOC_SERIES_NRF54H || SOC_SERIES_NRF92)
	help
	  Before each MRAM word write or erase, and after it completes, wait
	  until the MRAMC of the addressed bank reports it is ready (READY).

config NRF_MRAM_CHECK_READYNEXT_BIT
	bool "Check MRAMC READYNEXT bit before write or erase operation."
	default y if NRF_MRAM_CHECK_READY_BIT
	help
	  After each MRAM word write or erase, wait until the MRAMC reports it
	  can accept the next write operation (READYNEXT).

config NRF_MRAM_READY_MAX_SPINS
	int "Maximum MRAMC READY/READYNEXT poll iterations"
	default 1000000
	range 1 2147483647
	depends on NRF_MRAM_CHECK_READY_BIT || NRF_MRAM_CHECK_READYNEXT_BIT
	help
	  Number of times the MRAMC READY/READYNEXT status is polled before
	  a write or erase gives up and fails with -ETIMEDOUT.

config NRF_MRAM_USE_MUTEX_HW
	bool "Use hardware mutexes to serialize MRAM access across CPU domains"
	default y if $(dt_compat_any_has_prop,$(DT_COMPAT_NORDIC_MRAM),nordic-mutexes)
	help
	  When enabled, the driver claims a per-bank hardware mutex around each
	  MRAM write and erase transaction, using the controller's
	  "nordic,mutexes" list and each bank's "nordic,mutex-index".

endif # SOC_FLASH_NRF_MRAM
```

## drivers/flash/Kconfig.rpi_pico
```kconfig
# Copyright (c) 2022 Yonatan Schachter
#
# SPDX-License-Identifier: Apache-2.0

config FLASH_RPI_PICO
	bool "Raspberry Pi Pico flash driver"
	default y
	depends on DT_HAS_RASPBERRYPI_PICO_FLASH_CONTROLLER_ENABLED
	select FLASH_HAS_DRIVER_ENABLED
	select FLASH_HAS_PAGE_LAYOUT
	select FLASH_HAS_EXPLICIT_ERASE
	select PICOSDK_USE_FLASH
	help
	  Enable Raspberry Pi Pico flash driver.

config FLASH_RPI_PICO_READ_UNTRANSLATED
	bool "Use untranslated window for flash reads"
	depends on FLASH_RPI_PICO
	depends on SOC_SERIES_RP2350
	help
	  Bypass XIP cache and address translation hardware when reading from flash.

config FLASH_RPI_PICO_LOCK_IRQS
	bool "Lock IRQs during write and erase"
	depends on FLASH_RPI_PICO
	default y if XIP
	help
	  Disable interrupts while the pico-sdk write and erase routines run. The
	  vector table and any handler in flash are unreachable during that window,
	  so this is required whenever the application executes from flash. A
	  RAM-linked application only needs it if an interrupt handler reads a
	  memory-mapped flash partition.
```

## drivers/flash/Kconfig.ti_mspm0
```kconfig
# Copyright (c) 2026 Linumiz
# SPDX-License-Identifier: Apache-2.0

config SOC_FLASH_TI_MSPM0
	bool "TI MSPM0 flash controller driver"
	default y
	depends on DT_HAS_TI_MSPM0_FLASH_CONTROLLER_ENABLED
	select FLASH_HAS_DRIVER_ENABLED
	select FLASH_HAS_EXPLICIT_ERASE
	select FLASH_HAS_PAGE_LAYOUT
	select MPU_ALLOW_FLASH_WRITE if ARM_MPU
	help
	  Enables the TI MSPM0 flash controller driver, for the MAIN region
	  of the flash banks.
```

## drivers/fpga/Kconfig.machxo2
```kconfig
# Copyright (c) 2026 FIRST RF
# SPDX-License-Identifier: Apache-2.0

config MACHXO2_FPGA
	bool "Lattice MachXO2 FPGA sysCONFIG SPI driver"
	default y
	depends on DT_HAS_LATTICE_MACHXO2_FPGA_ENABLED
	depends on SPI
	select CRC
	select GPIO
	help
	  Enable support for the Lattice MachXO2 CPLD/FPGA configured through the
	  sysCONFIG slave SPI port.
```

## drivers/fuel_gauge/bq35100/Kconfig
```kconfig
# Copyright (c) 2025 Orgatex GmbH
#
# SPDX-License-Identifier: Apache-2.0

config BQ35100
	bool "BQ35100 Fuel Gauge"
	default y
	depends on DT_HAS_TI_BQ35100_ENABLED
	select I2C
	help
	  Enable I2C-based driver for BQ35100 Fuel Gauge.

if BQ35100

config EMUL_BQ35100
	bool "Emulate a BQ35100 gas gauge"
	default y
	depends on EMUL
	help
	  It answers with a fixed set of readings, thus allowing test code to
	  check that things are working as expected.

config BQ35100_MAX_RETRIES
	int "Status change retries"
	default 20
	help
	  Set the maximum number of retries
	  (read/write) for specific registers

config BQ35100_RAW_DATA_SAMPLING
	int "Number of raw data samplings for calibration"
	default 10

config BQ35100_SERIES_CELL_COUNT
	int "Number of battery cells used"
	range 1  256
	default 1

config BQ35100_FLASH_WRITE_DELAY
	int "Flash write delay"
	default 100

config BQ35100_NEW_BATTERY_DELAY
	int "New battery delay"
	default 200

config BQ35100_CALIBRATION
	bool "BQ35100 calibration functions"
	default n

endif # BQ35100
```

## drivers/fuel_gauge/bq40z50/Kconfig
```kconfig
# Copyright (c) Qualcomm Technologies, Inc. and/or its subsidiaries.
#
# SPDX-License-Identifier: Apache-2.0

config BQ40Z50
	bool "BQ40Z50 Fuel Gauge"
	default y
	depends on DT_HAS_TI_BQ40Z50_ENABLED
	select I2C
	help
	  Enable I2C-based driver for BQ40Z50 Fuel Gauge.

config EMUL_BQ40Z50
	bool "Emulate a BQ40Z50 fuel gauge"
	default y
	depends on EMUL
	depends on BQ40Z50
	help
	  It provides readings which follow a simple sequence, thus allowing
	  test code to check that things are working as expected.

config BQ40Z50_SPLIT_READ_DELAY_US
	int "Forced delay between write and read ops"
	default 0
	depends on BQ40Z50
	help
	  Non-zero value splits the I2C burst read transaction into a register
	  address write and data read transactions separated by a minimum delay
	  interval specified in microseconds.  This feature may be required on
	  target that implement non-I2C compliant clock stretching.
```

## drivers/fuel_gauge/bq4xz50/Kconfig
```kconfig
# Copyright (c) Qualcomm Technologies, Inc. and/or its subsidiaries.
# Copyright (c) 2026 Open Device Partnership and Contributors
#
# SPDX-License-Identifier: Apache-2.0

config BQ4XZ50
	bool
	select I2C
	help
	  Implementation shared by the TI bq40z50 and bq41z50 fuel gauges. Selected by the
	  per-device options below rather than chosen directly.

config BQ40Z50
	bool "BQ40Z50 Fuel Gauge"
	default y
	depends on DT_HAS_TI_BQ40Z50_ENABLED
	select BQ4XZ50
	help
	  Enable I2C-based driver for BQ40Z50 Fuel Gauge.

config BQ41Z50
	bool "BQ41Z50 Fuel Gauge"
	default y
	depends on DT_HAS_TI_BQ41Z50_ENABLED
	select BQ4XZ50
	help
	  Enable I2C-based driver for BQ41Z50 Fuel Gauge.

config EMUL_BQ4XZ50
	bool "Emulate a bq4xz50 family fuel gauge"
	default y
	depends on EMUL
	depends on BQ4XZ50
	help
	  It provides readings which follow a simple sequence, thus allowing
	  test code to check that things are working as expected.
```

## drivers/fuel_gauge/hy4245/Kconfig
```kconfig
# Copyright (c) 2025, Linumiz GmbH
#
# SPDX-License-Identifier: Apache-2.0

config HY4245
	bool "HY4245 Fuel Gauge"
	default y
	depends on DT_HAS_HYCON_HY4245_ENABLED
	select I2C
	help
	  Enable I2C-based driver for HY4245 Fuel Gauge.

if HY4245

config HY4245_RESET_SETTLE_TIME_MS
	int "Settle time after a gauge reset in milliseconds"
	default 2000
	help
	  Time the driver waits after a reset triggered through
	  HY4245_FUEL_GAUGE_RESET or by leaving calibration mode before it
	  returns to the caller. The gauge does not deliver valid
	  measurements until it has restarted its algorithm.

endif # HY4245
```

## drivers/fuel_gauge/linux_fuel_gauge/Kconfig
```kconfig
# SPDX-FileCopyrightText: Copyright (c) 2026 Muhammad Waleed Badar
# SPDX-License-Identifier: Apache-2.0

config NATIVE_LINUX_FUEL_GAUGE
	bool "Native Linux fuel gauge"
	default y
	depends on DT_HAS_ZEPHYR_NATIVE_LINUX_FUEL_GAUGE_ENABLED
	depends on ARCH_POSIX
	select NATIVE_USE_NSI_ERRNO
	help
	  Enable a native_sim fuel gauge backed by a Linux sysfs
	  power_supply class.
```

## drivers/fuel_gauge/ltc2941/Kconfig
```kconfig
# Copyright (c) 2026 RAKwireless Technology Limited
# SPDX-License-Identifier: Apache-2.0

config FUEL_GAUGE_LTC2941
	depends on DT_HAS_ADI_LTC2941_ENABLED
	bool "LTC2941 Fuel Gauge"
	default y
	select I2C
	help
	  Enable the LTC2941 coulomb counter / fuel gauge driver from Analog
	  Devices.
```

## drivers/fuel_gauge/ltc3337/Kconfig
```kconfig
# Copyright (c) 2026 Federico Borgo
#
# SPDX-License-Identifier: Apache-2.0

config FUEL_GAUGE_LTC3337
	bool "LTC3337 fuel gauge"
	default y
	depends on DT_HAS_ADI_LTC3337_ENABLED
	select I2C
	help
	  Enable the driver for the Analog Devices LTC3337 primary battery
	  state of health monitor with coulomb counter.

config EMUL_LTC3337
	bool "Emulate an LTC3337 fuel gauge"
	default y
	depends on EMUL
	depends on FUEL_GAUGE_LTC3337
	help
	  Emulate the register interface of the LTC3337 so that the driver can
	  be tested without hardware.
```
