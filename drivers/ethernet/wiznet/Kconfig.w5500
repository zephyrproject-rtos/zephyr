## drivers/ethernet/wiznet/Kconfig.w5500
```kconfig
# W5500 Ethernet driver configuration options

# Copyright (c) 2020 Linumiz
# Author: Parthiban Nallathambi <parthiban@linumiz.com>
# SPDX-License-Identifier: Apache-2.0

config ETH_W5500
	bool "W5500 Ethernet Controller"
	default y
	depends on DT_HAS_WIZNET_W5500_ENABLED
	select ETH_WIZNET
	select ETH_WIZNET_CORE
	select SPI
	select GPIO if ($(dt_compat_any_has_prop,$(DT_COMPAT_WIZNET_W5500),reset-gpios) || \
			$(dt_compat_any_has_prop,$(DT_COMPAT_WIZNET_W5500),int-gpios))
	help
	  W5500 Stand-Alone Ethernet Controller
	  with SPI Interface
```

## drivers/ethernet/wiznet/Kconfig.w6100
```kconfig
# SPDX-FileCopyrightText: Copyright (c) 2020 Linumiz
# SPDX-FileCopyrightText: Copyright (c) 2026 Sayed Naser Moravej
#
# SPDX-License-Identifier: Apache-2.0

config ETH_W6100
	bool "W6100 Ethernet Controller"
	default y
	depends on DT_HAS_WIZNET_W6100_ENABLED
	select ETH_WIZNET
	select ETH_WIZNET_CORE
	select SPI
	select GPIO if ($(dt_compat_any_has_prop,$(DT_COMPAT_WIZNET_W6100),reset-gpios) || \
			$(dt_compat_any_has_prop,$(DT_COMPAT_WIZNET_W6100),int-gpios))
	help
	  W6100 Stand-Alone Ethernet Controller
	  with SPI Interface
```

## drivers/ethernet/wiznet/Kconfig.w6300
```kconfig
# W6300 Ethernet driver configuration options

# Copyright (c) 2025 WIZnet Co., Ltd.
# SPDX-License-Identifier: Apache-2.0

config ETH_W6300
	bool "W6300 Ethernet Controller"
	default y
	depends on DT_HAS_WIZNET_W6300_ENABLED
	select ETH_WIZNET
	select SPI
	select GPIO if ($(dt_compat_any_has_prop,$(DT_COMPAT_WIZNET_W6300),reset-gpios) || \
			$(dt_compat_any_has_prop,$(DT_COMPAT_WIZNET_W6300),int-gpios))
	help
	  W6300 Stand-Alone Ethernet Controller with SPI interface.
```

## drivers/flash/Kconfig.avalanche_mram
```kconfig
# Copyright (c) 2026 Space Cubics Inc.
# SPDX-License-Identifier: Apache-2.0

config FLASH_AVALANCHE_MRAM
	bool "Avalanche Technology serial MRAM"
	default y
	depends on DT_HAS_AVALANCHE_AS301G208_ENABLED || \
		DT_HAS_AVALANCHE_AS302G208_ENABLED || \
		DT_HAS_AVALANCHE_AS304G208_ENABLED || \
		DT_HAS_AVALANCHE_AS308G208_ENABLED || \
		DT_HAS_AVALANCHE_AS3064204_ENABLED || \
		DT_HAS_AVALANCHE_AS3128208_ENABLED
	select SPI
	select SPI_EXTENDED_MODES
	select FLASH_HAS_DRIVER_ENABLED
	select FLASH_HAS_DRIVER_FILL
	select FLASH_HAS_NO_EXPLICIT_ERASE
	select FLASH_HAS_PAGE_LAYOUT
	help
	  Enable the Flash API driver for supported Avalanche Technology serial
	  MRAM-based persistent SRAM devices: AS301G208, AS302G208, AS304G208,
	  AS308G208, AS3064204, and AS3128208. Single-SPI and QPI (4-4-4)
	  operation are supported.

	  AS301G208, AS302G208, AS304G208, AS308G208, and AS3128208 expose two
	  QSPI interfaces. Each devicetree instance exposes one interface's capacity.
	  Dual-parallel operation across both interfaces is not supported.

config FLASH_AVALANCHE_MRAM_TRANSFER_SIZE
	int "Maximum Avalanche MRAM command data length"
	default 256
	range 1 1024
	depends on FLASH_AVALANCHE_MRAM
	help
	  Maximum data length, in bytes, issued in one MRAM memory command.
	  Controllers without FIFO streaming require this limit to fit their FIFO
	  capacity.
	  QPI reads include five latency bytes up to 40 MHz and six above it.
	  The limit must also leave room for at least one data byte.
```

## drivers/flash/Kconfig.cc27xx
```kconfig
# Copyright (c) 2025 Texas Instruments Incorporated
# Copyright (c) 2024 BayLibre, SAS
#
# SPDX-License-Identifier: Apache-2.0

config SOC_FLASH_CC27XX
	bool "TI SimpleLink CC27XX flash controller driver"
	default y
	depends on DT_HAS_TI_CC27XX_FLASH_CONTROLLER_ENABLED
	select FLASH_HAS_PAGE_LAYOUT
	select FLASH_HAS_DRIVER_ENABLED
	select FLASH_HAS_EXPLICIT_ERASE
	select MPU_ALLOW_FLASH_WRITE if ARM_MPU
	help
	  Enables TI SimpleLink CC27XX flash controller driver.
```

## drivers/flash/Kconfig.cc35xx
```kconfig
# Copyright (c) 2025 Conclusive Engineering Sp. z o.o.
# SPDX-License-Identifier: Apache-2.0

config SOC_FLASH_CC35XX
	bool "TI SimpleLink CC35xx flash driver"
	default y
	depends on DT_HAS_TI_CC35XX_NV_FLASH_ENABLED
	select FLASH_HAS_PAGE_LAYOUT
	select FLASH_HAS_DRIVER_ENABLED
	select FLASH_HAS_EXPLICIT_ERASE
	select MPU_ALLOW_FLASH_WRITE if ARM_MPU
	help
	  Enables TI SimpleLink CC35xx flash driver.
```

## drivers/flash/Kconfig.esp32
```kconfig
# Copyright (c) 2020 Espressif Systems (Shanghai) Co., Ltd.
# SPDX-License-Identifier: Apache-2.0

config SOC_FLASH_ESP32
	bool "Espressif ESP32 flash driver"
	default y
	depends on DT_HAS_ESPRESSIF_ESP32_FLASH_CONTROLLER_ENABLED
	select FLASH_HAS_DRIVER_ENABLED
	select FLASH_HAS_PAGE_LAYOUT
	select FLASH_HAS_EXPLICIT_ERASE
	help
	  Enable ESP32 internal flash driver.

if SOC_FLASH_ESP32

config ESP_FLASH_ASYNC
	bool "Use asynchronous work thread to execute the flash access operations"
	depends on MULTITHREADING && !MCUBOOT
	help
	  Enabling this makes the flash access operations deferred to the work thread.
	  Meaning every flash read or write would be postponed and executed when available.

config ESP_FLASH_ASYNC_TIMEOUT
	int "Timeout in seconds while waiting for the request to be available"
	depends on ESP_FLASH_ASYNC
	default 10
	help
	  Timeout in seconds while waiting for the request.

config ESP_FLASH_ASYNC_WORK
	bool "Use dedicated work thread to perform the work tasks"
	depends on ESP_FLASH_ASYNC
	help
	  Use dedicated work thread to perform the workqueue tasks with flash asynchronous operations.

config ESP_FLASH_ASYNC_WORK_PRIORITY
	int "Thread priority for dedicated work thread"
	depends on ESP_FLASH_ASYNC_WORK
	default 5
	help
	  Define thread priority for a dedicated work thread processing workqueue.

config ESP_FLASH_ASYNC_WORK_STACK_SIZE
	int "Stack size for dedicated work thread"
	depends on ESP_FLASH_ASYNC_WORK
	default 1024
	help
	  Define stack size for a dedicated work thread processing workqueue.

config ESP_FLASH_ASYNC_IPM
	bool "Allow multiple CPUs to access system flash"
	depends on ESP_FLASH_ASYNC && IPM
	default y if IPM
	help
	  Enable support for multi processor flash access using ipm0.

config ESP_FLASH_REMOTE
	bool "Remote IPM flash driver"
	default y if (SOC_ESP32_APPCPU_TARGET || SOC_ESP32C6_LPCORE) && (IPM || MBOX)

config ESP_FLASH_HOST
	bool "Host functionality flash driver"
	default y if !ESP_FLASH_REMOTE

config ESP_FLASH_YIELD_DURING_ERASE
	bool "Yield to other threads during erase and write"
	default y
	help
	  Erase and write operations run with the flash cache disabled and,
	  on multi-core SoCs, with the other core parked. Split long
	  operations into windows and, once the cache has been disabled for
	  ESP_FLASH_ERASE_YIELD_DURATION_MS in total, sleep for
	  ESP_FLASH_ERASE_YIELD_MS with the cache enabled so other threads,
	  interrupt handlers and the other core get to run.

config ESP_FLASH_ERASE_YIELD_DURATION_MS
	int "Cache-off time before a yield, in milliseconds"
	depends on ESP_FLASH_YIELD_DURING_ERASE
	default 20
	help
	  Cumulative time the cache may stay disabled for erase and write
	  windows before the driver yields.

config ESP_FLASH_ERASE_YIELD_MS
	int "Yield duration, in milliseconds"
	depends on ESP_FLASH_YIELD_DURING_ERASE
	default 10
	help
	  How long the driver sleeps, with the cache enabled, each time it
	  yields.

config ESP_FLASH_WRITE_CHUNK_SIZE
	int "Write window size in bytes"
	range 256 8192
	default 8192
	help
	  A write is issued in windows of at most this size. The cache is
	  re-enabled between windows and the yield check runs before each.

endif # SOC_FLASH_ESP32
```

## drivers/flash/Kconfig.everspin_emxxlx
```kconfig
# Copyright (c) 2026 Space Cubics Inc.
# SPDX-License-Identifier: Apache-2.0

config FLASH_EVERSPIN_EMXXLX
	bool "Everspin EMxxLX serial MRAM"
	default y
	depends on DT_HAS_EVERSPIN_EM004LXQ_ENABLED || \
		DT_HAS_EVERSPIN_EM008LXQ_ENABLED || \
		DT_HAS_EVERSPIN_EM016LXQ_ENABLED || \
		DT_HAS_EVERSPIN_EM032LXQ_ENABLED || \
		DT_HAS_EVERSPIN_EM064LXQ_ENABLED
	select SPI
	select SPI_EXTENDED_MODES
	select FLASH_HAS_DRIVER_ENABLED
	select FLASH_HAS_DRIVER_FILL
	select FLASH_HAS_NO_EXPLICIT_ERASE
	select FLASH_HAS_PAGE_LAYOUT
	help
	  Flash API driver for Everspin EM004LXQ, EM008LXQ, EM016LXQ,
	  EM032LXQ, and EM064LXQ serial MRAM (512 KiB to 8 MiB). Supports
	  single SPI and Quad STR (4-4-4) without a data strobe. Only volatile
	  configuration is changed; manufacturing initialization and recovery
	  that erase memory, OTP or nonvolatile registers are not performed.

config FLASH_EVERSPIN_EMXXLX_TRANSFER_SIZE
	int "Maximum Everspin MRAM command data length"
	default 256
	range 9 1024
	depends on FLASH_EVERSPIN_EMXXLX
	help
	  Maximum data length in bytes, including eight dummy bytes for Quad
	  reads. Controllers without FIFO streaming require this limit to fit
	  their FIFO capacity.
```

## drivers/flash/Kconfig.htpa
```kconfig
# Copyright (c) 2026 sensryio
# SPDX-License-Identifier: Apache-2.0

config FLASH_HEIMANN_HTPA
	bool "HTPA family calibration flash driver"
	default y
	depends on DT_HAS_HEIMANN_HTPA_FLASH_ENABLED
	select SPI
	help
	  Read-only calibration flash driver for HTPA family chips.

config FLASH_HEIMANN_HTPA_INIT_PRIORITY
	int "HTPA flash initialization priority"
	depends on FLASH_HEIMANN_HTPA
	default 55
	help
	  Initialize the calibration flash after its SPI bus and before the
	  HTPA sensor.
```

## drivers/flash/Kconfig.infineon
```kconfig
# Infineon CAT1 Flash configuration options

# Copyright (c) 2023 Cypress Semiconductor Corporation (an Infineon company) or
# an affiliate of Cypress Semiconductor Corporation
#
# SPDX-License-Identifier: Apache-2.0

config FLASH_INFINEON_CAT1
	bool "Infineon CAT1 FLASH driver"
	default y
	depends on DT_HAS_INFINEON_FLASH_CONTROLLER_ENABLED
	depends on DT_HAS_FIXED_PARTITIONS_ENABLED || DT_HAS_ZEPHYR_MAPPED_PARTITION_ENABLED
	depends on USE_INFINEON_LEGACY_HAL
	select FLASH_HAS_PAGE_LAYOUT
	select FLASH_HAS_DRIVER_ENABLED
	select USE_INFINEON_FLASH
	select FLASH_HAS_EXPLICIT_ERASE
	help
	  Enable the Flash driver for Infineon CAT1 family.

config FLASH_INFINEON_RRAM
	bool "Infineon CAT1 FLASH RRAM driver"
	default y
	depends on DT_HAS_INFINEON_RRAM_CONTROLLER_ENABLED
	depends on SOC_FAMILY_INFINEON_EDGE
	select FLASH_HAS_PAGE_LAYOUT
	select FLASH_HAS_DRIVER_ENABLED
	select USE_INFINEON_FLASH_RRAM
	select FLASH_HAS_NO_EXPLICIT_ERASE
	help
	  Enable the Flash RRAM driver for Infineon Edge family.

config FLASH_INFINEON_PSOC4
	bool "Infineon FLASH driver"
	default y
	depends on DT_HAS_INFINEON_FLASH_CONTROLLER_ENABLED
	depends on DT_HAS_FIXED_PARTITIONS_ENABLED || DT_HAS_ZEPHYR_MAPPED_PARTITION_ENABLED
	depends on !USE_INFINEON_LEGACY_HAL
	select FLASH_HAS_DRIVER_ENABLED
	select FLASH_HAS_PAGE_LAYOUT
	select FLASH_HAS_NO_EXPLICIT_ERASE
	select USE_INFINEON_FLASH
	help
	  Enable the Flash driver for Infineon PSoC4 family.

config INFINEON_CAT1_QSPI_FLASH
	bool "Infineon CAT1 QSPI FLASH driver"
	default y
	depends on DT_HAS_INFINEON_QSPI_FLASH_ENABLED
	depends on DT_HAS_FIXED_PARTITIONS_ENABLED || DT_HAS_ZEPHYR_MAPPED_PARTITION_ENABLED
	select FLASH_HAS_PAGE_LAYOUT
	select FLASH_HAS_DRIVER_ENABLED
	select USE_INFINEON_FLASH
	select USE_INFINEON_SMIF
	select USE_INFINEON_DMA
	select PINCTRL
	select FLASH_HAS_EXPLICIT_ERASE
	help
	  Enable the QSPI Flash driver for Infineon CAT1 family.

config FLASH_INFINEON_SMIF
	bool "Infineon SMIF controller driver"
	default y
	depends on DT_HAS_INFINEON_SMIF_ENABLED
	depends on SOC_FAMILY_INFINEON_EDGE
	select USE_INFINEON_SMIF
	select PINCTRL
	help
	  Enable the Infineon SMIF (Serial Memory InterFace) controller driver.
	  The controller enumerates the external memory devices attached to a
	  SMIF instance through the vendor PDL and owns the shared PDL memory
	  context. Per-device Zephyr APIs are provided by separate child
	  drivers (for example FLASH_INFINEON_SMIF_NOR).

config FLASH_INFINEON_SMIF_CTRL_INIT_PRIORITY
	int "Infineon SMIF controller init priority"
	default 40
	depends on FLASH_INFINEON_SMIF
	help
	  Device initialization priority for the SMIF controller. Must be lower
	  (earlier) than the attached device drivers so the controller is
	  enumerated before any device driver uses it.

config FLASH_INFINEON_SMIF_NOR
	bool "Infineon SMIF NOR flash device driver"
	default y
	depends on DT_HAS_INFINEON_SMIF_NOR_ENABLED
	depends on FLASH_INFINEON_SMIF
	select FLASH_HAS_PAGE_LAYOUT
	select FLASH_HAS_DRIVER_ENABLED
	select FLASH_HAS_EXPLICIT_ERASE
	help
	  Enable the Zephyr flash driver for NOR flash devices attached to an
	  Infineon SMIF controller (infineon,smif-nor).

config FLASH_INFINEON_SMIF_NOR_INIT_PRIORITY
	int "Infineon SMIF NOR flash device init priority"
	default 41
	depends on FLASH_INFINEON_SMIF_NOR
	help
	  Device initialization priority for SMIF NOR flash devices. Must be
	  higher (later) than FLASH_INFINEON_SMIF_CTRL_INIT_PRIORITY.
```

## drivers/flash/Kconfig.machxo2_ufm
```kconfig
# Copyright (c) 2026 FIRST RF
# SPDX-License-Identifier: Apache-2.0

config FLASH_MACHXO2_UFM
	bool "Lattice MachXO2 UFM flash driver"
	default y
	depends on FLASH
	depends on FPGA
	depends on DT_HAS_LATTICE_MACHXO2_UFM_ENABLED
	depends on DT_HAS_LATTICE_MACHXO2_FPGA_ENABLED
	select FLASH_HAS_DRIVER_ENABLED
	select FLASH_HAS_PAGE_LAYOUT
	select FLASH_HAS_EXPLICIT_ERASE
	select MACHXO2_FPGA
	select SPI
	help
	  Enable support for the Lattice MachXO2 user flash memory (UFM). The
	  UFM is accessed through the sysCONFIG transport of the MachXO2 FPGA
	  driver.

config MACHXO2_UFM_INIT_PRIORITY
	int "MachXO2 UFM flash driver init priority"
	default 76
	range 0 999
	depends on FLASH_MACHXO2_UFM
	help
	  Initialization priority for the MachXO2 UFM flash driver. It must run
	  after the parent MachXO2 FPGA driver has initialized the transport.
```
