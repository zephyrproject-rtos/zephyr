## drivers/ethernet/dwc_mac/Kconfig
```kconfig
# Synopsys DesignWare MAC configuration options

# Copyright (c) 2021 BayLibre SAS
# SPDX-License-Identifier: Apache-2.0

menu "Synopsys DesignWare MAC driver"

DT_CHOSEN_Z_DTCM := zephyr,dtcm

config ETH_DWC_ETHER_QOS_CORE
	bool
	depends on NET_BUF_FIXED_DATA_SIZE
	select CACHE_MANAGEMENT if DCACHE
	help
	  This is a driver for the Synopsys DesignWare Ethernet MAC 10/100/1G Quality-of-Service,
	  also referred to as "dwc_ether_qos".
	  IP versions v4.x and v5.x are supported.

config ETH_DWC_ETHER_1000_CORE
	bool
	depends on NET_BUF_FIXED_DATA_SIZE
	select CACHE_MANAGEMENT if DCACHE
	help
	  This is a driver for the Synopsys DesignWare Ethernet MAC 10/100/1G Universal,
	  also referred to as "dwc_ether_mac10_100_1000_universal".
	  IP version v3.x is supported.

config ETH_STM32_DWC_ETHER_QOS
	bool "Driver for DWC Ethernet QoS-based STM32"
	depends on !ETH_STM32_HAL
	depends on SOC_SERIES_STM32H5X \
		   || SOC_SERIES_STM32H7X \
		   || SOC_SERIES_STM32H7RSX
	depends on DT_HAS_ST_STM32_ETHERNET_ENABLED
	select ETH_DWC_ETHER_QOS_CORE
	select NOCACHE_MEMORY if ARCH_HAS_NOCACHE_MEMORY_SUPPORT
	select PINCTRL
	select HWINFO
	select CRC
	default y
	help
	  This enables the Synopsys DesignWare MAC driver on STM32 H5/H7/H7RS
	  series SoCs.

config ETH_STM32_DWC_ETHER_1000
	bool "Driver for DWC Ethernet MAC-based STM32"
	depends on !ETH_STM32_HAL
	depends on SOC_SERIES_STM32F7X || \
		   SOC_SERIES_STM32F4X || \
		   SOC_SERIES_STM32F2X || \
		   SOC_SERIES_STM32F1X
	depends on DT_HAS_ST_STM32_ETHERNET_ENABLED
	select ETH_DWC_ETHER_1000_CORE
	select NOCACHE_MEMORY if ARCH_HAS_NOCACHE_MEMORY_SUPPORT \
				 && !$(dt_chosen_enabled,$(DT_CHOSEN_Z_DTCM))
	select PINCTRL
	select HWINFO
	select CRC
	default y
	help
	  This enables the Synopsys DesignWare MAC driver for STM32 SoCs.
	  Applicable for STM32F1/F2/F4/F7 series; tested only on F2/F4/F7.

config ETH_DWMAC_MMU
	bool "Synopsys DesignWare MAC driver for MMU based platforms"
	depends on MMU
	depends on DT_HAS_SNPS_DESIGNWARE_ETHERNET_ENABLED
	select ETH_DWC_ETHER_QOS_CORE
	default y
	help
	  This enables the Synopsys DesignWare MAC driver on MMU based
	  platforms.

if ETH_DWC_ETHER_QOS_CORE || ETH_DWC_ETHER_1000_CORE

configdefault NET_BUF_ALIGNMENT
	default DCACHE_LINE_SIZE if DCACHE

config DWMAC_NB_TX_DESCS
	int "Number of entries in the transmit descriptor ring"
	default 16
	range 4 128
	help
	  A higher number allows for more packets to be queued which may
	  improve throughput, but that requires more transient memory.
	  However there must be enough descriptors to hold all fragments
	  of a full-size packet to be transmitted or the packet will be
	  dropped.

	  Fragment size is influenced by CONFIG_NET_BUF_DATA_SIZE.

config DWMAC_NB_RX_DESCS
	int "Number of entries in the receive descriptor ring"
	default 16
	range 4 128
	help
	  Received packets are spread across the required number of fragment
	  buffers. Each RX fragment has a size of CONFIG_NET_BUF_DATA_SIZE.
	  There is one descriptor entry per fragment.

	  A higher number allows for more packets to be received without
	  immediate intervention from the CPU but requires more transient
	  memory. A smaller number increases the risk of an overflow and
	  dropped packets.

config ETH_DWMAC_RX_REFILL_THREAD_PRIORITY
	int "Receive buffer refill thread priority"
	default 0
	help
	  Priority level of the internal thread which is used to refill
	  the receive buffer pool.

endif # ETH_DWC_ETHER_QOS_CORE || ETH_DWC_ETHER_1000_CORE

endmenu
```

## drivers/ethernet/dwc_xgmac/Kconfig
```kconfig
#
# Synopsys DesignWare XGMAC configuration options
#
# Copyright(c) 2024, Intel Corporation
# SPDX-License-Identifier: Apache-2.0
#

DT_COMPAT_DWC_XGMAC := snps,dwcxgmac

menu "DWC XGMAC configuration"

config ETH_DWC_XGMAC
	bool "Synopsys DesignWareCore XGMAC Ethernet driver"
	default y
	depends on DT_HAS_SNPS_DWCXGMAC_ENABLED
	help
	  This is a driver for the Synopsys DesignWare XGMAC, also referred to
	  as "DesignWare Cores Ethernet XGMAC". Hardware versions
	  3.x are supported.

	  Platform specific glue support is also required. This driver is
	  currently available on targets using the Intel Agilex5 series.

if  ETH_DWC_XGMAC

config ETH_DWC_XGMAC_BOTTOM_HALF_WORK_QUEUE
	bool "IRQ Bottom Half work Queue"
	default y

config ETH_DWC_XGMAC_SW_RESET_TIMEOUT
	int "A timeout value in us to check software reset status"
	default 1000
	help
	  A timeout value in ms to check software reset status

config ETH_DWC_XGMAC_POLLING_MODE
	bool "Polling mode"

config ETH_DWC_XGMAC_INTERRUPT_POLLING_INTERVAL_US
	int "XGMAC interrupt polling interval in us"
	default 500
	depends on ETH_DWC_XGMAC_POLLING_MODE
	help
	  XGMAC interrupt polling interval in us

config ETH_XGMAC_MAX_QUEUES
	int
	default 8
	help
	  Number hardware queues supported by the XGMAC IP

config ETH_DWC_XGMAC_RX_CS_OFFLOAD
	bool "RX checksum offload"
	default y
	help
	  Enable receive checksum offload for TCP/UDP/IP packets

config ETH_DWC_XGMAC_TX_CS_OFFLOAD
	bool "TX checksum offload"
	default y
	help
	  Enable transmit checksum offload for TCP/UDP/IP packets

config ETH_DWC_XGMAC_PROMISCUOUS_EXCEPTION
	bool "Promiscuous mode"
	depends on NET_PROMISCUOUS_MODE
	help
	  Disables the promiscuous mode support in XGMAC device.

config ETH_DWC_XGMAC_HW_FILTERING
	bool "H/W L2 Filtering"
	help
	  Enable Hardware support for L2 filtering of packets.

config ETH_DWC_XGMAC_HW_L3_L4_FILTERING
	bool "H/W L3 L4 Filtering"
	help
	  Enable Hardware support for L3 L4 filtering of packets.

config ETH_DWC_XGMAC_ARP_OFFLOAD
	bool "ARP Offload"
	help
	  Enable ARP hardware offloading support.

endif # ETH_DWC_XGMAC

endmenu
```

## drivers/ethernet/eth_nxp_enet_qos/Kconfig
```kconfig
# Copyright 2024
# SPDX-License-Identifier: Apache-2.0

menuconfig ETH_NXP_ENET_QOS
	bool "NXP ENET QOS Ethernet Module Driver"
	default y
	depends on DT_HAS_NXP_ENET_QOS_ENABLED
	select PINCTRL
	select MDIO if DT_HAS_NXP_ENET_QOS_MDIO_ENABLED
	help
	  Enable NXP ENET Ethernet Module Driver. This driver
	  handles IP module level tasks.

if ETH_NXP_ENET_QOS

config ETH_NXP_ENET_QOS_MAC
	bool "NXP ENET QOS Ethernet MAC Driver"
	default y
	depends on DT_HAS_NXP_ENET_QOS_MAC_ENABLED
	depends on NET_BUF_FIXED_DATA_SIZE
	help
	  Enable NXP ENET QOS Ethernet MAC Driver.

if ETH_NXP_ENET_QOS_MAC

DT_PROP_NXP_ENET_QOS_MAC_UNIQUE_MAC := nxp,unique-mac

config ETH_NXP_ENET_QOS_MAC_UNIQUE_MAC_ADDRESS
	bool "Unique MAC address support"
	default y if $(dt_compat_any_has_prop,$(DT_COMPAT_NXP_ENET_QOS_MAC),$(DT_PROP_NXP_ENET_QOS_MAC_UNIQUE_MAC),True)
	select HWINFO
	select CRC
	help
	  Enable Unique MAC address support based on device UUID.


config ETH_NXP_ENET_QOS_TX_BUFFER_DESCRIPTORS
	int "Number of tx buffer descriptors"
	default 4
	range 4 1024
	help
	  Number of TX buffer descriptors.

config ETH_NXP_ENET_QOS_RX_BUFFER_DESCRIPTORS
	int "Number of rx buffer descriptors"
	default 4
	range 4 1024
	help
	  Number of RX buffer descriptors.

config ETH_NXP_ENET_QOS_DMA_RESET_WAIT_TIME
	int "Time in microseconds to wait for software reset"
	default 10
	range 0 1000
	help
	  Time in us microseconds allow for software reset.
	  Value of 0 will allow the driver to wait unlimited time.

config ETH_NXP_ENET_QOS_RX_THREAD_STACK_SIZE
	int "Size of ENET QOS RX thread stack"
	default 1024
	help
	  Size in bytes of the ENET QOS RX thread stack.

config ETH_NXP_ENET_QOS_RX_THREAD_PRIORITY
	int "Cooperative priority of the ENET QOS RX thread"
	default 3
	help
	  Cooperative priority of the ENET QOS RX thread

endif # ETH_NXP_ENET_QOS_MAC
endif # ETH_NXP_ENET_QOS
```

## drivers/ethernet/intel/Kconfig
```kconfig
# Copyright (c) 2025 Intel Corporation
# SPDX-License-Identifier: Apache-2.0

config ETH_INTEL_PLAT
	bool "Intel Ethernet parent Platform device driver"
	depends on DT_HAS_INTEL_ETH_PLAT_ENABLED
	help
	  Enable Platform driver to retrieve the MMIO mapping details and
	  share them with all the child devices such as MDIO, PHY, MAC
	  and PTP_CLOCK.
source "drivers/ethernet/intel/Kconfig.intel_igc"
```

## drivers/ethernet/intel/Kconfig.intel_igc
```kconfig
# Copyright (c) 2025 Intel Corporation
# SPDX-License-Identifier: Apache-2.0

menuconfig ETH_INTEL_IGC
	bool "Intel IGC MAC driver"
	default y
	depends on DT_HAS_INTEL_IGC_MAC_ENABLED
	select PCIE_MSI_MULTI_VECTOR
	select PCIE_MSI_X
	help
	  Ethernet device driver for Intel i226 MAC.

if ETH_INTEL_IGC

config ETH_INTEL_IGC_INT_PRIORITY
	int "Interrupt priority"
	default 6
	help
	  MSI-X vectors priority for IGC interrupts.

config ETH_INTEL_IGC_NET_MTU
	int "MTU size"
	default 1500
	range 64 1522
	help
	  Maximum Transmission Unit (MTU) size configuration.

endif # ETH_INTEL_IGC
```

## drivers/ethernet/mdio/Kconfig
```kconfig
# MDIO configuration options

# Copyright (c) 2021 IP-Logix Inc.
# SPDX-License-Identifier: Apache-2.0

#
# MDIO options
#
menuconfig MDIO
	bool "Management Data Input/Output (MDIO) drivers"
	help
	  Enable MDIO Driver Configuration

if MDIO

config MDIO_SHELL
	bool "MDIO Shell"
	depends on SHELL
	help
	  Enable MDIO Shell.

	  The MDIO shell currently supports scanning and device
	  read/write.

# Include these first so that any properties (e.g. defaults) below can be
# overridden (by defining symbols in multiple locations)
# zephyr-keep-sorted-start
rsource "Kconfig.adin2111"
rsource "Kconfig.dwcxgmac"
rsource "Kconfig.esp32"
rsource "Kconfig.gpio"
rsource "Kconfig.intel_igc"
rsource "Kconfig.lan865x"
rsource "Kconfig.litex"
rsource "Kconfig.nxp_enet"
rsource "Kconfig.nxp_enet_qos"
rsource "Kconfig.nxp_imx_netc"
rsource "Kconfig.nxp_s32_gmac"
rsource "Kconfig.nxp_s32_netc"
rsource "Kconfig.renesas_ra"
rsource "Kconfig.sam"
rsource "Kconfig.stm32_hal"
rsource "Kconfig.sy1xx"
rsource "Kconfig.xilinx_axi_ethernet_lite"
rsource "Kconfig.xilinx_axienet"
rsource "Kconfig.xmc4xxx"
# zephyr-keep-sorted-stop

config MDIO_INIT_PRIORITY
	int "Init priority"
	default 60
	help
	  MDIO device driver initialization priority.


module = MDIO
module-str = mdio
source "subsys/logging/Kconfig.template.log_config"

endif # MDIO
```

## drivers/ethernet/mdio/Kconfig.adin1140
```kconfig
# Copyright (c) 2024-2026 Analog Devices, Inc.
# SPDX-License-Identifier: Apache-2.0

config MDIO_ADIN1140
	bool "ADIN1140 MDIO driver"
	default y
	depends on DT_HAS_ADI_ADIN1140_MDIO_ENABLED
	depends on ETH_ADIN1140
	help
	  Enable ADIN1140 MDIO driver.
```

## drivers/ethernet/mdio/Kconfig.adin2111
```kconfig
# Copyright 2023 PHOENIX CONTACT Electronics GmbH
# SPDX-License-Identifier: Apache-2.0

config MDIO_ADIN2111
	bool "ADIN2111 MDIO driver"
	default y
	depends on DT_HAS_ADI_ADIN2111_MDIO_ENABLED
	depends on ETH_ADIN2111
	help
	  Enable ADIN2111 MDIO driver.
```

## drivers/ethernet/mdio/Kconfig.bcmgenet
```kconfig
# Copyright (c) 2026 Muhammad Waleed Badar
# SPDX-License-Identifier: Apache-2.0

config MDIO_BCMGENET
	bool "Broadcom GENET MDIO driver"
	default y
	depends on DT_HAS_BRCM_GENET_MDIO_ENABLED
	depends on ETH_BCMGENET
	help
	  Enable Broadcom GENET MDIO driver.
```

## drivers/ethernet/mdio/Kconfig.dwcxgmac
```kconfig
# Copyright (c) 2023 Intel Corporation
# SPDX-License-Identifier: Apache-2.0

config MDIO_DWCXGMAC
	bool "synopsys mdio driver"
	depends on ETH_DWC_XGMAC
	default y
	help
	  Enable Synopsys dwc xgmac MDIO driver.

if  MDIO_DWCXGMAC

config MDIO_DWCXGMAC_STATUS_BUSY_CHECK_TIMEOUT
	int "A timeout value in us to check software reset status"
	default 10000
	help
	  This option specifies the timeout value in microseconds (us) for checking
	  the software reset status during the MDIo initialization.

endif
```

## drivers/ethernet/mdio/Kconfig.dwmac
```kconfig
# SPDX-FileCopyrightText: Copyright The Zephyr Project Contributors
# SPDX-License-Identifier: Apache-2.0

config MDIO_DWMAC
	bool "Synopsys DesignWare MAC MDIO driver"
	default y
	depends on DT_HAS_SNPS_DWMAC_MDIO_ENABLED
	depends on ETH_DWMAC
	select PINCTRL if $(dt_compat_any_has_prop,$(DT_COMPAT_SNPS_DWMAC_MDIO),pinctrl-0)
	help
	  Enable MDIO support for Synopsys DesignWare MAC devices that expose
	  an MDIO controller as a child node of the MAC.

if MDIO_DWMAC

config MDIO_DWMAC_BUSY_CHECK_TIMEOUT
	int "MDIO busy-wait timeout (us)"
	default 10000
	help
	  Timeout used while waiting for MDIO transactions to complete.

endif
```

## drivers/ethernet/mdio/Kconfig.lan78xx
```kconfig
# Copyright (c) 2026 Narek Aydinyan
# SPDX-License-Identifier: Apache-2.0

config MDIO_LAN78XX
	bool "Microchip LAN78xx MDIO Driver"
	default y
	depends on ETH_LAN78XX
	depends on DT_HAS_MICROCHIP_LAN78XX_MDIO_ENABLED
	help
	  Enable support for LAN78xx-backed MDIO controllers.
```

## drivers/ethernet/mdio/Kconfig.litex
```kconfig
# Copyright (c) 2024 Vogl Electronic GmbH
# SPDX-License-Identifier: Apache-2.0

config MDIO_LITEX_LITEETH
	bool "Litex LiteEth MDIO controller driver"
	default y
	depends on DT_HAS_LITEX_LITEETH_MDIO_ENABLED
	help
	  Enable MDIO support from Litex LiteEth controller.
```
