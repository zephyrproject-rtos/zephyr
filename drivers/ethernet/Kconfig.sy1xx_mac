## drivers/ethernet/Kconfig.sy1xx_mac
```kconfig
# Copyright (c) 2025 sensry.io
# SPDX-License-Identifier: Apache-2.0

config ETH_SY1XX
	bool "Sensry SY1XX Ethernet driver"
	default y
	depends on DT_HAS_SENSRY_SY1XX_MAC_ENABLED
	select PINCTRL
	help
	  Enable Sensry SY1XX Ethernet MAC driver.
```

## drivers/ethernet/Kconfig.test
```kconfig
# Copyright (c) 2024 TOKITA Hiroshi
# SPDX-License-Identifier: Apache-2.0

config ETH_TEST
	def_bool DT_HAS_VND_ETHERNET_ENABLED
	depends on DT_HAS_VND_ETHERNET_ENABLED
```

## drivers/ethernet/Kconfig.ti_am62l_cpsw
```kconfig
# TI AM62L CPSW Ethernet driver configuration

# Copyright (c) 2026 Texas Instruments Incorporated
# SPDX-License-Identifier: Apache-2.0

menuconfig ETH_TI_AM62L_CPSW
	bool "TI AM62L CPSW Ethernet Driver"
	default y
	depends on DT_HAS_TI_AM62L_CPSW_ENABLED
	select DYNAMIC_INTERRUPTS
	select DMA
	imply NVMEM if $(dt_compat_any_has_prop,$(DT_COMPAT_TI_AM62L_CPSW),nvmem-cells)
	help
	  Enable TI AM62L CPSW (Common Platform Ethernet Switch) driver.
	  Uses the TI AM62L PKTDMA driver for DMA-based packet transmission
	  and reception. Requires the MDIO subsystem for PHY management via
	  the CPSW MDIO controller if Ethernet PHY(s) is(are) used with CPSW
	  MAC Ports.

if ETH_TI_AM62L_CPSW

config ETH_TI_AM62L_CPSW_TX_DESC_NUM
	int "TX descriptor count"
	default 128
	help
	  Number of TX descriptors

config ETH_TI_AM62L_CPSW_RX_DESC_NUM
	int "RX descriptor count"
	default 128
	help
	  Number of RX descriptors

config ETH_TI_AM62L_CPSW_TX_THREAD_STACK_SIZE
	int "TX completion thread stack size"
	default 2048
	help
	  TX completion thread stack size

config ETH_TI_AM62L_CPSW_RX_THREAD_STACK_SIZE
	int "RX thread stack size"
	default 2048
	help
	  RX thread stack size

config ETH_TI_AM62L_TX_THREAD_PRIO
	int "TX completion thread priority"
	default 2
	help
	  TX completion thread priority

config ETH_TI_AM62L_RX_THREAD_PRIO
	int "RX thread priority"
	default 2
	help
	  RX thread priority

config ETH_TI_AM62L_CPSW_TX_BUDGET
	int "TX completion budget"
	default 64
	help
	  Number of TX completions processed before yielding

config ETH_TI_AM62L_CPSW_RX_BUDGET
	int "RX budget"
	default 64
	help
	  Number of packets received before yielding

config ETH_TI_AM62L_CPSW_TX_DESC_ACQUIRE_TIMEOUT
	int "TX descriptior acquire timeout"
	default 100
	help
	  Timeout in milliseconds for acquiring a TX descriptor

endif #ETH_TI_AM62L_CPSW
```

## drivers/ethernet/Kconfig.tsn_nic
```kconfig
# Copyright (c) 2024 Junho Lee <junho@tsnlab.com>
# SPDX-License-Identifier: Apache-2.0

config ETH_TSN_NIC
	bool "TSN NIC Ethernet Driver"
	default y
	depends on DT_HAS_TSNLAB_TSN_NIC_ETH_ENABLED
	help
	  Enable Ethernet driver for TSN NIC.
```

## drivers/ethernet/Kconfig.w5100s
```kconfig
# W5100S Ethernet driver configuration options

# Copyright (c) 2026 RAKwireless Technology Limited
# SPDX-License-Identifier: Apache-2.0

menuconfig ETH_W5100S
	bool "W5100S Ethernet Controller"
	default y
	depends on DT_HAS_WIZNET_W5100S_ENABLED
	select SPI
	help
	  W5100S Stand-Alone Ethernet Controller
	  with SPI Interface

config ETH_W5100S_RX_THREAD_STACK_SIZE
	int "Stack size for internal incoming packet handler"
	depends on ETH_W5100S
	default 1024
	help
	  Size of the stack used for internal thread which is ran for
	  incoming packet processing.

config ETH_W5100S_RX_THREAD_PRIO
	int "Priority for internal incoming packet handler"
	depends on ETH_W5100S
	default 2
	help
	  Priority level for internal thread which is ran for incoming
	  packet processing.

config ETH_W5100S_TIMEOUT
	int "IP buffer timeout"
	depends on ETH_W5100S
	default 100
	help
	  Given timeout in milliseconds. Maximum amount of time
	  that the driver will wait from the IP stack to get
	  a memory buffer before the Ethernet frame is dropped.

config ETH_W5100S_MONITOR_PERIOD
	int "Monitor task execution period"
	depends on ETH_W5100S
	default 500
	help
	  Monitor task execution period in milliseconds. The monitor task is
	  periodically executed to detect and report any changes in the
	  link status to the operating system.

config ETH_W5100S_POLL_PERIOD
	int "W5100S polling period in milliseconds"
	depends on ETH_W5100S
	default 10
	help
	  Polling interval in milliseconds for RX data and link status
	  when operating in polling mode (no int-gpios defined in
	  devicetree).
```

## drivers/ethernet/Kconfig.w5500
```kconfig
# W5500 Ethernet driver configuration options

# Copyright (c) 2020 Linumiz
# Author: Parthiban Nallathambi <parthiban@linumiz.com>
# SPDX-License-Identifier: Apache-2.0

menuconfig ETH_W5500
	bool "W5500 Ethernet Controller"
	default y
	depends on DT_HAS_WIZNET_W5500_ENABLED
	select SPI
	help
	  W5500 Stand-Alone Ethernet Controller
	  with SPI Interface

config ETH_W5500_RX_THREAD_STACK_SIZE
	int "Stack size for internal incoming packet handler"
	depends on ETH_W5500
	default 800
	help
	  Size of the stack used for internal thread which is ran for
	  incoming packet processing.

config ETH_W5500_RX_THREAD_PRIO
	int "Priority for internal incoming packet handler"
	depends on ETH_W5500
	default 2
	help
	  Priority level for internal thread which is ran for incoming
	  packet processing.

config ETH_W5500_TIMEOUT
	int "IP buffer timeout"
	depends on ETH_W5500
	default 100
	help
	  Given timeout in milliseconds. Maximum amount of time
	  that the driver will wait from the IP stack to get
	  a memory buffer before the Ethernet frame is dropped.
```

## drivers/ethernet/Kconfig.w6100
```kconfig
# SPDX-FileCopyrightText: Copyright (c) 2020 Linumiz
# SPDX-FileCopyrightText: Copyright (c) 2026 Sayed Naser Moravej
#
# SPDX-License-Identifier: Apache-2.0

menuconfig ETH_W6100
	bool "W6100 Ethernet Controller"
	default y
	depends on DT_HAS_WIZNET_W6100_ENABLED
	select SPI
	help
	  W6100 Stand-Alone Ethernet Controller
	  with SPI Interface

config ETH_W6100_RX_THREAD_STACK_SIZE
	int "Stack size for internal incoming packet handler"
	depends on ETH_W6100
	default 800
	help
	  Size of the stack used for internal thread which is ran for
	  incoming packet processing.

config ETH_W6100_RX_THREAD_PRIO
	int "Priority for internal incoming packet handler"
	depends on ETH_W6100
	default 2
	help
	  Priority level for internal thread which is ran for incoming
	  packet processing.

config ETH_W6100_TIMEOUT
	int "IP buffer timeout"
	depends on ETH_W6100
	default 100
	help
	  Given timeout in milliseconds. Maximum amount of time
	  that the driver will wait from the IP stack to get
	  a memory buffer before the Ethernet frame is dropped.

config ETH_W6100_MONITOR_PERIOD
	int "Monitor task execution period"
	depends on ETH_W6100
	default 500
	help
	  Monitor task execution period in milliseconds. The monitor task is
	  periodically executed to detect and report any changes in the
	  link status to the operating system.
```

## drivers/ethernet/Kconfig.w6300
```kconfig
# W6300 Ethernet driver configuration options

# Copyright (c) 2025 WIZnet Co., Ltd.
# SPDX-License-Identifier: Apache-2.0

menuconfig ETH_W6300
	bool "W6300 Ethernet Controller"
	default y
	depends on DT_HAS_WIZNET_W6300_ENABLED
	select SPI
	select GPIO
	help
	  W6300 Stand-Alone Ethernet Controller with SPI interface.

if ETH_W6300

config ETH_W6300_RX_THREAD_STACK_SIZE
	int "Stack size for internal incoming packet handler"
	default 1024
	help
	  Size of the stack used for internal thread which is ran for
	  incoming packet processing.

config ETH_W6300_RX_THREAD_PRIO
	int "Priority for internal incoming packet handler"
	default 2
	help
	  Priority level for internal thread which is ran for incoming
	  packet processing.

config ETH_W6300_TIMEOUT
	int "IP buffer timeout"
	default 100
	help
	  Given timeout in milliseconds. Maximum amount of time
	  that the driver will wait from the IP stack to get
	  a memory buffer before the Ethernet frame is dropped.

config ETH_W6300_MONITOR_PERIOD
	int "Monitor task execution period"
	default 500
	help
	  Monitor task execution period in milliseconds. The monitor task is
	  periodically executed to detect and report any changes in the
	  link status to the operating system.

endif # ETH_W6300
```

## drivers/ethernet/Kconfig.wch
```kconfig
# Copyright (c) 2025 James Bennion-Pedley <james@bojit.org>
# SPDX-License-Identifier: Apache-2.0

menuconfig ETH_WCH
	bool "WCH Ethernet driver"
	default y
	depends on DT_HAS_WCH_ETHERNET_ENABLED
	help
	  Enable WCH Ethernet driver. It is available for
	  all the CH32V307 and CH32V317 MCUs

if ETH_WCH

config ETH_WCH_HAL_RX_THREAD_STACK_SIZE
	int "RX thread stack size"
	default 1500
	help
	  RX thread stack size

config ETH_WCH_HAL_RX_THREAD_PRIO
	int "WCH Ethernet RX Thread Priority"
	default 2
	help
	  This option allows to configure the priority of the RX thread that
	  handles incoming Ethernet packets.
	  Switching between preemptive and cooperative scheduling can be done by
	  NET_TC_THREAD_PREEMPTIVE.
	  Preemptive scheduling can lead to more responsive handling of network traffic,
	  especially under high load.

config ETH_WCH_HW_CHECKSUM
	bool "Use TX and RX hardware checksum"
	help
	  Enable receive and transmit checksum offload to enhance throughput
	  performances.

config ETH_WCH_MULTICAST_FILTER
	bool "Multicast hash filter support"
	imply CRC
	help
	  Enable support for multicast hash filtering in the MAC.
	  Once enabled the ethernet MAC performs imperfect filtering
	  based on a computed hash of the destination MAC address of
	  the multicast address. Only multicast with the computed
	  hash set in the multicast table will be received and all
	  other multicast is dropped by the MAC. If disabled then all
	  multicast is received by the MAC.

endif # ETH_WCH
```

## drivers/ethernet/Kconfig.xilinx_axi_ethernet_lite
```kconfig
#
#Xilinx AXI Ethernet Lite
#
#Copyright(c) 2025, CISPA Helmholtz Center for Information Security
#SPDX-License-Identifier: Apache-2.0
#

menuconfig ETH_XILINX_AXI_ETHERNET_LITE
	bool "Xilinx AXI Ethernet Lite Driver"
	default y
	depends on DT_HAS_XLNX_XPS_ETHERNETLITE_3_00_A_MAC_ENABLED || DT_HAS_XLNX_XPS_ETHERNETLITE_1_00_A_MAC_ENABLED
	depends on LITTLE_ENDIAN # byte order operations might break for BE
	help
	  Enable Xilinx AXI Ethernet Lite MAC driver, commonly found on Xilinx FPGAs and SoCs.

config ETH_XILINX_AXI_ETHERNET_LITE_TIMER_PERIOD
	int "Xilinx AXI Ethernet Lite Timer Period in ms"
	default 1
	depends on ETH_XILINX_AXI_ETHERNET_LITE
	help
	  Period for periodic RX timer task in AXI Ethernet Lite.
	  Useful when either no IRQs are available at all
	  or when IRQs are not handled reliably by the interrupt controller.
	  Set to 0 to disable this feature.
```

## drivers/ethernet/Kconfig.xilinx_axienet
```kconfig
#
#Xilinx AXI 1G / 2.5G Ethernet Subsystem
#
#Copyright(c) 2024, CISPA Helmholtz Center for Information Security
#SPDX-License-Identifier: Apache-2.0
#

config ETH_XILINX_AXIENET
	bool "Xilinx AXI Ethernet Driver"
	default y
	depends on DT_HAS_XLNX_AXI_ETHERNET_1_00_A_ENABLED
	depends on DMA_XILINX_AXI_DMA
	help
		Enable Xilinx 1G / 2.5G AXI Ethernet driver,
		commonly found on FPGAs.

config ETH_XILINX_AXIENET_BUFFER_NUM_TX
	int "Number of buffers for concurrent transmission (TX)."
	depends on ETH_XILINX_AXIENET
	default DMA_XILINX_AXI_DMA_SG_DESCRIPTOR_NUM_TX
	range 2 DMA_XILINX_AXI_DMA_SG_DESCRIPTOR_NUM_TX
	help
		Number of buffers for transmission allocated in the Xilinx AXI Ethernet driver.
		This limits how many transmissions can be in-flight at the same time.
		This cannot exceed the number of available TX buffers in the AXI DMA. However,
		in scenarios with multiple AXI DMAs for different purposes in the system, it
		may be desirable to reduce the number of concurrent transmissions to conserve
		resources.

config ETH_XILINX_AXIENET_BUFFER_NUM_RX
	int "Number of buffers for concurrent reception (RX)."
	depends on ETH_XILINX_AXIENET
	default DMA_XILINX_AXI_DMA_SG_DESCRIPTOR_NUM_RX
	range 2 DMA_XILINX_AXI_DMA_SG_DESCRIPTOR_NUM_RX
	help
		Number of buffers for reception allocated in the Xilinx AXI Ethernet driver.
		This limits how many transmissions can be in-flight at the same time.
		This cannot exceed the number of available RX buffers in the AXI DMA. However,
		in scenarios with multiple AXI DMAs for different purposes in the system, it
		may be desirable to reduce the number of concurrent transmissions to conserve
		resources.
```

## drivers/ethernet/Kconfig.xmc4xxx
```kconfig
# ETH_XMC4XXX Ethernet driver configuration options

# Copyright (c) 2023 SLB
# SPDX-License-Identifier: Apache-2.0

menuconfig ETH_XMC4XXX
	bool "XMC4XXX Ethernet driver"
	default y
	depends on DT_HAS_INFINEON_XMC4XXX_ETHERNET_ENABLED
	help
	  Enable XMC4XXX Ethernet driver.

if ETH_XMC4XXX

config ETH_XMC4XXX_TX_FRAME_POOL_SIZE
	int "Number of TX frames in the pool size"
	default 4
	help
	  Number of TX frames which can be buffered in the driver.

config ETH_XMC4XXX_NUM_TX_DMA_DESCRIPTORS
	int "Number of TX DMA descriptors"
	default 32
	help
	  Number of TX DMA descriptors. Each descriptor stores the memory address of a
	  data fragment and its size.

config ETH_XMC4XXX_NUM_RX_DMA_DESCRIPTORS
	int "Number of RX DMA descriptors"
	default 12
	help
	  Number of RX DMA descriptors. Each descriptor stores the memory address of a
	  data fragment and its size. The data fragments are pre-allocated from the rx
	  network buffers (CONFIG_NET_BUF_RX_COUNT). When a frame is received, it is
	  forwarded to the network stack without copying the data. The buffers
	  in the descriptors are replaced by new pre-allocated buffers.

config ETH_XMC4XXX_VLAN_HW_FILTER
	bool "Hardware filter VLAN frames"
	default y if NET_VLAN_COUNT=1
	depends on NET_VLAN
	help
	  Hardware filter VLAN frames in hardware. Only ethernet frames with
	  a tag configured using vlan_setup() call will be received.
	  The filtering can only be done on one vlan tag. If vlan_setup() is
	  called multiple times, the filtering will be done on the latest
	  tag.

config PTP_CLOCK_XMC4XXX
	bool "XMC4XXX PTP clock driver support"
	default y
	depends on PTP_CLOCK
	help
	  Enable XMC4XXX PTP Clock support.

endif # ETH_XMC4XXX
```
