## drivers/ethernet/mdio/Kconfig.opencores_ethoc
```kconfig
# SPDX-FileCopyrightText: Copyright The Zephyr Project Contributors
# SPDX-License-Identifier: Apache-2.0

config MDIO_OPENCORES_ETHOC
	bool "OpenCores ethmac MDIO driver"
	default y
	depends on DT_HAS_OPENCORES_ETHOC_MDIO_ENABLED
	depends on ETH_OPENCORES_ETHOC
	help
	  Enable the MDIO controller of the OpenCores ethmac.

if MDIO_OPENCORES_ETHOC

config MDIO_OPENCORES_ETHOC_BUSY_TIMEOUT
	int "MDIO busy-wait timeout (us)"
	default 10000
	help
	  Maximum time to wait for an MDIO transaction to complete.

endif # MDIO_OPENCORES_ETHOC
```

## drivers/ethernet/mdio/Kconfig.wch
```kconfig
# Copyright (c) 2025 James Bennion-Pedley <james@bojit.org>
# SPDX-License-Identifier: Apache-2.0

config MDIO_WCH
	bool "WCH MDIO controller driver"
	default y
	depends on SOC_FAMILY_CH32V
	depends on DT_HAS_SNPS_DWMAC_MDIO_ENABLED
	help
	  Enable WCH MDIO support.
```

## drivers/ethernet/mdio/Kconfig.xmc4xxx
```kconfig
# Copyright (c) 2023 SLB
# SPDX-License-Identifier: Apache-2.0

config MDIO_INFINEON_XMC4XXX
	bool "Infineon XMC4XXX MDIO driver"
	default y
	depends on SOC_SERIES_XMC4XXX
	depends on DT_HAS_SNPS_DWMAC_MDIO_ENABLED
	select PINCTRL
	help
	  Enable Infineon XMC4XXX MDIO driver.
```

## drivers/ethernet/microchip/Kconfig
```kconfig
# SPDX-FileCopyrightText: Copyright The Zephyr Project Contributors
# SPDX-License-Identifier: Apache-2.0

# zephyr-keep-sorted-start
rsource "Kconfig.enc28j60"
rsource "Kconfig.enc424j600"
rsource "Kconfig.lan865x"
rsource "Kconfig.lan9250"
rsource "Kconfig.mchp"
rsource "Kconfig.sam_gmac"
# zephyr-keep-sorted-stop
```

## drivers/ethernet/nxp/Kconfig
```kconfig
# SPDX-FileCopyrightText: Copyright The Zephyr Project Contributors
# SPDX-License-Identifier: Apache-2.0

# zephyr-keep-sorted-start
rsource "Kconfig.nxp_enet"
rsource "Kconfig.nxp_s32_gmac"
rsource "Kconfig.nxp_s32_netc"
rsource "eth_nxp_enet_qos/Kconfig"
rsource "nxp_imx_netc/Kconfig"
# zephyr-keep-sorted-stop
```

## drivers/ethernet/pse/Kconfig
```kconfig
# Copyright (c) 2026 Analog Devices, Inc.
# SPDX-License-Identifier: Apache-2.0

menuconfig PSE
	bool "Power Sourcing Equipment (PSE) drivers"
	help
	  Include drivers for Power Sourcing Equipment (PSE) controllers, as
	  defined in IEEE 802.3 Clause 30/33/104/145.

if PSE

module = PSE
module-str = pse
source "subsys/logging/Kconfig.template.log_config"

endif # PSE
```

## drivers/ethernet/wiznet/Kconfig
```kconfig
# Copyright (c) 2026 RAKwireless Technology Limited
# SPDX-License-Identifier: Apache-2.0

# zephyr-keep-sorted-start
source "drivers/ethernet/wiznet/Kconfig.w5500"
source "drivers/ethernet/wiznet/Kconfig.w6100"
source "drivers/ethernet/wiznet/Kconfig.w6300"
# zephyr-keep-sorted-stop
```

## drivers/ethernet/wiznet/Kconfig.w5100s
```kconfig
# Copyright (c) 2026 RAKwireless Technology Limited
# SPDX-License-Identifier: Apache-2.0

config ETH_W5100S
	bool "W5100S Ethernet Controller"
	default y
	depends on DT_HAS_WIZNET_W5100S_ENABLED
	select ETH_WIZNET
	select ETH_WIZNET_CORE
	select SPI
	select GPIO if ($(dt_compat_any_has_prop,$(DT_COMPAT_WIZNET_W5100S),reset-gpios) || \
			$(dt_compat_any_has_prop,$(DT_COMPAT_WIZNET_W5100S),int-gpios))
	help
	  W5100S Stand-Alone Ethernet Controller with SPI interface.
```
