## drivers/ethernet/cdns_macb/Kconfig
```kconfig
# Cadence MACB/GEM Ethernet MAC configuration options

# SPDX-FileCopyrightText: Copyright The Zephyr Project Contributors
# SPDX-License-Identifier: Apache-2.0

menu "Cadence MACB/GEM Ethernet driver"

DT_COMPAT_CDNS_GEM := cdns,gem

config ETH_CDNS_MACB_CORE
	bool
	depends on NET_BUF_FIXED_DATA_SIZE
	select CACHE_MANAGEMENT if DCACHE
	# The DMA descriptor rings are not cache maintained, so they need an
	# uncached region, which on ARM can only be carved out by the MPU.
	select ARM_MPU if CPU_HAS_ARM_MPU && DCACHE
	imply NVMEM if $(dt_compat_any_has_prop,$(DT_COMPAT_CDNS_GEM),nvmem-cells)
	help
	  This is a driver for the Cadence GEM (Gigabit Ethernet MAC), the core
	  the Linux macb driver supports. The 10/100 MACB variant is not
	  supported.

config ETH_XLNX_CDNS_MACB
	bool "Driver for the Cadence GEM on Xilinx Zynq-7000 and ZynqMP"
	depends on DT_HAS_XLNX_ZYNQ_GEM_ENABLED || DT_HAS_XLNX_ZYNQMP_GEM_ENABLED
	depends on !QEMU_TARGET || NET_QEMU_ETHERNET || NET_QEMU_USER
	select ETH_CDNS_MACB_CORE
	select NOCACHE_MEMORY if ARCH_HAS_NOCACHE_MEMORY_SUPPORT
	default y
	help
	  This enables the Cadence GEM driver on the Xilinx Zynq-7000 and
	  ZynqMP processing systems. The data cache of the CPU is maintained
	  for the packet buffers; the Zynq-7000 L2 cache is not configured by
	  Zephyr and must stay disabled.

config ETH_NIC_MODEL
	string
	default "cadence_gem"
	depends on ETH_XLNX_CDNS_MACB
	help
	  Value of the -nic parameter to be used when starting QEMU.
	  This parameter specifies which type of Ethernet controller
	  shall be simulated by QEMU.

if ETH_CDNS_MACB_CORE

configdefault NET_BUF_ALIGNMENT
	default DCACHE_LINE_SIZE if DCACHE

config ETH_CDNS_MACB_NB_TX_DESCS
	int "Number of entries in the transmit descriptor ring"
	default 32
	range 4 256
	help
	  A higher number allows for more packets to be queued which may
	  improve throughput, but that requires more transient memory.
	  There must be enough descriptors to hold all fragments of a
	  full-size packet to be transmitted or the packet will be dropped.
	  One entry is always kept free to terminate the queue.

	  Fragment size is influenced by CONFIG_NET_BUF_DATA_SIZE.

config ETH_CDNS_MACB_NB_RX_DESCS
	int "Number of entries in the receive descriptor ring"
	default 32
	range 8 256
	help
	  Received packets are spread across the required number of fragment
	  buffers. Each RX fragment has a size of CONFIG_NET_BUF_DATA_SIZE,
	  so a full-size frame needs 12 entries with the default of 128
	  bytes. There is one descriptor entry per fragment, taken from the
	  RX data pool, so CONFIG_NET_BUF_RX_COUNT should be well above this.

	  A higher number allows for more packets to be received without
	  immediate intervention from the CPU but requires more transient
	  memory. A smaller number increases the risk of an overflow and
	  dropped packets.

config ETH_CDNS_MACB_DMA_64BIT
	bool "64-bit DMA descriptors"
	default y if 64BIT
	help
	  Use 16-byte descriptors carrying 64-bit buffer addresses. The
	  hardware must support 64-bit DMA addressing (DCFG6.DAW64), which
	  the driver checks at initialization. Required on 64-bit CPUs, and
	  selectable on 32-bit ones for testing.

config ETH_CDNS_MACB_RX_REFILL_IRQ
	bool "Receive buffer refill in interrupt"
	default y
	help
	  Refill the receive buffer pool in the rx interrupt, if
	  possible, otherwise in the refill thread.

config ETH_CDNS_MACB_RX_REFILL_THREAD_PRIORITY
	int "Receive buffer refill thread priority"
	default 0
	help
	  Priority level of the internal thread which is used to refill
	  the receive buffer pool.

config ETH_CDNS_MACB_MULTICAST_FILTER
	bool "Multicast filter support"
	depends on NET_L2_ETHERNET
	default y
	help
	  Enable the 64-bin multicast hash filter of the MAC, so only
	  multicast for the addresses the stack listens to is received.
	  If disabled, all multicast is received by the MAC.

config ETH_CDNS_MACB_TX_HW_CHECKSUM
	bool "Use TX hardware checksum"
	select NET_CHECKSUM_OFFLOAD_SUPPORTED if NET_L2_ETHERNET
	default y
	help
	  Enable transmit checksum offload to enhance throughput
	  performances. Only available when the packet buffers of the
	  core are in SRAM mode, which the driver checks at initialization.

config ETH_CDNS_MACB_TX_HW_CHECKSUM_EN
	bool
	depends on ETH_CDNS_MACB_TX_HW_CHECKSUM
	depends on NET_CHECKSUM_OFFLOAD
	default y

config ETH_CDNS_MACB_RX_HW_CHECKSUM
	bool "Use RX hardware checksum"
	select NET_CHECKSUM_OFFLOAD_SUPPORTED if NET_L2_ETHERNET
	default y
	help
	  Enable receive checksum offload to enhance throughput
	  performances. Frames with a bad checksum are discarded by the
	  hardware, except in promiscuous mode.

config ETH_CDNS_MACB_RX_HW_CHECKSUM_EN
	bool
	depends on ETH_CDNS_MACB_RX_HW_CHECKSUM
	depends on NET_CHECKSUM_OFFLOAD
	default y

endif # ETH_CDNS_MACB_CORE

endmenu
```

## drivers/ethernet/cdns_macb/Kconfig.ptp
```kconfig
# SPDX-FileCopyrightText: Copyright The Zephyr Project Contributors
# SPDX-License-Identifier: Apache-2.0

config PTP_CLOCK_CDNS_MACB
	bool "Cadence MACB/GEM PTP clock driver support"
	default y
	depends on PTP_CLOCK
	depends on DT_HAS_CDNS_MACB_PTP_CLOCK_ENABLED
	depends on ETH_CDNS_MACB_CORE
	select NET_L2_PTP_TIMESTAMPING
	help
	  Enable the 1588 time stamp unit of the Cadence GEM as PTP clock and
	  the hardware timestamps of received and transmitted frames. The
	  descriptors grow by the two timestamp words, and receive buffers
	  need an 8-byte alignment.
```

## drivers/ethernet/dsa/Kconfig
```kconfig
# Distributed Switch Architecture [DSA] device configuration options

# Copyright (c) 2020 DENX Software Engineering GmbH
#               Lukasz Majewski <lukma@denx.de>
# Copyright 2025 NXP
# SPDX-License-Identifier: Apache-2.0

menuconfig DSA_DRIVERS
	bool "Distributed Switch Architecture device drivers"
	default y if NET_DSA
	help
	  Enable Distributed Switch Architecture support.

if DSA_DRIVERS

# Used by sourced files
DSA_PORT_COMPAT := zephyr,dsa-port

rsource "Kconfig.netc"

endif # DSA_DRIVERS
```

## drivers/ethernet/dsa/Kconfig.ksz8463
```kconfig
# Microchip KSZ8463 DSA configuration options

# Copyright (c) 2026 Vilhelm Engström
#
# SPDX-License-Identifier: Apache-2.0

KSZ8463_COMPAT := microchip,ksz8463

config DSA_MICROCHIP_KSZ8463
	bool "Support for Microchip KSZ8463 Ethernet switch"
	default y
	depends on DT_HAS_MICROCHIP_KSZ8463_ENABLED
	select GPIO if $(dt_compat_any_has_prop,$(KSZ8463_COMPAT),int-gpios,1) || \
				$(dt_compat_any_has_prop,$(KSZ8463_COMPAT),reset-gpios,1)
	select SPI
	help
	  Add support for the KSZ8463 3-port Ethernet switch family. Both MII and RMII models
	  are supported.

if DSA_MICROCHIP_KSZ8463

config DSA_MICROCHIP_KSZ8463_SPI_OPERATIONAL_TIMEOUT
	int "Maximum time to wait for initial SPI resopnse"
	default 100
	range 10 10000
	help
	  Number of milliseconds to wait for the chip to respond over SPI during initialization.

config DSA_MICROCHIP_KSZ8463_LINK_STATE_POLL_INTERVAL
	int "Interval at which the link state is polled"
	default 1000
	range 10 60000
	help
	  Interval at which the link state is polled should no int-gpios property be provided.
	  Given in ms.

config DSA_MICROCHIP_KSZ8463_PHY_AUTONEG_POLL_INTERVAL
	int "Interval at which the PHY is polled for auto-negotiation completion"
	default 100
	help
	  During auto-negotiation, the PHY is periodically polled to determine whether or
	  not the negotiation has completed. This setting determines how often said state is
	  polled. Given in ms.

config DSA_MICROCHIP_KSZ8463_PHY_AUTONEG_TIMEOUT
	int "Auto-negotiation timeout"
	default 5000
	help
	  Number of milliseconds after which auto-negotiation is assumed to have failed. On failure,
	  the PHY falls back on whatever speed is configured via its microchip,fixed-link-speed
	  devicetree property.

	  The value must be greater DSA_MICROCHIP_KSZ8463_PHY_AUTONEG_POLL_INTERVAL.

endif # DSA_MICROCHIP_KSZ8463
```

## drivers/ethernet/dsa/Kconfig.netc
```kconfig
# NXP NETC DSA configuration options

# Copyright (c) 2020 DENX Software Engineering GmbH
#               Lukasz Majewski <lukma@denx.de>
# Copyright 2025 NXP
# SPDX-License-Identifier: Apache-2.0

config DSA_NXP_IMX_NETC
	bool "Support for NXP i.MX NETC"
	default y
	depends on DT_HAS_NXP_NETC_SWITCH_ENABLED
	select NET_PKT_CONTROL_BLOCK if PTP_CLOCK_NXP_NETC
	help
	  Add support for NXP i.MX NETC DSA device driver.

config DSA_NXP_IMX_NETC_GCL_LEN
	int "Gate control list length for i.MX NETC switch"
	default 64
	range 1 256
	depends on DSA_NXP_IMX_NETC && NET_QBV
	help
	  Amount of Gate control list to use. Small value saves RAM.
	  The Max of the value can be 64, 128, or 256.

# DSA tag protocol driver
#   Tag protocol ID found in <zephyr/dt-bindings/ethernet/dsa_tag_proto.h>
config DSA_TAG_PROTOCOL_NETC
	bool "Tag protocol - NETC"
	default y
	select NET_PKT_CONTROL_BLOCK
	depends on $(dt_compat_any_has_prop,$(DSA_PORT_COMPAT),dsa-tag-protocol,1)
	help
	  NXP NETC tag protocol.
```

## drivers/ethernet/dwc_mac/Kconfig.mcast
```kconfig
# Synopsys DesignWare MAC multicast filter configuration options

# SPDX-FileCopyrightText: Copyright The Zephyr Project Contributors
# SPDX-License-Identifier: Apache-2.0

DT_PROP_SNPS_MULTICAST_FILTER_BINS := snps,multicast-filter-bins
DT_PROP_SNPS_PERFECT_FILTER_ENTRIES := snps,perfect-filter-entries

config ETH_DWC_ETHER_MULTICAST_FILTER_HASH_SUPPORTED
	def_bool $(dt_compat_any_has_prop,$(DT_COMPAT_SNPS_DWMAC),$(DT_PROP_SNPS_MULTICAST_FILTER_BINS))
	help
	  The hardware can hash multicast addresses, which the devicetree
	  property snps,multicast-filter-bins indicates.

config ETH_DWC_ETHER_MULTICAST_FILTER_PERFECT_SUPPORTED
	def_bool !$(dt_compat_all_has_prop,$(DT_COMPAT_SNPS_DWMAC),$(DT_PROP_SNPS_PERFECT_FILTER_ENTRIES),1)
	help
	  The hardware has spare MAC address entries to perfect filter
	  multicast addresses with, meaning the devicetree property
	  snps,perfect-filter-entries is larger than 1, as entry 0 holds
	  the station address.

config ETH_DWC_ETHER_MULTICAST_FILTER
	bool "Multicast filter support"
	depends on ETH_DWC_ETHER_MULTICAST_FILTER_HASH_SUPPORTED || \
		ETH_DWC_ETHER_MULTICAST_FILTER_PERFECT_SUPPORTED
	depends on NET_L2_ETHERNET
	default y
	help
	  Enable support for multicast filtering in the MAC, so only
	  multicast for the addresses the stack listens to is received.
	  If disabled, or if the hardware cannot filter at all, then all
	  multicast is received by the MAC.

choice ETH_DWC_ETHER_MULTICAST_FILTER_MODE
	prompt "Multicast filter mode"
	depends on ETH_DWC_ETHER_MULTICAST_FILTER
	default ETH_DWC_ETHER_MULTICAST_FILTER_HASH if ETH_DWC_ETHER_MULTICAST_FILTER_HASH_SUPPORTED
	default ETH_DWC_ETHER_MULTICAST_FILTER_PERFECT

config ETH_DWC_ETHER_MULTICAST_FILTER_HASH
	bool "Hash filtering"
	depends on ETH_DWC_ETHER_MULTICAST_FILTER_HASH_SUPPORTED
	select CRC
	help
	  Imperfect multicast filtering based on a computed hash of the
	  destination MAC address.

config ETH_DWC_ETHER_MULTICAST_FILTER_PERFECT
	bool "Perfect filtering"
	depends on ETH_DWC_ETHER_MULTICAST_FILTER_PERFECT_SUPPORTED
	help
	  Perfect multicast filtering against the spare MAC address entries
	  of the hardware. Should the addresses ever not fit into the spare
	  entries, all multicast is received instead.

endchoice
```

## drivers/ethernet/dwc_mac/Kconfig.ptp
```kconfig
# SPDX-FileCopyrightText: Copyright The Zephyr Project Contributors
# SPDX-License-Identifier: Apache-2.0

config PTP_CLOCK_DWC_MAC
	bool "DWC MAC PTP clock driver support"
	default y
	depends on PTP_CLOCK
	depends on DT_HAS_SNPS_DWMAC_PTP_CLOCK_ENABLED
	select NET_L2_PTP_TIMESTAMPING
	help
	  Enable PTP clock support for the Synopsys DesignWare MAC cores.

if PTP_CLOCK_DWC_MAC

choice PTP_CLOCK_DWC_MAC_RX_TIMESTAMP
	prompt "Received frames to timestamp"
	default PTP_CLOCK_DWC_MAC_RX_TIMESTAMP_PTP if PTP
	default PTP_CLOCK_DWC_MAC_RX_TIMESTAMP_ALL

config PTP_CLOCK_DWC_MAC_RX_TIMESTAMP_ALL
	bool "All frames"
	help
	  Take a timestamp for every received frame.

config PTP_CLOCK_DWC_MAC_RX_TIMESTAMP_PTP
	bool "PTP frames only"
	help
	  Take a timestamp only for received PTP event messages of the
	  enabled PTP version and transports. This covers the messages
	  needed by both the end-to-end and the peer-to-peer delay
	  mechanisms.

endchoice

if PTP_CLOCK_DWC_MAC_RX_TIMESTAMP_PTP

config PTP_CLOCK_DWC_MAC_RX_TIMESTAMP_PTPV2
	bool "PTPv2 frame format"
	default y
	help
	  Parse received PTP frames as IEEE 1588-2008 (PTPv2). Otherwise they
	  are parsed as IEEE 1588-2002 (PTPv1).

config PTP_CLOCK_DWC_MAC_RX_TIMESTAMP_L2
	bool "PTP over Ethernet"
	default y if PTP_IEEE_802_3_PROTOCOL
	help
	  Timestamp PTP frames carried directly over Ethernet.

config PTP_CLOCK_DWC_MAC_RX_TIMESTAMP_IPV4
	bool "PTP over UDP/IPv4"
	default y if PTP_UDP_IPV4_PROTOCOL
	help
	  Timestamp PTP frames carried over UDP/IPv4.

config PTP_CLOCK_DWC_MAC_RX_TIMESTAMP_IPV6
	bool "PTP over UDP/IPv6"
	default y if PTP_UDP_IPV6_PROTOCOL
	help
	  Timestamp PTP frames carried over UDP/IPv6.

endif # PTP_CLOCK_DWC_MAC_RX_TIMESTAMP_PTP

endif # PTP_CLOCK_DWC_MAC
```

## drivers/ethernet/mdio/Kconfig.cdns_macb
```kconfig
# SPDX-FileCopyrightText: Copyright The Zephyr Project Contributors
# SPDX-License-Identifier: Apache-2.0

config MDIO_CDNS_MACB
	bool "Cadence MACB/GEM MDIO controller driver"
	default y
	depends on DT_HAS_CDNS_MACB_MDIO_ENABLED
	depends on ETH_CDNS_MACB_CORE
	help
	  Enable MDIO support for Cadence MACB/GEM Ethernet MACs, which
	  expose the MDIO controller as a child node of the MAC.

if MDIO_CDNS_MACB

config MDIO_CDNS_MACB_IRQ
	bool "Wait for the management frame done interrupt"
	default y
	depends on !QEMU_TARGET
	help
	  Wait for the interrupt of the MAC that signals the completion of a
	  management frame, instead of polling the idle bit of the network
	  status register. QEMU does not raise this interrupt: there a frame is
	  done at once and the bus always reads idle.

config MDIO_CDNS_MACB_IDLE_TIMEOUT_US
	int "MDIO idle wait timeout"
	default 10000
	help
	  Timeout in microseconds to wait for the MDIO bus to become idle
	  before a read or write operation and for the operation to complete.

endif # MDIO_CDNS_MACB
```

## drivers/ethernet/mdio/Kconfig.designware
```kconfig
# SPDX-FileCopyrightText: Copyright (c) 2026 KylinSoft
# SPDX-License-Identifier: Apache-2.0

config MDIO_DESIGNWARE
	bool "Synopsys DesignWare standalone MDIO driver"
	default y
	depends on DT_HAS_SNPS_DESIGNWARE_MDIO_ENABLED
	help
	  Enable MDIO support for Synopsys DesignWare Ethernet MAC instances
	  that expose a standalone MDIO controller node (snps,designware-mdio).
```

## drivers/ethernet/mdio/Kconfig.dm9000
```kconfig
# Copyright (c) 2026 Fuyu Fei
# SPDX-License-Identifier: Apache-2.0

config MDIO_DM9000
	bool "Davicom DM9000 MDIO driver"
	default y
	depends on DT_HAS_DAVICOM_DM9000_MDIO_ENABLED
	depends on ETH_DM9000
	help
	  Enable the Davicom DM9000 MDIO driver. The controller reaches its
	  integrated PHY (and an optional external PHY) through the parent
	  MAC's EPCR/EPAR/EPDR registers.
```

## drivers/ethernet/mdio/Kconfig.mchp
```kconfig
# Copyright (c) 2026 Microchip Technology Inc.
# SPDX-License-Identifier: Apache-2.0

config MDIO_MCHP_GMAC_G1
	bool "Microchip MDIO driver"
	depends on DT_HAS_MICROCHIP_GMAC_G1_MDIO_ENABLED
	depends on ETH_MCHP_GMAC_G1
	default y
	help
	  Enable Microchip MCU Family MDIO driver.

config MDIO_MCHP_GMAC_G2
	bool "Microchip G2 GMAC MDIO driver"
	default y
	depends on DT_HAS_MICROCHIP_GMAC_G2_MDIO_ENABLED
	select PINCTRL
	help
	  Enable the Clause 22 MDIO driver of the Microchip G2 GMAC, the
	  "ETH" peripheral of PIC32CZ CA.
```

## drivers/ethernet/mdio/Kconfig.nxp_imx_netc
```kconfig
# Copyright 2024 NXP
# SPDX-License-Identifier: Apache-2.0

config MDIO_NXP_IMX_NETC
	bool "NXP i.MX NETC External MDIO driver"
	default y
	depends on DT_HAS_NXP_IMX_NETC_EMDIO_ENABLED
	help
	  Enable NETC External MDIO Controller driver for NXP i.MX SoCs.
```
