## drivers/ethernet/Kconfig.nxp_enet
```kconfig
# NXP ENET ethernet drivers configuration options

# Copyright (c) 2016-2017 ARM Ltd
# Copyright 2024-2025 NXP
# SPDX-License-Identifier: Apache-2.0

DT_NXP_UNIQUE_MAC_PROP := nxp,unique-mac

config ETH_NXP_ENET
	bool "NXP ENET Ethernet driver"
	default y
	depends on DT_HAS_NXP_ENET_MAC_ENABLED
	select ETH_PHY_DRIVER
	select NOCACHE_MEMORY if CPU_HAS_DCACHE
	select ARM_MPU if CPU_CORTEX_M7
	imply NET_POWER_MANAGEMENT
	select PINCTRL
	select HWINFO if $(dt_compat_any_has_prop,$(DT_COMPAT_NXP_ENET_MAC),$(DT_NXP_UNIQUE_MAC_PROP),True)
	imply NVMEM if $(dt_compat_any_has_prop,$(DT_COMPAT_NXP_ENET_MAC),nvmem-cells)
	select NET_CHECKSUM_OFFLOAD_SUPPORTED if NET_L2_ETHERNET
	help
	  Enable NXP ENET Ethernet driver.


if ETH_NXP_ENET

config ETH_NXP_ENET_USE_DTCM_FOR_DMA_BUFFER
	bool "Use DTCM for hardware DMA buffers"
	# ERR050396: ENET writes to TCM require CACHE_ENET to be cleared, while
	# ENET_1G writes to TCM can still corrupt data on Cortex-M7.
	default n if CPU_CORTEX_M7
	default y
	help
	  Place the hardware DMA buffers into DTCM for better
	  networking performance.

config ETH_NXP_ENET_HW_ACCELERATION
	bool "Hardware acceleration"
	default y
	depends on NET_CHECKSUM_OFFLOAD
	help
	  Enable hardware acceleration for the following:
	  - IPv4, UDP and TCP checksum (both Rx and Tx)

config ETH_NXP_ENET_RX_BUFFERS
	int "Number of RX buffers for ethernet driver"
	default 6
	range 6 128
	help
	  Depth of the receive DMA buffer-descriptor ring.

config ETH_NXP_ENET_TX_BUFFERS
	int "Number of TX buffers for ethernet driver"
	default 16 if ETH_NXP_ENET_TX_ZERO_COPY
	default 1
	range 2 128 if ETH_NXP_ENET_TX_ZERO_COPY
	range 1 128
	help
	  Depth of the transmit DMA buffer-descriptor ring. Zero-copy TX hands
	  the HAL one buffer descriptor per non-empty net_buf fragment, so the
	  ring must hold a whole worst-case frame: at least
	  ceil(NET_ETH_MAX_FRAME_SIZE / NET_BUF_DATA_SIZE) + 1 descriptors
	  (enforced by a BUILD_ASSERT in the driver). The copy path transmits a
	  linear bounce buffer and works with a single descriptor.

config ETH_NXP_ENET_TX_ZERO_COPY
	bool "Zero-copy TX (DMA directly from net_buf fragments)"
	depends on !ETH_NXP_ENET_USE_DTCM_FOR_DMA_BUFFER
	depends on NET_BUF_FIXED_DATA_SIZE
	help
	  DMA directly from the net_buf fragments instead of copying each
	  outgoing frame into a driver TX buffer. The worst-case fragment
	  count per frame is derived from NET_BUF_DATA_SIZE. Incompatible
	  with DTCM DMA buffers.

config ETH_NXP_ENET_RX_ZERO_COPY
	bool "Zero-copy RX (DMA directly into net_buf-backed buffers)"
	depends on !ETH_NXP_ENET_USE_DTCM_FOR_DMA_BUFFER
	depends on NET_BUF_FIXED_DATA_SIZE
	help
	  DMA received frames straight into the network stack's RX data
	  buffers instead of copying each frame out of a driver buffer. The
	  MAC scatters a frame across several buffers, so NET_BUF_DATA_SIZE
	  need not hold a whole frame, but it must meet the HAL minimum and
	  the ENET DMA/cache alignment, enforced by BUILD_ASSERTs.
	  Incompatible with DTCM DMA buffers.

config ETH_NXP_ENET_RX_ZERO_COPY_BUFFERS
	int "Zero-copy RX buffer lookup-table size"
	depends on ETH_NXP_ENET_RX_ZERO_COPY
	default 64
	range 8 512
	help
	  Size of the driver table mapping a DMA buffer back to its net_buf. It
	  must cover every buffer the HAL holds at once (the DMA ring plus the
	  replacement it allocates before releasing a received buffer). The
	  buffers themselves come from NET_BUF_RX_COUNT, not from here.

config ETH_NXP_ENET_RX_THREAD_STACK_SIZE
	int "NXP ENET RX thread stack size"
	default 2048 if ETH_NXP_ENET_RX_ZERO_COPY
	default 1600
	help
	  ENET RX thread stack size in bytes. Zero-copy RX walks the HAL
	  rxBuffArray and the net_buf/net_pkt teardown on this thread, so it
	  needs more stack than the copy path.

config ETH_NXP_ENET_RX_THREAD_PRIORITY
	int "NXP ENET driver RX thread priority"
	default 2
	help
	  Priority level of the dedicated ENET RX workqueue thread.

config ETH_NXP_ENET_RX_THREAD_PREEMPTIVE
	bool "Run the NXP ENET RX drain thread at a preemptible priority"
	help
	  Run the RX drain thread at a preemptible priority instead of the
	  default cooperative one.

config ETH_NXP_ENET_RX_INT_COALESCE
	bool "ENET hardware RX/TX interrupt coalescing"
	help
	  Program the ENET RXIC/TXIC registers so the MAC raises an interrupt
	  only after a number of frames accumulate or a hardware timer expires,
	  instead of once per frame.

if ETH_NXP_ENET_RX_INT_COALESCE

config ETH_NXP_ENET_RX_COALESCE_FRAMES
	int "RX interrupt coalescing frame-count threshold"
	default 8
	range 1 255
	help
	  Number of received frames the MAC accumulates before raising a
	  receive interrupt (RXIC ICFT, ring 0). Higher values mean fewer
	  interrupts but more latency; ensure the ring is deep enough for this
	  many in-flight frames.

config ETH_NXP_ENET_RX_COALESCE_TICKS
	int "RX interrupt coalescing timer threshold"
	default 100
	range 0 65535
	help
	  Maximum time the MAC waits (coalescing timer units, 64 bus-clock
	  cycles each) before raising a receive interrupt if the frame-count
	  threshold is not reached. Bounds worst-case latency. 0 disables it.

config ETH_NXP_ENET_TX_COALESCE_FRAMES
	int "TX interrupt coalescing frame-count threshold"
	default 1
	range 1 255
	help
	  Number of transmitted frames the MAC accumulates before raising a
	  transmit interrupt (TXIC ICFT, ring 0). Keep at 1 unless the reclaim
	  path tolerates batching.

config ETH_NXP_ENET_TX_COALESCE_TICKS
	int "TX interrupt coalescing timer threshold"
	default 30 if ETH_NXP_ENET_TX_COALESCE_FRAMES > 1
	default 0
	range 1 65535 if ETH_NXP_ENET_TX_COALESCE_FRAMES > 1
	range 0 65535
	help
	  Maximum time the MAC waits (coalescing timer units, 64 bus-clock
	  cycles each) before raising a transmit interrupt if the TX frame-count
	  threshold is not reached. 0 disables it.

endif # ETH_NXP_ENET_RX_INT_COALESCE

config ETH_NXP_ENET_RMII_EXT_CLK
	bool "RMII clock from external sources"
	help
	  Setting this option will configure ENET clock block to feed RMII
	  reference clock from external source (ENET_1588_CLKIN)

config ETH_NXP_ENET_MULTICAST_FILTER
	bool "Multicast destination address filtering"
	default y
	help
	  Enable support for multicast destination address filtering in the
	  MAC. The MAC performs imperfect filtering using a group-address hash
	  table (GAUR/GALR). Only multicast whose computed hash bit is set in
	  the table is received and all other multicast is dropped by the MAC.
	  If disabled, the hash table is opened to every multicast address so
	  that reception does not depend on per-group hash installation.

endif # ETH_NXP_ENET
```

## drivers/ethernet/Kconfig.opencores_ethoc
```kconfig
# SPDX-FileCopyrightText: Copyright The Zephyr Project Contributors
# SPDX-License-Identifier: Apache-2.0

menuconfig ETH_OPENCORES_ETHOC
	bool "OpenCores ethmac Ethernet driver"
	default y
	depends on DT_HAS_OPENCORES_ETHOC_ENABLED
	select CACHE_MANAGEMENT if DCACHE && !ETH_OPENCORES_ETHOC_DMA_COHERENT
	select ETH_NIC_MODEL_ONBOARD
	help
	  Enable the OpenCores 10/100 Mbps Ethernet MAC (ethmac) driver.

if ETH_OPENCORES_ETHOC

config ETH_NIC_MODEL
	string
	default "open_eth"
	help
	  Value of the -nic parameter to be used when starting QEMU.

config ETH_OPENCORES_ETHOC_DMA_COHERENT
	def_bool $(dt_compat_all_has_prop,$(DT_COMPAT_OPENCORES_ETHOC),dma-coherent,True)

config ETH_OPENCORES_ETHOC_NB_TX_DESCS
	int "Number of TX descriptors"
	default 8
	range 1 127
	help
	  Number of TX buffer descriptors, each of which holds one frame.
	  Without ETH_OPENCORES_ETHOC_ZERO_COPY, each descriptor also has an
	  internal frame buffer. TX and RX descriptors together must not
	  exceed 128.

config ETH_OPENCORES_ETHOC_NB_RX_DESCS
	int "Number of RX descriptors"
	default 8
	range 1 127
	help
	  Number of RX buffer descriptors, each of which holds one frame in a
	  network buffer, or in an internal frame buffer without
	  ETH_OPENCORES_ETHOC_ZERO_COPY. TX and RX descriptors together must
	  not exceed 128.

config ETH_OPENCORES_ETHOC_ZERO_COPY
	bool "Use network buffers holding whole frames"
	default y if NET_BUF_VARIABLE_DATA_SIZE || NET_BUF_DATA_SIZE >= 1536
	help
	  Receive frames directly into network buffers, and copy packets that
	  cannot be sent from their own buffer into a new network buffer. This
	  needs network buffers large enough for a whole frame.

	  If disabled, frames are received into internal buffers and copied
	  into network buffers of any size, and packets that cannot be sent
	  from their own buffer are copied into internal buffers.

configdefault NET_BUF_DATA_SIZE
	default 1536

# A network buffer holds a whole frame, so far fewer buffers are needed:
# one per pending packet, plus the ones armed in the RX descriptors.
configdefault NET_BUF_RX_COUNT
	default 22 if ETH_OPENCORES_ETHOC_ZERO_COPY

configdefault NET_BUF_TX_COUNT
	default 16 if ETH_OPENCORES_ETHOC_ZERO_COPY

# received frames must not share cache lines with other data
configdefault NET_BUF_ALIGNMENT
	default DCACHE_LINE_SIZE if DCACHE && ETH_OPENCORES_ETHOC_ZERO_COPY && \
		!ETH_OPENCORES_ETHOC_DMA_COHERENT

configdefault NET_L2_ETHERNET_RESERVE_HEADER
	default y

endif # ETH_OPENCORES_ETHOC
```

## drivers/ethernet/Kconfig.slip_tap
```kconfig
# SPDX-FileCopyrightText: Copyright The Zephyr Project Contributors
# SPDX-License-Identifier: Apache-2.0

config ETH_SLIP_TAP
	bool "SLIP TAP Ethernet driver"
	default y if !QEMU_TARGET || NET_QEMU_SLIP
	depends on DT_HAS_ZEPHYR_SLIP_ETH_ENABLED
	depends on NET_NATIVE
	depends on NET_L2_ETHERNET
	select SLIP_COMMON
	help
	  Carry Ethernet frames over the SLIP link of the zephyr,slip-eth
	  node. The host side runs tunslip6 with TAP support from the
	  net-tools project, see https://github.com/zephyrproject-rtos/net-tools
```

## drivers/ethernet/Kconfig.virtio_net
```kconfig
# Copyright (c) 2025 Antmicro
# SPDX-License-Identifier: Apache-2.0

menuconfig ETH_VIRTIO_NET
	bool "VIRTIO networking paravirtualization device driver"
	default y
	depends on DT_HAS_VIRTIO_NET_ENABLED
	select VIRTIO

if ETH_VIRTIO_NET

config ETH_NIC_MODEL
	string
	default "virtio-net-device" if VIRTIO_MMIO
	default "virtio-net-pci" if VIRTIO_PCI
	help
	  Tells QEMU what network model to use. This value is given as
	  a parameter to the -nic QEMU command line option.

config ETH_VIRTIO_NET_RX_BUFFERS
	int "VIRTIO network device receive buffers"
	range 1 32768
	default 4

config ETH_VIRTIO_NET_TX_BUFFERS
	int "Transmit requests"
	range 1 64
	default 4
	help
	  Maximum number of packets queued or waiting for transmit descriptors.
	  Each request includes a full-frame copy buffer for packets whose
	  fragments cannot be submitted directly. Packet references and request
	  buffers are released when the device completes transmission.

endif
```

## drivers/ethernet/Kconfig.xlnx_gem
```kconfig
#
# Xilinx Processor System Gigabit Ethernet controller (GEM) driver
# configuration options
#
# Copyright (c) 2021, Weidmueller Interface GmbH & Co. KG
# SPDX-License-Identifier: Apache-2.0
#

menuconfig ETH_XLNX_GEM
	bool "Xilinx GEM Ethernet driver [DEPRECATED]"
	default y
	depends on DT_HAS_XLNX_GEM_ENABLED
	depends on !QEMU_TARGET || (QEMU_TARGET && NET_QEMU_ETHERNET)
	select NOCACHE_MEMORY if ARCH_HAS_NOCACHE_MEMORY_SUPPORT
	select CACHE_MANAGEMENT if DCACHE
	select NET_CHECKSUM_OFFLOAD_SUPPORTED if NET_L2_ETHERNET
	select ETH_NIC_MODEL_ONBOARD
	select DEPRECATED
	help
	  Enable the Xilinx GEM Ethernet driver. It is deprecated in favour of
	  the Cadence MACB/GEM driver, ETH_XLNX_CDNS_MACB, which the GEM nodes
	  of the Zynq-7000 and ZynqMP use.

config ETH_NIC_MODEL
	string
	default "cadence_gem"
	depends on ETH_XLNX_GEM
	help
	  Value of the -nic parameter to be used when starting QEMU.
	  This parameter specifies which type of Ethernet controller
	  shall be simulated by QEMU.
```
