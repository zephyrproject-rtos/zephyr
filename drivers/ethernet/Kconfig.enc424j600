## drivers/ethernet/Kconfig.enc424j600
```kconfig
# ENC424J600 Ethernet driver configuration options

# Copyright (c) 2019 PHYTEC Messtechnik GmbH
# Copyright (c) 2021 Laird Connectivity
# SPDX-License-Identifier: Apache-2.0

menuconfig ETH_ENC424J600
	bool "ENC424J600C Ethernet Controller"
	depends on SPI
	help
	  ENC424J600C Stand-Alone Ethernet Controller
	  with SPI Interface

if ETH_ENC424J600

config ETH_ENC424J600_RX_THREAD_STACK_SIZE
	int "Stack size for internal incoming packet handler"
	default 800
	help
	  Size of the stack used for internal thread which is ran for
	  incoming packet processing.

config ETH_ENC424J600_RX_THREAD_PRIO
	int "Priority for internal incoming packet handler"
	default 2
	help
	  Priority level for internal thread which is ran for incoming
	  packet processing.

config ETH_ENC424J600_TIMEOUT
	int "IP buffer timeout"
	default 100
	help
	  Given timeout in milliseconds. Maximum amount of time
	  that the driver will wait from the IP stack to get
	  a memory buffer before the Ethernet frame is dropped.

config ETH_ENC424J600_DEBUG_UNKNOWN_INTERRUPT
	bool "Debug unknown interrupts"
	help
	  Will stop the driver from responding to interrupts when an
	  unknown interrupt has been detected. Useful for debugging the
	  ethernet driver.

endif
```

## drivers/ethernet/Kconfig.gd32
```kconfig
# Copyright (c) 2022 Carbon Robotics
# SPDX-License-Identifier: Apache-2.0

DT_COMPAT_GD_GD32_ETHERNET := gd,gd32-ethernet

menuconfig ETH_GD32_HAL
	bool "GigaDevice GD32 HAL Ethernet driver"
	default y if $(dt_compat_enabled,$(DT_COMPAT_GD_GD32_ETHERNET))
	select USE_GD32_ENET
	select USE_GD32_SYSCFG
	help
	  Enable GigaDevice GD32 HAL based Ethernet driver.

if ETH_GD32_HAL

config ETH_GD32_HAL_RX_THREAD_STACK_SIZE
	int "RX thread stack size"
	default 1500
	help
	  RX thread stack size

config ETH_GD32_HAL_RX_NET_PKT_ALLOC_TIMEOUT_MS
	int "Network interface RX packet allocation timeout"
	default 100
	help
	  Network interface RX net_pkt allocation timeout in milliseconds.

config ETH_GD32_HAL_RX_THREAD_PRIO
	int "RX thread priority"
	default 2
	help
	  RX thread priority

config ETH_GD32_HAL_PHY_ADDRESS
	int "PHY address"
	default 1
	help
	  The phy address to use.

choice ETH_GD32_HAL_PHY
	prompt "PHY chip"
	default ETH_GD32_HAL_PHY_DP83848

config ETH_GD32_HAL_PHY_DP83848
	bool "DP83848"
	help
	  Use DP83848 PHY.

config ETH_GD32_HAL_PHY_LAN8700
	bool "LAN8700"
	help
	  Use LAN8700 series PHY.

endchoice

config ETH_GD32_HAL_MII
	bool "Use MII interface"
	help
	  Use the MII physical interface instead of RMII.

config ETH_GD32_CARRIER_CHECK_RX_IDLE_TIMEOUT_MS
	int "Carrier check timeout period (ms)"
	default 500
	range 100 30000
	help
	  Set the RX idle timeout period in milliseconds after which the
	  PHY's carrier status is re-evaluated.

config PTP_CLOCK_GD32_HAL
	bool "GigaDevice GD32 HAL PTP clock driver support"
	default y
	depends on PTP_CLOCK || NET_L2_PTP
	help
	  Enable GigaDevice GD32 PTP clock support.

config ETH_GD32_HAL_PTP_CLOCK_SRC_HZ
	int "Frequency of the clock source for the PTP timer"
	default 50000000
	depends on PTP_CLOCK_GD32_HAL
	help
	  Set the frequency in Hz sourced to the PTP timer.
	  If the value is set properly, the timer will be accurate.

config ETH_GD32_HAL_PTP_CLOCK_ADJ_MIN_PCT
	int "Lower bound of clock frequency adjustment (in percent)"
	default 90
	depends on PTP_CLOCK_GD32_HAL
	help
	  Specifies lower bound of PTP clock rate adjustment.

config ETH_GD32_HAL_PTP_CLOCK_ADJ_MAX_PCT
	int "Upper bound of clock frequency adjustment (in percent)"
	default 110
	depends on PTP_CLOCK_GD32_HAL
	help
	  Specifies upper bound of PTP clock rate adjustment.

config ETH_GD32_HAL_PTP_CLOCK_INIT_PRIO
	int
	default 85
	depends on PTP_CLOCK_GD32_HAL
	help
	  GigaDevice GD32 PTP Clock initialization priority level.
	  There is a dependency from the network stack that this device
	  initializes before network stack (NET_INIT_PRIO).

endif # ETH_GD32_HAL
```

## drivers/ethernet/Kconfig.gecko
```kconfig
# Copyright (c) 2019 Interay Solutions B.V.
# Copyright (c) 2019 Oane Kingma
# SPDX-License-Identifier: Apache-2.0

menuconfig ETH_GECKO
	bool "SiLabs Gecko Ethernet driver"
	help
	  Enable Ethernet driver for Silicon Labs Gecko chips.

if ETH_GECKO

config ETH_GECKO_IRQ_PRI
	int "Interrupt priority"
	default 0
	help
	  IRQ priority of Ethernet device

config ETH_GECKO_RX_THREAD_STACK_SIZE
	int "RX thread stack size"
	default 1500
	help
	  RX thread stack size

config ETH_GECKO_RX_THREAD_PRIO
	int "RX thread priority"
	default 2
	help
	  RX thread priority

config ETH_GECKO_CARRIER_CHECK_RX_IDLE_TIMEOUT_MS
	int "Carrier check timeout period (ms)"
	default 500
	range 100 30000
	help
	  Set the RX idle timeout period in milliseconds after which the
	  PHY's carrier status is re-evaluated.

endif # ETH_GECKO
```

## drivers/ethernet/Kconfig.ivshmem
```kconfig
# IVSHMEM Ethernet driver configuration options

# Copyright (c) 2023 Enphase Energy
# SPDX-License-Identifier: Apache-2.0

menuconfig ETH_IVSHMEM
	bool "Inter-VM shared memory Ethernet driver"
	select PCIE
	select VIRTUALIZATION
	select IVSHMEM_V2
	select IVSHMEM_DOORBELL
	select OPENAMP
	help
	  Enable Inter-VM Shared Memory Ethernet driver.
	  Used for Ethernet communication between "cells" in the Jailhouse hypervisor.

if ETH_IVSHMEM

config ETH_IVSHMEM_THREAD_STACK_SIZE
	int "IVSHMEM Ethernet thread stack size"
	default 4096

config ETH_IVSHMEM_THREAD_PRIORITY
	int "IVSHMEM Ethernet thread priority"
	default 2

endif # ETH_IVSHMEM
```

## drivers/ethernet/Kconfig.ksdk
```kconfig
# Kconfig - ETH_KSDK Ethernet driver configuration options

# Copyright (c) 2016 ARM Ltd
#
# Licensed under the Apache License, Version 2.0 (the "License");
# you may not use this file except in compliance with the License.
# You may obtain a copy of the License at
#
#     http://www.apache.org/licenses/LICENSE-2.0
#
# Unless required by applicable law or agreed to in writing, software
# distributed under the License is distributed on an "AS IS" BASIS,
# WITHOUT WARRANTIES OR CONDITIONS OF ANY KIND, either express or implied.
# See the License for the specific language governing permissions and
# limitations under the License.

menuconfig ETH_KSDK
	bool
	prompt "KSDK Ethernet driver"
	depends on ETHERNET && HAS_KSDK
	default n
	help
	Enable KSDK Ethernet driver.  Note, this driver performs one shot PHY
	setup.  There is no support for PHY disconnect, reconnect or
	configuration change.

if ETH_KSDK
config ETH_KSDK_RX_BUFFERS
	int "Number of KSDK RX buffers"
	depends on ETH_KSDK
	default 2
	range 1 16
	help
	Set the number of RX buffers provided to the KSDK driver.

config ETH_KSDK_TX_BUFFERS
	int "Number of KSDK TX buffers"
	depends on ETH_KSDK
	default 2
	range 1 16
	help
	Set the number of TX buffers provided to the KSDK driver.

config ETH_KSDK_0
	bool "KSDK Ethernet port 0"
	default n
	help
	Include port 0 driver

config ETH_KSDK_0_NAME
	string "Driver name"
	depends on ETH_KSDK_0
	default "ETH_0"

config ETH_KSDK_0_IRQ_PRI
	int "Controller interrupt priority"
	depends on ETH_KSDK_0
	default 0
	help
	IRQ priority

config ETH_KSDK_0_RANDOM_MAC
	bool "Random MAC address"
	depends on ETH_KSDK_0 && RANDOM_GENERATOR
	default y
	help
	Generate a random MAC address dynamically.

if ETH_KSDK_0 && ! ETH_KSDK_0_RANDOM_MAC

config ETH_KSDK_0_MAC0
	hex "MAC Address Byte 0"
	default 0
	range 0 ff
	help
	This is byte 0 of the MAC address.

config ETH_KSDK_0_MAC1
	hex "MAC Address Byte 1"
	default 0
	range 0 ff
	help
	This is the byte 1 of the MAC address.

config ETH_KSDK_0_MAC2
	hex "MAC Address Byte 2"
	default 0
	range 0 ff
	help
	This is the byte 2 of the MAC address.

config ETH_KSDK_0_MAC3
	hex "MAC Address Byte 3"
	default 0
	range 0 ff
	help
	This is the byte 3 of the MAC address.

config ETH_KSDK_0_MAC4
	hex "MAC Address Byte 4"
	default 0
	range 0 ff
	help
	This is the byte 4 of the MAC address.

config ETH_KSDK_0_MAC5
	hex "MAC Address Byte 5"
	default 0
	range 0 ff
	help
	This is the byte 5 of the MAC address.
endif
endif
```

## drivers/ethernet/Kconfig.lan78xx
```kconfig
# LAN78xx USB Ethernet Controller configuration options
#
# Copyright (c) 2026 Narek Aydinyan
# SPDX-License-Identifier: Apache-2.0

config ETH_LAN78XX
	bool "LAN78xx USB Ethernet Controller"
	default y
	depends on DT_HAS_MICROCHIP_LAN78XX_ENABLED
	depends on USB_HOST_STACK
	help
	  Enable support for Microchip LAN78xx USB Ethernet adapters.

	  The driver implementation is expected to live under the Ethernet
	  driver subsystem even though the device is attached through the
	  USB host stack.
```

## drivers/ethernet/Kconfig.lan865x
```kconfig
# Copyright (c) 2023 DENX Software Engineering GmbH
# SPDX-License-Identifier: Apache-2.0

menuconfig ETH_LAN865X
	bool "LAN865X 10BASE-T1S Controller"
	default y
	depends on DT_HAS_MICROCHIP_LAN865X_ENABLED
	select SPI
	select NET_L2_ETHERNET_MGMT
	select OA_TC6
	help
	  The LAN865X is a low power, 10BASE-T1S transceiver compliant with
	  the IEEE® 802.3cg-2019™ Ethernet standard for long reach, 10
	  Mbps single pair Ethernet (SPE).

	  Featuring an integrated media access control (MAC) and a PHY,
	  the LAN865X enables direct connectivity with a variety of controllers
	  via a serial peripheral inter-face (SPI).

if ETH_LAN865X

config ETH_LAN865X_INIT_PRIORITY
	int "LAN865X driver init priority"
	default 50
	help
	  LAN865X device driver initialization priority.
	  Must be initialized after SPI.

endif # ETH_LAN865X
```

## drivers/ethernet/Kconfig.liteeth
```kconfig
# Copyright (c) 2019 Antmicro
# SPDX-License-Identifier: Apache-2.0

menuconfig ETH_LITEETH
	bool "LiteEth Ethernet core driver"
	default y
	depends on DT_HAS_LITEX_ETH0_ENABLED

if ETH_LITEETH

config ETH_LITEETH_0
	bool "LiteEth Ethernet port 0"
	default y

endif
```

## drivers/ethernet/Kconfig.litex
```kconfig
# Copyright (c) 2019 Antmicro
# SPDX-License-Identifier: Apache-2.0

config ETH_LITEX_LITEETH
	bool "LiteX LiteEth Ethernet core driver"
	default y
	depends on DT_HAS_LITEX_ETH0_ENABLED
```

## drivers/ethernet/Kconfig.lowRISC
```kconfig
# Copyright (c) Recogni


menuconfig ETH_LOWRISC
	bool "Low Risc Ethernet driver"
	help
	  Enable LowRISC Ethernet driver.

config ETH_NIC_MODEL
	string
	default "lowRISC"
	depends on ETH_LOWRISC
	help
	  Tells what Qemu network model to use. This value is given as
	  a parameter to -nic qemu command line option.

config ETH_LOWRISC_VERBOSE_DEBUG
        bool "Enable hexdump of the received and sent frames"
        help
          Enabling this will turn on the hexdump of the received and sent
          frames. Do not leave on for production.
```

## drivers/ethernet/Kconfig.mcux
```kconfig
# ETH_MCUX Ethernet driver configuration options

# Copyright (c) 2016-2017 ARM Ltd
# SPDX-License-Identifier: Apache-2.0

menuconfig ETH_MCUX
	bool "MCUX Ethernet driver"
	depends on HAS_MCUX_ENET
	select NOCACHE_MEMORY if HAS_MCUX_CACHE
	select ARM_MPU if CPU_CORTEX_M7
	select NET_POWER_MANAGEMENT if DEVICE_POWER_MANAGEMENT
	help
	  Enable MCUX Ethernet driver.  Note, this driver performs one shot PHY
	  setup.  There is no support for PHY disconnect, reconnect or
	  configuration change.

if ETH_MCUX

config ETH_MCUX_PROMISCUOUS_MODE
	bool "Enable promiscuous mode"
	help
	  Place the Ethernet receiver in promiscuous mode. This may be useful
	  for debugging and not needed for normal work.

config ETH_MCUX_RMII_EXT_CLK
	bool "Enable RMII clock from external sources"
	help
	  Setting this option will configure MCUX clock block to feed RMII
	  reference clock from external source (ENET_1588_CLKIN)

config ETH_MCUX_NO_PHY_SMI
	bool "Do not use SMI for PHY communication"
	help
	  Some PHY devices, with DSA capabilities do not use SMI for
	  communication with MAC ENET controller. Other busses - like SPI
	  or I2C are used instead.

config ETH_MCUX_PHY_TICK_MS
	int "PHY poll period (ms)"
	default 1000
	range 100 30000
	help
	  Set the PHY status polling period.

config ETH_MCUX_PHY_EXTRA_DEBUG
	bool "Enable additional detailed PHY debug"
	help
	  Enable additional PHY related debug information related to
	  PHY status polling.

config ETH_MCUX_RX_BUFFERS
	int "Number of MCUX RX buffers"
	default 1
	range 1 16
	help
	  Set the number of RX buffers provided to the MCUX driver.

config ETH_MCUX_TX_BUFFERS
	int "Number of MCUX TX buffers"
	default 1
	range 1 1
	help
	  Set the number of TX buffers provided to the MCUX driver.

config ETH_MCUX_0
	bool "MCUX Ethernet port 0"
	help
	  Include port 0 driver

config ETH_MCUX_1
	bool "MCUX Ethernet port 1"
	depends on SOC_MIMXRT1062 || SOC_MIMXRT1064
	help
	  Include port 1 driver

config ETH_MCUX_HW_ACCELERATION
	bool "Enable hardware acceleration"
	help
	  Enable hardware acceleration for the following:
	  - IPv4, UDP and TCP checksum (both Rx and Tx)

config PTP_CLOCK_MCUX
	bool "MCUX PTP clock driver support"
	default y
	depends on PTP_CLOCK && NET_PKT_TIMESTAMP
	help
	  Enable MCUX PTP clock support.

if PTP_CLOCK_MCUX

config ETH_MCUX_PTP_RX_BUFFERS
	int "Size of the RX timestamp ring buffer"
	default 10
	help
	  Set the number of RX buffers provided to the MCUX driver
	  to store timestamps.

config ETH_MCUX_PTP_TX_BUFFERS
	int "Size of the TX timestamp ring buffer"
	default 10
	help
	  Set the number of TX buffers provided to the MCUX driver
	  to store timestamps.

config ETH_MCUX_PTP_CLOCK_SRC_HZ
	int "Frequency of the clock source for the PTP timer"
	default 50000000
	help
	  Set the frequency in Hz sourced to the PTP timer.
	  If the value is set properly, the timer will be accurate.

endif # PTP_CLOCK_MCUX

endif # ETH_MCUX
```
