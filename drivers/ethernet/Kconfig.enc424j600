## drivers/ethernet/Kconfig.pic32cxsg_gmac
```kconfig
# Microchip PIC32CXSG Ethernet (GMAC) driver configuration options

# Copyright (c) 2024 Microchip
# SPDX-License-Identifier: Apache-2.0

menuconfig ETH_PIC32CXSG_GMAC
	bool "Microchip PIC32CXSG Ethernet driver"
	default y
	depends on NET_BUF_FIXED_DATA_SIZE
	depends on DT_HAS_MICROCHIP_PIC32CXSG_GMAC_ENABLED || \
		   DT_HAS_MICROCHIP_PIC32CXSG_GMAC_ENABLED
	select NOCACHE_MEMORY if ARCH_HAS_NOCACHE_MEMORY_SUPPORT
	select MDIO
	help
	  Enable Microchip PIC32CXSG MCU Family Ethernet driver.

if ETH_PIC32CXSG_GMAC

# Workaround for not being able to have commas in macro arguments
DT_ETH_PIC32CXSG_GMAC_PATH := $(dt_nodelabel_path,gmac)

# Just for readability, to keep the following lines shorter.
DT_ETH_PIC32CXSG_GMAC_NQ := $(dt_node_int_prop_int,$(DT_ETH_PIC32CXSG_GMAC_PATH),num-queues)

config ETH_PIC32CXSG_GMAC_QUEUES
	int "Number of active hardware TX and RX queues"
	default 1
	range 1 $(DT_ETH_PIC32CXSG_GMAC_NQ) if SOC_SERIES_PIC32CXSG41 || \
						SOC_SERIES_PIC32CXSG60 || \
						SOC_SERIES_PIC32CXSG61
	help
	  Select the number of hardware queues used by the driver. Packets will be
	  routed to appropriate queues based on their priority.

config ETH_PIC32CXSG_GMAC_FORCE_QUEUE
	bool "Force all traffic to be routed through a specific queue"
	depends on ETH_PIC32CXSG_GMAC_QUEUES > 1
	depends on NET_TC_RX_COUNT < 5
	help
	  This option is meant to be used only for debugging. Use it to force all
	  traffic to be routed through a specific hardware queue. With this enabled
	  it is easier to verify whether the chosen hardware queue actually works.
	  This works only if there are four or fewer RX traffic classes enabled, as
	  the PIC32CXSG GMAC hardware supports screening up to four traffic classes.

config ETH_PIC32CXSG_GMAC_FORCED_QUEUE
	int "Queue to force the packets to"
	depends on ETH_PIC32CXSG_GMAC_FORCE_QUEUE
	default 0
	range 0 1 if ETH_PIC32CXSG_GMAC_QUEUES = 2
	range 0 2 if ETH_PIC32CXSG_GMAC_QUEUES = 3
	range 0 3 if ETH_PIC32CXSG_GMAC_QUEUES = 4
	range 0 4 if ETH_PIC32CXSG_GMAC_QUEUES = 5
	range 0 5 if ETH_PIC32CXSG_GMAC_QUEUES = 6
	help
	  Which queue to force the routing to. This affects both the TX and RX queues
	  setup.

config ETH_PIC32CXSG_GMAC_BUF_RX_COUNT
	int "Network RX buffers preallocated by the PIC32CXSG ETH driver"
	default 12
	help
	  Number of network buffers that will be permanently allocated by the
	  Ethernet driver. These buffers are used in receive path. They are
	  preallocated by the driver and made available to the GMAC module to be
	  filled in with incoming data. Their number has to be large enough to fit
	  at least one complete Ethernet frame. PIC32CXSG ETH driver will always allocate
	  that amount of buffers for itself thus reducing the NET_BUF_RX_COUNT
	  which is a total amount of RX data buffers used by the whole networking
	  stack. One has to ensure that NET_PKT_RX_COUNT is large enough to
	  fit at least two Ethernet frames: one being received by the GMAC module
	  and the other being processed by the higher layer networking stack.

config ETH_PIC32CXSG_GMAC_MAC_I2C_EEPROM
	bool "Read from an I2C EEPROM"
	help
	  Read MAC address from an I2C EEPROM.

if ETH_PIC32CXSG_GMAC_MAC_I2C_EEPROM

config ETH_PIC32CXSG_GMAC_MAC_I2C_INT_ADDRESS
	hex "I2C EEPROM internal address"
	range 0 0xffffffff
	help
	  Internal address of the EEPROM chip where the MAC address is stored.
	  Chips with 1 to 4 byte internal address size are supported. Address
	  size has to be configured in a separate Kconfig option.

config ETH_PIC32CXSG_GMAC_MAC_I2C_INT_ADDRESS_SIZE
	int "I2C EEPROM internal address size"
	default 1
	range 1 4
	help
	  Size (in bytes) of the internal EEPROM address.

endif # ETH_PIC32CXSG_GMAC_MAC_I2C_EEPROM

config PTP_CLOCK_PIC32CXSG_GMAC
	bool "PIC32CXSG GMAC PTP clock driver support"
	default y
	depends on PTP_CLOCK
	help
	  Enable PIC32CXSG GMAC PTP Clock support.

endif # ETH_PIC32CXSG_GMAC
```

## drivers/ethernet/Kconfig.renesas_ra
```kconfig
# Copyright (c) 2024 Renesas Electronics Corporation
# SPDX-License-Identifier: Apache-2.0

config ETH_RENESAS_RA
	bool "Renesas RA Ethernet"
	default y
	depends on DT_HAS_RENESAS_RA_ETHERNET_ENABLED
	select USE_RA_FSP_ETHER
	help
	  Enable Renesas RA Ethernet Driver.

if ETH_RENESAS_RA

config ETH_RA_RX_THREAD_STACK_SIZE
	int "Stack size for internal incoming packet handler"
	default 1500
	help
	  Size of the stack used for internal thread which is ran for
	  incoming packet processing.

config ETH_RA_RX_THREAD_PRIORITY
	int "Renesas RA Ethernet receive thread priority"
	default 2

config ETH_RENESAS_TX_BUF_NUM
	int "Number of Transmit buffer"
	default 4
	range 1 8

config ETH_RENESAS_RX_BUF_NUM
	int "Number of Receive buffer"
	default 4
	range 1 8

config ETH_RENESAS_RA_USE_NS_BUF
	bool "Use non-secure section for buffers"
	default y if SOC_SERIES_RA6M5 || SOC_SERIES_RA6M4
	depends on CPU_HAS_TEE
	depends on !ARM_SECURE_FIRMWARE && !ARM_NONSECURE_FIRMWARE

endif
```

## drivers/ethernet/Kconfig.renesas_ra_rmac
```kconfig
# Copyright (c) 2025 Renesas Electronics Corporation
# SPDX-License-Identifier: Apache-2.0

config ETH_RENESAS_RA_RMAC
	bool "Renesas RA ethernet RMAC driver"
	default y
	depends on DT_HAS_RENESAS_RA_ETHERNET_RMAC_ENABLED
	select USE_RA_FSP_RMAC
	select USE_RA_FSP_LAYER3_SWITCH
	select NOCACHE_MEMORY if ARCH_HAS_NOCACHE_MEMORY_SUPPORT
	select NET_BRIDGE_HW_OFFLOAD_SUPPORTED
	help
	  Add support for Renesas RA ethernet device driver.

if ETH_RENESAS_RA_RMAC

config ETH_RENESAS_RA_RX_THREAD_STACK_SIZE
	int "Stack size for internal incoming packet handler"
	default 1500
	help
	  Size of the stack used for internal thread which is ran for
	  incoming packet processing.

config ETH_RENESAS_RA_RX_THREAD_PRIORITY
	int "Renesas RA Ethernet receive thread priority"
	default 2

config ETH_RENESAS_RA_USE_HW_WRITEBACK
	bool "Wait hardware writeback of ethernet buffers"
	default y
	help
	  Enable this option to wait for Ethernet descriptor writeback, ensuring
	  that the TX frame is written successfully. Note that enabling this option
	  may cause ethernet write operations to take slightly longer.

config ETH_RENESAS_RA_HW_BRIDGE
	bool "Hardware bridge offload for RA8T2 RMAC"
	depends on NET_BRIDGE_HW_OFFLOAD
	default y
	help
	  Enable hardware-accelerated L2 bridge using the RA8T2 ESWM
	  MAC forwarding table. Known unicast is forwarded between ports
	  by hardware without CPU involvement. Unknown unicast and
	  broadcast still pass through the CPU.

config ETH_RENESAS_RA_HW_BRIDGE_MAC_AGING_TIME
	int "Hardware bridge MAC table aging time (seconds)"
	depends on ETH_RENESAS_RA_HW_BRIDGE
	default 300
	range 10 3600
	help
	  Time in seconds before an inactive hardware MAC table entry is
	  removed from the ESWM forwarding table. Shorter values recover
	  faster after a host moves to a different port; longer values
	  reduce re-learning overhead on stable networks.
	  IEEE 802.1D recommends 300 seconds as the default.

endif
```

## drivers/ethernet/Kconfig.sam_gmac
```kconfig
# Atmel SAM Ethernet (GMAC) driver configuration options

# Copyright (c) 2016 Piotr Mienkowski
# SPDX-License-Identifier: Apache-2.0

menuconfig ETH_SAM_GMAC
	bool "Atmel SAM Ethernet driver"
	default y
	depends on NET_BUF_FIXED_DATA_SIZE
	depends on DT_HAS_ATMEL_SAM_GMAC_ENABLED || \
		   DT_HAS_ATMEL_SAM0_GMAC_ENABLED
	select NOCACHE_MEMORY if ARCH_HAS_NOCACHE_MEMORY_SUPPORT
	select MDIO
	select PINCTRL
	help
	  Enable Atmel SAM MCU Family Ethernet driver.

if ETH_SAM_GMAC

# Workaround for not being able to have commas in macro arguments
DT_ETH_SAM_GMAC_PATH := $(dt_nodelabel_path,gmac)

# Just for readability, to keep the following lines shorter.
DT_ETH_SAM_GMAC_NQ := $(dt_node_int_prop_int,$(DT_ETH_SAM_GMAC_PATH),num-queues)

config ETH_SAM_GMAC_QUEUES
	int "Number of active hardware TX and RX queues"
	default 1
	range 1 $(DT_ETH_SAM_GMAC_NQ) if SOC_SERIES_SAME70 || \
						SOC_SERIES_SAMV71 || \
						SOC_SERIES_SAM4E || \
						SOC_SERIES_SAME54
	help
	  Select the number of hardware queues used by the driver. Packets will be
	  routed to appropriate queues based on their priority.

config ETH_SAM_GMAC_FORCE_QUEUE
	bool "Force all traffic to be routed through a specific queue"
	depends on ETH_SAM_GMAC_QUEUES > 1
	depends on NET_TC_RX_COUNT < 5
	help
	  This option is meant to be used only for debugging. Use it to force all
	  traffic to be routed through a specific hardware queue. With this enabled
	  it is easier to verify whether the chosen hardware queue actually works.
	  This works only if there are four or fewer RX traffic classes enabled, as
	  the SAM GMAC hardware supports screening up to four traffic classes.

config ETH_SAM_GMAC_FORCED_QUEUE
	int "Queue to force the packets to"
	depends on ETH_SAM_GMAC_FORCE_QUEUE
	default 0
	range 0 1 if ETH_SAM_GMAC_QUEUES = 2
	range 0 2 if ETH_SAM_GMAC_QUEUES = 3
	range 0 3 if ETH_SAM_GMAC_QUEUES = 4
	range 0 4 if ETH_SAM_GMAC_QUEUES = 5
	range 0 5 if ETH_SAM_GMAC_QUEUES = 6
	help
	  Which queue to force the routing to. This affects both the TX and RX queues
	  setup.

config ETH_SAM_GMAC_BUF_RX_COUNT
	int "Network RX buffers preallocated by the SAM ETH driver"
	default 12
	help
	  Number of network buffers that will be permanently allocated by the
	  Ethernet driver. These buffers are used in receive path. They are
	  preallocated by the driver and made available to the GMAC module to be
	  filled in with incoming data. Their number has to be large enough to fit
	  at least one complete Ethernet frame. SAM ETH driver will always allocate
	  that amount of buffers for itself thus reducing the NET_BUF_RX_COUNT
	  which is a total amount of RX data buffers used by the whole networking
	  stack. One has to ensure that NET_PKT_RX_COUNT is large enough to
	  fit at least two Ethernet frames: one being received by the GMAC module
	  and the other being processed by the higher layer networking stack.

config ETH_SAM_GMAC_MAC_I2C_EEPROM
	bool "Read from an I2C EEPROM"
	help
	  Read MAC address from an I2C EEPROM.

if ETH_SAM_GMAC_MAC_I2C_EEPROM

config ETH_SAM_GMAC_MAC_I2C_INT_ADDRESS
	hex "I2C EEPROM internal address"
	range 0 0xffffffff
	help
	  Internal address of the EEPROM chip where the MAC address is stored.
	  Chips with 1 to 4 byte internal address size are supported. Address
	  size has to be configured in a separate Kconfig option.

config ETH_SAM_GMAC_MAC_I2C_INT_ADDRESS_SIZE
	int "I2C EEPROM internal address size"
	default 1
	range 1 4
	help
	  Size (in bytes) of the internal EEPROM address.

endif # ETH_SAM_GMAC_MAC_I2C_EEPROM

config PTP_CLOCK_SAM_GMAC
	bool "SAM GMAC PTP clock driver support"
	default y
	depends on PTP_CLOCK
	help
	  Enable SAM GMAC PTP Clock support.

endif # ETH_SAM_GMAC
```

## drivers/ethernet/Kconfig.smsc911x
```kconfig
# Copyright (c) 2018 Linaro Limited
# SPDX-License-Identifier: Apache-2.0

menuconfig ETH_SMSC911X
	bool "SMSC911x/9220 Ethernet driver"
	default y
	depends on DT_HAS_SMSC_LAN9220_ENABLED
	help
	  Enable driver for SMSC/LAN911x/9220 family of chips.

config ETH_NIC_MODEL
	string
	default "lan9118"
	depends on ETH_SMSC911X
	help
	  Tells what Qemu network model to use. This value is given as
	  a parameter to -nic qemu command line option.
```

## drivers/ethernet/Kconfig.smsc91x
```kconfig
# Copyright (c) 2023 Arm Limited (or its affiliates). All rights reserved.
# SPDX-License-Identifier: Apache-2.0

config ETH_SMSC91X
	bool "SMSC91x Ethernet driver"
	default y
	depends on DT_HAS_SMSC_LAN91C111_ENABLED
	help
	  Enable driver for SMSC/LAN91x family of chips.
```

## drivers/ethernet/Kconfig.stellaris
```kconfig
# ETH_STELLARIS Ethernet driver configuration options

# Copyright (c) 2018 Zilogic Systems
# SPDX-License-Identifier: Apache-2.0

menuconfig ETH_STELLARIS
	bool "TI Stellaris MCU family ethernet driver."
	default y
	depends on DT_HAS_TI_STELLARIS_ETHERNET_ENABLED
	help
	  Stellaris on-board Ethernet Controller

config ETH_NIC_MODEL
	string
	default "stellaris"
	depends on ETH_STELLARIS
	help
	  Tells what Qemu network model to use. This value is given as
	  a parameter to -nic qemu command line option.
```
