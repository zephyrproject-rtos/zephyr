## drivers/ethernet/Kconfig.native_posix
```kconfig
# Native posix ethernet driver configuration options

# Copyright (c) 2018 Intel Corporation
# SPDX-License-Identifier: Apache-2.0

menuconfig ETH_NATIVE_POSIX
	bool "Native Posix Ethernet driver"
	depends on ARCH_POSIX
	help
	  Enable native posix ethernet driver. Note, this driver is run inside
	  a process in your host system.

if ETH_NATIVE_POSIX

config ETH_NATIVE_POSIX_INTERFACE_COUNT
	int "Number of network interfaces created"
	default NET_GPTP_NUM_PORTS if NET_GPTP
	default 1
	range 1 32
	help
	  By default only one network interface is created. It is possible
	  to create multiple interfaces in certain use cases. For example if
	  multiple ports are defined in gPTP, then multiple network interfaces
	  must be created here.

config ETH_NATIVE_POSIX_DRV_NAME
	string "Ethernet driver name"
	default "zeth"
	help
	  This option sets the driver name and name of the network interface
	  in your host system. If there are multiple network interfaces defined,
	  then this value is used as a prefix and the interface names will be
	  zeth0, zeth1, etc.

config ETH_NATIVE_POSIX_DEV_NAME
	string "Host ethernet TUN/TAP device name"
	default "/dev/net/tun"
	help
	  This option sets the TUN/TAP device name in your host system.

config ETH_NATIVE_POSIX_PTP_CLOCK
	bool "PTP clock driver support"
	default y if NET_GPTP
	select PTP_CLOCK
	depends on NET_GPTP
	help
	  Enable PTP clock support.

config ETH_NATIVE_POSIX_RANDOM_MAC
	bool "Random MAC address"
	depends on ENTROPY_GENERATOR
	default y
	help
	  Generate a random MAC address dynamically.

config ETH_NATIVE_POSIX_VLAN_TAG_STRIP
	bool "Strip VLAN tag from Rx frames"
	depends on NET_VLAN
	help
	  Native posix ethernet driver will strip of VLAN tag from
	  Rx Ethernet frames and sets tag information in net packet
	  metadata.

config ETH_NATIVE_POSIX_MAC_ADDR
	string "MAC address for the interface"
	default ""
	depends on !ETH_NATIVE_POSIX_RANDOM_MAC
	help
	  Specify a MAC address for the ethernet interface in the form of
	  six hex 8-bit chars separated by colons (e.g.:
	  aa:33:cc:22:e2:c0).  The default is an empty string, which
	  means the code will make 00:00:5E:00:53:XX, where XX will be
	  random.

config ETH_NATIVE_POSIX_RX_TIMEOUT
	int "Ethernet RX timeout"
	default 1 if NET_GPTP
	default 50
	range 1 100
	help
	  Native posix ethernet driver repeatedly checks for new data.
	  Specify how long the thread sleeps between these checks if no new data
	  available.

endif # ETH_NATIVE_POSIX
```

## drivers/ethernet/Kconfig.nct
```kconfig
# Nuvoton Ethernet driver configuration options

# Copyright (c) 2025 Nuvoton Technology Corporation.
# SPDX-License-Identifier: Apache-2.0

DT_COMPAT_NUVOTON_NCT_ETHERNET := nuvoton,nct-ethernet

config ETH_NCT
	bool "Nuvoton NCT Ethernet driver"
	default y
	depends on DT_HAS_NUVOTON_NCT_ETHERNET_ENABLED
	help
	  This option enables the ethernet driver for NCT family of
	  processors.
	  Say y if you wish to use ethernet on NCT MCU.

config ETH_NCT_RX_THREAD_STACK_SIZE
	int "RX thread stack size"
	default 4096
	help
	  RX thread stack size

config ETH_NCT_RX_THREAD_PRIO
	int "RX thread priority"
	default 3
	help
	  RX thread priority

config ETH_NCT_PHY_ADDRESS
	int "Phy address"
	default 1
	help
	  The phy address to use.

config ETH_NCT_RANDOM_MAC
	bool "Random MAC address"
	depends on ENTROPY_GENERATOR
	default y
	help
	  Generate a random MAC address dynamically.

if !ETH_NCT_RANDOM_MAC

config ETH_NCT6XX_MAC3
	hex "MAC Address Byte 3"
	default 0
	range 0 0xff
	help
	  This is the byte 3 of the MAC address.

config ETH_NCT6XX_MAC4
	hex "MAC Address Byte 4"
	default 0
	range 0 0xff
	help
	  This is the byte 4 of the MAC address.

config ETH_NCT6XX_MAC5
	hex "MAC Address Byte 5"
	default 0
	range 0 0xff
	help
	  This is the byte 5 of the MAC address.

endif

config ETH_NCT_CARRIER_CHECK_RX_IDLE_TIMEOUT_MS
	int "Carrier check timeout period (ms)"
	default 500
	range 100 30000
	help
	  Set the RX idle timeout period in milliseconds after which the
	  PHY's carrier status is re-evaluated.
```

## drivers/ethernet/Kconfig.numicro
```kconfig
# Copyright (c) 2026 Fiona Behrens <me@kloenk.dev>
# SPDX-License-Identifier: Apache-2.0

menuconfig ETH_NUMICRO
	bool "Nuvoton numicro MCU ethernet driver"
	default y
	select PINCTRL
	depends on DT_HAS_NUVOTON_NUMICRO_ETHERNET_ENABLED
	help
	  This option enables the Ethernet driver for Nuvoton Numicro family of
	  processors.
	  Say y if you wish to enable Numicro ETH.

if ETH_NUMICRO

config ETH_NUMICRO_RX_THREAD_STACK_SIZE
	int "RX thread stack size"
	default 1500
	help
	  RX thread stack size

config ETH_NUMICRO_RX_THREAD_PRIO
	int "RX thread priority"
	default 2

config ETH_NUMICRO_RXBUF_COUNT
	int "RX dma buffer count"
	default 4

config ETH_NUMICRO_TXBUF_COUNT
	int "TX dma buffer count"
	default 4

endif
```

## drivers/ethernet/Kconfig.nxp_s32_gmac
```kconfig
# Copyright 2022-2023 NXP
# SPDX-License-Identifier: Apache-2.0

menuconfig ETH_NXP_S32_GMAC
	bool "NXP S32 GMAC driver"
	default y
	depends on DT_HAS_NXP_S32_GMAC_ENABLED
	select NOCACHE_MEMORY if ARCH_HAS_NOCACHE_MEMORY_SUPPORT
	select PINCTRL
	help
	  Enable GMAC/EMAC Ethernet driver for NXP S32 SoCs.

if ETH_NXP_S32_GMAC

config ETH_NXP_S32_TX_RING_LEN
	int "TX ring length"
	default 4
	range 4 128
	help
	  Length of the TX ring. ETH_NXP_S32_TX_RING_BUF_SIZE * ETH_NXP_S32_TX_RING_LEN
	  must be a multiple of TX FIFO block size.

config ETH_NXP_S32_TX_RING_BUF_SIZE
	int "TX ring data buffer size"
	default 1536
	range 64 1536
	help
	  Size, in bytes, of the TX data buffer. The size must be big enough to
	  store one complete Ethernet frame, and be a multiple of the data bus
	  width.

config ETH_NXP_S32_RX_RING_LEN
	int "RX ring length"
	default 4
	range 4 128
	help
	  Length of the RX ring. ETH_NXP_S32_RX_RING_BUF_SIZE * ETH_NXP_S32_RX_RING_LEN
	  must be a multiple of RX FIFO block size.

config ETH_NXP_S32_RX_RING_BUF_SIZE
	int "RX ring data buffer size"
	default 1536
	range 64 1536
	help
	  Size, in bytes, of the RX data buffer. The size must be big enough to
	  store one complete Ethernet frame, and be a multiple of the data bus
	  width.

config ETH_NXP_S32_CLOCK_CONFIG_IDX
	int
	default 1
	help
	  This option specifies the zero-based index of the clock configuration
	  used to initialize the GMAC/EMAC clocks.

config ETH_NXP_S32_RX_THREAD_PRIO
	int "RX thread priority"
	default 2
	help
	  RX thread priority. RX thread is a cooperative thread.

config ETH_NXP_S32_RX_THREAD_STACK_SIZE
	int "RX thread stack size"
	default 1500
	help
	  RX thread stack size.

config ETH_NXP_S32_RX_BUDGET
	int "RX thread budget"
	default 128
	range 1 1024
	help
	  The budget parameter places a limit on the amount of work the driver
	  may do in the RX thread before yielding the processor, in case there
	  is more work to do. This is to prevent the RX thread to starve other
	  threads. Each received frame counts as one unit of work.

config ETH_NXP_S32_LOOPBACK
	bool "MAC loopback"
	help
	  MAC operates in loopback mode. The data is looped back through
	  internal FIFO on to the internal MII/GMII interface, passing through
	  the corresponding transmit PHY interface block.
	  This mode requires the MII/GMII Rx clock input signal to function
	  properly because the transmit clock is not internally looped back.

config ETH_NXP_S32_MULTICAST_FILTER
	bool "Multicast destination address filtering"
	help
	  Enable support for multicast destination address filtering in the MAC.
	  MAC performs imperfect filtering using a 64-bit hash table. The upper
	  6-bits CRC of the received multicast address is used as index to the
	  content of the hash table. Only multicast with the computed hash set
	  in the multicast table will be received and all other multicast is
	  dropped by the MAC. If disabled, all multicast is received by the MAC.

endif # ETH_NXP_S32_GMAC
```

## drivers/ethernet/Kconfig.nxp_s32_netc
```kconfig
# Copyright 2022 NXP
# SPDX-License-Identifier: Apache-2.0

menuconfig ETH_NXP_S32_NETC
	bool "NXP S32 Ethernet Switch and Controller (NETC) driver"
	default y
	depends on (DT_HAS_NXP_S32_NETC_PSI_ENABLED || DT_HAS_NXP_S32_NETC_VSI_ENABLED)
	depends on !NET_TEST
	select MBOX
	select MDIO if DT_HAS_NXP_S32_NETC_PSI_ENABLED
	select NOCACHE_MEMORY if ARCH_HAS_NOCACHE_MEMORY_SUPPORT
	help
	  Enable Ethernet Switch and Controller (NETC) driver for NXP S32 SoCs.

if ETH_NXP_S32_NETC

config ETH_NXP_S32_RX_THREAD_PRIO
	int "RX thread priority"
	default 2
	help
	  RX thread priority. RX thread is a cooperative thread.

config ETH_NXP_S32_RX_THREAD_STACK_SIZE
	int "RX thread stack size"
	default 1500
	help
	  RX thread stack size.

config ETH_NXP_S32_RX_BUDGET
	int "RX thread budget"
	default 128
	range 1 1024
	help
	  The budget parameter places a limit on the amount of work the driver may
	  do in the RX thread before yielding the processor, in case there is more
	  work to do. This is to prevent the RX thread to starve other threads. Each
	  received frame counts as one unit of work.

config ETH_NXP_S32_TX_RING_LEN
	int "TX ring length"
	default 64
	range 8 256
	help
	  Length of the TX ring. The value must be a multiple of 8.

config ETH_NXP_S32_TX_RING_BUF_SIZE
	int "TX ring data buffer size"
	default 1536
	range 64 1536
	help
	  Size, in bytes, of the TX data buffer. The size must be big enough to
	  store one complete Ethernet frame, and be a multiple of 8.

config ETH_NXP_S32_RX_RING_LEN
	int "RX ring length"
	default 64
	range 8 256
	help
	  Length of the RX ring. The value must be a multiple of 8.

config ETH_NXP_S32_RX_RING_BUF_SIZE
	int "RX ring data buffer size"
	default 1536
	range 64 1536
	help
	  Size, in bytes, of the RX data buffer. The size must be big enough to
	  store one complete Ethernet frame, and be a multiple of 8.

config ETH_NXP_S32_RX_IRQ_PACKET_THRESHOLD
	int "RX interrupt coalescing packet threshold"
	default 32
	range 1 511
	help
	  RX interrupt coalescing packet threshold. This values determines the
	  minimum number of packets received before raising an interrupt.

config ETH_NXP_S32_RX_IRQ_TIMER_THRESHOLD
	int "RX interrupt coalescing timer threshold"
	default 60000
	range 1 4294967295
	help
	  RX interrupt coalescing timer threshold, in units of NETC clock cycles.
	  This value determines the maximum amount of time allowed between a first
	  received packet until RX interrupt coalescing packet threshold is reached.
	  If the timer expires before the threshold is reached, an interrupt is
	  raised.

config ETH_NXP_S32_MAC_FILTER_TABLE_SIZE
	int "MAC filter hash table size"
	default 8
	range 8 128
	help
	  Maximum number of entries supported in the MAC filter hash table.

config ETH_NXP_S32_VSI_INIT_PRIORITY
	int
	default 81
	help
	  VSI initialization priority. It must be bigger than PSI init priority
	  (CONFIG_ETH_INIT_PRIORITY) and lower than CONFIG_NET_INIT_PRIO, so
	  that it can start after the PSI but before the networking sub-system.

endif # ETH_NXP_S32_NETC
```

## drivers/ethernet/Kconfig.oa_tc6
```kconfig
# Copyright (c) 2025 Microchip Technology Inc.
# SPDX-License-Identifier: Apache-2.0

menuconfig OA_TC6
	bool "OPEN Alliance TC6 10BASE-T1x MAC-PHY support"
	help
	  This library implements OPEN Alliance TC6 10BASE-T1x MAC-PHY
	  Serial Interface protocol for supporting 10BASE-T1x MAC-PHYs.

if OA_TC6

config OA_TC6_IRQ_THREAD_STACK_SIZE
	int "Stack size of OA TC6 thread that processes IRQ"
	default 512
	help
	  Size of the stack used for internal thread which is ran to
	  process raised INT IRQ.

config OA_TC6_IRQ_THREAD_PRIO
	int "Priority for internal incoming packet handler"
	default 2
	help
	  Priority level for internal thread which is ran for LAN
	  INT IRQ processing.

config OA_TC6_TIMEOUT
	int "IP buffer timeout"
	default 100
	help
	  Given timeout in milliseconds. Maximum amount of time
	  that the driver will wait from the IP stack to get
	  a memory buffer.

config OA_TC6_TX_RX_BUFFER_SIZE
	int "OA SPI TX RX BUFFER SIZE"
	default 31
	help
	  Size of the buffer to transmit and receive SPI chunks to MAC-PHY
	  and from MAC-PHY respectively. One buffer size is equal to 68
	  bytes. (Size of the single OASPI chunk is 68 bytes). Buffer size
	  31 is equal to (31 * 68) 2108 bytes.

endif
```
