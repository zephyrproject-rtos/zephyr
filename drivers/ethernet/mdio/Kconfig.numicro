## drivers/ethernet/mdio/Kconfig.numicro
```kconfig
# Copyright (c) 2026 Fiona Behrens <me@kloenk.dev>
# SPDX-License-Identifier: Apache-2.0

config MDIO_NUMICRO
	bool "Nuvoton MCU mdio driver"
	default y
	depends on DT_HAS_NUVOTON_NUMICRO_MDIO_ENABLED
	select PINCTRL
	help
	  This option enables MDIO driver for Nuvoton Numicro family of
	  processors.
	  Say y if you wish to enable Numicro MDIO.
```

## drivers/ethernet/mdio/Kconfig.nxp_enet_qos
```kconfig
# Copyright 2023 NXP
# SPDX-License-Identifier: Apache-2.0

config MDIO_NXP_ENET_QOS
	bool "NXP ENET QoS MDIO driver"
	default y
	depends on DT_HAS_NXP_ENET_QOS_MDIO_ENABLED
	help
	  Enable NXP ENET QOS (Quality of Service) MDIO driver.

if MDIO_NXP_ENET_QOS

config MDIO_NXP_ENET_QOS_RECHECK_COUNT
	int "Number of times to recheck MDIO transaction status"
	default 3
	help
	  Number of times that the driver should recheck the status
	  of an MDIO bus transaction before timing out
	  Timeout time is:
	  CONFIG_MDIO_NXP_ENET_QOS_RECHECK_TIME * CONFIG_MDIO_NXP_ENET_QOS_RECHECK_COUNT

config MDIO_NXP_ENET_QOS_RECHECK_TIME
	int "Time between rechecks of transaction status (us)"
	default 100
	help
	  The amount of time in microseconds that the driver should
	  busy wait between checks of the MDIO transaction status.
	  Timeout time is:
	  CONFIG_MDIO_NXP_ENET_QOS_RECHECK_TIME * CONFIG_MDIO_NXP_ENET_QOS_RECHECK_COUNT

endif
```

## drivers/ethernet/mdio/Kconfig.nxp_s32_gmac
```kconfig
# Copyright 2023 NXP
# SPDX-License-Identifier: Apache-2.0

menuconfig MDIO_NXP_S32_GMAC
	bool "NXP S32 GMAC MDIO driver"
	default y
	depends on DT_HAS_NXP_S32_GMAC_MDIO_ENABLED
	select CLOCK_CONTROL
	select NOCACHE_MEMORY if ARCH_HAS_NOCACHE_MEMORY_SUPPORT
	select PINCTRL
	help
	  Enable GMAC MDIO driver for NXP S32 SoCs.

if MDIO_NXP_S32_GMAC

config MDIO_NXP_S32_TIMEOUT
	int "Timeout for read/write operations in milliseconds"
	default 2
	help
	  Timeout (in milliseconds) for read/write operations over MDIO.

endif # MDIO_NXP_S32_GMAC
```

## drivers/ethernet/mdio/Kconfig.nxp_s32_netc
```kconfig
# Copyright 2022-2023 NXP
# SPDX-License-Identifier: Apache-2.0

config MDIO_NXP_S32_NETC
	bool "NXP S32 NETC External MDIO driver"
	default y
	depends on DT_HAS_NXP_S32_NETC_EMDIO_ENABLED
	depends on ETH_NXP_S32_NETC && DT_HAS_NXP_S32_NETC_PSI_ENABLED
	select NOCACHE_MEMORY if ARCH_HAS_NOCACHE_MEMORY_SUPPORT
	select PINCTRL
	help
	  Enable NETC External MDIO Controller driver for NXP S32 SoCs.
```

## drivers/ethernet/mdio/Kconfig.renesas_ra
```kconfig
# Copyright (c) 2024 Renesas Electronics Corporation
# SPDX-License-Identifier: Apache-2.0

config MDIO_RENESAS_RA
	bool "RENESAS MDIO controller driver"
	default y
	depends on DT_HAS_RENESAS_RA_MDIO_ENABLED
	select PINCTRL
	select USE_RA_FSP_ETHER_PHY
	help
	  Enable RENESAS MDIO support.
```

## drivers/ethernet/mdio/Kconfig.ti_am62l_cpsw_mdio
```kconfig
# Copyright (c) 2026 Texas Instruments Incorporated
# SPDX-License-Identifier: Apache-2.0

config MDIO_TI_AM62L_CPSW
	bool "TI AM62L CPSW MDIO Driver"
	default y
	depends on DT_HAS_TI_AM62L_CPSW_MDIO_ENABLED
	help
	  Enable TI AM62L CPSW MDIO controller driver.
```

## drivers/ethernet/mdio/Kconfig.xilinx_axi_ethernet_lite
```kconfig
# Copyright 2025 CISPA Helmholtz Center for Information Security
# SPDX-License-Identifier: Apache-2.0

config MDIO_XILINX_AXI_ETHERNET_LITE
	bool "Xilinx AXI Ethernet Lite MDIO driver"
	default y
	depends on DT_HAS_XLNX_XPS_ETHERNETLITE_3_00_A_MDIO_ENABLED || DT_HAS_XLNX_XPS_ETHERNETLITE_1_00_A_MDIO_ENABLED
	help
	  Enable Xilinx AXI Ethernet Lite MDIO bus driver.
```

## drivers/ethernet/mdio/Kconfig.xilinx_axienet
```kconfig
# Copyright 2024 CISPA Helmholtz Center for Information Security gGmbH
# SPDX-License-Identifier: Apache-2.0

config MDIO_XILINX_AXI_ENET
	bool "Xilinx AXI Ethernet MDIO driver"
	default y
	depends on DT_HAS_XLNX_AXI_ETHERNET_1_00_A_MDIO_ENABLED
	help
	  Enable Xilinx AXI Ethernet MDIO bus driver.
```

## drivers/ethernet/mdio/Kconfig.xlnx_gem
```kconfig
# Copyright (c) 2026 Immo Birnbaum
# SPDX-License-Identifier: Apache-2.0

config MDIO_XLNX_GEM
	bool "Xilinx GEM MDIO controller driver"
	default y
	depends on DT_HAS_XLNX_GEM_MDIO_ENABLED
	depends on ETH_XLNX_GEM
	help
	  Enable Xilinx GEM MDIO support.

if MDIO_XLNX_GEM

config MDIO_XLNX_GEM_IDLE_TIMEOUT_US
	int "MDIO idle wait timeout"
	default 1000000
	help
	  Timeout in microseconds to wait for the GEM MDIO Bus
	  to become idle before or after a read or write operation.

endif # MDIO_XLNX_GEM
```

## drivers/ethernet/nxp_enet/Kconfig
```kconfig
# NXP ENET ethernet drivers configuration options

# Copyright (c) 2016-2017 ARM Ltd
# Copyright 2024 NXP
# SPDX-License-Identifier: Apache-2.0

menu "NXP ENET"

choice NXP_ENET_DRIVER
	prompt "NXP ENET Driver Version"
	default ETH_NXP_ENET if DT_HAS_NXP_ENET_MAC_ENABLED
	default ETH_MCUX if DT_HAS_NXP_KINETIS_ETHERNET_ENABLED
	depends on DT_HAS_NXP_ENET_MAC_ENABLED || DT_HAS_NXP_KINETIS_ETHERNET_ENABLED

config ETH_NXP_ENET
	bool "NXP ENET Ethernet driver"
	select NOCACHE_MEMORY if HAS_MCUX_CACHE && CPU_HAS_DCACHE
	select ARM_MPU if CPU_CORTEX_M7
	select MDIO if DT_HAS_NXP_ENET_MDIO_ENABLED
	select NET_POWER_MANAGEMENT if (PM_DEVICE && SOC_FAMILY_KINETIS)
	select ETH_DSA_SUPPORT
	select PINCTRL
	help
	  Enable NXP ENET Ethernet driver.

config ETH_MCUX
	bool "MCUX Ethernet driver"
	select NOCACHE_MEMORY if HAS_MCUX_CACHE && CPU_HAS_DCACHE
	select ARM_MPU if CPU_CORTEX_M7
	select NET_POWER_MANAGEMENT if PM_DEVICE
	select ETH_DSA_SUPPORT
	select DEPRECATED
	select PINCTRL
	help
	  Enable deprecated legacy MCUX Ethernet driver.
	  Note, this driver performs one shot PHY setup.
	  There is no support for PHY disconnect, reconnect or configuration change.

endchoice

if ETH_NXP_ENET

config ETH_NXP_ENET_1G
	bool "1G mode for ENET1G instance"
	default y
	depends on DT_HAS_NXP_ENET1G_ENABLED
	help
	  Enable the use of the ENET1G ethernet instance in 1G mode.

config ETH_NXP_ENET_USE_DTCM_FOR_DMA_BUFFER
	bool "Use DTCM for hardware DMA buffers"
	default y
	help
	  Place the hardware DMA buffers into DTCM for better
	  networking performance.

config ETH_NXP_ENET_HW_ACCELERATION
	bool "Hardware acceleration"
	default y
	depends on !NET_IPV6
	help
	  Enable hardware acceleration for the following:
	  - IPv4, UDP and TCP checksum (both Rx and Tx)

config ETH_NXP_ENET_RX_BUFFERS
	int "Number of RX buffers for ethernet driver"
	default 6
	range 6 16
	help
	  Set the number of RX buffers provided to the NXP ENET driver.

config ETH_NXP_ENET_TX_BUFFERS
	int "Number of TX buffers for ethernet driver"
	default 1
	range 1 16
	help
	  Set the number of TX buffers provided to the NXP ENET driver.

config ETH_NXP_ENET_RX_THREAD_STACK_SIZE
	int "NXP ENET RX thread stack size"
	default 1600
	help
	  ENET RX thread stack size in bytes.

config ETH_NXP_ENET_RX_THREAD_PRIORITY
	int "NXP ENET driver RX cooperative thread priority"
	default 2
	help
	  ENET MAC Driver handles RX in cooperative workqueue thread.
	  This options sets the priority of that thread.

endif # ETH_NXP_ENET

if ETH_MCUX

config ETH_MCUX_PROMISCUOUS_MODE
	bool "Promiscuous mode"
	help
	  Place the Ethernet receiver in promiscuous mode. This may be useful
	  for debugging and not needed for normal work.

config ETH_MCUX_USE_DTCM_FOR_DMA_BUFFER
	bool "Use DTCM for hardware DMA buffers"
	default y
	help
	  Place the hardware DMA buffers into DTCM for better
	  networking performance.

config ETH_MCUX_HW_ACCELERATION
	bool "Hardware acceleration"
	default y
	help
	  Enable hardware acceleration for the following:
	  - IPv4, UDP and TCP checksum (both Rx and Tx)

config ETH_MCUX_RX_BUFFERS
	int "Number of RX buffers for ethernet driver"
	default 6
	range 6 16
	help
	  Set the number of RX buffers provided to the NXP ENET driver.

config ETH_MCUX_TX_BUFFERS
	int "Number of TX buffers for ethernet driver"
	default 1
	range 1 16
	help
	  Set the number of TX buffers provided to the NXP ENET driver.

menu "Legacy driver options"

config ETH_MCUX_RMII_EXT_CLK
	bool "RMII clock from external sources"
	help
	  Setting this option will configure MCUX clock block to feed RMII
	  reference clock from external source (ENET_1588_CLKIN)

config ETH_MCUX_NO_PHY_SMI
	bool "Do not use SMI for PHY communication"
	help
	  Some PHY devices, with DSA capabilities do not use SMI for
	  communication with MAC ENET controller. Other busses - like SPI
	  or I2C are used instead.

config ETH_MCUX_PHY_TICK_MS
	int "PHY poll period (ms)"
	default 1000
	range 100 30000
	help
	  Set the PHY status polling period.

config ETH_MCUX_PHY_EXTRA_DEBUG
	bool "Additional detailed PHY debug"
	help
	  Enable additional PHY related debug information related to
	  PHY status polling.

config ETH_MCUX_PHY_RESET
	bool "Reset the PHY at boot"
	help
	  Reset the ethernet PHY at boot. Requires dts properties int-gpios and
	  reset-gpios to be present.

config PTP_CLOCK_MCUX
	bool "MCUX PTP clock driver support"
	default y
	depends on PTP_CLOCK || NET_L2_PTP
	help
	  Enable MCUX PTP clock support.

if PTP_CLOCK_MCUX

config ETH_MCUX_PTP_CLOCK_SRC_HZ
	int "Frequency of the clock source for the PTP timer"
	default 50000000 if SOC_SERIES_KINETIS_K6X
	default 50000000 if SOC_SERIES_IMXRT10XX
	default 24000000 if SOC_SERIES_IMXRT11XX
	help
	  Set the frequency in Hz sourced to the PTP timer.
	  If the value is set properly, the timer will be accurate.

config ETH_MCUX_PTP_CLOCK_INIT_PRIO
	int
	default 85
	help
	  MCUX PTP Clock initialization priority level. There is
	  a dependency from the network stack that this device
	  initializes before network stack (NET_INIT_PRIO).

endif # PTP_CLOCK_MCUX

endmenu # Legacy options

endif # ETH_MCUX

endmenu # NXP ENET
```

## drivers/ethernet/nxp_imx_netc/Kconfig
```kconfig
# Copyright 2024-2025 NXP
# SPDX-License-Identifier: Apache-2.0

menuconfig ETH_NXP_IMX_NETC
	bool "NXP IMX Ethernet and Network Controller (NETC) driver"
	default y
	depends on DT_HAS_NXP_IMX_NETC_PSI_ENABLED
	select NOCACHE_MEMORY if ARCH_HAS_NOCACHE_MEMORY_SUPPORT
	help
	  Enable Ethernet and Network Controller (NETC) driver for NXP IMX SoCs.

if ETH_NXP_IMX_NETC

DT_GIC_ITS_COMPAT := arm,gic-v3-its
DT_NETC_PATH := $(dt_nodelabel_path,netc)
DT_NETC_INT_PARENT_PATH := $(dt_node_ph_prop_path,$(DT_NETC_PATH),msi-parent)
DT_NETC_INT_IS_GIC := $(dt_node_has_compat,$(DT_NETC_INT_PARENT_PATH),$(DT_GIC_ITS_COMPAT))

config ETH_NXP_IMX_NETC_MSI_GIC
	bool
	default	y if ($(DT_NETC_INT_IS_GIC) && DT_HAS_ARM_GIC_V3_ITS_ENABLED)
	depends on GIC_V3_ITS
	help
	  Use GIC ITS controller as MSI module for NXP NETC

if !ETH_NXP_IMX_NETC_MSI_GIC
config ETH_NXP_IMX_MSGINTR
	int "Message Interrupt module select"
	default 1
	help
	  Message Interrupt module select.
endif

config ETH_NXP_IMX_RX_THREAD_PRIO
	int "RX thread priority"
	default 2
	help
	  RX thread priority. RX thread is a cooperative thread.

config ETH_NXP_IMX_RX_THREAD_STACK_SIZE
	int "RX thread stack size"
	default 1500
	help
	  RX thread stack size.

config ETH_NXP_IMX_RX_BUDGET
	int "RX thread budget"
	default 128
	range 1 1024
	help
	  The budget parameter places a limit on the amount of work the driver may
	  do in the RX thread before yielding the processor, in case there is more
	  work to do. This is to prevent the RX thread to starve other threads. Each
	  received frame counts as one unit of work.

config ETH_NXP_IMX_TX_RING_NUM
	int "TX ring number"
	default 1
	range 1 1023
	help
	  TX ring number used. The actual maximum value may varies from platforms.

config ETH_NXP_IMX_TX_RING_LEN
	int "TX ring length"
	default 8
	range 8 256
	help
	  Length of the TX ring. The value must be a multiple of 8.

config ETH_NXP_IMX_TX_RING_BUF_SIZE
	int "TX ring data buffer size"
	default 1000
	range 64 1536
	help
	  Size, in bytes, of the TX data buffer. The size must be big enough to
	  store one complete Ethernet frame, and be a multiple of 8.

config ETH_NXP_IMX_RX_RING_NUM
	int "RX ring number"
	default 1
	range 1 1023
	help
	  RX ring number used. The actual maximum value may varies from platforms.

config ETH_NXP_IMX_RX_RING_LEN
	int "RX ring length"
	default 8
	range 8 256
	help
	  Length of the RX ring. The value must be a multiple of 8.

config ETH_NXP_IMX_RX_RING_BUF_SIZE
	int "RX ring data buffer size"
	default 1518
	range 64 1536
	help
	  Size, in bytes, of the RX data buffer. The size must be big enough to
	  store one complete Ethernet frame, and be a multiple of 8.

endif # ETH_NXP_IMX_NETC
```

## drivers/ethernet/offload/Kconfig
```kconfig
# Copyright (c) 2026 Madhab Sharma <madhabsharma94@gmail.com>
# SPDX-License-Identifier: Apache-2.0

# zephyr-keep-sorted-start
source "drivers/ethernet/offload/Kconfig.wch9120"
# zephyr-keep-sorted-stop
```

## drivers/ethernet/offload/Kconfig.wch9120
```kconfig
# Copyright (c) 2026 Madhab Sharma <madhabsharma94@gmail.com>
# SPDX-License-Identifier: Apache-2.0
# CH9120 ethernet driver options

menuconfig ETH_CH9120
	bool "ch9120 ethernet driver"
	depends on DT_HAS_WCH_CH9120_ENABLED
	depends on SERIAL_SUPPORT_INTERRUPT
	select UART_INTERRUPT_DRIVEN
	select NET_SOCKETS_OFFLOAD
	select UART_USE_RUNTIME_CONFIGURE
	help
	  This offloads ethernet driver to ch9120 chip. Note: the
	  chip only supports only a single TCP/UDP client connection at
	  a time. Attempting to open a second socket will fail.

if ETH_CH9120

config ETH_CH9120_RX_BUF_SIZE
	int "RX ring buffer size in bytes"
	default 1024
	range 256 4096
	help
	  Size of the receive ring buffer. Increase if dropping
	  data at high throughput.

endif # ETH_CH9120
```
