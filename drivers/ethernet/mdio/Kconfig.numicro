## drivers/ethernet/phy/Kconfig
```kconfig
# Ethernet PHY drivers configuration options

# Copyright (c) 2021 IP-Logix Inc.
# SPDX-License-Identifier: Apache-2.0

menuconfig ETH_PHY_DRIVER
	bool "Ethernet PHY drivers"
	default y if NET_L2_ETHERNET || ETH_DRIVER

if ETH_PHY_DRIVER

module = PHY
module-dep = LOG
module-str = Log level for Ethernet PHY driver
module-help = Sets log level for Ethernet PHY Device Drivers.
source "subsys/net/Kconfig.template.log_config.net"
source "drivers/ethernet/phy/Kconfig.tja1103"
source "drivers/ethernet/phy/Kconfig.dm8806"
source "drivers/ethernet/phy/Kconfig.microchip_t1s"

config PHY_INIT_PRIORITY
	int "Ethernet PHY driver init priority"
	default 70
	help
	  Ethernet PHY device driver initialization priority.
	  Do not mess with it unless you know what you are doing.
	  Note that the priority needs to be lower than the net stack
	  so that it can start before the networking sub-system.

config PHY_GENERIC_MII
	bool "Generic MII PHY Driver"
	default y if DT_HAS_ETHERNET_PHY_ENABLED
	depends on MDIO
	help
	  This is a generic MII PHY interface that communicates with the
	  PHY using the MDIO bus.

config PHY_ADIN2111
	bool "ADIN2111 PHY driver"
	default y
	depends on DT_HAS_ADI_ADIN2111_PHY_ENABLED || DT_HAS_ADI_ADIN1100_PHY_ENABLED
	help
	  Enable ADIN2111 PHY driver.

config PHY_MICROCHIP_KSZ8081
	bool "Microchip KSZ8081 PHY Driver"
	default y
	depends on DT_HAS_MICROCHIP_KSZ8081_ENABLED
	depends on MDIO
	depends on GPIO
	help
	  Enable Microchip KSZ8081 Ethernet PHY Driver

config PHY_MICROCHIP_VSC8541
	bool "Microchip VSC8541 PHY Driver"
	default y
	depends on DT_HAS_MICROCHIP_VSC8541_ENABLED
	depends on MDIO
	depends on GPIO
	help
	  Enable Microchip VSC8541 Ethernet PHY Driver

config PHY_TI_DP83825
	bool "TI DP83825 PHY Driver"
	default y
	depends on DT_HAS_TI_DP83825_ENABLED
	depends on MDIO
	depends on GPIO
	help
	  Enable TI DP83825 Ethernet PHY Driver

config PHY_TI_DP83867
	bool "TI DP83867 PHY Driver"
	default y
	depends on DT_HAS_TI_DP83867_ENABLED
	depends on MDIO
	depends on GPIO
	help
	  Enable TI DP83867 Ethernet PHY Driver

config PHY_REALTEK_RTL8211F
	bool "Realtek RTL8211F PHY Driver"
	default y
	depends on DT_HAS_REALTEK_RTL8211F_ENABLED
	depends on MDIO
	depends on GPIO || (!$(dt_compat_any_has_prop,$(DT_COMPAT_REALTEK_RTL8211F),reset-gpios) && \
			    !$(dt_compat_any_has_prop,$(DT_COMPAT_REALTEK_RTL8211F),int-gpios))
	help
	  Enable Realtek RTL8211F Ethernet PHY Driver

config PHY_QUALCOMM_AR8031
	bool "Qualcomm Atheros AR8031 Ethernet PHY Driver"
	default y
	depends on DT_HAS_QCA_AR8031_ENABLED
	depends on MDIO
	help
	  Enable Qualcomm Atheros AR8031 Ethernet PHY Driver

config PHY_AUTONEG_TIMEOUT_MS
	int "Auto-negotiation timeout value in milliseconds"
	default 4000
	help
	  Maximum duration of auto-negotiation sequence in milliseconds
	  before the process fails

config PHY_MONITOR_PERIOD
	int "Monitor task execution period"
	default 500
	help
	  Monitor task execution period in milliseconds. The monitor task is
	  periodically executed to detect and report any changes in the
	  PHY link status to the operating system.

config PHY_OA_TC14_PLCA_LIB
	bool "Open Alliance TC14 PLCA generic lib"
	help
	  Enable Open Alliance TC14 PLCA generic lib.

config PHY_VERIFY_DEVICE_IDENTIFICATION
	bool "Verify selected phy to actual reported phy chip id"
	help
	  Verify the organizationally unique identifier that is reported
	  by the phy chip.

endif # "Ethernet PHY Drivers"
```

## drivers/ethernet/phy/Kconfig.dm8806
```kconfig
# Copyright 2024 Robert Slawinski <robert.slawinski1@gmail.com>
# SPDX-License-Identifier: Apache-2.0

# Davicom PHY DM8806 driver configuration options

menuconfig PHY_DM8806
	bool "Davicom PHY DM8806 driver"
	default y
	depends on DT_HAS_DAVICOM_DM8806_PHY_ENABLED
	depends on MDIO
	help
	  Enable driver for Davicom DM8806 PHY.

if PHY_DM8806

choice PHY_DM8806_TRIGGER_MODE
	prompt "Trigger mode"
	default PHY_DM8806_TRIGGER_GLOBAL_THREAD
	help
	  Specify the type of triggering to be used by the driver.

config PHY_DM8806_TRIGGER_NONE
	bool "No trigger"

config PHY_DM8806_TRIGGER_GLOBAL_THREAD
	bool "Use global thread"
	depends on GPIO
	select PHY_DM8806_TRIGGER

endchoice

config PHY_DM8806_ENERGY_EFFICIENT_MODE
	bool "Energy efficient mode"
	help
	  By default in DM8806, the energy efficient mode is enabled.
	  It had been observed that the network randomly fails when
	  this mode is on. Thus, this symbol is by default disabled.

config PHY_DM8806_TRIGGER
	bool

config PHY_DM8806_THREAD_PRIORITY
	int "Thread priority"
	depends on PHY_DM8806_TRIGGER_GLOBAL_THREAD
	default 13
	help
	  Priority of thread used by the driver to handle interrupts.

config PHY_DM8806_THREAD_STACK_SIZE
	int "Thread stack size"
	depends on PHY_DM8806_TRIGGER_GLOBAL_THREAD
	default 1024
	help
	  Stack size of thread used by the driver to handle interrupts.

config PHY_DM8806_SMI_BUS_CHECK
	bool "Host SMI bus error check function"
	default y
	help
	  This functionality prevents the host SMI bus to be interferered by the
	  noise on board-level. During write procedure, the written value in
	  register will be applied until the correct checksum is written. In read
	  procedure, the hardware calculated checksum is compared with the software
	  calculated one to detect correctness of received data.

config PHY_DM8806_SMI_BUS_CHECK_REPETITION
	int "SMI bus transmission repetitions"
	depends on PHY_DM8806_SMI_BUS_CHECK
	default 5
	help
	  The numbers of SMI bus transmission repetition in case if CRC checksum
	  fails during read or write. After this numbers of repetition, the reading
	  message is dropped and will not be passed to the system. In write
	  procedure, the written value in register will be applied until the correct
	  checksum is written to the PHY register.

endif # PHY_DM8806
```

## drivers/ethernet/phy/Kconfig.microchip_t1s
```kconfig
# Copyright 2025 Microchip Technology Inc.
# SPDX-License-Identifier: Apache-2.0

config PHY_MICROCHIP_T1S
	bool "Microchip 10BASE-T1S Ethernet PHYs Driver"
	default y
	depends on DT_HAS_MICROCHIP_T1S_PHY_ENABLED
	select MDIO
	select PHY_OA_TC14_PLCA_LIB
	help
	  Enable Microchip's LAN8650/1 Rev.B0/B1 Internal PHYs and
	  LAN8670/1/2 Rev.C1/C2 PHYs Driver.
```

## drivers/ethernet/phy/Kconfig.nxp_t1s
```kconfig
# NXP 10BASE-T1S digital PHY driver configuration options

# Copyright 2026 NXP
# SPDX-License-Identifier: Apache-2.0

config PHY_NXP_T1S
	bool "NXP 10BASE-T1S Ethernet PHY Driver"
	default y
	depends on DT_HAS_NXP_T1S_PHY_ENABLED
	help
	  Enable NXP 10BASE-T1S PHY Driver.
```

## drivers/ethernet/phy/Kconfig.tja1101
```kconfig
# NXP PHY TJA1101 driver configuration options

# Copyright 2024 NXP
# SPDX-License-Identifier: Apache-2.0

menuconfig PHY_TJA1101
	bool "TJA1101 PHY driver"
	default y
	depends on DT_HAS_NXP_TJA1101_ENABLED
	depends on MDIO
	help
	  Enable TJA1101 PHY driver.
```

## drivers/ethernet/phy/Kconfig.tja1103
```kconfig
# NXP PHY TJA1103 driver configuration options

# Copyright 2024 NXP
# SPDX-License-Identifier: Apache-2.0

menuconfig PHY_TJA1103
	bool "TJA1103 PHY driver"
	default y
	depends on DT_HAS_NXP_TJA1103_ENABLED
	select MDIO
	help
	  Enable TJA1103 PHY driver.

if PHY_TJA1103

config PHY_TJA1103_IRQ_THREAD_STACK_SIZE
	int "Stack size for a thread that processes TJA1103 IRQ"
	default 2048
	help
	  Size of the stack used for internal thread which is ran to
	  process raised INT IRQ.

config PHY_TJA1103_IRQ_THREAD_PRIO
	int "Priority for internal incoming packet handler"
	default 2
	help
	  Priority level for internal thread which is ran for TJA1103
	  INT IRQ processing.

endif # PHY_TJA1103
```

## drivers/ethernet/phy/Kconfig.tja11xx
```kconfig
# NXP PHY TJA11xx driver configuration options

# Copyright 2024 NXP
# SPDX-License-Identifier: Apache-2.0

config PHY_TJA11XX
	bool "TJA11XX PHY driver"
	default y
	depends on DT_HAS_NXP_TJA11XX_ENABLED
	select MDIO
	help
	  Enable TJA11xx PHY driver.
```

## drivers/ethernet/smi/Kconfig
```kconfig
# SMI configuration options

# Copyright (c) 2026 Bas van Loon
# SPDX-License-Identifier: Apache-2.0

#
# SMI options
#
menuconfig SMI
	bool "Simple Management Interface (SMI) drivers"
	help
	  Enable SMI Driver Configuration

if SMI

config SMI_SHELL
	bool "SMI Shell"
	depends on SHELL
	help
	  Enable SMI Shell.

	  The SMI shell currently supports scanning and device
	  read/write.

config SMI_GPIO
	bool "GPIO bitbang SMI controller driver"
	default y
	depends on DT_HAS_MICROCHIP_SMI_GPIO_ENABLED
	help
	  Enable software driven (bit banging) SMI support using GPIO pins

config SMI_INIT_PRIORITY
	int "Init priority"
	default ETH_INIT_PRIORITY
	help
	  SMI device driver initialization priority.

module = SMI
module-str = smi
source "subsys/logging/Kconfig.template.log_config"

endif # SMI
```

## drivers/ethernet/usb/Kconfig
```kconfig
# Copyright (c) 2026 Narek Aydinyan
# SPDX-License-Identifier: Apache-2.0

source "drivers/ethernet/usb/Kconfig.lan78xx"
```

## drivers/ethernet/usb/Kconfig.lan78xx
```kconfig
# LAN78xx USB Ethernet Controller configuration options

# Copyright (c) 2026 Narek Aydinyan
# SPDX-License-Identifier: Apache-2.0

menuconfig ETH_LAN78XX
	bool "LAN78xx USB Ethernet Controller"
	default y
	depends on DT_HAS_MICROCHIP_LAN78XX_ENABLED
	select NET_L2_ETHERNET_RESERVE_HEADER
	select USB_HOST_STACK
	help
	  Enable support for Microchip LAN78xx USB Ethernet adapters.

if ETH_LAN78XX

config ETH_LAN78XX_MGMT_STACK_SIZE
	int "LAN78xx management thread stack size"
	default 6144
	help
	  Stack size of the management thread that handles attach, detach,
	  and link polling.

config ETH_LAN78XX_LINK_POLL_MS
	int "LAN78xx link poll interval (ms)"
	default 500
	range 50 60000
	help
	  Periodic PHY/link status poll interval.

config ETH_LAN78XX_RX_BUF_SIZE
	int "LAN78xx USB RX buffer size"
	default 2048
	range 512 16384
	help
	  Bulk-IN transfer buffer size used by the driver.

config ETH_LAN78XX_RX_XFERS
	int "LAN78xx queued RX transfers"
	default 4
	range 1 16
	help
	  Number of concurrent bulk-IN transfers kept queued.

config ETH_LAN78XX_TX_INFLIGHT
	int "LAN78xx in-flight TX transfers"
	default 4
	range 1 16
	help
	  Number of concurrent bulk-OUT transfers kept queued.

config ETH_LAN78XX_MGMT_THREAD_PRIO
	int "LAN78xx management thread priority"
	default 8
	help
	  Priority of the management thread that handles attach, detach,
	  and link polling.

config ETH_LAN78XX_IO_STACK_SIZE
	int "LAN78xx I/O thread stack size"
	default 8192
	help
	  Stack size of the I/O thread that processes RX completions and
	  rearms USB transfers.

config ETH_LAN78XX_IO_THREAD_PRIO
	int "LAN78xx I/O thread priority"
	default 10
	help
	  Priority of the I/O thread that processes RX completions and
	  rearms USB transfers.

endif # ETH_LAN78XX
```

## drivers/fan/Kconfig
```kconfig
# Copyright The Zephyr Project Contributors
# SPDX-License-Identifier: Apache-2.0

menuconfig FAN
	bool "Fan drivers [EXPERIMENTAL]"
	select EXPERIMENTAL
	help
	  Include fan drivers in the system configuration.

if FAN

module = FAN
module-str = fan
source "subsys/logging/Kconfig.template.log_config"

config FAN_INIT_PRIORITY
	int "Fan initialization priority"
	default 90
	help
	  System initialization priority for fan drivers.

rsource "Kconfig.fan_pwm"

endif # FAN
```

## drivers/fan/Kconfig.fan_pwm
```kconfig
# Copyright The Zephyr Project Contributors
# SPDX-License-Identifier: Apache-2.0

menuconfig FAN_PWM
	bool "PWM based fan driver"
	default y
	depends on DT_HAS_FAN_PWM_ENABLED
	select PWM
	help
	  Enable PWM based fan driver

if FAN_PWM

config FAN_PWM_INITIAL_DUTY_CYCLE
	int "Initial PWM duty cycle"
	default 0
	range 0 100
	help
	  Set the initial PWM duty cycle that the fan starts up with

config FAN_PWM_TACHOMETER
	bool "Tachometer reading"
	depends on GPIO
	help
	  Enable tachometer reading

choice FAN_PWM_TACHOMETER_METHOD
	prompt "Tachometer measurement method"
	depends on FAN_PWM_TACHOMETER
	default FAN_PWM_TACHOMETER_INTERRUPT
	help
	  Select how tachometer pulses are counted. Interrupt mode is the most
	  efficient but requires a GPIO that supports edge interrupts and a free
	  EXTI line. Polling mode works on any input GPIO and avoids EXTI line
	  conflicts, at the cost of CPU time spent sampling the pin.

config FAN_PWM_TACHOMETER_INTERRUPT
	bool "Interrupt driven tachometer"
	help
	  Count tachometer pulses using GPIO edge interrupts

config FAN_PWM_TACHOMETER_POLL
	bool "Poll tachometer"
	help
	  Count tachometer pulses by periodically sampling the input GPIO and
	  detecting rising edges in software. Use this when the tachometer GPIO
	  cannot use an edge interrupt, for example because its EXTI line is
	  already in use by another pin.

endchoice # FAN_PWM_TACHOMETER_METHOD

config FAN_PWM_TACHOMETER_MEASURE_MS
	int "Tachometer measurement window (ms)"
	depends on FAN_PWM_TACHOMETER
	default 100
	range 1 10000
	help
	  Duration, in milliseconds, over which tachometer pulses are counted
	  when computing the rotation rate. Longer windows improve accuracy at
	  low speeds but make fan_get_rpm() block for longer.

endif # FAN_PWM
```
