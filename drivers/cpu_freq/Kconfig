## drivers/crypto/Kconfig.mchp
```kconfig
# Copyright (c) 2022 Intel Corporation
# SPDX-License-Identifier: Apache-2.0


config CRYPTO_MCHP_SHA_G1
	bool "Microchip SAM SHA driver"
	default y if DT_HAS_MICROCHIP_SHA_G1_CRYPTO_ENABLED
	help
	  Enable Microchip SAM Secure Hash Algorithm (SHA) driver.

config CRYPTO_MCHP_XEC_SYMCR
	bool "Microchip XEC symmetric crypto (AES/Hash) driver"
	default y
	depends on DT_HAS_MICROCHIP_XEC_SYMCR_ENABLED
	help
	  Enable Microchip XEC symmetric crypto (AES/Hash) driver.
	  Symmetric crypto provides a single hardware interface
	  to AES and hash engines.
```

## drivers/crypto/Kconfig.mcux_dcp
```kconfig
# Copyright (c) 2023 Basalte bv
# SPDX-License-Identifier: Apache-2.0

config CRYPTO_MCUX_DCP
	bool "NXP Data Co-Processor (DCP) driver"
	default y
	depends on HAS_MCUX_CACHE
	depends on DT_HAS_NXP_MCUX_DCP_ENABLED
	select NOCACHE_MEMORY if ARCH_HAS_NOCACHE_MEMORY_SUPPORT
	select CACHE_MANAGEMENT if DCACHE
	help
	  Enable NXP Data Co-Processor (DCP) driver.

config CRYPTO_MCUX_DCP_MAX_SESSION
	int "Maximum number of sessions NXP DCP crypto driver can handle"
	range 1 4
	default 2
	depends on CRYPTO_MCUX_DCP
	help
	  This can be used to tweak the amount of sessions the driver
	  can handle in parallel.
```

## drivers/crypto/Kconfig.mspm0
```kconfig
# Copyright (c) 2026 Linumiz

# SPDX-License-Identifier: Apache-2.0

config CRYPTO_MSPM0_AES
	bool "TI MSPM0 AES driver support"
	default y
	depends on DT_HAS_TI_MSPM0_AES_ENABLED
	depends on CRYPTO
	select USE_MSPM0_DL_AES
	help
	  Enable TI MSPM0 AES driver support

config CRYPTO_MSPM0_MAX_SESSION
	int "Maximum of sessions the mspm0 aes driver can handle"
	default 2
	depends on CRYPTO_MSPM0_AES
	help
	  This can be used to tweak the amount of sessions the driver
	  can handle in parallel
```

## drivers/crypto/Kconfig.npcx
```kconfig
# NPCX SHA driver configuration options

# Copyright (c) 2022 Nuvoton Technology Corporation.
# SPDX-License-Identifier: Apache-2.0

config CRYPTO_NPCX_SHA
	bool "NPCX SHA driver"
	default y
	depends on DT_HAS_NUVOTON_NPCX_SHA_ENABLED
	help
	  Enable NPCX SHA driver.
```

## drivers/crypto/Kconfig.nrf52_cc310_aes
```kconfig
# Nordic CryptoCell 310 (AES electronic codebook mode encryption)

# Copyright (c) 2025 GARDENA GmbH
# SPDX-License-Identifier: Apache-2.0

config CRYPTO_NRF52_CC310_AES
	bool "nrf52 cryptocell AES driver"
	default y
	depends on DT_HAS_ARM_CRYPTOCELL_310_ENABLED
	help
	  Enable hardware accelerated AES driver.


config CRYPTO_NRF52_CC310_AES_MAX_SESSION
	int "max allowed sessions"
	default 1
	depends on CRYPTO_NRF52_CC310_AES
	help
	  This can be used to tweak the amount of sessions the driver
	  can handle in parallel.
```

## drivers/crypto/Kconfig.nrf_ecb
```kconfig
# NRF AES ECB configuration options

# Copyright (c) 2020 Nordic Semiconductor ASA
# SPDX-License-Identifier: Apache-2.0

config CRYPTO_NRF_ECB
	bool "nRF AES electronic codebook mode encryption"
	default y
	depends on DT_HAS_NORDIC_NRF_ECB_ENABLED
	# Bluetooth controller uses the ECB peripheral directly
	# (see subsys/bluetooth/controller/ll_sw/nordic/hal/nrf5/ecb.c),
	# hence this driver cannot be enabled together with it.
	depends on !HAS_BT_CTLR
	help
	  Enable nRF HAL-based AES ECB encryption driver
```

## drivers/crypto/Kconfig.nxp_s32_hse
```kconfig
# Copyright 2025 NXP
# SPDX-License-Identifier: Apache-2.0

menuconfig CRYPTO_NXP_S32_HSE
	bool "NXP S32 HSE crypto driver"
	default y
	depends on DT_HAS_NXP_S32_CRYPTO_HSE_MU_ENABLED
	help
	  Enable NXP HSE crypto driver.

if CRYPTO_NXP_S32_HSE

config CRYPTO_NXP_S32_HSE_OUTPUT_BUFFER_SIZE
	int "HSE crypto service output buffer size in bytes"
	default 128
	help
	  The output buffer size for storing the output data of HSE crypto service, measured in bytes.

config CRYPTO_NXP_S32_HSE_AES_KEY_SIZE
	int "Key size in bits"
	default 128
	help
	  The size of the AES key, measured in bits. Only support for 128 bits or 256 bits.

config CRYPTO_NXP_S32_HSE_AES_KEY_GROUP_ID
	int "The AES Key Group ID within RAM Key Catalog."
	range 0 255
	default 0
	help
	  The AES Key Group ID within RAM Key Catalog.

endif #CRYPTO_NXP_S32_HSE
```
