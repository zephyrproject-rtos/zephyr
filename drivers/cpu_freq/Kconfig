## drivers/cpu_freq/Kconfig
```kconfig
# CPU Frequency configuration options

# Copyright (c) 2025 Intel Corporation
# SPDX-License-Identifier: Apache-2.0

config CPU_FREQ
	bool "Dynamic selection of CPU frequency"
	default n
	help
	  This option allows an application to select at runtime the CPU
	  frequency from a predetermined set of CPU frequencies defined
	  in the device tree.

if CPU_FREQ
config CPU_FREQ_INIT_PRIORITY
	int "Priority of routine to initialize CPU Frequency"
	default 50
	help
	  This option specifies the initialization priority of the
	  CPU frequency.
endif # CPU_FREQ
```

## drivers/crc/Kconfig
```kconfig
# Copyright (c) 2024 Brill Power Ltd.
# SPDX-License-Identifier: Apache-2.0

menuconfig CRC_DRIVER
	bool "CRC device drivers"
	help
	  Enable support for CRC device driver.

if CRC_DRIVER

module = CRC_DRIVER
module-str = CRC_DRIVER

source "subsys/logging/Kconfig.template.log_config"

config CRC_DRIVER_INIT_PRIORITY
	int "CRC init priority"
	default KERNEL_INIT_PRIORITY_DEVICE
	help
	  CRC driver device initialization priority.

source "drivers/crc/Kconfig.renesas_ra"

config CRC_DRIVER_HAS_CRC4
	bool
	help
	  CRC driver has CRC4 computation

config CRC_DRIVER_HAS_CRC4_TI
	bool
	help
	  CRC driver has CRC4 TI computation

config CRC_DRIVER_HAS_CRC7_BE
	bool
	help
	  CRC driver has CRC7 BE computation

config CRC_DRIVER_HAS_CRC8
	bool
	help
	  CRC driver has CRC8 computation

config CRC_DRIVER_HAS_CRC8_CCITT
	bool
	help
	  CRC driver has CRC8 CCITT computation

config CRC_DRIVER_HAS_CRC8_ROHC
	bool
	help
	  CRC driver has CRC8 ROHC computation

config CRC_DRIVER_HAS_CRC16
	bool
	help
	  CRC driver has CRC16 computation

config CRC_DRIVER_HAS_CRC16_CCITT
	bool
	help
	  CRC driver has CRC16 CCITT computation

config CRC_DRIVER_HAS_CRC16_ITU_T
	bool
	help
	  CRC driver has CRC16 ITU-T computation

config CRC_DRIVER_HAS_CRC16_ANSI
	bool
	depends on CRC_DRIVER_HAS_CRC16_REFLECT
	help
	  CRC driver has CRC16 Ansi computation

config CRC_DRIVER_HAS_CRC16_REFLECT
	bool
	help
	  CRC driver has CRC16 reflect computation

config CRC_DRIVER_HAS_CRC24_PGP
	bool
	help
	  CRC driver has CRC24 PGP computation

config CRC_DRIVER_HAS_CRC32_C
	bool
	help
	  CRC driver has CRC32C computation

config CRC_DRIVER_HAS_CRC32_IEEE
	bool
	help
	  CRC driver has CRC32 IEEE computation

config CRC_DRIVER_HAS_CRC32_K_4_2
	bool
	help
	  CRC driver has CRC32K/4.2 computation

endif # CRC_DEVICE
```

## drivers/crc/Kconfig.ambiq
```kconfig
# Ambiq CRC configuration options

# Copyright (c) 2025 Ambiq
# Author: Richard S Wheatley
# SPDX-License-Identifier: Apache-2.0

config CRC_AMBIQ
	bool "Ambiq Apollo510 CRC support"
	default y
	depends on DT_HAS_AMBIQ_HW_CRC32_ENABLED
	select CRC_DRIVER_HAS_CRC32_IEEE
	help
	  Enable hardware-accelerated CRC32 IEEE support for Ambiq
	  Apollo510 SoCs. Uses the SECURITY CRC engine
	  with boundary-crossing protection for TCM and SSRAM regions.
```

## drivers/crc/Kconfig.nxp
```kconfig
# Copyright 2025 NXP
# SPDX-License-Identifier: Apache-2.0

config CRC_DRIVER_NXP
	bool
	depends on DT_HAS_NXP_CRC_ENABLED
	default y
	select CRC_DRIVER_HAS_CRC16
	select CRC_DRIVER_HAS_CRC16_CCITT
	select CRC_DRIVER_HAS_CRC16_ANSI
	select CRC_DRIVER_HAS_CRC16_ITU_T
	select CRC_DRIVER_HAS_CRC16_REFLECT
	select CRC_DRIVER_HAS_CRC32_C
	select CRC_DRIVER_HAS_CRC32_IEEE
	help
	  Enable the driver implementation for NXP microcontrollers
```

## drivers/crc/Kconfig.renesas_ra
```kconfig
# Copyright (c) 2025 Renesas Electronics Corporation
# SPDX-License-Identifier: Apache-2.0

config CRC_DRIVER_RENESAS_RA
	bool
	depends on DT_HAS_RENESAS_RA_CRC_ENABLED
	default y
	select CRC_DRIVER_HAS_CRC8
	select CRC_DRIVER_HAS_CRC8_ROHC
	select CRC_DRIVER_HAS_CRC8_CCITT
	select CRC_DRIVER_HAS_CRC16
	select CRC_DRIVER_HAS_CRC16_CCITT
	select CRC_DRIVER_HAS_CRC16_ANSI
	select CRC_DRIVER_HAS_CRC16_ITU_T
	select CRC_DRIVER_HAS_CRC16_REFLECT
	select CRC_DRIVER_HAS_CRC32_C
	select CRC_DRIVER_HAS_CRC32_IEEE
	select USE_RA_FSP_CRC
	help
	  Enable the driver implementation for Renesas RA microcontrollers
```

## drivers/crc/Kconfig.sf32lb
```kconfig
# Copyright (c) 2025 SiFli Technologies(Nanjing) Co., Ltd
# SPDX-License-Identifier: Apache-2.0

config CRC_DRIVER_SF32LB
	bool "SiFli SF32LB CRC driver"
	depends on DT_HAS_SIFLI_SF32LB_CRC_ENABLED
	default y
	select CRC_DRIVER_HAS_CRC8
	select CRC_DRIVER_HAS_CRC8_ROHC
	select CRC_DRIVER_HAS_CRC8_CCITT
	select CRC_DRIVER_HAS_CRC16
	select CRC_DRIVER_HAS_CRC16_REFLECT
	select CRC_DRIVER_HAS_CRC16_ANSI
	select CRC_DRIVER_HAS_CRC16_CCITT
	select CRC_DRIVER_HAS_CRC16_ITU_T
	select CRC_DRIVER_HAS_CRC32_IEEE
	select CRC_DRIVER_HAS_CRC32_C
	select CRC_DRIVER_HAS_CRC32_K_4_2
	help
	  Enable support for the CRC peripheral present on SiFli SF32LB SoCs.
```

## drivers/crc/Kconfig.silabs
```kconfig
# Copyright (c) 2026 Phuc Hoang
# SPDX-License-Identifier: Apache-2.0

config CRC_DRIVER_SILABS_GPCRC
	bool "Silicon Labs GPCRC driver"
	depends on DT_HAS_SILABS_GPCRC_ENABLED
	default y
	select SILABS_SISDK_GPCRC
	select CRC_DRIVER_HAS_CRC16
	select CRC_DRIVER_HAS_CRC16_ANSI
	select CRC_DRIVER_HAS_CRC16_CCITT
	select CRC_DRIVER_HAS_CRC16_ITU_T
	select CRC_DRIVER_HAS_CRC16_REFLECT
	select CRC_DRIVER_HAS_CRC32_IEEE
	help
	  Enable the General Purpose CRC (GPCRC) driver implementation
	  for Silicon Labs Gecko (EFR32/EFM32) microcontrollers.
```

## drivers/crc/Kconfig.stm32
```kconfig
# SPDX-FileCopyrightText: Copyright (c) 2026 STMicroelectronics
# SPDX-License-Identifier: Apache-2.0

menuconfig CRC_STM32
	bool "STM32 CRC driver"
	default y
	depends on DT_HAS_ST_STM32_CRC_ENABLED
	select CRC_DRIVER_HAS_CRC7_BE
	select CRC_DRIVER_HAS_CRC8
	select CRC_DRIVER_HAS_CRC16
	select CRC_DRIVER_HAS_CRC16_CCITT
	select CRC_DRIVER_HAS_CRC16_REFLECT
	select CRC_DRIVER_HAS_CRC32_C
	select CRC_DRIVER_HAS_CRC32_IEEE
	help
	  Enables STM32 family CRC driver.

if CRC_STM32

config CRC_STM32_DMA
	bool "DMA support"
	select DMA
	help
	  Enable the DMA transfer for CRC instance
	  That enables dma channel in their device tree node
	  for transferring data to the CRC input

if CRC_STM32_DMA

config CRC_STM32_DMA_THRESHOLD
	int "Minimal buffer size for DMA transfers"
	default 1
	range 1 $(UINT32_MAX)
	help
	  Minimum size required to use DMA transfers for copy of
	  buffer provided to crc_update() towards CRC peripheral.

	  If buffer size is superior or equal to this option's value,
	  a DMA transfer is used to copy the buffer's contents towards
	  the CRC peripheral using a DMA transfer (while the transfer
	  is ongoing, another thread can execute on the CPU).

	  If buffer size is strictly less than this option's value,
	  the CPU is used to copy the buffer's contents towards the
	  CRC peripheral (busy CPU copy / DMA not used).

	  The default value of 1 forces a DMA transfer to be used
	  unconditionally by crc_update() regardless of buffer size.

endif # CRC_STM32_DMA

endif # CRC_STM32
```

## drivers/crypto/Kconfig
```kconfig
# Crypto configuration options

# Copyright (c) 2017 Intel Corporation
# SPDX-License-Identifier: Apache-2.0

#
# CRYPTO options
#
menuconfig CRYPTO
	bool "Crypto drivers"

if CRYPTO

config CRYPTO_INIT_PRIORITY
	int "Crypto devices init priority"
	default 90
	help
	  Crypto devices initialization priority.

module = CRYPTO
module-str = CRYPTO
source "subsys/logging/Kconfig.template.log_config"

config CRYPTO_MBEDTLS_SHIM
	bool "Mbed TLS shim driver [EXPERIMENTAL]"
	select PSA_CRYPTO
	select MBEDTLS_ENABLE_HEAP
	imply PSA_WANT_ALG_SHA_224
	imply PSA_WANT_ALG_SHA_256
	imply PSA_WANT_ALG_SHA_384
	imply PSA_WANT_ALG_SHA_512
	imply PSA_WANT_KEY_TYPE_AES
	imply PSA_WANT_ALG_ECB_NO_PADDING
	imply PSA_WANT_ALG_CBC_NO_PADDING
	imply PSA_WANT_ALG_CCM
	imply PSA_WANT_ALG_GCM
	select EXPERIMENTAL
	help
	  Enable Mbed TLS shim layer compliant with crypto APIs. You will need
	  to fill in a relevant value to CONFIG_MBEDTLS_HEAP_SIZE.

config CRYPTO_MBEDTLS_SHIM_DRV_NAME
	string "Device name for mbedTLS Pseudo device"
	default "CRYPTO_MTLS"
	depends on CRYPTO_MBEDTLS_SHIM
	help
	  Device name for mbedTLS Pseudo device.

config CRYPTO_MBEDTLS_SHIM_MAX_SESSION
	int "Maximum of sessions mbedTLS shim driver can handle"
	default 2
	depends on CRYPTO_MBEDTLS_SHIM
	help
	  This can be used to tweak the amount of sessions the driver
	  can handle in parallel.

source "drivers/crypto/Kconfig.*"

endif # CRYPTO
```

## drivers/crypto/Kconfig.ataes132a
```kconfig
# Atmel ATAES132A configuration options

# Copyright (c) 2017 Intel Corporation
# SPDX-License-Identifier: Apache-2.0

menuconfig CRYPTO_ATAES132A
	bool "Atmel ATAES132A 32k AES Serial EEPROM support"
	depends on I2C
	help
	  Enable Atmel ATAES132A 32k AES Serial EEPROM support.

if CRYPTO_ATAES132A

choice
	prompt "ATAES132A I2C bus speed"
	default CRYPTO_ATAES132A_I2C_SPEED_STANDARD

config CRYPTO_ATAES132A_I2C_SPEED_STANDARD
	bool "Standard"
	help
	  Standard bis speed of up to 100KHz.

config CRYPTO_ATAES132A_I2C_SPEED_FAST
	bool "Fast"
	help
	  Fast bus speed of up to 400KHz.
endchoice

endif # CRYPTO_ATAES132A
```

## drivers/crypto/Kconfig.bflb
```kconfig
# Copyright The Zephyr Project Contributors
# SPDX-License-Identifier: Apache-2.0

config CRYPTO_BFLB_SEC_ENG_AES
	bool "Bouffalo Lab SEC Engine AES crypto driver"
	default y
	depends on DT_HAS_BFLB_SEC_ENG_AES_ENABLED
	help
	  Enable the Bouffalo Lab SEC Engine crypto driver providing
	  hardware-accelerated AES (ECB/CBC/CTR).

config CRYPTO_BFLB_SEC_ENG_AES_MAX_SESSION
	int "Maximum concurrent AES cipher sessions"
	default 4
	depends on CRYPTO_BFLB_SEC_ENG_AES
	help
	  Maximum number of concurrent AES cipher sessions.

config CRYPTO_BFLB_SEC_ENG_SHA
	bool "Bouffalo Lab SEC Engine SHA hash driver"
	default y
	depends on DT_HAS_BFLB_SEC_ENG_SHA_ENABLED
	help
	  Enable the Bouffalo Lab SEC Engine SHA hash driver providing
	  hardware-accelerated SHA-224 and SHA-256.

config CRYPTO_BFLB_SEC_ENG_SHA_MAX_SESSION
	int "Maximum concurrent SHA hash sessions"
	default 4
	depends on CRYPTO_BFLB_SEC_ENG_SHA
	help
	  Maximum number of concurrent SHA hash sessions.
```

## drivers/crypto/Kconfig.cc23x0
```kconfig
# CC23X0 AES accelerator configuration options

# Copyright (c) 2024 BayLibre, SAS
# SPDX-License-Identifier: Apache-2.0

config CRYPTO_CC23X0
	bool "CC23X0 AES accelerator driver"
	default y
	depends on DT_HAS_TI_CC23X0_AES_ENABLED
	help
	  Enable TI CC23X0 AES accelerator driver.
	  This driver supports the following modes:
	  - ECB (Electronic Code Book) encryption only (decryption not supported by the hardware)
	  - CTR (Counter)
	  - CCM (CTR with CBC-MAC)
```

## drivers/crypto/Kconfig.esp32
```kconfig
# Copyright (c) 2025 Espressif Systems
# SPDX-License-Identifier: Apache-2.0

config CRYPTO_ESP32
	bool "Espressif Crypto driver"
	depends on DT_HAS_ESPRESSIF_ESP32_AES_ENABLED || DT_HAS_ESPRESSIF_ESP32_SHA_ENABLED
	default y
	help
	  Enable the Espressif hardware crypto drivers for AES and SHA
	  accelerators.

if CRYPTO_ESP32

config CRYPTO_ESP32_AES
	bool "ESP32 AES Hardware Accelerator"
	depends on DT_HAS_ESPRESSIF_ESP32_AES_ENABLED
	default y
	help
	  Enable support for the Espressif AES hardware accelerator.
	  This driver implements AES-ECB, AES-CBC, and AES-CTR modes
	  using the hardware AES engine through the HAL.

config CRYPTO_ESP32_SHA
	bool "ESP32 SHA Hardware Accelerator"
	depends on DT_HAS_ESPRESSIF_ESP32_SHA_ENABLED
	default y
	help
	  Enable support for the Espressif SHA hardware accelerator.
	  This driver implements SHA-224, SHA-256, SHA-384, and SHA-512
	  using the Espressif HAL SHA engine.

config CRYPTO_ESP32_SHA_SESSIONS_MAX
	int "Max ESP32 SHA sessions"
	depends on CRYPTO_ESP32_SHA
	range 1 32
	default 2
	help
	  Maximum number of concurrent SHA hash sessions.
	  Each session uses approximately 300-400 bytes of RAM
	  (more for SHA-384/512 due to larger state).

config ESP32_CRYPTO_AES_SESSIONS_MAX
	int "Max ESP32 AES sessions"
	depends on CRYPTO_ESP32_AES
	range 1 32
	default 4
	help
	  Maximum number of concurrent AES sessions.
	  Each session uses approximately 300-400 bytes of RAM
	  (more for AES-256 due to larger state).

endif # CRYPTO_ESP32
```

## drivers/crypto/Kconfig.infineon_mxcrypto
```kconfig
# SPDX-FileCopyrightText: Copyright (c) 2026 Infineon Technologies AG,
# SPDX-FileCopyrightText: or an affiliate of Infineon Technologies AG. All rights reserved.
#
# SPDX-License-Identifier: Apache-2.0

config CRYPTO_INFINEON_MXCRYPTO
	bool "Infineon MXCRYPTO hardware crypto driver"
	default y
	depends on DT_HAS_INFINEON_MXCRYPTO_CRYPTO_ENABLED
	select MFD
	select USE_INFINEON_MXCRYPTO_AES
	select USE_INFINEON_MXCRYPTO_SHA
	select NOCACHE_MEMORY if ARCH_HAS_NOCACHE_MEMORY_SUPPORT
	help
	  Enable the Infineon MXCRYPTO hardware-accelerated crypto driver
	  for supported devices.  Provides AES-128/192/256 ECB, CBC, CTR,
	  CCM and GCM cipher operations and SHA-224/256/384/512
	  operations via the Zephyr crypto API.

if CRYPTO_INFINEON_MXCRYPTO

config CRYPTO_INFINEON_MXCRYPTO_MAX_SESSION
	int "Maximum number of simultaneous crypto sessions"
	default 4
	help
	  Number of concurrent cipher or hash sessions the driver supports.

endif # CRYPTO_INFINEON_MXCRYPTO
```

## drivers/crypto/Kconfig.infineon_mxcryptolite
```kconfig
# SPDX-FileCopyrightText: Copyright (c) 2026 Infineon Technologies AG,
# SPDX-FileCopyrightText: or an affiliate of Infineon Technologies AG. All rights reserved.
#
# SPDX-License-Identifier: Apache-2.0

config CRYPTO_INFINEON_MXCRYPTOLITE
	bool "Infineon MXCRYPTOLITE hardware crypto driver"
	default y
	depends on DT_HAS_INFINEON_MXCRYPTOLITE_CRYPTO_ENABLED
	select MFD
	select USE_INFINEON_MXCRYPTOLITE_AES
	select USE_INFINEON_MXCRYPTOLITE_SHA256
	help
	  Enable the Infineon MXCRYPTOLITE hardware-accelerated crypto driver
	  for supported devices.  Provides AES-128 ECB, CBC, CTR, and CCM cipher
	  operations and SHA-256 hash operations via the Zephyr crypto API.

if CRYPTO_INFINEON_MXCRYPTOLITE

config CRYPTO_INFINEON_MXCRYPTOLITE_MAX_SESSION
	int "Maximum number of simultaneous crypto sessions"
	default 4
	help
	  Number of concurrent cipher or hash sessions the driver supports.

endif # CRYPTO_INFINEON_MXCRYPTOLITE
```

## drivers/crypto/Kconfig.intel
```kconfig
# Copyright (c) 2022 Intel Corporation
# SPDX-License-Identifier: Apache-2.0


config CRYPTO_INTEL_SHA
	bool "Intel SHA driver"
	default y
	depends on DT_HAS_INTEL_ADSP_SHA_ENABLED
	help
	  Enable Intel SHA driver. To be used on ACE and CAVS platforms.
```

## drivers/crypto/Kconfig.it51xxx
```kconfig
# Copyright (c) 2025 ITE Corporation.
# SPDX-License-Identifier: Apache-2.0

config CRYPTO_IT51XXX_SHA
	bool "ITE IT51XXX SHA driver"
	default y
	depends on DT_HAS_ITE_IT51XXX_SHA_ENABLED
	select SOC_IT51XXX_SHA256_HW_ACCELERATE
	help
	  The IT51XXX hardware supports SHA-256 calculation, which is faster than
	  the firmware implementation.
```

## drivers/crypto/Kconfig.it8xxx2
```kconfig
# Copyright (c) 2023 ITE Corporation.
# SPDX-License-Identifier: Apache-2.0

config CRYPTO_IT8XXX2_SHA
	bool "ITE IT8XXX2 SHA driver"
	default y
	depends on DT_HAS_ITE_IT8XXX2_SHA_ENABLED
	select SOC_IT8XXX2_SHA256_HW_ACCELERATE
	help
	  Enable ITE IT8XXX2 SHA driver.
	  This driver supports SHA256 hardware accelerator of the it8xxx2 series.
	  It requires 256 + 256 bytes in the RAM's first 4k-bytes to calculate
	  SHA256 hash.

config CRYPTO_IT8XXX2_SHA_V2
	bool "ITE IT8XXX2 SHA V2 driver"
	default y
	depends on DT_HAS_ITE_IT8XXX2_SHA_V2_ENABLED
	select SOC_IT8XXX2_SHA256_HW_ACCELERATE
	help
	  Enable ITE IT8XXX2 SHA V2 driver.
	  This driver supports SHA256 hardware accelerator of the it82xx2 series.
	  It requires 1024 + 256 bytes in the RAM's first 4k-bytes to calculate
	  SHA256 hash.
```
