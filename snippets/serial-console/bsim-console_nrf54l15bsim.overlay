/*
 * Copyright (c) 2025 Nordic Semiconductor ASA
 *
 * SPDX-License-Identifier: Apache-2.0
 */

&uart20 {
	status = "okay";
};

/ {
	chosen {
		zephyr,console = &uart20;
		zephyr,shell-uart = &uart20;
	};
};
