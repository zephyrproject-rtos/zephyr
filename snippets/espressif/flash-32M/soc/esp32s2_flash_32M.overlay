/*
 * Copyright (c) 2025 Espressif Systems (Shanghai) Co., Ltd.
 *
 * SPDX-License-Identifier: Apache-2.0
 */

/delete-node/ &flash0;

#include <espressif/esp32s2/esp32s2_common.dtsi>
#include <espressif/partitions_0x0_amp_32M.dtsi>

&flash0 {
	reg = <0x0 DT_SIZE_M(32)>;
};
