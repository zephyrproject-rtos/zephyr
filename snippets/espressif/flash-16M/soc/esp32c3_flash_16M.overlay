/*
 * Copyright (c) 2025 Espressif Systems (Shanghai) Co., Ltd.
 *
 * SPDX-License-Identifier: Apache-2.0
 */

/delete-node/ &flash0;

#include <espressif/esp32c3/esp32c3_common.dtsi>
#include <espressif/partitions_0x0_default_16M.dtsi>

&flash0 {
	reg = <0x0 DT_SIZE_M(16)>;
};
