/*
 * Copyright (c) 2024 Nordic Semiconductor
 * SPDX-License-Identifier: Apache-2.0
 */

&cpuppr_code_data {
	status = "okay";
};

&cpuppr_vpr {
	execution-memory = <&cpuppr_code_data>;
};

&uart135 {
	status = "reserved";
};
