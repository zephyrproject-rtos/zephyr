/*
 * Copyright (c) 2024 Nordic Semiconductor
 * SPDX-License-Identifier: Apache-2.0
 */

&uart135 {
	status = "reserved";
	interrupt-parent = <&cpuppr_clic>;
};

&cpuapp_cpuppr_ipc {
	status = "okay";
};

&cpuppr_vevif {
	status = "okay";
};

&cpuapp_bellboard {
	status = "okay";
};
