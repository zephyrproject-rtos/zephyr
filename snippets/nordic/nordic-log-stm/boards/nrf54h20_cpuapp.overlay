/*
 * Copyright (c) 2024 Nordic Semiconductor
 * SPDX-License-Identifier: Apache-2.0
 */

&uart136 {
	status = "okay";
};

&tbm {
	status = "okay";
};

&coresight {
	status = "okay";
	mode = "stm-etr";
};
