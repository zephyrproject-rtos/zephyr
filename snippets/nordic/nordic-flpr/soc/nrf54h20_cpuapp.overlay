/*
 * Copyright (c) 2024 Nordic Semiconductor
 * SPDX-License-Identifier: Apache-2.0
 */

&uart120 {
	status = "reserved";
	interrupt-parent = <&cpuflpr_clic>;
};

&cpuapp_cpuflpr_ipc {
	status = "okay";
};

&cpuflpr_vevif {
	status = "okay";
};

&cpuapp_bellboard {
	status = "okay";
};
