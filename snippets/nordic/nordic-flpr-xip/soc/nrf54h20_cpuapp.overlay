/*
 * Copyright (c) 2024 Nordic Semiconductor
 * SPDX-License-Identifier: Apache-2.0
 */

&cpuflpr_vpr {
	execution-memory = <&cpuflpr_code_partition>;
	/delete-property/ source-memory;
};

&uart120 {
	status = "reserved";
	interrupt-parent = <&cpuflpr_clic>;
};
