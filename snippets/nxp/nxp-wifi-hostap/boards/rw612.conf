## snippets/nxp/nxp-wifi-hostap/boards/rw612.conf
```kconfig
# Copyright 2026 NXP
# SPDX-License-Identifier: Apache-2.0

CONFIG_MBEDTLS_HEAP_SIZE=75072
CONFIG_SYSTEM_WORKQUEUE_STACK_SIZE=4096
CONFIG_WIFI_NM_WPA_SUPPLICANT_NAN=y
CONFIG_MBEDTLS_PSA_P256M_DRIVER_ENABLED=n
```

## snippets/nxp/nxp-wifi-iw610x/boards/frdm_mcxn947.conf
```kconfig
# Copyright 2026 NXP
# SPDX-License-Identifier: Apache-2.0

CONFIG_NET_BUF_RX_COUNT=20
CONFIG_NET_BUF_TX_COUNT=20
CONFIG_NET_PKT_RX_COUNT=16
CONFIG_NET_PKT_TX_COUNT=16
CONFIG_NET_TCP_MAX_RECV_WINDOW_SIZE=20440
CONFIG_NET_TCP_MAX_SEND_WINDOW_SIZE=20440
CONFIG_NXP_WIFI_SLIM=y
```

## snippets/nxp/nxp-wifi-iw610x/boards/mimxrt1060.conf
```kconfig
# Copyright 2026 NXP
# SPDX-License-Identifier: Apache-2.0

CONFIG_CODE_DATA_RELOCATION_SRAM=y
CONFIG_NET_BUF_RX_COUNT=40
CONFIG_NET_BUF_TX_COUNT=40
CONFIG_NET_PKT_RX_COUNT=36
CONFIG_NET_PKT_TX_COUNT=36
CONFIG_NET_TCP_MAX_RECV_WINDOW_SIZE=46720
CONFIG_NET_TCP_MAX_SEND_WINDOW_SIZE=46720
CONFIG_NXP_WIFI_FW_DEBUG=y
CONFIG_NXP_WIFI_WAKE_TIMER_ENABLE=y
CONFIG_PM=y
CONFIG_PM_DEVICE=y
CONFIG_PM_DEVICE_LOG_LEVEL_OFF=y
CONFIG_PM_LOG_LEVEL_OFF=y
CONFIG_SPEED_OPTIMIZATIONS=y
```

## snippets/nxp/wifi/nxp-wifi/boards/frdm_mcxn947_mcxn947_cpu0.conf
```kconfig
CONFIG_NET_PKT_RX_COUNT=16
CONFIG_NET_PKT_TX_COUNT=16
CONFIG_NET_BUF_RX_COUNT=20
CONFIG_NET_BUF_TX_COUNT=20
CONFIG_NET_MGMT_EVENT_QUEUE_SIZE=40
```

## snippets/nxp/wifi/nxp-wifi/boards/mimxrt1060_evk_mimxrt1062_qspi_C.conf
```kconfig
CONFIG_NET_PKT_RX_COUNT=72
CONFIG_NET_PKT_TX_COUNT=36
CONFIG_NET_BUF_RX_COUNT=80
CONFIG_NET_BUF_TX_COUNT=40
CONFIG_NET_MGMT_EVENT_QUEUE_SIZE=40
```

## soc/abov/abov32/Kconfig
```kconfig
# Copyright (c) 2026 ABOV Semiconductor Co., Ltd.
# SPDX-License-Identifier: Apache-2.0

config SOC_FAMILY_ABOV32
	bool

if SOC_FAMILY_ABOV32

config SOC_PRODUCT_LINE
	string

rsource "*/Kconfig"

endif # SOC_FAMILY_ABOV32
```

## soc/abov/abov32/Kconfig.defconfig
```kconfig
# Copyright (c) 2026 ABOV Semiconductor Co., Ltd.
# SPDX-License-Identifier: Apache-2.0

rsource "*/Kconfig.defconfig"
```

## soc/abov/abov32/Kconfig.soc
```kconfig
# Copyright (c) 2026 ABOV Semiconductor Co., Ltd.
# SPDX-License-Identifier: Apache-2.0

config SOC_FAMILY_ABOV32
	bool

config SOC_FAMILY
	default "abov32" if SOC_FAMILY_ABOV32

rsource "*/Kconfig.soc"
```

## soc/abov/abov32/a31xxxx/a31c15x/Kconfig.defconfig
```kconfig
# Copyright (c) 2026 ABOV Semiconductor Co., Ltd.
# SPDX-License-Identifier: Apache-2.0

# ABOV Semiconductor A31C15x MCU series

if SOC_SERIES_A31C15X

config NUM_IRQS
	default 32

config SYS_CLOCK_HW_CYCLES_PER_SEC
	default $(dt_node_int_prop_int,/cpus/cpu@0,clock-frequency)

endif # SOC_SERIES_A31C15X
```

## soc/abov/abov32/a31xxxx/a31c15x/Kconfig.soc
```kconfig
# Copyright (c) 2026 ABOV Semiconductor Co., Ltd.
# SPDX-License-Identifier: Apache-2.0

# ABOV Semiconductor A31C15x MCU series

config SOC_SERIES_A31C15X
	bool
	select SOC_PRODUCT_LINE_A31XXXX

config SOC_SERIES
	default "a31c15x" if SOC_SERIES_A31C15X

config SOC_A31C156
	bool
	select SOC_SERIES_A31C15X

config SOC
	default "a31c156" if SOC_A31C156
```

## soc/adi/max32/Kconfig.defconfig.max32651
```kconfig
# Analog Devices MAX32651 MCU

# Copyright (c) 2026 Analog Devices, Inc.
# SPDX-License-Identifier: Apache-2.0

if SOC_MAX32651

config SYS_CLOCK_HW_CYCLES_PER_SEC
	default $(dt_node_int_prop_int,/clocks/clk_ipo,clock-frequency)

choice SOC_FAMILY_MAX32_SECURE_SOC_SIGNING_ALGO
	default SOC_FAMILY_MAX32_SECURE_SOC_SIGNING_ALGO_RSA2048
endchoice

endif # SOC_MAX32651
```

## soc/adi/max32/Kconfig.defconfig.max32662
```kconfig
# Analog Devices MAX32662 MCU

# Copyright (c) 2024 Analog Devices, Inc.
# SPDX-License-Identifier: Apache-2.0

if SOC_MAX32662

config SYS_CLOCK_HW_CYCLES_PER_SEC
	default $(dt_node_int_prop_int,/clocks/clk_ipo,clock-frequency)

endif # SOC_MAX32662
```

## soc/adi/max32/Kconfig.defconfig.max32670
```kconfig
# Analog Devices MAX32670 MCU

# Copyright (c) 2024 Analog Devices, Inc.
# SPDX-License-Identifier: Apache-2.0

if SOC_MAX32670

config SYS_CLOCK_HW_CYCLES_PER_SEC
	default $(dt_node_int_prop_int,/clocks/clk_ipo,clock-frequency)

endif # SOC_MAX32670
```

## soc/adi/max32/Kconfig.defconfig.max32672
```kconfig
# Analog Devices MAX32672 MCU

# Copyright (c) 2024 Analog Devices, Inc.
# SPDX-License-Identifier: Apache-2.0

if SOC_MAX32672

config SYS_CLOCK_HW_CYCLES_PER_SEC
	default $(dt_node_int_prop_int,/clocks/clk_ipo,clock-frequency)

config NUM_IRQS
	default 108

choice SOC_FAMILY_MAX32_SECURE_SOC_SIGNING_ALGO
	default SOC_FAMILY_MAX32_SECURE_SOC_SIGNING_ALGO_ECDSA256
endchoice

endif # SOC_MAX32672
```

## soc/adi/max32/Kconfig.defconfig.max32690
```kconfig
# Analog Devices MAX32690 MCU

# Copyright (c) 2023-2024 Analog Devices, Inc.
# SPDX-License-Identifier: Apache-2.0

if SOC_MAX32690

if SOC_MAX32690_M4

config SYS_CLOCK_HW_CYCLES_PER_SEC
	default $(dt_node_int_prop_int,/clocks/clk_ipo,clock-frequency)

endif

if SOC_MAX32690_RV32

config SYS_CLOCK_HW_CYCLES_PER_SEC
	default $(dt_node_int_prop_int,/clocks/clk_iso,clock-frequency)

endif

endif # SOC_MAX32690
```
