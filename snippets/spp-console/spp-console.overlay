/*
 * Copyright (c) 2026 Xiaomi Corporation
 *
 * SPDX-License-Identifier: Apache-2.0
 */

/ {
	chosen {
		zephyr,console = &bt_spp_console_uart;
		zephyr,shell-uart = &bt_spp_console_uart;
	};

	bt_spp_console_uart: bt_spp_console_uart {
		compatible = "zephyr,bt-spp-uart";
		rx-fifo-size = <1024>;
		tx-fifo-size = <1024>;
	};
};
