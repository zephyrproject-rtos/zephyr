/*
 * SPDX-FileCopyrightText: Copyright The Zephyr Project Contributors
 * SPDX-License-Identifier: Apache-2.0
 */

/* RP2040 requires at least 1.15 V for 200 MHz operation. */
&vreg {
	regulator-min-microvolt = <1150000>;
	regulator-max-microvolt = <1150000>;
	status = "okay";
};

/* 12 MHz / 1 * 100 / 6 / 1 = 200 MHz */
&pll_sys {
	clock-div = <1>;
	fb-div = <100>;
	post-div1 = <6>;
	post-div2 = <1>;
};

&clk_sys {
	clock-frequency = <200000000>;
};

&clk_peri {
	clock-frequency = <200000000>;
};
