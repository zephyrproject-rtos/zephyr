/*
 * Copyright (c) 2024 Nordic Semiconductor
 * SPDX-License-Identifier: Apache-2.0
 */

&cpuppr_vpr {
	execution-memory = <&cpuppr_code_partition>;
	/delete-property/ source-memory;
};

&uart135 {
	status = "reserved";
};
