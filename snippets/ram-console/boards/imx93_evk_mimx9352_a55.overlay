/*
 * Copyright 2024 NXP
 *
 * SPDX-License-Identifier: Apache-2.0
 */

/ {
	chosen {
		zephyr,ram-console = &snippet_ram_console;
	};

	snippet_ram_console: memory@d0100000 {
		compatible = "zephyr,memory-region";
		reg = <0xd0100000 DT_SIZE_K(4)>;
		zephyr,memory-region = "RAM_CONSOLE";
	};
};
