/*
 * Copyright The Zephyr Project Contributors
 * SPDX-License-Identifier: Apache-2.0
 */

/ {
	chosen {
		zephyr,camera = &video_sw_generator;
	};

	video_sw_generator: video-sw-generator {
		compatible = "zephyr,video-sw-generator";
	};
};
