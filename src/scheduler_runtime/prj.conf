## CMakeLists.txt
```
# SPDX-License-Identifier: Apache-2.0

cmake_minimum_required(VERSION 3.20.0)

find_package(Zephyr REQUIRED HINTS $ENV{ZEPHYR_BASE})
project(hello_world)
include_directories(include)
target_sources(app PRIVATE src/main.c)
```

## prj.conf
```kconfig
CONFIG_THREAD_STACK_INFO=y
CONFIG_DYNAMIC_THREAD=y
CONFIG_MP_MAX_NUM_CPUS=2
CONFIG_SMP=y

# CONFIG_DYNAMIC_THREAD_POOL_SIZE=6
CONFIG_SCHED_CPU_MASK=y
# CONFIG_SCHED_CPU_MASK_PIN_ONLY=y
CONFIG_SCHED_DUMB=y
```

## src/main.c
```c
#include <stdio.h>
#include <stdint.h>
#include <zephyr/kernel.h>
#include <zephyr/sys/reboot.h>

#include "compute_graph.h"

#define NUM_HARTS CONFIG_MP_MAX_NUM_CPUS
#define TASK_INTERVAL_MS 2000  // Time interval for task generation
#define WORK_QUEUE_SIZE 10      // Maximum tasks per worker queue

K_THREAD_STACK_ARRAY_DEFINE(worker_stacks, NUM_HARTS, 1024);
K_THREAD_STACK_DEFINE(producer_stack, 1024);

struct k_thread worker_threads[NUM_HARTS];
struct k_thread producer_thread;
struct k_mutex print_mutex;

// Message queues for worker threads
struct k_msgq task_queues[NUM_HARTS];

// Statically allocated task buffer (each worker has a buffer of `WORK_QUEUE_SIZE` tasks)
struct k_work task_buffers[NUM_HARTS][WORK_QUEUE_SIZE];

// Message queue storage buffers
struct k_work *task_msg_buffers[NUM_HARTS][WORK_QUEUE_SIZE];

// Task function that prints the executing hart
void print_task(struct k_work *work) {
    int hart_id = arch_curr_cpu()->id;
    k_mutex_lock(&print_mutex, K_FOREVER);
    printf("Task executed on hart %d\n", hart_id);
    k_mutex_unlock(&print_mutex);
}

// Worker function that explicitly fetches and processes work
void worker_func(void *arg1, void *arg2, void *arg3) {
    int hart_id = (int)(uintptr_t)arg1;
    struct k_work *task;

    k_mutex_lock(&print_mutex, K_FOREVER);
    printf("Worker thread started on hart %d\n", hart_id);
    k_mutex_unlock(&print_mutex);

    while (1) {
        // Wait for a task in the queue
        if (k_msgq_get(&task_queues[hart_id], &task, K_FOREVER) == 0) {
            // Execute the task
            task->handler(task);
        }
    }
}

// Producer thread that assigns tasks periodically
void producer_func(void *arg1, void *arg2, void *arg3) {
    static int task_index[NUM_HARTS] = {0};  // Track which task to use per hart

    while (1) {
		k_mutex_lock(&print_mutex, K_FOREVER);
		printf("Producer thread generating tasks\n");
		k_mutex_unlock(&print_mutex);
		for(int j = 0; j < 4; j++) {
			for (int i = 0; i < NUM_HARTS; i++) {
				struct k_work *task = &task_buffers[i][task_index[i]];
				k_work_init(task, print_task);

				// Submit task to worker queue
				if (k_msgq_put(&task_queues[i], &task, K_NO_WAIT) != 0) {
					printf("Worker %d task queue full, skipping task\n", i);
				}

				// Round-robin through preallocated tasks
				task_index[i] = (task_index[i] + 1) % WORK_QUEUE_SIZE;
			}
		}

        k_sleep(K_MSEC(TASK_INTERVAL_MS));
    }
}

int main(void) {
    printf("Hello World! %s\n", CONFIG_BOARD_TARGET);
    k_mutex_init(&print_mutex);

    k_mutex_lock(&print_mutex, K_FOREVER);
    printf("Starting SMP worker threads on %d harts\n", NUM_HARTS);
    k_mutex_unlock(&print_mutex);

    // Initialize worker threads and message queues
    for (int i = 0; i < NUM_HARTS; i++) {
        // Initialize message queue for each worker
        k_msgq_init(&task_queues[i], (char *)task_msg_buffers[i], sizeof(struct k_work *), WORK_QUEUE_SIZE);

        // Start worker thread
        k_tid_t tid = k_thread_create(
            &worker_threads[i],
            worker_stacks[i],
            K_THREAD_STACK_SIZEOF(worker_stacks[i]),
            worker_func,
            (void *)(uintptr_t)i, NULL, NULL,
            K_PRIO_PREEMPT(1), 0, K_FOREVER
        );

        // Pin thread to specific hart
        k_thread_cpu_mask_clear(tid);
        k_thread_cpu_mask_enable(tid, i);
        k_thread_start(tid);
    }

    // Create producer thread (not pinned, higher priority)
    k_thread_create(
        &producer_thread,
        producer_stack,
        K_THREAD_STACK_SIZEOF(producer_stack),
        producer_func,
        NULL, NULL, NULL,
        K_PRIO_PREEMPT(0), 0, K_NO_WAIT
    );

    return 0;
}
```

## include/compute_graph.h
```c
#ifndef COMPUTE_GRAPH_H
#define COMPUTE_GRAPH_H

#include <zephyr/kernel.h>
#include <zephyr/sys/atomic.h>

#define MAX_DEPS 4      // Maximum dependencies per task
#define MAX_TASKS 16    // Maximum tasks per compute graph

typedef void (*task_func_t)(void *arg);  // Function pointer for task execution

/**
 * @brief Represents a node (task) in the compute graph.
 */
typedef struct graph_node {
    task_func_t func;                     // Task function to execute
    void *arg;                             // Argument passed to the function
    int num_deps;                          // Static: Total dependencies
    atomic_t remaining_deps;               // Dynamic: Number of unfinished dependencies
    struct graph_node *deps[MAX_DEPS];     // List of dependent tasks
} graph_node_t;

/**
 * @brief Represents a full compute graph (DAG).
 */
typedef struct compute_graph {
    int num_nodes;                         // Total number of nodes in the graph
    graph_node_t nodes[MAX_TASKS];         // Array of task nodes
} compute_graph_t;

/**
 * @brief Initializes a task node in the compute graph.
 * 
 * @param node Pointer to the task node.
 * @param func Task function to execute.
 * @param arg Argument for the task function.
 */
static inline void graph_node_init(graph_node_t *node, task_func_t func, void *arg) {
    node->func = func;
    node->arg = arg;
    node->num_deps = 0;
    atomic_set(&node->remaining_deps, 0);
}

/**
 * @brief Adds a dependency to a task node.
 * 
 * @param node Task node that depends on `dep_node`.
 * @param dep_node The dependency node that must complete before `node`.
 */
static inline void graph_node_add_dependency(graph_node_t *node, graph_node_t *dep_node) {
    if (node->num_deps < MAX_DEPS) {
        node->deps[node->num_deps++] = dep_node;
        atomic_inc(&node->remaining_deps); // Increment dependency count
    }
}

/**
 * @brief Resets the compute graph before dispatching a new AoT schedule.
 * 
 * @param graph Pointer to the compute graph.
 */
static inline void reset_compute_graph(compute_graph_t *graph) {
    for (int i = 0; i < graph->num_nodes; i++) {
        atomic_set(&graph->nodes[i].remaining_deps, graph->nodes[i].num_deps);
    }
}

#endif /* COMPUTE_GRAPH_H */
```
