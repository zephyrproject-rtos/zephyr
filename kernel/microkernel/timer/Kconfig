## lib/cmsis_rtos_v1/Kconfig
```kconfig
#
# Copyright (c) 2018 Intel Corporation
#
# SPDX-License-Identifier: Apache-2.0
#
config CMSIS_RTOS_V1
	bool "CMSIS RTOS v1 API"
	default n
	help
	  This enables CMSIS RTOS v1 API support. This is an OS-integration
	  layer which allows applications using CMSIS RTOS APIs to build on
	  Zephyr.

if CMSIS_RTOS_V1
config  THREAD_CUSTOM_DATA
	bool "Thread custom data"
	default y
	help
	  This option allows each thread to store 32 bits of custom data,
	  which can be accessed using the k_thread_custom_data_xxx() APIs.

config POLL
	bool "Async I/O Framework"
	default y
	help
	  Asynchronous notification framework. Enable the k_poll() and
	  k_poll_signal() APIs.  The former can wait on multiple events
	  concurrently, which can be either directly triggered or triggered by
	  the availability of some kernel objects (semaphores and fifos).

config CMSIS_MAX_THREAD_COUNT
	int "Maximum thread count in CMSIS RTOS application"
	default 10
	range 0 255
	help
	  Mention max number of threads in CMSIS RTOS compliant application.
	  There's a limitation on the number of threads due to memory
	  related constraints.

config CMSIS_THREAD_MAX_STACK_SIZE
	int "Max stack size threads can be allocated in CMSIS RTOS application"
	default 512
	help
	  Mention max stack size threads can be allocated in CMSIS RTOS application.

config CMSIS_TIMER_MAX_COUNT
	int "Maximum timer count in CMSIS application"
	default 5
	range 0 255
	help
	  Mention maximum number of timers in CMSIS compliant application.

config CMSIS_MUTEX_MAX_COUNT
	int "Maximum mutex count in CMSIS application"
	default 5
	range 0 255
	help
	  Mention maximum number of mutexes in CMSIS compliant application.

config CMSIS_SEMAPHORE_MAX_COUNT
	int "Maximum semaphore count in CMSIS application"
	default 5
	range 0 255
	help
	  Mention maximum number of semaphores in CMSIS compliant application.

config NUM_PREEMPT_PRIORITIES
	int
	default 7
endif
```

## lib/cmsis_rtos_v2/Kconfig
```kconfig
#
# Copyright (c) 2018 Intel Corporation
#
# SPDX-License-Identifier: Apache-2.0
#
config CMSIS_RTOS_V2
	bool "CMSIS RTOS v2 API"
	default n
	depends on POLL
	depends on THREAD_NAME
	depends on THREAD_STACK_INFO
	depends on THREAD_MONITOR
	depends on INIT_STACKS
	help
	  This enables CMSIS RTOS v2 API support. This is an OS-integration
	  layer which allows applications using CMSIS RTOS V2 APIs to build
	  on Zephyr.

if CMSIS_RTOS_V2
config CMSIS_V2_THREAD_MAX_COUNT
	int "Maximum thread count in CMSIS RTOS V2 application"
	default 15
	range 0 255
	help
	  Mention max number of threads in CMSIS RTOS V2 compliant application.
	  There's a limitation on the number of threads due to memory
	  related constraints.

config CMSIS_V2_THREAD_MAX_STACK_SIZE
	int "Max stack size threads can be allocated in CMSIS RTOS V2 application"
	default 512
	help
	  Mention max stack size threads can be allocated in CMSIS RTOS V2 application.
endif
```

## lib/cpp/Kconfig
```kconfig
# C++ configuration options

# Copyright (c) 2018 B. Leforestier
# SPDX-License-Identifier: Apache-2.0

menu "C++ Language Support"

config CPP
	bool "C++ support for the application"
	help
	  This option enables the use of applications built with C++.

if CPP

config STD_CPP_VERSION
	int
	default 199711 if STD_CPP98
	default 201103 if STD_CPP11
	default 201402 if STD_CPP14
	default 201703 if STD_CPP17
	default 202002 if STD_CPP20 || STD_CPP2A
	default 202302 if STD_CPP23 || STD_CPP2B
	help
	  The version number of C++ standard being used (NOTE: this uses the
	  full year and month, and is the same as the __cplusplus macro defined
	  by the compiler). This config can be used to check for a minimum
	  supported version. Example:

	    depends on STD_CPP_VERSION >= 201703

	  Adding this to your library's enablement Kconfig will force a minimum
	  c++17 standard.

	  The full year is used so c++98 can be checked using > and < operators
	  without conflicting with c++11 or higher.

choice STD_CPP
	prompt "C++ Standard"
	default STD_CPP11
	help
	  C++ Standards.

config STD_CPP98
	bool "C++ 98"
	help
	  1998 C++ standard as modified by the 2003 technical corrigendum
	  and some later defect reports.

config STD_CPP11
	bool "C++ 11"
	help
	  2011 C++ standard, previously known as C++0x.

config STD_CPP14
	bool "C++ 14"
	help
	  2014 C++ standard.

config STD_CPP17
	bool "C++ 17"
	help
	  2017 C++ standard, previously known as C++0x.

config STD_CPP2A
	bool "C++ 2a"
	help
	  Next revision of the C++ standard, which is expected to be published in 2020.

config STD_CPP20
	bool "C++ 20"
	help
	  2020 C++ standard, previously known as C++2A.

config STD_CPP2B
	bool "C++ 2b"
	help
	  Next revision of the C++ standard, which is expected to be published in 2023.

config STD_CPP23
	bool "C++ 23"
	help
	  2023 C++ standard, previously known as C++2B.

endchoice

config REQUIRES_FULL_LIBCPP
	bool "Require complete C++ standard library"
	select REQUIRES_FULL_LIBC
	help
	  Indicates that a full C++ standard library is required, either by
	  a subsystem or an application. This will also include a full C
	  library implementation.

config FULL_LIBCPP_SUPPORTED
	bool
	help
	  Selected when the target has at least one C++ library that offers a
	  complete implementation and which would be selected when
	  REQUIRES_FULL_LIBCPP is set.

choice LIBCPP_IMPLEMENTATION
	prompt "C++ Standard Library Implementation"
	default EXTERNAL_LIBCPP if REQUIRES_FULL_LIBCPP && NATIVE_BUILD
	default LIBCXX_LIBCPP if REQUIRES_FULL_LIBCPP && "$(ZEPHYR_TOOLCHAIN_VARIANT)" = "llvm"
	default GLIBCXX_LIBCPP if REQUIRES_FULL_LIBCPP
	default MINIMAL_LIBCPP

config MINIMAL_LIBCPP
	bool "Minimal C++ Library"
	depends on !REQUIRES_FULL_LIBCPP
	help
	  Build with the minimal C++ library provided by Zephyr.

	  The Zephyr minimal C++ library only provides a very limited subset
	  of the standard C++ library and is mainly intended for use with the
	  applications that do not require the Standard Template Library (STL).

config GLIBCXX_LIBCPP
	bool "GNU C++ Standard Library"
	depends on NEWLIB_LIBC || PICOLIBC
	select FULL_LIBCPP_SUPPORTED
	help
	  Build with GNU C++ Standard Library (libstdc++) provided by the GNU
	  Compiler Collection (GCC)-based toolchain.

config LIBCXX_LIBCPP
	bool "LLVM C++ Standard Library"
	depends on NEWLIB_LIBC
	depends on "$(ZEPHYR_TOOLCHAIN_VARIANT)" = "llvm"
	select FULL_LIBCPP_SUPPORTED
	help
	  Build with LLVM C++ Standard Library (libc++) provided by LLVM
	  toolchain. Information about library can be found at
	  https://libcxx.llvm.org

config ARCMWDT_LIBCPP
	bool "ARC MWDT C++ Library"
	depends on ARCMWDT_LIBC
	help
	  Build with ARC MetaWare C++ Standard Library provided by the ARC
	  MetaWare Development Tools (MWDT) toolchain.

config EXTERNAL_LIBCPP
	bool "External C++ standard library"
	help
	  Build and link with an external/user-provided C++ standard library.

config EXTERNAL_MODULE_LIBCPP
	bool "External C++ standard library module"
	help
	  Build an external/user-provided C++ standard library.

endchoice # LIBCPP_IMPLEMENTATION

if !MINIMAL_LIBCPP

config CPP_EXCEPTIONS
	bool "C++ exceptions support"
	depends on !NEWLIB_LIBC_NANO
	help
	  This option enables support of C++ exceptions.

config CPP_RTTI
	bool "C++ RTTI support"
	help
	  This option enables support of C++ RTTI.

endif # !MINIMAL_LIBCPP

endif # CPP

endmenu
```

## lib/cpp/Kconfig.deprecated
```kconfig
# Copyright (c) 2022 Nordic Semiconductor ASA
# SPDX-License-Identifier: Apache-2.0

menu "Deprecated"

config CPLUSPLUS
	bool "[DEPRECATED] C++ support for the application"
	select CPP
	select DEPRECATED
	help
	  This option enables the use of applications built with C++.

	  [DEPRECATED] Select CPP instead.

config LIB_CPLUSPLUS
	bool "[DEPRECATED] Link with STD C++ library"
	select REQUIRES_FULL_LIBC
	select REQUIRES_FULL_LIBCPP
	select DEPRECATED
	help
	  Link with STD C++ Library.

	  [DEPRECATED]
	  Select REQUIRES_FULL_LIBCPP or specify the C++ standard library
	  implementation to use from LIBCPP_IMPLEMENTATION.

if LIB_CPLUSPLUS

config EXCEPTIONS
	bool "[DEPRECATED] C++ exceptions support"
	depends on !NEWLIB_LIBC_NANO
	select CPP_EXCEPTIONS
	select DEPRECATED
	help
	  This option enables support of C++ exceptions.

	  [DEPRECATED] Select CPP_EXCEPTIONS instead.

config RTTI
	bool "[DEPRECATED] C++ RTTI support"
	select CPP_RTTI
	select DEPRECATED
	help
	  This option enables support of C++ RTTI.

	  [DEPRECATED] Select CPP_RTTI instead.

endif # LIB_CPLUSPLUS

endmenu
```

## lib/crc/Kconfig
```kconfig
# Copyright (c) 2016,2023 Intel Corporation
# Copyright (c) 2024 Intercreate, Inc.
# SPDX-License-Identifier: Apache-2.0
#
config CRC
	bool "Cyclic redundancy check (CRC) Support"
	help
	  Enable use of CRC.

if CRC
config CRC_SHELL
	bool "CRC Shell"
	depends on SHELL
	select POSIX_C_LIB_EXT
	help
	  Enable CRC checking for memory regions from the shell.

config CRC32_K_4_2_TABLE_256
	bool "Use 256-length table for CRC32-K/4.2"
	help
	  Enable the 256-length instead of 16-length table for CRC32-K/4.2.

endif # CRC
```

## lib/crypto/tinycrypt/Kconfig
```kconfig
# Kconfig - Cryptography primitive options for TinyCrypt

#
# Copyright (c) 2015 Intel Corporation
#
# Redistribution and use in source and binary forms, with or without
# modification, are permitted provided that the following conditions are met:
#
# 1) Redistributions of source code must retain the above copyright notice,
# this list of conditions and the following disclaimer.
#
# 2) Redistributions in binary form must reproduce the above copyright notice,
# this list of conditions and the following disclaimer in the documentation
# and/or other materials provided with the distribution.
#
# 3) Neither the name of Intel Corporation nor the names of its contributors
# may be used to endorse or promote products derived from this software without
# specific prior written permission.
#
# THIS SOFTWARE IS PROVIDED BY THE COPYRIGHT HOLDERS AND CONTRIBUTORS "AS IS"
# AND ANY EXPRESS OR IMPLIED WARRANTIES, INCLUDING, BUT NOT LIMITED TO, THE
# IMPLIED WARRANTIES OF MERCHANTABILITY AND FITNESS FOR A PARTICULAR PURPOSE
# ARE DISCLAIMED. IN NO EVENT SHALL THE COPYRIGHT HOLDER OR CONTRIBUTORS BE
# LIABLE FOR ANY DIRECT, INDIRECT, INCIDENTAL, SPECIAL, EXEMPLARY, OR
# CONSEQUENTIAL DAMAGES (INCLUDING, BUT NOT LIMITED TO, PROCUREMENT OF
# SUBSTITUTE GOODS OR SERVICES; LOSS OF USE, DATA, OR PROFITS; OR BUSINESS
# INTERRUPTION) HOWEVER CAUSED AND ON ANY THEORY OF LIABILITY, WHETHER IN
# CONTRACT, STRICT LIABILITY, OR TORT (INCLUDING NEGLIGENCE OR OTHERWISE)
# ARISING IN ANY WAY OUT OF THE USE OF THIS SOFTWARE, EVEN IF ADVISED OF THE
# POSSIBILITY OF SUCH DAMAGE.
#

config  TINYCRYPT
        bool
        prompt "Cryptography Support"
        default n
        help
          This option enables the TinyCrypt cryptography library.

config  TINYCRYPT_SHA256
        bool
        prompt "SHA-256 Hash function support"
        depends on TINYCRYPT
        default n
        help
          This option enables support for SHA-256
          hash function primitive.

config  TINYCRYPT_SHA256_HMAC
        bool
        prompt "HMAC (via SHA256) message auth support"
        depends on TINYCRYPT_SHA256
        default n
        help
          This option enables support for HMAC using SHA-256
          message authentication code.

config  TINYCRYPT_SHA256_HMAC_PRNG
        bool
        prompt "PRNG (via HMAC-SHA256) support"
        depends on TINYCRYPT_SHA256_HMAC
        default n
        help
          This option enables support for psudeo-random number
          generator.

config  TINYCRYPT_AES
        bool
        prompt "AES-128 decrypt/encrypt"
        depends on TINYCRYPT
        default n
        help
          This option enables support for AES-128 decrypt and encrypt.

config  TINYCRYPT_AES_CBC
        bool
        prompt "AES-128 block cipher"
        depends on TINYCRYPT_AES
        default n
        help
          This option enables support for AES-128 block cipher mode.

config  TINYCRYPT_AES_CTR
        bool
        prompt "AES-128 counter mode"
        depends on TINYCRYPT_AES
        default n
        help
          This option enables support for AES-128 counter mode.
```

## lib/delta/Kconfig
```kconfig
# Copyright (c) 2026 Clovis Corde
# SPDX-License-Identifier: Apache-2.0

menuconfig DELTA
	bool "Delta patching library"
	help
	  Generic binary delta patching primitive.

if DELTA

module = DELTA
module-str = delta
source "subsys/logging/Kconfig.template.log_config"

rsource "backends/bsdiffhs/Kconfig"

endif # DELTA
```

## lib/delta/backends/bsdiffhs/Kconfig
```kconfig
# Copyright (c) 2026 Clovis Corde
# SPDX-License-Identifier: Apache-2.0

config DELTA_BACKEND_BSDIFFHS
	bool "bsdiff + heatshrink delta backend"
	select HEATSHRINK
	help
	  Ships delta_backend_bsdiffhs: a delta backend using bsdiff for
	  binary diffing and heatshrink for stream compression.
```

## lib/gui/Kconfig
```kconfig
#
# Copyright (c) 2018 Jan Van Winkel <jan.van_winkel@dxplore.eu>
#
# SPDX-License-Identifier: Apache-2.0
#

rsource "lvgl/Kconfig"
```

## lib/gui/lvgl/Kconfig
```kconfig
# Copyright (c) 2018-2019 Jan Van Winkel <jan.van_winkel@dxplore.eu>
# Copyright (c) 2020 Teslabs Engineering S.L.
# Copyright (c) 2021 Krivorot Oleg <krivorot.oleg@gmail.com>
# SPDX-License-Identifier: Apache-2.0

menuconfig LVGL
	bool "LittlevGL GUI library"
	help
	  This option enables the LittlevGL GUI library.

if LVGL

module = LVGL
module-str = lvgl
source "subsys/logging/Kconfig.template.log_config"

config APP_LINK_WITH_LVGL
	bool "Link 'app' with LVGL"
	default y
	help
	  Add LVGL header files to the 'app' include path. It may be
	  disabled if the include paths for LVGL are causing aliasing
	  issues for 'app'.

config LVGL_USE_USER_CONFIG
	bool "Use user config file"
	help
	  Include a custom preferences file (lv_conf_user.h by default; see
	  LVGL_USER_CONFIG_FILE).  In the file, you can set the preferences
	  that cannot be set using Kconfig (e.g. custom fonts).

config LVGL_USER_CONFIG_FILE
	string "User config file name"
	default "lv_conf_user.h"
	depends on LVGL_USE_USER_CONFIG
	help
	  This file should be located in the root folder of the project,
	  or in any folder, the path to which is registered in root
	  CMakeLists.txt using the macro zephyr_include_directories()

rsource "Kconfig.graphical"
rsource "Kconfig.memory"
rsource "Kconfig.input"
rsource "Kconfig.feature"
rsource "Kconfig.image"
rsource "Kconfig.debug"
rsource "Kconfig.themes"
rsource "Kconfig.fonts"
rsource "Kconfig.text"
rsource "Kconfig.objects"

endif # LVGL
```
