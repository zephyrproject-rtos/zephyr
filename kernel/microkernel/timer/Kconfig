## lib/gui/lvgl/Kconfig.debug
```kconfig
# Copyright (c) 2018-2019 Jan Van Winkel <jan.van_winkel@dxplore.eu>
# Copyright (c) 2020 Teslabs Engineering S.L.
# SPDX-License-Identifier: Apache-2.0

menu "Debug settings"

config LVGL_USE_DEBUG
	bool "Enable debug support"
	default y if TEST
	help
	  Enable debug support.

	  If debug support is enabled LVGL will validate the parameters of
	  any function call made and if an invalid parameter is found __ASSERT
	  is called.

if LVGL_USE_DEBUG

config LVGL_USE_ASSERT_NULL
	bool "Enable null pointer assertion"
	default y if TEST
	help
	  Enable null pointer assertion

	  Check if a null pointer is passed as a parameter (Quite fast)

config LVGL_USE_ASSERT_MEM
	bool "Enable memory allocation assertion"
	default y if TEST
	help
	  Enable memory allocation assertion

	  Check if memory allocation is successful (Quite fast)

config LVGL_USE_ASSERT_MEM_INTEGRITY
	bool "Enable memory integrity check"
	default y if TEST
	help
	  Check the integrity of lv_mem after critical operations. (Slow)

config LVGL_USE_ASSERT_STR
	bool "Enable string assertion"
	default y if TEST
	help
	  Enable string assertion

	  Check if the string is not a NULL pointer, unusually long string,
	  contains invalid characters or contains unusual repetitions. (Slow)

	  If this option is disabled and NULL pointer checking is enabled, the
	  NULL pointer check is executed instead.

config LVGL_USE_ASSERT_OBJ
	bool "Enable object assertion"
	default y if TEST
	help
	  Enable object assertion

	  Check if an object is not a NULL pointer, has the correct type and
	  does exists. (Quite Slow)

	  If this option is disabled and NULL pointer checking is enabled, the
	  NULL pointer check is executed instead.

config LVGL_USE_ASSERT_STYLE
	bool "Enable style assertion"
	default y if TEST
	help
	  Enable style assertion

	  Check if a used style is correctly initialized. (Fast)

endif

endmenu
```

## lib/gui/lvgl/Kconfig.fonts
```kconfig
# Copyright (c) 2019 Jan Van Winkel <jan.van_winkel@dxplore.eu>
# SPDX-License-Identifier: Apache-2.0

menu "Fonts"

config LVGL_FONT_SUBPX_BGR
	bool "Use BGR instead RGB for sub-pixel rendering"
	help
	  User BGR pixel format instead of RGB for sub-pixel rendering

config LVGL_FONT_MONTSERRAT_12
	bool "Enable Montserrat 12px font"
	help
	  Enable Montserrat font support, size 12 pixels

config LVGL_FONT_MONTSERRAT_14
	bool "Enable Montserrat 14px font"
	help
	  Enable Montserrat font support, size 14 pixels

config LVGL_FONT_MONTSERRAT_16
	bool "Enable Montserrat 16px font"
	help
	  Enable Montserrat font support, size 16 pixels

config LVGL_FONT_MONTSERRAT_18
	bool "Enable Montserrat 18px font"
	help
	  Enable Montserrat font support, size 18 pixels

config LVGL_FONT_MONTSERRAT_20
	bool "Enable Montserrat 20px font"
	help
	  Enable Montserrat font support, size 20 pixels

config LVGL_FONT_MONTSERRAT_22
	bool "Enable Montserrat 22px font"
	help
	  Enable Montserrat font support, size 22 pixels

config LVGL_FONT_MONTSERRAT_24
	bool "Enable Montserrat 24px font"
	help
	  Enable Montserrat font support, size 24 pixels

config LVGL_FONT_MONTSERRAT_26
	bool "Enable Montserrat 26px font"
	help
	  Enable Montserrat font support, size 26 pixels

config LVGL_FONT_MONTSERRAT_28
	bool "Enable Montserrat 28px font"
	help
	  Enable Montserrat font support, size 28 pixels

config LVGL_FONT_MONTSERRAT_30
	bool "Enable Montserrat 30px font"
	help
	  Enable Montserrat font support, size 30 pixels

config LVGL_FONT_MONTSERRAT_32
	bool "Enable Montserrat 32px font"
	help
	  Enable Montserrat font support, size 32 pixels

config LVGL_FONT_MONTSERRAT_34
	bool "Enable Montserrat 34px font"
	help
	  Enable Montserrat font support, size 34 pixels

config LVGL_FONT_MONTSERRAT_36
	bool "Enable Montserrat 36px font"
	help
	  Enable Montserrat font support, size 36 pixels

config LVGL_FONT_MONTSERRAT_38
	bool "Enable Montserrat 38px font"
	help
	  Enable Montserrat font support, size 38 pixels

config LVGL_FONT_MONTSERRAT_40
	bool "Enable Montserrat 40px font"
	help
	  Enable Montserrat font support, size 40 pixels

config LVGL_FONT_MONTSERRAT_42
	bool "Enable Montserrat 42px font"
	help
	  Enable Montserrat font support, size 42 pixels

config LVGL_FONT_MONTSERRAT_44
	bool "Enable Montserrat 44px font"
	help
	  Enable Montserrat font support, size 44 pixels

config LVGL_FONT_MONTSERRAT_46
	bool "Enable Montserrat 46px font"
	help
	  Enable Montserrat font support, size 46 pixels

config LVGL_FONT_MONTSERRAT_48
	bool "Enable Montserrat 48px font"
	help
	  Enable Montserrat font support, size 48 pixels

config LVGL_FONT_MONTSERRAT_12_SUBPX
	bool "Enable Montserrat 12px font with sub-pixel rendering"
	help
	  Enable Montserrat font support with sub-pixel rendering, size 12 pixels

config LVGL_FONT_MONTSERRAT_28_COMPRESSED
	bool "Enable Montserrat 28px compressed font"
	help
	  Enable Montserrat compressed font support, size 28 pixels

config LVGL_FONT_DEJAVU_16_PERSIAN_HEBREW
	bool "Enable Dejavu 16px font with Hebrew, Arabic and Persian letters"
	help
	  Enable Dejavu font support, size 16 pixels, Hebrew, Arabic, Perisan
	  letters and all their forms

config LVGL_FONT_SIMSUN_16_CJK
	bool "Enable Simsun 16px font with CJK radicals"
	help
	  Enable Simsun font support, size 16 pixels, 1000 most common CJK
	  radicals

config LVGL_FONT_UNSCII_8
	bool "Enable Unscii 8px monospace fonts"
	default y
	help
	  Enable Unscii monospace font support, size 8 pixels

endmenu
```

## lib/gui/lvgl/Kconfig.graphical
```kconfig
# Copyright (c) 2018-2019 Jan Van Winkel <jan.van_winkel@dxplore.eu>
# Copyright (c) 2020 Teslabs Engineering S.L.
# SPDX-License-Identifier: Apache-2.0

menu "Graphical settings"

config LVGL_DISPLAY_DEV_NAME
	string "Display device name"
	default "DISPLAY"
	help
	  Name of the display device to use for rendering.

config LVGL_HOR_RES_MAX
	int "Horizontal Screen Resolution"
	default 480
	help
	  Horizontal screen resolution in pixels

config LVGL_VER_RES_MAX
	int "Vertical Screen Resolution"
	default 320
	help
	  Vertical screen resolution in pixels

choice LVGL_COLOR_DEPTH
	prompt "Color Depth"
	default LVGL_COLOR_DEPTH_32
	help
	  Color depth to be used by library

	config LVGL_COLOR_DEPTH_32
		bool "32-bit"

	config LVGL_COLOR_DEPTH_16
		bool "16-bit"

	config LVGL_COLOR_DEPTH_8
		bool "8-bit"

	config LVGL_COLOR_DEPTH_1
		bool "1-bit"

endchoice

config LVGL_COLOR_16_SWAP
	bool "RGB565 byte swap"
	depends on LVGL_COLOR_DEPTH_16
	help
	  Swap the 2 bytes of a RGB565 pixel.

config LVGL_COLOR_SCREEN_TRANSP
	bool "Transparency support"
	depends on LVGL_COLOR_DEPTH_32
	help
	  Enable screen transparency. Useful for OSD or other overlapping GUISs.

choice
	prompt "Chroma key color"
	default LVGL_COLOR_TRANSP_GREEN
	help
	  Color to to use as chroma key

	config LVGL_COLOR_TRANSP_RED
		bool "Red"

	config LVGL_COLOR_TRANSP_GREEN
		bool "Green"

	config LVGL_COLOR_TRANSP_BLUE
		bool "Blue"

	config LVGL_COLOR_TRANSP_CUSTOM
		bool "Custom"

endchoice

if LVGL_COLOR_TRANSP_CUSTOM

config LVGL_CUSTOM_COLOR_TRANSP_RED
	hex "Chroma Key Red"
	range 0x00 0xFF
	default 0x00
	help
	  Value of the color red to be used in the chroma key

config LVGL_CUSTOM_COLOR_TRANSP_GREEN
	hex "Chroma Key Green"
	range 0x00 0xFF
	default 0xFF
	help
	  Value of the color green to be used in the chroma key

config LVGL_CUSTOM_COLOR_TRANSP_BLUE
	hex "Chroma Key Blue"
	range 0x00 0xFF
	default 0x00
	help
	  Value of the color blue to be used in the chroma key

endif # LVGL_COLOR_TRANSP_CUSTOM

config LVGL_ANTIALIAS
	bool "Enable anti-aliasing"
	help
	  Enable anti-aliasing

config LVGL_DISP_DEF_REFR_PERIOD
	int "Screen refresh period"
	default 30
	help
	  Screen refresh period in milliseconds

config LVGL_DPI
	int "DPI"
	default 130
	help
	  Dots per inch (DPI)

config LVGL_DISP_SMALL_LIMIT
	int "Small display limit"
	default 30
	help
	  According to the width of the display (hor. res. / dpi) the displays fall
	  in 4 categories. This limit is the threshold for small displays.

config LVGL_DISP_MEDIUM_LIMIT
	int "Medium display limit"
	default 50
	help
	  According to the width of the display (hor. res. / dpi) the displays fall
	  in 4 categories. This limit is the threshold for medium displays.

config LVGL_DISP_LARGE_LIMIT
	int "Large display limit"
	default 70
	help
	  According to the width of the display (hor. res. / dpi) the displays fall
	  in 4 categories. This limit is the threshold for large displays.

endmenu
```

## lib/gui/lvgl/Kconfig.image
```kconfig
# Copyright (c) 2018-2019 Jan Van Winkel <jan.van_winkel@dxplore.eu>
# Copyright (c) 2020 Teslabs Engineering S.L.
# SPDX-License-Identifier: Apache-2.0

menu "Image decoder and cache"

config LVGL_IMG_CF_INDEXED
	bool "Enable indexed image support"
	default y
	help
	  Enable support for indexed images

config LVGL_IMG_CF_ALPHA
	bool "Enable alpha indexed image support"
	default y
	help
	  Enable support for alpha indexed images

config LVGL_IMG_CACHE_DEF_SIZE
	int "Default image cache size"
	default 1
	help
	  Default image cache size, image caching keeps the images open.
	  If only the built-in image formats are used there is no real
	  advantage of caching. With complex image decoders (e.g. PNG or JPG)
	  caching can save the continuous decoding of images. However the
	  opened images might consume additional RAM.

endmenu
```

## lib/gui/lvgl/Kconfig.input
```kconfig
# Copyright (c) 2018-2019 Jan Van Winkel <jan.van_winkel@dxplore.eu>
# Copyright (c) 2020 Teslabs Engineering S.L.
# SPDX-License-Identifier: Apache-2.0

menu "Input device settings"

config LVGL_POINTER_KSCAN
	bool "Keyboard scan pointer input"
	depends on KSCAN
	help
	  Enable keyboard scan pointer input

if LVGL_POINTER_KSCAN

config LVGL_POINTER_KSCAN_DEV_NAME
	string "Keyboard scan device name for pointer input"
	default "KSCAN"
	help
	  Name of the keyboard scan device to use for pointer input.

config LVGL_POINTER_KSCAN_MSGQ_COUNT
	int "Keyboard scan message queue count maximum"
	default 10
	help
	  Maximum number of items in the keyboard scan message queue.

config LVGL_POINTER_KSCAN_SWAP_XY
	bool "Swap keyboard scan X,Y axes"
	help
	  Swap keyboard scan X,Y axes. This option can be used to align keyboard
	  scan coordinates with the display.

config LVGL_POINTER_KSCAN_INVERT_X
	bool "Invert keyboard scan X axis"
	help
	  Invert keyboard scan X axis. This option can be used to align keyboard
	  scan coordinates with the display.

config LVGL_POINTER_KSCAN_INVERT_Y
	bool "Invert keyboard scan Y axis"
	help
	  Invert keyboard scan Y axis. This option can be used to align keyboard
	  scan coordinates with the display.

endif # LVGL_POINTER_KSCAN

endmenu
```

## lib/gui/lvgl/Kconfig.memory
```kconfig
# Copyright (c) 2018-2019 Jan Van Winkel <jan.van_winkel@dxplore.eu>
# Copyright (c) 2020 Teslabs Engineering S.L.
# SPDX-License-Identifier: Apache-2.0

menu "Memory manager settings"

config LVGL_BITS_PER_PIXEL
	int "Bits per pixel"
	default 32
	range 1 32
	depends on LVGL_BUFFER_ALLOC_STATIC
	help
	  Number of bits per pixel.

choice
	prompt "Memory pool"
	default LVGL_MEM_POOL_HEAP_KERNEL
	help
	  Memory pool to use for lvgl allocated objects

	config LVGL_MEM_POOL_HEAP_KERNEL
		bool "Kernel Heap"
		depends on HEAP_MEM_POOL_SIZE != 0
		help
		  Use k_malloc and k_free to allocate objects on the kernel heap

	config LVGL_MEM_POOL_HEAP_LIB_C
	  bool "C library Heap"
	  depends on !MINIMAL_LIBC || (MINIMAL_LIBC_MALLOC_ARENA_SIZE != 0)
	  help
		Use C library malloc and free to allocate objects on the C library heap

	config LVGL_MEM_POOL_KERNEL
		bool "Kernel space lvgl pool"
		help
		  Use a dedicated memory pool in kernel space to allocate lvgl objects
		  on

	config LVGL_MEM_POOL_USER
		bool "User space lvgl pool"
		help
		  Use a dedicated memory pool in user space to allocate lvgl objects on

endchoice

if LVGL_MEM_POOL_KERNEL || LVGL_MEM_POOL_USER

config LVGL_MEM_POOL_MIN_SIZE
	int "Minimum memory pool block size"
	default 16
	help
	  Size of the smallest block in the memory pool in bytes

config LVGL_MEM_POOL_MAX_SIZE
	int "Maximum memory pool block size"
	default 2048
	help
	  Size of the largest block in the memory pool in bytes

config LVGL_MEM_POOL_NUMBER_BLOCKS
	int "Number of max size blocks in memory pool"
	default 1
	help
	  Number of maximum sized blocks in the memory pool.

endif

config LVGL_VDB_SIZE
	int "Rendering buffer size"
	default 10
	range 1 100
	help
	  Size of the buffer used for rendering screen content as a percentage
	  of total display size.

config LVGL_DOUBLE_VDB
	bool "Use two rendering buffers"
	help
	  Use two buffers to render and flush data in parallel

choice
	prompt "Rendering Buffer Allocation"
	default LVGL_BUFFER_ALLOC_STATIC
	help
	  Type of allocation that should be used for allocating rendering buffers

config LVGL_BUFFER_ALLOC_STATIC
	bool "Static"
	help
	  Rendering buffers are statically allocated based on the following
	  configuration parameters:
	  * Horizontal screen resolution
	  * Vertical screen resolution
	  * Rendering buffer size
	  * Bytes per pixel

config LVGL_BUFFER_ALLOC_DYNAMIC
	bool "Dynamic"
	help
	  Rendering buffers are dynamically allocated based on the actual
	  display parameters

endchoice

endmenu
```
