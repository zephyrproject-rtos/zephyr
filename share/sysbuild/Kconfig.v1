## share/sysbuild/Kconfig.v2
```kconfig
# Copyright (c) 2023 Nordic Semiconductor
#
# SPDX-License-Identifier: Apache-2.0

config BOARD
	string
	default "$(BOARD)"
	help
	  This option holds the name of the board and is used to locate the files
	  related to the board in the source tree (under boards/).
	  The Board is the first location where we search for a linker.ld file,
	  if not found we look for the linker file in
	  soc/<arch>/<family>/<series>

config BOARD_REVISION
	def_string "$(BOARD_REVISION)"
	help
	  If the BOARD has a revision field set, this is the revision.
	  Otherwise, it is the empty string. For example, if BOARD is
	  "plank@foo", this option will be "foo". If BOARD is "plank",
	  this option will be the empty string.

config BOARD_DEPRECATED_RELEASE
	string
	help
	  This hidden option is set in the board configuration and indicates
	  the Zephyr release that the board configuration will be removed.
	  When set, any build for that board will generate a clearly visible
	  deprecation warning.

source "boards/Kconfig.v2"
source "soc/Kconfig.v2"
```

## share/sysbuild/bootloader/Kconfig
```kconfig
# Copyright (c) 2022 Nordic Semiconductor
#
# SPDX-License-Identifier: Apache-2.0

config SUPPORT_BOOTLOADER
	bool
	default y

config SUPPORT_BOOTLOADER_MCUBOOT_ZEPHYR
	bool
	default y

choice BOOTLOADER
	prompt "Bootloader support"
	default BOOTLOADER_NONE
	depends on SUPPORT_BOOTLOADER

config BOOTLOADER_NONE
	bool "None"
	help
	  Do not Include a bootloader in the build

config BOOTLOADER_MCUBOOT
	bool "MCUboot"
	depends on SUPPORT_BOOTLOADER_MCUBOOT_ZEPHYR
	help
	  Include MCUboot (Zephyr port) as the bootloader to use

endchoice

if BOOTLOADER_MCUBOOT

config SIGNATURE_TYPE
	string
	default NONE if BOOT_SIGNATURE_TYPE_NONE
	default RSA  if BOOT_SIGNATURE_TYPE_RSA
	default ECDSA_P256 if BOOT_SIGNATURE_TYPE_ECDSA_P256
	default ED25519 if BOOT_SIGNATURE_TYPE_ED25519

choice BOOT_SIGNATURE_TYPE
	prompt "Signature type"
	default BOOT_SIGNATURE_TYPE_RSA

config BOOT_SIGNATURE_TYPE_NONE
	bool "No signature; use only hash check"

config BOOT_SIGNATURE_TYPE_RSA
	bool "RSA signatures"

config BOOT_SIGNATURE_TYPE_ECDSA_P256
	bool "Elliptic curve digital signatures with curve P-256"

config BOOT_SIGNATURE_TYPE_ED25519
	bool "Edwards curve digital signatures using ed25519"

endchoice

config BOOT_SIGNATURE_KEY_FILE
	string "PEM key file"
	default "$(ZEPHYR_MCUBOOT_MODULE_DIR)/root-ec-p256.pem" if BOOT_SIGNATURE_TYPE_ECDSA_P256
	default "$(ZEPHYR_MCUBOOT_MODULE_DIR)/root-ed25519.pem" if BOOT_SIGNATURE_TYPE_ED25519
	default "$(ZEPHYR_MCUBOOT_MODULE_DIR)/root-rsa-2048.pem" if BOOT_SIGNATURE_TYPE_RSA
	default ""
	help
	  Absolute path to key file to use with MCUBoot.

endif
```

## share/sysbuild/bootloader/Kconfig.image.mcuboot.template
```kconfig
# Copyright (c) 2023 Nordic Semiconductor
#
# SPDX-License-Identifier: Apache-2.0

choice BOOT_SIGNATURE_TYPE
	default BOOT_SIGNATURE_TYPE_@SB_CONFIG_SIGNATURE_TYPE@
endchoice
```

## share/sysbuild/build/Kconfig
```kconfig
# Copyright (c) 2024 Nordic Semiconductor
#
# SPDX-License-Identifier: Apache-2.0

config COMPILER_WARNINGS_AS_ERRORS
	bool "Treat warnings as errors"
	help
	  Turn on "warning as error" toolchain flags for all images if set.

config MERGED_HEX_FILES
	bool "Create merged hex files"
	help
	  If this option is enabled, merged hex files will be created, one per unique board
	  target, that contain all the data of the hex output files merged into a single file,
	  named ``merged_<NORMALIZED_BOARD_TARGET>.hex``.
```

## share/sysbuild/images/Kconfig
```kconfig
# Copyright (c) 2021-2023 Nordic Semiconductor
#
# SPDX-License-Identifier: Apache-2.0

rsource "bootloader/Kconfig"
rsource "firmware_loader/Kconfig"
```

## share/sysbuild/images/bootloader/Kconfig
```kconfig
# Copyright (c) 2022 Nordic Semiconductor
#
# SPDX-License-Identifier: Apache-2.0

config SUPPORT_BOOTLOADER
	bool
	default y

config SUPPORT_BOOTLOADER_MCUBOOT_ZEPHYR
	bool
	default y

choice BOOTLOADER
	prompt "Bootloader support"
	default BOOTLOADER_NONE
	depends on SUPPORT_BOOTLOADER

config BOOTLOADER_NONE
	bool "None"
	help
	  Do not Include a bootloader in the build

config BOOTLOADER_MCUBOOT
	bool "MCUboot"
	depends on SUPPORT_BOOTLOADER_MCUBOOT_ZEPHYR
	help
	  Include MCUboot (Zephyr port) as the bootloader to use

endchoice

if BOOTLOADER_MCUBOOT

choice MCUBOOT_MODE
	prompt "Mode of operation"
	# Should be removed if board dts is updated
	default MCUBOOT_MODE_SWAP_USING_MOVE if SOC_FAMILY_STM32 || SOC_FAMILY_ESPRESSIF_ESP32
	default MCUBOOT_MODE_SWAP_USING_OFFSET
	help
	  The operating mode of MCUboot (which will also be propagated to the application).

config MCUBOOT_MODE_SINGLE_APP
	bool "Single slot"
	help
	  MCUboot will only boot slot0_partition placed application and does not care about other
	  slots. In this mode application is not able to DFU its own update to secondary slot and
	  all updates need to be performed using MCUboot serial recovery.

config MCUBOOT_MODE_SWAP_USING_OFFSET
	bool "Swap using offset"
	help
	  MCUboot expects slot0_partition and slot1_partition to be present in DT and application
	  will boot from slot0_partition. MCUBOOT_BOOTLOADER_NO_DOWNGRADE should also be selected
	  in main application if MCUboot has been built with MCUBOOT_DOWNGRADE_PREVENTION.

config MCUBOOT_MODE_SWAP_USING_MOVE
	bool "Swap using move"
	help
	  MCUboot expects slot0_partition and slot1_partition to be present in DT and application
	  will boot from slot0_partition. MCUBOOT_BOOTLOADER_NO_DOWNGRADE should also be selected
	  in main application if MCUboot has been built with MCUBOOT_DOWNGRADE_PREVENTION.

config MCUBOOT_MODE_SWAP_WITHOUT_SCRATCH
	bool "Swap without scratch (swap using move) [DEPRECATED]"
	select DEPRECATED
	help
	  This Kconfig is deprecated, use MCUBOOT_MODE_SWAP_USING_MOVE instead.

config MCUBOOT_MODE_SWAP_SCRATCH
	bool "Swap using scratch"
	help
	  MCUboot expects slot0_partition, slot1_partition and scratch_partition to be present in
	  DT, and application will boot from slot0_partition. In this mode scratch_partition is
	  used as temporary storage when MCUboot swaps application from the secondary slot to the
	  primary slot.
	  MCUBOOT_BOOTLOADER_NO_DOWNGRADE should also be selected in main application if MCUboot
	  has been built with MCUBOOT_DOWNGRADE_PREVENTION.

config MCUBOOT_MODE_OVERWRITE_ONLY
	bool "Overwrite"
	help
	  MCUboot will take contents of secondary slot of an image and will overwrite primary slot
	  with it. In this mode it is not possible to revert back to previous version as it is not
	  stored in the secondary slot.
	  This mode supports MCUBOOT_BOOTLOADER_NO_DOWNGRADE which means that the overwrite will
	  not happen unless the version of secondary slot is higher than the version in primary
	  slot.

config MCUBOOT_MODE_DIRECT_XIP
	bool "DirectXIP"
	help
	  MCUboot expects slot0_partition and slot1_partition to exist in DT. In this mode MCUboot
	  can boot from either partition and will select one with higher application image version,
	  which usually means major.minor.patch triple, unless BOOT_VERSION_CMP_USE_BUILD_NUMBER is
	  also selected in MCUboot that enables comparison of build number.
	  This option automatically selects MCUBOOT_BOOTLOADER_NO_DOWNGRADE as it is not possible
	  to swap back to older version of application.

config MCUBOOT_MODE_DIRECT_XIP_WITH_REVERT
	bool "DirectXIP with revert"
	help
	  MCUboot expects slot0_partition and slot1_partition to exist in DT. In this mode MCUboot
	  will boot the application with the higher version from either slot, as long as it has
	  been marked to be boot next time for test or permanently. In case when application is
	  marked for test it needs to confirm itself, on the first boot, or it will be removed and
	  MCUboot will revert to booting previously approved application.
	  This mode does not allow freely switching between application versions, as, once higher
	  version application is approved, it is not possible to select lower version for boot.
	  This mode selects MCUBOOT_BOOTLOADER_NO_DOWNGRADE as it is not possible to downgrade
	  running application, but note that MCUboot may do that if application with higher
	  version will not get confirmed.

config MCUBOOT_MODE_RAM_LOAD
	bool "RAM load"
	help
	  MCUboot expects slot0_partition and slot1_partition to exist in DT. In this mode, MCUboot
	  will select the image with the higher version number, copy it to RAM and begin execution
	  from there. The image must be linked to execute from RAM, the address that it is copied
	  to is specified using the load-addr argument when running imgtool.

	  Note: RAM must be assigned to the bootloader that is not used by the application in this
	  mode so that the bootloader is able to function until the application has booted.

config MCUBOOT_MODE_RAM_LOAD_WITH_REVERT
	bool "RAM load with revert"
	help
	  MCUboot expects slot0_partition and slot1_partition to exist in DT. In this mode, MCUboot
	  will select the image with the higher version number, copy it to RAM and begin execution
	  from there. MCUBoot will only boot an image if it has been marked to be boot next time
	  for test or permanently. In case when application is marked for test it needs to confirm
	  itself, on the first boot, or it will be removed and MCUboot will revert to booting
	  previously approved application. The image must be linked to execute from RAM, the address
	  that it is copied to is specified using the load-addr argument when running imgtool.

	  Note: RAM must be assigned to the bootloader that is not used by the application in this
	  mode so that the bootloader is able to function until the application has booted.

config MCUBOOT_MODE_FIRMWARE_UPDATER
	bool "Firmware updater"
	help
	  MCUboot will only boot slot0_partition for the main application but has an entrance
	  mechanism defined for entering the slot1_partition which is a dedicated firmware updater
	  application used to update the slot0_partition application.

config MCUBOOT_MODE_SINGLE_APP_RAM_LOAD
	bool "Single app RAM load mode"
	help
	  MCUboot can load the image to RAM from an arbitrary location. In this mode,
	  MCUboot will copy the image to RAM and begin execution from there. The image
	  must be linked to execute from RAM, the address that it is copied to is
	  specified using the load-addr argument when running imgtool.
	  Note that while not used directly, a slot0_partition must be defined in the
	  DT, as it is used to get information about size of the image to be loaded.
	  This option automatically selects MCUBOOT_BOOTLOADER_NO_DOWNGRADE as it is
	  not possible to swap back to older version of the application. In fact, none
	  of the swap operations are supported in this mode.

endchoice

config MCUBOOT_MODE_FIRMWARE_UPDATER_BOOT_MODE_ENTRANCE
	bool "Firmware updater retention boot mode entrance"
	depends on MCUBOOT_MODE_FIRMWARE_UPDATER
	help
	  Will enable retained memory, retention and the boot mode module in MCUboot and the main
	  application so that it can be used to force booting the firmware loader application
	  image. This needs the ``zephyr,boot-mode`` chosen node to be correctly configured.

config SIGNATURE_TYPE
	string
	default "NONE" if BOOT_SIGNATURE_TYPE_NONE
	default "RSA" if BOOT_SIGNATURE_TYPE_RSA
	default "ECDSA_P256" if BOOT_SIGNATURE_TYPE_ECDSA_P256
	default "ED25519" if BOOT_SIGNATURE_TYPE_ED25519

choice BOOT_SIGNATURE_TYPE
	prompt "Signature type"
	default BOOT_SIGNATURE_TYPE_RSA

config BOOT_SIGNATURE_TYPE_NONE
	bool "No signature; use only hash check"

config BOOT_SIGNATURE_TYPE_RSA
	bool "RSA signatures"

config BOOT_SIGNATURE_TYPE_ECDSA_P256
	bool "Elliptic curve digital signatures with curve P-256"

config BOOT_SIGNATURE_TYPE_ED25519
	bool "Edwards curve digital signatures using ed25519"

endchoice

config BOOT_SIGNATURE_KEY_FILE
	string "Signing PEM key file" if !BOOT_SIGNATURE_TYPE_NONE
	default "$(ZEPHYR_MCUBOOT_MODULE_DIR)/root-ec-p256.pem" if BOOT_SIGNATURE_TYPE_ECDSA_P256
	default "$(ZEPHYR_MCUBOOT_MODULE_DIR)/root-ed25519.pem" if BOOT_SIGNATURE_TYPE_ED25519
	default "$(ZEPHYR_MCUBOOT_MODULE_DIR)/root-rsa-2048.pem" if BOOT_SIGNATURE_TYPE_RSA
	default ""
	help
	  Absolute path to signing key file to use with MCUBoot.

config SUPPORT_BOOT_ENCRYPTION
	bool
	depends on !BOOT_SIGNATURE_TYPE_NONE && !MCUBOOT_MODE_DIRECT_XIP && !MCUBOOT_MODE_DIRECT_XIP_WITH_REVERT && !MCUBOOT_MODE_FIRMWARE_UPDATER
	default y

config BOOT_ENCRYPTION
	bool "Encrypted image support"
	depends on SUPPORT_BOOT_ENCRYPTION
	help
	  Support encrypted images.

config BOOT_ENCRYPTION_KEY_FILE
	string "Encryption PEM key file"
	depends on BOOT_ENCRYPTION
	default "$(ZEPHYR_MCUBOOT_MODULE_DIR)/enc-ec256-priv.pem" if BOOT_SIGNATURE_TYPE_ECDSA_P256
	default "$(ZEPHYR_MCUBOOT_MODULE_DIR)/enc-x25519-priv.pem" if BOOT_SIGNATURE_TYPE_ED25519
	default "$(ZEPHYR_MCUBOOT_MODULE_DIR)/enc-rsa2048-priv.pem" if BOOT_SIGNATURE_TYPE_RSA
	default ""
	help
	  Absolute path to encryption key file to use with MCUBoot.

if BOOT_ENCRYPTION

choice BOOT_ENCRYPTION_ALG
	prompt "Algorithm used for image encryption"
	default BOOT_ENCRYPTION_ALG_AES_128

config BOOT_ENCRYPTION_ALG_AES_128
	bool "Use AES-128 for image encryption"

config BOOT_ENCRYPTION_ALG_AES_256
	bool "Use AES-256 for image encryption"

endchoice # BOOT_ENCRYPTION_ALG

endif # BOOT_ENCRYPTION

endif
```

## share/sysbuild/images/firmware_loader/Kconfig
```kconfig
# Copyright (c) 2025 Nordic Semiconductor
#
# SPDX-License-Identifier: Apache-2.0

config SUPPORT_FIRMWARE_LOADER_SMP_SVR
	bool
	default y

choice FIRMWARE_LOADER
	prompt "Firmware loader image"
	default FIRMWARE_LOADER_IMAGE_NONE
	depends on MCUBOOT_MODE_FIRMWARE_UPDATER

config FIRMWARE_LOADER_IMAGE_NONE
	bool "None"
	help
	  Do not Include a firmware loader image in the build.

config FIRMWARE_LOADER_IMAGE_SMP_SVR
	bool "smp_svr"
	depends on SUPPORT_FIRMWARE_LOADER_SMP_SVR
	help
	  Include the MCUmgr ``smp_svr`` sample as the firmware loader image to use.

endchoice

config FIRMWARE_LOADER_IMAGE_NAME
	string
	default "smp_svr" if FIRMWARE_LOADER_IMAGE_SMP_SVR
	help
	  Name of firmware loader image.

config FIRMWARE_LOADER_IMAGE_PATH
	string
	default "$(ZEPHYR_BASE)/samples/subsys/mgmt/mcumgr/smp_svr" if FIRMWARE_LOADER_IMAGE_SMP_SVR
	help
	  Source directory of firmware loader image.
```

## sip/Kconfig
```kconfig
# Copyright (c) 2025 Nordic Semiconductor ASA
# SPDX-License-Identifier: Apache-2.0

source "$(KCONFIG_BINARY_DIR)/sip/Kconfig.sip"
```

## sip/nordic/Kconfig.sip
```kconfig
# Copyright (c) 2025 Nordic Semiconductor ASA
# SPDX-License-Identifier: Apache-2.0

config SIP_NRF9131_NRF9120_LACA
	bool
	select SOC_NRF9120

config SIP_NRF9151_NRF9120_LACA
	bool
	select SOC_NRF9120

config SIP_NRF9161_NRF9120_LACA
	bool
	select SOC_NRF9120
```

## snippets/nxp/nxp-wifi/boards/mimxrt1060.conf
```kconfig
# Copyright 2026 NXP
# SPDX-License-Identifier: Apache-2.0

# External module (IW416/IW612/IW610) via SDIO
CONFIG_NXP_MONOLITHIC_WIFI=y

# Larger buffers for external module
CONFIG_NET_PKT_RX_COUNT=80
CONFIG_NET_PKT_TX_COUNT=80
CONFIG_NET_BUF_RX_COUNT=160
CONFIG_NET_BUF_TX_COUNT=160
```

## snippets/st/st-rtc-alarm/boards/nucleo_wb09ke.conf
```kconfig
# RTC alarms disabled due to STM32WB09xE erratum ES0584 §2.5.2:
# RTC interrupts may be lost in Run mode (LSI/LSE clock)
CONFIG_RTC_ALARM=n
```

## snippets/ti/ti-io-exp/boards/am62l_evm.conf
```kconfig
# Copyright (c) 2026 Texas Instruments
# SPDX-License-Identifier: Apache-2.0

CONFIG_GPIO=y
CONFIG_GPIO_HOGS=y
```
