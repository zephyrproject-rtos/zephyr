## soc/Kconfig
```kconfig
# SPDX-License-Identifier: Apache-2.0

# Only v1 model has choice for SoC selection, therefore the optional source
# Sourced here and not in Kconfig.v1 to keep current SoC/CPU selection menu
# side-by-side with "Hardware Configuration" in the menu structure.
orsource "Kconfig.$(HWM_SCHEME).choice"

menu "Hardware Configuration"

rsource "Kconfig.$(HWM_SCHEME)"

# Source Zephyr Kconfig specifics from SoC roots.
osource "$(KCONFIG_BINARY_DIR)/soc/Kconfig"

# Source common Kconfig file
osource "soc/common/Kconfig"

module = SOC
module-str = SOC
source "subsys/logging/Kconfig.template.log_config"

endmenu

# The helper symbols below are put here due to an unusual setup: The simulated
# nrf5x_bsim boards use the POSIX arch, but are compatible with Nordic ARM boards

config SOC_COMPATIBLE_NRF
	bool

config SOC_COMPATIBLE_NRF52X
	bool

config SOC_COMPATIBLE_NRF53X
	bool

config SOC_COMPATIBLE_NRF54LX
	bool

config SOC_COMPATIBLE_NRF52833
	bool

config SOC_COMPATIBLE_NRF5340_CPUNET
	bool

config SOC_COMPATIBLE_NRF5340_CPUAPP
	bool

config SOC_COMPATIBLE_NRF54L15
	bool

config SOC_COMPATIBLE_NRF54L15_CPUAPP
	bool

config SOC_DEPRECATED_RELEASE
	string
	help
	  This hidden option is set in the SoC configuration and indicates
	  the Zephyr release that the SoC configuration will be removed.
	  When set, any build for that SoC will generate a clearly visible
	  deprecation warning.
	  When adding this to a SOC, remember to follow the instructions in
	  https://docs.zephyrproject.org/latest/develop/api/api_lifecycle.html#deprecated

config SOC_HAS_TIMING_FUNCTIONS
	bool
	help
	  Should be selected if SoC provides custom method for retrieving
	  timestamps and cycle count.

config SOC_HAS_RUNTIME_NUM_CPUS
	bool
	help
	  Should be selected if SoC handles determining the number of CPUs
	  at runtime.
```

## soc/Kconfig.v1
```kconfig
# Copyright (c) 2023 Nordic Semiconductor ASA

# SPDX-License-Identifier: Apache-2.0

config SOC
	string
	help
	  SoC name. The value of this setting must be defined by the selected
	  SoC for hw model v2.

config SOC_SERIES
	string
	help
	  SoC series. The value of this setting must be defined by the selected
	  SoC if the SoC belongs to a common series.

config SOC_FAMILY
	string
	help
	  SoC family. The value of this setting must be defined by the selected
	  SoC if the SoC belongs to a SoC family. Usually a SoC family also
	  indicates the vendor of the SoC.

# This loads custom SoC root Kconfig (only available if custom SoC root are defined)
osource "$(KCONFIG_BINARY_DIR)/soc/Kconfig.soc.arch"
# This loads Zephyr base SoC Kconfigs
osource "soc/soc_legacy/$(ARCH)/*/Kconfig"
```

## soc/Kconfig.v1.choice
```kconfig
# Copyright (c) 2023 Nordic Semiconductor ASA

# SPDX-License-Identifier: Apache-2.0

choice
	prompt "SoC/CPU/Configuration Selection"

# This loads custom SoC root Kconfig (only available if custom SoC root are defined)
osource "$(KCONFIG_BINARY_DIR)/soc/Kconfig.soc.choice"

endchoice
```

## soc/Kconfig.v2
```kconfig
# Copyright (c) 2022 Nordic Semiconductor ASA

# SPDX-License-Identifier: Apache-2.0

# Load all SoCs.
# SoCs that has transitioned to SoC scheme v2 are promptless, and thus
# unselectable by the user or through configuration files.
#
# SoC that are still using scheme v1 are still having a prompt but is loaded as
# they offer board maintainers the possibility to use board scheme v2.

config SOC
	string
	help
	  SoC name. The value of this setting must be defined by the selected
	  SoC for hw model v2.

config SOC_SERIES
	string
	help
	  SoC series. The value of this setting must be defined by the selected
	  SoC if the SoC belongs to a common series.

config SOC_FAMILY
	string
	help
	  SoC family. The value of this setting must be defined by the selected
	  SoC if the SoC belongs to a SoC family. Usually a SoC family also
	  indicates the vendor of the SoC.

config SOC_PART_NUMBER
	string
	help
	  This string holds the full part number of the SoC. It is a hidden option
	  that you should not set directly. The part number selection choice defines
	  the default value for this string.

# Source all Kconfig HWMv2 from SoC roots.
source "$(KCONFIG_BINARY_DIR)/soc/Kconfig.soc"
```

## soc/adi/max32/Kconfig
```kconfig
# Analog Devices MAX32xxx MCU family

# Copyright (c) 2023-2025 Analog Devices, Inc.
# SPDX-License-Identifier: Apache-2.0

config SOC_FAMILY_MAX32
	select CLOCK_CONTROL
	select BUILD_OUTPUT_HEX
	select SOC_EARLY_INIT_HOOK
	select HAS_SEGGER_RTT if ZEPHYR_SEGGER_MODULE

config SOC_FAMILY_MAX32_M33
	select ARM
	select CPU_CORTEX_M_HAS_SYSTICK
	select CPU_HAS_ARM_MPU
	select CPU_HAS_CUSTOM_FIXED_SOC_MPU_REGIONS
	select CPU_HAS_FPU
	select CLOCK_CONTROL
	select CPU_CORTEX_M33
	select ARM_TRUSTZONE_M
	select CPU_HAS_ARM_SAU
	select ARMV8_M_DSP
	select HAS_PM

config SOC_FAMILY_MAX32_M4
	select ARM
	select CPU_CORTEX_M4
	select CPU_CORTEX_M_HAS_SYSTICK
	select CPU_HAS_ARM_MPU
	select CPU_HAS_FPU
	select HAS_PM

config SOC_MAX32655_M4
	select MAX32_HAS_SECONDARY_RV32

config SOC_MAX32680_M4
	select MAX32_HAS_SECONDARY_RV32

config SOC_MAX32690_M4
	select MAX32_HAS_SECONDARY_RV32

config SOC_MAX78000_M4
	select MAX32_HAS_SECONDARY_RV32

config SOC_MAX78002_M4
	select MAX32_HAS_SECONDARY_RV32

if SOC_FAMILY_MAX32

config MAX32_ON_ENTER_CPU_IDLE_HOOK
	bool "CPU idle hook enable"
	default y if !PM
	imply ARM_ON_ENTER_CPU_IDLE_HOOK
	help
	  Enables a hook (z_arm_on_enter_cpu_idle()) that is called when
	  the CPU is made idle (by k_cpu_idle() or k_cpu_atomic_idle()).
	  If needed, this hook can be used to prevent the CPU from actually
	  entering sleep by skipping the WFE/WFI instruction.

config MAX32_HAS_SECONDARY_RV32
	bool

config MAX32_SECONDARY_RV32
	bool "Secondary RISC-V core enable"
	depends on MAX32_HAS_SECONDARY_RV32

DT_CHOSEN_Z_CODE_RV32_PARTITION := zephyr,code-rv32-partition

config MAX32_SECONDARY_RV32_BOOT_ADDRESS
	hex "Secondary RISC-V core boot address"
	default $(dt_chosen_reg_addr_hex,$(DT_CHOSEN_Z_CODE_RV32_PARTITION))
	depends on MAX32_SECONDARY_RV32

config BUILD_WITH_TFM
	default y if TRUSTED_EXECUTION_NONSECURE
	help
	  Auto set WITH_TFM for a Non-Secure version of the board,

endif # SOC_FAMILY_MAX32
```

## soc/adi/max32/Kconfig.defconfig.max32650
```kconfig
# Analog Devices MAX32650 MCU

# Copyright (c) 2025 Analog Devices, Inc.
# SPDX-License-Identifier: Apache-2.0

if SOC_MAX32650

config SYS_CLOCK_HW_CYCLES_PER_SEC
	default $(dt_node_int_prop_int,/clocks/clk_ipo,clock-frequency)

config NUM_IRQS
	default 80

endif # SOC_MAX32650
```

## soc/adi/max32/Kconfig.defconfig.max32655
```kconfig
# Analog Devices MAX32655 MCU

# Copyright (c) 2023-2024 Analog Devices, Inc.
# SPDX-License-Identifier: Apache-2.0

if SOC_MAX32655

if SOC_MAX32655_M4

config SYS_CLOCK_HW_CYCLES_PER_SEC
	default $(dt_node_int_prop_int,/clocks/clk_ipo,clock-frequency)

config NUM_IRQS
	default 110

endif

if SOC_MAX32655_RV32

config SYS_CLOCK_HW_CYCLES_PER_SEC
	default $(dt_node_int_prop_int,/clocks/clk_iso,clock-frequency)

config NUM_IRQS
	default 64

config ISR_STACK_SIZE
	default 1024

config IDLE_STACK_SIZE
	default 512

config ZTEST_STACK_SIZE
	default 1024
	depends on ZTEST

config TEST_EXTRA_STACK_SIZE
	default 512

endif

endif # SOC_MAX32655
```

## soc/adi/max32/Kconfig.defconfig.max32680
```kconfig
# Analog Devices MAX32680 MCU

# Copyright (c) 2024 Analog Devices, Inc.
# SPDX-License-Identifier: Apache-2.0

if SOC_MAX32680

config SYS_CLOCK_HW_CYCLES_PER_SEC
	default $(dt_node_int_prop_int,/clocks/clk_ipo,clock-frequency)

config NUM_IRQS
	default 104 if SOC_MAX32680_M4
	default 60 if SOC_MAX32680_RV32

endif # SOC_MAX32680
```

## soc/adi/max32/Kconfig.defconfig.max78000
```kconfig
# Analog Devices MAX78000 MCU

# Copyright (c) 2025 Analog Devices, Inc.
# SPDX-License-Identifier: Apache-2.0

if SOC_MAX78000

if SOC_MAX78000_M4

config SYS_CLOCK_HW_CYCLES_PER_SEC
	default $(dt_node_int_prop_int,/clocks/clk_ipo,clock-frequency)

config NUM_IRQS
	default 119

endif # SOC_MAX78000_M4

if SOC_MAX78000_RV32

config SYS_CLOCK_HW_CYCLES_PER_SEC
	default $(dt_node_int_prop_int,/clocks/clk_iso,clock-frequency)

config NUM_IRQS
	default 60

endif # SOC_MAX78000_RV32


endif # SOC_MAX78000
```

## soc/adi/max32/Kconfig.soc
```kconfig
# Analog Devices MAX32xxx MCU family

# Copyright (c) 2023-2025 Analog Devices, Inc.
# SPDX-License-Identifier: Apache-2.0

config SOC_FAMILY_MAX32
	bool

config SOC_FAMILY
	default "max32" if SOC_FAMILY_MAX32

config SOC_MAX32655
	bool
	select SOC_FAMILY_MAX32

config SOC_MAX32655_M4
	bool
	select SOC_MAX32655

config SOC_MAX32662
	bool
	select SOC_FAMILY_MAX32

config SOC_MAX32666
	bool
	select SOC_FAMILY_MAX32

config SOC_MAX32666_CPU0
	bool
	select SOC_MAX32666

config SOC_MAX32670
	bool
	select SOC_FAMILY_MAX32

config SOC_MAX32672
	bool
	select SOC_FAMILY_MAX32

config SOC_MAX32675
	bool
	select SOC_FAMILY_MAX32

config SOC_MAX32680
	bool
	select SOC_FAMILY_MAX32

config SOC_MAX32680_M4
	bool
	select SOC_MAX32680

config SOC_MAX32690
	bool
	select SOC_FAMILY_MAX32

config SOC_MAX32690_M4
	bool
	select SOC_MAX32690

config SOC_MAX78000
	bool
	select SOC_FAMILY_MAX32

config SOC_MAX78000_M4
	bool
	select SOC_MAX78000

config SOC_MAX78002
	bool
	select SOC_FAMILY_MAX32

config SOC_MAX78002_M4
	bool
	select SOC_MAX78002

config SOC
	default "max32655" if SOC_MAX32655
	default "max32662" if SOC_MAX32662
	default "max32666" if SOC_MAX32666
	default "max32670" if SOC_MAX32670
	default "max32672" if SOC_MAX32672
	default "max32675" if SOC_MAX32675
	default "max32680" if SOC_MAX32680
	default "max32690" if SOC_MAX32690
	default "max78000" if SOC_MAX78000
	default "max78002" if SOC_MAX78002
```

## soc/adi/max32/sbt/Kconfig.defconfig
```kconfig
# Copyright (c) 2026 Analog Devices, Inc.
# SPDX-License-Identifier: Apache-2.0

if MAX32_SECURE_SOC_SIGNING

config CUSTOM_LINKER_SCRIPT
	default "$(ZEPHYR_BASE)/soc/adi/max32/sbt/linker_with_sig_section.ld"

config BUILD_GAP_FILL_PATTERN
	default 0x00

endif
```
