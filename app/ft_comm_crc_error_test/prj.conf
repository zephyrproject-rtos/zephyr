## CMakeLists.txt
```
# SPDX-License-Identifier: Apache-2.0

cmake_minimum_required(VERSION 3.20.0)
find_package(Zephyr REQUIRED HINTS $ENV{ZEPHYR_BASE})
project(ft_comm_crc_error_test)
target_sources(app PRIVATE src/main.c)
```

## prj.conf
```kconfig
# Configuration file for CRC Error Test

CONFIG_FT_API_ENABLED=y
CONFIG_FT_EVENT_QUEUE_SIZE=16
CONFIG_FT_WORKER_STACK_SIZE=2048

CONFIG_LOG=y
CONFIG_LOG_MODE_DEFERRED=y
CONFIG_LOG_DEFAULT_LEVEL=3

CONFIG_PRINTK=y
CONFIG_EARLY_CONSOLE=y
```

## src/main.c
```c
/*
 * Fault Tolerance Test - Communication CRC Error
 * Copyright (c) 2025
 * SPDX-License-Identifier: Apache-2.0
 */

#include <zephyr/kernel.h>
#include <zephyr/fault_tolerance/ft_api.h>
#include <zephyr/logging/log.h>

LOG_MODULE_REGISTER(ft_comm_crc_test, LOG_LEVEL_INF);

#define TEST_DELAY_MS  2000

static volatile bool test_completed = false;

struct crc_context {
	const char *protocol;
	uint32_t expected_crc;
	uint32_t received_crc;
	uint32_t packet_id;
	size_t packet_size;
};

static ft_recovery_result_t crc_error_recovery(const ft_event_t *event)
{
	struct crc_context *ctx = NULL;

	LOG_WRN("=== CRC ERROR RECOVERY HANDLER ===");
	LOG_WRN("Fault Kind: %s", ft_kind_to_string(event->kind));

	if (event->context != NULL && event->context_size >= sizeof(struct crc_context)) {
		ctx = (struct crc_context *)event->context;
		LOG_WRN("Protocol: %s", ctx->protocol);
		LOG_WRN("Expected CRC: 0x%08x", ctx->expected_crc);
		LOG_WRN("Received CRC: 0x%08x", ctx->received_crc);
		LOG_WRN("Packet ID: %u", ctx->packet_id);
		LOG_WRN("Packet Size: %u bytes", ctx->packet_size);
	}

	LOG_INF("Requesting packet retransmission...");
	test_completed = true;
	return FT_RECOVERY_SUCCESS;
}

int main(void)
{
	LOG_INF("========================================");
	LOG_INF("Fault Tolerance Test: CRC Error");
	LOG_INF("========================================");

	ft_init();
	ft_register_handler(FT_COMM_CRC_ERROR, crc_error_recovery);
	ft_enable_detection(FT_COMM_CRC_ERROR);

	k_msleep(TEST_DELAY_MS);

	LOG_WRN("=== INITIATING CRC ERROR TEST ===");

	struct crc_context ctx = {
		.protocol = "UART",
		.expected_crc = 0x12345678,
		.received_crc = 0x12345600,
		.packet_id = 42,
		.packet_size = 128
	};

	ft_event_t event = {
		.kind = FT_COMM_CRC_ERROR,
		.severity = FT_SEV_WARNING,
		.domain = FT_DOMAIN_COMMUNICATION,
		.code = 0x7000,
		.timestamp = k_uptime_get(),
		.thread_id = k_current_get(),
		.context = &ctx,
		.context_size = sizeof(ctx)
	};

	ft_report_fault(&event);
	k_msleep(100);

	if (test_completed) {
		LOG_INF("=== TEST RESULT: PASS ===");
	}

	return 0;
}
```
