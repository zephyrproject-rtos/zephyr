## CMakeLists.txt
```
cmake_minimum_required(VERSION 3.20.0)

find_package(Zephyr REQUIRED HINTS $ENV{ZEPHYR_BASE})
project(tm1637_driver_app)



target_sources(app PRIVATE src/main.c)
```

## prj.conf
```kconfig
CONFIG_DISPLAY=y
CONFIG_DISPLAY_TM1637=y
CONFIG_DISPLAY_LOG_LEVEL_DEFAULT=y
CONFIG_DISPLAY_INIT_PRIORITY=80
```

## boards/esp32_devkitc_wrover_procpu.overlay
```dts
&gpio0  {
    tm1637:  tm1637_0  {
        compatible = "hw,tm1637";
        status = "okay";
        clk-gpios = <&gpio0 17 GPIO_ACTIVE_HIGH>;
        dio-gpios = <&gpio0 18 GPIO_ACTIVE_HIGH>;
    };
};
    
```

## src/main.c
```c
#include <zephyr/kernel.h>
#include <zephyr/device.h>
#include <zephyr/drivers/display_tm1637.h>



#define TM1637_NODE DT_NODELABEL(tm1637)

void main(void)
{
	const struct device *tm1637 = DEVICE_DT_GET(TM1637_NODE);

	if (!device_is_ready(tm1637)) {
		printk("TM1637 device not ready\n");
		return;
	}

	
		
	
	      
	      tm1637_display_raw_segments(tm1637,1,0x3f);
	     //tm1637_display_number(tm1637,8000,false);
	     
	      
		
	
}
```
