## boards/sifli/sf32lb52_devkit_lcd/Kconfig.sf32lb52_devkit_lcd
```kconfig
# Copyright (c) 2025 Core Devices LLC
# SPDX-License-Identifier: Apache-2.0

config BOARD_SF32LB52_DEVKIT_LCD
	select SOC_SF32LB525UC6
```

## boards/sifli/sf32lb52_devkit_lcd/board.yml
```yaml
# Copyright (c) 2025 Core Devices LLC
# SPDX-License-Identifier: Apache-2.0

board:
  name: sf32lb52_devkit_lcd
  full_name: SF32LB52-DevKit-LCD
  vendor: sifli
  socs:
    - name: sf32lb525uc6
```

## boards/sifli/sf32lb52_devkit_lcd/sf32lb52_devkit_lcd_defconfig
```kconfig
# Copyright (c) 2025 Core Devices LLC
# SPDX-License-Identifier: Apache-2.0

CONFIG_ARM_MPU=y
CONFIG_HW_STACK_PROTECTION=y

CONFIG_SERIAL=y
CONFIG_GPIO=y

CONFIG_CONSOLE=y
CONFIG_UART_CONSOLE=y
```

## boards/sifli/sf32lb58_devkit_lcd/Kconfig.defconfig
```kconfig
# Copyright (c) 2025 Qingdao IotPi Ltd.
#
# SPDX-License-Identifier: Apache-2.0

if BOARD_SF32LB58_DEVKIT_LCD
	config BOARD
		default "SF32LB58_DEVKIT_LCD"
endif
```

## boards/sifli/sf32lb58_devkit_lcd/Kconfig.sf32lb58_devkit_lcd
```kconfig
# Copyright (c) 2026 Qingsong Gou <gouqs@hotmail.com>
# SPDX-License-Identifier: Apache-2.0

config BOARD_SF32LB58_DEVKIT_LCD
	select SOC_SF32LB583VCC36
```

## boards/sifli/sf32lb58_devkit_lcd/board.yml
```yaml
# Copyright (c) 2026 Qingsong Gou <gouqs@hotmail.com>
# SPDX-License-Identifier: Apache-2.0

board:
  name: sf32lb58_devkit_lcd
  full_name: SF32LB58-DevKit-LCD
  vendor: sifli
  socs:
    - name: sf32lb583vcc36
```

## boards/sifli/sf32lb58_devkit_lcd/sf32lb58_devkit_lcd_sf32lb586_lcpu_defconfig
```kconfig
CONFIG_SERIAL=y
CONFIG_CONSOLE=y
CONFIG_UART_CONSOLE=y
CONFIG_CLOCK_CONTROL=y

CONFIG_ARM_MPU=y

CONFIG_HW_STACK_PROTECTION=y
CONFIG_MAIN_STACK_SIZE=2048
```

## boards/silabs/dev_kits/Kconfig
```kconfig
# SPDX-License-Identifier: Apache-2.0

# Add the board to the official Silabs development kits
source "boards/silabs/dev_kits/*/Kconfig"
```

## boards/silabs/dev_kits/bgm220_ek4314a/Kconfig.bgm220_ek4314a
```kconfig
# Copyright The Zephyr Project Contributors
# SPDX-License-Identifier: Apache-2.0

config BOARD_BGM220_EK4314A
	select SOC_BGM220PC22HNA
```

## boards/silabs/dev_kits/bgm220_ek4314a/Kconfig.defconfig
```kconfig
# Copyright The Zephyr Project Contributors
# SPDX-License-Identifier: Apache-2.0

if BOARD_BGM220_EK4314A

config LOG_BACKEND_SWO_FREQ_HZ
	default 875000
	depends on LOG_BACKEND_SWO

config FPU
	default y if SOC_GECKO_USE_RAIL || BT

if BT

config MAIN_STACK_SIZE
	default 3072 if PM
	default 2304

endif # BT

endif # BOARD_BGM220_EK4314A
```

## boards/silabs/dev_kits/bgm220_ek4314a/board.yml
```yaml
board:
  name: bgm220_ek4314a
  full_name: BGM220 Explorer Kit (BGM220-EK4314A)
  vendor: silabs
  socs:
    - name: bgm220pc22hna
```

## boards/silabs/dev_kits/efm32gg_sltb009a/Kconfig.efm32gg_sltb009a
```kconfig
# EFM32GG SLTB009A board configuration
# Copyright (c) 2023 Antmicro <www.antmicro.com>
# SPDX-License-Identifier: Apache-2.0

config BOARD_EFM32GG_SLTB009A
	select SOC_PART_NUMBER_EFM32GG12B810F1024GM64
```

## boards/silabs/dev_kits/efr32_thunderboard/Kconfig.efr32bg22_brd4184b
```kconfig
# EFR32BG SLTB010A board

# Copyright (c) 2021, Sateesh Kotapati
# SPDX-License-Identifier: Apache-2.0

config BOARD_EFR32BG22_BRD4184B
	select SOC_PART_NUMBER_EFR32BG22C224F512IM40
```

## boards/silabs/dev_kits/efr32_thunderboard/Kconfig.efr32bg27_brd2602a
```kconfig
# EFR32BG SLTB010A board

# Copyright (c) 2021, Sateesh Kotapati
# SPDX-License-Identifier: Apache-2.0

config BOARD_EFR32BG27_BRD2602A
	select SOC_PART_NUMBER_EFR32BG27C140F768IM40
```

## boards/silabs/dev_kits/pg23_pk2504a/Kconfig.defconfig
```kconfig
# Copyright (c) 2025 Christoph Jans
# SPDX-License-Identifier: Apache-2.0

if BOARD_PG23_PK2504A

config LOG_BACKEND_SWO_FREQ_HZ
	default 875000
	depends on LOG_BACKEND_SWO

endif
```

## boards/silabs/dev_kits/pg23_pk2504a/Kconfig.pg23_pk2504a
```kconfig
# Copyright (c) 2025 Christoph Jans
# SPDX-License-Identifier: Apache-2.0

config BOARD_PG23_PK2504A
	select SOC_EFM32PG23B310F512IM48
```

## boards/silabs/dev_kits/pg23_pk2504a/board.yml
```yaml
board:
  name: pg23_pk2504a
  full_name: EFM32PG23 Pro Kit (PG23-PK2504A)
  vendor: silabs
  socs:
    - name: efm32pg23b310f512im48
```

## boards/silabs/dev_kits/pg28_pk2506a/Kconfig.defconfig
```kconfig
# Copyright (c) 2025 Christoph Jans
# SPDX-License-Identifier: Apache-2.0

if BOARD_PG28_PK2506A

config LOG_BACKEND_SWO_FREQ_HZ
	default 875000
	depends on LOG_BACKEND_SWO

endif
```

## boards/silabs/dev_kits/pg28_pk2506a/Kconfig.pg28_pk2506a
```kconfig
# Copyright (c) 2025 Christoph Jans
# SPDX-License-Identifier: Apache-2.0

config BOARD_PG28_PK2506A
	select SOC_EFM32PG28B310F1024IM68
```

## boards/silabs/dev_kits/pg28_pk2506a/board.yml
```yaml
board:
  name: pg28_pk2506a
  full_name: EFM32PG28 Pro Kit (PG28-PK2506A)
  vendor: silabs
  socs:
    - name: efm32pg28b310f1024im68
```

## boards/silabs/dev_kits/sim3u1xx_dk/Kconfig.sim3u1xx_dk
```kconfig
# Copyright (c) 2024 GARDENA GmbH
#
# SPDX-License-Identifier: Apache-2.0

config BOARD_SIM3U1XX_DK
	select SOC_SIM3U167AGQ
```

## boards/silabs/dev_kits/sim3u1xx_dk/board.yml
```yaml
# Copyright (c) 2024 GARDENA GmbH
#
# SPDX-License-Identifier: Apache-2.0

board:
  name: sim3u1xx_dk
  full_name: SiM3U1xx 32-bit MCU USB Development Kit
  vendor: silabs
  socs:
    - name: sim3u167
```

## boards/silabs/dev_kits/siwx917_dk2605a/Kconfig.siwx917_dk2605a
```kconfig
# Copyright (c) 2025 Silicon Laboratories Inc.
# SPDX-License-Identifier: Apache-2.0

config BOARD_SIWX917_DK2605A
	select SOC_SIWG917M111MGTBA
```

## boards/silabs/dev_kits/siwx917_dk2605a/board.yml
```yaml
board:
  name: siwx917_dk2605a
  full_name: SiWx917 Wi-Fi 6 and Bluetooth LE SoC Dev Kit (BRD2605A)
  vendor: silabs
  socs:
    - name: siwg917m111mgtba
```
