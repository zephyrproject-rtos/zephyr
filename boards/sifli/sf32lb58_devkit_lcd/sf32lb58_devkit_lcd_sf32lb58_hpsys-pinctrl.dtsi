/*
 * Copyright (c) 2025 Qingdao IotPi Ltd.
 *
 * SPDX-License-Identifier: Apache-2.0
 */

#include <sifli/sf32lb58-hpsys-pinmux.dtsi>

&pinctrl {
	pinmux_usart1_default: pinmux_usart1_default {
		group0 {
			pinmux = <&uart1_rxd_pa32 &uart1_txd_pa31>;
			bias-disable;
		};
	};
};
