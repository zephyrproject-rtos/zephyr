/*
 * Copyright (c) 2019-2020 Cobham Gaisler AB
 *
 * SPDX-License-Identifier: Apache-2.0
 */

/dts-v1/;

#include <gaisler/leon3soc.dtsi>

/ {
	model = "Generic LEON3 system";
	compatible = "gaisler,generic-leon3";

	chosen {
		zephyr,console = &uart0;
		zephyr,shell-uart = &uart0;
		zephyr,sram = &ram0;
	};
};

&ram0 {
	reg = <0x40000000 0x00400000>;
};

&uart0 {
	status = "okay";
};
