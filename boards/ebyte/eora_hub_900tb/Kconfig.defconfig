## boards/ebyte/eora_hub_900tb/Kconfig.defconfig
```kconfig
# SPDX-FileCopyrightText: Copyright The Zephyr Project Contributors
# SPDX-License-Identifier: Apache-2.0

if BOARD_EORA_HUB_900TB

if LORA

choice LORA_MODULE_BACKEND
	default LORA_MODULE_BACKEND_NATIVE
endchoice

endif # LORA

endif # BOARD_EORA_HUB_900TB
```

## boards/ebyte/eora_hub_900tb/Kconfig.eora_hub_900tb
```kconfig
# Copyright (c) 2026 MASSDRIVER EI (massdriver.space)
# SPDX-License-Identifier: Apache-2.0

config BOARD_EORA_HUB_900TB
	select SOC_ESP32S3
	select SOC_ESP32S3_PROCPU if BOARD_EORA_HUB_900TB_ESP32S3_PROCPU
	select SOC_ESP32S3_APPCPU if BOARD_EORA_HUB_900TB_ESP32S3_APPCPU
```

## boards/ebyte/eora_hub_900tb/board.yml
```yaml
board:
  name: eora_hub_900tb
  full_name: Ebyte EoRa-HUB-900TB Module Test Kit
  vendor: ebyte
  socs:
    - name: esp32s3
```

## boards/efinix/titanium_ti60_f225/Kconfig.titanium_ti60_f225
```kconfig
# Copyright (c) 2023 Efinix Inc.
# SPDX-License-Identifier: Apache-2.0

config BOARD_TITANIUM_TI60_F225
	select SOC_EFINIX_SAPPHIRE
```

## boards/efinix/titanium_ti60_f225/board.yml
```yaml
board:
  name: titanium_ti60_f225
  full_name: Titanium Ti60 F225
  vendor: efinix
  socs:
  - name: efinix_sapphire
```

## boards/efinix/titanium_ti60_f225/titanium_ti60_f225_defconfig
```kconfig
# Copyright (c) 2023 Efinix Inc.
# SPDX-License-Identifier: Apache-2.0

CONFIG_CONSOLE=y
CONFIG_SERIAL=y
CONFIG_UART_CONSOLE=y
CONFIG_GPIO=y
CONFIG_CLOCK_CONTROL=n
CONFIG_XIP=n
CONFIG_HEAP_MEM_POOL_SIZE=16384
CONFIG_INIT_STACKS=n
```

## boards/egis/egis_et171/Kconfig.egis_et171
```kconfig
# Copyright (c) 2025 Egis Technology Inc.
# SPDX-License-Identifier: Apache-2.0

config BOARD_EGIS_ET171
	select SOC_EGIS_ET171
```

## boards/egis/egis_et171/board.yml
```yaml
board:
  name: egis_et171
  full_name: ET171 Development Board
  vendor: egis
  socs:
    - name: et171
```

## boards/elan/32f967_dv/32f967_dv_defconfig
```kconfig
# Copyright (c) 2026 ELAN Microelectronics Corp.
#
# SPDX-License-Identifier: Apache-2.0

CONFIG_SERIAL=y
CONFIG_CONSOLE=y
CONFIG_UART_CONSOLE=y
CONFIG_CLOCK_CONTROL=y
CONFIG_GPIO=y
```

## boards/elan/32f967_dv/Kconfig
```kconfig
menu "Zephyr"

config MAIN_STACK_SIZE
	int "MAIN_STACK_SIZE"
	default 4096

config ISR_STACK_SIZE
	int "ISR_STACK_SIZE"
	default 4096

config IDLE_STACK_SIZE
	int "IDLE_STACK_SIZE"
	default 1024

config UART_USE_RUNTIME_CONFIGURE
	bool	"UART_USE_RUNTIME_CONFIGURE"
	default n
	
config UART_INTERRUPT_DRIVEN
	bool	"UART_INTERRUPT_DRIVEN"
	default n
	
config UART_ASYNC_API
	bool	"UART_ASYNC_API"
	default n

endmenu
```

## boards/elan/32f967_dv/Kconfig.32f967_dv
```kconfig
# Copyright (c) 2025 ELAN Microelectronics Corp.
#
# SPDX-License-Identifier: Apache-2.0

config BOARD_32F967_DV
	select SOC_EM32F967
```

## boards/elan/32f967_dv/Kconfig.defconfig
```kconfig
# Copyright (c) 2025 ELAN Microelectronics Corp.
#
# SPDX-License-Identifier: Apache-2.0

config UART_USE_RUNTIME_CONFIGURE
	default n

config UART_INTERRUPT_DRIVEN
	default n

config UART_ASYNC_API
	default n
```

## boards/elan/32f967_dv/board.yml
```yaml
board:
  name: 32f967_dv
  full_name: ELAN EM32F967
  vendor: ELAN
  socs:
   - name: em32f967
```

## boards/electronut/nrf52840_blip/board.yml
```yaml
board:
  name: nrf52840_blip
  full_name: Labs Blip
  vendor: electronut
  socs:
  - name: nrf52840
```

## boards/electronut/nrf52840_papyr/Kconfig
```kconfig
# Electronut Labs Papyr board configuration

# Copyright (c) 2018 Electronut Labs
# SPDX-License-Identifier: Apache-2.0

config BOARD_ENABLE_DCDC
	bool "DCDC mode"
	select SOC_DCDC_NRF52X
	default y
	depends on BOARD_NRF52840_PAPYR
```

## boards/electronut/nrf52840_papyr/board.yml
```yaml
board:
  name: nrf52840_papyr
  full_name: Labs Papyr
  vendor: electronut
  socs:
  - name: nrf52840
```

## boards/electronut_labs/nrf52840_blip/board.yml
```yaml
board:
  name: nrf52840_blip
  vendor: Electronut Labs
  socs:
  - name: nrf52840
```

## boards/electronut_labs/nrf52840_papyr/Kconfig.nrf52840_papyr
```kconfig
# Electronut Labs Papyr board configuration

# Copyright (c) 2018 Electronut Labs
# SPDX-License-Identifier: Apache-2.0

config BOARD_NRF52840_PAPYR
	bool
	default y
	select SOC_NRF52840_QIAA
```

## boards/element14/warp7/Kconfig.defconfig
```kconfig
# WaRP7 iMX7S M4 board

# Copyright (c) 2018, Diego Sueiro
# SPDX-License-Identifier: Apache-2.0

if BOARD_WARP7

config FXOS8700_DRDY_INT1
	default y
	depends on FXOS8700_TRIGGER

config FXAS21002_DRDY_INT1
	default y
	depends on FXAS21002_TRIGGER

endif # BOARD_WARP7
```

## boards/element14/warp7/Kconfig.warp7
```kconfig
# Copyright (c) 2018, Diego Sueiro
# Copyright 2024 NXP
# SPDX-License-Identifier: Apache-2.0

config BOARD_WARP7
	select SOC_PART_NUMBER_MCIMX7S3DVK08SA
	select SOC_MCIMX7D_M4 if BOARD_WARP7_MCIMX7D_M4
```

## boards/element14/warp7/board.yml
```yaml
board:
  name: warp7
  full_name: WaRP7 - Next Generation IoT and Wearable Development Platform
  vendor: element14
  socs:
    - name: mcimx7d
```
