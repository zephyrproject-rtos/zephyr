/*
 * Copyright (c) 2026 MASSDRIVER EI (massdriver.space)
 *
 * SPDX-License-Identifier: Apache-2.0
 */

/dts-v1/;

#include "e80_900mbl_common.dtsi"

/ {
	model = "Ebyte E80 Module Development Board (LR2021, HF)";

	aliases {
		lora0 = &lora0;
	};
};

&spi1 {
	lora0: lora@0 {
		compatible = "semtech,lr2021";
		reg = <0>;
		spi-max-frequency = <1000000>;
		reset-gpios = <&gpiob 0 GPIO_ACTIVE_LOW>;
		busy-gpios = <&gpioa 3 GPIO_ACTIVE_HIGH>;
		irq-gpios = <&gpiob 1 (GPIO_PULL_DOWN | GPIO_ACTIVE_HIGH)>;
		dio-functions = "NONE", "NONE", "NONE", "NONE", "IRQ", "NONE", "NONE";
		dio-sleep-pulls = "UP", "NONE", "NONE", "NONE", "DOWN", "NONE", "NONE";
		tcxo-voltage = <2200>;
		use-simo;
		rx-boosted;
		status = "okay";
	};
};
