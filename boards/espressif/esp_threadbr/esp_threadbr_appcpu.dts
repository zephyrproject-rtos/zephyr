/*
 * Copyright (c) 2026 Espressif Systems (Shanghai) Co., Ltd.
 *
 * SPDX-License-Identifier: Apache-2.0
 */
/dts-v1/;

#include <espressif/esp32s3/esp32s3_wroom_n4.dtsi>
#include <espressif/esp32s3/esp32s3_appcpu.dtsi>
#include <espressif/partitions_0x0_amp.dtsi>

/ {
	model = "Espressif ESP Thread Border Router / ZigBee Gateway APPCPU";
	compatible = "espressif,esp32s3";

	chosen {
		zephyr,sram = &sram1;
		zephyr,ipc_shm = &shm0;
		zephyr,ipc = &ipm0;
		zephyr,flash = &flash0;
		zephyr,code-partition = &slot0_appcpu_partition;
	};
};

&trng0 {
	status = "okay";
};

&ipm0 {
	status = "okay";
};
