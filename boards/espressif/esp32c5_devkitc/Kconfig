## boards/espressif/esp32c5_devkitc/Kconfig
```kconfig
# Copyright (c) 2026 Espressif Systems (Shanghai) Co., Ltd.
# SPDX-License-Identifier: Apache-2.0

config HEAP_MEM_POOL_ADD_SIZE_BOARD
	int
	default 4096 if BOARD_ESP32C5_DEVKITC_ESP32C5_HPCORE
	default 256 if BOARD_ESP32C5_DEVKITC_ESP32C5_LPCORE
```

## boards/espressif/esp32c5_devkitc/Kconfig.esp32c5_devkitc
```kconfig
# ESP32C5 devkitc board configuration

# Copyright (c) 2026 Espressif Systems (Shanghai) Co., Ltd.
# SPDX-License-Identifier: Apache-2.0

config BOARD_ESP32C5_DEVKITC
	select SOC_ESP32_C5_WROOM_1_N8R4
	select SOC_ESP32C5_HPCORE if BOARD_ESP32C5_DEVKITC_ESP32C5_HPCORE
	select SOC_ESP32C5_LPCORE if BOARD_ESP32C5_DEVKITC_ESP32C5_LPCORE
```

## boards/espressif/esp32c5_devkitc/board.yml
```yaml
board:
  name: esp32c5_devkitc
  full_name: ESP32-C5-DevKitC-1
  vendor: espressif
  socs:
  - name: esp32c5
```

## boards/espressif/esp32c6_devkitc/Kconfig
```kconfig
# Copyright (c) 2024 Espressif Systems (Shanghai) Co., Ltd.
# SPDX-License-Identifier: Apache-2.0

config HEAP_MEM_POOL_ADD_SIZE_BOARD
	int
	default 4096 if BOARD_ESP32C6_DEVKITC_ESP32C6_HPCORE
	default 256 if BOARD_ESP32C6_DEVKITC_ESP32C6_LPCORE
```

## boards/espressif/esp32c6_devkitc/Kconfig.defconfig
```kconfig
# ESP32C6 devkitc board configuration

# Copyright (c) 2023 Espressif Systems (Shanghai) Co., Ltd.
# SPDX-License-Identifier: Apache-2.0

config HEAP_MEM_POOL_SIZE
	default 98304 if WIFI
	default 40960 if BT
	default 4096
```

## boards/espressif/esp32c6_devkitc/esp32c6_devkitc_lpcore_defconfig
```kconfig
# Copyright (c) 2025 Espressif Systems (Shanghai) Co., Ltd.
# SPDX-License-Identifier: Apache-2.0

# Memory protection
CONFIG_THREAD_STACK_INFO=n
CONFIG_THREAD_CUSTOM_DATA=n

# Boot
CONFIG_BOOT_BANNER=n

# Console
CONFIG_SERIAL=y
CONFIG_CONSOLE=y
CONFIG_UART_CONSOLE=y
CONFIG_PRINTK=n
CONFIG_CBPRINTF_NANO=y

# Build
CONFIG_SIZE_OPTIMIZATIONS=y
```

## boards/espressif/esp32h2_devkitm/Kconfig.esp32h2_devkitm
```kconfig
# ESP32-H2 DevKitM board configuration

# Copyright (c) 2025 Espressif Systems (Shanghai) Co., Ltd.
# SPDX-License-Identifier: Apache-2.0

config BOARD_ESP32H2_DEVKITM
	select SOC_ESP32_H2_MINI_H4
```

## boards/espressif/esp32h2_devkitm/Kconfig.sysbuild
```kconfig
# Copyright (c) 2025 Espressif Systems (Shanghai) Co., Ltd.
# SPDX-License-Identifier: Apache-2.0

choice BOOT_SIGNATURE_TYPE
	default BOOT_SIGNATURE_TYPE_NONE
endchoice
```

## boards/espressif/esp32h2_devkitm/board.yml
```yaml
board:
  name: esp32h2_devkitm
  full_name: ESP32-H2-DevKitM
  vendor: espressif
  socs:
  - name: esp32h2
```

## boards/espressif/esp32p4_function_ev_board/Kconfig
```kconfig
# Copyright (c) 2026 Espressif Systems (Shanghai) Co., Ltd.
# SPDX-License-Identifier: Apache-2.0

config HEAP_MEM_POOL_ADD_SIZE_BOARD
	int
	default 4096 if BOARD_ESP32P4_FUNCTION_EV_BOARD_ESP32P4_HPCORE
	default 256 if BOARD_ESP32P4_FUNCTION_EV_BOARD_ESP32P4_LPCORE
```

## boards/espressif/esp32p4_function_ev_board/Kconfig.esp32p4_function_ev_board
```kconfig
# ESP32-P4 Function EV Board configuration

# Copyright (c) 2026 Espressif Systems (Shanghai) Co., Ltd.
# SPDX-License-Identifier: Apache-2.0

config BOARD_ESP32P4_FUNCTION_EV_BOARD
	select SOC_ESP32P4_HPCORE if BOARD_ESP32P4_FUNCTION_EV_BOARD_ESP32P4_HPCORE
	select SOC_ESP32P4_LPCORE if BOARD_ESP32P4_FUNCTION_EV_BOARD_ESP32P4_LPCORE
	select SOC_ESP32P4_REV_1_3
```

## boards/espressif/esp32p4_function_ev_board/board.yml
```yaml
board:
  name: esp32p4_function_ev_board
  full_name: ESP32-P4-Function-EV-Board
  vendor: espressif
  socs:
  - name: esp32p4
```

## boards/espressif/esp32p4x_function_ev_board/board.yml
```yaml
board:
  name: esp32p4x_function_ev_board
  full_name: ESP32-P4X-Function-EV-Board
  vendor: espressif
  socs:
  - name: esp32p4
```

## boards/espressif/esp32s2_devkitc/Kconfig.defconfig
```kconfig
# ESP32S2 DevKitC board configuration

# Copyright (c) 2024 Espressif Systems (Shanghai) Co., Ltd.
# SPDX-License-Identifier: Apache-2.0

config ENTROPY_GENERATOR
	default y
```

## boards/espressif/esp32s2_devkitc/Kconfig.esp32s2_devkitc
```kconfig
# Copyright (c) 2024 Espressif Systems (Shanghai) Co., Ltd.
# SPDX-License-Identifier: Apache-2.0

config BOARD_ESP32S2_DEVKITC
	select SOC_ESP32S2_SOLO_N4R2
```

## boards/espressif/esp32s2_saola/Kconfig.defconfig
```kconfig
# ESP32S2 Saola board configuration

# Copyright (c) 2021 Espressif Systems (Shanghai) Co., Ltd.
# SPDX-License-Identifier: Apache-2.0

config ENTROPY_GENERATOR
	default y

config HEAP_MEM_POOL_ADD_SIZE_BOARD
	int
	default 8192
```

## boards/espressif/esp32s2_saola/Kconfig.esp32s2_saola
```kconfig
# Copyright (c) 2023 Espressif Systems (Shanghai) Co., Ltd.
# SPDX-License-Identifier: Apache-2.0

config BOARD_ESP32S2_SAOLA
	select SOC_ESP32S2_WROVER_N4R2
```

## boards/espressif/esp32s2_saola/board.yml
```yaml
board:
  name: esp32s2_saola
  full_name: ESP32-S2-Saola
  vendor: espressif
  socs:
  - name: esp32s2
```

## boards/espressif/esp32s3_box3/Kconfig
```kconfig
# Copyright (c) 2026 NotioNext LTD.
# SPDX-License-Identifier: Apache-2.0

config HEAP_MEM_POOL_ADD_SIZE_BOARD
	int
	default 4096 if BOARD_ESP32S3_BOX3_ESP32S3_PROCPU
	default 256 if BOARD_ESP32S3_BOX3_ESP32S3_APPCPU
```

## boards/espressif/esp32s3_box3/Kconfig.esp32s3_box3
```kconfig
# Copyright (c) 2026 NotioNext Ltd.
# SPDX-License-Identifier: Apache-2.0

config BOARD_ESP32S3_BOX3
	select SOC_ESP32S3_WROOM_N16R16
	select SOC_ESP32S3_PROCPU if BOARD_ESP32S3_BOX3_ESP32S3_PROCPU
	select SOC_ESP32S3_APPCPU if BOARD_ESP32S3_BOX3_ESP32S3_APPCPU
```

## boards/espressif/esp32s3_box3/Kconfig.sysbuild
```kconfig
# Copyright (c) 2026 NotioNext Ltd.
# SPDX-License-Identifier: Apache-2.0

choice BOOTLOADER
	default BOOTLOADER_MCUBOOT
endchoice

choice BOOT_SIGNATURE_TYPE
	default BOOT_SIGNATURE_TYPE_NONE
endchoice
```

## boards/espressif/esp32s3_box3/board.yml
```yaml
# Copyright (c) 2026 NotioNext Ltd.
# SPDX-License-Identifier: Apache-2.0

board:
  name: esp32s3_box3
  full_name: ESP32-S3-BOX-3
  vendor: espressif
  socs:
  - name: esp32s3
```

## boards/espressif/esp32s3_box3/esp32s3_box3_appcpu_defconfig
```kconfig
# Copyright (c) 2026 NotioNext Ltd.
# SPDX-License-Identifier: Apache-2.0

CONFIG_CLOCK_CONTROL=y
```

## boards/espressif/esp32s3_box3/esp32s3_box3_procpu_defconfig
```kconfig
# Copyright (c) 2026 NotioNext Ltd.
# SPDX-License-Identifier: Apache-2.0

CONFIG_CONSOLE=y
CONFIG_SERIAL=y
CONFIG_UART_CONSOLE=y
CONFIG_GPIO=y
CONFIG_CLOCK_CONTROL=y
CONFIG_SPI=y
```
