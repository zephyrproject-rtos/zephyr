## boards/espressif/esp32s3_devkitc/Kconfig.defconfig
```kconfig
# ESP32S3 DevKitC board configuration

# Copyright (c) 2024 Espressif Systems (Shanghai) Co., Ltd.
# SPDX-License-Identifier: Apache-2.0

if BOARD_ESP32S3_DEVKITC_ESP32S3_PROCPU

config HEAP_MEM_POOL_ADD_SIZE_BOARD
	int
	default 65535 if WIFI && BT
	default 51200 if WIFI
	default 40960 if BT
	default 4096

endif # BOARD_ESP32S3_DEVKITC_ESP32S3_PROCPU

if BOARD_ESP32S3_DEVKITC_ESP32S3_APPCPU

config HEAP_MEM_POOL_ADD_SIZE_BOARD
	default 256

endif # BOARD_ESP32S3_DEVKITC_ESP32S3_APPCPU
```

## boards/espressif/esp32s3_devkitc/Kconfig.esp32s3_devkitc
```kconfig
# Copyright (c) 2024 Espressif Systems (Shanghai) Co., Ltd.
# SPDX-License-Identifier: Apache-2.0

config BOARD_ESP32S3_DEVKITC
	select SOC_ESP32S3_WROOM_N8
	select SOC_ESP32S3_PROCPU if BOARD_ESP32S3_DEVKITC_ESP32S3_PROCPU
	select SOC_ESP32S3_APPCPU if BOARD_ESP32S3_DEVKITC_ESP32S3_APPCPU
```

## boards/espressif/esp32s3_devkitm/Kconfig
```kconfig
# Copyright (c) 2024 Espressif Systems (Shanghai) Co., Ltd.
# SPDX-License-Identifier: Apache-2.0

config BOARD_ESP32S3_DEVKITM
	select SOC_ESP32S3_PROCPU if BOARD_ESP32S3_DEVKITM_ESP32S3_PROCPU
	select SOC_ESP32S3_APPCPU if BOARD_ESP32S3_DEVKITM_ESP32S3_APPCPU
```

## boards/espressif/esp32s3_devkitm/Kconfig.defconfig
```kconfig
# ESP32S3 DevKitM board configuration

# Copyright (c) 2022 Espressif Systems (Shanghai) Co., Ltd.
# SPDX-License-Identifier: Apache-2.0

if BOARD_ESP32S3_DEVKITM_ESP32S3_PROCPU

config HEAP_MEM_POOL_ADD_SIZE_BOARD
	int
	default $(UINT16_MAX) if WIFI && BT
	default 51200 if WIFI
	default 40960 if BT
	default 4096

endif # BOARD_ESP32S3_DEVKITM_ESP32S3_PROCPU

if BOARD_ESP32S3_DEVKITM_ESP32S3_APPCPU

config HEAP_MEM_POOL_ADD_SIZE_BOARD
	default 256

endif # BOARD_ESP32S3_DEVKITM_ESP32S3_APPCPU
```

## boards/espressif/esp32s3_devkitm/Kconfig.esp32s3_devkitm
```kconfig
# Copyright (c) 2022 Espressif Systems (Shanghai) Co., Ltd.
# SPDX-License-Identifier: Apache-2.0

config BOARD_ESP32S3_DEVKITM
	select SOC_ESP32S3_MINI_N8
	select SOC_ESP32S3_PROCPU if BOARD_ESP32S3_DEVKITM_ESP32S3_PROCPU
	select SOC_ESP32S3_APPCPU if BOARD_ESP32S3_DEVKITM_ESP32S3_APPCPU
```

## boards/espressif/esp32s3_devkitm/esp32s3_devkitm_procpu_defconfig
```kconfig
# SPDX-License-Identifier: Apache-2.0

CONFIG_MAIN_STACK_SIZE=4096

CONFIG_CONSOLE=y
CONFIG_SERIAL=y
CONFIG_UART_CONSOLE=y
CONFIG_GPIO=y
CONFIG_CLOCK_CONTROL=y
```

## boards/espressif/esp32s3_eye/Kconfig.defconfig
```kconfig
# ESP32S3 EYE board configuration

# Copyright (c) 2024 Espressif Systems (Shanghai) Co., Ltd.
# SPDX-License-Identifier: Apache-2.0

if BOARD_ESP32S3_EYE_ESP32S3_PROCPU

config LV_COLOR_16_SWAP
	default y

endif # BOARD_ESP32S3_EYE_ESP32S3_PROCPU
```

## boards/espressif/esp32s3_eye/board.yml
```yaml
board:
  name: esp32s3_eye
  full_name: ESP32-S3-EYE
  vendor: espressif
  socs:
  - name: esp32s3
```

## boards/espressif/esp32s3_lcd_ev/board.yml
```yaml
board:
  name: esp32s3_lcd_ev
  full_name: ESP32-S3-LCD-EV-Board
  vendor: espressif
  socs:
  - name: esp32s3
```

## boards/espressif/esp8684_devkitm/Kconfig.esp8684_devkitm
```kconfig
# ESP8684 devkitm board configuration

# Copyright (c) 2024 Espressif Systems (Shanghai) Co., Ltd.
# SPDX-License-Identifier: Apache-2.0

config BOARD_ESP8684_DEVKITM
	select SOC_ESP8684_MINI_H4
```

## boards/espressif/esp8684_devkitm/board.yml
```yaml
board:
  name: esp8684_devkitm
  full_name: ESP8684-DevKitM
  vendor: espressif
  socs:
  - name: esp32c2
```

## boards/espressif/esp_threadbr/Kconfig.esp_threadbr
```kconfig
# Copyright (c) 2026 Espressif Systems (Shanghai) Co., Ltd.
# SPDX-License-Identifier: Apache-2.0

config BOARD_ESP_THREADBR
	select SOC_ESP32S3_WROOM_N8R2
	select SOC_ESP32S3_PROCPU if BOARD_ESP_THREADBR_ESP32S3_PROCPU
	select SOC_ESP32S3_APPCPU if BOARD_ESP_THREADBR_ESP32S3_APPCPU
```

## boards/espressif/esp_threadbr/board.yml
```yaml
board:
  name: esp_threadbr
  full_name: ESP Thread Border Router / ZigBee Gateway
  vendor: espressif
  socs:
  - name: esp32s3
```

## boards/espressif/esp_threadbr_zigbeegw/Kconfig.esp_threadbr_zigbeegw
```kconfig
# Copyright (c) 2025 Espressif Systems (Shanghai) Co., Ltd.
# SPDX-License-Identifier: Apache-2.0

config BOARD_ESP_THREADBR_ZIGBEEGW
	select SOC_ESP32S3_WROOM_N8R2
	select SOC_ESP32S3_PROCPU if BOARD_THREADBR_ZIGBEEGW_ESP32S3_PROCPU
	select SOC_ESP32S3_APPCPU if BOARD_THREADBR_ZIGBEEGW_ESP32S3_APPCPU
```

## boards/espressif/esp_threadbr_zigbeegw/board.yml
```yaml
board:
  name: esp_threadbr_zigbeegw
  full_name: ESP Thread Border Router / ZigBee router
  vendor: espressif
  socs:
  - name: esp32s3
```

## boards/espressif/esp_tz_router/Kconfig.esp_tz_router
```kconfig
# Copyright (c) 2025 Espressif Systems (Shanghai) Co., Ltd.
# SPDX-License-Identifier: Apache-2.0

config BOARD_ESP_TZ_ROUTER
	select SOC_ESP32S3_WROOM_N8R2
	select SOC_ESP32S3_PROCPU if BOARD_ESP_TZ_ROUTER_ESP32S3_PROCPU
	select SOC_ESP32S3_APPCPU if BOARD_ESP_TZ_ROUTER_ESP32S3_APPCPU
```

## boards/espressif/esp_tz_router/board.yml
```yaml
board:
  name: esp_tz_router
  full_name: ESP Thread Border Router / ZigBee router
  vendor: espressif
  socs:
  - name: esp32s3
```

## boards/espressif/esp_wrover_kit/Kconfig
```kconfig
# Copyright (c) 2024 Espressif Systems (Shanghai) Co., Ltd.
# SPDX-License-Identifier: Apache-2.0

config BOARD_ESP_WROVER_KIT
	select SOC_ESP32_PROCPU if BOARD_ESP_WROVER_KIT_ESP32_PROCPU
	select SOC_ESP32_APPCPU if BOARD_ESP_WROVER_KIT_ESP32_APPCPU
```

## boards/espressif/esp_wrover_kit/Kconfig.defconfig
```kconfig
# ESP-WROVER-KIT board configuration

# Copyright (c) 2021 Espressif Systems (Shanghai) Co., Ltd.
# SPDX-License-Identifier: Apache-2.0

if BOARD_ESP_WROVER_KIT_ESP32_PROCPU

config DISK_DRIVER_SDMMC
	default y

endif # BOARD_ESP_WROVER_KIT_ESP32_PROCPU
```

## boards/espressif/esp_wrover_kit/Kconfig.esp_wrover_kit
```kconfig
# ESP-WROVER-KIT board configuration

# Copyright (c) 2021 Espressif Systems (Shanghai) Co., Ltd.
# SPDX-License-Identifier: Apache-2.0

config BOARD_ESP_WROVER_KIT
	select SOC_ESP32_WROVER_E_N4R8
	select SOC_ESP32_PROCPU if BOARD_ESP_WROVER_KIT_ESP32_PROCPU
	select SOC_ESP32_APPCPU if BOARD_ESP_WROVER_KIT_ESP32_APPCPU
```

## boards/espressif/esp_wrover_kit/board.yml
```yaml
board:
  name: esp_wrover_kit
  full_name: ESP-WROVER-KIT
  vendor: espressif
  default_qualifier: esp32/procpu
  socs:
  - name: esp32
```

## boards/eurovibes/sertest-ng/Kconfig.defconfig
```kconfig
# Eurovibes STM32G431RB based Sertest NG board

# Copyright (c) 2026 Benedikt Spranger
# SPDX-License-Identifier: Apache-2.0

if BOARD_EUROVIBES_STM32G431_SERTEST_NG

source "boards/common/usb/Kconfig.cdc_acm_serial.defconfig"

endif # BOARD_MINI_STM32H743
```

## boards/eurovibes/sertest-ng/Kconfig.eurovibes_stm32g431_sertest-ng
```kconfig
# Copyright (c) 2026 Benedikt Spranger
# SPDX-License-Identifier: Apache-2.0

config BOARD_EUROVIBES_STM32G431_SERTEST_NG
	select SOC_STM32G431XX
```

## boards/eurovibes/sertest-ng/board.yml
```yaml
board:
  name: eurovibes_stm32g431_sertest-ng
  full_name: STM32G431 based Sertest-NG board
  vendor: eurovibes
  socs:
    - name: stm32g431xx
```
