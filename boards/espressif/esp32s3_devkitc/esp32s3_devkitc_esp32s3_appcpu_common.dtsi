/*
 * Copyright (c) 2024 Espressif Systems (Shanghai) Co., Ltd.
 *
 * SPDX-License-Identifier: Apache-2.0
 */

#include "esp32s3_devkitc-pinctrl.dtsi"

/ {
	model = "Espressif ESP32S3-DevkitC APPCPU";
	compatible = "espressif,esp32s3";

	chosen {
		zephyr,sram = &sram1;
		zephyr,ipc_shm = &shm0;
		zephyr,ipc = &ipm0;
		zephyr,flash = &flash0;
		zephyr,code-partition = &slot0_appcpu_partition;
	};
};

&trng0 {
	status = "okay";
};

&ipm0 {
	status = "okay";
};
