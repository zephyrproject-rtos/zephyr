/*
 * Copyright (c) 2024 Espressif Systems (Shanghai) Co., Ltd.
 *
 * SPDX-License-Identifier: Apache-2.0
 */
/dts-v1/;

#include <espressif/esp32s3/esp32s3_wroom_n8.dtsi>
#include <espressif/partitions_0x0_amp_8M.dtsi>
#include "esp32s3_devkitc_esp32s3_appcpu_common.dtsi"

/ {};
