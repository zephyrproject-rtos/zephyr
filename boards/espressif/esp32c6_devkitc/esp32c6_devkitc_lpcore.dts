/*
 * Copyright (c) 2025 Espressif Systems (Shanghai) Co., Ltd.
 *
 * SPDX-License-Identifier: Apache-2.0
 */
/dts-v1/;

#include <espressif/esp32c6/esp32c6_lpcore.dtsi>
#include <espressif/partitions_0x0_default.dtsi>

/ {
	compatible = "espressif,esp32c6";
	model = "Espressif ESP32C6-DevkitC LPCORE";

	chosen {
		zephyr,flash = &flash0;
		zephyr,sram = &ulp_ram;
		zephyr,code-partition = &slot0_lpcore_partition;
		zephyr,console = &lp_uart;
		zephyr,shell-uart = &lp_uart;
	};
};

&flash0 {
	reg = <0x0 DT_SIZE_M(8)>;
	ranges = <0x0 0x0 DT_SIZE_M(8)>;
};

&lp_uart {
	current-speed = <115200>;
	status = "okay";
};
