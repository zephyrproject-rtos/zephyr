/*
 * Copyright (c) 2026 Espressif Systems (Shanghai) Co., Ltd.
 *
 * SPDX-License-Identifier: Apache-2.0
 */

/dts-v1/;

#include <espressif/esp32p4/esp32p4_lpcore.dtsi>
#include <espressif/partitions_0x2000_default_16M.dtsi>

/ {
	model = "Espressif ESP32-P4X-Function-EV-Board LP Core";
	compatible = "espressif,esp32p4";

	chosen {
		zephyr,sram = &sramlp;
		zephyr,console = &lp_uart;
		zephyr,shell-uart = &lp_uart;
		zephyr,flash = &flash0;
		zephyr,code-partition = &slot0_lpcore_partition;
	};
};

&flash0 {
	reg = <0x0 DT_SIZE_M(16)>;
	ranges = <0x0 0x0 DT_SIZE_M(16)>;
};

&lp_uart {
	status = "okay";
	current-speed = <115200>;
};
