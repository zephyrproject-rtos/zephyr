## boards/snps/iotdk/board.yml
```yaml
board:
  name: iotdk
  full_name: ARC IoT Development Kit
  vendor: snps
  socs:
  - name: arc_iot
```

## boards/snps/iotdk/iotdk_defconfig
```kconfig
# SPDX-License-Identifier: Apache-2.0

CONFIG_XIP=n
CONFIG_BUILD_OUTPUT_BIN=n
CONFIG_ARCV2_INTERRUPT_UNIT=y
CONFIG_ARCV2_TIMER=y
CONFIG_CONSOLE=y
CONFIG_UART_CONSOLE=y
CONFIG_SERIAL=y
CONFIG_UART_INTERRUPT_DRIVEN=y
CONFIG_ARC_MPU_ENABLE=y
```

## boards/snps/nsim/arc_classic/Kconfig
```kconfig
# DesignWare ARC nSIM simulated platform configuration

# Copyright (c) 2016, 2019 Synopsys, Inc. All rights reserved.
# SPDX-License-Identifier: Apache-2.0

config BOARD_NSIM
	select HAS_COVERAGE_SUPPORT
```

## boards/snps/nsim/arc_classic/Kconfig.nsim
```kconfig
# DesignWare ARC nSIM simulated platform configuration

# Copyright (c) 2016, 2019 Synopsys, Inc. All rights reserved.
# SPDX-License-Identifier: Apache-2.0

config BOARD_NSIM
	select SOC_NSIM_EM if BOARD_NSIM_NSIM_EM
	select SOC_NSIM_EM7D_V22 if BOARD_NSIM_NSIM_EM7D_V22
	select SOC_NSIM_EM11D if BOARD_NSIM_NSIM_EM11D
	select SOC_NSIM_HS if BOARD_NSIM_NSIM_HS
	select SOC_NSIM_HS if BOARD_NSIM_NSIM_HS_SRAM
	select SOC_NSIM_HS_SMP if BOARD_NSIM_NSIM_HS_SMP
	select SOC_NSIM_HS if BOARD_NSIM_NSIM_HS_FLASH_XIP
	select SOC_NSIM_HS_MPUV6 if BOARD_NSIM_NSIM_HS_MPUV6
	select SOC_NSIM_HS if BOARD_NSIM_NSIM_HS_HOSTLINK
	select SOC_NSIM_HS5X if BOARD_NSIM_NSIM_HS5X
	select SOC_NSIM_HS5X_SMP if BOARD_NSIM_NSIM_HS5X_SMP
	select SOC_NSIM_HS5X_SMP if BOARD_NSIM_NSIM_HS5X_SMP_12CORES
	select SOC_NSIM_HS6X if BOARD_NSIM_NSIM_HS6X
	select SOC_NSIM_HS6X_SMP if BOARD_NSIM_NSIM_HS6X_SMP
	select SOC_NSIM_HS6X_SMP if BOARD_NSIM_NSIM_HS6X_SMP_12CORES
	select SOC_NSIM_SEM if BOARD_NSIM_NSIM_SEM
	select SOC_NSIM_SEM if BOARD_NSIM_NSIM_SEM_MPU_STACK_GUARD
	select SOC_NSIM_VPX5 if BOARD_NSIM_NSIM_VPX5
	help
	  The DesignWare ARC nSIM board is a virtual board based on
	  the ARC nSIM simulator. It demonstrates the ARC core features
	  and a console based on the ns16550 UART model.
```

## boards/snps/nsim/arc_classic/board.yml
```yaml
board:
  name: nsim
  full_name: ARC nSIM and HAPS FPGA boards
  vendor: snps
  socs:
  - name: nsim_em
  - name: nsim_em7d_v22
  - name: nsim_em11d
  - name: nsim_hs
    variants:
    - name: sram
    - name: smp
    - name: flash_xip
    - name: mpuv6
    - name: hostlink
  - name: nsim_hs5x
    variants:
    - name: smp
      variants:
      - name: 12cores
  - name: nsim_hs6x
    variants:
    - name: smp
      variants:
      - name: 12cores
  - name: nsim_sem
    variants:
    - name: mpu_stack_guard
  - name: nsim_vpx5
```

## boards/snps/nsim/arc_classic/nsim_nsim_hs_sram_defconfig
```kconfig
# SPDX-License-Identifier: Apache-2.0

CONFIG_SYS_CLOCK_TICKS_PER_SEC=100
CONFIG_BUILD_OUTPUT_BIN=n
CONFIG_ARCV2_INTERRUPT_UNIT=y
CONFIG_ARCV2_TIMER=y
CONFIG_CONSOLE=y
CONFIG_UART_CONSOLE=y
CONFIG_SERIAL=y
CONFIG_ARC_MPU_ENABLE=y
CONFIG_HARVARD=n
```

## boards/snps/nsim/arc_v/Kconfig.defconfig
```kconfig
# Copyright (c) 2024 Synopsys, Inc.
# SPDX-License-Identifier: Apache-2.0

if BOARD_NSIM_ARC_V_RMX100

config SYS_CLOCK_TICKS_PER_SEC
	default 1000

config SYS_CLOCK_HW_CYCLES_PER_SEC
	default 5000000

endif # BOARD_NSIM_ARC_V_RMX100
```

## boards/snps/nsim/arc_v/Kconfig.nsim_arc_v
```kconfig
# Copyright (c) 2024 Synopsys, Inc.
# SPDX-License-Identifier: Apache-2.0

config BOARD_NSIM_ARC_V
	select SOC_RMX100 if BOARD_NSIM_ARC_V_RMX100
```

## boards/snps/nsim/arc_v/board.yml
```yaml
board:
  name: nsim_arc_v
  full_name: RISC-V nSIM and HAPS FPGA boards
  vendor: snps
  socs:
  - name: rmx100
```

## boards/snps/nsim/arc_v/nsim_arc_v_rhx100_defconfig
```kconfig
# Copyright (c) 2024 Synopsys, Inc.
# SPDX-License-Identifier: Apache-2.0

CONFIG_XIP=n
CONFIG_CONSOLE=y
CONFIG_SERIAL=y
CONFIG_UART_CONSOLE=y
CONFIG_BUILD_OUTPUT_HEX=y
CONFIG_INCLUDE_RESET_VECTOR=y
CONFIG_LOG=y

# nSIM standalone mode has no PLIC/APLIC model, so UART interrupts never
# reach the CPU. Use polling mode for the shell UART backend instead.
CONFIG_SHELL_BACKEND_SERIAL_INTERRUPT_DRIVEN=n
```

## boards/snps/nsim/arc_v/nsim_arc_v_rmx100_defconfig
```kconfig
# Copyright (c) 2024 Synopsys, Inc.
# SPDX-License-Identifier: Apache-2.0

CONFIG_XIP=n
CONFIG_CONSOLE=y
CONFIG_SERIAL=y
CONFIG_UART_CONSOLE=y
CONFIG_BUILD_OUTPUT_HEX=y
CONFIG_INCLUDE_RESET_VECTOR=y
CONFIG_LOG=y
```

## boards/snps/nsim/arcv5/Kconfig.nsim_rmx500
```kconfig
# Copyright (c) 2024 Synopsys, Inc.
# SPDX-License-Identifier: Apache-2.0

config BOARD_NSIM_RMX500
	select SOC_NSIM_RV_RMX500
```

## boards/snps/nsim/arcv5/nsim_rmx500_defconfig
```kconfig
# Copyright (c) 2024 Synopsys, Inc.
# SPDX-License-Identifier: Apache-2.0

CONFIG_XIP=n
CONFIG_CONSOLE=y
CONFIG_SERIAL=y
CONFIG_UART_CONSOLE=y
CONFIG_BUILD_OUTPUT_HEX=y
CONFIG_MP_MAX_NUM_CPUS=1
#CONFIG_FLASH_SIZE=0
#CONFIG_FLASH_BASE_ADDRESS=0x0
CONFIG_DEBUG_OPTIMIZATIONS=y
# CONFIG_PLATFORM_SPECIFIC_INIT=y
CONFIG_INCLUDE_RESET_VECTOR=y
CONFIG_LOG=y
```

## boards/snps/nsim_riscv/Kconfig.defconfig
```kconfig
# Copyright (c) 2024 Synopsys, Inc.
# SPDX-License-Identifier: Apache-2.0

if BOARD_NSIM_RISCV_RMX500

config SYS_CLOCK_TICKS_PER_SEC
	default 1000

config SYS_CLOCK_HW_CYCLES_PER_SEC
	default 5000000

endif # BOARD_NSIM_RISCV_RMX500
```

## boards/snps/nsim_riscv/Kconfig.nsim_riscv
```kconfig
# Copyright (c) 2024 Synopsys, Inc.
# SPDX-License-Identifier: Apache-2.0

config BOARD_NSIM_RISCV
	select SOC_RMX500 if BOARD_NSIM_RISCV_RMX500
```

## boards/solderedelectronics/inkplate_6color/Kconfig
```kconfig
# Copyright (c) 2026 Fabian Blatz <fabianblatz@gmail.com>
# SPDX-License-Identifier: Apache-2.0

config HEAP_MEM_POOL_ADD_SIZE_BOARD
	int
	default 4096 if BOARD_INKPLATE_6COLOR_ESP32_PROCPU
	default 256 if BOARD_INKPLATE_6COLOR_ESP32_APPCPU
```

## boards/solderedelectronics/inkplate_6color/Kconfig.defconfig
```kconfig
# Copyright (c) 2026 Fabian Blatz <fabianblatz@gmail.com>
# SPDX-License-Identifier: Apache-2.0

if GPIO_PCAL64XXA

config GPIO_HOGS_INIT_PRIORITY
	default 75 # Ensure Expander is initialized first

endif # GPIO_PCAL64XXA
```

## boards/solderedelectronics/inkplate_6color/Kconfig.inkplate_6color
```kconfig
# Copyright (c) 2026 Fabian Blatz <fabianblatz@gmail.com>
# SPDX-License-Identifier: Apache-2.0

config BOARD_INKPLATE_6COLOR
	select SOC_ESP32_WROVER_E_N4R8
	select SOC_ESP32_PROCPU if BOARD_INKPLATE_6COLOR_ESP32_PROCPU
	select SOC_ESP32_APPCPU if BOARD_INKPLATE_6COLOR_ESP32_APPCPU
```

## boards/solderedelectronics/inkplate_6color/board.yml
```yaml
board:
  name: inkplate_6color
  full_name: Inkplate 6Color
  vendor: solderedelectronics
  socs:
  - name: esp32
```

## boards/space_cubics/scobc_module1/board.yml
```yaml
board:
  name: scobc_module1
  vendor: spacecubics
  socs:
  - name: designstart_fpga_cortex_m3
```

## boards/sparc/generic_leon3/Kconfig.board
```kconfig
# Copyright (c) 2019-2020 Cobham Gaisler AB
#
# SPDX-License-Identifier: Apache-2.0

config BOARD_GENERIC_LEON3
	bool "Generic LEON3 system"
	depends on SOC_LEON3
```

## boards/sparc/generic_leon3/Kconfig.defconfig
```kconfig
# Copyright (c) 2019-2020 Cobham Gaisler AB
#
# SPDX-License-Identifier: Apache-2.0

if BOARD_GENERIC_LEON3

config BOARD
	default "generic_leon3"

config SPARC_CASA
	default n

config SYS_CLOCK_HW_CYCLES_PER_SEC
	default 50000000

endif
```

## boards/sparc/generic_leon3/Kconfig.generic_leon3
```kconfig
# Copyright (c) 2022 Zephyr Project members and individual contributors
# SPDX-License-Identifier: Apache-2.0

config BOARD_GENERIC_LEON3
	bool
	default y
	select SOC_LEON3
```
