/dts-v1/;

#include <synopsys/rmx500.dtsi>

/ {
	model = "Synpsys Rmx500";
	compatible = "snps,rmx500";

	aliases {
		uart-0 = &uart0;
	};

	chosen {
		zephyr,sram = &ddr0;
		zephyr,console = &uart0;
		zephyr,shell-uart = &uart0;
	};

};

&uart0 {
	status = "okay";
	current-speed = <115200>;
};
