/dts-v1/;

#include "rhx100.dtsi"

/ {
	compatible = "snps,rhx100";
	model = "Synopsys RHX100";

	aliases {
		uart-0 = &uart0;
	};

	chosen {
		zephyr,sram = &ddr0;
		zephyr,console = &uart0;
		zephyr,shell-uart = &uart0;
	};
};

&uart0 {
	current-speed = <115200>;
	status = "okay";
};
