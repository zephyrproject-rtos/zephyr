/dts-v1/;

#include "rmx500.dtsi"

/ {
	model = "Synopsys RMX500";
	compatible = "snps,rmx500";

	aliases {
		uart-0 = &uart0;
	};

	chosen {
		zephyr,sram = &ddr0;
		zephyr,console = &uart0;
		zephyr,shell-uart = &uart0;
	};

};

&uart0 {
	status = "okay";
	current-speed = <115200>;
};
