/*
 * Copyright (c) 2019, Synopsys, Inc. All rights reserved.
 *
 * SPDX-License-Identifier: Apache-2.0
 */

/dts-v1/;

#define ICCM_SIZE DT_SIZE_K(512)
#define DCCM_SIZE DT_SIZE_K(512)

#include "nsim_em-sec.dtsi"

/ {
	model = "snps,nsim_sem";
	compatible = "snps,nsim_sem";
};
