/*
 * Copyright (c) 2022, Synopsys, Inc. All rights reserved.
 *
 * SPDX-License-Identifier: Apache-2.0
 */

#include "skeleton.dtsi"
#include <mem.h>

#ifndef ICCM_ADDR
#define ICCM_ADDR 0
#endif

#ifndef ICCM_SIZE
#define ICCM_SIZE DT_SIZE_M(1)
#endif

#ifndef DCCM_ADDR
#define DCCM_ADDR 80000000
#endif

#ifndef DCCM_SIZE
#define DCCM_SIZE DT_SIZE_M(1)
#endif

/ {
	iccm0: iccm@ICCM_ADDR {
		compatible = "arc,iccm";
		reg = <DT_ADDR(ICCM_ADDR) ICCM_SIZE>;
	};

	dccm0: dccm@DCCM_ADDR {
		compatible = "arc,dccm";
		reg = <DT_ADDR(DCCM_ADDR) DCCM_SIZE>;
	};

	chosen {
		zephyr,sram = &dccm0;
	};
};
