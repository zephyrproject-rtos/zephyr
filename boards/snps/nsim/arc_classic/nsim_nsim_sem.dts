/*
 * Copyright (c) 2018, Synopsys, Inc. All rights reserved.
 *
 * SPDX-License-Identifier: Apache-2.0
 */

/dts-v1/;

#define ICCM_SIZE DT_SIZE_K(256)
#define DCCM_SIZE DT_SIZE_K(256)

#include "nsim_em-sec.dtsi"

/ {
	model = "snps,nsim_sem";
	compatible = "snps,nsim_sem";
};
