/*
 * Copyright (c) 2021, Synopsys, Inc.
 *
 * SPDX-License-Identifier: Apache-2.0
 */

/dts-v1/;

#include "nsim.dtsi"
#include "nsim-flat-mem.dtsi"
#include "nsim-uart-ns16550.dtsi"

/ {
	compatible = "snps,nsim_hs";
	model = "snps,nsim_hs";

	cpus {
		#address-cells = <1>;
		#size-cells = <0>;

		cpu@0 {
			compatible = "snps,archs";
			reg = <0>;
			device_type = "cpu";
		};
	};
};
