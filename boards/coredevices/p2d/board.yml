## boards/coredevices/p2d/board.yml
```yaml
# Copyright (c) 2025 Core Devices LLC
# SPDX-License-Identifier: Apache-2.0

boards:
- name: p2d
  full_name: Pebble 2 Duo
  vendor: coredevices
  socs:
  - name: nrf52840
```

## boards/coredevices/pt2/Kconfig.pt2
```kconfig
# Copyright (c) 2025 Core Devices LLC
# SPDX-License-Identifier: Apache-2.0

config BOARD_PT2
	select SOC_SF32LB52JUD6
```

## boards/coredevices/pt2/board.yml
```yaml
# Copyright (c) 2025 Core Devices LLC
# SPDX-License-Identifier: Apache-2.0

board:
  name: pt2
  full_name: Pebble Time 2
  vendor: coredevices
  socs:
    - name: sf32lb52jud6
```

## boards/coredevices/pt2/pt2_defconfig
```kconfig
# Copyright (c) 2025 Core Devices LLC
# SPDX-License-Identifier: Apache-2.0

CONFIG_ARM_MPU=y
CONFIG_HW_STACK_PROTECTION=y

CONFIG_SERIAL=y
CONFIG_GPIO=y

CONFIG_CONSOLE=y
CONFIG_UART_CONSOLE=y

CONFIG_SF32LB52X_BOOTROM_FLASH_ON_DELAY_MS=100
CONFIG_SF32LB52X_BOOTROM_FLASH_OFF_DELAY_MS=100
```

## boards/croxel/croxel_cx1825/Kconfig
```kconfig
# Copyright (c) 2024 Luis Ubieda
# SPDX-License-Identifier: Apache-2.0

if BOARD_CROXEL_CX1825

config BOARD_ENABLE_DCDC
	bool "DCDC mode"
	select SOC_DCDC_NRF52X
	default y

config BOARD_ENABLE_DCDC_HV
	bool "High Voltage DCDC converter"
	select SOC_DCDC_NRF52X_HV
	default y

endif # BOARD_CROXEL_CX1825
```

## boards/croxel/croxel_cx1825/Kconfig.croxel_cx1825
```kconfig
# Copyright (c) 2024 Luis Ubieda
# SPDX-License-Identifier: Apache-2.0

config BOARD_CROXEL_CX1825
	select SOC_NRF52840_QIAA
```

## boards/croxel/croxel_cx1825/Kconfig.defconfig
```kconfig
# Copyright (c) 2024 Luis Ubieda
# SPDX-License-Identifier: Apache-2.0

if BOARD_CROXEL_CX1825

source "boards/common/usb/Kconfig.cdc_acm_serial.defconfig"

endif # BOARD_CROXEL_CX1825
```

## boards/croxel/croxel_cx1825/board.yml
```yaml
board:
  name: croxel_cx1825
  full_name: CX1825 nRF52840
  vendor: croxel
  socs:
  - name: nrf52840
```

## boards/croxel/croxel_cx1825/croxel_cx1825_nrf52840_defconfig
```kconfig
# Copyright (c) 2024 Luis Ubieda
# SPDX-License-Identifier: Apache-2.0

# Enable MPU
CONFIG_ARM_MPU=y

# Enable hardware stack protection
CONFIG_HW_STACK_PROTECTION=y

# enable GPIO
CONFIG_GPIO=y

CONFIG_SERIAL=y
CONFIG_CONSOLE=y
CONFIG_UART_CONSOLE=y
CONFIG_UART_INTERRUPT_DRIVEN=y
CONFIG_UART_LINE_CTRL=y
```

## boards/ct/ctcc/Kconfig
```kconfig
# CTHINGS.CO Connectivity Card board configuration

# Copyright (c) 2024 CTHINGS.CO
# SPDX-License-Identifier: Apache-2.0

config BOARD_SERIAL_BACKEND_CDC_ACM
	bool "USB CDC"
	default y
	depends on BOARD_CTCC_NRF52840
```

## boards/ct/ctcc/Kconfig.ctcc
```kconfig
# CTHINGS.CO Connectivity Card board configuration

# Copyright (c) 2024 CTHINGS.CO
# SPDX-License-Identifier: Apache-2.0

config BOARD_CTCC
	select SOC_NRF52840_QIAA if BOARD_CTCC_NRF52840
	select SOC_NRF9161_LACA if BOARD_CTCC_NRF9161 || BOARD_CTCC_NRF9161_NS
```

## boards/ct/ctcc/Kconfig.defconfig
```kconfig
# CTHINGS.CO Connectivity Card board configuration

# Copyright (c) 2024 CTHINGS.CO
# SPDX-License-Identifier: Apache-2.0

if BOARD_CTCC_NRF52840

source "boards/common/usb/Kconfig.cdc_acm_serial.defconfig"

endif # BOARD_CTCC_NRF52840

config BOARD_CTCC
	select USE_DT_CODE_PARTITION if BOARD_CTCC_NRF9161_NS
```

## boards/ct/ctcc/board.yml
```yaml
board:
  name: ctcc
  full_name: CTHINGS.CO Connectivity Card
  vendor: ct
  socs:
    - name: nrf52840
    - name: nrf9161
      variants:
        - name: 'ns'
```

## boards/ct/ctcc/ctcc_nrf9161_ns_defconfig
```kconfig
# SPDX-License-Identifier: Apache-2.0

# Enable MPU
CONFIG_ARM_MPU=y

# Enable hardware stack protection
CONFIG_HW_STACK_PROTECTION=y

# Enable TrustZone-M
CONFIG_ARM_TRUSTZONE_M=y

# This board implies building Non-Secure firmware
CONFIG_TRUSTED_EXECUTION_NONSECURE=y

# Enable GPIO
CONFIG_GPIO=y

# Enable UART driver
CONFIG_SERIAL=y

# Enable console
CONFIG_CONSOLE=y
CONFIG_UART_CONSOLE=y
```

## boards/cypress/cy8ckit_062_ble/Kconfig.cy8ckit_062_ble
```kconfig
# PSOC 6 BLE Pioneer Kit configuration

# Copyright (c) 2018 Cypress
# Copyright (c) 2020 ATL Electronics
# SPDX-License-Identifier: Apache-2.0

config BOARD_CY8CKIT_062_BLE
	select SOC_PART_NUMBER_CY8C6347BZI_BLD53
	select SOC_CY8C6347_M0 if BOARD_CY8CKIT_062_BLE_CY8C6347_M0
	select SOC_CY8C6347_M4 if BOARD_CY8CKIT_062_BLE_CY8C6347_M4
```

## boards/cypress/cy8ckit_062_ble/board.yml
```yaml
board:
  name: cy8ckit_062_ble
  full_name: PSOC 63 BLE Pioneer Kit
  vendor: cypress
  revision:
    format: "major.minor.patch"
    default: "0.0.0"
    revisions:
      - name: "0.0.0"
      - name: "1.0.0"
  socs:
    - name: cy8c6347
```

## boards/cypress/cy8ckit_062_ble/cy8ckit_062_ble_cy8c6347_m4_defconfig
```kconfig
#
# Copyright (c) 2018, Cypress
# Copyright (c) 2020, ATL Electronics
#
# SPDX-License-Identifier: Apache-2.0
#

CONFIG_CONSOLE=y
CONFIG_UART_CONSOLE=y

# UART driver
CONFIG_SERIAL=y
```

## boards/cypress/cy8ckit_062_wifi_bt/Kconfig.cy8ckit_062_wifi_bt
```kconfig
# PSOC 6 WiFi-BT Pioneer Kit configuration

# Copyright (c) 2018 Cypress
# Copyright (c) 2020 ATL Electronics
# SPDX-License-Identifier: Apache-2.0

config BOARD_CY8CKIT_062_WIFI_BT
	select SOC_PART_NUMBER_CY8C6247BZI_D54
	select SOC_CY8C6247_M0 if BOARD_CY8CKIT_062_WIFI_BT_CY8C6247_M0
	select SOC_CY8C6247_M4 if BOARD_CY8CKIT_062_WIFI_BT_CY8C6247_M4
```

## boards/cypress/cy8ckit_062_wifi_bt/board.yml
```yaml
board:
  name: cy8ckit_062_wifi_bt
  full_name: PSOC 6 WiFi-BT Pioneer Kit
  vendor: cypress
  socs:
  - name: cy8c6247
```

## boards/cypress/cy8ckit_062_wifi_bt/cy8ckit_062_wifi_bt_cy8c6247_m0_defconfig
```kconfig
#
# Copyright (c) 2018, Cypress
#
# SPDX-License-Identifier: Apache-2.0
#

CONFIG_CONSOLE=y
CONFIG_UART_CONSOLE=y
CONFIG_BUILD_OUTPUT_HEX=y

# UART driver
CONFIG_SERIAL=y
```

## boards/cypress/cy8ckit_062s4/board.yml
```yaml
board:
  name: cy8ckit_062s4
  vendor: cypress
  socs:
  - name: cy8c6244lqi_s4d92
```

## boards/cypress/cy8cproto_062_4343w/board.yml
```yaml
board:
  name: cy8cproto_062_4343w
  vendor: cypress
  socs:
  - name: cy8c624abzi_s2d44
```

## boards/cypress/cy8cproto_062_4343w/cy8cproto_062_4343w_defconfig
```kconfig
#
# Copyright (c) 2021 Cypress Semiconductor Corporation.
# SPDX-License-Identifier: Apache-2.0
#

# General configuration
CONFIG_CORTEX_M_SYSTICK=y
CONFIG_BUILD_OUTPUT_HEX=y

CONFIG_ARM_MPU=y
CONFIG_HW_STACK_PROTECTION=y

# Enable console
CONFIG_CONSOLE=y
CONFIG_UART_CONSOLE=y

# Enable UART driver
CONFIG_SERIAL=y

# Enable pin controller
CONFIG_PINCTRL=y

# Enable GPIO driver
CONFIG_GPIO=y

# Enable clock controller
CONFIG_CLOCK_CONTROL=y

# Main Stack Size
CONFIG_MAIN_STACK_SIZE=2048
```

## boards/cypress/cy8cproto_063_ble/Kconfig.cy8cproto_063_ble
```kconfig
# CY8CPROTO-063-BLE PSoC™ 6 BLE Prototyping Kit
#
# Copyright (c) 2023 Cypress Semiconductor Corporation (an Infineon company) or
# an affiliate of Cypress Semiconductor Corporation
# SPDX-License-Identifier: Apache-2.0

config BOARD_CY8CPROTO_063_BLE
	select SOC_CYBLE_416045_02
```

## boards/cypress/cy8cproto_063_ble/board.yml
```yaml
board:
  name: cy8cproto_063_ble
  vendor: cypress
  socs:
  - name: cyble_416045_02
```
