## boards/sc/scobc_a1/scobc_a1_defconfig
```kconfig
# SPDX-License-Identifier: Apache-2.0

CONFIG_ARM_MPU=n

CONFIG_SERIAL=y
CONFIG_UART_INTERRUPT_DRIVEN=y
CONFIG_CONSOLE=y
CONFIG_UART_CONSOLE=y

CONFIG_XIP=n
CONFIG_FLASH_SIZE=0
CONFIG_FLASH_BASE_ADDRESS=0x0
```

## boards/seagate/faze/Kconfig.defconfig
```kconfig
#
# Copyright The Zephyr Project Contributors
#
# SPDX-License-Identifier: Apache-2.0
#

configdefault MAIN_STACK_SIZE
	default 512

configdefault ISR_STACK_SIZE
	default 768

configdefault SYS_CLOCK_HW_CYCLES_PER_SEC
	default $(dt_node_int_prop_int,/cpus/cpu@0,clock-frequency)
```

## boards/seeed/xiao_nrf52840_plus/Kconfig.defconfig
```kconfig
# SPDX-FileCopyrightText: Copyright The Zephyr Project Contributors
# SPDX-License-Identifier: Apache-2.0

if BOARD_XIAO_NRF52840_PLUS

source "boards/common/usb/Kconfig.cdc_acm_serial.defconfig"

endif # BOARD_XIAO_NRF52840_PLUS
```

## boards/seeed/xiao_nrf52840_plus/Kconfig.xiao_nrf52840_plus
```kconfig
# SPDX-FileCopyrightText: Copyright The Zephyr Project Contributors
# SPDX-License-Identifier: Apache-2.0

config BOARD_XIAO_NRF52840_PLUS
	select SOC_NRF52840_QIAA
```

## boards/seeed/xiao_nrf52840_plus/board.yml
```yaml
board:
  name: xiao_nrf52840_plus
  full_name: XIAO nRF52840 (Sense) Plus
  vendor: seeed
  socs:
  - name: nrf52840
    variants:
    - name: 'sense'
```

## boards/seeed/xiao_nrf54l15/board.yml
```yaml
board:
  name: xiao_nrf54l15
  full_name: XIAO NRF54L15
  vendor: seeed
  socs:
  - name: nrf54l15
    variants:
    - name: xip
      cpucluster: cpuflpr
runners:
  run_once:
    '--recover':
    - runners:
      - nrfjprog
      - nrfutil
      run: first
      groups:
      - boards:
        - xiao_nrf54l15/nrf54l15/cpuapp
        - xiao_nrf54l15/nrf54l15/cpuflpr
        - xiao_nrf54l15/nrf54l15/cpuflpr/xip
    '--erase':
    - runners:
      - nrfjprog
      - jlink
      - nrfutil
      - openocd
      run: first
      groups:
      - boards:
        - xiao_nrf54l15/nrf54l15/cpuapp
        - xiao_nrf54l15/nrf54l15/cpuflpr
        - xiao_nrf54l15/nrf54l15/cpuflpr/xip
    '--reset':
    - runners:
      - nrfjprog
      - jlink
      - nrfutil
      run: last
      groups:
      - boards:
        - xiao_nrf54l15/nrf54l15/cpuapp
        - xiao_nrf54l15/nrf54l15/cpuflpr
        - xiao_nrf54l15/nrf54l15/cpuflpr/xip
```

## boards/seeed/xiao_nrf54lm20a/Kconfig.xiao_nrf54lm20a
```kconfig
# Copyright (c) 2025 Seeed Technology Co., Ltd.
# SPDX-License-Identifier: Apache-2.0

config BOARD_XIAO_NRF54LM20A
	select SOC_NRF54LM20A_CPUAPP if BOARD_XIAO_NRF54LM20A_NRF54LM20A_CPUAPP || \
					BOARD_XIAO_NRF54LM20A_NRF54LM20A_CPUAPP_NS
	select SOC_NRF54LM20A_CPUFLPR if BOARD_XIAO_NRF54LM20A_NRF54LM20A_CPUFLPR
```

## boards/seeed/xiao_nrf54lm20a/board.yml
```yaml
board:
  name: xiao_nrf54lm20a
  full_name: XIAO nRF54LM20A
  vendor: seeed
  revision:
    format: major.minor.patch
    default: "1.0.0"
    revisions:
      - name: "1.0.0"
      - name: "2.0.0"
  socs:
    - name: nrf54lm20a
runners:
  run_once:
    '--recover':
      - runners:
          - nrfjprog
          - nrfutil
        run: first
        groups:
          - boards:
              - xiao_nrf54lm20a/nrf54lm20a/cpuapp
              - xiao_nrf54lm20a/nrf54lm20a/cpuflpr
    '--erase':
      - runners:
          - nrfjprog
          - jlink
          - nrfutil
          - openocd
        run: first
        groups:
          - boards:
              - xiao_nrf54lm20a/nrf54lm20a/cpuapp
              - xiao_nrf54lm20a/nrf54lm20a/cpuflpr
    '--reset':
      - runners:
          - nrfjprog
          - jlink
          - nrfutil
        run: last
        groups:
          - boards:
              - xiao_nrf54lm20a/nrf54lm20a/cpuapp
              - xiao_nrf54lm20a/nrf54lm20a/cpuflpr
```

## boards/seeed/xiao_nrf54lm20b/Kconfig.xiao_nrf54lm20b
```kconfig
# Copyright (c) 2026 Seeed Technology Co., Ltd.
# SPDX-License-Identifier: Apache-2.0

config BOARD_XIAO_NRF54LM20B
	select SOC_NRF54LM20B_CPUAPP if BOARD_XIAO_NRF54LM20B_NRF54LM20B_CPUAPP
```

## boards/seeed/xiao_nrf54lm20b/board.yml
```yaml
board:
  name: xiao_nrf54lm20b
  full_name: XIAO nRF54LM20B
  vendor: seeed
  socs:
  - name: nrf54lm20b
runners:
  run_once:
    '--recover':
    - runners:
      - nrfjprog
      - nrfutil
      run: first
      groups:
      - boards:
        - xiao_nrf54lm20b/nrf54lm20b/cpuapp
    '--erase':
    - runners:
      - nrfjprog
      - jlink
      - nrfutil
      run: first
      groups:
      - boards:
        - xiao_nrf54lm20b/nrf54lm20b/cpuapp
    '--reset':
    - runners:
      - nrfjprog
      - jlink
      - nrfutil
      run: last
      groups:
      - boards:
        - xiao_nrf54lm20b/nrf54lm20b/cpuapp
```

## boards/seeed/xiao_nrf54lm20b/xiao_nrf54lm20b_nrf54lm20b_cpuapp_defconfig
```kconfig
# Copyright (c) 2026 Seeed Technology Co., Ltd.
# SPDX-License-Identifier: Apache-2.0

# Enable GPIO
CONFIG_GPIO=y

# Enable MPU
CONFIG_ARM_MPU=y

# MPU-based null-pointer dereferencing detection cannot
# be applied as the (0x0 - 0x400) is unmapped for this target.
CONFIG_NULL_POINTER_EXCEPTION_DETECTION_NONE=y

# Enable Cache
CONFIG_CACHE_MANAGEMENT=y
CONFIG_EXTERNAL_CACHE=y

# Start SYSCOUNTER on driver init
CONFIG_NRF_GRTC_START_SYSCOUNTER=y
```

## boards/seeed/xiao_rp2040/Kconfig.defconfig
```kconfig
# Copyright (c) 2023 Seeed Studio inc.
# SPDX-License-Identifier: Apache-2.0

if BOARD_XIAO_RP2040

if I2C_DW

config I2C_DW_CLOCK_SPEED
	default 125

endif # I2C_DW

endif # BOARD_XIAO_RP2040
```

## boards/seeed/xiao_rp2350/Kconfig.defconfig
```kconfig
# SPDX-FileCopyrightText: Copyright (c) 2026 Navimatix GmbH
# SPDX-FileCopyrightText: Copyright (c) 2026 TiaC Systems
# SPDX-License-Identifier: Apache-2.0

if BOARD_XIAO_RP2350

if I2C_DW

config I2C_DW_CLOCK_SPEED
	default 150

endif # I2C_DW

endif # BOARD_XIAO_RP2350
```

## boards/seeed/xiao_stm32c5/Kconfig.defconfig
```kconfig
# Copyright (c) 2026 Seeed Technology Co., Ltd.
# SPDX-License-Identifier: Apache-2.0

if BOARD_XIAO_STM32C5

source "boards/common/usb/Kconfig.cdc_acm_serial.defconfig"

endif # BOARD_XIAO_STM32C5
```

## boards/segger/nandeval_h743zi/Kconfig.nandeval_h743zi
```kconfig
# SPDX-FileCopyrightText: Copyright The Zephyr Project Contributors
# SPDX-License-Identifier: Apache-2.0

config BOARD_NANDEVAL_H743ZI
	select SOC_STM32H743XX
```

## boards/segger/nandeval_h743zi/board.yml
```yaml
board:
  name: nandeval_h743zi
  full_name: NAND Flash Evaluator
  vendor: segger
  socs:
    - name: stm32h743xx
```

## boards/semiconlab/litewing/Kconfig.defconfig
```kconfig
# Copyright (c) 2026 Sahaj Sarup
# SPDX-License-Identifier: Apache-2.0

if BOARD_LITEWING

if FUEL_GAUGE

config ADC
	default y

config SENSOR
	default y

endif # FUEL_GAUGE

endif # BOARD_LITEWING
```

## boards/semiconlab/litewing/board.yml
```yaml
board:
  name: litewing
  full_name: Litewing Drone
  vendor: semiconlab
  socs:
  - name: esp32s3
```
