/*
 * Copyright (c) 2024 Chen Xingyu <hi@xingrz.me>
 * SPDX-License-Identifier: Apache-2.0
 */

&pinctrl {
	uart1_default: uart1_default {
		group1 {
			pinmux = <CVI_PINMUX(JTAG_CPU_TMS, UART1_TX)>,  /* A19 */
				 <CVI_PINMUX(JTAG_CPU_TCK, UART1_RX)>;  /* A18 */
		};
	};
};
