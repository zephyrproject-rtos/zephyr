## boards/syna/sr100/Kconfig.defconfig
```kconfig
# Synaptics SR100 Astra Machina Micro (RDK) Board configuration options

# Copyright (c) 2025 Synaptics Inc.
# SPDX-License-Identifier: Apache-2.0

if BOARD_SR100_RDK

if SERIAL

config UART_INTERRUPT_DRIVEN
	default y

endif # SERIAL

if I2C_DW

config I2C_DW_CLOCK_SPEED
	default 100

endif # I2C_DW

endif # BOARD_SR100_RDK
```

## boards/syna/sr100/Kconfig.sr100_rdk
```kconfig
# Synaptics SR100 Astra Machina Micro (RDK) Board configuration options

# Copyright (c) 2025 Synaptics, Inc.
# SPDX-License-Identifier: Apache-2.0

config BOARD_SR100_RDK
	select SOC_SR100_B0
```

## boards/syna/sr100/board.yml
```yaml
boards:
  - name: sr100_rdk
    full_name: SR100 RDK
    vendor: syna
    socs:
      - name: sr100_b0
```

## boards/synaptics/sl2619_rdk/Kconfig.sl2619_rdk
```kconfig
# Copyright (c) 2026 Synaptics Incorporated
# SPDX-License-Identifier: Apache-2.0
config BOARD_SL2619_RDK
	select SOC_SL2619_A55 if BOARD_SL2619_RDK_SL2619_A55
	select SOC_SL2619_M52 if BOARD_SL2619_RDK_SL2619_M52
```

## boards/synaptics/sl2619_rdk/board.yml
```yaml
# Copyright (c) 2026 Synaptics Incorporated
# SPDX-License-Identifier: Apache-2.0

board:
  name: sl2619_rdk
  full_name: SL2619 RDK
  vendor: syna
  socs:
    - name: sl2619
```

## boards/synaptics/sl2619_rdk/sl2619_rdk_sl2619_a55_defconfig
```kconfig
# Copyright (c) 2026 Synaptics Incorporated
# SPDX-License-Identifier: Apache-2.0

# Zephyr Kernel Configuration
CONFIG_XIP=n
CONFIG_KERNEL_DIRECT_MAP=y

# Serial Drivers
CONFIG_SERIAL=y
CONFIG_CONSOLE=y
CONFIG_UART_CONSOLE=y
#CONFIG_UART_NS16550_DW8250_DW_APB=y

# ARM Options
CONFIG_ARM_ARCH_TIMER=y
CONFIG_AARCH64_IMAGE_HEADER=y
CONFIG_ARMV8_A_NS=y

# Cache Options
CONFIG_CACHE_MANAGEMENT=y
CONFIG_ICACHE_LINE_SIZE=64
CONFIG_DCACHE_LINE_SIZE=64

# SMP
CONFIG_SMP=y
CONFIG_MP_MAX_NUM_CPUS=2
CONFIG_PM_CPU_OPS=y
```

## boards/synaptics/sr100/sr100_rdk_defconfig
```kconfig
# defconfig - Synaptics SR100 Astra Machina Micro (RDK) Board configuration

#
# Copyright (c) 2025 Synaptics Inc.
#
# SPDX-License-Identifier: Apache-2.0
#

CONFIG_SERIAL=y
CONFIG_CONSOLE=y
CONFIG_UART_CONSOLE=y
CONFIG_GPIO=y
```

## boards/synopsys/em_starterkit/em_starterkit_emsk_em7d_2_3_defconfig
```kconfig
# SPDX-License-Identifier: Apache-2.0
# Copyright (c) 2017 Synopsys

CONFIG_ARC_HAS_SECURE=y
CONFIG_TRUSTED_EXECUTION_SECURE=y
CONFIG_INIT_ARCH_HW_AT_BOOT=y
```

## boards/synopsys/em_starterkit/em_starterkit_emsk_em7d_defconfig
```kconfig
# SPDX-License-Identifier: Apache-2.0
# Copyright (c) 2017 Synopsys

CONFIG_ARC_MPU_ENABLE=y
```

## boards/synopsys/hsdk/board.yml
```yaml
board:
  name: hsdk
  vendor: Synopsys
  socs:
  - name: arc_hsdk
    variants:
    - name: 2cores
```

## boards/synopsys/nsim/nsim_nsim_hs5x_smp_defconfig
```kconfig
# SPDX-License-Identifier: Apache-2.0

CONFIG_SMP=y
CONFIG_MP_MAX_NUM_CPUS=2
CONFIG_TICKET_SPINLOCKS=y
```

## boards/synopsys/nsim/nsim_nsim_hs_smp_defconfig
```kconfig
# SPDX-License-Identifier: Apache-2.0

CONFIG_ARC_MPU_ENABLE=n
CONFIG_SMP=y
CONFIG_MP_MAX_NUM_CPUS=2
CONFIG_TICKET_SPINLOCKS=y
```

## boards/tcc/topst_vcp45/Kconfig.defconfig
```kconfig
# Copyright 2024 Hounjoung Rim <hounjoung@tsnlab.com>
# SPDX-License-Identifier: Apache-2.0

if BOARD_TOPST_VCP45

config BUILD_OUTPUT_BIN
	default y

config USERSPACE
	default y

config MAX_THREAD_BYTES
	default 3

config BOUNDS_CHECK_BYPASS_MITIGATION
	default y

endif # BOARD_TOPST_VCP45
```

## boards/tcc/topst_vcp45/Kconfig.topst_vcp45
```kconfig
# Copyright 2024 Hounjoung Rim <hounjoung@tsnlab.com>
# SPDX-License-Identifier: Apache-2.0

config BOARD_TOPST_VCP45
	select SOC_TCC7045
```

## boards/tcc/topst_vcp45/topst_vcp45_defconfig
```kconfig
# SPDX-License-Identifier: Apache-2.0
# Copyright 2024 Hounjoung Rim <hounjoung@tsnlab.com>

CONFIG_GPIO=y

CONFIG_SERIAL=y
CONFIG_CONSOLE=y
```

## boards/tdk/robokit1/Kconfig.defconfig
```kconfig
# Copyright (c) 2024 Henrik Brix Andersen <henrik@brixandersen.dk>
# SPDX-License-Identifier: Apache-2.0

if BOARD_ROBOKIT1

config ADC_ADS7052_INIT_PRIORITY
	default 60
	depends on ADC_ADS7052

config SENSOR_INIT_PRIORITY
	default 60
	depends on SENSOR

config EEPROM_INIT_PRIORITY
	default 60
	depends on EEPROM

endif # BOARD_ROBOKIT1
```

## boards/tdk/robokit1/Kconfig.robokit1
```kconfig
# Copyright (c) 2022 Intel Corporation
# Copyright (c) 2024 Gerson Fernando Budke
# SPDX-License-Identifier: Apache-2.0

config BOARD_ROBOKIT1
	select SOC_SAME70Q21B
```

## boards/tdk/robokit1/board.yml
```yaml
board:
  name: robokit1
  full_name: RoboKit 1
  vendor: tdk
  socs:
    - name: same70q21b
```
