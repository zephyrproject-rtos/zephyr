## boards/dsdtech/shc31a/board.yml
```yaml
board:
  name: dsdtech_shc31a
  full_name: SH-C31A
  vendor: dsdtech
  socs:
    - name: stm32g431xx
```

## boards/dsdtech/shc31a/dsdtech_shc31a_defconfig
```kconfig
# Copyright (c) 2026 Base Power Company
# SPDX-License-Identifier: Apache-2.0

CONFIG_ARM_MPU=y
```

## boards/ebyte/e80_900mbl/board.yml
```yaml
boards:
- name: e80_900mbl_01
  full_name: Ebyte E80 Module Development Board (LR1121, HF)
  vendor: ebyte
  socs:
  - name: stm32f103x8
- name: e80_900mbl_02
  full_name: Ebyte E80 Module Development Board (LR2021, HF)
  vendor: ebyte
  socs:
  - name: stm32f103x8
```

## boards/emtrion/emsbc_neon_cm7/Kconfig.defconfig
```kconfig
# emSBC-NEON-CM7 board configuration

# Copyright (c) 2026 Ruediger Fichter, emtrion GmbH
# SPDX-License-Identifier: Apache-2.0

if BOARD_EMSBC_NEON_CM7

configdefault ETH_DRIVER
	default y

configdefault EEPROM
	default y

configdefault EEPROM_AT2X_INIT_PRIORITY
	default 55

configdefault NVMEM
	default y

configdefault NVMEM_EEPROM
	default y

endif # BOARD_EMSBC_NEON_CM7
```

## boards/emtrion/emsbc_neon_cm7/Kconfig.emsbc_neon_cm7
```kconfig
# Copyright (c) 2026 emtrion GmbH
# SPDX-License-Identifier: Apache-2.0

config BOARD_EMSBC_NEON_CM7
	select SOC_STM32F769XX
```

## boards/enjoydigital/litex_vexiiriscv/Kconfig.defconfig
```kconfig
# SPDX-FileCopyrightText: Copyright The Zephyr Project Contributors
# SPDX-License-Identifier: Apache-2.0

if BOARD_LITEX_VEXIIRISCV

configdefault ETH_DRIVER
	default y

endif # BOARD_LITEX_VEXIIRISCV
```

## boards/enjoydigital/litex_vexriscv/Kconfig.defconfig
```kconfig
# Copyright (c) 2018 - 2019 Antmicro <www.antmicro.com>
# SPDX-License-Identifier: Apache-2.0

if BOARD_LITEX_VEXRISCV

configdefault ETH_DRIVER
	default y

endif # BOARD_LITEX_VEXRISCV
```

## boards/espressif/common/Kconfig.qemu
```kconfig
# Copyright (c) 2026 Espressif Systems (Shanghai) Co., Ltd.
# SPDX-License-Identifier: Apache-2.0

config ESPRESSIF_QEMU
	bool "Espressif QEMU emulation support"
	depends on SOC_SERIES_ESP32 || SOC_SERIES_ESP32S3 || \
		SOC_SERIES_ESP32C3 || SOC_SERIES_ESP32C6
	depends on !SOC_ESP32_APPCPU && !SOC_ESP32S3_APPCPU
	depends on !SOC_ESP32C6_LPCORE
	select ESPRESSIF_QEMU_TARGET
	select BUILD_OUTPUT_BIN
	help
	  Generate a merged SPI flash image and enable the 'west build -t run'
	  target using Espressif's QEMU fork (https://github.com/espressif/qemu).

	  Enable either with -DCONFIG_ESPRESSIF_QEMU=y on any board whose SoC
	  is supported, or by building a DevKitC /qemu board variant
	  (e.g. esp32c3_devkitc/esp32c3/qemu), which is intended for
	  Twister/CI. The variant targets set this option in defconfig.

	  Requires qemu-system-xtensa (ESP32, ESP32-S3) or qemu-system-riscv32
	  (ESP32-C3, ESP32-C6) from that fork on PATH, or set ESPRESSIF_QEMU_PATH
	  / QEMU_BIN_PATH to the directory containing the binary.

	  For Simple Boot builds, a single application image is merged. For
	  MCUboot/sysbuild builds, the bootloader and signed application are
	  merged at their partition offsets in the application image. The
	  MCUboot image itself does not enable the emu/flash-merge path
	  (CMake skips CONFIG_MCUBOOT builds).

	  On ESP32, the run target supplies an ECO3 eFuse image (CHIP_VER_REV1
	  and CHIP_VER_REV2) so the guest reports chip revision v3.0 without
	  enabling CONFIG_ESP32_USE_UNSUPPORTED_REVISION.
```

## boards/espressif/esp32_devkitc/board.yml
```yaml
board:
  name: esp32_devkitc
  full_name: ESP32-DevKitC
  vendor: espressif
  socs:
  - name: esp32
    variants:
    - name: qemu
      cpucluster: procpu
```

## boards/espressif/esp32_ethernet_kit/Kconfig.defconfig
```kconfig
# ESP32-ETHERNET-KIT board configuration

# Copyright (c) 2022 Grant Ramsay <grant.ramsay@hotmail.com>
# SPDX-License-Identifier: Apache-2.0

if BOARD_ESP32_ETHERNET_KIT_ESP32_PROCPU

config SOC_FAMILY_ESPRESSIF_SPIRAM
	default y if !MCUBOOT && !SOC_ESP32_USE_UNSUPPORTED_REVISION

configdefault ETH_DRIVER
	default y

endif # BOARD_ESP32_ETHERNET_KIT_ESP32_PROCPU
```

## boards/espressif/esp32c61_devkitc/Kconfig.esp32c61_devkitc
```kconfig
# ESP32C61 devkitc board configuration

# Copyright (c) 2026 Espressif Systems (Shanghai) Co., Ltd.
# SPDX-License-Identifier: Apache-2.0

config BOARD_ESP32C61_DEVKITC
	select SOC_ESP32C61
	select SOC_ESP32C61_REV_1_0
```

## boards/espressif/esp32c61_devkitc/board.yml
```yaml
board:
  name: esp32c61_devkitc
  full_name: ESP32-C61-DevKitC
  vendor: espressif
  socs:
  - name: esp32c61
```

## boards/espressif/esp32c6_devkitc/Kconfig.esp32c6_devkitc
```kconfig
# ESP32C6 devkitc board configuration

# Copyright (c) 2024 Espressif Systems (Shanghai) Co., Ltd.
# SPDX-License-Identifier: Apache-2.0

config BOARD_ESP32C6_DEVKITC
	select SOC_ESP32C6
	select SOC_ESP32C6_HPCORE if BOARD_ESP32C6_DEVKITC_ESP32C6_HPCORE
	select SOC_ESP32C6_LPCORE if BOARD_ESP32C6_DEVKITC_ESP32C6_LPCORE
```

## boards/espressif/esp32c6_devkitc/board.yml
```yaml
board:
  name: esp32c6_devkitc
  full_name: ESP32-C6-DevKitC
  vendor: espressif
  socs:
  - name: esp32c6
    variants:
    - name: qemu
      cpucluster: hpcore
```

## boards/espressif/esp32s31_devkitc/Kconfig.esp32s31_devkitc
```kconfig
# ESP32-S31-DevKitC configuration

# Copyright (c) 2026 Espressif Systems (Shanghai) Co., Ltd.
# SPDX-License-Identifier: Apache-2.0

config BOARD_ESP32S31_DEVKITC
	select SOC_ESP32S31_HPCORE if BOARD_ESP32S31_DEVKITC_ESP32S31_HPCORE
	select SOC_ESP32S31_REV_0_0
```

## boards/espressif/esp32s31_devkitc/board.yml
```yaml
board:
  name: esp32s31_devkitc
  full_name: ESP32-S31-DevKitC
  vendor: espressif
  socs:
  - name: esp32s31
```

## boards/espressif/esp32s31_function_coreboard/Kconfig.defconfig
```kconfig
# ESP32-S31 Function CoreBoard configuration

# Copyright (c) 2026 Espressif Systems (Shanghai) Co., Ltd.
# SPDX-License-Identifier: Apache-2.0

if BOARD_ESP32S31_FUNCTION_COREBOARD_ESP32S31_HPCORE

configdefault ETH_DRIVER
	default y

configdefault NET_IF_MAX_IPV4_COUNT
	default 2 if ETH_DRIVER && WIFI

endif # BOARD_ESP32S31_FUNCTION_COREBOARD_ESP32S31_HPCORE
```

## boards/espressif/esp32s31_function_coreboard/Kconfig.esp32s31_function_coreboard
```kconfig
# ESP32-S31-Function-CoreBoard-1 configuration

# Copyright (c) 2026 Espressif Systems (Shanghai) Co., Ltd.
# SPDX-License-Identifier: Apache-2.0

config BOARD_ESP32S31_FUNCTION_COREBOARD
	select SOC_ESP32S31_HPCORE if BOARD_ESP32S31_FUNCTION_COREBOARD_ESP32S31_HPCORE
	select SOC_ESP32S31_REV_0_0
```

## boards/espressif/esp32s31_function_coreboard/board.yml
```yaml
board:
  name: esp32s31_function_coreboard
  full_name: ESP32-S31-Function-CoreBoard-1
  vendor: espressif
  socs:
  - name: esp32s31
```

## boards/espressif/esp32s3_box3/Kconfig.defconfig
```kconfig
# Copyright (c) 2026 NotioNext Ltd.
# SPDX-License-Identifier: Apache-2.0

if BOARD_ESP32S3_BOX3_ESP32S3_PROCPU

if LVGL

choice LV_COLOR_FORMAT_DEFAULT
	default LV_COLOR_FORMAT_RGB565
endchoice

# RGB565 byte swap required for ILI9342C over SPI
config LV_COLOR_16_SWAP
	default y

endif # LVGL

endif # BOARD_ESP32S3_BOX3_ESP32S3_PROCPU
```

## boards/espressif/esp32s3_devkitc/board.yml
```yaml
board:
  name: esp32s3_devkitc
  full_name: ESP32-S3-DevKitC
  vendor: espressif
  socs:
  - name: esp32s3
    variants:
    - name: qemu
      cpucluster: procpu
```

## boards/espressif/esp32s3_eye/esp32s3_eye_procpu_defconfig
```kconfig
# SPDX-License-Identifier: Apache-2.0

CONFIG_CONSOLE=y
CONFIG_SERIAL=y
CONFIG_UART_CONSOLE=y
CONFIG_GPIO=y
CONFIG_CLOCK_CONTROL=y
CONFIG_ADC=y
CONFIG_SOC_FAMILY_ESPRESSIF_SPIRAM=y
CONFIG_SOC_FAMILY_ESPRESSIF_SPIRAM_MODE_OCT=y
```

## boards/espressif/esp32s3_lcd_ev/Kconfig.esp32s3_lcd_ev
```kconfig
# Copyright (c) 2026 Espressif Systems (Shanghai) Co., Ltd.
# SPDX-License-Identifier: Apache-2.0

config BOARD_ESP32S3_LCD_EV
	select SOC_ESP32S3
	select SOC_ESP32S3_PROCPU if BOARD_ESP32S3_LCD_EV_ESP32S3_PROCPU
	select SOC_ESP32S3_APPCPU if BOARD_ESP32S3_LCD_EV_ESP32S3_APPCPU
```

## boards/espressif/esp32s3_lcd_ev/esp32s3_lcd_ev_procpu_defconfig
```kconfig
# SPDX-License-Identifier: Apache-2.0

CONFIG_CONSOLE=y
CONFIG_SERIAL=y
CONFIG_UART_CONSOLE=y
CONFIG_GPIO=y
CONFIG_CLOCK_CONTROL=y
CONFIG_I2C=y
CONFIG_DMA=y
CONFIG_ESP_SPIRAM=y
CONFIG_SPIRAM_MODE_OCT=y
CONFIG_DISPLAY=y
CONFIG_DISPLAY_ESP32_RGB=y
CONFIG_INPUT=y
CONFIG_INPUT_GT1151=y
```
