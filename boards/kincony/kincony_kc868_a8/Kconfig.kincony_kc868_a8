## boards/kincony/kincony_kc868_a8/Kconfig.kincony_kc868_a8
```kconfig
# Copyright (c) 2026 Bartosz Bilas
# SPDX-License-Identifier: Apache-2.0

config BOARD_KINCONY_KC868_A8
	select SOC_ESP32_WROOM_32UE_N4
	select SOC_ESP32_PROCPU if BOARD_KINCONY_KC868_A8_ESP32_PROCPU
	select SOC_ESP32_APPCPU if BOARD_KINCONY_KC868_A8_ESP32_APPCPU
```

## boards/kincony/kincony_kc868_a8/board.yml
```yaml
board:
  name: kincony_kc868_a8
  full_name: KC868-A8
  vendor: kincony
  socs:
  - name: esp32
```

## boards/kincony/kincony_kc868_a8/kincony_kc868_a8_procpu_defconfig
```kconfig
# Copyright (c) Bartosz Bilas
# SPDX-License-Identifier: Apache-2.0

CONFIG_CONSOLE=y
CONFIG_SERIAL=y
CONFIG_UART_CONSOLE=y

CONFIG_GPIO=y
CONFIG_I2C=y
```

## boards/kosagi/tomu/Kconfig.defconfig
```kconfig
# Copyright (c) 2026 Patryk Koscik <pkoscik@antmicro.com>
# SPDX-License-Identifier: Apache-2.0

if BOARD_TOMU

config USE_DT_CODE_PARTITION
	default y

# Tomu doesn't have external oscillators. HFCLK runs off the internal HFRCO,
# which Toboot sets up before handing over control (see toboot/main.c).
# We must define `CMU_HFXO_FREQ` and `CMU_LFXO_FREQ` because leaving these
# default-less Kconfig symbols empty will fail the assembler via an empty
# .equ operand in GEN_ABSOLUTE_SYM_KCONFIG.

config CMU_HFXO_FREQ
	default 0

config CMU_LFXO_FREQ
	default 0

endif # BOARD_TOMU
```

## boards/kosagi/tomu/Kconfig.tomu
```kconfig
# Copyright (c) 2026 Patryk Koscik <pkoscik@antmicro.com>
# SPDX-License-Identifier: Apache-2.0

config BOARD_TOMU
	select SOC_EFM32HG309F64
```

## boards/kosagi/tomu/board.yml
```yaml
board:
  name: tomu
  full_name: Tomu
  vendor: kosagi
  socs:
  - name: efm32hg309f64
```

## boards/kosagi/tomu/tomu_defconfig
```kconfig
# SPDX-License-Identifier: Apache-2.0

CONFIG_CONSOLE=y
CONFIG_RAM_CONSOLE=y
CONFIG_GPIO=y
CONFIG_CMU_HFCLK_HFRCO=y
CONFIG_WATCHDOG=y
CONFIG_WDT_DISABLE_AT_BOOT=y
```

## boards/kws/pico2_spe/Kconfig.defconfig
```kconfig
# Copyright (c) 2025 KWS Computersysteme Gmbh
# SPDX-License-Identifier: Apache-2.0

if BOARD_PICO2_SPE

if I2C_DW

config I2C_DW_CLOCK_SPEED
	default 125

endif # I2C_DW

config USB_SELF_POWERED
	default n

config PHY_INIT_PRIORITY
	default 82
	depends on NET_L2_ETHERNET && ETH_DRIVER

if NETWORKING

config NET_L2_ETHERNET
	default y

if ETH_LAN865X

config NET_IF_MAX_IPV4_COUNT
	default 2

endif # ETH_LAN865X

endif # NETWORKING

endif # BOARD_PICO2_SPE
```

## boards/kws/pico2_spe/Kconfig.pico2_spe
```kconfig
# Copyright (c) 2025 KWS Computersysteme Gmbh
# SPDX-License-Identifier: Apache-2.0

config BOARD_PICO2_SPE
	select SOC_RP2350A_M33 if BOARD_PICO2_SPE_RP2350A_M33
```

## boards/kws/pico2_spe/board.yml
```yaml
board:
  name: pico2_spe
  full_name: Pico2-SPE
  vendor: kws
  socs:
  - name: rp2350a
```

## boards/kws/pico_spe/Kconfig
```kconfig
# Copyright (c) 2024 KWS Computersysteme Gmbh
# SPDX-License-Identifier: Apache-2.0

config BOARD_PICO_SPE
	select RP2_FLASH_W25Q080
```

## boards/kws/pico_spe/Kconfig.defconfig
```kconfig
# Copyright (c) 2024 KWS Computersysteme Gmbh
# SPDX-License-Identifier: Apache-2.0

if BOARD_PICO_SPE

if I2C_DW

config I2C_DW_CLOCK_SPEED
	default 125

endif # I2C_DW

config USB_SELF_POWERED
	default n

configdefault PHY_INIT_PRIORITY
	default 82

configdefault NET_L2_ETHERNET
	default y

if ETH_LAN865X

configdefault NET_IF_MAX_IPV4_COUNT
	default 2

endif # ETH_LAN865X

endif # BOARD_PICO_SPE
```

## boards/kws/pico_spe/Kconfig.pico_spe
```kconfig
# Copyright (c) 2024 KWS Computersysteme Gmbh
# SPDX-License-Identifier: Apache-2.0

config BOARD_PICO_SPE
	select SOC_RP2040
```

## boards/kws/pico_spe/board.yml
```yaml
board:
  name: pico_spe
  full_name: Pico-SPE
  vendor: kws
  socs:
  - name: rp2040
```

## boards/laird_connect/bl5340_dvk/board.yml
```yaml
board:
  name: bl5340_dvk
  vendor: Laird Connectivity
  socs:
  - name: 'nrf5340'
    variants:
    - name: 'ns'
      cpucluster: 'cpuapp'
```

## boards/laird_connect/bl652_dvk/board.yml
```yaml
board:
  name: bl652_dvk
  vendor: Laird Connectivity
  socs:
  - name: nrf52832
```

## boards/laird_connect/bl653_dvk/board.yml
```yaml
board:
  name: bl653_dvk
  vendor: Laird Connectivity
  socs:
  - name: nrf52833
```

## boards/laird_connect/bl654_dvk/Kconfig.bl654_dvk
```kconfig
# BL654 DVK board configuration

# Copyright (c) 2019 Laird Connectivity
# SPDX-License-Identifier: Apache-2.0

config BOARD_BL654_DVK
	bool
	default y
	select SOC_NRF52840_QIAA
```

## boards/laird_connect/bl654_dvk/board.yml
```yaml
board:
  name: bl654_dvk
  vendor: Laird Connectivity
  socs:
  - name: nrf52840
```

## boards/laird_connect/bl654_sensor_board/board.yml
```yaml
board:
  name: bl654_sensor_board
  vendor: Laird Connectivity
  socs:
  - name: nrf52840
```

## boards/laird_connect/bl654_usb/board.yml
```yaml
board:
  name: bl654_usb
  vendor: Laird Connectivity
  socs:
  - name: nrf52840
```

## boards/laird_connect/bt510/Kconfig.bt510
```kconfig
# BT510 DVK board configuration

# Copyright (c) 2020 Laird Connectivity
# SPDX-License-Identifier: Apache-2.0

config BOARD_BT510
	bool
	default y
	select SOC_NRF52840_QIAA
```
