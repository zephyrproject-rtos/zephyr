/* Auto-generated by gen_nxp_virtual_board.py */
/* Master DTS template: boards/nxp/mcx_nx4x_evk/mcx_n9xx_evk_mcxn947_cpu0.dts */
/*
 * Copyright 2025 NXP
 *
 * SPDX-License-Identifier: Apache-2.0
 */

/dts-v1/;

#include "mcx_n9xx_evk_mcxn947_cpu0.dtsi"

/ {
	model = "NXP Virtual Board (mcxn947/cpu1)";
};
