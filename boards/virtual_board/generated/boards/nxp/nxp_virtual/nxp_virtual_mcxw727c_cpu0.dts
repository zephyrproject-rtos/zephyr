/* Auto-generated by gen_nxp_virtual_board.py */
/dts-v1/;

#include <nxp/nxp_mcxw72.dtsi>

/ {
	model = "NXP Virtual Board (mcxw727c/cpu0)";
	compatible = "nxp,mcxw727c";
};

/ { cpus { /delete-node/ cpu@1; }; };
