/* Auto-generated by gen_nxp_virtual_board.py */
/* Master DTS template: boards/nxp/frdm_mcxaxx6/frdm_mcxa346.dts */
/*
 * Copyright 2025 NXP
 *
 * SPDX-License-Identifier: Apache-2.0
 */

/dts-v1/;

#include <nxp/nxp_mcxa346.dtsi>
#include "frdm_mcxa346-pinctrl.dtsi"
#include "board_common.dtsi"

/ {
	model = "NXP Virtual Board (mcxa346)";
	compatible = "nxp,mcxa346", "nxp,mcx";
};

&cpu0 {
	clock-frequency = <180000000>;
};

/* OPAMP configuration */
&opamp0 {
	pinctrl-0 = <&pinmux_opamp0>;
	pinctrl-names = "default";
	status = "okay";
};

&opamp1 {
	status = "okay";
};
