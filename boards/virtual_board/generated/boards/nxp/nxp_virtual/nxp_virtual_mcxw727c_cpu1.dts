/* Auto-generated by gen_nxp_virtual_board.py */
/dts-v1/;

#include <nxp/nxp_mcxw727c.dtsi>

/ {
	model = "NXP Virtual Board (mcxw727c/cpu1)";
	compatible = "nxp,mcxw727c";
};

/ { cpus { /delete-node/ cpu@0; }; };
