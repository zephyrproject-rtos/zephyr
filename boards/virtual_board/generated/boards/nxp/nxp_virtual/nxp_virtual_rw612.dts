/* Auto-generated by gen_nxp_virtual_board.py */
/* Master DTS template: boards/nxp/frdm_rw612/frdm_rw612.dts */
/*
 * Copyright 2024 NXP
 *
 * SPDX-License-Identifier: Apache-2.0
 */

/dts-v1/;

#include <nxp/nxp_rw6xx.dtsi>
#include "frdm_rw612_common.dtsi"
