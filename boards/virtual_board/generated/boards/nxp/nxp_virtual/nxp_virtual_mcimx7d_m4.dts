/* Auto-generated by gen_nxp_virtual_board.py (template: imx7d_m4) */
/dts-v1/;

#include <nxp/nxp_imx7d_m4.dtsi>
#include <nxp/nxp_imx/mimx7d-pinctrl.dtsi>

/ {
	model = "NXP Virtual Board (mcimx7d/m4)";
	compatible = "nxp,mcimx7d";

	chosen {
		zephyr,flash = &tcml_code;
		zephyr,sram = &tcmu_sys;
	};
};
