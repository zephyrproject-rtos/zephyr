/* Auto-generated by gen_nxp_virtual_board.py (template: imx6sx_m4) */
/dts-v1/;

#include <mem.h>

/* Required by nxp_imx6sx_m4.dtsi */
#define DT_FLASH_SIZE	DT_SIZE_K(512)
#define DT_FLASH_ADDR	84000000
#define DT_SRAM_SIZE	DT_SIZE_K(128)
#define DT_SRAM_ADDR	84080000

#include <nxp/nxp_imx6sx_m4.dtsi>
#include <nxp/nxp_imx/mimx6sx-pinctrl.dtsi>

/ {
	model = "NXP Virtual Board (mcimx6x/m4)";
	compatible = "nxp,mcimx6x";
	chosen {
		zephyr,flash = &flash;
		zephyr,sram = &sram;
	};
};
