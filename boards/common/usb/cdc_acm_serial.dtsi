/*
 * Copyright (c) 2024 Nordic Semiconductor ASA
 *
 * SPDX-License-Identifier: Apache-2.0
 */

/ {
	chosen {
		zephyr,console = &board_cdc_acm_uart;
		zephyr,shell-uart = &board_cdc_acm_uart;
		zephyr,uart-mcumgr = &board_cdc_acm_uart;
		zephyr,bt-mon-uart = &board_cdc_acm_uart;
		zephyr,bt-c2h-uart = &board_cdc_acm_uart;
	};
};

&zephyr_udc0 {
	board_cdc_acm_uart: board_cdc_acm_uart {
		compatible = "zephyr,cdc-acm-uart";
	};
};
