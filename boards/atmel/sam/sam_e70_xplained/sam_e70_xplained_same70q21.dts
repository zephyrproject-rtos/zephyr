/*
 * Copyright (c) 2017 Piotr Mienkowski
 * Copyright (c) 2017 Justin Watson
 * Copyright (c) 2020-2024 Gerson Fernando Budke <nandojve@gmail.com>
 *
 * SPDX-License-Identifier: Apache-2.0
 */

/dts-v1/;

#include <atmel/same70x21.dtsi>
#include "sam_e70_xplained-common.dtsi"

/ {
	compatible = "atmel,sam_e70_xplained", "atmel,same70q21", "atmel,same70";
	model = "Atmel SAM E70 Xplained board";
};
