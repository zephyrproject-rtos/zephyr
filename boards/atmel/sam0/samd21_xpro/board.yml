## boards/atmel/sam0/samd21_xpro/board.yml
```yaml
board:
  name: samd21_xpro
  full_name: SAM D21 Xplained Pro Evaluation Kit
  vendor: atmel
  socs:
    - name: samd21j18a
```

## boards/atmel/sam0/same54_xpro/Kconfig.defconfig
```kconfig
# SAM E54 Xplained Pro board configuration
#
# Copyright (c) 2019 Benjamin Valentin
# Copyright (c) 2024 Gerson Fernando Budke <nandojve@gmail.com>
# SPDX-License-Identifier: Apache-2.0

if ETH_SAM_GMAC

# Read MAC address from AT24MAC402 EEPROM

config EEPROM
	default y

config NVMEM
	default y

endif # ETH_SAM_GMAC

if NETWORKING

config NET_L2_ETHERNET
	default y

endif # NETWORKING
```

## boards/atmel/sam0/same54_xpro/Kconfig.same54_xpro
```kconfig
# Copyright (c) 2019 Benjamin Valentin
# Copyright (c) 2024 Gerson Fernando Budke <nandojve@gmail.com>
# SPDX-License-Identifier: Apache-2.0

config BOARD_SAME54_XPRO
	select SOC_SAME54P20A
```

## boards/atmel/sam0/same54_xpro/board.yml
```yaml
board:
  name: same54_xpro
  full_name: SAM E54 Xplained Pro Evaluation Kit
  vendor: atmel
  socs:
    - name: same54p20a
```

## boards/atmel/sam0/same54_xpro/same54_xpro_defconfig
```kconfig
# Copyright (c) 2019 Benjamin Valentin
# Copyright (c) 2024 Gerson Fernando Budke <nandojve@gmail.com>
# SPDX-License-Identifier: Apache-2.0

CONFIG_SOC_ATMEL_SAMD5X_XOSC32K=y
CONFIG_SOC_ATMEL_SAMD5X_XOSC32K_AS_MAIN=y

CONFIG_BUILD_OUTPUT_HEX=y

CONFIG_ARM_MPU=y
CONFIG_HW_STACK_PROTECTION=y

CONFIG_CONSOLE=y
CONFIG_SERIAL=y
CONFIG_UART_CONSOLE=y
CONFIG_UART_INTERRUPT_DRIVEN=y
```

## boards/atmel/sam0/saml21_xpro/Kconfig.saml21_xpro
```kconfig
# Copyright (c) 2021 Argentum Systems Ltd.
# Copyright (c) 2024 Gerson Fernando Budke <nandojve@gmail.com>
# SPDX-License-Identifier: Apache-2.0

config BOARD_SAML21_XPRO
	select SOC_SAML21J18B
```

## boards/atmel/sam0/saml21_xpro/board.yml
```yaml
board:
  name: saml21_xpro
  full_name: SAM L21 Xplained Pro Evaluation Kit
  vendor: atmel
  socs:
    - name: saml21j18b
```

## boards/atmel/sam0/samr21_xpro/Kconfig.samr21_xpro
```kconfig
# Copyright (c) 2019 Benjamin Valentin
# Copyright (c) 2024 Gerson Fernando Budke <nandojve@gmail.com>
# SPDX-License-Identifier: Apache-2.0

config BOARD_SAMR21_XPRO
	select SOC_SAMR21G18A
```

## boards/atmel/sam0/samr21_xpro/board.yml
```yaml
board:
  name: samr21_xpro
  full_name: SAM R21 Xplained Pro Evaluation Kit
  vendor: atmel
  socs:
    - name: samr21g18a
```

## boards/atmel/sam0/samr21_xpro/samr21_xpro_defconfig
```kconfig
# Copyright (c) 2019 Benjamin Valentin
# Copyright (c) 2024 Gerson Fernando Budke <nandojve@gmail.com>
# SPDX-License-Identifier: Apache-2.0

CONFIG_SOC_ATMEL_SAMD_XOSC32K=y
CONFIG_SOC_ATMEL_SAMD_XOSC32K_AS_MAIN=y

CONFIG_BUILD_OUTPUT_HEX=y

CONFIG_CONSOLE=y
CONFIG_SERIAL=y
CONFIG_UART_CONSOLE=y
CONFIG_UART_INTERRUPT_DRIVEN=y
```

## boards/atmel/sam0/samr34_xpro/Kconfig.samr34_xpro
```kconfig
# Copyright (c) 2021 Argentum Systems Ltd.
# Copyright (c) 2024 Gerson Fernando Budke <nandojve@gmail.com>
# SPDX-License-Identifier: Apache-2.0

config BOARD_SAMR34_XPRO
	select SOC_SAMR34J18B
```

## boards/atmel/sam0/samr34_xpro/board.yml
```yaml
board:
  name: samr34_xpro
  full_name: SAM R34 Xplained Pro Evaluation Kit
  vendor: atmel
  socs:
    - name: samr34j18b
```

## boards/atmel/sam0/samr34_xpro/samr34_xpro_defconfig
```kconfig
# Copyright (c) 2021 Argentum Systems Ltd.
# Copyright (c) 2024 Gerson Fernando Budke <nandojve@gmail.com>
# SPDX-License-Identifier: Apache-2.0

CONFIG_SOC_ATMEL_SAML_XOSC32K=y
CONFIG_SOC_ATMEL_SAML_XOSC32K_AS_MAIN=y

CONFIG_BUILD_OUTPUT_HEX=y

CONFIG_CONSOLE=y
CONFIG_SERIAL=y
CONFIG_UART_CONSOLE=y
CONFIG_UART_INTERRUPT_DRIVEN=y
```

## boards/atmosic/atm33evk/Kconfig.ATMEVK-3325-LQK
```kconfig
# Copyright (c) 2021-2023 Atmosic
# SPDX-License-Identifier: Apache-2.0

config BOARD_ATMEVK_3325_LQK
	select SOC_ATM33XX_5
```

## boards/atmosic/atm33evk/Kconfig.ATMEVK-3325-QK-5
```kconfig
# Copyright (c) 2021-2023 Atmosic
# SPDX-License-Identifier: Apache-2.0

config BOARD_ATMEVK_3325_QK_5
	select SOC_ATM33XX_5
```

## boards/atmosic/atm33evk/Kconfig.ATMEVK-3330e-QN-5
```kconfig
# Copyright (c) 2021-2023 Atmosic
# SPDX-License-Identifier: Apache-2.0

config BOARD_ATMEVK_3330E_QN_5
	select SOC_ATM33XX_5
```

## boards/atmosic/atm33evk/Kconfig.ATMEVK-3330e-QN-7
```kconfig
# Copyright (c) 2021-2024 Atmosic
# SPDX-License-Identifier: Apache-2.0

config BOARD_ATMEVK_3330E_QN_7
	select SOC_ATM33XX_5
```

## boards/atmosic/atm33evk/board.yml
```yaml
boards:
- name: ATMEVK-3330-QN-5
  vendor: atmosic
  revision:
    format: custom
    default: normal
    revisions:
    - name: mcuboot
    - name: normal
  socs:
    - name: ATM33xx-5
      variants:
      - name: 'ns'

- name: ATMEVK-3330e-QN-5
  vendor: atmosic
  revision:
    format: custom
    default: normal
    revisions:
    - name: mcuboot
    - name: normal
  socs:
    - name: ATM33xx-5
      variants:
      - name: 'ns'

- name: ATMEVK-3330e-QN-7
  vendor: atmosic
  revision:
    format: custom
    default: normal
    revisions:
    - name: mcuboot
    - name: normal
  socs:
    - name: ATM33xx-5
      variants:
      - name: 'ns'

- name: ATMEVK-3325-QK-5
  vendor: atmosic
  revision:
    format: custom
    default: normal
    revisions:
    - name: mcuboot
    - name: normal
  socs:
    - name: ATM33xx-5
      variants:
      - name: 'ns'

- name: ATMEVK-3325-LQK
  vendor: atmosic
  revision:
    format: custom
    default: normal
    revisions:
    - name: mcuboot
    - name: normal
  socs:
    - name: ATM33xx-5
      variants:
      - name: 'ns'
```

## boards/atmosic/atm34evk/ATMEVK-3430e-YQN-5_ns_defconfig
```kconfig
# Copyright (c) 2021-2025 Atmosic
#
# SPDX-License-Identifier: Apache-2.0

CONFIG_CORTEX_M_SYSTICK=y
CONFIG_CORTEX_M_SYSTICK_EXTERNAL_REF=y
CONFIG_RUNTIME_NMI=y
CONFIG_USE_DT_CODE_PARTITION=y

# Enable MPU
CONFIG_ARM_MPU=y

# Enable hardware stack protection
CONFIG_HW_STACK_PROTECTION=y

# Enable TrustZone-M
CONFIG_ARM_TRUSTZONE_M=y

# This Board implies building Non-Secure firmware
CONFIG_TRUSTED_EXECUTION_NONSECURE=y

# enable uart driver
CONFIG_SERIAL=y

# enable console
CONFIG_CONSOLE=y
CONFIG_UART_CONSOLE=y

# GPIOs
CONFIG_GPIO=y

# Watchdog
CONFIG_WATCHDOG=y
```

## boards/atmosic/atm34evk/Kconfig.ATMEVK-3405-PQK-5
```kconfig
# Copyright (c) 2021-2024 Atmosic
# SPDX-License-Identifier: Apache-2.0

config BOARD_ATMEVK_3405_PQK_5
	select SOC_ATM34XX_5
```

## boards/atmosic/atm34evk/Kconfig.ATMEVK-3405-YBV-5
```kconfig
# Copyright (c) 2025 Atmosic
# SPDX-License-Identifier: Apache-2.0

config BOARD_ATMEVK_3405_YBV_5
	select SOC_ATM34XX_5
```

## boards/atmosic/atm34evk/Kconfig.ATMEVK-3425-PQK-2
```kconfig
# Copyright (c) 2021-2024 Atmosic
# SPDX-License-Identifier: Apache-2.0

config BOARD_ATMEVK_3425_PQK_2
	select SOC_ATM34XX_2
```

## boards/atmosic/atm34evk/Kconfig.ATMEVK-3425-YQK-5
```kconfig
# Copyright (c) 2021-2024 Atmosic
# SPDX-License-Identifier: Apache-2.0

config BOARD_ATMEVK_3425_YQK_5
	select SOC_ATM34XX_5
```

## boards/atmosic/atm34evk/Kconfig.ATMEVK-3430e-WQN-2
```kconfig
# Copyright (c) 2021-2025 Atmosic
# SPDX-License-Identifier: Apache-2.0

config BOARD_ATMEVK_3430E_WQN_2
	select SOC_ATM34XX_2

# power manage the onboard stacked flash
config FLASH
	bool
	default y if PM
```

## boards/atmosic/atm34evk/Kconfig.ATMEVK-3430e-YQN-5
```kconfig
# Copyright (c) 2021-2025 Atmosic
# SPDX-License-Identifier: Apache-2.0

config BOARD_ATMEVK_3430E_YQN_5
	select SOC_ATM34XX_5

# power manage the onboard stacked flash
config FLASH
	bool
	default y if PM
```
