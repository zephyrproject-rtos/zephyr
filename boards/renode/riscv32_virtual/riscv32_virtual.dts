/*
 * Copyright (c) 2023 Meta
 *
 * SPDX-License-Identifier: Apache-2.0
 */

/dts-v1/;

#include <renode_riscv32_virt.dtsi>

/ {
	compatible = "renode,riscv32-virtual";
	model = "Renode RISCV32 Virtual target";

	chosen {
		zephyr,console = &uart0;
		zephyr,shell-uart = &uart0;
		zephyr,flash = &flash0;
		zephyr,sram = &sram0;
	};
};

&uart0 {
	status = "okay";
};
