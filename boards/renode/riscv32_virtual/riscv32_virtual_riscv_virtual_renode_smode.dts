/*
 * Copyright (c) 2026 Antmicro <www.antmicro.com>
 *
 * SPDX-License-Identifier: Apache-2.0
 */

/dts-v1/;

#include <renode_riscv32_virt.dtsi>

/ {
	model = "Renode RISCV32 Virtual target";
	compatible = "renode,riscv32-virtual";

	chosen {
		zephyr,console = &uart0;
		zephyr,shell-uart = &uart0;
		zephyr,flash = &flash0;
		zephyr,sram = &sram0;
	};
};

&{/cpus/cpu@0} {
	riscv,privilege-modes = "m", "s", "u";
};

&uart0 {
	status = "okay";
};
