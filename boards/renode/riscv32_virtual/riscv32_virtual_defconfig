## boards/renode/riscv32_virtual/riscv32_virtual_defconfig
```kconfig
# Copyright (c) 2023 Meta
# SPDX-License-Identifier: Apache-2.0

CONFIG_CONSOLE=y
CONFIG_SERIAL=y
CONFIG_UART_CONSOLE=y
CONFIG_GPIO=n
CONFIG_XIP=y

# Workaround for incorrect SYS_CLOCK_HW_CYCLES_PER_SEC
CONFIG_SYS_CLOCK_TICKS_PER_SEC=100
```

## boards/retronix/sparrowhawk_rcar_v4h/Kconfig.sparrowhawk_rcar_v4h
```kconfig
# Copyright (c) 2025 Renesas Electronics Corporation
# SPDX-License-Identifier: Apache-2.0

config BOARD_SPARROWHAWK_RCAR_V4H
	select SOC_R8A779G0_R52 if BOARD_SPARROWHAWK_RCAR_V4H_R8A779G0_R52
```

## boards/retronix/sparrowhawk_rcar_v4h/board.yml
```yaml
board:
  name: sparrowhawk_rcar_v4h
  full_name: Sparrow Hawk R-Car V4H SBC
  vendor: retronix
  socs:
  - name: r8a779g0
```

## boards/retronix/sparrowhawk_rcar_v4h/dts/bindings/retronix,sparrowhawk-gpio.yaml
```yaml
#
# Copyright (c) 2026 Renesas Electronics Corporation
#
# SPDX-License-Identifier: Apache-2.0
#

description: Renesas RCAR GPIO

compatible: "retronix,sparrowhawk-gpio"

include: [gpio-nexus.yaml, base.yaml]
```

## boards/retronix/sparrowhawk_rcar_v4h/dts/bindings/retronix,sparrowhawk-pinout.yaml
```yaml
#
# Copyright (c) 2026 Renesas Electronics Corporation
#
# SPDX-License-Identifier: Apache-2.0
#

title: Consumer for IO pins on Sparrow Hawk board

description: |
  Describe the pinout node label and the default hardware channels
  for each supported pin.

compatible: "retronix,sparrowhawk-pinout"

include: base.yaml

child-binding:
  properties:
    gpios:
      type: phandle-array
      description: >
        List of pin specifiers: <&gpio-controller pin flag>
    pwms:
      type: phandle-array
      description: >
        List of pin specifiers: <&pwm-controller channel period flag>
```

## boards/retronix/sparrowhawk_rcar_v4h/dts/bindings/retronix,sparrowhawk-pwm-io.yaml
```yaml
#
# Copyright (c) 2026 Renesas Electronics Corporation
#
# SPDX-License-Identifier: Apache-2.0
#
#

title: PWM consumer for output pin on board

description: >
  A node that holds a list of PWM phandles and the pin names.

compatible: "retronix,sparrowhawk-pwm-io"

include: base.yaml

properties:
  pwms:
    type: phandle-array
    required: true
    description: >
      List of PWM specifiers: <&controller channel period_ns flags>
  pwm-names:
    type: string-array
    description: >
      The board pin names corresponding to entries in 'pwms'
```

## boards/retronix/sparrowhawk_rcar_v4h/sparrowhawk_rcar_v4h_r8a779g0_r52_defconfig
```kconfig
CONFIG_CLOCK_CONTROL=y

# UART driver
CONFIG_SERIAL=y
CONFIG_UART_USE_RUNTIME_CONFIGURE=y
CONFIG_UART_INTERRUPT_DRIVEN=n

# Console
CONFIG_CONSOLE=y
CONFIG_RAM_CONSOLE=n
CONFIG_UART_CONSOLE=y
```

## boards/riscv/adp_xc7k_ae350/Kconfig.adp_xc7k_ae350
```kconfig
# Copyright (c) 2022 Zephyr Project members and individual contributors
# SPDX-License-Identifier: Apache-2.0

config BOARD_ADP_XC7K_AE350
	bool
	default y
	select SOC_SERIES_RISCV_ANDES_V5
	select SOC_RISCV_ANDES_AE350
```

## boards/riscv/adp_xc7k_ae350/Kconfig.board
```kconfig
# Copyright (c) 2021 Andes Technology Corporation
# SPDX-License-Identifier: Apache-2.0

config BOARD_ADP_XC7K_AE350
	bool "Andes ADP-XC7K AE350 Platform"
	depends on SOC_RISCV_ANDES_AE350
```

## boards/riscv/adp_xc7k_ae350/Kconfig.defconfig
```kconfig
# Copyright (c) 2021 Andes Technology Corporation
# SPDX-License-Identifier: Apache-2.0

config BOARD
	default "adp_xc7k_ae350" if BOARD_ADP_XC7K_AE350
```

## boards/riscv/adp_xc7k_ae350/adp_xc7k_ae350_defconfig
```kconfig
CONFIG_SOC_SERIES_RISCV_ANDES_V5=y
CONFIG_SOC_RISCV_ANDES_AE350=y
CONFIG_BOARD_ADP_XC7K_AE350=y
CONFIG_XIP=n
CONFIG_PLIC=y
CONFIG_RISCV_MACHINE_TIMER=y
CONFIG_CONSOLE=y
CONFIG_UART_CONSOLE=y

# Serial driver options
CONFIG_SERIAL=y
CONFIG_UART_NS16550=y

# GPIO driver options
CONFIG_GPIO=y
CONFIG_GPIO_ANDES_ATCGPIO100=y

# RV64 options
#CONFIG_RV64I_CPU=y

# FPU (single precision) options
#CONFIG_FPU=y
#CONFIG_FPU_SHARING=y
#CONFIG_FLOAT_HARD=y
#CONFIG_SINGLE_PRECISION_FPU=y

# FPU (double precision) options
#CONFIG_FPU=y
#CONFIG_FPU_SHARING=y
#CONFIG_FLOAT_HARD=y
#CONFIG_DOUBLE_PRECISION_FPU=y

# HW DSP options
#CONFIG_SOC_ANDES_V5_HWDSP=y

# Cache options
CONFIG_CACHE_ENABLE=y

# Nocache memory options
#CONFIG_SOC_ANDES_V5_PMA=y
#CONFIG_NOCACHE_MEMORY=y
```

## boards/riscv/beaglev_fire/Kconfig.defconfig
```kconfig
# Copyright (c) 2023 Microchip Technology Inc
# SPDX-License-Identifier: Apache-2.0

config BOARD
	default "beaglev_fire"
	depends on BOARD_BEAGLEV_FIRE
```

## boards/riscv/beaglev_starlight_jh7100/Kconfig.beaglev_starlight_jh7100
```kconfig
# Copyright (c) 2022 Zephyr Project members and individual contributors
# SPDX-License-Identifier: Apache-2.0

config BOARD_BEAGLEV_STARLIGHT_JH7100
	bool
	default y
	select SOC_SERIES_STARFIVE_JH71XX
	select SOC_JH7100
	select 64BIT
```

## boards/riscv/beaglev_starlight_jh7100/Kconfig.board
```kconfig
# Copyright (c) 2021 Rajnesh Kanwal <rajnesh.kanwal49@gmail.com>
# SPDX-License-Identifier: Apache-2.0

config BOARD_BEAGLEV_STARLIGHT_JH7100
	bool "BeagleV Starlight JH7100 RISCV64 target"
	depends on SOC_JH7100
	select 64BIT
```

## boards/riscv/beaglev_starlight_jh7100/Kconfig.defconfig
```kconfig
# Copyright (c) 2021 Rajnesh Kanwal <rajnesh.kanwal49@gmail.com>
# SPDX-License-Identifier: Apache-2.0

config BOARD
	default "beaglev_starlight_jh7100"
	depends on BOARD_BEAGLEV_STARLIGHT_JH7100
```

## boards/riscv/beaglev_starlight_jh7100/beaglev_starlight_jh7100_defconfig
```kconfig
# SPDX-License-Identifier: Apache-2.0

# Platform Configuration
CONFIG_SOC_SERIES_STARFIVE_JH71XX=y
CONFIG_SOC_JH7100=y
CONFIG_BOARD_BEAGLEV_STARLIGHT_JH7100=y
CONFIG_PLIC=y
CONFIG_RISCV_MACHINE_TIMER=y
CONFIG_STACK_SENTINEL=y

# Zephyr Kernel Configuration
CONFIG_XIP=n

# Serial Drivers
CONFIG_SERIAL=y
CONFIG_UART_INTERRUPT_DRIVEN=y
CONFIG_UART_NS16550=y
CONFIG_UART_NS16550_ACCESS_WORD_ONLY=y

# Enable Console
CONFIG_CONSOLE=y
CONFIG_UART_CONSOLE=y
```

## boards/riscv/ch32v307v_evt_r1/Kconfig.board
```kconfig
# Copyright (c) 2022 TOKITA Hiroshi <tokita.hiroshi@gmail.com>
# SPDX-License-Identifier: Apache-2.0

config BOARD_CH32V307V_EVT_R1
	bool "WCH CH32V307V_EVT_R1"
	depends on SOC_CH32V307
```

## boards/riscv/ch32v307v_evt_r1/Kconfig.defconfig
```kconfig
# WCH CH32V307V_EVT_R1 Board Configuration

# Copyright (c) 2022 TOKITA Hiroshi <tokita.hiroshi@gmail.com>

if BOARD_CH32V307V_EVT_R1

config BOARD
	default "ch32v307v_evt_r1" if BOARD_CH32V307V_EVT_R1

endif # BOARD_CH32V307V_EVT_R1
```

## boards/riscv/ch32v307v_evt_r1/ch32v307v_evt_r1_defconfig
```kconfig
# WCH CH32V307V_EVT_R1 Board Configuration
#
# Copyright (c) 2022 TOKITA Hiroshi <tokita.hiroshi@gmail.com>
#
# SPDX-License-Identifier: Apache-2.0

CONFIG_SOC_SERIES_CH32V30X=y
CONFIG_SOC_CH32V307=y
CONFIG_BOARD_CH32V307V_EVT_R1=y

CONFIG_SERIAL=y
CONFIG_UART_INTERRUPT_DRIVEN=n

CONFIG_CONSOLE=y
CONFIG_UART_CONSOLE=y

CONFIG_GPIO=y
```

## boards/riscv/ch565w_evt/Kconfig.board
```kconfig
# Copyright (c) 2023 Chen Xingyu <hi@xingrz.me>
# SPDX-License-Identifier: Apache-2.0

config BOARD_CH565W_EVT
	bool "WCH CH565W-EVT"
	depends on SOC_CH565
```

## boards/riscv/ch565w_evt/Kconfig.defconfig
```kconfig
# Copyright (c) 2023 Chen Xingyu <hi@xingrz.me>
# SPDX-License-Identifier: Apache-2.0

if BOARD_CH565W_EVT

config BOARD
	default "ch565w_evt"

endif # BOARD_CH565W_EVT
```

## boards/riscv/ch565w_evt/ch565w_evt_defconfig
```kconfig
# Copyright (c) 2023 Chen Xingyu <hi@xingrz.me>
# SPDX-License-Identifier: Apache-2.0

CONFIG_SOC_SERIES_CH32V_QINGKE_V3A=y
CONFIG_SOC_CH565=y
CONFIG_BOARD_CH565W_EVT=y
```

## boards/riscv/ch569w_evt/Kconfig.board
```kconfig
# Copyright (c) 2023 Chen Xingyu <hi@xingrz.me>
# SPDX-License-Identifier: Apache-2.0

config BOARD_CH569W_EVT
	bool "WCH CH569W-EVT"
	depends on SOC_CH569
```

## boards/riscv/ch569w_evt/Kconfig.defconfig
```kconfig
# Copyright (c) 2023 Chen Xingyu <hi@xingrz.me>
# SPDX-License-Identifier: Apache-2.0

if BOARD_CH569W_EVT

config BOARD
	default "ch569w_evt"

endif # BOARD_CH569W_EVT
```

## boards/riscv/ch569w_evt/ch569w_evt_defconfig
```kconfig
# Copyright (c) 2023 Chen Xingyu <hi@xingrz.me>
# SPDX-License-Identifier: Apache-2.0

CONFIG_SOC_SERIES_CH32V_QINGKE_V3A=y
CONFIG_SOC_CH569=y
CONFIG_BOARD_CH569W_EVT=y
```
