/*
 * Copyright (c) 2024 Antmicro <www.antmicro.com>
 *
 * SPDX-License-Identifier: Apache-2.0
 */

/dts-v1/;

#include <cortex_r8_virt.dtsi>

/ {
	compatible = "renode,cortex-r8-virtual";
	model = "Cortex-R8 Virtual target";

	chosen {
		zephyr,sram = &sram0;
		zephyr,flash = &flash0;
		zephyr,console = &uart0;
		zephyr,shell-uart = &uart0;
	};
};

&uart0 {
	current-speed = <115200>;
	clock-frequency = <99999901>;
	status = "okay";
};
