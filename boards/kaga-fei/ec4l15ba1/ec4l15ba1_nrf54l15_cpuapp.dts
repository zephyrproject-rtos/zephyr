/*
 * Copyright (c) 2024 Nordic Semiconductor ASA
 * Copyright (c) 2026 KAGA FEI Co., Ltd.
 *
 * SPDX-License-Identifier: Apache-2.0
 */

/dts-v1/;

#include <nordic/nrf54l15_cpuapp.dtsi>
#include "ec4l15ba1_cpuapp_common.dtsi"

/ {
	compatible = "kaga-fei,ec4l15ba1-cpuapp";
	model = "KAGA FEI EC4L15BA1 nRF54L15 Application MCU";

	chosen {
		zephyr,code-partition = &slot0_partition;
		zephyr,sram = &cpuapp_sram;
	};
};

/* Include default memory partition configuration file */
#include <vendor/nordic/nrf54l15_cpuapp_partition.dtsi>
