	afe_dl2: afe_dl2 {
		compatible = "mediatek,afe";
		afe_name = "DL2";
		dai_id = <0>;
		downlink;
		base = <0x00000000 0x10b11250>;
		cur = <0x00000000 0x10b11254>;
		end = <0x00000000 0x10b11258>;
		fs = <0x10b115a0 10 5>;
		enable = <0x10b11200 18 1>;
		hd = <0x10b1125c 5 1>;
		msb = <0x10b1192c 18 1>;
		msb2 = <0x10b11930 18 1>;
		agent_disable = <0x10b10014 18 1>;
		ch_num = <0x10b1125c 0 5>;
	};

	afe_dl3: afe_dl3 {
		compatible = "mediatek,afe";
		afe_name = "DL3";
		dai_id = <1>;
		downlink;
		base = <0x00000000 0x10b11260>;
		cur = <0x00000000 0x10b11264>;
		end = <0x00000000 0x10b11268>;
		fs = <0x10b115a0 15 5>;
		enable = <0x10b11200 19 1>;
		hd = <0x10b1126c 5 1>;
		msb = <0x10b1192c 19 1>;
		msb2 = <0x10b11930 19 1>;
		agent_disable = <0x10b10014 19 1>;
		ch_num = <0x10b1126c 0 5>;
	};

	afe_ul4: afe_ul4 {
		compatible = "mediatek,afe";
		afe_name = "UL4";
		dai_id = <2>;
		base = <0x00000000 0x10b11330>;
		cur = <0x00000000 0x10b11334>;
		end = <0x00000000 0x10b11338>;
		fs = <0x10b115a8 15 5>;
		mono = <0x10b1133c 1 1>;
		int_odd = <0x10b1133c 0 1>;
		enable = <0x10b11200 4 1>;
		hd = <0x10b1133c 5 1>;
		msb = <0x10b1192c 3 1>;
		msb2 = <0x10b11930 3 1>;
		agent_disable = <0x10b10014 3 1>;
	};

	afe_ul5: afe_ul5 {
		compatible = "mediatek,afe";
		afe_name = "UL5";
		dai_id = <3>;
		base = <0x00000000 0x10b11340>;
		cur = <0x00000000 0x10b11344>;
		end = <0x00000000 0x10b11348>;
		fs = <0x10b115a8 20 5>;
		mono = <0x10b1134c 1 1>;
		int_odd = <0x10b1134c 0 1>;
		enable = <0x10b11200 5 1>;
		hd = <0x10b1134c 5 1>;
		msb = <0x10b1192c 4 1>;
		msb2 = <0x10b11930 4 1>;
		agent_disable = <0x10b10014 4 1>;
	};
