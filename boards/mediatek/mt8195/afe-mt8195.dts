	afe_dl2: afe_dl2 {
		compatible = "mediatek,afe";
		afe-name = "DL2";
		dai-id = <0>;
		downlink;
		base = <0x00000000 0x10891250>;
		cur = <0x00000000 0x10891254>;
		end = <0x00000000 0x10891258>;
		fs = <0x108915a0 10 5>;
		enable = <0x10891200 18 1>;
		hd = <0x1089125c 5 1>;
		msb = <0x1089192c 18 1>;
		msb2 = <0x10891930 18 1>;
		agent-disable = <0x10890014 18 1>;
		ch-num = <0x1089125c 0 5>;
	};

	afe_dl3: afe_dl3 {
		compatible = "mediatek,afe";
		afe-name = "DL3";
		dai-id = <1>;
		downlink;
		base = <0x00000000 0x10891260>;
		cur = <0x00000000 0x10891264>;
		end = <0x00000000 0x10891268>;
		fs = <0x108915a0 15 5>;
		enable = <0x10891200 19 1>;
		hd = <0x1089126c 5 1>;
		msb = <0x1089192c 19 1>;
		msb2 = <0x10891930 19 1>;
		agent-disable = <0x10890014 19 1>;
		ch-num = <0x1089126c 0 5>;
	};

	afe_ul4: afe_ul4 {
		compatible = "mediatek,afe";
		afe-name = "UL4";
		dai-id = <2>;
		base = <0x00000000 0x10891330>;
		cur = <0x00000000 0x10891334>;
		end = <0x00000000 0x10891338>;
		fs = <0x108915a8 15 5>;
		mono = <0x1089133c 1 1>;
		enable = <0x10891200 4 1>;
		hd = <0x1089133c 5 1>;
		msb = <0x1089192c 3 1>;
		msb2 = <0x10891930 3 1>;
		agent-disable = <0x10890014 3 1>;
	};

	afe_ul5: afe_ul5 {
		compatible = "mediatek,afe";
		afe-name = "UL5";
		dai-id = <3>;
		base = <0x00000000 0x10891340>;
		cur = <0x00000000 0x10891344>;
		end = <0x00000000 0x10891348>;
		fs = <0x108915a8 20 5>;
		mono = <0x1089134c 1 1>;
		enable = <0x10891200 5 1>;
		hd = <0x1089134c 5 1>;
		msb = <0x1089192c 4 1>;
		msb2 = <0x10891930 4 1>;
		agent-disable = <0x10890014 4 1>;
	};
