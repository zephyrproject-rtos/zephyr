## boards/adi/max32675evkit/board.yml
```yaml
# Copyright (c) 2024 Analog Devices, Inc.
# SPDX-License-Identifier: Apache-2.0

board:
  name: max32675evkit
  full_name: MAX32675EVKIT
  vendor: adi
  socs:
    - name: max32675
```

## boards/adi/max32675evkit/max32675evkit_defconfig
```kconfig
# Copyright (c) 2024 Analog Devices, Inc.
# SPDX-License-Identifier: Apache-2.0

# Enable GPIO
CONFIG_GPIO=y

# Console
CONFIG_CONSOLE=y
CONFIG_UART_CONSOLE=y

# Enable UART
CONFIG_SERIAL=y
CONFIG_UART_INTERRUPT_DRIVEN=y
```

## boards/adi/max32680evkit/Kconfig.max32680evkit
```kconfig
# MAX32680EVKIT boards configuration

# Copyright (c) 2024 Analog Devices, Inc.
# SPDX-License-Identifier: Apache-2.0

config BOARD_MAX32680EVKIT
	select SOC_MAX32680_M4 if BOARD_MAX32680EVKIT_MAX32680_M4
```

## boards/adi/max32680evkit/board.yml
```yaml
# Copyright (c) 2024 Analog Devices, Inc.
# SPDX-License-Identifier: Apache-2.0

board:
  name: max32680evkit
  full_name: MAX32680EVKIT
  vendor: adi
  socs:
    - name: max32680
```

## boards/adi/max32690evkit/Kconfig.max32690evkit
```kconfig
# MAX32690 board configuration

# Copyright (c) 2023-2024 Analog Devices, Inc.
# SPDX-License-Identifier: Apache-2.0

config BOARD_MAX32690EVKIT
	select SOC_MAX32690_M4 if BOARD_MAX32690EVKIT_MAX32690_M4
```

## boards/adi/max32690evkit/board.yml
```yaml
# Copyright (c) 2023-2024 Analog Devices, Inc.
# SPDX-License-Identifier: Apache-2.0

board:
  name: max32690evkit
  full_name: MAX32690EVKIT
  vendor: adi
  socs:
    - name: max32690
```

## boards/adi/max32690evkit/max32690evkit_max32690_rv32_defconfig
```kconfig
# Copyright (c) 2026 Analog Devices, Inc.
# SPDX-License-Identifier: Apache-2.0

# Set supported clock accuracy
CONFIG_SYS_CLOCK_TICKS_PER_SEC=5000

# Console
CONFIG_CONSOLE=y
CONFIG_UART_CONSOLE=y

# Enable UART
CONFIG_SERIAL=y
CONFIG_UART_INTERRUPT_DRIVEN=y

CONFIG_USE_DT_CODE_PARTITION=y
```

## boards/adi/max32690fthr/board.yml
```yaml
# Copyright (c) 2023-2024 Analog Devices, Inc.
# SPDX-License-Identifier: Apache-2.0

board:
  name: max32690fthr
  full_name: MAX32690FTHR
  vendor: adi
  socs:
    - name: max32690
```

## boards/adi/max78000evkit/Kconfig.max78000evkit
```kconfig
# MAX78000EVKIT boards configuration

# Copyright (c) 2025 Analog Devices, Inc.
# SPDX-License-Identifier: Apache-2.0

config BOARD_MAX78000EVKIT
	select SOC_MAX78000_M4 if BOARD_MAX78000EVKIT_MAX78000_M4
```

## boards/adi/max78000evkit/board.yml
```yaml
# Copyright (c) 2025 Analog Devices, Inc.
# SPDX-License-Identifier: Apache-2.0

board:
  name: max78000evkit
  full_name: MAX78000EVKIT
  vendor: adi
  socs:
    - name: max78000
```

## boards/adi/max78000fthr/Kconfig.max78000fthr
```kconfig
# MAX78000FTHR boards configuration

# Copyright (c) 2025 Analog Devices, Inc.
# SPDX-License-Identifier: Apache-2.0

config BOARD_MAX78000FTHR
	select SOC_MAX78000_M4 if BOARD_MAX78000FTHR_MAX78000_M4
```

## boards/adi/max78000fthr/board.yml
```yaml
# Copyright (c) 2025 Analog Devices, Inc.
# SPDX-License-Identifier: Apache-2.0

board:
  name: max78000fthr
  full_name: MAX78000FTHR
  vendor: adi
  socs:
    - name: max78000
```

## boards/adi/max78002evkit/Kconfig.max78002evkit
```kconfig
# MAX78002EVKIT board configuration

# Copyright (c) 2024 Analog Devices, Inc.
# SPDX-License-Identifier: Apache-2.0

config BOARD_MAX78002EVKIT
	select SOC_MAX78002_M4 if BOARD_MAX78002EVKIT_MAX78002_M4
```

## boards/adi/max78002evkit/board.yml
```yaml
# Copyright (c) 2024 Analog Devices, Inc.
# SPDX-License-Identifier: Apache-2.0

board:
  name: max78002evkit
  full_name: MAX78002EVKIT
  vendor: adi
  socs:
    - name: max78002
```

## boards/adi/max78002evkit/max78002evkit_max78002_m4_defconfig
```kconfig
# Copyright (c) 2024 Analog Devices, Inc.
# SPDX-License-Identifier: Apache-2.0

# Enable MPU
CONFIG_ARM_MPU=y

# Enable GPIO
CONFIG_GPIO=y

# Console
CONFIG_CONSOLE=y
CONFIG_UART_CONSOLE=y

# Enable UART
CONFIG_SERIAL=y
CONFIG_UART_INTERRUPT_DRIVEN=y

# Load at the correct code partition
CONFIG_USE_DT_CODE_PARTITION=y
```

## boards/adi/max78002evkit/max78002evkit_max78002_rv32_defconfig
```kconfig
# Copyright (c) 2026 Analog Devices, Inc.
# SPDX-License-Identifier: Apache-2.0

# Set supported clock accuracy
CONFIG_SYS_CLOCK_TICKS_PER_SEC=4500

# Enable GPIO
CONFIG_GPIO=y

# Console
CONFIG_CONSOLE=y
CONFIG_UART_CONSOLE=y

# Enable UART
CONFIG_SERIAL=y
CONFIG_UART_INTERRUPT_DRIVEN=y

CONFIG_USE_DT_CODE_PARTITION=y
```

## boards/adi/sdp_k1/Kconfig.adi_sdp_k1
```kconfig
# Copyright (c) 2024 BayLibre
# SPDX-License-Identifier: Apache-2.0

config BOARD_ADI_SDP_K1
	select SOC_STM32F469XX
```

## boards/adi/sdp_k1/Kconfig.defconfig
```kconfig
# ADI SDP-K1 board configuration

# Copyright (c) 2024 BayLibre
# SPDX-License-Identifier: Apache-2.0

if BOARD_ADI_SDP_K1

config SPI_STM32_INTERRUPT
	default y
	depends on SPI

endif # BOARD_ADI_SDP_K1
```

## boards/adi/sdp_k1/adi_sdp_k1_defconfig
```kconfig
# SPDX-License-Identifier: Apache-2.0

# Enable MPU
CONFIG_ARM_MPU=y

# Enable HW stack protection
CONFIG_HW_STACK_PROTECTION=y

CONFIG_SERIAL=y

# console
CONFIG_CONSOLE=y
CONFIG_UART_CONSOLE=y

# enable GPIO
CONFIG_GPIO=y

# Enable Clocks
CONFIG_CLOCK_CONTROL=y

# enable pin controller
CONFIG_PINCTRL=y

CONFIG_GPIO_MAX22017=y
CONFIG_DAC_MAX22017=y
CONFIG_LOG=y
```

## boards/adi/sdp_k1/board.yml
```yaml
board:
  name: adi_sdp_k1
  full_name: SDP-K1
  vendor: adi
  socs:
    - name: stm32f469xx
```

## boards/aesc/elemrv/Kconfig.elemrv
```kconfig
# Copyright (c) 2025 Aesc Silicon
# SPDX-License-Identifier: Apache-2.0

config BOARD_ELEMRV
	select SOC_ELEMRV_N
```

## boards/aesc/elemrv/board.yml
```yaml
board:
  name: elemrv
  full_name: ElemRV-N
  vendor: aesc
  socs:
  - name: elemrv_n
```

## boards/aesc/elemrv/elemrv_elemrv_n_defconfig
```kconfig
# Copyright (c) 2025 Aesc Silicon
# SPDX-License-Identifier: Apache-2.0

# Serial Driver
CONFIG_SERIAL=y

# Enable Console
CONFIG_CONSOLE=y
CONFIG_UART_CONSOLE=y

# GPIO Driver
CONFIG_GPIO=y
```

## boards/aesc/elemrv_flask/Kconfig.elemrv_flask
```kconfig
# SPDX-FileCopyrightText: 2025 Aesc Silicon
# SPDX-License-Identifier: Apache-2.0

config BOARD_ELEMRV_FLASK
	select SOC_ELEMRV_N if BOARD_ELEMRV_FLASK_ELEMRV_N
```

## boards/aesc/elemrv_flask/board.yml
```yaml
board:
  name: elemrv_flask
  full_name: ElemRV Flask
  vendor: aesc
  socs:
  - name: elemrv_h
  - name: elemrv_n
```
