## boards/adi/max32655fthr/Kconfig.max32655fthr
```kconfig
# MAX32655FTHR boards configuration

# Copyright (c) 2023-2024 Analog Devices, Inc.
# SPDX-License-Identifier: Apache-2.0

config BOARD_MAX32655FTHR
	select SOC_MAX32655_M4 if BOARD_MAX32655FTHR_MAX32655_M4
```

## boards/adi/max32655fthr/board.yml
```yaml
# Copyright (c) 2023-2024 Analog Devices, Inc.
# SPDX-License-Identifier: Apache-2.0

board:
  name: max32655fthr
  full_name: MAX32655FTHR
  vendor: adi
  socs:
    - name: max32655
```

## boards/adi/max32655fthr/max32655fthr_max32655_rv32_defconfig
```kconfig
# Copyright (c) 2023-2026 Analog Devices, Inc.
# SPDX-License-Identifier: Apache-2.0

CONFIG_SYS_CLOCK_TICKS_PER_SEC=5000

CONFIG_GPIO=y

# Console
CONFIG_CONSOLE=y
CONFIG_UART_CONSOLE=y

# Enable UART
CONFIG_SERIAL=y
CONFIG_UART_INTERRUPT_DRIVEN=y

CONFIG_USE_DT_CODE_PARTITION=y
```

## boards/adi/max32657evkit/Kconfig.max32657evkit
```kconfig
# Copyright (c) 2024-2025 Analog Devices, Inc.
# SPDX-License-Identifier: Apache-2.0

config BOARD_MAX32657EVKIT
	select SOC_MAX32657 if BOARD_MAX32657EVKIT_MAX32657 ||	\
			       BOARD_MAX32657EVKIT_MAX32657_NS
```

## boards/adi/max32657evkit/board.yml
```yaml
# Copyright (c) 2024-2025 Analog Devices, Inc.
# SPDX-License-Identifier: Apache-2.0

board:
  name: max32657evkit
  vendor: adi
  socs:
  - name: max32657
    variants:
    - name: "ns"
```

## boards/adi/max32657evkit/max32657evkit_max32657_defconfig
```kconfig
# Copyright (c) 2024-2025 Analog Devices, Inc.
# SPDX-License-Identifier: Apache-2.0

# Enable MPU
CONFIG_ARM_MPU=y

# Enable GPIO
CONFIG_GPIO=y

# Console
CONFIG_CONSOLE=y
CONFIG_UART_CONSOLE=y

# Enable UART
CONFIG_SERIAL=y
CONFIG_UART_INTERRUPT_DRIVEN=y

# It is secure fw, enable flags
CONFIG_TRUSTED_EXECUTION_SECURE=y
```

## boards/adi/max32658evkit/Kconfig.defconfig
```kconfig
# Copyright (c) 2024-2025 Analog Devices, Inc.
# SPDX-License-Identifier: Apache-2.0

if BOARD_MAX32658EVKIT

# Code Partition:
#
# For the secure version of the board the firmware is linked at the beginning
# of the flash, or into the code-partition defined in DT if it is intended to
# be loaded by MCUboot. If the secure firmware is to be combined with a non-
# secure image (TRUSTED_EXECUTION_SECURE=y), the secure FW image shall always
# be restricted to the size of its code partition.
#
# For the non-secure version of the board, the firmware
# must be linked into the code-partition (non-secure) defined in DT, regardless.
# Apply this configuration below by setting the Kconfig symbols used by
# the linker according to the information extracted from DT partitions.

# Workaround for not being able to have commas in macro arguments
DT_CHOSEN_Z_CODE_PARTITION := zephyr,code-partition

config FLASH_LOAD_SIZE
	default $(dt_chosen_reg_size_hex,$(DT_CHOSEN_Z_CODE_PARTITION))

if BOARD_MAX32658EVKIT_MAX32658_NS

config FLASH_LOAD_OFFSET
	default $(dt_chosen_reg_addr_hex,$(DT_CHOSEN_Z_CODE_PARTITION))

# MAX32658 has one UART interface,
# It can be used either on TFM or Zephyr
# Enabling debug (TFM_SPM_LOG_LEVEL || TFM_PARTITION_LOG_LEVEL) will transfer it to the TFM side
# Disabling TFM debug will transfer it to the Zephyr side.

choice TFM_SPM_LOG_LEVEL
	default TFM_SPM_LOG_LEVEL_SILENCE
endchoice

choice TFM_PARTITION_LOG_LEVEL
	default TFM_PARTITION_LOG_LEVEL_SILENCE
endchoice

endif # BOARD_MAX32658EVKIT_MAX32658_NS

config I3C
	default y if ADXL367

endif # BOARD_MAX32658EVKIT
```

## boards/adi/max32658evkit/Kconfig.max32658evkit
```kconfig
# Copyright (c) 2024-2025 Analog Devices, Inc.
# SPDX-License-Identifier: Apache-2.0

config BOARD_MAX32658EVKIT
	select SOC_MAX32658 if BOARD_MAX32658EVKIT_MAX32658 ||	\
			       BOARD_MAX32658EVKIT_MAX32658_NS
```

## boards/adi/max32658evkit/board.yml
```yaml
# Copyright (c) 2024-2025 Analog Devices, Inc.
# SPDX-License-Identifier: Apache-2.0

board:
  name: max32658evkit
  full_name: MAX32658EVKIT
  vendor: adi
  socs:
  - name: max32658
    variants:
    - name: "ns"
```

## boards/adi/max32658evkit/max32658evkit_max32658_ns_defconfig
```kconfig
# Copyright (c) 2024-2025 Analog Devices, Inc.
# SPDX-License-Identifier: Apache-2.0

# Enable GPIO
CONFIG_GPIO=y

# Console
CONFIG_CONSOLE=y
CONFIG_UART_CONSOLE=y

# Enable UART
CONFIG_SERIAL=y
CONFIG_UART_INTERRUPT_DRIVEN=y

# It is non-secure fw, enable flags
CONFIG_TRUSTED_EXECUTION_NONSECURE=y

# Set TFM and Zephyr sign key
CONFIG_TFM_MCUBOOT_SIGNATURE_TYPE="RSA-3072"
```

## boards/adi/max32660evsys/Kconfig.max32660evsys
```kconfig
# MAX32660EVSYS boards configuration

# Copyright (c) 2025 Analog Devices, Inc.
# SPDX-License-Identifier: Apache-2.0

config BOARD_MAX32660EVSYS
	select SOC_MAX32660
```

## boards/adi/max32660evsys/board.yml
```yaml
# Copyright (c) 2025 Analog Devices, Inc.
# SPDX-License-Identifier: Apache-2.0

board:
  name: max32660evsys
  full_name: MAX32660EVSYS
  vendor: adi
  socs:
    - name: max32660
```

## boards/adi/max32662evkit/Kconfig.max32662evkit
```kconfig
# MAX32662EVKIT boards configuration

# Copyright (c) 2024 Analog Devices, Inc.
# SPDX-License-Identifier: Apache-2.0

config BOARD_MAX32662EVKIT
	select SOC_MAX32662
```

## boards/adi/max32662evkit/board.yml
```yaml
# Copyright (c) 2024 Analog Devices, Inc.
# SPDX-License-Identifier: Apache-2.0

board:
  name: max32662evkit
  full_name: MAX32662EVKIT
  vendor: adi
  socs:
    - name: max32662
```

## boards/adi/max32666evkit/board.yml
```yaml
# Copyright (c) 2024 Analog Devices, Inc.
# SPDX-License-Identifier: Apache-2.0

board:
  name: max32666evkit
  full_name: MAX32666EVKIT
  vendor: adi
  socs:
    - name: max32666
```

## boards/adi/max32666evkit/max32666evkit_max32666_cpu0_defconfig
```kconfig
# Copyright (c) 2024 Analog Devices, Inc.
# SPDX-License-Identifier: Apache-2.0

# Enable MPU
CONFIG_ARM_MPU=y

# Enable GPIO
CONFIG_GPIO=y

# Console
CONFIG_CONSOLE=y
CONFIG_UART_CONSOLE=y

# enable uart driver
CONFIG_SERIAL=y
CONFIG_UART_INTERRUPT_DRIVEN=y
```

## boards/adi/max32666fthr/Kconfig.max32666fthr
```kconfig
# MAX32666FTHR boards configuration

# Copyright (c) 2023-2024 Analog Devices, Inc.
# SPDX-License-Identifier: Apache-2.0

config BOARD_MAX32666FTHR
	select SOC_MAX32666_CPU0 if BOARD_MAX32666FTHR_MAX32666_CPU0
```

## boards/adi/max32666fthr/board.yml
```yaml
# Copyright (c) 2023-2024 Analog Devices, Inc.
# SPDX-License-Identifier: Apache-2.0

board:
  name: max32666fthr
  full_name: MAX32666FTHR
  vendor: adi
  socs:
    - name: max32666
```

## boards/adi/max32670evkit/Kconfig.max32670evkit
```kconfig
# MAX32670EVKIT boards configuration

# Copyright (c) 2024 Analog Devices, Inc.
# SPDX-License-Identifier: Apache-2.0

config BOARD_MAX32670EVKIT
	select SOC_MAX32670
```

## boards/adi/max32670evkit/board.yml
```yaml
# Copyright (c) 2024 Analog Devices, Inc.
# SPDX-License-Identifier: Apache-2.0

board:
  name: max32670evkit
  full_name: MAX32670EVKIT
  vendor: adi
  socs:
    - name: max32670
```

## boards/adi/max32672evkit/board.yml
```yaml
# Copyright (c) 2024 Analog Devices, Inc.
# SPDX-License-Identifier: Apache-2.0

board:
  name: max32672evkit
  full_name: MAX32672EVKIT
  vendor: adi
  socs:
    - name: max32672
```

## boards/adi/max32672fthr/Kconfig.defconfig
```kconfig
# MAX32672FTHR boards configuration

# Copyright (c) 2024 Analog Devices, Inc.
# SPDX-License-Identifier: Apache-2.0

if BOARD_MAX32672FTHR

if DISPLAY

if LVGL

# LVGL should allocate buffers equal to size of display
config LV_Z_VDB_SIZE
	default 64

# Default Dot Per Inch. [px/inch]
# Used to initialize default sizes such as widgets sized, style paddings.
config LV_DPI_DEF
	default 128

config LV_Z_BITS_PER_PIXEL
	default 1

# Use offloaded render thread
config LV_Z_FLUSH_THREAD
	default y

choice LV_COLOR_DEPTH
	default LV_COLOR_DEPTH_1  # 1 byte per pixel
endchoice

endif # LVGL

endif # DISPLAY

endif # BOARD_MAX32672FTHR
```

## boards/adi/max32672fthr/Kconfig.max32672fthr
```kconfig
# MAX32672FTHR boards configuration

# Copyright (c) 2024 Analog Devices, Inc.
# SPDX-License-Identifier: Apache-2.0

config BOARD_MAX32672FTHR
	select SOC_MAX32672
```

## boards/adi/max32672fthr/board.yml
```yaml
# Copyright (c) 2024 Analog Devices, Inc.
# SPDX-License-Identifier: Apache-2.0

board:
  name: max32672fthr
  full_name: MAX32672FTHR
  vendor: adi
  socs:
    - name: max32672
```

## boards/adi/max32675evkit/Kconfig.max32675evkit
```kconfig
# MAX32675EVKIT boards configuration

# Copyright (c) 2024 Analog Devices, Inc.
# SPDX-License-Identifier: Apache-2.0

config BOARD_MAX32675EVKIT
	select SOC_MAX32675
```
