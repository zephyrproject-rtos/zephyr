## boards/adi/ad_swiot1l_sl/Kconfig.defconfig
```kconfig
# AD-SWIOT1L-SL board configuration

# Copyright (c) 2026 Analog Devices, Inc.
# SPDX-License-Identifier: Apache-2.0

if BOARD_AD_SWIOT1L_SL

configdefault ETH_DRIVER
	default y if NETWORKING

endif # BOARD_AD_SWIOT1L_SL
```

## boards/adi/apard32690/Kconfig.defconfig
```kconfig
# Copyright (c) 2024 Analog Devices, Inc.
# SPDX-License-Identifier: Apache-2.0
if BOARD_APARD32690

configdefault ETH_DRIVER
	default y

config NET_IF_MAX_IPV4_COUNT
	default 2 if ETH_DRIVER &&  WIFI

endif # BOARD_APARD32690
```

## boards/adi/eval_adema_apph5/Kconfig.eval_adema_apph5
```kconfig
# Copyright (c) 2026 Analog Devices Inc.
# SPDX-License-Identifier: Apache-2.0

config BOARD_EVAL_ADEMA_APPH5
	select SOC_STM32H573XX
```

## boards/adi/eval_adema_apph5/board.yml
```yaml
# Copyright (c) 2026 Analog Devices Inc.
# SPDX-License-Identifier: Apache-2.0

board:
  name: eval_adema_apph5
  full_name: ADI EVAL-ADEMA-APPH5 (STM32H573ZI)
  vendor: adi
  socs:
    - name: stm32h573xx
```

## boards/adi/eval_adin1140d1z/Kconfig.adi_eval_adin1140d1z
```kconfig
# Copyright (c) 2024-2026 Analog Devices, Inc.
# SPDX-License-Identifier: Apache-2.0

config BOARD_ADI_EVAL_ADIN1140D1Z
	select SOC_MAX32690_M4 if BOARD_ADI_EVAL_ADIN1140D1Z_MAX32690_M4
```

## boards/adi/eval_adin1140d1z/Kconfig.defconfig
```kconfig
# Copyright (c) 2024-2026 Analog Devices, Inc.
# SPDX-License-Identifier: Apache-2.0

if BOARD_ADI_EVAL_ADIN1140D1Z

config SPI_MAX32_DMA
	default y

configdefault NET_IF_MAX_IPV4_COUNT
	default 2

configdefault ETH_DRIVER
	default y

endif # BOARD_ADI_EVAL_ADIN1140D1Z
```

## boards/adi/eval_adin1140d1z/board.yml
```yaml
# Copyright (c) 2024-2026 Analog Devices, Inc.
# SPDX-License-Identifier: Apache-2.0

board:
  name: adi_eval_adin1140d1z
  full_name: EVAL-ADIN1140D1Z
  vendor: adi
  socs:
    - name: max32690
```

## boards/adi/max32666evkit/Kconfig.defconfig
```kconfig
# MAX32666EVKIT boards configuration defaults

# Copyright (c) 2026 Analog Devices, Inc.
# SPDX-License-Identifier: Apache-2.0

if BOARD_MAX32666EVKIT

if DISPLAY

if LVGL

config LV_Z_VDB_SIZE
	default 16

config LV_DPI_DEF
	default 150

choice LV_COLOR_FORMAT_DEFAULT
	default LV_COLOR_FORMAT_I1
endchoice

endif # LVGL

endif # DISPLAY

endif # BOARD_MAX32666EVKIT
```

## boards/adi/max32672evkit/Kconfig.defconfig
```kconfig
# MAX32672EVKIT boards configuration

# Copyright (c) 2024 Analog Devices, Inc.
# SPDX-License-Identifier: Apache-2.0

if BOARD_MAX32672EVKIT

if DISPLAY

config MIPI_DBI_SPI_3WIRE
	default y

if LVGL

configdefault LV_COLOR_16_SWAP
	default y

endif # LVGL

endif # DISPLAY

endif # BOARD_MAX32672EVKIT
```

## boards/aesc/elemrv_flask_h/Kconfig.elemrv_flask_h
```kconfig
# SPDX-FileCopyrightText: 2026 Aesc Silicon
# SPDX-License-Identifier: Apache-2.0

config BOARD_ELEMRV_FLASK_H
	select SOC_ELEMRV_H if BOARD_ELEMRV_FLASK_H_ELEMRV_H
```

## boards/aesc/elemrv_flask_h/board.yml
```yaml
board:
  name: elemrv_flask_h
  full_name: ElemRV Flask-H
  vendor: aesc
  socs:
  - name: elemrv_h
```

## boards/aesc/elemrv_flask_n/Kconfig.elemrv_flask_n
```kconfig
# SPDX-FileCopyrightText: 2025 Aesc Silicon
# SPDX-License-Identifier: Apache-2.0

config BOARD_ELEMRV_FLASK_N
	select SOC_ELEMRV_N if BOARD_ELEMRV_FLASK_N_ELEMRV_N
```

## boards/aesc/elemrv_flask_n/board.yml
```yaml
board:
  name: elemrv_flask_n
  full_name: ElemRV Flask-N
  vendor: aesc
  socs:
  - name: elemrv_n
```

## boards/aithinker/ai_m61_32s_kit/Kconfig.ai_m61_32s_kit
```kconfig
# Copyright (c) 2024-2026 MASSDRIVER EI (massdriver.space)
#
# SPDX-License-Identifier: Apache-2.0

config BOARD_AI_M61_32S_KIT
	select SOC_BL618M05Q2I if BOARD_REVISION_BLOFN8IR4
	select SOC_BL618M65Q2I if BOARD_REVISION_BLIFN8IR4

if BOARD_AI_M61_32S_KIT

config BOARD_REVISION_BLOFN8IR4
	bool

config BOARD_REVISION_BLIFN8IR4
	bool

# Avoid adding 8 identical files
config CONSOLE
	bool
	default y

config SERIAL
	bool
	default y

config UART_CONSOLE
	bool
	default y

config MEMC
	bool
	default y

endif
```

## boards/aithinker/ai_m61_32s_kit/board.yml
```yaml
board:
  name: ai_m61_32s_kit
  full_name: Ai-Thinker M61-32S development board
  vendor: aithinker
  revision:
    format: custom
    default: "BLOFN8IR4"
    exact: true
    revisions:
      - name: "BLIFN8IR4"
      - name: "BLOFN8IR4"
  socs:
    - name: bl618m05q2i # BLIFN8IR4 revision is bl618m65q2i, Kconfig repairs this 'error'
      variants:
        - name: "safe_overclock"
        - name: "unsafe_overclock"
```

## boards/aithinker/aipi_cam_d200/Kconfig.aipi_cam_d200
```kconfig
# Copyright (c) 2026 Panoramix Labs
#
# SPDX-License-Identifier: Apache-2.0

config BOARD_AIPI_CAM_D200
	select SOC_BL618M05Q2I
```

## boards/aithinker/aipi_cam_d200/Kconfig.defconfig
```kconfig
# Copyright (c) 2024-2026 MASSDRIVER EI (massdriver.space)
#
# SPDX-License-Identifier: Apache-2.0

if BOARD_AIPI_CAM_D200

configdefault CONSOLE
	default y

configdefault SERIAL
	default y

configdefault UART_CONSOLE
	default y

configdefault MEMC
	default y

configdefault GPIO
	default y

config REGULATOR_GPIO_INIT_PRIORITY
	default 41 # GPIO_INIT_PRIORITY + 1

endif
```

## boards/aithinker/aipi_cam_d200/board.yml
```yaml
board:
  name: aipi_cam_d200
  full_name: AiPi-Cam-200 Multi-Functional Development Board
  vendor: aithinker
  socs:
    - name: bl618m05q2i
      variants:
        - name: "safe_overclock"
        - name: "unsafe_overclock"
```

## boards/aithinker/aipi_eyes/Kconfig.aipi_eyes_s1
```kconfig
# SPDX-FileCopyrightText: Copyright The Zephyr Project Contributors
#
# SPDX-License-Identifier: Apache-2.0

config BOARD_AIPI_EYES_S1
	select SOC_BL618M05Q2I
```

## boards/aithinker/aipi_eyes/board.yml
```yaml
# SPDX-FileCopyrightText: Copyright The Zephyr Project Contributors
#
# SPDX-License-Identifier: Apache-2.0

boards:
  - name: aipi_eyes_s1
    full_name: AiPi-Eyes-S1 Multi-Functional Development Board
    vendor: aithinker
    socs:
      - name: bl618m05q2i
        variants:
          - name: "safe_overclock"
          - name: "unsafe_overclock"
  - name: aipi_eyes_s2
    full_name: AiPi-Eyes-S2 Multi-Functional Development Board
    vendor: aithinker
    socs:
      - name: bl618m05q2i
        variants:
          - name: "safe_overclock"
          - name: "unsafe_overclock"
```

## boards/aithinker/esp32_cam/Kconfig.defconfig
```kconfig
# Ai-Thinker ESP32-CAM board configuration

# Copyright (c) 2025 Muhammad Waleed Badar
# SPDX-License-Identifier: Apache-2.0

if BOARD_ESP32_CAM_ESP32_PROCPU

config SOC_FAMILY_ESPRESSIF_SPIRAM
	default y if !MCUBOOT && !SOC_ESP32_USE_UNSUPPORTED_REVISION

endif # BOARD_ESP32_CAM_ESP32_PROCPU
```

## boards/alientek/dnesp32s3b/Kconfig.defconfig
```kconfig
# Copyright (c) 2025 Chen Xingyu <hi@xingrz.me>
# SPDX-License-Identifier: Apache-2.0

if BOARD_DNESP32S3B

if DISPLAY

# Turn on the LCD backlight
config REGULATOR
	default y

if LVGL

config LV_COLOR_16_SWAP
	default y

endif # LVGL

endif # DISPLAY

endif # BOARD_DNESP32S3B
```

## boards/alientek/elite_dnf103/Kconfig.elite_dnf103
```kconfig
# Copyright (c) 2026 Wang Yixiang
# SPDX-License-Identifier: Apache-2.0

config BOARD_ELITE_DNF103
	select SOC_STM32F103XE
```

## boards/alientek/elite_dnf103/board.yml
```yaml
board:
  name: elite_dnf103
  full_name: STM32F103 Elite Development Board
  vendor: alientek
  socs:
    - name: stm32f103xe
```
