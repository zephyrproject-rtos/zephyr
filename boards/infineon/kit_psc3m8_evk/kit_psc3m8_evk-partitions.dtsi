/*
 * SPDX-FileCopyrightText: Copyright (c) 2026 Infineon Technologies AG,
 * SPDX-FileCopyrightText: or an affiliate of Infineon Technologies AG. All rights reserved.
 *
 * SPDX-License-Identifier: Apache-2.0
 */

&flash0 {
	partitions {
		ranges;
		#address-cells = <1>;
		#size-cells = <1>;

		slot0_partition: partition@0 {
			compatible = "zephyr,mapped-partition";
			reg = <0x0 DT_SIZE_K(512)>;
			label = "slot0";
		};
	};
};
