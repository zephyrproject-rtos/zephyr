/*
 * SPDX-FileCopyrightText: Copyright (c) 2026 Infineon Technologies AG,
 * SPDX-FileCopyrightText: or an affiliate of Infineon Technologies AG. All rights reserved.
 *
 * SPDX-License-Identifier: Apache-2.0
 */

#include "kit_psoc4_hvpa_144k_lite-pinctrl.dtsi"

uart0: &scb0 {
	compatible = "infineon,uart";
	current-speed = <115200>;
	clocks = <&peri_clk_div0>;
	pinctrl-0 = <&p0_1_scb0_uart_tx &p0_0_scb0_uart_rx>;
	pinctrl-names = "default";
	status = "okay";
};

&peri_clk_div0 {
	status = "okay";
};

&gpio_prt0 {
	status = "okay";
};
