/*
 * Copyright (c) 2024 Cypress Semiconductor Corporation.
 * SPDX-License-Identifier: Apache-2.0
 */

/* Configure pin control bias mode for uart2 pins */
&p13_1_scb3_uart_tx {
	drive-push-pull;
};

&p13_0_scb3_uart_rx {
	input-enable;
};

&p13_2_scb3_uart_rts {
	drive-push-pull;
};

&p13_3_scb3_uart_cts {
	input-enable;
};
