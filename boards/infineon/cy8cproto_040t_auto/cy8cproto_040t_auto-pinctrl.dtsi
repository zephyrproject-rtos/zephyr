/*
 * SPDX-FileCopyrightText: <text>Copyright (c) 2026 Infineon Technologies AG,
 * or an affiliate of Infineon Technologies AG. All rights reserved.</text>
 *
 * SPDX-License-Identifier: Apache-2.0
 */

/* Configure pin drive mode for uart pins */
&p2_3_scb0_uart_tx {
	drive-push-pull;
};

&p2_2_scb0_uart_rx {
	input-enable;
};
