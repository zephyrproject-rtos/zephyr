## boards/infineon/kit_t2g_c2d6m_lite/Kconfig.defconfig
```kconfig
# SPDX-FileCopyrightText: Copyright The Zephyr Project Contributors
# SPDX-License-Identifier: Apache-2.0

if BOARD_KIT_T2G_C2D6M_LITE

configdefault ETH_DRIVER
	default y

endif # BOARD_KIT_T2G_C2D6M_LITE
```

## boards/infineon/kit_t2g_c2d6m_lite/kit_t2g_c2d6m_lite_cyt4dnjbzs_m7_smp_defconfig
```kconfig
#
# SPDX-FileCopyrightText: Copyright (c) 2026 Linumiz
#
# SPDX-License-Identifier: Apache-2.0
#

# General configuration
CONFIG_BUILD_OUTPUT_HEX=y
CONFIG_BUILD_OUTPUT_BIN=y
CONFIG_USE_DT_CODE_PARTITION=y

CONFIG_HW_STACK_PROTECTION=y

# Enable console
CONFIG_CONSOLE=y
CONFIG_UART_CONSOLE=y

# Enable UART driver
CONFIG_SERIAL=y

# Enable GPIO driver
CONFIG_GPIO=y

# Enable SMP
CONFIG_SMP=y
CONFIG_MP_MAX_NUM_CPUS=2
CONFIG_USE_SWITCH=y

# The M7 data caches are not coherent
CONFIG_DCACHE=n
```

## boards/intel/socfpga/agilex3_socdk/Kconfig.defconfig
```kconfig
# Copyright (c) 2022-2024 Intel Corporation
# SPDX-License-Identifier: Apache-2.0

config HAS_COVERAGE_SUPPORT
	default y

config MAX_THREAD_BYTES
	default 5

if NET_L2_ETHERNET

configdefault NET_BUF_RX_COUNT
	default 512

configdefault NET_TX_STACK_SIZE
	default 2048

configdefault NET_RX_STACK_SIZE
	default 2048

configdefault NET_MGMT_EVENT_STACK_SIZE
	default 1024

configdefault NET_SOCKETS_SERVICE_STACK_SIZE
	default 3072

endif # NET_L2_ETHERNET
```

## boards/intel/socfpga/agilex3_socdk/board.yml
```yaml
board:
  name: intel_socfpga_agilex3_socdk
  full_name: Agilex™ 3 SoC FPGA Development Kit
  vendor: intel
  socs:
    - name: agilex3
```

## boards/intel/socfpga_std/cyclonev_socdk/Kconfig.defconfig
```kconfig
# Copyright (c) 2022-2024 Intel Corporation
# SPDX-License-Identifier: Apache-2.0

if I2C_DW
config I2C_DW_CLOCK_SPEED
	default 200
endif # I2C_DW

configdefault ETH_DRIVER
	default y

configdefault TEST_RANDOM_GENERATOR
	default y if NETWORKING
```

## boards/kevinbot/stm32h743_can_hs/Kconfig.defconfig
```kconfig
# Copyright (c) 2026 Kevin Ahr <kevin@kevinbot.net>
# SPDX-License-Identifier: Apache-2.0

if BOARD_STM32H743_CAN_HS

source "boards/common/usb/Kconfig.cdc_acm_serial.defconfig"

endif # BOARD_STM32H743_CAN_HS
```

## boards/kevinbot/stm32h743_can_hs/Kconfig.stm32h743_can_hs
```kconfig
# Copyright (c) 2026 Kevin Ahr <kevin@kevinbot.net>
# SPDX-License-Identifier: Apache-2.0

config BOARD_STM32H743_CAN_HS
	select SOC_STM32H743XX
```

## boards/kevinbot/stm32h743_can_hs/board.yml
```yaml
board:
  name: stm32h743_can_hs
  full_name: STM32H743 CAN + USB-HS Dev Board
  vendor: kevinbot
  socs:
    - name: stm32h743xx
```

## boards/kevinbot/stm32h743_can_hs/stm32h743_can_hs_defconfig
```kconfig
# Copyright (c) 2026 Kevin Ahr <kevin@kevinbot.net>
# SPDX-License-Identifier: Apache-2.0

# Enable MPU
CONFIG_ARM_MPU=y

# Enable HW stack protection
CONFIG_HW_STACK_PROTECTION=y

# Enable UART driver
CONFIG_SERIAL=y

# Enable console
CONFIG_CONSOLE=y

# Enable GPIO
CONFIG_GPIO=y
```

## boards/khadas/edgev/khadas_edgev_defconfig
```kconfig
# SPDX-License-Identifier: Apache-2.0

# Platform Configuration
CONFIG_ARM64_VA_BITS_40=y
CONFIG_ARM64_PA_BITS_40=y
CONFIG_CACHE_MANAGEMENT=y
CONFIG_ARMV8_A_NS=y

# Serial Drivers
CONFIG_SERIAL=y
CONFIG_UART_INTERRUPT_DRIVEN=y

# Enable Console
CONFIG_CONSOLE=y
CONFIG_UART_CONSOLE=y
```

## boards/kincony/kincony_kc868_a8/Kconfig.sysbuild
```kconfig
# Copyright (c) Bartosz Bilas
# SPDX-License-Identifier: Apache-2.0

choice BOOTLOADER
	default BOOTLOADER_MCUBOOT
endchoice
```

## boards/lilygo/t_deck/Kconfig.sysbuild
```kconfig
# SPDX-FileCopyrightText: Copyright The Zephyr Project Contributors
# SPDX-License-Identifier: Apache-2.0

choice BOOTLOADER
default BOOTLOADER_MCUBOOT
endchoice
```

## boards/lilygo/tdisplay_s3_amoled_plus/Kconfig.tdisplay_s3_amoled_plus
```kconfig
# SPDX-FileCopyrightText: Copyright The Zephyr Project Contributors
# SPDX-License-Identifier: Apache-2.0

config BOARD_TDISPLAY_S3_AMOLED_PLUS
	select SOC_ESP32S3
	select SOC_ESP32S3_PROCPU if BOARD_TDISPLAY_S3_AMOLED_PLUS_ESP32S3_PROCPU
	select SOC_ESP32S3_APPCPU if BOARD_TDISPLAY_S3_AMOLED_PLUS_ESP32S3_APPCPU
```

## boards/lilygo/tdisplay_s3_amoled_plus/board.yml
```yaml
# SPDX-FileCopyrightText: Copyright The Zephyr Project Contributors
# SPDX-License-Identifier: Apache-2.0

board:
  name: tdisplay_s3_amoled_plus
  full_name: LilyGO T-Display S3 AMOLED Plus
  vendor: lilygo
  socs:
  - name: esp32s3
```

## boards/lilygo/tfpga_s3/board.yml
```yaml
board:
  name: tfpga_s3
  full_name: T-FPGA S3
  vendor: lilygo
  socs:
  - name: esp32s3
```

## boards/lowrisc/opentitan_earlgrey/board.yml
```yaml
board:
  name: opentitan_earlgrey
  full_name: OpenTitan Earl Grey
  vendor: lowrisc
  revision:
    format: major.minor.patch
    default: "1.0.0"
    exact: true
    revisions:
    - name: "0.0.0"
    - name: "1.0.0"
  socs:
  - name: opentitan
```

## boards/lowrisc/opentitan_earlgrey/opentitan_earlgrey_0_0_0_defconfig
```kconfig
# Copyright The Zephyr Project Contributors
# SPDX-License-Identifier: Apache-2.0

CONFIG_MAX_IRQ_PER_AGGREGATOR=185
```

## boards/luckfox/luckfox_lume/Kconfig.luckfox_lume
```kconfig
# SPDX-FileCopyrightText: Copyright The Zephyr Project Contributors
# SPDX-License-Identifier: Apache-2.0

config BOARD_LUCKFOX_LUME
	select SOC_T153_E907
```

## boards/luckfox/luckfox_lume/board.yml
```yaml
# SPDX-FileCopyrightText: Copyright The Zephyr Project Contributors
# SPDX-License-Identifier: Apache-2.0

board:
  name: luckfox_lume
  full_name: Luckfox Lume
  vendor: luckfox
  socs:
    - name: t153
```

## boards/m5stack/m5stack_atoms3/Kconfig.m5stack_atoms3
```kconfig
# M5Stack AtomS3 board configuration

# Copyright (c) 2023 Benjamin Cabé <benjamin@zephyrproject.org>
# SPDX-License-Identifier: Apache-2.0

config BOARD_M5STACK_ATOMS3
	select SOC_ESP32S3
	select SOC_ESP32S3_PROCPU if BOARD_M5STACK_ATOMS3_ESP32S3_PROCPU
	select SOC_ESP32S3_APPCPU if BOARD_M5STACK_ATOMS3_ESP32S3_APPCPU
```

## boards/m5stack/m5stack_coremp135/Kconfig.defconfig
```kconfig
# SPDX-FileCopyrightText: Copyright The Zephyr Project Contributors
# SPDX-License-Identifier: Apache-2.0

if BOARD_M5STACK_COREMP135_STM32MP135DXX_FSBL

config SOC_SERIES_STM32MP13X_FSBL
	default y

endif # BOARD_M5STACK_COREMP135_STM32MP135DXX_FSBL
```
