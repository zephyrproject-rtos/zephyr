/*
 * SPDX-FileCopyrightText: <text>Copyright (c) 2026 Infineon Technologies AG,
 * or an affiliate of Infineon Technologies AG. All rights reserved.</text>
 *
 * SPDX-License-Identifier: Apache-2.0
 */

/* Configure pin control bias mode for uart pins */
&p13_1_scb3_uart_tx {
	drive-push-pull;
};

&p13_0_scb3_uart_rx {
	input-enable;
};

&p13_2_scb3_uart_rts {
	drive-push-pull;
};

&p13_3_scb3_uart_cts {
	input-enable;
};
