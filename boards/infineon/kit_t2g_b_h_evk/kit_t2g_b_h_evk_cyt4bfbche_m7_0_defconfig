## boards/infineon/kit_t2g_b_h_evk/kit_t2g_b_h_evk_cyt4bfbche_m7_0_defconfig
```kconfig
# Copyright (c) 2026 Infineon Technologies AG
# SPDX-License-Identifier: Apache-2.0
#

# General configuration
CONFIG_BUILD_OUTPUT_HEX=y
CONFIG_BUILD_OUTPUT_BIN=y
CONFIG_USE_DT_CODE_PARTITION=y

CONFIG_ARM_MPU=y
CONFIG_HW_STACK_PROTECTION=y
CONFIG_CACHE_MANAGEMENT=n

# Enable console
CONFIG_CONSOLE=y
CONFIG_UART_CONSOLE=y
CONFIG_UART_PDL_INFINEON_CAT1=y

# Enable UART driver
CONFIG_SERIAL=y

# Enable GPIO driver
CONFIG_GPIO=y

# Enable clock controller
CONFIG_CLOCK_CONTROL=y

CONFIG_NET_L2_ETHERNET=y
CONFIG_NET_CONNECTION_MANAGER=y

CONFIG_UART_ASYNC_API=y

CONFIG_MDIO=y
```

## boards/infineon/kit_t2g_b_h_lite/Kconfig.kit_t2g_b_h_lite
```kconfig
# Copyright (c) 2025 Infineon Technologies AG,
# or an affiliate of Infineon Technologies AG.
#
# SPDX-License-Identifier: Apache-2.0

config BOARD_KIT_T2G_B_H_LITE
	select SOC_CYT4BF8CDS_M0PLUS if BOARD_KIT_T2G_B_H_LITE_CYT4BF8CDS_M0P
	select SOC_CYT4BF8CDS_M7_0 if BOARD_KIT_T2G_B_H_LITE_CYT4BF8CDS_M7_0
	select SOC_CYT4BF8CDS_M7_1 if BOARD_KIT_T2G_B_H_LITE_CYT4BF8CDS_M7_1
```

## boards/infineon/kit_t2g_b_h_lite/board.yml
```yaml
# SPDX-FileCopyrightText: <text>Copyright (c) 2026 Infineon Technologies AG,
# or an affiliate of Infineon Technologies AG. All rights reserved.</text>
#
# SPDX-License-Identifier: Apache-2.0

board:
  name: kit_t2g_b_h_lite
  full_name: T2G Body High Lite Evaluation Kit
  vendor: infineon
  socs:
  - name: cyt4bf8cds
```

## boards/infineon/kit_t2g_c2d6m_lite/Kconfig.kit_t2g_c2d6m_lite
```kconfig
# Copyright (c) 2026 Linumiz
# SPDX-License-Identifier: Apache-2.0

config BOARD_KIT_T2G_C2D6M_LITE
	select SOC_CYT4DNJBZS_M0PLUS if BOARD_KIT_T2G_C2D6M_LITE_CYT4DNJBZS_M0P
	select SOC_CYT4DNJBZS_M7_0 if BOARD_KIT_T2G_C2D6M_LITE_CYT4DNJBZS_M7_0
	select SOC_CYT4DNJBZS_M7_1 if BOARD_KIT_T2G_C2D6M_LITE_CYT4DNJBZS_M7_1
```

## boards/infineon/kit_t2g_c2d6m_lite/board.yml
```yaml
board:
  name: kit_t2g_c2d6m_lite
  full_name: Kit T2G-C2-D-6M Lite
  vendor: infineon
  socs:
  - name: cyt4dnjbzs
```

## boards/infineon/kit_t2g_c2d6m_lite/kit_t2g_c2d6m_lite_cyt4dnjbzs_m0p_defconfig
```kconfig
#
# Copyright (c) 2026 Linumiz
# SPDX-License-Identifier: Apache-2.0
#

# General configuration
CONFIG_BUILD_OUTPUT_HEX=y
CONFIG_BUILD_OUTPUT_BIN=y
CONFIG_USE_DT_CODE_PARTITION=y

CONFIG_GPIO=y

# Enable UART driver
CONFIG_SERIAL=y

# Enable console if required
CONFIG_CONSOLE=y
CONFIG_UART_CONSOLE=y
```

## boards/infineon/kit_t2g_c2d6m_lite/kit_t2g_c2d6m_lite_cyt4dnjbzs_m7_1_defconfig
```kconfig
#
# Copyright (c) 2026 Linumiz
# SPDX-License-Identifier: Apache-2.0
#

# General configuration
CONFIG_BUILD_OUTPUT_HEX=y
CONFIG_BUILD_OUTPUT_BIN=y
CONFIG_USE_DT_CODE_PARTITION=y

CONFIG_HW_STACK_PROTECTION=y

# Enable console
CONFIG_CONSOLE=y
CONFIG_UART_CONSOLE=y

# Enable UART driver
CONFIG_SERIAL=y

# Enable GPIO driver
CONFIG_GPIO=y
```

## boards/infineon/kit_xmc72_evk/Kconfig.kit_xmc72_evk
```kconfig
# Copyright (c) 2025 Cypress Semiconductor Corporation.
# SPDX-License-Identifier: Apache-2.0

config BOARD_KIT_XMC72_EVK
	select SOC_XMC7200D_E272K8384_M0PLUS if BOARD_KIT_XMC72_EVK_XMC7200D_E272K8384_M0P
	select SOC_XMC7200D_E272K8384_M7_0 if BOARD_KIT_XMC72_EVK_XMC7200D_E272K8384_M7_0
	select SOC_XMC7200D_E272K8384_M7_1 if BOARD_KIT_XMC72_EVK_XMC7200D_E272K8384_M7_1
```

## boards/infineon/kit_xmc72_evk/board.yml
```yaml
board:
  name: kit_xmc72_evk
  full_name: XMC7200 Evaluation Kit
  vendor: infineon
  socs:
  - name: xmc7200d_e272k8384
```

## boards/infineon/kit_xmc72_evk/kit_xmc72_evk_xmc7200d_e272k8384_m7_0_defconfig
```kconfig
#
# Copyright (c) 2025 Cypress Semiconductor Corporation.
# SPDX-License-Identifier: Apache-2.0
#

# General configuration
CONFIG_BUILD_OUTPUT_HEX=y
CONFIG_BUILD_OUTPUT_BIN=y

CONFIG_ARM_MPU=y
CONFIG_HW_STACK_PROTECTION=y
CONFIG_CACHE_MANAGEMENT=y

# Enable console
CONFIG_CONSOLE=y
CONFIG_UART_CONSOLE=y

# Enable UART driver
CONFIG_SERIAL=y

# Enable GPIO driver
CONFIG_GPIO=y

# Enable clock controller
CONFIG_CLOCK_CONTROL=y
```

## boards/infineon/xmc45_relax_kit/Kconfig.defconfig
```kconfig
# SPDX-License-Identifier: Apache-2.0
#
# Copyright (c) 2020 Linumiz
# Author: Parthiban Nallathambi <parthiban@linumiz.com>

if BOARD_XMC45_RELAX_KIT

configdefault NET_L2_ETHERNET
	default y

configdefault TEST_RANDOM_GENERATOR
	default y if NETWORKING

endif # BOARD_XMC45_RELAX_KIT
```

## boards/infineon/xmc45_relax_kit/Kconfig.xmc45_relax_kit
```kconfig
# SPDX-License-Identifier: Apache-2.0
#
# Copyright (c) 2020 Linumiz
# Author: Parthiban Nallathambi <parthiban@linumiz.com>

config BOARD_XMC45_RELAX_KIT
	select SOC_XMC4500
	select SOC_PART_NUMBER_F100X1024
```

## boards/infineon/xmc45_relax_kit/board.yml
```yaml
board:
  name: xmc45_relax_kit
  full_name: XMC45-RELAX-KIT
  vendor: infineon
  socs:
  - name: xmc4500
```

## boards/infineon/xmc45_relax_kit/xmc45_relax_kit_xmc4500_defconfig
```kconfig
# SPDX-License-Identifier: Apache-2.0
#
# Copyright (c) 2020 Linumiz
# Author: Parthiban Nallathambi <parthiban@linumiz.com>

CONFIG_ARM_MPU=y

# enable uart driver
CONFIG_SERIAL=y

# enable console
CONFIG_CONSOLE=y
CONFIG_UART_CONSOLE=y
CONFIG_USE_DT_CODE_PARTITION=y
```

## boards/infineon/xmc47_relax_kit/Kconfig.defconfig
```kconfig
# SPDX-License-Identifier: Apache-2.0
#
# Copyright (c) 2023 Schlumberger

if BOARD_XMC47_RELAX_KIT

configdefault NET_L2_ETHERNET
	default y

config TEST_RANDOM_GENERATOR
	default y if NETWORKING

endif
```

## boards/infineon/xmc47_relax_kit/Kconfig.xmc47_relax_kit
```kconfig
# SPDX-License-Identifier: Apache-2.0
#
# Copyright (c) 2023 Schlumberger

config BOARD_XMC47_RELAX_KIT
	select SOC_XMC4700
	select SOC_PART_NUMBER_F144X2048
```

## boards/infineon/xmc47_relax_kit/board.yml
```yaml
board:
  name: xmc47_relax_kit
  full_name: XMC47-RELAX-KIT
  vendor: infineon
  socs:
  - name: xmc4700
```

## boards/infineon/xmc47_relax_kit/xmc47_relax_kit_defconfig
```kconfig
# SPDX-License-Identifier: Apache-2.0
#
# Copyright (c) 2023 Schlumberger

# Enable UART driver
CONFIG_SERIAL=y

# Enable console
CONFIG_CONSOLE=y
CONFIG_UART_CONSOLE=y
CONFIG_USE_DT_CODE_PARTITION=y
```

## boards/innblue/innblue21/Kconfig.innblue21
```kconfig
# nRF9160 innblue V2.1 board configuration

# Copyright (c) 2020 InnBlue
# SPDX-License-Identifier: Apache-2.0

config BOARD_INNBLUE21
	select SOC_NRF9160_SICA
```

## boards/innblue/innblue21/board.yml
```yaml
board:
  name: innblue21
  full_name: nRF9160 INNBLUE21
  vendor: innblue
  socs:
  - name: nrf9160
    variants:
    - name: 'ns'
```

## boards/innblue/innblue22/Kconfig.innblue22
```kconfig
# nRF9160 innblue V2.2 board configuration

# Copyright (c) 2020 InnBlue
# SPDX-License-Identifier: Apache-2.0

config BOARD_INNBLUE22
	select SOC_NRF9160_SICA
```

## boards/innblue/innblue22/board.yml
```yaml
board:
  name: innblue22
  full_name: nRF9160 INNBLUE22
  vendor: innblue
  socs:
  - name: nrf9160
    variants:
    - name: 'ns'
```

## boards/innblue/innblue22/innblue22_nrf9160_defconfig
```kconfig
# Copyright (c) 2020 InnBlue
# SPDX-License-Identifier: Apache-2.0

# Enable MPU
CONFIG_ARM_MPU=y

# Enable TrustZone-M
CONFIG_ARM_TRUSTZONE_M=y

# Enable GPIO
CONFIG_GPIO=y

# Enable UART driver
CONFIG_SERIAL=y

# Enable console
CONFIG_CONSOLE=y
CONFIG_UART_CONSOLE=y
```

## boards/innblue/innblue22/innblue22_nrf9160_ns_defconfig
```kconfig
# Copyright (c) 2020 InnBlue
# SPDX-License-Identifier: Apache-2.0

# Enable MPU
CONFIG_ARM_MPU=y

# Enable TrustZone-M
CONFIG_ARM_TRUSTZONE_M=y

# This Board implies building Non-Secure firmware
CONFIG_TRUSTED_EXECUTION_NONSECURE=y

# Enable GPIO
CONFIG_GPIO=y

# Enable UART driver
CONFIG_SERIAL=y

# Enable console
CONFIG_CONSOLE=y
CONFIG_UART_CONSOLE=y
```

## boards/intel/adl/Kconfig.intel_adl_crb
```kconfig
# Copyright (c) 2023-2024 Intel Corporation
# SPDX-License-Identifier: Apache-2.0

config BOARD_INTEL_ADL_CRB
	select SOC_ALDER_LAKE
```
