## boards/infineon/cy8ckit_041s_max/Kconfig.cy8ckit_041s_max
```kconfig
# SPDX-FileCopyrightText: Copyright (c) 2026 Infineon Technologies AG,
# SPDX-FileCopyrightText: or an affiliate of Infineon Technologies AG. All rights reserved.
#
# SPDX-License-Identifier: Apache-2.0

config BOARD_CY8CKIT_041S_MAX
	select SOC_CY8C4149AZI_S598
```

## boards/infineon/cy8ckit_149_plus/Kconfig.cy8ckit_149_plus
```kconfig
# SPDX-FileCopyrightText: Copyright (c) 2026 Infineon Technologies AG,
# SPDX-FileCopyrightText: or an affiliate of Infineon Technologies AG. All rights reserved.
#
# SPDX-License-Identifier: Apache-2.0

config BOARD_CY8CKIT_149_PLUS
	select SOC_CY8C4147AZI_S475
```

## boards/infineon/cy8ckit_149_plus/board.yml
```yaml
# SPDX-FileCopyrightText: Copyright (c) 2026 Infineon Technologies AG,
# SPDX-FileCopyrightText: or an affiliate of Infineon Technologies AG. All rights reserved.
#
# SPDX-License-Identifier: Apache-2.0

board:
  name: cy8ckit_149_plus
  full_name: PSOC™ 4100S Plus pioneer kit
  vendor: infineon
  socs:
  - name: cy8c4147azi_s475
```

## boards/infineon/cy8cproto_040t/Kconfig.cy8cproto_040t
```kconfig
# SPDX-FileCopyrightText: Copyright (c) 2026 Infineon Technologies AG,
# SPDX-FileCopyrightText: or an affiliate of Infineon Technologies AG. All rights reserved.
#
# SPDX-License-Identifier: Apache-2.0

config BOARD_CY8CPROTO_040T
	select SOC_CY8C4046LQI_T452
```

## boards/infineon/cy8cproto_040t/Kconfig.cy8cproto_040t_auto
```kconfig
# SPDX-FileCopyrightText: Copyright (c) 2026 Infineon Technologies AG,
# SPDX-FileCopyrightText: or an affiliate of Infineon Technologies AG. All rights reserved.
#
# SPDX-License-Identifier: Apache-2.0

config BOARD_CY8CPROTO_040T_AUTO
	select SOC_CY8C4046LQE_T1
```

## boards/infineon/cy8cproto_040t/board.yml
```yaml
# SPDX-FileCopyrightText: Copyright (c) 2026 Infineon Technologies AG,
# SPDX-FileCopyrightText: or an affiliate of Infineon Technologies AG. All rights reserved.
#
# SPDX-License-Identifier: Apache-2.0

boards:
  - name: cy8cproto_040t_auto
    full_name: PSOC™ 4000T AUTO
    vendor: infineon
    socs:
      - name: cy8c4046lqe_t1
  - name: cy8cproto_040t
    full_name: PSOC™ 4000T
    vendor: infineon
    socs:
      - name: cy8c4046lqi_t452
```

## boards/infineon/cy8cproto_041tp/Kconfig.cy8cproto_041tp
```kconfig
# SPDX-FileCopyrightText: Copyright (c) 2026 Infineon Technologies AG,
# SPDX-FileCopyrightText: or an affiliate of Infineon Technologies AG. All rights reserved.
#
# SPDX-License-Identifier: Apache-2.0

config BOARD_CY8CPROTO_041TP
	select SOC_CY8C4147AZQ_T495
```

## boards/infineon/cy8cproto_062_4343w/Kconfig
```kconfig
# Copyright The Zephyr Project Contributors
# SPDX-License-Identifier: Apache-2.0

config HEAP_MEM_POOL_ADD_SIZE_BOARD
	int
	default 15000 if WIFI
	default 4096
```

## boards/infineon/cy8cproto_062s2_43439/Kconfig
```kconfig
# SPDX-FileCopyrightText: Copyright (c) 2026 Infineon Technologies AG,
# SPDX-FileCopyrightText: or an affiliate of Infineon Technologies AG. All rights reserved.
#
# SPDX-License-Identifier: Apache-2.0

config HEAP_MEM_POOL_ADD_SIZE_BOARD
	int
	default 15000 if WIFI
	default 4096
```

## boards/infineon/cy8cproto_062s2_43439/Kconfig.defconfig
```kconfig
# SPDX-FileCopyrightText: Copyright (c) 2026 Infineon Technologies AG,
# SPDX-FileCopyrightText: or an affiliate of Infineon Technologies AG. All rights reserved.
#
# SPDX-License-Identifier: Apache-2.0

# CY8CPROTO-062S2-43439 PSOC™ 6 Wi-Fi BT Prototyping Kit configuration

if BOARD_CY8CPROTO_062S2_43439

if WIFI || BT

# Select AIROC part and module
choice AIROC_PART
	default CYW43439
endchoice

choice CYW43439_MODULE
	default CYW43439_MURATA_1YN
endchoice

endif # WIFI || BT

if WIFI

# Enable L2 Ethernet
configdefault NET_L2_ETHERNET
	default y

endif # WIFI

# Heap Pool Size
config HEAP_MEM_POOL_ADD_SIZE_BOARD
	int
	default 15000 if WIFI
	default 4096

endif   # BOARD_CY8CPROTO_062S2_43439
```

## boards/infineon/cy8cproto_062s2_43439/board.yml
```yaml
# SPDX-FileCopyrightText: Copyright (c) 2026 Infineon Technologies AG,
# SPDX-FileCopyrightText: or an affiliate of Infineon Technologies AG. All rights reserved.
#
# SPDX-License-Identifier: Apache-2.0

board:
  name: cy8cproto_062s2_43439
  full_name: CY8CPROTO-062S2-43439
  vendor: infineon
  socs:
  - name: cy8c624abzi_s2d44
```

## boards/infineon/cyw920829m2evk_02/Kconfig
```kconfig
# Copyright The Zephyr Project Contributors
# SPDX-License-Identifier: Apache-2.0

config HEAP_MEM_POOL_ADD_SIZE_BOARD
	int
	default 10096
```

## boards/infineon/cyw920829m2evk_02/board.yml
```yaml
# SPDX-FileCopyrightText: Copyright (c) 2026 Infineon Technologies AG,
# SPDX-FileCopyrightText: or an affiliate of Infineon Technologies AG. All rights reserved.
#
# SPDX-License-Identifier: Apache-2.0

board:
  name: cyw920829m2evk_02
  full_name: CYW920829M2EVK-02
  vendor: infineon
  socs:
    - name: cyw20829b0lkml
    - name: cyw20829b1010
    - name: cyw20829b1340
```

## boards/infineon/kit_a2g_tc375_lite/Kconfig.defconfig
```kconfig
# SPDX-FileCopyrightText: Copyright (c) 2024 Infineon Technologies AG,
# SPDX-FileCopyrightText: or an affiliate of Infineon Technologies AG. All rights reserved.
# SPDX-FileCopyrightText: Copyright (c) 2026 Linumiz
#
# SPDX-License-Identifier: Apache-2.0

if BOARD_KIT_A2G_TC375_LITE

# fSTM = fPLL0 300 MHz / 3, see the ccu node
config SYS_CLOCK_HW_CYCLES_PER_SEC
	default 100000000

endif
```

## boards/infineon/kit_a2g_tc375_lite/Kconfig.kit_a2g_tc375_lite
```kconfig
# SPDX-FileCopyrightText: Copyright (c) 2024 Infineon Technologies AG,
# SPDX-FileCopyrightText: or an affiliate of Infineon Technologies AG. All rights reserved.
# SPDX-FileCopyrightText: Copyright (c) 2026 Linumiz
#
# SPDX-License-Identifier: Apache-2.0

config BOARD_KIT_A2G_TC375_LITE
	select SOC_TC375TP_CPU0 if BOARD_KIT_A2G_TC375_LITE_TC375TP_CPU0
```

## boards/infineon/kit_a2g_tc375_lite/board.yml
```yaml
# SPDX-FileCopyrightText: Copyright (c) 2024 Infineon Technologies AG,
# SPDX-FileCopyrightText: or an affiliate of Infineon Technologies AG. All rights reserved.
# SPDX-FileCopyrightText: Copyright (c) 2026 Linumiz
#
# SPDX-License-Identifier: Apache-2.0

board:
  name: kit_a2g_tc375_lite
  full_name: AURIX TC375 lite kit
  vendor: infineon
  socs:
    - name: tc375tp
```

## boards/infineon/kit_a3g_tc4d7_lite/Kconfig.defconfig
```kconfig
# SPDX-FileCopyrightText: Copyright (c) 2024 Infineon Technologies AG,
# SPDX-FileCopyrightText: or an affiliate of Infineon Technologies AG. All rights reserved.
# SPDX-FileCopyrightText: Copyright (c) 2026 Linumiz
#
# SPDX-License-Identifier: Apache-2.0

if BOARD_KIT_A3G_TC4D7_LITE

# fSTM = fPLL0 500 MHz, see the ccu node
config SYS_CLOCK_HW_CYCLES_PER_SEC
	default 500000000

endif
```

## boards/infineon/kit_a3g_tc4d7_lite/Kconfig.kit_a3g_tc4d7_lite
```kconfig
# SPDX-FileCopyrightText: Copyright (c) 2025 Infineon Technologies AG,
# SPDX-FileCopyrightText: or an affiliate of Infineon Technologies AG. All rights reserved.
# SPDX-FileCopyrightText: Copyright (c) 2026 Linumiz
#
# SPDX-License-Identifier: Apache-2.0

config BOARD_KIT_A3G_TC4D7_LITE
	select SOC_TC4D7XP_CPU0 if BOARD_KIT_A3G_TC4D7_LITE_TC4D7XP_CPU0
```
