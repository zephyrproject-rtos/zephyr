## boards/infineon/kit_a3g_tc4d7_lite/board.yml
```yaml
# SPDX-FileCopyrightText: Copyright (c) 2024 Infineon Technologies AG,
# SPDX-FileCopyrightText: or an affiliate of Infineon Technologies AG. All rights reserved.
# SPDX-FileCopyrightText: Copyright (c) 2026 Linumiz
#
# SPDX-License-Identifier: Apache-2.0

board:
  name: kit_a3g_tc4d7_lite
  full_name: AURIX TC4D7 lite kit
  vendor: infineon
  socs:
    - name: tc4d7xp
```

## boards/infineon/kit_a3g_tc4d7_lite/kit_a3g_tc4d7_lite_tc4d7xp_cpu0_defconfig
```kconfig
# SPDX-FileCopyrightText: Copyright (c) 2024 Infineon Technologies AG,
# SPDX-FileCopyrightText: or an affiliate of Infineon Technologies AG. All rights reserved.
# SPDX-FileCopyrightText: Copyright (c) 2026 Linumiz
#
# SPDX-License-Identifier: Apache-2.0

CONFIG_CONSOLE=y
CONFIG_SERIAL=y
CONFIG_UART_CONSOLE=y
CONFIG_USE_DT_CODE_PARTITION=y
```

## boards/infineon/kit_psc3m5_cc2/board.yml
```yaml
board:
  name: kit_psc3m5_cc2
  full_name: PSOC™ Control C3M5 Connectivity Card 2
  vendor: infineon
  socs:
  - name: psc3m5fds2afq1
```

## boards/infineon/kit_psc3m5_evk/Kconfig.defconfig
```kconfig
# SPDX-FileCopyrightText: Copyright (c) 2026 Infineon Technologies AG,
# SPDX-FileCopyrightText: or an affiliate of Infineon Technologies AG. All rights reserved.
#
# SPDX-License-Identifier: Apache-2.0

if BOARD_KIT_PSC3M5_EVK

config ARM_MPU
	default y

config HW_STACK_PROTECTION
	default y

config GPIO
	default y

config CLOCK_CONTROL
	default y

config CONSOLE
	default y

config UART_CONSOLE
	default y

config SERIAL
	default y

endif # BOARD_KIT_PSC3M5_EVK

if BOOTLOADER_MCUBOOT

config ROM_START_OFFSET
	default 0x400

endif
```

## boards/infineon/kit_psc3m5_evk/kit_psc3m5_evk_defconfig
```kconfig
# SPDX-FileCopyrightText: Copyright (c) 2026 Infineon Technologies AG,
# SPDX-FileCopyrightText: or an affiliate of Infineon Technologies AG. All rights reserved.
#
# SPDX-License-Identifier: Apache-2.0

CONFIG_TRUSTED_EXECUTION_SECURE=y
CONFIG_ARM_TRUSTZONE_M=y
```

## boards/infineon/kit_psc3m6_eval/Kconfig.defconfig
```kconfig
# SPDX-FileCopyrightText: Copyright (c) 2026 Infineon Technologies AG,
# SPDX-FileCopyrightText: or an affiliate of Infineon Technologies AG. All rights reserved.
#
# SPDX-License-Identifier: Apache-2.0

if BOARD_KIT_PSC3M6_EVAL

configdefault ARM_MPU
	default y

configdefault HW_STACK_PROTECTION
	default y

configdefault GPIO
	default y

configdefault CLOCK_CONTROL
	default y

configdefault CONSOLE
	default y

configdefault UART_CONSOLE
	default y

configdefault SERIAL
	default y

endif # BOARD_KIT_PSC3M6_EVAL
```

## boards/infineon/kit_psc3m6_eval/Kconfig.sysbuild
```kconfig
# SPDX-FileCopyrightText: Copyright (c) 2026 Infineon Technologies AG,
# SPDX-FileCopyrightText: or an affiliate of Infineon Technologies AG. All rights reserved.
#
# SPDX-License-Identifier: Apache-2.0

if BOOTLOADER_MCUBOOT

choice MCUBOOT_MODE
	default MCUBOOT_MODE_OVERWRITE_ONLY
endchoice

endif # BOOTLOADER_MCUBOOT
```

## boards/infineon/kit_psc3m6_evk/Kconfig.defconfig
```kconfig
# SPDX-FileCopyrightText: Copyright (c) 2026 Infineon Technologies AG,
# SPDX-FileCopyrightText: or an affiliate of Infineon Technologies AG. All rights reserved.
#
# SPDX-License-Identifier: Apache-2.0

if BOARD_KIT_PSC3M6_EVK

config ROM_START_OFFSET
	default 0x400 if BOOTLOADER_MCUBOOT

endif # BOARD_KIT_PSC3M6_EVK
```

## boards/infineon/kit_psc3m6_evk/board.yml
```yaml
# SPDX-FileCopyrightText: Copyright (c) 2026 Infineon Technologies AG,
# SPDX-FileCopyrightText: or an affiliate of Infineon Technologies AG. All rights reserved.
#
# SPDX-License-Identifier: Apache-2.0

board:
  name: kit_psc3m6_evk
  full_name: PSOC™ Control C3M6 Evaluation Kit
  vendor: infineon
  socs:
  - name: psc3m6ges3ahq1
    variants:
    - name: 'ns'
```

## boards/infineon/kit_psc3m6_evk/kit_psc3m6_evk_defconfig
```kconfig
# SPDX-FileCopyrightText: Copyright (c) 2026 Infineon Technologies AG,
# SPDX-FileCopyrightText: or an affiliate of Infineon Technologies AG. All rights reserved.
#
# SPDX-License-Identifier: Apache-2.0

# General configuration
CONFIG_ARM_MPU=y
CONFIG_HW_STACK_PROTECTION=y
CONFIG_TRUSTED_EXECUTION_SECURE=y

# Enable GPIO driver
CONFIG_GPIO=y

# Enable clock controller
CONFIG_CLOCK_CONTROL=y

# Enable console
CONFIG_CONSOLE=y
CONFIG_UART_CONSOLE=y

# Enable UART driver
CONFIG_SERIAL=y

CONFIG_ARM_TRUSTZONE_M=y
```

## boards/infineon/kit_psc3m8_evk/board.yml
```yaml
# SPDX-FileCopyrightText: Copyright (c) 2026 Infineon Technologies AG,
# SPDX-FileCopyrightText: or an affiliate of Infineon Technologies AG. All rights reserved.
#
# SPDX-License-Identifier: Apache-2.0

board:
  name: kit_psc3m8_evk
  full_name: PSOC™ Control C3M8 Evaluation Kit
  vendor: infineon
  socs:
  - name: psc3m8gfs3pahq1
```

## boards/infineon/kit_pse84_ai/Kconfig
```kconfig
# Copyright The Zephyr Project Contributors
# SPDX-License-Identifier: Apache-2.0

if WIFI

config HEAP_MEM_POOL_ADD_SIZE_BOARD
	int
	default 15000

endif # WIFI
```

## boards/infineon/kit_pse84_eval/board.yml
```yaml
# SPDX-FileCopyrightText: Copyright (c) 2026 Infineon Technologies AG,
# SPDX-FileCopyrightText: or an affiliate of Infineon Technologies AG. All rights reserved.
#
# SPDX-License-Identifier: Apache-2.0

board:
  name: kit_pse84_eval
  full_name: PSOC™ Edge E84 Evaluation Kit
  vendor: infineon
  socs:
  - name: pse846gps2dbzc4a
    variants:
    - name: eth
      cpucluster: m33
    - name: eth
      cpucluster: m55
    - name: ns
      cpucluster: m33
      variants:
      - name: eth
        cpucluster: m33
```

## boards/infineon/kit_pse84_hmi/board.yml
```yaml
# SPDX-FileCopyrightText: Copyright (c) 2026 Infineon Technologies AG,
# SPDX-FileCopyrightText: or an affiliate of Infineon Technologies AG. All rights reserved.
#
# SPDX-License-Identifier: Apache-2.0

board:
  name: kit_pse84_hmi
  full_name: PSOC™ Edge E84 HMI Kit
  vendor: infineon
  socs:
  - name: pse846gps2dbzc4a
```

## boards/infineon/kit_psoc4_hvms_128k_lite/Kconfig.kit_psoc4_hvms_128k_lite
```kconfig
# SPDX-FileCopyrightText: Copyright (c) 2026 Infineon Technologies AG,
# SPDX-FileCopyrightText: or an affiliate of Infineon Technologies AG. All rights reserved.
#
# SPDX-License-Identifier: Apache-2.0

config BOARD_KIT_PSOC4_HVMS_128K_LITE
	select SOC_CY8C4147LWE_HVS135X
```

## boards/infineon/kit_psoc4_hvms_128k_lite/board.yml
```yaml
# SPDX-FileCopyrightText: Copyright (c) 2026 Infineon Technologies AG,
# SPDX-FileCopyrightText: or an affiliate of Infineon Technologies AG. All rights reserved.
#
# SPDX-License-Identifier: Apache-2.0

board:
  name: kit_psoc4_hvms_128k_lite
  full_name: PSOC™ 4 HVMS 128K Lite Kit
  vendor: infineon
  socs:
  - name: cy8c4147lwe_hvs135x
```

## boards/infineon/kit_psoc4_hvms_64k_lite/Kconfig.kit_psoc4_hvms_64k_lite
```kconfig
# SPDX-FileCopyrightText: Copyright (c) 2026 Infineon Technologies AG,
# SPDX-FileCopyrightText: or an affiliate of Infineon Technologies AG. All rights reserved.
#
# SPDX-License-Identifier: Apache-2.0

config BOARD_KIT_PSOC4_HVMS_64K_LITE
	select SOC_CY8C4146LWE_HVS115X
```

## boards/infineon/kit_psoc4_hvms_64k_lite/board.yml
```yaml
# SPDX-FileCopyrightText: Copyright (c) 2026 Infineon Technologies AG,
# SPDX-FileCopyrightText: or an affiliate of Infineon Technologies AG. All rights reserved.
#
# SPDX-License-Identifier: Apache-2.0

board:
  name: kit_psoc4_hvms_64k_lite
  full_name: PSOC™ 4 HVMS 64K Lite Kit
  vendor: infineon
  socs:
  - name: cy8c4146lwe_hvs115x
```

## boards/infineon/kit_psoc4_hvpa_144k_lite/board.yml
```yaml
# SPDX-FileCopyrightText: Copyright (c) 2026 Infineon Technologies AG,
# SPDX-FileCopyrightText: or an affiliate of Infineon Technologies AG. All rights reserved.
#
# SPDX-License-Identifier: Apache-2.0

board:
  name: kit_psoc4_hvpa_144k_lite
  full_name: PSOC™ 4 HVPA 144K Lite Kit
  vendor: infineon
  socs:
  - name: cy8c4147lce_hv423
```
