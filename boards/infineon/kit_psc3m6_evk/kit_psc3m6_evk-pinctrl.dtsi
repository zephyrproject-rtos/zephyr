/*
 * SPDX-FileCopyrightText: Copyright (c) 2026 Infineon Technologies AG,
 * SPDX-FileCopyrightText: or an affiliate of Infineon Technologies AG. All rights reserved.
 *
 * SPDX-License-Identifier: Apache-2.0
 */

/* Debug UART (SCB3) pin drive modes */
&p6_3_scb3_uart_tx {
	drive-push-pull;
};

&p6_2_scb3_uart_rx {
	input-enable;
};

/* User UART (SCB4) pin drive modes */
&p3_3_scb4_uart_tx {
	drive-push-pull;
};

&p3_2_scb4_uart_rx {
	input-enable;
};
