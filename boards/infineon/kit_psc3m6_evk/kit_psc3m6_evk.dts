/*
 * SPDX-FileCopyrightText: Copyright (c) 2026 Infineon Technologies AG,
 * SPDX-FileCopyrightText: or an affiliate of Infineon Technologies AG. All rights reserved.
 *
 * SPDX-License-Identifier: Apache-2.0
 */

/dts-v1/;
#include <arm/infineon/cat1b/mpns/psc3m6ges3ahq1_s.dtsi>
#include <arm/infineon/cat1b/psc3/psc3m6/system_clocks.dtsi>
#include "kit_psc3m6_evk_partition_512k.dtsi"
#include "kit_psc3m6_evk-common.dtsi"
#include "kit_psc3m6_evk-pinctrl.dtsi"

/ {
	chosen {
		zephyr,sram = &sram0;
		zephyr,flash = &flash0;
		zephyr,flash-controller = &flash_controller;
		zephyr,code-partition = &slot0_partition;
		zephyr,console = &uart3;
		zephyr,shell-uart = &uart3;
		zephyr,canbus = &can1;
	};
};

&flash_controller {
	status = "okay";
};
