/*
 * Copyright (c) 2026 Infineon Technologies AG.
 * SPDX-License-Identifier: Apache-2.0
 */

#include <zephyr/dt-bindings/gpio/gpio.h>
#include "cyw55513_evk_memory_map.dtsi"
#include "cyw55513_evk-common.dtsi"

/ {
	chosen {
		zephyr,sram = &sram0;
		zephyr,flash = &flash0;
		zephyr,code-partition = &slot0_partition;
	};
};
