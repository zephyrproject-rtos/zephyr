## boards/infineon/cyw55513_evk/Kconfig.cyw55513_evk
```kconfig
# AIROC CYW55513 Evaluation Kit

# Copyright (c) 2026 Infineon Technologies AG.
# SPDX-License-Identifier: Apache-2.0

config BOARD_CYW55513_EVK
	bool "AIROC CYW55513 Evaluation Kit"
	select SOC_CYW20829B0LKML
```

## boards/infineon/cyw55513_evk/Kconfig.defconfig
```kconfig
# AIROC CYW55513 Evaluation Kit

# Copyright (c) 2026 Infineon Technologies AG.
# SPDX-License-Identifier: Apache-2.0

if BOARD_CYW55513_EVK

if WIFI

# Enable L2 Ethernet for Wi-Fi connectivity
config NET_L2_ETHERNET
	default y

# Heap Pool Size
config HEAP_MEM_POOL_ADD_SIZE_BOARD
	int
	default 10000

endif # WIFI

if BT

# Heap Pool Size for Bluetooth
config HEAP_MEM_POOL_ADD_SIZE_BOARD
	int
	default 5000

endif # BT

endif # BOARD_CYW55513_EVK
```

## boards/infineon/cyw55513_evk/board.yml
```yaml
# Copyright (c) 2026 Infineon Technologies AG.
# SPDX-License-Identifier: Apache-2.0

board:
  name: cyw55513_evk
  full_name: AIROC CYW55513 Evaluation Kit
  vendor: infineon
  socs:
    - name: cyw20829b0lkml
```

## boards/infineon/cyw55513_evk/cyw55513_evk_cyw20829b0lkml_defconfig
```kconfig
# AIROC CYW55513 Evaluation Kit with CYW20829B0LKML
# Copyright (c) 2026 Infineon Technologies AG.
# SPDX-License-Identifier: Apache-2.0

# Enable console
CONFIG_CONSOLE=y
CONFIG_UART_CONSOLE=y

# Enable UART driver
CONFIG_SERIAL=y

# Enable GPIO driver
CONFIG_GPIO=y

# Enable clock control
CONFIG_CLOCK_CONTROL=y
```

## boards/infineon/cyw55513_evk/cyw55513_evk_cyw55513_murata_2fy_defconfig
```kconfig
# AIROC CYW55513 Evaluation Kit - Murata Type 2FY
# Copyright (c) 2026 Infineon Technologies AG.
# SPDX-License-Identifier: Apache-2.0

CONFIG_BOARD_CYW55513_EVK=y
CONFIG_BOARD_CYW55513_EVK_CYW55513_MURATA_2FY=y
CONFIG_SOC_CYW55513_MURATA_2FY=y
```

## boards/infineon/cyw920829m2evk_02/Kconfig.cyw920829m2evk_02
```kconfig
# ==================================================================================================
# Copyright (c) 2025 Cypress Semiconductor Corporation (an Infineon company) or
# an affiliate of Cypress Semiconductor Corporation
#
# SPDX-License-Identifier: Apache-2.0
# ==================================================================================================

# The Infineon AIROC™ CYW20829 Bluetooth® LE evaluation kit (CYW92089M2EVK-02)

config BOARD_CYW920829M2EVK_02
	select SOC_CYW20829B0LKML
```

## boards/infineon/cyw920829m2evk_02/cyw920829m2evk_02_cyw20829b0lkml_defconfig
```kconfig
# Copyright (c) 2025 Infineon Technologies AG,
# or an affiliate of Infineon Technologies AG.
#
# SPDX-License-Identifier: Apache-2.0

# General configuration
CONFIG_ARM_MPU=y
CONFIG_HW_STACK_PROTECTION=y

# MPU null-pointer detection not functional (flash at 0x8000000, not near address 0)
CONFIG_NULL_POINTER_EXCEPTION_DETECTION_NONE=y

# Enable console
CONFIG_CONSOLE=y
CONFIG_UART_CONSOLE=y

# Enable UART driver
CONFIG_SERIAL=y

# Enable GPIO driver
CONFIG_GPIO=y

# Enable clock controller
CONFIG_CLOCK_CONTROL=y

# Enable code/data relocation to move SMIF driver into RAM
CONFIG_CODE_DATA_RELOCATION=y
```

## boards/infineon/cyw920829m2evk_02/cyw920829m2evk_02_defconfig
```kconfig
#
# Copyright (c) 2024 Cypress Semiconductor Corporation.
# SPDX-License-Identifier: Apache-2.0
#

# General configuration
CONFIG_CORTEX_M_SYSTICK=y
CONFIG_BUILD_OUTPUT_HEX=y
CONFIG_BUILD_OUTPUT_BIN=y

CONFIG_ARM_MPU=y
CONFIG_HW_STACK_PROTECTION=y

# Enable console
CONFIG_CONSOLE=y
CONFIG_UART_CONSOLE=y

# Enable UART driver
CONFIG_SERIAL=y

# Enable clock controller
CONFIG_CLOCK_CONTROL=y

# Main Stack Size
CONFIG_MAIN_STACK_SIZE=2048

# Enable code/data relocation to move SMIF driver into RAM
CONFIG_CODE_DATA_RELOCATION=y
```

## boards/infineon/kit_a2g_tc375_lite/kit_a2g_tc375_lite_tc375tp_cpu0_defconfig
```kconfig
# Copyright 2024 Infineon Technologies AG
# SPDX-License-Identifier: Apache-2.0

CONFIG_SERIAL=y
CONFIG_GPIO=y
CONFIG_LED=y

CONFIG_CONSOLE=y
CONFIG_UART_CONSOLE=y
```

## boards/infineon/kit_a2g_tc397xa_3v3_tft/Kconfig.kit_a2g_tc397xa_3v3_tft
```kconfig
# Copyright 2024 Infineon Technologies AG
# SPDX-License-Identifier: Apache-2.0

config BOARD_KIT_A2G_TC397XA_3V3_TFT
	select SOC_TC397XA_CPU0 if BOARD_KIT_A2G_TC397XA_3V3_TFT_TC397XA_CPU0
```

## boards/infineon/kit_a2g_tc397xa_3v3_tft/board.yml
```yaml
# Copyright 2024 Infineon Technologies AG
# SPDX-License-Identifier: Apache-2.0

board:
  name: kit_a2g_tc397xa_3v3_tft
  full_name: Application Kit TC397 ADAS
  vendor: infineon
  revision:
    format: major.minor.patch
    default: "2.0.0"
    revisions:
      - name: "2.0.0"
  socs:
    - name: tc397xp
```

## boards/infineon/kit_a2g_tc397xa_3v3_tft/kit_a2g_tc397xa_3v3_tft_tc397xa_cpu0_defconfig
```kconfig
# Copyright 2024 Infineon Technologies AG
# SPDX-License-Identifier: Apache-2.0

CONFIG_GPIO=y
CONFIG_LED=y
CONFIG_SERIAL=y

CONFIG_CONSOLE=y
CONFIG_UART_CONSOLE=y
```

## boards/infineon/kit_psc3m5_evk/Kconfig.kit_psc3m5_evk
```kconfig
# The Infineon PSOC™ Control C3M5 Evaluation Kit (KIT_PSC3M5_EVK)

# Copyright (c) 2025 Cypress Semiconductor Corporation.
# SPDX-License-Identifier: Apache-2.0

config BOARD_KIT_PSC3M5_EVK
	select SOC_PSC3M5FDS2AFQ1
```

## boards/infineon/kit_psc3m5_evk/board.yml
```yaml
board:
  name: kit_psc3m5_evk
  full_name: PSOC Control C3M5 Evaluation Kit
  vendor: infineon
  socs:
  - name: psc3m5fds2afq1
    variants:
    - name: 'ns'
```

## boards/infineon/kit_psc3m5_evk/kit_psc3m5_evk_psc3m5fds2afq1_norflash_defconfig
```kconfig
# SPDX-FileCopyrightText: <text>Copyright (c) 2026 Infineon Technologies AG,
# or an affiliate of Infineon Technologies AG. All rights reserved.</text>
#
# SPDX-License-Identifier: Apache-2.0


CONFIG_TRUSTED_EXECUTION_SECURE=y
CONFIG_ARM_TRUSTZONE_M=y

# Enable SPI and NOR FLASH
CONFIG_SPI=y
CONFIG_SPI_NOR=y
```

## boards/infineon/kit_psc3m5_evk/kit_psc3m5_evk_psc3m5fds2afq1_ns_defconfig
```kconfig
#
# Copyright (c) 2025 Cypress Semiconductor Corporation.
# SPDX-License-Identifier: Apache-2.0
#

CONFIG_TRUSTED_EXECUTION_NONSECURE=y
```

## boards/infineon/kit_pse84_ai/Kconfig.defconfig
```kconfig
# SPDX-FileCopyrightText: <text>Copyright (c) 2026 Infineon Technologies AG,
# or an affiliate of Infineon Technologies AG. All rights reserved.</text>
#
# SPDX-License-Identifier: Apache-2.0

if BOARD_KIT_PSE84_AI_PSE846GPS2DBZC4A_M55

config CLOCK_CONTROL
	default y if !PSOC_EDGE_M55_SRF_SUPPORT

if BT

choice AIROC_PART
	default CYW55500
endchoice

choice CYW55500_MODULE
	default CYW55513_MURATA_2FY
endchoice

config MAIN_STACK_SIZE
	default 2048 if BT_HCI

endif # BT

if WIFI

# Select AIROC part and module
choice AIROC_PART
	default CYW55500
endchoice

choice CYW55500_MODULE
	default CYW55513_MURATA_2FY_SM
endchoice

# Heap Pool Size
config HEAP_MEM_POOL_ADD_SIZE_BOARD
	int
	default 15000

endif # WIFI

endif # BOARD_KIT_PSE84_AI_PSE846GPS2DBZC4A_M55

config FLASH_FILL_BUFFER_SIZE
	default 256 if FLASH

# The extended boot of PSE84 validates a 0x400-byte MCUBoot-format header
# at the start of the first image. ROM_START_OFFSET reserves space in the
# ELF for imgtool to write the header into during signing. TF-M also reserves
# the space at the beginning of the NSPE.
#
# In the sysbuild flow the CM33 image carries the ext-boot header and
# enables the CM55, so the CM55 image itself is not signed and needs no
# reserved header space.
config ROM_START_OFFSET
	default 0x0 if BOARD_KIT_PSE84_AI_PSE846GPS2DBZC4A_M55
	default 0x400
```

## boards/infineon/kit_pse84_ai/board.yml
```yaml
# SPDX-FileCopyrightText: <text>Copyright (c) 2026 Infineon Technologies AG,
# or an affiliate of Infineon Technologies AG. All rights reserved.</text>
#
# SPDX-License-Identifier: Apache-2.0

board:
  name: kit_pse84_ai
  full_name: PSOC™ Edge E84 AI Evaluation Kit
  vendor: infineon
  socs:
  - name: pse846gps2dbzc4a
```

## boards/infineon/kit_pse84_ai/kit_pse84_ai_m33_defconfig
```kconfig
# SPDX-FileCopyrightText: <text>Copyright (c) 2026 Infineon Technologies AG,
# or an affiliate of Infineon Technologies AG. All rights reserved.</text>
#
# SPDX-License-Identifier: Apache-2.0

# Enable FPU
CONFIG_FPU=y

# General configuration
CONFIG_CORTEX_M_SYSTICK=y
CONFIG_BUILD_OUTPUT_HEX=y

CONFIG_ARM_MPU=y
CONFIG_HW_STACK_PROTECTION=y

# Enable GPIO driver
CONFIG_GPIO=y

# Enable Clock Control driver
CONFIG_CLOCK_CONTROL=y

# Enable console
CONFIG_CONSOLE=y
CONFIG_UART_CONSOLE=y

# Enable UART driver
CONFIG_SERIAL=y

CONFIG_ARM_TRUSTZONE_M=y
CONFIG_ARM_MPU=y

# Build a Secure firmware image
CONFIG_TRUSTED_EXECUTION_SECURE=y

CONFIG_CODE_DATA_RELOCATION=y

CONFIG_USE_DT_CODE_PARTITION=y

# Enable MXCRYPTO TRNG entropy driver
CONFIG_ENTROPY_GENERATOR=y
CONFIG_ENTROPY_INFINEON_MXCRYPTO_TRNG=y

# Enable MXCRYPTO hardware crypto driver
CONFIG_CRYPTO=y
CONFIG_CRYPTO_INFINEON_MXCRYPTO=y
```

## boards/infineon/kit_pse84_ai/kit_pse84_ai_m55_defconfig
```kconfig
# SPDX-FileCopyrightText: <text>Copyright (c) 2026 Infineon Technologies AG,
# or an affiliate of Infineon Technologies AG. All rights reserved.</text>
#
# SPDX-License-Identifier: Apache-2.0

# Enable FPU
CONFIG_FPU=y

# General configuration
CONFIG_BUILD_OUTPUT_HEX=y

CONFIG_ARM_MPU=y
CONFIG_HW_STACK_PROTECTION=y

# Enable GPIO driver
CONFIG_GPIO=y

# Enable console
CONFIG_CONSOLE=y
CONFIG_UART_CONSOLE=y

# Enable UART driver
CONFIG_SERIAL=y

CONFIG_CODE_DATA_RELOCATION=y

CONFIG_USE_DT_CODE_PARTITION=y

# Enable MXCRYPTO TRNG entropy driver
CONFIG_ENTROPY_GENERATOR=y
CONFIG_ENTROPY_INFINEON_MXCRYPTO_TRNG=y

# Enable MXCRYPTO hardware crypto driver
CONFIG_CRYPTO=y
CONFIG_CRYPTO_INFINEON_MXCRYPTO=y
```

## boards/infineon/kit_pse84_eval/Kconfig.defconfig
```kconfig
# SPDX-FileCopyrightText: <text>Copyright (c) 2026 Infineon Technologies AG,
# or an affiliate of Infineon Technologies AG. All rights reserved.</text>
#
# SPDX-License-Identifier: Apache-2.0

if WIFI

# Select AIROC part and module
choice AIROC_PART
	default CYW55500
endchoice

choice CYW55500_MODULE
	default CYW55513IUBG_SM
endchoice

# Heap Pool Size
config HEAP_MEM_POOL_ADD_SIZE_BOARD
	int
	default 15000

endif # WIFI

if BT

# Select AIROC part and module
choice AIROC_PART
	default CYW55500
endchoice

choice CYW55500_MODULE
	default CYW55513IUBG_SM
endchoice

config MAIN_STACK_SIZE
	default 2048 if BT_HCI

endif # BT

if BOARD_KIT_PSE84_EVAL_PSE846GPS2DBZC4A_M55

config CLOCK_CONTROL
	default y if !PSOC_EDGE_M55_SRF_SUPPORT
endif

config FLASH_FILL_BUFFER_SIZE
	default 256 if FLASH

# The extended boot of PSE84 validates a 0x400-byte MCUBoot-format header
# at the start of the first image. ROM_START_OFFSET reserves space in the
# ELF for imgtool to write the header into during signing. TF-M also reserves
# the space at the beginning of the NSPE.
#
# Every image reserves this space except the CM55 application when it is not
# built as an MCUBoot slot (not chain-loaded by MCUBoot). In the sysbuild flow
# the CM33 image carries the ext-boot header and enables the CM55, so the CM55
# image itself is not signed and needs no reserved header space.
config ROM_START_OFFSET
	default 0x0 if BOARD_KIT_PSE84_EVAL_PSE846GPS2DBZC4A_M55 && !BOOTLOADER_MCUBOOT
	default 0x400
```

## boards/infineon/kit_pse84_eval/Kconfig.kit_pse84_eval
```kconfig
# SPDX-FileCopyrightText: <text>Copyright (c) 2026 Infineon Technologies AG,
# or an affiliate of Infineon Technologies AG. All rights reserved.</text>
#
# SPDX-License-Identifier: Apache-2.0

# PSOC E84 Configuration

config BOARD_KIT_PSE84_EVAL
	select SOC_PSE846GPS2DBZC4A_M33 if BOARD_KIT_PSE84_EVAL_PSE846GPS2DBZC4A_M33 ||	\
						BOARD_KIT_PSE84_EVAL_PSE846GPS2DBZC4A_M33_NS
	select SOC_PSE846GPS2DBZC4A_M55 if BOARD_KIT_PSE84_EVAL_PSE846GPS2DBZC4A_M55
```

## boards/infineon/kit_pse84_eval/kconfig.defconfig
```kconfig
# Copyright (c) 2025 Infineon Technologies AG,
# or an affiliate of Infineon Technologies AG.
#
# SPDX-License-Identifier: Apache-2.0

if BOARD_KIT_PSE84_EVAL_PSE846GPS2DBZC4A_M55

if WIFI

# Select AIROC part and module
choice AIROC_PART
	default CYW55500
endchoice

choice CYW55500_MODULE
	default CYW55513IUBG_SM
endchoice

# Enable L2 Ethernet
config NET_L2_ETHERNET
	default y

# Heap Pool Size
config HEAP_MEM_POOL_ADD_SIZE_BOARD
	int
	default 15000

endif # WIFI

endif # BOARD_KIT_PSE84_EVAL_PSE846GPS2DBZC4A_M55
```

## boards/infineon/kit_t2g_b_h_evk/Kconfig.kit_t2g_b_h_evk
```kconfig
# Copyright (c) 2025 Infineon Technologies AG,
# or an affiliate of Infineon Technologies AG.
#
# SPDX-License-Identifier: Apache-2.0

config BOARD_KIT_T2G_B_H_EVK
	select SOC_CYT4BFBCHE_M0PLUS if BOARD_KIT_T2G_B_H_EVK_CYT4BFBCHE_M0P
	select SOC_CYT4BFBCHE_M7_0 if BOARD_KIT_T2G_B_H_EVK_CYT4BFBCHE_M7_0
	select SOC_CYT4BFBCHE_M7_1 if BOARD_KIT_T2G_B_H_EVK_CYT4BFBCHE_M7_1
```

## boards/infineon/kit_t2g_b_h_evk/kit_t2g_b_h_evk_cyt4bfbche_m0p_defconfig
```kconfig
# SPDX-FileCopyrightText: <text>Copyright (c) 2026 Infineon Technologies AG,
# or an affiliate of Infineon Technologies AG. All rights reserved.</text>
#
# SPDX-License-Identifier: Apache-2.0

# General configuration
CONFIG_ARM_MPU=y
CONFIG_HW_STACK_PROTECTION=y

# Enable console
CONFIG_CONSOLE=y
CONFIG_UART_CONSOLE=y

# Enable UART driver
CONFIG_SERIAL=y

# Enable GPIO driver
CONFIG_GPIO=y

# Enable clock controller
CONFIG_CLOCK_CONTROL=y
```
