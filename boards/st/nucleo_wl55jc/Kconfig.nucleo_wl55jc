## boards/st/nucleo_wl55jc/Kconfig.nucleo_wl55jc
```kconfig
# Copyright (c) 2020 STMicroelectronics
# SPDX-License-Identifier: Apache-2.0

config BOARD_NUCLEO_WL55JC
	select SOC_STM32WL55XX
```

## boards/st/nucleo_wl55jc/board.yml
```yaml
board:
  name: nucleo_wl55jc
  full_name: Nucleo WL55JC
  vendor: st
  socs:
    - name: stm32wl55xx
```

## boards/st/sensortile_box/Kconfig.sensortile_box
```kconfig
# Copyright (c) 2019 STMicroelectronics
# SPDX-License-Identifier: Apache-2.0

config BOARD_SENSORTILE_BOX
	select SOC_STM32L4R9XX
```

## boards/st/sensortile_box/board.yml
```yaml
board:
  name: sensortile_box
  full_name: SensorTile.box
  vendor: st
  socs:
    - name: stm32l4r9xx
```

## boards/st/sensortile_box_pro/Kconfig
```kconfig
# SENSORTILE_BOX_PRO board configuration

# Copyright (c) 2024 STMicroelectronics
# SPDX-License-Identifier: Apache-2.0

if BOARD_SENSORTILE_BOX_PRO

config BOARD_SERIAL_BACKEND_CDC_ACM
	bool "Use USB CDC as serial console backend"
	default y

endif # BOARD_SENSORTILE_BOX_PRO
```

## boards/st/sensortile_box_pro/Kconfig.sensortile_box_pro
```kconfig
# Copyright (c) 2023 STMicroelectronics
# SPDX-License-Identifier: Apache-2.0

config BOARD_SENSORTILE_BOX_PRO
	select SOC_STM32U585XX
```

## boards/st/sensortile_box_pro/board.yml
```yaml
board:
  name: sensortile_box_pro
  full_name: SensorTile.box PRO
  vendor: st
  socs:
    - name: stm32u585xx
```

## boards/st/sensortile_box_pro/sensortile_box_pro_defconfig
```kconfig
# SPDX-License-Identifier: Apache-2.0

# Enable MPU
CONFIG_ARM_MPU=y

# Enable hardware stack protection
CONFIG_HW_STACK_PROTECTION=y

# enable GPIO
CONFIG_GPIO=y

# Enable console
CONFIG_SERIAL=y
CONFIG_CONSOLE=y
```

## boards/st/st25dv_mb1283_disco/Kconfig.defconfig
```kconfig
# ST25DV DISCOVERY board configuration

# Copyright (c) 2024 Eve Redero
# SPDX-License-Identifier: Apache-2.0

if BOARD_ST25DV_MB1283_DISCO

config SPI_STM32_INTERRUPT
	default y
	depends on SPI

endif # BOARD_ST25DV_MB1283_DISCO
```

## boards/st/st25dv_mb1283_disco/Kconfig.st25dv_mb1283_disco
```kconfig
# ST25DV DISCOVERY board configuration

# Copyright (c) 2024 Eve Redero
# SPDX-License-Identifier: Apache-2.0

config BOARD_ST25DV_MB1283_DISCO
	select SOC_STM32F405XX
```

## boards/st/st25dv_mb1283_disco/board.yml
```yaml
board:
  name: st25dv_mb1283_disco
  full_name: ST25DV Discovery, MB1283 version
  vendor: st
  socs:
    - name: stm32f405xx
```

## boards/st/steval_fcu001v1/Kconfig.steval_fcu001v1
```kconfig
# Copyright (c) 2019 Linumiz
# SPDX-License-Identifier: Apache-2.0

config BOARD_STEVAL_FCU001V1
	select SOC_STM32F401XC
```

## boards/st/steval_fcu001v1/board.yml
```yaml
board:
  name: steval_fcu001v1
  full_name: STM32 Flight Controller Unit
  vendor: st
  socs:
    - name: stm32f401xc
```

## boards/st/steval_fcu001v1/steval_fcu001v1_defconfig
```kconfig
# SPDX-License-Identifier: Apache-2.0

# Enable MPU
CONFIG_ARM_MPU=y

CONFIG_SERIAL=y

# console
CONFIG_CONSOLE=y
CONFIG_UART_CONSOLE=y

# enable GPIO
CONFIG_GPIO=y
```

## boards/st/steval_stwinbx1/Kconfig
```kconfig
# STEVAL_STWINBX1 Development kit board configuration

# Copyright (c) 2024 STMicroelectronics
# SPDX-License-Identifier: Apache-2.0

if BOARD_STEVAL_STWINBX1

config BOARD_SERIAL_BACKEND_CDC_ACM
	bool "Use USB CDC as serial console backend"
	default y

endif # BOARD_STEVAL_STWINBX1
```

## boards/st/steval_stwinbx1/Kconfig.defconfig
```kconfig
# STEVAL_STWINBX1 Development kit board configuration

# Copyright (c) 2024 STMicroelectronics
# SPDX-License-Identifier: Apache-2.0

if BOARD_STEVAL_STWINBX1

if BT

config BT_BLUENRG_ACI
	default y

# Disable Flow control
config BT_HCI_ACL_FLOW_CONTROL
	default n

endif # BT

config SPI_STM32_INTERRUPT
	default y
	depends on SPI

source "boards/common/usb/Kconfig.cdc_acm_serial.defconfig"

endif # BOARD_STEVAL_STWINBX1
```

## boards/st/steval_stwinbx1/Kconfig.steval_stwinbx1
```kconfig
# Copyright (c) 2024 STMicroelectronics
# SPDX-License-Identifier: Apache-2.0

config BOARD_STEVAL_STWINBX1
	select SOC_STM32U585XX
```

## boards/st/steval_stwinbx1/board.yml
```yaml
board:
  name: steval_stwinbx1
  full_name: STEVAL STWINBX1 Development kit
  vendor: st
  socs:
    - name: stm32u585xx
```

## boards/st/steval_stwinbx1/steval_stwinbx1_defconfig
```kconfig
# SPDX-License-Identifier: Apache-2.0

# Enable MPU
CONFIG_ARM_MPU=y

# Enable hardware stack protection
CONFIG_HW_STACK_PROTECTION=y

# enable GPIO
CONFIG_GPIO=y
CONFIG_GPIO_HOGS=y

# Enable Clocks
CONFIG_CLOCK_CONTROL=y

# Enable console
CONFIG_SERIAL=y
CONFIG_CONSOLE=y

# enable pin controller
CONFIG_PINCTRL=y
```

## boards/st/stm3210c_eval/Kconfig.stm3210c_eval
```kconfig
# Copyright (c) 2016 RnDity Sp. z o.o.
# SPDX-License-Identifier: Apache-2.0

config BOARD_STM3210C_EVAL
	select SOC_STM32F107XC
```

## boards/st/stm3210c_eval/board.yml
```yaml
board:
  name: stm3210c_eval
  full_name: STM3210C Evaluation
  vendor: st
  socs:
    - name: stm32f107xc
```

## boards/st/stm3210c_eval/stm3210c_eval_defconfig
```kconfig
# SPDX-License-Identifier: Apache-2.0

# Serial Drivers
CONFIG_SERIAL=y
CONFIG_UART_INTERRUPT_DRIVEN=y
# enable console
CONFIG_CONSOLE=y
CONFIG_UART_CONSOLE=y

# RCC Controller
CONFIG_CLOCK_CONTROL=y
```

## boards/st/stm32373c_eval/Kconfig.stm32373c_eval
```kconfig
# Copyright (c) 2016 Open-RnD Sp. z o.o.
# SPDX-License-Identifier: Apache-2.0

config BOARD_STM32373C_EVAL
	select SOC_STM32F373XC
```

## boards/st/stm32373c_eval/board.yml
```yaml
board:
  name: stm32373c_eval
  full_name: STM32373C Evaluation
  vendor: st
  socs:
    - name: stm32f373xc
```

## boards/st/stm32c0116_dk/Kconfig.stm32c0116_dk
```kconfig
# Copyright (c) 2024 Kickmaker
# SPDX-License-Identifier: Apache-2.0

config BOARD_STM32C0116_DK
	select SOC_STM32C011XX
```
