/*
 * SPDX-License-Identifier: Apache-2.0
 *
 * Copyright (c) 2025 STMicroelectronics
 */

/ {
	dma_test_gpdma1: dma-test-gpdma1 {
		compatible = "test-dma-memory-to-memory";
		dma = <&gpdma1>;
	};
};

&gpdma1 {
	status = "okay";
};
