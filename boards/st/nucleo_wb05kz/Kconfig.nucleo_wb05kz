## boards/st/nucleo_wb05kz/Kconfig.nucleo_wb05kz
```kconfig
# Copyright (c) 2024 STMicroelectronics
# SPDX-License-Identifier: Apache-2.0

config BOARD_NUCLEO_WB05KZ
	select SOC_STM32WB05XX
```

## boards/st/nucleo_wb05kz/board.yml
```yaml
board:
  name: nucleo_wb05kz
  full_name: Nucleo WB05KZ
  vendor: st
  socs:
    - name: stm32wb05
```

## boards/st/nucleo_wb07cc/Kconfig.nucleo_wb07cc
```kconfig
# Copyright (c) 2025 STMicroelectronics
# SPDX-License-Identifier: Apache-2.0

config BOARD_NUCLEO_WB07CC
	select SOC_STM32WB07XX
```

## boards/st/nucleo_wb07cc/board.yml
```yaml
board:
  name: nucleo_wb07cc
  full_name: Nucleo WB07CC
  vendor: st
  socs:
    - name: stm32wb07
```

## boards/st/nucleo_wb09ke/Kconfig.nucleo_wb09ke
```kconfig
# Copyright (c) 2024 STMicroelectronics
# SPDX-License-Identifier: Apache-2.0

config BOARD_NUCLEO_WB09KE
	select SOC_STM32WB09XX
```

## boards/st/nucleo_wb09ke/board.yml
```yaml
board:
  name: nucleo_wb09ke
  full_name: Nucleo WB09KE
  vendor: st
  socs:
    - name: stm32wb09
```

## boards/st/nucleo_wb55rg/Kconfig.defconfig
```kconfig
# STM32WB55RG Nucleo board configuration

# Copyright (c) 2019 Linaro Limited
# SPDX-License-Identifier: Apache-2.0

if BOARD_NUCLEO_WB55RG

config BT_STM32_IPM
	default y
	depends on BT

endif
```

## boards/st/nucleo_wb55rg/Kconfig.nucleo_wb55rg
```kconfig
# Copyright (c) 2019 Linaro Limited
# SPDX-License-Identifier: Apache-2.0

config BOARD_NUCLEO_WB55RG
	select SOC_STM32WB55XX
```

## boards/st/nucleo_wb55rg/board.yml
```yaml
board:
  name: nucleo_wb55rg
  full_name: Nucleo WB55RG
  vendor: st
  socs:
    - name: stm32wb55xx
```

## boards/st/nucleo_wba25ce1/Kconfig.defconfig
```kconfig
# STM32WBA25CE1 Nucleo board configuration

# Copyright (c) 2026 STMicroelectronics

# SPDX-License-Identifier: Apache-2.0

if BOARD_NUCLEO_WBA25CE1

configdefault SPI_STM32_INTERRUPT
	default y

endif # BOARD_NUCLEO_WBA25CE1
```

## boards/st/nucleo_wba25ce1/Kconfig.nucleo_wba25ce1
```kconfig
# Copyright (c) 2026 STMicroelectronics
# SPDX-License-Identifier: Apache-2.0

config BOARD_NUCLEO_WBA25CE1
	select SOC_STM32WBA25XX
```

## boards/st/nucleo_wba25ce1/board.yml
```yaml
board:
  name: nucleo_wba25ce1
  full_name: Nucleo WBA25CE1
  vendor: st
  socs:
    - name: stm32wba25xx
```

## boards/st/nucleo_wba52cg/Kconfig.defconfig
```kconfig
# STM32WBA52CG Nucleo board configuration

# Copyright (c) 2023 STMicroelectronics

# SPDX-License-Identifier: Apache-2.0

if BOARD_NUCLEO_WBA52CG

config SPI_STM32_INTERRUPT
	default y
	depends on SPI

endif # BOARD_NUCLEO_WBA52CG
```

## boards/st/nucleo_wba52cg/board.yml
```yaml
board:
  name: nucleo_wba52cg
  full_name: Nucleo WBA52CG
  vendor: st
  socs:
    - name: stm32wba52xx
```

## boards/st/nucleo_wba55cg/Kconfig
```kconfig
# Copyright (c) 2025 STMicroelectronics
# SPDX-License-Identifier: Apache-2.0

config BOARD_NUCLEO_WBA55CG
	select BOARD_EARLY_INIT_HOOK
```

## boards/st/nucleo_wba55cg/Kconfig.nucleo_wba55cg
```kconfig
# Copyright (c) 2023 STMicroelectronics
# SPDX-License-Identifier: Apache-2.0

config BOARD_NUCLEO_WBA55CG
	select SOC_STM32WBA55XX
```

## boards/st/nucleo_wba55cg/board.yml
```yaml
board:
  name: nucleo_wba55cg
  full_name: Nucleo WBA55CG
  vendor: st
  socs:
    - name: stm32wba55xx
```

## boards/st/nucleo_wba55cg/nucleo_wba55cg_defconfig
```kconfig
# SPDX-License-Identifier: Apache-2.0
# Copyright (c) 2023 STMicroelectronics

# enable uart driver
CONFIG_SERIAL=y

# enable GPIO
CONFIG_GPIO=y

# console
CONFIG_CONSOLE=y
CONFIG_UART_CONSOLE=y

# Enable MPU
CONFIG_ARM_MPU=y

# Enable HW stack protection
CONFIG_HW_STACK_PROTECTION=y

# Enable the internal SMPS regulator
CONFIG_POWER_SUPPLY_DIRECT_SMPS=y
```

## boards/st/nucleo_wba65ri/Kconfig.defconfig
```kconfig
# STM32WBA65RI Nucleo board configuration

# Copyright (c) 2025 STMicroelectronics

# SPDX-License-Identifier: Apache-2.0

if BOARD_NUCLEO_WBA65RI

config SPI_STM32_INTERRUPT
	default y
	depends on SPI

endif # BOARD_NUCLEO_WBA65RI
```

## boards/st/nucleo_wba65ri/Kconfig.nucleo_wba65ri
```kconfig
# Copyright (c) 2025 STMicroelectronics
# SPDX-License-Identifier: Apache-2.0

config BOARD_NUCLEO_WBA65RI
	select SOC_STM32WBA65XX
```

## boards/st/nucleo_wba65ri/board.yml
```yaml
board:
  name: nucleo_wba65ri
  full_name: Nucleo WBA65RI
  vendor: st
  socs:
    - name: stm32wba65xx
```

## boards/st/nucleo_wba65ri/nucleo_wba65ri_defconfig
```kconfig
# SPDX-License-Identifier: Apache-2.0
# Copyright (c) 2025 STMicroelectronics

# Enable UART driver
CONFIG_SERIAL=y

# Enable GPIO
CONFIG_GPIO=y

# Enable clock
CONFIG_CLOCK_CONTROL=y

# Console
CONFIG_CONSOLE=y
CONFIG_UART_CONSOLE=y

# Enable MPU
CONFIG_ARM_MPU=y

# Enable HW stack protection
CONFIG_HW_STACK_PROTECTION=y

# Enable the internal SMPS regulator
CONFIG_POWER_SUPPLY_DIRECT_SMPS=y
```

## boards/st/nucleo_wba65ri/nucleo_wba65ri_stm32wba65xx_ns_defconfig
```kconfig
# SPDX-License-Identifier: Apache-2.0
# Copyright (c) 2025 STMicroelectronics

# Enable UART driver
CONFIG_SERIAL=y

# Enable GPIO
CONFIG_GPIO=y

# Console
CONFIG_CONSOLE=y
CONFIG_UART_CONSOLE=y

# Enable MPU
CONFIG_ARM_MPU=y

# Enable HW stack protection
CONFIG_HW_STACK_PROTECTION=y

# Enable the internal SMPS regulator
CONFIG_POWER_SUPPLY_DIRECT_SMPS=y

# Enable TZ non-secure configuration
CONFIG_ARM_TRUSTZONE_M=y
CONFIG_RUNTIME_NMI=y
CONFIG_TRUSTED_EXECUTION_NONSECURE=y
CONFIG_BUILD_WITH_TFM=y
CONFIG_TFM_BL2=n
```

## boards/st/nucleo_wl33cc1/Kconfig.nucleo_wl33cc1
```kconfig
# Copyright (c) 2026 Anders Frandsen <anfran@anfran.dk>
# SPDX-License-Identifier: Apache-2.0

config BOARD_NUCLEO_WL33CC1
	select SOC_STM32WL33XX
```

## boards/st/nucleo_wl33cc1/nucleo_wl33cc1_defconfig
```kconfig
# SPDX-License-Identifier: Apache-2.0

# Enable GPIO
CONFIG_GPIO=y

# Enable UART driver + console
CONFIG_SERIAL=y
CONFIG_CONSOLE=y
CONFIG_UART_CONSOLE=y
```
