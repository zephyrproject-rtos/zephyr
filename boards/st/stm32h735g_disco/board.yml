## boards/st/stm32h735g_disco/board.yml
```yaml
board:
  name: stm32h735g_disco
  full_name: STM32H735G Discovery
  vendor: st
  socs:
    - name: stm32h735xx
```

## boards/st/stm32h735g_disco/stm32h735g_disco_defconfig
```kconfig
# SPDX-License-Identifier: Apache-2.0
# Copyright (c) 2021 SILA Embedded Solutions GmbH

# Enable the internal SMPS regulator
CONFIG_POWER_SUPPLY_DIRECT_SMPS=y

# Enable MPU
CONFIG_ARM_MPU=y

# Enable HW stack protection
CONFIG_HW_STACK_PROTECTION=y

CONFIG_SERIAL=y

# Console
CONFIG_CONSOLE=y
CONFIG_UART_CONSOLE=y

# Enable GPIO
CONFIG_GPIO=y
```

## boards/st/stm32h745i_disco/Kconfig.defconfig
```kconfig
# STM32H745XI DISCOVERY board configuration

# Copyright (c) 2020 Alexander Kozhinov <ak.alexander.kozhinov@gmail.com>
# Copyright (c) 2024 Tomas Jurena <jurena@utb.cz>
# SPDX-License-Identifier: Apache-2.0

if BOARD_STM32H745I_DISCO

configdefault NET_L2_ETHERNET
	default y

config MEMC
	default y if DISPLAY


endif # BOARD_STM32H745I_DISCO
```

## boards/st/stm32h745i_disco/Kconfig.stm32h745i_disco
```kconfig
# STM32H745XI DISCOVERY board configuration

# Copyright (c) 2020 Alexander Kozhinov <ak.alexander.kozhinov@gmail.com>
# Copyright (c) 2024 Tomas Jurena <jurena@utb.cz>
# SPDX-License-Identifier: Apache-2.0

config BOARD_STM32H745I_DISCO
	select SOC_STM32H745XX_M7 if BOARD_STM32H745I_DISCO_STM32H745XX_M7
	select SOC_STM32H745XX_M4 if BOARD_STM32H745I_DISCO_STM32H745XX_M4
```

## boards/st/stm32h745i_disco/board.yml
```yaml
board:
  name: stm32h745i_disco
  full_name: STM32H745I Discovery
  vendor: st
  socs:
    - name: stm32h745xx
```

## boards/st/stm32h745i_disco/stm32h745i_disco_stm32h745xx_m4_defconfig
```kconfig
# SPDX-License-Identifier: Apache-2.0
# Copyright (c) 2020 Alexander Kozhinov <AlexanderKozhinov@yandex.com>
# Copyright (c) 2024 Tomas Jurena <jurena@utb.cz>

# Enable GPIO
CONFIG_GPIO=y

# By default SERIAL peripherals are assigned to m7

# Enable uart driver
#CONFIG_SERIAL=y

# Console
#CONFIG_CONSOLE=y
#CONFIG_UART_CONSOLE=y
```

## boards/st/stm32h747i_disco/Kconfig.defconfig
```kconfig
# STM32H747I DISCOVERY board configuration

# Copyright (c) 2019 Linaro Limited
# SPDX-License-Identifier: Apache-2.0

if BOARD_STM32H747I_DISCO

configdefault NET_L2_ETHERNET
	default y

endif # BOARD_STM32H747I_DISCO
```

## boards/st/stm32h747i_disco/Kconfig.stm32h747i_disco
```kconfig
# STM32H747I DISCOVERY board configuration

# Copyright (c) 2019 Linaro Limited
# SPDX-License-Identifier: Apache-2.0

config BOARD_STM32H747I_DISCO
	select SOC_STM32H747XX_M7 if BOARD_STM32H747I_DISCO_STM32H747XX_M7
	select SOC_STM32H747XX_M4 if BOARD_STM32H747I_DISCO_STM32H747XX_M4
```

## boards/st/stm32h747i_disco/board.yml
```yaml
board:
  name: stm32h747i_disco
  full_name: STM32H747I Discovery
  vendor: st
  socs:
    - name: stm32h747xx
```

## boards/st/stm32h747i_disco/stm32h747i_disco_stm32h747xx_m4_defconfig
```kconfig
# SPDX-License-Identifier: Apache-2.0
# Copyright (c) 2019 STMicroelectronics

# Enable GPIO
CONFIG_GPIO=y

# Enable MPU
CONFIG_ARM_MPU=y

# Enable HW stack protection
CONFIG_HW_STACK_PROTECTION=y

# Enable UART driver
CONFIG_SERIAL=y

# By default CONSOLE is assigned to m7
#CONFIG_CONSOLE=y
#CONFIG_UART_CONSOLE=y
```

## boards/st/stm32h747i_disco/stm32h747i_disco_stm32h747xx_m7_defconfig
```kconfig
# SPDX-License-Identifier: Apache-2.0
# Copyright (c) 2019 STMicroelectronics

# Enable the internal SMPS regulator
CONFIG_POWER_SUPPLY_DIRECT_SMPS=y

# Enable GPIO
CONFIG_GPIO=y

# Enable clocks
CONFIG_CLOCK_CONTROL=y

# Enable MPU
CONFIG_ARM_MPU=y

# Enable HW stack protection
CONFIG_HW_STACK_PROTECTION=y

# Disable following to assign serial ports to m4 core

# Enable uart driver
CONFIG_SERIAL=y
# Console
CONFIG_CONSOLE=y
CONFIG_UART_CONSOLE=y

# Enable pin controller
CONFIG_PINCTRL=y
```

## boards/st/stm32h750b_dk/Kconfig.defconfig
```kconfig
# STM32H750B DISCOVERY board configuration

# Copyright (c) 2024 STMicroelectronics
# SPDX-License-Identifier: Apache-2.0

if BOARD_STM32H750B_DK

# MEMC needs to be enabled in order to store
# LTDC framebuffer to external SDRAM connected to FMC
config MEMC
	default y if STM32_LTDC

endif # BOARD_STM32H750B_DK
```

## boards/st/stm32h750b_dk/Kconfig.stm32h750b_dk
```kconfig
# Copyright (c) 2023 STMicroelectronics
# SPDX-License-Identifier: Apache-2.0

config BOARD_STM32H750B_DK
	select SOC_STM32H750XX

if DISPLAY

# MEMC needs to be enabled in order to store
# display buffer to external SDRAM connected to FMC
config MEMC
	default y

endif # DISPLAY
```

## boards/st/stm32h750b_dk/Kconfig.sysbuild
```kconfig
# SPDX-FileCopyrightText: Copyright The Zephyr Project Contributors
# SPDX-License-Identifier: Apache-2.0

if BOARD_STM32H750B_DK_STM32H750XX_EXT_FLASH_APP

choice BOOTLOADER
	default BOOTLOADER_MCUBOOT
endchoice

choice BOOT_SIGNATURE_TYPE
	default BOOT_SIGNATURE_TYPE_NONE
endchoice

choice MCUBOOT_MODE
	default MCUBOOT_MODE_SWAP_USING_OFFSET
endchoice

endif # BOARD_STM32H750B_DK_STM32H750XX_EXT_FLASH_APP
```

## boards/st/stm32h750b_dk/board.yml
```yaml
board:
  name: stm32h750b_dk
  full_name: STM32H750B Discovery Kit
  vendor: st
  socs:
    - name: stm32h750xx
```

## boards/st/stm32h750b_dk/stm32h750b_dk_defconfig
```kconfig
# Copyright (c) 2023 STMicroelectronics
# SPDX-License-Identifier: Apache-2.0

# Enable the internal SMPS regulator
CONFIG_POWER_SUPPLY_LDO=y

# Enable MPU
CONFIG_ARM_MPU=y

# Enable HW stack protection
CONFIG_HW_STACK_PROTECTION=y

CONFIG_SERIAL=y

# console
CONFIG_CONSOLE=y
CONFIG_UART_CONSOLE=y

# enable GPIO
CONFIG_GPIO=y
```

## boards/st/stm32h757i_eval/Kconfig.defconfig
```kconfig
# STM32H757I EVAL board configuration

# Copyright (c) 2019 Linaro Limited
# Copyright (c) 2025 Foss Analytical A/S
# SPDX-License-Identifier: Apache-2.0

if BOARD_STM32H757I_EVAL

if NETWORKING

config NET_L2_ETHERNET
	default y

endif # NETWORKING

config DISK_DRIVER_SDMMC
	default y if DISK_DRIVERS

endif # BOARD_STM32H757I_EVAL
```

## boards/st/stm32h757i_eval/Kconfig.stm32h757i_eval
```kconfig
# STM32H757I EVAL board configuration

# Copyright (c) 2019 Linaro Limited
# Copyright (c) 2025 Foss Analytical A/S
# SPDX-License-Identifier: Apache-2.0

config BOARD_STM32H757I_EVAL
	select SOC_STM32H757XX_M7 if BOARD_STM32H757I_EVAL_STM32H757XX_M7
	select SOC_STM32H757XX_M4 if BOARD_STM32H757I_EVAL_STM32H757XX_M4
```

## boards/st/stm32h757i_eval/board.yml
```yaml
board:
  name: stm32h757i_eval
  full_name: STM32H757I Eval
  vendor: st
  socs:
    - name: stm32h757xx
```

## boards/st/stm32h757i_eval/stm32h757i_eval_stm32h757xx_m7_defconfig
```kconfig
# SPDX-License-Identifier: Apache-2.0
# Copyright (c) 2019 STMicroelectronics
# Copyright (c) 2025 Foss Analytical A/S

# Enable the internal SMPS regulator
CONFIG_POWER_SUPPLY_DIRECT_SMPS=y

# Enable GPIO
CONFIG_GPIO=y

# Enable MPU
CONFIG_ARM_MPU=y

# Enable HW stack protection
CONFIG_HW_STACK_PROTECTION=y

# Disable following to assign serial ports to m4 core

# Enable uart driver
CONFIG_SERIAL=y
# Console
CONFIG_CONSOLE=y
CONFIG_UART_CONSOLE=y
```

## boards/st/stm32h7b3i_dk/Kconfig.defconfig
```kconfig
# STM32H7B3I DISCOVERY KIT board configuration

# Copyright (c) 2022 Byte-Lab d.o.o. <dev@byte-lab.com>
# Copyright (c) 2024 Charles Dias <charlesdias.cd@outlook.com>
# SPDX-License-Identifier: Apache-2.0

if BOARD_STM32H7B3I_DK

config INPUT
	default y if LVGL

# MEMC needs to be enabled in order to store
# display buffer to external SDRAM connected to FMC
config MEMC
	default y if DISPLAY

if LVGL

config LV_USE_DRAW_DMA2D
	default y

config STM32_LTDC_FB_NUM
	default 2

config LV_Z_VDB_SIZE
	default 100

config LV_Z_DOUBLE_VDB
	default y

config LV_Z_FULL_REFRESH
	default y

config LV_Z_VDB_CUSTOM_SECTION
	default y

config LV_Z_FLUSH_THREAD
	default y

config LV_Z_BITS_PER_PIXEL
	default 16 if STM32_LTDC_RGB565

endif # LVGL

endif # BOARD_STM32H7B3I_DK
```

## boards/st/stm32h7b3i_dk/Kconfig.stm32h7b3i_dk
```kconfig
# Copyright (c) 2022 Byte-Lab d.o.o. <dev@byte-lab.com>
# SPDX-License-Identifier: Apache-2.0

config BOARD_STM32H7B3I_DK
	select SOC_STM32H7B3XXQ
```

## boards/st/stm32h7b3i_dk/board.yml
```yaml
board:
  name: stm32h7b3i_dk
  full_name: STM32H7B3I Discovery kit
  vendor: st
  socs:
    - name: stm32h7b3xx
```

## boards/st/stm32h7b3i_dk/stm32h7b3i_dk_defconfig
```kconfig
# Copyright (c) 2022 Byte-Lab d.o.o. <dev@byte-lab.com>
# SPDX-License-Identifier: Apache-2.0

# Set SoC present on the board
# Enable MPU
CONFIG_ARM_MPU=y

# Enable HW stack protection
CONFIG_HW_STACK_PROTECTION=y

# Enable serial
CONFIG_SERIAL=y

# Enable console
CONFIG_CONSOLE=y
CONFIG_UART_CONSOLE=y

# Enable GPIO
CONFIG_GPIO=y

# Enable SMPS
CONFIG_POWER_SUPPLY_DIRECT_SMPS=y
```

## boards/st/stm32h7s78_dk/Kconfig.stm32h7s78_dk
```kconfig
# STM32H7S78-DK Discovery kit board configuration
#
# Copyright (c) 2024 STMicroelectronics
#
# SPDX-License-Identifier: Apache-2.0
#

config BOARD_STM32H7S78_DK
	select SOC_STM32H7S7XX
```
