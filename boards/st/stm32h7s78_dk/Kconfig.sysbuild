## boards/st/stm32h7s78_dk/Kconfig.sysbuild
```kconfig
# Copyright (c) 2024-2025 STMicroelectronics
# SPDX-License-Identifier: Apache-2.0

if BOARD_STM32H7S78_DK_STM32H7S7XX_EXT_FLASH_APP

choice BOOTLOADER
	default BOOTLOADER_MCUBOOT
endchoice

choice BOOT_SIGNATURE_TYPE
	default BOOT_SIGNATURE_TYPE_NONE
endchoice

choice MCUBOOT_MODE
	default MCUBOOT_MODE_SINGLE_APP
endchoice

endif # BOARD_STM32H7S78_DK_STM32H7S7XX_EXT_FLASH_APP
```

## boards/st/stm32h7s78_dk/board.yml
```yaml
board:
  name: stm32h7s78_dk
  full_name: STM32H7S78-DK Discovery
  vendor: st
  socs:
    - name: stm32h7s7xx
```

## boards/st/stm32h7s78_dk/stm32h7s78_dk_defconfig
```kconfig
# Copyright (c) 2024 STMicroelectronics
# SPDX-License-Identifier: Apache-2.0

# Enable SMPS
CONFIG_POWER_SUPPLY_DIRECT_SMPS=y

# Enable MPU
CONFIG_ARM_MPU=y

# Enable HW stack protection
CONFIG_HW_STACK_PROTECTION=y

# enable uart driver
CONFIG_SERIAL=y
# enable console
CONFIG_CONSOLE=y
CONFIG_UART_CONSOLE=y

# enable GPIO
CONFIG_GPIO=y

# SRAM0 being small (128KB), SYS_HEAP_SMALL_ONLY
# is automatically selected, leading to not being
# able to tackle HEAP on the large PSRAM. Force it
# to AUTO in order to be able to handle HEAP on
# both SRAM and PSRAM
CONFIG_SYS_HEAP_AUTO=y
```

## boards/st/stm32l1_disco/Kconfig.stm32l152c_disco
```kconfig
# Copyright (c) 2024 Maxin John
# SPDX-License-Identifier: Apache-2.0

config BOARD_STM32L152C_DISCO
	select SOC_STM32L152XC
```

## boards/st/stm32l1_disco/Kconfig.stm32l1_disco
```kconfig
# Copyright (c) 2019 eTactica ehf
# SPDX-License-Identifier: Apache-2.0

config BOARD_STM32L1_DISCO
	select SOC_STM32L151XB
```

## boards/st/stm32l1_disco/board.yml
```yaml
boards:
  - name: stm32l1_disco
    full_name: STM32L1 Discovery
    vendor: st
    socs:
      - name: stm32l151xb
  - name: stm32l152c_disco
    full_name: STM32L152C Discovery
    vendor: st
    socs:
      - name: stm32l152xc
```

## boards/st/stm32l1_disco/stm32l1_disco_defconfig
```kconfig
# SPDX-License-Identifier: Apache-2.0

# enable uart driver
CONFIG_SERIAL=y

# enable console
CONFIG_CONSOLE=y
CONFIG_UART_CONSOLE=y

# enable GPIO
CONFIG_GPIO=y

# Enable Clocks
CONFIG_CLOCK_CONTROL=y

# enable pin controller
CONFIG_PINCTRL=y
```

## boards/st/stm32l476g_disco/Kconfig.stm32l476g_disco
```kconfig
# Copyright (c) 2017 Arthur Sfez
# SPDX-License-Identifier: Apache-2.0

config BOARD_STM32L476G_DISCO
	select SOC_STM32L476XX
```

## boards/st/stm32l476g_disco/board.yml
```yaml
board:
  name: stm32l476g_disco
  full_name: STM32L476G Discovery
  vendor: st
  socs:
    - name: stm32l476xx
```

## boards/st/stm32l496g_disco/Kconfig
```kconfig
# Copyright The Zephyr Project Contributors
# SPDX-License-Identifier: Apache-2.0

config BOARD_STM32L496G_DISCO
	select BOARD_LATE_INIT_HOOK if ADC
```

## boards/st/stm32l496g_disco/Kconfig.stm32l496g_disco
```kconfig
# Copyright (c) 2019 Centaur Analytics, Inc
# SPDX-License-Identifier: Apache-2.0

config BOARD_STM32L496G_DISCO
	select SOC_STM32L496XX
```

## boards/st/stm32l496g_disco/board.yml
```yaml
board:
  name: stm32l496g_disco
  full_name: STM32L496G Discovery
  vendor: st
  socs:
    - name: stm32l496xx
```

## boards/st/stm32l4r9i_disco/Kconfig.stm32l4r9i_disco
```kconfig
# Copyright (c) 2023 STMicroelectronics
# SPDX-License-Identifier: Apache-2.0

config BOARD_STM32L4R9I_DISCO
	select SOC_STM32L4R9XX
```

## boards/st/stm32l4r9i_disco/board.yml
```yaml
board:
  name: stm32l4r9i_disco
  full_name: STM32L4R9I Discovery
  vendor: st
  socs:
    - name: stm32l4r9xx
```

## boards/st/stm32l562e_dk/Kconfig.defconfig
```kconfig
# STM32L562E-DK Discovery board configuration

# Copyright (c) 2020 Yestin Sun
# SPDX-License-Identifier: Apache-2.0

if BOARD_STM32L562E_DK

if BT

config BT_BLUENRG_ACI
	default y

# Disable Flow control
config BT_HCI_ACL_FLOW_CONTROL
	default n

config BT_HCI_VS
	default n

endif # BT

config MIPI_DBI_STM32_FMC_MEM_BARRIER
	default n if MIPI_DBI_STM32_FMC

if DISPLAY

choice ST7789V_PIXEL_FORMAT
	default ST7789V_BGR565
endchoice

endif # DISPLAY

if BUILD_WITH_TFM

# Not defining LIBC malloc arena has the effect of declaring all available RAM
# as available for malloc.
# This currently conflicts with TF-M MPU setting, resulting in a hard fault.
# Define a specific size to avoid this situation.

config COMMON_LIBC_MALLOC_ARENA_SIZE
	default 2048

endif # BUILD_WITH_TFM

endif # BOARD_STM32L562E_DK
```

## boards/st/stm32l562e_dk/Kconfig.stm32l562e_dk
```kconfig
# Copyright (c) 2020 Yestin Sun
# SPDX-License-Identifier: Apache-2.0

config BOARD_STM32L562E_DK
	select SOC_STM32L562XX
```

## boards/st/stm32l562e_dk/board.yml
```yaml
board:
  name: stm32l562e_dk
  full_name: STM32L562E-DK Discovery
  vendor: st
  socs:
    - name: stm32l562xx
      variants:
        - name: ns
```

## boards/st/stm32l562e_dk/stm32l562e_dk_stm32l562xx_ns_defconfig
```kconfig
# SPDX-License-Identifier: Apache-2.0

# enable uart driver
CONFIG_SERIAL=y

# enable GPIO
CONFIG_GPIO=y

# console
CONFIG_CONSOLE=y
CONFIG_UART_CONSOLE=y

# Enable MPU
CONFIG_ARM_MPU=y

# Enable TZ non-secure configuration
CONFIG_TRUSTED_EXECUTION_NONSECURE=y
CONFIG_RUNTIME_NMI=y
```

## boards/st/stm32mp135f_dk/Kconfig.defconfig
```kconfig
# STM32MP135F DISCOVERY board configuration

# Copyright (c) 2025 STMicroelectronics
# SPDX-License-Identifier: Apache-2.0

if BOARD_STM32MP135F_DK

if GPIO_MCP230XX

config GPIO_MCP230XX_INIT_PRIORITY
	default I2C_INIT_PRIORITY

endif # GPIO_MCP230XX

configdefault NET_L2_ETHERNET
	default y

endif # BOARD_STM32MP135F_DK
```

## boards/st/stm32mp135f_dk/Kconfig.stm32mp135f_dk
```kconfig
# Copyright (c) 2025 STMicroelectronics
# SPDX-License-Identifier: Apache-2.0

config BOARD_STM32MP135F_DK
	select SOC_STM32MP135FXX
```

## boards/st/stm32mp135f_dk/board.yml
```yaml
board:
  name: stm32mp135f_dk
  full_name: STM32MP135F-DK Discovery
  vendor: st
  socs:
    - name: stm32mp135fxx
```

## boards/st/stm32mp157c_dk2/Kconfig.defconfig
```kconfig
# STM32MP157 discovery board configuration

# Copyright (c) 2019 STMicroelectronics
# SPDX-License-Identifier: Apache-2.0

if BOARD_STM32MP157C_DK2

config SPI_STM32_INTERRUPT
	default y
	depends on SPI

config CLOCK_STM32_HSE_CLOCK
	default 24000000

endif # BOARD_STM32MP157_Dk2
```

## boards/st/stm32mp157c_dk2/Kconfig.stm32mp157c_dk2
```kconfig
# Copyright (c) 2019 STMicroelectronics
# SPDX-License-Identifier: Apache-2.0

config BOARD_STM32MP157C_DK2
	select SOC_STM32MP15_M4
```

## boards/st/stm32mp157c_dk2/board.yml
```yaml
board:
  name: stm32mp157c_dk2
  full_name: STM32MP157C-DK2 Discovery
  vendor: st
  socs:
    - name: stm32mp157cxx
```

## boards/st/stm32mp157c_dk2/stm32mp157c_dk2_defconfig
```kconfig
# enable GPIO
CONFIG_GPIO=y

# Enable MPU
CONFIG_ARM_MPU=y

# Enable HW stack protection
CONFIG_HW_STACK_PROTECTION=y

# enable uart driver
CONFIG_SERIAL=y
CONFIG_UART_INTERRUPT_DRIVEN=y

# clock configuration
CONFIG_CLOCK_CONTROL=y

# console (remote proc console by default)
CONFIG_CONSOLE=y
CONFIG_RAM_CONSOLE=y
CONFIG_RAM_CONSOLE_BUFFER_SIZE=1024

# uart console (overrides remote proc console)
CONFIG_UART_CONSOLE=n

# enable pin controller
CONFIG_PINCTRL=y
```
