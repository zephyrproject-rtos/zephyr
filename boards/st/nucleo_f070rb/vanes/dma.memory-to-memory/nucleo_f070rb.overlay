/*
 * SPDX-License-Identifier: Apache-2.0
 *
 * Copyright (c) 2023 STMicroelectronics
 */

/ {
	dma_test_dma1: dma-test-dma1 {
		compatible = "test-dma-memory-to-memory";
		dma = <&dma1>;
		channels = <1 2>;
	};
};

&dma1 {
	status = "okay";
};
