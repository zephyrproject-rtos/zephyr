## boards/st/nucleo_h503rb/Kconfig.nucleo_h503rb
```kconfig
# Copyright (c) 2024 Arrow Electronics.
# SPDX-License-Identifier: Apache-2.0

config BOARD_NUCLEO_H503RB
	select SOC_STM32H503XX
```

## boards/st/nucleo_h503rb/board.yml
```yaml
# Copyright (c) 2024 Arrow Electronics.
# SPDX-License-Identifier: Apache-2.0

board:
  name: nucleo_h503rb
  full_name: Nucleo H503RB
  vendor: st
  socs:
    - name: stm32h503xx
```

## boards/st/nucleo_h533re/Kconfig.nucleo_h533re
```kconfig
# Copyright (c) 2024 STMicroelectronics
# SPDX-License-Identifier: Apache-2.0

config BOARD_NUCLEO_H533RE
	select SOC_STM32H533XX
```

## boards/st/nucleo_h533re/board.yml
```yaml
board:
  name: nucleo_h533re
  full_name: Nucleo H533RE
  vendor: st
  socs:
    - name: stm32h533xx
```

## boards/st/nucleo_h533re/nucleo_h533re_defconfig
```kconfig
# SPDX-License-Identifier: Apache-2.0

# enable uart driver
CONFIG_SERIAL=y

# console
CONFIG_CONSOLE=y
CONFIG_UART_CONSOLE=y

# Enable clock
CONFIG_CLOCK_CONTROL=y

# enable GPIO
CONFIG_GPIO=y
# enable pin controller
CONFIG_PINCTRL=y
```

## boards/st/nucleo_h563zi/Kconfig.defconfig
```kconfig
# STM32H563ZI Nucleo board configuration

# Copyright (c) 2023 Thomas Stranger
# SPDX-License-Identifier: Apache-2.0

if BOARD_NUCLEO_H563ZI

configdefault NET_L2_ETHERNET
	default y

endif # BOARD_NUCLEO_H563ZI
```

## boards/st/nucleo_h563zi/Kconfig.nucleo_h563zi
```kconfig
# Copyright (c) 2023 Thomas Stranger
# SPDX-License-Identifier: Apache-2.0

config BOARD_NUCLEO_H563ZI
	select SOC_STM32H563XX
```

## boards/st/nucleo_h563zi/board.yml
```yaml
board:
  name: nucleo_h563zi
  full_name: Nucleo H563ZI
  vendor: st
  socs:
    - name: stm32h563xx
```

## boards/st/nucleo_h563zi/nucleo_h563zi_defconfig
```kconfig
# SPDX-License-Identifier: Apache-2.0

# enable uart driver
CONFIG_SERIAL=y

# console
CONFIG_CONSOLE=y
CONFIG_UART_CONSOLE=y

# Enable clock
CONFIG_CLOCK_CONTROL=y

# Enable MPU
CONFIG_ARM_MPU=y

# Enable HW stack protection
CONFIG_HW_STACK_PROTECTION=y

# enable GPIO
CONFIG_GPIO=y
# enable pin controller
CONFIG_PINCTRL=y
```

## boards/st/nucleo_h723zg/Kconfig.defconfig
```kconfig
# STM32H723ZG Nucleo board configuration

# Copyright (c) 2020 Alexander Kozhinov <ak.alexander.kozhinov@gmail.com>
# SPDX-License-Identifier: Apache-2.0

if BOARD_NUCLEO_H723ZG

configdefault NET_L2_ETHERNET
	default y

endif # BOARD_NUCLEO_H723ZG
```

## boards/st/nucleo_h723zg/Kconfig.nucleo_h723zg
```kconfig
# Copyright (c) 2020 Alexander Kozhinov <ak.alexander.kozhinov@gmail.com>
# SPDX-License-Identifier: Apache-2.0

config BOARD_NUCLEO_H723ZG
	select SOC_STM32H723XX
```

## boards/st/nucleo_h723zg/board.yml
```yaml
board:
  name: nucleo_h723zg
  full_name: Nucleo H723ZG
  vendor: st
  socs:
    - name: stm32h723xx
```

## boards/st/nucleo_h743zi/Kconfig.defconfig
```kconfig
# STM32H743ZI Nucleo board configuration

# Copyright (c) 2020 Teslabs Engineering S.L.
# SPDX-License-Identifier: Apache-2.0

if BOARD_NUCLEO_H743ZI

configdefault NET_L2_ETHERNET
	default y

endif # BOARD_NUCLEO_H743ZI
```

## boards/st/nucleo_h743zi/Kconfig.nucleo_h743zi
```kconfig
# Copyright (c) 2020 Teslabs Engineering S.L.
# SPDX-License-Identifier: Apache-2.0

config BOARD_NUCLEO_H743ZI
	select SOC_STM32H743XX
```

## boards/st/nucleo_h743zi/board.yml
```yaml
board:
  name: nucleo_h743zi
  full_name: Nucleo H743ZI
  vendor: st
  socs:
    - name: stm32h743xx
```

## boards/st/nucleo_h745zi_q/Kconfig.nucleo_h745zi_q
```kconfig
# STM32H745ZI Nucleo board configuration

# Copyright (c) 2020 Alexander Kozhinov <AlexanderKozhinov@yandex.com>
# SPDX-License-Identifier: Apache-2.0

config BOARD_NUCLEO_H745ZI_Q
	select SOC_STM32H745XX_M7 if BOARD_NUCLEO_H745ZI_Q_STM32H745XX_M7
	select SOC_STM32H745XX_M4 if BOARD_NUCLEO_H745ZI_Q_STM32H745XX_M4
```

## boards/st/nucleo_h745zi_q/board.yml
```yaml
board:
  name: nucleo_h745zi_q
  full_name: Nucleo H745ZI-Q
  vendor: st
  socs:
    - name: stm32h745xx
```

## boards/st/nucleo_h745zi_q/nucleo_h745zi_q_stm32h745xx_m4_defconfig
```kconfig
# SPDX-License-Identifier: Apache-2.0
# Copyright (c) 2020 Alexander Kozhinov <ak.alexander.kozhinov@gmail.com>

# Enable GPIO
CONFIG_GPIO=y

# By default SERIAL peripherals are assigned to m7

# Enable uart driver
#CONFIG_SERIAL=y

# Console
#CONFIG_CONSOLE=y
#CONFIG_UART_CONSOLE=y
```

## boards/st/nucleo_h745zi_q/nucleo_h745zi_q_stm32h745xx_m7_defconfig
```kconfig
# SPDX-License-Identifier: Apache-2.0
# Copyright (c) 2020 Alexander Kozhinov <ak.alexander.kozhinov@gmail.com>

# Enable MPU
CONFIG_ARM_MPU=y

# Enable HW stack protection
CONFIG_HW_STACK_PROTECTION=y

# Enable UART ( disable to assign to M4 core)
CONFIG_SERIAL=y

# Console ( disable to assign to M4 core)
CONFIG_CONSOLE=y
CONFIG_UART_CONSOLE=y

# Enable GPIO
CONFIG_GPIO=y
```

## boards/st/nucleo_h753zi/Kconfig.defconfig
```kconfig
# STM32H753ZI Nucleo board configuration

# Copyright (c) 2021 Blue Clover Devices
# SPDX-License-Identifier: Apache-2.0

if BOARD_NUCLEO_H753ZI

configdefault NET_L2_ETHERNET
	default y

endif # BOARD_NUCLEO_H753ZI
```

## boards/st/nucleo_h753zi/Kconfig.nucleo_h753zi
```kconfig
# Copyright (c) 2021 Blue Clover Devices
# SPDX-License-Identifier: Apache-2.0

config BOARD_NUCLEO_H753ZI
	select SOC_STM32H753XX
```

## boards/st/nucleo_h753zi/board.yml
```yaml
board:
  name: nucleo_h753zi
  full_name: Nucleo H753ZI
  vendor: st
  socs:
    - name: stm32h753xx
```

## boards/st/nucleo_h755zi_q/Kconfig.defconfig
```kconfig
# STM32H755ZI Nucleo board configuration

# Copyright (c) 2024 S&C Electric Company <Michael.Banducci@sandc.com>
# SPDX-License-Identifier: Apache-2.0

if BOARD_NUCLEO_H755ZI_Q

if NETWORKING

config NET_L2_ETHERNET
	default y

endif # NETWORKING

endif # BOARD_NUCLEO_H755ZI_Q
```

## boards/st/nucleo_h755zi_q/Kconfig.nucleo_h755zi_q
```kconfig
# STM32H755ZI Nucleo board configuration

# Copyright (c) 2024 S&C Electric Company <Michael.Banducci@sandc.com>
# SPDX-License-Identifier: Apache-2.0

config BOARD_NUCLEO_H755ZI_Q
	select SOC_STM32H755XX_M7 if BOARD_NUCLEO_H755ZI_Q_STM32H755XX_M7
	select SOC_STM32H755XX_M4 if BOARD_NUCLEO_H755ZI_Q_STM32H755XX_M4
```

## boards/st/nucleo_h755zi_q/board.yml
```yaml
board:
  name: nucleo_h755zi_q
  full_name: Nucleo H755ZI-Q
  vendor: st
  socs:
    - name: stm32h755xx
```
