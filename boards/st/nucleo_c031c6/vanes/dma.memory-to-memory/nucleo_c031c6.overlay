/*
 * Copyright (c) 2023 Benjamin Björnsson <benjamin.bjornsson@gmail.com>
 *
 * SPDX-License-Identifier: Apache-2.0
 */

/ {
	dma_test_dma1: dma-test-dma1 {
		compatible = "test-dma-memory-to-memory";
		dma = <&dma1>;
		channels = <1 2>;
	};
};

&dma1 {
	status = "okay";
};
