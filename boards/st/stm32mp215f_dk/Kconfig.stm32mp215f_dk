## boards/st/stm32mp215f_dk/Kconfig.stm32mp215f_dk
```kconfig
# Copyright (C) 2026 STMicroelectronics
# SPDX-License-Identifier: Apache-2.0

config BOARD_STM32MP215F_DK
	select SOC_STM32MP2X_M33 if BOARD_STM32MP215F_DK_STM32MP215FXX_M33
```

## boards/st/stm32mp215f_dk/board.yml
```yaml
board:
  name: stm32mp215f_dk
  full_name: STM32MP215F-DK Evaluation Board
  vendor: st
  socs:
    - name: stm32mp215fxx
```

## boards/st/stm32mp257f_dk/board.yml
```yaml
board:
  name: stm32mp257f_dk
  full_name: STM32MP257F-DK Discovery Kit
  vendor: st
  socs:
    - name: stm32mp257fxx
```

## boards/st/stm32mp257f_ev1/Kconfig.defconfig
```kconfig
# STM32MP257 evaluation board configuration

# Copyright (C) 2025 Savoir-faire Linux, Inc.
# SPDX-License-Identifier: Apache-2.0

if BOARD_STM32MP257F_EV1

config BOARD
        default "stm32mp257f_ev1"

endif # BOARD_STM32MP257F_EV1
```

## boards/st/stm32mp257f_ev1/Kconfig.stm32mp257f_ev1
```kconfig
# Copyright (C) 2025 Savoir-faire Linux, Inc.
# SPDX-License-Identifier: Apache-2.0

config BOARD_STM32MP257F_EV1
	select SOC_STM32MP2X_M33 if BOARD_STM32MP257F_EV1_STM32MP257FXX_M33
```

## boards/st/stm32mp257f_ev1/board.yml
```yaml
board:
  name: stm32mp257f_ev1
  full_name: STM32MP257F-EV1 Evaluation Board
  vendor: st
  socs:
    - name: stm32mp257fxx
```

## boards/st/stm32mp257f_ev1/stm32mp257f_ev1_stm32mp257fxx_m33_defconfig
```kconfig
# Copyright (C) 2025 Savoir-faire Linux, Inc.
# SPDX-License-Identifier: Apache-2.0

# Enable MPU
CONFIG_ARM_MPU=y

# Enable GPIO
CONFIG_GPIO=y

# Enable HW stack protection
CONFIG_HW_STACK_PROTECTION=y
```

## boards/st/stm32n6570_dk/Kconfig.defconfig
```kconfig
# STM32N6570 DISCOVERY board configuration

# Copyright (c) 2025 STMicroelectronics
# SPDX-License-Identifier: Apache-2.0

if BOARD_STM32N6570_DK

configdefault NET_L2_ETHERNET
	default y

configdefault OTP
	default y if ETH_STM32_HAL && NVMEM

# MEMC needs to be enabled in order to store
# LTDC frame buffer and video buffer pool to external PSRAM
config MEMC
	default y if STM32_LTDC || VIDEO

if DISPLAY
configdefault I2C_STM32_V2_TIMING
	default y if INPUT
endif # DISPLAY

if VIDEO
# Place video buffer pool into the PSRAM
config VIDEO_BUFFER_POOL_ZEPHYR_REGION
	default y

config VIDEO_BUFFER_POOL_ZEPHYR_REGION_NAME
	default "PSRAM"

# Place VENC internal buffer into the PSRAM
if VIDEO_STM32_VENC

choice VIDEO_STM32_VENC_MEM_ALLOC
	default VIDEO_STM32_VENC_HEAP_ALLOC
endchoice

config VIDEO_STM32_VENC_HEAP_ZEPHYR_REGION
	default y

config VIDEO_STM32_VENC_HEAP_ZEPHYR_REGION_NAME
	default "PSRAM"

endif # VIDEO_STM32_VENC
endif # VIDEO

# Enable Neochrom GPU2D graphic acceleration using nemaGFX

if LVGL

if NEOCHROM_GPU2D

configdefault LV_ATTRIBUTE_MEM_ALIGN_SIZE
	default 32 if NEOCHROM_GPU2D

configdefault LV_Z_NEMA_GFX_MULTI_THREAD
	default y if LV_USE_NEMA_GFX

choice LV_USE_NEMA_HAL
	default LV_NEMA_HAL_CUSTOM
endchoice

choice LV_USE_NEMA_LIB
	default LV_NEMA_LIB_M55
endchoice

configdefault LV_NEMA_USE_CACHE
	default y

configdefault LV_NEMA_CACHE_HAL_INCLUDE
	default "stm32n6xx_hal.h"

endif # NEOCHROM_GPU2D

endif # LVGL

endif # BOARD_STM32N6570_DK
```

## boards/st/stm32n6570_dk/Kconfig.stm32n6570_dk
```kconfig
# Copyright (c) 2024 STMicroelectronics
# SPDX-License-Identifier: Apache-2.0

config BOARD_STM32N6570_DK
	select SOC_STM32N657XX
```

## boards/st/stm32n6570_dk/Kconfig.sysbuild
```kconfig
# SPDX-License-Identifier: Apache-2.0
# Copyright (c) 2025 STMicroelectronics

if BOARD_STM32N6570_DK_STM32N657XX

choice BOOTLOADER
	default BOOTLOADER_MCUBOOT
endchoice

endif
```

## boards/st/stm32n6570_dk/board.yml
```yaml
board:
  name: stm32n6570_dk
  full_name: STM32N6570-DK
  vendor: st
  socs:
    - name: stm32n657xx
      variants:
        - name: sb
```

## boards/st/stm32n6570_dk/stm32n6570_dk_defconfig
```kconfig
# SPDX-License-Identifier: Apache-2.0
# Copyright (c) 2024 STMicroelectronics

# Enable UART driver
CONFIG_SERIAL=y

# Enable GPIO
CONFIG_GPIO=y

# Console
CONFIG_CONSOLE=y
CONFIG_UART_CONSOLE=y

# Enable MPU
CONFIG_ARM_MPU=y

# Enable HW stack protection
CONFIG_HW_STACK_PROTECTION=y

# No internal Flash
CONFIG_XIP=n
```

## boards/st/stm32n6570_dk/stm32n6570_dk_stm32n657xx_sb_defconfig
```kconfig
# SPDX-License-Identifier: Apache-2.0
# Copyright (c) 2024 STMicroelectronics

# Enable UART driver
CONFIG_SERIAL=y

# Enable GPIO
CONFIG_GPIO=y

# Console
CONFIG_CONSOLE=y
CONFIG_UART_CONSOLE=y

# Enable MPU
CONFIG_ARM_MPU=y

# Enable HW stack protection
CONFIG_HW_STACK_PROTECTION=y

# No internal Flash
CONFIG_XIP=n

# Use serial boot (USB)
CONFIG_STM32N6_BOOT_SERIAL=y

# Rely on Multi-Heap / Shared-Multi-Heap for PSRAM access
CONFIG_MULTI_HEAP=y
CONFIG_SHARED_MULTI_HEAP=y

# Let LTDC use memory allocated via SMH
CONFIG_STM32_LTDC_FB_USE_SHARED_MULTI_HEAP=y
CONFIG_STM32_LTDC_FB_SMH_ATTRIBUTE=2
CONFIG_STM32_LTDC_FB_SMH_ALIGN=256
```

## boards/st/stm32u083c_dk/Kconfig.stm32u083c_dk
```kconfig
# Copyright (c) 2024 STMicroelectronics
# SPDX-License-Identifier: Apache-2.0

config BOARD_STM32U083C_DK
	select SOC_STM32U083XX
```

## boards/st/stm32u083c_dk/board.yml
```yaml
board:
  name: stm32u083c_dk
  full_name: STM32U083C-DK
  vendor: st
  socs:
    - name: stm32u083xx
```

## boards/st/stm32u5a9j_dk/Kconfig.stm32u5a9j_dk
```kconfig
# Copyright (c) 2023 STMicroelectronics
# SPDX-License-Identifier: Apache-2.0

config BOARD_STM32U5A9J_DK
	select SOC_STM32U5A9XX
```

## boards/st/stm32u5a9j_dk/board.yml
```yaml
board:
  name: stm32u5a9j_dk
  full_name: STM32U5A9J Discovery Kit
  vendor: st
  socs:
    - name: stm32u5a9xx
```

## boards/st/stm32u5a9j_dk/stm32u5a9j_dk_defconfig
```kconfig
# Copyright (c) 2023 STMicroelectronics
# SPDX-License-Identifier: Apache-2.0

# Enable MPU
CONFIG_ARM_MPU=y

# Enable HW stack protection
CONFIG_HW_STACK_PROTECTION=y

# Enable serial
CONFIG_SERIAL=y

# Enable console
CONFIG_CONSOLE=y
CONFIG_UART_CONSOLE=y

# Enable GPIO
CONFIG_GPIO=y
```

## boards/st/stm32u5g9j_dk1/Kconfig.stm32u5g9j_dk1
```kconfig
# Copyright (c) 2025 Charles Dias
# SPDX-License-Identifier: Apache-2.0

config BOARD_STM32U5G9J_DK1
	select SOC_STM32U5G9XX
```

## boards/st/stm32u5g9j_dk1/board.yml
```yaml
board:
  name: stm32u5g9j_dk1
  full_name: STM32U5G9J Discovery Kit 1
  vendor: st
  socs:
    - name: stm32u5g9xx
```

## boards/st/stm32u5g9j_dk2/Kconfig.stm32u5g9j_dk2
```kconfig
# Copyright (c) 2025 STMicroelectronics
# SPDX-License-Identifier: Apache-2.0

config BOARD_STM32U5G9J_DK2
	select SOC_STM32U5G9XX
```

## boards/st/stm32u5g9j_dk2/board.yml
```yaml
board:
  name: stm32u5g9j_dk2
  full_name: STM32U5G9J Discovery Kit
  vendor: st
  socs:
    - name: stm32u5g9xx
```

## boards/st/stm32vl_disco/Kconfig.stm32vl_disco
```kconfig
# Copyright (c) 2020 Jonas Eriksson, Up to Code AB
# SPDX-License-Identifier: Apache-2.0

config BOARD_STM32VL_DISCO
	select SOC_STM32F100XB
```

## boards/st/stm32vl_disco/board.yml
```yaml
board:
  name: stm32vl_disco
  full_name: STM32VL Discovery
  vendor: st
  socs:
    - name: stm32f100xb
```

## boards/st/stm32wb5mm_dk/Kconfig.defconfig
```kconfig
# STM32WB5MM-DK Discovery Development board configuration

# Copyright (c) 2024 Javad Rahimipetroudi <javad.rahimipetroudi@mind.be>
# SPDX-License-Identifier: Apache-2.0

if BOARD_STM32WB5MM_DK

config BT_STM32_IPM
	default y
	depends on BT

endif
```
