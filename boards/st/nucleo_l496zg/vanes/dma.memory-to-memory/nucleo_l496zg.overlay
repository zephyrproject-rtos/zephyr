/*
 * Copyright (c) 2020 Erwin Rol <erwin@erwinrol.com>
 *
 * SPDX-License-Identifier: Apache-2.0
 */

/ {
	dma_test_dma2: dma-test-dma2 {
		compatible = "test-dma-memory-to-memory";
		dma = <&dma2>;
	};
};

&dma1 {
	status = "okay";
};

&dma2 {
	status = "okay";
};
