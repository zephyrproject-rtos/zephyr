## boards/st/nucleo_n657x0_q/Kconfig.nucleo_n657x0_q
```kconfig
# STM32N657X0_Q Nucleo board configuration

# Copyright (c) 2024 STMicroelectronics
# SPDX-License-Identifier: Apache-2.0

config BOARD_NUCLEO_N657X0_Q
	select SOC_STM32N657XX
```

## boards/st/nucleo_n657x0_q/Kconfig.sysbuild
```kconfig
# SPDX-License-Identifier: Apache-2.0
# Copyright (c) 2026 Gaiaochos

if BOARD_NUCLEO_N657X0_Q_STM32N657XX
choice BOOTLOADER
   default BOOTLOADER_MCUBOOT
endchoice
endif
```

## boards/st/nucleo_n657x0_q/board.yml
```yaml
board:
  name: nucleo_n657x0_q
  full_name: Nucleo N657X0-Q
  vendor: st
  socs:
    - name: stm32n657xx
      variants:
        - name: sb
```

## boards/st/nucleo_n657x0_q/nucleo_n657x0_q_stm32n657xx_fsbl_defconfig
```kconfig
# SPDX-License-Identifier: Apache-2.0
# Copyright (c) 2025 Gaiaochos

# Enable UART driver
CONFIG_SERIAL=y

# Enable GPIO
CONFIG_GPIO=y

# Console
CONFIG_CONSOLE=y
CONFIG_UART_CONSOLE=y

# Enable MPU
CONFIG_ARM_MPU=y

# Enable Hardware stack protection
CONFIG_HW_STACK_PROTECTION=y

# Don't place text and such in ROM
CONFIG_XIP=n

# HAL needs TRUSTED_EXECUTION_SECURE explicitly enabled
CONFIG_TRUSTED_EXECUTION_SECURE=y
```

## boards/st/nucleo_n657x0_q/nucleo_n657x0_q_stm32n657xx_sb_defconfig
```kconfig
# SPDX-License-Identifier: Apache-2.0
# Copyright (c) 2024 STMicroelectronics

# Enable UART driver
CONFIG_SERIAL=y

# Enable GPIO
CONFIG_GPIO=y

# Console
CONFIG_CONSOLE=y
CONFIG_UART_CONSOLE=y

# No internal Flash
CONFIG_XIP=n

# Use serial boot (USB)
CONFIG_STM32N6_BOOT_SERIAL=y
```

## boards/st/nucleo_u031r8/Kconfig.nucleo_u031r8
```kconfig
# Copyright (c) 2024 STMicroelectronics
# SPDX-License-Identifier: Apache-2.0

config BOARD_NUCLEO_U031R8
	select SOC_STM32U031XX
```

## boards/st/nucleo_u031r8/board.yml
```yaml
board:
  name: nucleo_u031r8
  full_name: Nucleo U031R8
  vendor: st
  socs:
    - name: stm32u031xx
```

## boards/st/nucleo_u031r8/nucleo_u031r8_defconfig
```kconfig
# SPDX-License-Identifier: Apache-2.0

# Enable MPU
CONFIG_ARM_MPU=y

# Serial Drivers
CONFIG_SERIAL=y
CONFIG_UART_INTERRUPT_DRIVEN=y

# enable console
CONFIG_CONSOLE=y
CONFIG_UART_CONSOLE=y

# GPIO Controller
CONFIG_GPIO=y
```

## boards/st/nucleo_u083rc/Kconfig.nucleo_u083rc
```kconfig
# Copyright (c) 2024 STMicroelectronics
# SPDX-License-Identifier: Apache-2.0

config BOARD_NUCLEO_U083RC
	select SOC_STM32U083XX
```

## boards/st/nucleo_u083rc/board.yml
```yaml
board:
  name: nucleo_u083rc
  full_name: Nucleo U083RC
  vendor: st
  socs:
    - name: stm32u083xx
```

## boards/st/nucleo_u385rg/board.yml
```yaml
board:
  name: nucleo_u385rg
  full_name: Nucleo U385RG
  vendor: st
  socs:
    - name: stm32u385xx
```

## boards/st/nucleo_u385rg/nucleo_u385rg_defconfig
```kconfig
# SPDX-License-Identifier: Apache-2.0

# Enable MPU
CONFIG_ARM_MPU=y

# Serial Drivers
CONFIG_SERIAL=y

# Enable console
CONFIG_CONSOLE=y
CONFIG_UART_CONSOLE=y

# GPIO Controller
CONFIG_GPIO=y
```

## boards/st/nucleo_u385rg_q/Kconfig.nucleo_u385rg_q
```kconfig
# Copyright (c) 2025 STMicroelectronics
# SPDX-License-Identifier: Apache-2.0

config BOARD_NUCLEO_U385RG_Q
	select SOC_STM32U385XX
```

## boards/st/nucleo_u385rg_q/board.yml
```yaml
board:
  name: nucleo_u385rg_q
  full_name: Nucleo U385RG Q
  vendor: st
  revision:
    format: letter
    default: "D"
    revisions:
      - name: "D"
      - name: "E"
  socs:
    - name: stm32u385xx
```

## boards/st/nucleo_u3c5zi_q/Kconfig.nucleo_u3c5zi_q
```kconfig
# Copyright (c) 2026 Filip Stojanovic filipembedded@gmail.com
# SPDX-License-Identifier: Apache-2.0

config BOARD_NUCLEO_U3C5ZI_Q
	select SOC_STM32U3C5XX
```

## boards/st/nucleo_u3c5zi_q/board.yml
```yaml
board:
  name: nucleo_u3c5zi_q
  full_name: Nucleo U3C5ZI Q
  vendor: st
  socs:
    - name: stm32u3c5xx
```

## boards/st/nucleo_u3c5zi_q/nucleo_u3c5zi_q_stm32u3c5xx_ns_defconfig
```kconfig
# SPDX-FileCopyrightText: Copyright 2026 STMicroelectronics
# SPDX-License-Identifier: Apache-2.0

# Enable uart driver
CONFIG_SERIAL=y

# Console
CONFIG_CONSOLE=y
CONFIG_UART_CONSOLE=y

# Enable MPU
CONFIG_ARM_MPU=y

# Enable HW stack protection
CONFIG_HW_STACK_PROTECTION=y

# Header offset since TF-M has no BL2 hence Zephyr is not signed
CONFIG_ROM_START_OFFSET=0x400

# Enable TZ non-secure configuration
CONFIG_TRUSTED_EXECUTION_NONSECURE=y
CONFIG_RUNTIME_NMI=y
```

## boards/st/nucleo_u545re_q/Kconfig.nucleo_u545re_q
```kconfig
# SPDX-License-Identifier: Apache-2.0
# Copyright (c) 2026 Smile

config BOARD_NUCLEO_U545RE_Q
	select SOC_STM32U545XX
```

## boards/st/nucleo_u545re_q/board.yml
```yaml
board:
  name: nucleo_u545re_q
  full_name: Nucleo U545RE Q
  vendor: st
  socs:
    - name: stm32u545xx
```

## boards/st/nucleo_u575zi_q/Kconfig.nucleo_u575zi_q
```kconfig
# Copyright (c) 2021 Linaro Limited
# SPDX-License-Identifier: Apache-2.0

config BOARD_NUCLEO_U575ZI_Q
	select SOC_STM32U575XX
```

## boards/st/nucleo_u575zi_q/board.yml
```yaml
board:
  name: nucleo_u575zi_q
  full_name: Nucleo U575ZI Q
  vendor: st
  socs:
    - name: stm32u575xx
```

## boards/st/nucleo_u5a5zj_q/Kconfig.defconfig
```kconfig
# Copyright (c) 2025
# SPDX-License-Identifier: Apache-2.0

if BOARD_NUCLEO_U5A5ZJ_Q

config TFM_BOARD
	default "${ZEPHYR_BASE}/boards/st/nucleo_u5a5zj_q/tfm"

if BUILD_WITH_TFM

config USE_DT_CODE_PARTITION
	default y if TRUSTED_EXECUTION_NONSECURE

config TFM_INITIAL_ATTESTATION_KEY
	default y

# Disabled to show how to define custom keys,
#  see nucleo_u5a5zj_q_stm32u5a5xx_ns_defconfig
config TFM_DUMMY_PROVISIONING
	default n

endif # BUILD_WITH_TFM

endif # BOARD_NUCLEO_U5A5ZJ_Q
```

## boards/st/nucleo_u5a5zj_q/Kconfig.nucleo_u5a5zj_q
```kconfig
# Copyright (c) 2025 STMicroelectronics
# SPDX-License-Identifier: Apache-2.0

config BOARD_NUCLEO_U5A5ZJ_Q
	select SOC_STM32U5A5XX
```

## boards/st/nucleo_u5a5zj_q/board.yml
```yaml
board:
  name: nucleo_u5a5zj_q
  full_name: Nucleo U5A5ZJ Q
  vendor: st
  socs:
    - name: stm32u5a5xx
      variants:
        - name: ns
```

## boards/st/nucleo_u5a5zj_q/nucleo_u5a5zj_q_stm32u5a5xx_ns_defconfig
```kconfig
#
# Copyright (c) 2025 Leica Geosystems AG
#
# SPDX-License-Identifier: Apache-2.0
#

# enable uart driver
CONFIG_SERIAL=y

# enable GPIO
CONFIG_GPIO=y

# console
CONFIG_CONSOLE=y
CONFIG_UART_CONSOLE=y

# Enable MPU
CONFIG_ARM_MPU=y

# Enable HW stack protection
CONFIG_HW_STACK_PROTECTION=y

# TF-M
CONFIG_ARM_TRUSTZONE_M=y
CONFIG_RUNTIME_NMI=y
CONFIG_TRUSTED_EXECUTION_NONSECURE=y

# Keys/Certificates
#
#	For development purposes only. These must be changed for a real product.
#
# The otp_provision.c will be picked from the same rsa-3072-private-s.pem folder.
#
CONFIG_TFM_MCUBOOT_SIGNATURE_TYPE="RSA-3072"
CONFIG_TFM_KEY_FILE_S="${BOARD_DIR}/tfm/certs/rsa-3072-private-s.pem"
CONFIG_TFM_KEY_FILE_NS="${BOARD_DIR}/tfm/certs/rsa-3072-private-ns.pem"
```
