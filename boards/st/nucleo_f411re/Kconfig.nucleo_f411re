## boards/st/nucleo_f411re/Kconfig.nucleo_f411re
```kconfig
# Copyright (c) 2016 Matthias Boesl
# SPDX-License-Identifier: Apache-2.0

config BOARD_NUCLEO_F411RE
	select SOC_STM32F411XE
```

## boards/st/nucleo_f411re/board.yml
```yaml
board:
  name: nucleo_f411re
  full_name: Nucleo F411RE
  vendor: st
  socs:
    - name: stm32f411xe
```

## boards/st/nucleo_f411re/nucleo_f411re_defconfig
```kconfig
# SPDX-License-Identifier: Apache-2.0

# Enable MPU
CONFIG_ARM_MPU=y

# Enable HW stack protection
CONFIG_HW_STACK_PROTECTION=y

CONFIG_SERIAL=y

# console
CONFIG_CONSOLE=y
CONFIG_UART_CONSOLE=y

# enable GPIO
CONFIG_GPIO=y
```

## boards/st/nucleo_f412zg/Kconfig.nucleo_f412zg
```kconfig
# Copyright (c) 2017 Florian Vaussard, HEIG-VD
# SPDX-License-Identifier: Apache-2.0

config BOARD_NUCLEO_F412ZG
	select SOC_STM32F412ZX
```

## boards/st/nucleo_f412zg/board.yml
```yaml
board:
  name: nucleo_f412zg
  full_name: Nucleo F412ZG
  vendor: st
  socs:
    - name: stm32f412zx
```

## boards/st/nucleo_f413zh/Kconfig.defconfig
```kconfig
# NUCLEO-144 F413ZH board configuration

# Copyright (c) 2017 Florian Vaussard, HEIG-VD
# SPDX-License-Identifier: Apache-2.0

if BOARD_NUCLEO_F413ZH

if NETWORKING

config USB_DEVICE_STACK
	default y

config USB_DEVICE_NETWORK_ECM
	default y

endif # NETWORKING

endif # BOARD_NUCLEO_F413ZH
```

## boards/st/nucleo_f413zh/Kconfig.nucleo_f413zh
```kconfig
# Copyright (c) 2017 Florian Vaussard, HEIG-VD
# SPDX-License-Identifier: Apache-2.0

config BOARD_NUCLEO_F413ZH
	select SOC_STM32F413XX
```

## boards/st/nucleo_f413zh/Kconfig.sysbuild
```kconfig
# SPDX-FileCopyrightText: Copyright STMicroelectronics
# SPDX-License-Identifier: Apache-2.0

choice MCUBOOT_MODE
	default MCUBOOT_MODE_SWAP_SCRATCH if BOOTLOADER_MCUBOOT
endchoice
```

## boards/st/nucleo_f413zh/board.yml
```yaml
board:
  name: nucleo_f413zh
  full_name: Nucleo F413ZH
  vendor: st
  socs:
    - name: stm32f413xx
```

## boards/st/nucleo_f429zi/Kconfig.nucleo_f429zi
```kconfig
# Copyright (c) 2017 Linaro Limited
# SPDX-License-Identifier: Apache-2.0

config BOARD_NUCLEO_F429ZI
	select SOC_STM32F429XX
```

## boards/st/nucleo_f429zi/board.yml
```yaml
board:
  name: nucleo_f429zi
  full_name: Nucleo F429ZI
  vendor: st
  socs:
    - name: stm32f429xx
```

## boards/st/nucleo_f439zi/Kconfig.defconfig
```kconfig
# NUCLEO-144 F439ZI board configuration

# Copyright (c) 2025 Mathieu Anquetin <mathieu.anquetin@groupe-cahors.com>
# SPDX-License-Identifier: Apache-2.0

if BOARD_NUCLEO_F439ZI

if NETWORKING

config NET_L2_ETHERNET
	default y

endif # NETWORKING

endif # BOARD_NUCLEO_F439ZI
```

## boards/st/nucleo_f439zi/Kconfig.nucleo_f439zi
```kconfig
# Copyright (c) 2025 Mathieu Anquetin <mathieu.anquetin@groupe-cahors.com>
# SPDX-License-Identifier: Apache-2.0

config BOARD_NUCLEO_F439ZI
	select SOC_STM32F439XX
```

## boards/st/nucleo_f439zi/board.yml
```yaml
board:
  name: nucleo_f439zi
  full_name: Nucleo F439ZI
  vendor: st
  socs:
    - name: stm32f439xx
```

## boards/st/nucleo_f446re/Kconfig.defconfig
```kconfig
# STM32F446RE Nucleo board configuration

# Copyright (c) 2018 Philémon Jaermann
# SPDX-License-Identifier: Apache-2.0

if BOARD_NUCLEO_F446RE

config SPI_STM32_INTERRUPT
	default y
	depends on SPI

endif # BOARD_NUCLEO_F446RE
```

## boards/st/nucleo_f446re/Kconfig.nucleo_f446re
```kconfig
# Copyright (c) 2018 Philémon Jaermann
# SPDX-License-Identifier: Apache-2.0

config BOARD_NUCLEO_F446RE
	select SOC_STM32F446XX
```

## boards/st/nucleo_f446re/board.yml
```yaml
board:
  name: nucleo_f446re
  full_name: Nucleo F446RE
  vendor: st
  socs:
    - name: stm32f446xx
```

## boards/st/nucleo_f446ze/Kconfig.defconfig
```kconfig
# STM32F446ZE Nucleo board configuration

# Copyright (c) 2021 Tom Owen
# SPDX-License-Identifier: Apache-2.0

if BOARD_NUCLEO_F446ZE

config SPI_STM32_INTERRUPT
	default y
	depends on SPI

endif # BOARD_NUCLEO_F446ZE
```

## boards/st/nucleo_f446ze/Kconfig.nucleo_f446ze
```kconfig
# Copyright (c) 2021 Tom Owen
# SPDX-License-Identifier: Apache-2.0

config BOARD_NUCLEO_F446ZE
	select SOC_STM32F446XX
```

## boards/st/nucleo_f446ze/board.yml
```yaml
board:
  name: nucleo_f446ze
  full_name: Nucleo F446ZE
  vendor: st
  socs:
    - name: stm32f446xx
```

## boards/st/nucleo_f722ze/Kconfig.defconfig
```kconfig
# STM32F722ZE Nucleo board configuration
#
# Copyright (c) 2023 Evan Perry Grove
# SPDX-License-Identifier: Apache-2.0

if BOARD_NUCLEO_F722ZE

config SPI_STM32_INTERRUPT
	default y
	depends on SPI

endif # BOARD_NUCLEO_F722ZE
```

## boards/st/nucleo_f722ze/Kconfig.nucleo_f722ze
```kconfig
# Copyright (c) 2023 Evan Perry Grove
# SPDX-License-Identifier: Apache-2.0

config BOARD_NUCLEO_F722ZE
	select SOC_STM32F722XX
```

## boards/st/nucleo_f722ze/board.yml
```yaml
board:
  name: nucleo_f722ze
  full_name: Nucleo F722ZE
  vendor: st
  socs:
    - name: stm32f722xx
```

## boards/st/nucleo_f722ze/nucleo_f722ze_defconfig
```kconfig
# SPDX-License-Identifier: Apache-2.0

# Enable MPU
CONFIG_ARM_MPU=y

# Enable HW stack protection
CONFIG_HW_STACK_PROTECTION=y

# Enable UART
CONFIG_SERIAL=y

# Enable console (use UART by default)
CONFIG_CONSOLE=y
CONFIG_UART_CONSOLE=y

# Enable GPIO
CONFIG_GPIO=y

# Enable clocks
CONFIG_CLOCK_CONTROL=y

# Enable pinctrl
CONFIG_PINCTRL=y
```

## boards/st/nucleo_f746zg/Kconfig.nucleo_f746zg
```kconfig
# Copyright (c) 2018 AJ Palmer
# SPDX-License-Identifier: Apache-2.0

config BOARD_NUCLEO_F746ZG
	select SOC_STM32F746XX
```
