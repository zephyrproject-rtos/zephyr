## boards/st/stm32wb5mm_dk/board.yml
```yaml
board:
  name: stm32wb5mm_dk
  full_name: STM32WB5MM-DK
  vendor: st
  socs:
    - name: stm32wb55xx
```

## boards/st/stm32wb5mmg/Kconfig.defconfig
```kconfig
# STM32WB5MMG Bluetooth module board configuration

# Copyright (c) 2024 Javad Rahimipetroudi <javad.rahimipetroudi@mind.be>
# SPDX-License-Identifier: Apache-2.0

if BOARD_STM32WB5MMG

config BT_STM32_IPM
	default y
	depends on BT

endif
```

## boards/st/stm32wb5mmg/Kconfig.stm32wb5mmg
```kconfig
# Copyright (c) 2024 Javad Rahimipetroudi <javad.rahimipetroudi@mind.be>
# SPDX-License-Identifier: Apache-2.0

config BOARD_STM32WB5MMG
	select SOC_STM32WB55XX
```

## boards/st/stm32wb5mmg/board.yml
```yaml
board:
  name: stm32wb5mmg
  full_name: STM32WB5MMG
  vendor: st
  socs:
    - name: stm32wb55xx
```

## boards/st/stm32wba65i_dk1/Kconfig.defconfig
```kconfig
# STM32WBA65I Discovery kit board configuration

# Copyright (c) 2025 STMicroelectronics

# SPDX-License-Identifier: Apache-2.0

if BOARD_STM32WBA65I_DK1

config SPI_STM32_INTERRUPT
	default y
	depends on SPI

endif # BOARD_STM32WBA65I_DK1
```

## boards/st/stm32wba65i_dk1/Kconfig.stm32wba65i_dk1
```kconfig
# Copyright (c) 2025 STMicroelectronics
# SPDX-License-Identifier: Apache-2.0

config BOARD_STM32WBA65I_DK1
	select SOC_STM32WBA65XX
```

## boards/st/stm32wba65i_dk1/board.yml
```yaml
board:
  name: stm32wba65i_dk1
  full_name: STM32WBA65I Discovery kit
  vendor: st
  socs:
    - name: stm32wba65xx
      variants:
        - name: ns
```

## boards/st/stm32wba65i_dk1/stm32wba65i_dk1_stm32wba65xx_ns_defconfig
```kconfig
# SPDX-License-Identifier: Apache-2.0
# Copyright (c) 2025 STMicroelectronics

# Enable UART driver
CONFIG_SERIAL=y

# Enable GPIO
CONFIG_GPIO=y

# Console
CONFIG_CONSOLE=y
CONFIG_UART_CONSOLE=y

# Enable MPU
CONFIG_ARM_MPU=y

# Enable HW stack protection
CONFIG_HW_STACK_PROTECTION=y

# Enable the internal SMPS regulator
CONFIG_POWER_SUPPLY_DIRECT_SMPS=y

# Enable ADC for joystick
CONFIG_ADC=y

# Header offset since TF-M has no BL2 hence Zephyr is not signed
CONFIG_ROM_START_OFFSET=0x400

# Enable TZ non-secure configuration
CONFIG_TRUSTED_EXECUTION_NONSECURE=y
CONFIG_RUNTIME_NMI=y
```

## boards/starfive/visionfive2/Kconfig.visionfive2
```kconfig
# Copyright (c) 2024 Kanak Shilledar <kanakshilledar111@protonmail.com>
# SPDX-License-Identifier: Apache-2.0

config BOARD_VISIONFIVE2
	select SOC_JH7110
```

## boards/starfive/visionfive2/board.yml
```yaml
# Copyright (c) 2024 Kanak Shilledar <kanakshilledar111@protonmail.com>
# SPDX-License-Identifier: Apache-2.0

board:
  name: visionfive2
  vendor: starfive
  socs:
    - name: jh7110
```

## boards/starfive/visionfive2/visionfive2_defconfig
```kconfig
# SPDX-License-Identifier: Apache-2.0

# Zephyr Kernel Configuration
CONFIG_PRINTK=y
CONFIG_XIP=n

# Serial Drivers
CONFIG_SERIAL=y
CONFIG_CONSOLE=y
CONFIG_UART_CONSOLE=y
```

## boards/starfive/visionfive2_jh7110/board.yml
```yaml
# Copyright (c) 2024 Kanak Shilledar <kanakshilledar111@protonmail.com>
# SPDX-License-Identifier: Apache-2.0

board:
  name: visionfive2_jh7110
  vendor: Starfive Tech
  socs:
    - name: jh7110
```

## boards/steelseries/apex_pro_mini/Kconfig.apex_pro_mini
```kconfig
# Copyright (c) 2025 Eve Redero
# SPDX-License-Identifier: Apache-2.0

config BOARD_APEX_PRO_MINI
	select SOC_STM32L412XX
```

## boards/steelseries/apex_pro_mini/Kconfig.defconfig
```kconfig
# Steelseries Apex Pro Mini keyboard configuration

# Copyright (c) 2025 Eve Redero
# SPDX-License-Identifier: Apache-2.0

if BOARD_APEX_PRO_MINI

config SPI_STM32_INTERRUPT
	default y
	depends on SPI

config INPUT_KBD_MATRIX_16_BIT_ROW
	default y if INPUT_GPIO_KBD_MATRIX

config SPI_NOR_FLASH_LAYOUT_PAGE_SIZE
	default 4096 if FLASH

source "boards/common/usb/Kconfig.cdc_acm_serial.defconfig"

endif # BOARD_APEX_PRO_MINI
```

## boards/steelseries/apex_pro_mini/apex_pro_mini_defconfig
```kconfig
# SPDX-License-Identifier: Apache-2.0

# Enable MPU
CONFIG_ARM_MPU=y

# Enable HW stack protection
CONFIG_HW_STACK_PROTECTION=y

# Enable GPIO
CONFIG_GPIO=y
```

## boards/steelseries/apex_pro_mini/board.yml
```yaml
board:
  name: apex_pro_mini
  full_name: Apex Pro Mini
  vendor: steelseries
  socs:
    - name: stm32l412xx
```

## boards/steelseries/apexpromini/Kconfig.apexpromini
```kconfig
# Copyright (c) 2025 Eve Redero
# SPDX-License-Identifier: Apache-2.0

config BOARD_APEXPROMINI
	select SOC_STM32L412XX
```

## boards/steelseries/apexpromini/Kconfig.defconfig
```kconfig
# Steelseries Apex Pro Mini keyboard configuration

# Copyright (c) 2025 Eve Redero
# SPDX-License-Identifier: Apache-2.0

if BOARD_APEXPROMINI

config SPI_STM32_INTERRUPT
	default y
	depends on SPI

endif # BOARD_APEXPROMINI
```

## boards/steelseries/apexpromini/apexpromini_defconfig
```kconfig
# SPDX-License-Identifier: Apache-2.0

# Enable MPU
CONFIG_ARM_MPU=y

# Enable HW stack protection
CONFIG_HW_STACK_PROTECTION=y

# enable uart driver
CONFIG_SERIAL=y

# Console
CONFIG_CONSOLE=y
CONFIG_UART_CONSOLE=y

# Enable GPIO
CONFIG_GPIO=y

# Enable USB
CONFIG_USB_DEVICE_STACK_NEXT=y
CONFIG_CDC_ACM_SERIAL_INITIALIZE_AT_BOOT=y
CONFIG_USBD_CDC_ACM_LOG_LEVEL_OFF=y

# Enable input keyboard matrix
CONFIG_INPUT=y
CONFIG_INPUT_KEYMAP=y
CONFIG_INPUT_GPIO_KBD_MATRIX=y
# Required because rows are actually columns
CONFIG_INPUT_KBD_MATRIX_16_BIT_ROW=y

# Enable spi flash
CONFIG_FLASH=y
CONFIG_SPI_NOR_FLASH_LAYOUT_PAGE_SIZE=4096
```

## boards/steelseries/apexpromini/board.yml
```yaml
board:
  name: apexpromini
  full_name: SteelSeries Apex Pro Mini
  vendor: steelseries
  socs:
    - name: stm32l412xx
```

## boards/stm32_mini_a15/stm32_mini_a15_defconfig
```kconfig
CONFIG_ARM=y
CONFIG_BOARD_STM32_MINI_A15=y
CONFIG_SOC_STM32=y
CONFIG_SOC_STM32F1X=y
CONFIG_SOC_STM32F103VE=y
CONFIG_CORTEX_M_SYSTICK=y
# 36MHz system clock
CONFIG_SYS_CLOCK_HW_CYCLES_PER_SEC=36000000

# enable uart driver
CONFIG_SERIAL=y
CONFIG_UART_STM32=y
CONFIG_UART_STM32_PORT_0=y
CONFIG_UART_STM32_PORT_0_BAUD_RATE=9600

# enable pinmux
CONFIG_PINMUX=y
CONFIG_PINMUX_BASE=0
CONFIG_PINMUX_STM32=y

# enable GPIOs
CONFIG_GPIO=y
CONFIG_GPIO_STM32=y
CONFIG_GPIO_STM32_PORTB=y

# configure clocks to get 36MHz on APB1 and APB2
CONFIG_CLOCK_CONTROL=y
CONFIG_CLOCK_CONTROL_STM32F10X=y
CONFIG_CLOCK_STM32F10X_SYSCLK_SRC_PLL=y
CONFIG_CLOCK_STM32F10X_PLL_SRC_HSI=y
CONFIG_CLOCK_STM32F10X_PLL_MULTIPLIER=9
CONFIG_CLOCK_STM32F10X_AHB_PRESCALER=0
CONFIG_CLOCK_STM32F10X_APB1_PRESCALER=0
CONFIG_CLOCK_STM32F10X_APB2_PRESCALER=0

# console
CONFIG_CONSOLE=y
CONFIG_UART_CONSOLE=y
```

## boards/syna/astra_sr/sr100/Kconfig.defconfig
```kconfig
# Synaptics SR100 Astra Machina Micro (RDK) Board configuration options

# SPDX-FileCopyrightText: Copyright (c) 2025 Synaptics Incorporated
# SPDX-License-Identifier: Apache-2.0

if BOARD_SR100_RDK

if SERIAL

config UART_INTERRUPT_DRIVEN
	default y if BOARD_SR100_RDK_SR100_M55

endif # SERIAL

if I2C_DW

config I2C_DW_CLOCK_SPEED
	default 100

endif # I2C_DW

endif # BOARD_SR100_RDK
```

## boards/syna/astra_sr/sr100/Kconfig.sr100_rdk
```kconfig
# Synaptics SR100 Astra Machina Micro (RDK) Board configuration options

# SPDX-FileCopyrightText: Copyright (c) 2025 Synaptics Incorporated
# SPDX-License-Identifier: Apache-2.0

config BOARD_SR100_RDK
	select SOC_SR100_M55 if BOARD_SR100_RDK_SR100_M55
```

## boards/syna/astra_sr/sr100/sr100_rdk_sr100_m4_defconfig
```kconfig
# defconfig - Synaptics SR100 Astra Machina Micro (RDK) Board configuration

#
# SPDX-FileCopyrightText: Copyright (c) 2025 Synaptics Incorporated
#
# SPDX-License-Identifier: Apache-2.0
#

CONFIG_SERIAL=y
CONFIG_CONSOLE=y
CONFIG_UART_CONSOLE=y
CONFIG_GPIO=y
CONFIG_I2C=y
CONFIG_EXTERNAL_CACHE=y
CONFIG_CACHE_ARM_AHB=y
```

## boards/syna/astra_sr/sr100/sr100_rdk_sr100_m55_defconfig
```kconfig
# defconfig - Synaptics SR100 Astra Machina Micro (RDK) Board configuration

#
# SPDX-FileCopyrightText: Copyright (c) 2025 Synaptics Incorporated
#
# SPDX-License-Identifier: Apache-2.0
#

CONFIG_SERIAL=y
CONFIG_CONSOLE=y
CONFIG_UART_CONSOLE=y
CONFIG_GPIO=y
CONFIG_REGULATOR=y
CONFIG_REGULATOR_FIXED_INIT_PRIORITY=45
```
