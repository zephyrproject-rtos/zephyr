/*
 * SPDX-License-Identifier: Apache-2.0
 *
 * Copyright (c) 2025 STMicroelectronics
 */

/ {
	dma_test_dmamux1: dma-test-dmamux1 {
		compatible = "test-dma-memory-to-memory";
		dma = <&dmamux1>;
		channels = <0 7>;
	};
};

&dma1 {
	status = "okay";
};

&dmamux1 {
	status = "okay";
};
