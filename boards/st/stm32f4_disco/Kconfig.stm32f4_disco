## boards/st/stm32f4_disco/Kconfig.stm32f4_disco
```kconfig
# Copyright (c) 2016 Linaro Limited.
# SPDX-License-Identifier: Apache-2.0

config BOARD_STM32F4_DISCO
	select SOC_STM32F407XG
```

## boards/st/stm32f4_disco/board.yml
```yaml
board:
  name: stm32f4_disco
  full_name: STM32F4 Discovery
  vendor: st
  socs:
    - name: stm32f407xx
```

## boards/st/stm32f723e_disco/Kconfig.stm32f723e_disco
```kconfig
# Copyright (c) 2018 Aurelien Jarno
# SPDX-License-Identifier: Apache-2.0

config BOARD_STM32F723E_DISCO
	select SOC_STM32F723XX
```

## boards/st/stm32f746g_disco/Kconfig.stm32f746g_disco
```kconfig
# Copyright (c) 2018 Yurii Hamann
# SPDX-License-Identifier: Apache-2.0

config BOARD_STM32F746G_DISCO
	select SOC_STM32F746XX
```

## boards/st/stm32f746g_disco/board.yml
```yaml
board:
  name: stm32f746g_disco
  full_name: STM32F746G Discovery
  vendor: st
  socs:
    - name: stm32f746xx
```

## boards/st/stm32f7508_dk/Kconfig.stm32f7508_dk
```kconfig
# Copyright (c) 2022, Rtone.
# SPDX-License-Identifier: Apache-2.0

config BOARD_STM32F7508_DK
	select SOC_STM32F750XX
```

## boards/st/stm32f7508_dk/board.yml
```yaml
board:
  name: stm32f7508_dk
  full_name: STM32F7508-DK Discovery Kit
  vendor: st
  socs:
    - name: stm32f750xx
```

## boards/st/stm32f769i_disco/Kconfig.stm32f769i_disco
```kconfig
# Copyright (c) 2018 Yong Jin
# SPDX-License-Identifier: Apache-2.0

config BOARD_STM32F769I_DISCO
	select SOC_STM32F769XX
```

## boards/st/stm32f769i_disco/board.yml
```yaml
board:
  name: stm32f769i_disco
  full_name: STM32F769I Discovery
  vendor: st
  socs:
    - name: stm32f769xx
```

## boards/st/stm32g0316_disco/Kconfig.stm32g0316_disco
```kconfig
# Copyright (c) 2019 SEAL AG
# SPDX-License-Identifier: Apache-2.0

config BOARD_STM32G0316_DISCO
	select SOC_STM32G031XX
```

## boards/st/stm32g0316_disco/board.yml
```yaml
board:
  name: stm32g0316_disco
  full_name: STM32G0316 Discovery
  vendor: st
  socs:
    - name: stm32g031xx
```

## boards/st/stm32g0316_disco/stm32g0316_disco_defconfig
```kconfig
# Serial Drivers
CONFIG_SERIAL=y
CONFIG_UART_INTERRUPT_DRIVEN=y

# enable console
CONFIG_CONSOLE=y
CONFIG_UART_CONSOLE=y

# GPIO Controller
CONFIG_GPIO=y
```

## boards/st/stm32g071b_disco/Kconfig.stm32g071b_disco
```kconfig
# Copyright 2021 The Chromium OS Authors
# SPDX-License-Identifier: Apache-2.0

config BOARD_STM32G071B_DISCO
	select SOC_STM32G071XX
```

## boards/st/stm32g071b_disco/board.yml
```yaml
board:
  name: stm32g071b_disco
  full_name: STM32G071B Discovery
  vendor: st
  socs:
    - name: stm32g071xx
```

## boards/st/stm32g071b_disco/stm32g071b_disco_defconfig
```kconfig
# Copyright 2021 The Chromium OS Authors
#
# SPDX-License-Identifier: Apache-2.0

# Serial Drivers
CONFIG_SERIAL=y
CONFIG_UART_INTERRUPT_DRIVEN=y

# enable console
CONFIG_CONSOLE=y
CONFIG_UART_CONSOLE=y

# GPIO Controller
CONFIG_GPIO=y
```

## boards/st/stm32g081b_eval/Kconfig.stm32g081b_eval
```kconfig
# Copyright 2021 The Chromium OS Authors
# SPDX-License-Identifier: Apache-2.0

config BOARD_STM32G081B_EVAL
	select SOC_STM32G081XX
```

## boards/st/stm32g081b_eval/board.yml
```yaml
board:
  name: stm32g081b_eval
  full_name: STM32G081B Evaluation
  vendor: st
  socs:
    - name: stm32g081xx
```

## boards/st/stm32h573i_dk/Kconfig.stm32h573i_dk
```kconfig
# Copyright (c) 2023 STMicroelectronics
# SPDX-License-Identifier: Apache-2.0

config BOARD_STM32H573I_DK
	select SOC_STM32H573XX
```

## boards/st/stm32h573i_dk/Kconfig.sysbuild
```kconfig
# SPDX-FileCopyrightText: Copyright The Zephyr Project Contributors
# SPDX-License-Identifier: Apache-2.0

choice BOOTLOADER
	default BOOTLOADER_MCUBOOT
endchoice

choice BOOT_SIGNATURE_TYPE
	default BOOT_SIGNATURE_TYPE_RSA
endchoice
```

## boards/st/stm32h573i_dk/stm32h573i_dk_defconfig
```kconfig
# Copyright (c) 2023 STMicroelectronics
# SPDX-License-Identifier: Apache-2.0

# Enable MPU
CONFIG_ARM_MPU=y

# Enable HW stack protection
CONFIG_HW_STACK_PROTECTION=y

# enable uart driver
CONFIG_SERIAL=y
# enable console
CONFIG_CONSOLE=y
CONFIG_UART_CONSOLE=y

# enable GPIO
CONFIG_GPIO=y
```

## boards/st/stm32h573i_dk/stm32h573i_dk_stm32h573xx_ns_defconfig
```kconfig
# Copyright (c) 2023 STMicroelectronics
# Copyright (c) 2025 CodeWrights GmbH
# SPDX-License-Identifier: Apache-2.0

# Enable MPU
CONFIG_ARM_MPU=y

# Enable HW stack protection
CONFIG_HW_STACK_PROTECTION=y

# Enable UART driver
CONFIG_SERIAL=y

# Enable console
CONFIG_CONSOLE=y
CONFIG_UART_CONSOLE=y

# Enable TZ non-secure configuration
CONFIG_TRUSTED_EXECUTION_NONSECURE=y
CONFIG_RUNTIME_NMI=y

# Set HEX file to program non-secure image through flash secure address range
CONFIG_SOC_FAMILY_STM32_HEX_FILE_NS_APPLI_IN_SECURE_RANGE=y
```

## boards/st/stm32h5f5j_dk/Kconfig.stm32h5f5j_dk
```kconfig
# Copyright (c) 2026 STMicroelectronics
# SPDX-License-Identifier: Apache-2.0

config BOARD_STM32H5F5J_DK
	select SOC_STM32H5F5XX
```

## boards/st/stm32h5f5j_dk/board.yml
```yaml
board:
  name: stm32h5f5j_dk
  full_name: STM32H5F5J-DK Discovery
  vendor: st
  socs:
    - name: stm32h5f5xx
      variants:
        - name: ext_flash_app
```

## boards/st/stm32h735g_disco/Kconfig.stm32h735g_disco
```kconfig
# Copyright (c) 2021 SILA Embedded Solutions GmbH
# SPDX-License-Identifier: Apache-2.0

config BOARD_STM32H735G_DISCO
	select SOC_STM32H735XX
```
