/*
 * Copyright (c) 2021 Thomas Stranger
 *
 * SPDX-License-Identifier: Apache-2.0
 */

/ {
	dma_test_dmamux1: dma-test-dmamux1 {
		compatible = "test-dma-memory-to-memory";
		dma = <&dmamux1>;
		channels = <0 1 4>;
	};
};

&dma1 {
	status = "okay";
};

&dmamux1 {
	status = "okay";
};
