## boards/st/stm32h7p5i_dk/board.yml
```yaml
# SPDX-FileCopyrightText: Copyright (c) 2026 STMicroelectronics
# SPDX-License-Identifier: Apache-2.0

board:
  name: stm32h7p5i_dk
  full_name: STM32H7P5I-DK Discovery Kit
  vendor: st
  socs:
    - name: stm32h7p5xx
```

## boards/st/stm32l4r9i_disco/Kconfig.defconfig
```kconfig
# STM32L4R9I DISCOVERY board configuration

# Copyright (c) 2026 STMicroelectronics
# SPDX-License-Identifier: Apache-2.0

if BOARD_STM32L4R9I_DISCO

if LVGL

# Let LVGL fully handle the buffers
configdefault STM32_LTDC_FB_NUM
	default 0

configdefault LV_Z_VDB_ZEPHYR_REGION
	default y

configdefault LV_Z_VDB_ZEPHYR_REGION_NAME
	default "SRAM2"

choice LV_Z_RENDERING_MODE
	default LV_Z_DIRECT_RENDERING
endchoice

endif # LVGL

endif # BOARD_STM32L4R9I_DISCO
```

## boards/st/stm32l562e_dk/stm32l562e_dk_stm32l562xx_ext_flash_app_defconfig
```kconfig
# Copyright (c) 2026 STMicroelectronics
# SPDX-License-Identifier: Apache-2.0

CONFIG_SERIAL=y
CONFIG_CONSOLE=y
CONFIG_UART_CONSOLE=y
CONFIG_MSPI_MEMMAP=y
```

## boards/st/stm32mp157_dk2/Kconfig.stm32mp157_dk2
```kconfig
# Copyright (c) 2019 STMicroelectronics
# SPDX-License-Identifier: Apache-2.0

config BOARD_STM32MP157_DK2
	select SOC_STM32MP157CXX if BOARD_STM32MP157_DK2_STM32MP157CXX
	select SOC_STM32MP157FXX if BOARD_STM32MP157_DK2_STM32MP157FXX
```

## boards/st/stm32mp157_dk2/board.yml
```yaml
board:
  name: stm32mp157_dk2
  full_name: STM32MP157-DK2 Discovery
  vendor: st
  socs:
    - name: stm32mp157cxx
    - name: stm32mp157fxx
```

## boards/st/stm32mp157x_dk2/Kconfig.stm32mp157x_dk2
```kconfig
# Copyright (c) 2019 STMicroelectronics
# SPDX-License-Identifier: Apache-2.0

config BOARD_STM32MP157X_DK2
	select SOC_STM32MP157CXX_M4 if BOARD_STM32MP157X_DK2_STM32MP157CXX
	select SOC_STM32MP157FXX_M4 if BOARD_STM32MP157X_DK2_STM32MP157FXX
```

## boards/st/stm32mp157x_dk2/board.yml
```yaml
board:
  name: stm32mp157x_dk2
  full_name: STM32MP157x-DK2 Discovery
  vendor: st
  socs:
    - name: stm32mp157cxx
    - name: stm32mp157fxx
```

## boards/st/stm32u5g9j_dk2/Kconfig.defconfig
```kconfig
# STM32U5G9J-DK2 DISCOVERY KIT board configuration
#
# Copyright (c) 2026 STMicroelectronics
#
# SPDX-License-Identifier: Apache-2.0
#

if BOARD_STM32U5G9J_DK2

if INPUT

config INPUT_GT911_INTERRUPT
	default y

endif # INPUT

# Enable Neochrom GPU2D graphic acceleration using nemaGFX
if LVGL

# Let LVGL fully handle the buffers
configdefault STM32_LTDC_FB_NUM
	default 0

configdefault LV_Z_DOUBLE_VDB
	default y

choice LV_Z_RENDERING_MODE
	default LV_Z_DIRECT_RENDERING
endchoice

if NEOCHROM_GPU2D

config LV_ATTRIBUTE_MEM_ALIGN_SIZE
	default 32

config LV_Z_NEMA_GFX_MULTI_THREAD
	default y if LV_USE_NEMA_GFX

choice LV_USE_NEMA_HAL
	default LV_NEMA_HAL_CUSTOM
endchoice

choice LV_USE_NEMA_LIB
	default LV_NEMA_LIB_M33_REVC
endchoice

config LV_NEMA_CACHE_HAL_INCLUDE
	default "stm32u5xx.h"

endif # NEOCHROM_GPU2D

endif # LVGL

endif # BOARD_STM32U5G9J_DK2
```

## boards/starfive/visionfive2/Kconfig.defconfig
```kconfig
# Copyright (c) 2024 Kanak Shilledar <kanakshilledar111@protonmail.com>
# SPDX-License-Identifier: Apache-2.0

if BOARD_VISIONFIVE2_JH7110

config SYS_CLOCK_TICKS_PER_SEC
	default 1000

endif # BOARD_VISIONFIVE2_JH7110
```

## boards/syna/astra_sr/sr100/Kconfig.sysbuild
```kconfig
# SPDX-FileCopyrightText: Copyright (c) 2026 Synaptics Incorporated
# SPDX-License-Identifier: Apache-2.0

if BOARD_SR100_RDK

config SOC_SR100_M4_APP_DIR
	string "Source directory of the SR100-M4 Zephyr application"
	help
	  Path to the SR100-M4 application source directory.

endif # BOARD_SR100_RDK
```

## boards/t3gemstone/t3_gem_o1/Kconfig.t3_gem_o1
```kconfig
# Copyright (c) 2026 T3 Gemstone
# 	T3 Gemstone Developer Team <support@t3gemstone.org>
#
# SPDX-License-Identifier: Apache-2.0

config BOARD_T3_GEM_O1
	select SOC_J722S_MAIN_R5F0_0 if BOARD_T3_GEM_O1_J722S_MAIN_R5F0_0
	select SOC_J722S_MCU_R5F0_0 if BOARD_T3_GEM_O1_J722S_MCU_R5F0_0
```

## boards/t3gemstone/t3_gem_o1/board.yml
```yaml
board:
  name: t3_gem_o1
  full_name: T3 Gemstone O1
  vendor: t3gemstone
  socs:
  - name: j722s
```

## boards/ti/am62l_evm/Kconfig.defconfig
```kconfig
# Texas Instruments Sitara AM62L EVM
#
# Copyright (c) 2025 Texas Instruments Incorporated
#
# SPDX-License-Identifier: Apache-2.0

if BOARD_AM62L_EVM

config TFA_PLATFORM
	default "k3low"

endif # BOARD_AM62L_EVM
```

## boards/ti/lp_em_cc1354p10_1/Kconfig.lp_em_cc1354p10_1
```kconfig
# Copyright (c) 2026 Texas Instruments
# SPDX-License-Identifier: Apache-2.0

config BOARD_LP_EM_CC1354P10_1
	select SOC_CC1354P10
```

## boards/ti/lp_em_cc1354p10_1/board.yml
```yaml
board:
  name: lp_em_cc1354p10_1
  full_name: Texas Instruments LP_EM_CC1354P10_1 Launchpad
  vendor: ti
  socs:
  - name: cc1354p10
```

## boards/ti/lp_em_cc1354p10_1/lp_em_cc1354p10_1_defconfig
```kconfig
# Copyright (c) 2026 Texas Instruments Incorporated
# SPDX-License-Identifier: Apache-2.0

CONFIG_BUILD_OUTPUT_HEX=y
CONFIG_ARM_MPU=n
CONFIG_HW_STACK_PROTECTION=y
```

## boards/ti/lp_em_cc2340r53/Kconfig
```kconfig
# Copyright (c) 2024 Texas Instruments Incorporated
#
# SPDX-License-Identifier: Apache-2.0

rsource "../lpf3_common/Kconfig"
```

## boards/ti/lp_em_cc2340r53/Kconfig.lp_em_cc2340r53
```kconfig
# Copyright (c) 2024 Texas Instruments Incorporated
# Copyright (c) 2024 BayLibre, SAS
#
# SPDX-License-Identifier: Apache-2.0

config BOARD_LP_EM_CC2340R53
	select SOC_CC2340R53
```

## boards/ti/lp_em_cc2340r53/board.yml
```yaml
board:
  name: lp_em_cc2340r53
  full_name: CC2340R53 LaunchPad
  vendor: ti
  socs:
    - name: cc2340r53
```
