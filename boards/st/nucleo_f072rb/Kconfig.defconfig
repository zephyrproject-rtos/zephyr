## boards/st/nucleo_f072rb/Kconfig.defconfig
```kconfig
# NUCLEO_F072RB board configuration

# Copyright (c) 2025 Alex Fabre
# SPDX-License-Identifier: Apache-2.0

if BOARD_NUCLEO_F072RB

config SPI_STM32_INTERRUPT
	default y
	depends on SPI

endif # BOARD_NUCLEO_F072RB
```

## boards/st/nucleo_f072rb/Kconfig.nucleo_f072rb
```kconfig
# Copyright (c) 2025 Alex Fabre
# SPDX-License-Identifier: Apache-2.0

config BOARD_NUCLEO_F072RB
	select SOC_STM32F072XB
```

## boards/st/nucleo_f072rb/board.yml
```yaml
board:
  name: nucleo_f072rb
  full_name: Nucleo F072RB
  vendor: st
  socs:
    - name: stm32f072xb
```

## boards/st/nucleo_f091rc/Kconfig.defconfig
```kconfig
# STM32 Nucleo-64 development board with STM32F091RC MCU

# Copyright (c) 2017 Bobby Noelte
# SPDX-License-Identifier: Apache-2.0

if BOARD_NUCLEO_F091RC

config SPI_STM32_INTERRUPT
	default y
	depends on SPI

endif # BOARD_NUCLEO_F091RC
```

## boards/st/nucleo_f091rc/Kconfig.nucleo_f091rc
```kconfig
# Copyright (c) 2017 Bobby Noelte
# SPDX-License-Identifier: Apache-2.0

config BOARD_NUCLEO_F091RC
	select SOC_STM32F091XC
```

## boards/st/nucleo_f091rc/board.yml
```yaml
board:
  name: nucleo_f091rc
  full_name: Nucleo F091RC
  vendor: st
  socs:
    - name: stm32f091xc
```

## boards/st/nucleo_f103rb/Kconfig.nucleo_f103rb
```kconfig
# Copyright (c) 2016 Open-RnD Sp. z o.o.
# SPDX-License-Identifier: Apache-2.0

config BOARD_NUCLEO_F103RB
	select SOC_STM32F103XB
```

## boards/st/nucleo_f103rb/board.yml
```yaml
board:
  name: nucleo_f103rb
  full_name: Nucleo F103RB
  vendor: st
  socs:
    - name: stm32f103xb
```

## boards/st/nucleo_f207zg/Kconfig.nucleo_f207zg
```kconfig
# Copyright (c) 2018 qianfan Zhao
# SPDX-License-Identifier: Apache-2.0

config BOARD_NUCLEO_F207ZG
	select SOC_STM32F207XX
```

## boards/st/nucleo_f207zg/board.yml
```yaml
board:
  name: nucleo_f207zg
  full_name: Nucleo F207ZG
  vendor: st
  socs:
    - name: stm32f207xx
```

## boards/st/nucleo_f207zg/nucleo_f207zg_defconfig
```kconfig
# SPDX-License-Identifier: Apache-2.0

CONFIG_SERIAL=y

# Enable MPU
CONFIG_ARM_MPU=y

# Enable HW stack protection
CONFIG_HW_STACK_PROTECTION=y

# console
CONFIG_CONSOLE=y
CONFIG_UART_CONSOLE=y

# enable GPIO
CONFIG_GPIO=y
```

## boards/st/nucleo_f302r8/Kconfig.nucleo_f302r8
```kconfig
# Copyright (c) 2018 Seitz & Associates
# SPDX-License-Identifier: Apache-2.0

config BOARD_NUCLEO_F302R8
	select SOC_STM32F302X8
```

## boards/st/nucleo_f303k8/Kconfig.nucleo_f303k8
```kconfig
# Copyright (c) 2020 Sebastian Schwabe <sebastian.schwabe@mailbox.tu-dresden.de>
# SPDX-License-Identifier: Apache-2.0

config BOARD_NUCLEO_F303K8
	select SOC_STM32F303X8
```

## boards/st/nucleo_f303k8/board.yml
```yaml
board:
  name: nucleo_f303k8
  full_name: Nucleo F303K8
  vendor: st
  socs:
    - name: stm32f303x8
```

## boards/st/nucleo_f303k8/nucleo_f303k8_defconfig
```kconfig
# SPDX-License-Identifier: Apache-2.0

CONFIG_SERIAL=y

# console
CONFIG_CONSOLE=y
CONFIG_UART_CONSOLE=y

# enable GPIO
CONFIG_GPIO=y
```

## boards/st/nucleo_f303re/Kconfig.nucleo_f303re
```kconfig
# Copyright (c) 2020 Paul M. Bendixen
# SPDX-License-Identifier: Apache-2.0

config BOARD_NUCLEO_F303RE
	select SOC_STM32F303XE
```

## boards/st/nucleo_f303re/board.yml
```yaml
board:
  name: nucleo_f303re
  full_name: Nucleo F303RE
  vendor: st
  socs:
    - name: stm32f303xe
```

## boards/st/nucleo_f334r8/Kconfig.nucleo_f334r8
```kconfig
# Copyright (c) 2016 RnDity Sp. z o.o.
# SPDX-License-Identifier: Apache-2.0

config BOARD_NUCLEO_F334R8
	select SOC_STM32F334X8
```

## boards/st/nucleo_f334r8/board.yml
```yaml
board:
  name: nucleo_f334r8
  full_name: Nucleo F334R8
  vendor: st
  socs:
    - name: stm32f334x8
```

## boards/st/nucleo_f401re/Kconfig.defconfig
```kconfig
# NUCLEO-64 F401RE board configuration

# Copyright (c) 2016 Linaro Limited.
# Copyright (c) 2019 Centaur Analytics, Inc
# SPDX-License-Identifier: Apache-2.0

if BOARD_NUCLEO_F401RE

config SPI_STM32_INTERRUPT
	default y
	depends on SPI

endif # BOARD_NUCLEO_F401RE
```

## boards/st/nucleo_f401re/Kconfig.nucleo_f401re
```kconfig
# Copyright (c) 2016 Linaro Limited.
# SPDX-License-Identifier: Apache-2.0

config BOARD_NUCLEO_F401RE
	select SOC_STM32F401XE
```

## boards/st/nucleo_f401re/board.yml
```yaml
board:
  name: nucleo_f401re
  full_name: Nucleo F401RE
  vendor: st
  socs:
    - name: stm32f401xe
```

## boards/st/nucleo_f410rb/Kconfig.nucleo_f410rb
```kconfig
# Copyright (c) 2020 Hans Unzner
# SPDX-License-Identifier: Apache-2.0

config BOARD_NUCLEO_F410RB
	select SOC_STM32F410RX
```

## boards/st/nucleo_f410rb/board.yml
```yaml
board:
  name: nucleo_f410rb
  full_name: Nucleo F410RB
  vendor: st
  socs:
    - name: stm32f410rx
```
