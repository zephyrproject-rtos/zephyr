## boards/st/stm32c0116_dk/board.yml
```yaml
board:
  name: stm32c0116_dk
  full_name: STM32C0116-DK Discovery Kit
  vendor: st
  socs:
    - name: stm32c011xx
```

## boards/st/stm32f072_eval/board.yml
```yaml
board:
  name: stm32f072_eval
  full_name: STM32F072 Evaluation
  vendor: st
  socs:
    - name: stm32f072xb
```

## boards/st/stm32f072b_disco/Kconfig.defconfig
```kconfig
# STM32F072B-DISCO board configuration

# Copyright (c) 2017 Clage GmbH
# SPDX-License-Identifier: Apache-2.0

if BOARD_STM32F072B_DISCO

config SPI_STM32_INTERRUPT
	default y
	depends on SPI

endif # BOARD_STM32F072B_DISCO
```

## boards/st/stm32f072b_disco/Kconfig.stm32f072b_disco
```kconfig
# Copyright (c) 2017 Clage GmbH
# SPDX-License-Identifier: Apache-2.0

config BOARD_STM32F072B_DISCO
	select SOC_STM32F072XB
```

## boards/st/stm32f072b_disco/board.yml
```yaml
board:
  name: stm32f072b_disco
  full_name: STM32F072B Discovery
  vendor: st
  socs:
    - name: stm32f072xb
```

## boards/st/stm32f0_disco/Kconfig.stm32f0_disco
```kconfig
# Copyright (c) 2018 Nathan Tsoi <nathan@vertile.com>
# SPDX-License-Identifier: Apache-2.0

config BOARD_STM32F0_DISCO
	select SOC_STM32F051X8
```

## boards/st/stm32f0_disco/board.yml
```yaml
board:
  name: stm32f0_disco
  full_name: STM32F0 Discovery
  vendor: st
  socs:
    - name: stm32f051x8
```

## boards/st/stm32f103_mini/Kconfig.stm32f103_mini
```kconfig
# Copyright (c) 2020 WuhanStudio
# SPDX-License-Identifier: Apache-2.0

config BOARD_STM32F103_MINI
	select SOC_STM32F103XE
```

## boards/st/stm32f3_disco/Kconfig.stm32f3_disco
```kconfig
# Copyright (c) 2017 I-SENSE group of ICCS
# SPDX-License-Identifier: Apache-2.0

config BOARD_STM32F3_DISCO
	select SOC_STM32F303XC
```

## boards/st/stm32f3_disco/board.yml
```yaml
board:
  name: stm32f3_disco
  full_name: STM32F3 Discovery
  vendor: st
  revision:
    format: letter
    default: "B"
    revisions:
      - name: "B"
      - name: "E"
  socs:
    - name: stm32f303xc
```

## boards/st/stm32f411e_disco/Kconfig.stm32f411e_disco
```kconfig
# Copyright (c) 2017 Fenix Engineering Solutions
# SPDX-License-Identifier: Apache-2.0

config BOARD_STM32F411E_DISCO
	select SOC_STM32F411XE
```

## boards/st/stm32f411e_disco/board.yml
```yaml
board:
  name: stm32f411e_disco
  full_name: STM32F411E Discovery
  vendor: st
  revision:
    format: letter
    default: "D"
    revisions:
      - name: "B"
      - name: "D"
  socs:
    - name: stm32f411xe
```

## boards/st/stm32f411e_disco/stm32f411e_disco_defconfig
```kconfig
# SPDX-License-Identifier: Apache-2.0

# Enable MPU
CONFIG_ARM_MPU=y

# Enable HW stack protection
CONFIG_HW_STACK_PROTECTION=y

# Serial Drivers
CONFIG_SERIAL=y
CONFIG_UART_INTERRUPT_DRIVEN=y
CONFIG_CONSOLE=y
CONFIG_UART_CONSOLE=y

# enable GPIO
CONFIG_GPIO=y
```

## boards/st/stm32f412g_disco/Kconfig.stm32f412g_disco
```kconfig
# Copyright (c) 2017 Powersoft
# SPDX-License-Identifier: Apache-2.0

config BOARD_STM32F412G_DISCO
	select SOC_STM32F412ZX
```

## boards/st/stm32f412g_disco/board.yml
```yaml
board:
  name: stm32f412g_disco
  full_name: STM32F412G Discovery
  vendor: st
  socs:
    - name: stm32f412zx
```

## boards/st/stm32f413h_disco/Kconfig.stm32f413h_disco
```kconfig
# Copyright (c) 2024 STMicroelectronics
# SPDX-License-Identifier: Apache-2.0

config BOARD_STM32F413H_DISCO
	select SOC_STM32F413XX
```

## boards/st/stm32f413h_disco/board.yml
```yaml
board:
  name: stm32f413h_disco
  full_name: STM32F413H Discovery
  vendor: st
  socs:
    - name: stm32f413xx
```

## boards/st/stm32f413h_disco/stm32f413h_disco_defconfig
```kconfig
# SPDX-License-Identifier: Apache-2.0

# Enable MPU
CONFIG_ARM_MPU=y

# Enable HW stack protection
CONFIG_HW_STACK_PROTECTION=y

CONFIG_SERIAL=y

# Console
CONFIG_CONSOLE=y
CONFIG_UART_CONSOLE=y

# Enable GPIO ports A, B, C, D, E, F, G, H
CONFIG_GPIO=y
```

## boards/st/stm32f429i_disc1/Kconfig.stm32f429i_disc1
```kconfig
# Copyright (c) 2016 Linaro Limited.
# SPDX-License-Identifier: Apache-2.0

config BOARD_STM32F429I_DISC1
	select SOC_STM32F429XX
```

## boards/st/stm32f429i_disc1/board.yml
```yaml
board:
  name: stm32f429i_disc1
  full_name: STM32F429I Discovery
  vendor: st
  socs:
    - name: stm32f429xx
```

## boards/st/stm32f469i_disco/Kconfig.defconfig
```kconfig
# STM32F469I-DISCO board configuration

# Copyright (c) 2016 Linaro Limited.
# SPDX-License-Identifier: Apache-2.0

if BOARD_STM32F469I_DISCO

config SPI_STM32_INTERRUPT
	default y
	depends on SPI

if LVGL

# Double frame buffer maintained by lvgl.
config STM32_LTDC_FB_NUM
	default 0

config LV_Z_DOUBLE_VDB
	default y

config LV_Z_VDB_ZEPHYR_REGION
	default y

config LV_Z_VDB_ZEPHYR_REGION_NAME
	default "SDRAM1"

config LV_Z_FULL_REFRESH
	default y

config LV_Z_BITS_PER_PIXEL
	default 32

config LV_DPI_DEF
	default 128

config LV_Z_FLUSH_THREAD
	default y

choice LV_COLOR_DEPTH
	default LV_COLOR_DEPTH_32
endchoice

endif #LVGL
endif # BOARD_STM32F469I_DISCO
```

## boards/st/stm32f469i_disco/Kconfig.stm32f469i_disco
```kconfig
# Copyright (c) 2016 Linaro Limited.
# SPDX-License-Identifier: Apache-2.0

config BOARD_STM32F469I_DISCO
	select SOC_STM32F469XX
```

## boards/st/stm32f469i_disco/board.yml
```yaml
board:
  name: stm32f469i_disco
  full_name: STM32F469I Discovery
  vendor: st
  socs:
    - name: stm32f469xx
      variants:
        - name: au1       # This variant uses the newer nt35510 device for the screen
```

## boards/st/stm32f469i_disco/stm32f469i_disco_stm32f469xx_au1_defconfig
```kconfig
# SPDX-License-Identifier: Apache-2.0

# Enable MPU
CONFIG_ARM_MPU=y

# Enable HW stack protection
CONFIG_HW_STACK_PROTECTION=y

# Enable UART
CONFIG_SERIAL=y

# Enable console
CONFIG_CONSOLE=y
CONFIG_UART_CONSOLE=y

# Enable GPIO
CONFIG_GPIO=y

# Enable external Memory
CONFIG_MEMC=y

# Configure display
CONFIG_STM32_LTDC_ARGB8888=y
```
