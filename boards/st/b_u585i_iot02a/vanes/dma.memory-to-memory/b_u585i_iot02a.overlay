/*
 * SPDX-License-Identifier: Apache-2.0
 *
 * Copyright (c) Benjamin Björnsson <benjamin.bjornsson@gmail.com>
 */

/ {
	dma_test_gpdma1: dma-test-gpdma1 {
		compatible = "test-dma-memory-to-memory";
		dma = <&gpdma1>;
		channels = <5 10 2>;
	};
};

&gpdma1 {
	status = "okay";
};
