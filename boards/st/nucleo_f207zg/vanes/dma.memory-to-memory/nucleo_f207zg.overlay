/*
 * SPDX-License-Identifier: Apache-2.0
 *
 * Copyright (c) Benjamin Björnsson <benjamin.bjornsson@gmail.com>
 */

/ {
	dma_test_dma2: dma-test-dma2 {
		compatible = "test-dma-memory-to-memory";
		dma = <&dma2>;
		channels = <1 2 0>;
	};
};

&dma2 {
	status = "okay";
};

&dma1 {
	status = "okay";
};
