## boards/st/nucleo_f746zg/board.yml
```yaml
board:
  name: nucleo_f746zg
  full_name: Nucleo F746ZG
  vendor: st
  socs:
    - name: stm32f746xx
```

## boards/st/nucleo_f756zg/Kconfig.nucleo_f756zg
```kconfig
# Copyright (c) 2018 AJ Palmer
# SPDX-License-Identifier: Apache-2.0

config BOARD_NUCLEO_F756ZG
	select SOC_STM32F756XX
```

## boards/st/nucleo_f756zg/board.yml
```yaml
board:
  name: nucleo_f756zg
  full_name: Nucleo F756ZG
  vendor: st
  socs:
    - name: stm32f756xx
```

## boards/st/nucleo_f767zi/Kconfig.nucleo_f767zi
```kconfig
# Copyright (c) 2019 Roland Ma
# SPDX-License-Identifier: Apache-2.0

config BOARD_NUCLEO_F767ZI
	select SOC_STM32F767XX
```

## boards/st/nucleo_f767zi/board.yml
```yaml
board:
  name: nucleo_f767zi
  full_name: Nucleo F767ZI
  vendor: st
  socs:
    - name: stm32f767xx
```

## boards/st/nucleo_g031k8/Kconfig.nucleo_g031k8
```kconfig
# Copyright (c) 2022 Joylab AG <team@joylab.ch>
# SPDX-License-Identifier: Apache-2.0

config BOARD_NUCLEO_G031K8
	select SOC_STM32G031XX
```

## boards/st/nucleo_g031k8/board.yml
```yaml
board:
  name: nucleo_g031k8
  full_name: Nucleo G031K8
  vendor: st
  socs:
    - name: stm32g031xx
```

## boards/st/nucleo_g070rb/Kconfig.nucleo_g070rb
```kconfig
# Copyright (c) 2023 Marin Jurjević <marin.jurjevic@hotmail.com>
# SPDX-License-Identifier: Apache-2.0

config BOARD_NUCLEO_G070RB
	select SOC_STM32G070XX
```

## boards/st/nucleo_g070rb/board.yml
```yaml
board:
  name: nucleo_g070rb
  full_name: Nucleo G070RB
  vendor: st
  socs:
    - name: stm32g070xx
```

## boards/st/nucleo_g071rb/Kconfig.nucleo_g071rb
```kconfig
# Copyright (c) 2019 STMicroelectronics
# SPDX-License-Identifier: Apache-2.0

config BOARD_NUCLEO_G071RB
	select SOC_STM32G071XX
```

## boards/st/nucleo_g071rb/board.yml
```yaml
board:
  name: nucleo_g071rb
  full_name: Nucleo G071RB
  vendor: st
  socs:
    - name: stm32g071xx
```

## boards/st/nucleo_g0b1re/Kconfig.nucleo_g0b1re
```kconfig
# Copyright (c) 2019 Thomas Stranger
# SPDX-License-Identifier: Apache-2.0

config BOARD_NUCLEO_G0B1RE
	select SOC_STM32G0B1XX
```

## boards/st/nucleo_g0b1re/board.yml
```yaml
board:
  name: nucleo_g0b1re
  full_name: Nucleo G0B1RE
  vendor: st
  socs:
    - name: stm32g0b1xx
```

## boards/st/nucleo_g0b1re/nucleo_g0b1re_defconfig
```kconfig
# Enable MPU
CONFIG_ARM_MPU=y

# Serial Drivers
CONFIG_SERIAL=y
CONFIG_UART_INTERRUPT_DRIVEN=y
# enable console
CONFIG_CONSOLE=y
CONFIG_UART_CONSOLE=y

# GPIO Controller
CONFIG_GPIO=y

# Enable Clocks
CONFIG_CLOCK_CONTROL=y

# enable pin controller
CONFIG_PINCTRL=y
```

## boards/st/nucleo_g431kb/Kconfig.nucleo_g431kb
```kconfig
# Copyright (c) 2024 Klaus Nagel <nagelkl01@gmail.com>
# SPDX-License-Identifier: Apache-2.0

config BOARD_NUCLEO_G431KB
	select SOC_STM32G431XX
```

## boards/st/nucleo_g431kb/board.yml
```yaml
board:
  name: nucleo_g431kb
  full_name: Nucleo G431KB
  vendor: st
  socs:
    - name: stm32g431xx
```

## boards/st/nucleo_g431kb/nucleo_g431kb_defconfig
```kconfig
# SPDX-License-Identifier: Apache-2.0

# Serial drivers
CONFIG_SERIAL=y
CONFIG_UART_INTERRUPT_DRIVEN=y

# enable GPIO
CONFIG_GPIO=y

# Console
CONFIG_CONSOLE=y
CONFIG_UART_CONSOLE=y

# Enable MPU
CONFIG_ARM_MPU=y

# Enable HW stack protection
CONFIG_HW_STACK_PROTECTION=y
```

## boards/st/nucleo_g431rb/Kconfig.defconfig
```kconfig
# STM32G431RB Nucleo board configuration

# Copyright (c) 2019 Richard Osterloh <richard.osterloh@gmail.com>
# SPDX-License-Identifier: Apache-2.0

if BOARD_NUCLEO_G431RB

config SPI_STM32_INTERRUPT
	default y
	depends on SPI

endif # BOARD_NUCLEO_G431RB
```

## boards/st/nucleo_g431rb/Kconfig.nucleo_g431rb
```kconfig
# Copyright (c) 2019 Richard Osterloh <richard.osterloh@gmail.com>
# SPDX-License-Identifier: Apache-2.0

config BOARD_NUCLEO_G431RB
	select SOC_STM32G431XX
```

## boards/st/nucleo_g431rb/board.yml
```yaml
board:
  name: nucleo_g431rb
  full_name: Nucleo G431RB
  vendor: st
  socs:
    - name: stm32g431xx
```

## boards/st/nucleo_g474re/Kconfig.nucleo_g474re
```kconfig
# Copyright (c) 2019 STMicroelectronics.
# SPDX-License-Identifier: Apache-2.0

config BOARD_NUCLEO_G474RE
	select SOC_STM32G474XX
```

## boards/st/nucleo_g474re/board.yml
```yaml
board:
  name: nucleo_g474re
  full_name: Nucleo G474RE
  vendor: st
  socs:
    - name: stm32g474xx
```

## boards/st/nucleo_g491re/Kconfig.defconfig
```kconfig
# STM32G491RE Nucleo board configuration

# Copyright (c) 2026 Lennart Rittel <lrittel@posteo.de>
# SPDX-License-Identifier: Apache-2.0

if BOARD_NUCLEO_G491RE

config SPI_STM32_INTERRUPT
	default y
	depends on SPI

endif # BOARD_NUCLEO_G491RE
```

## boards/st/nucleo_g491re/Kconfig.nucleo_g491re
```kconfig
# Copyright (c) 2026 Lennart Rittel <lrittel@posteo.de>
# SPDX-License-Identifier: Apache-2.0

config BOARD_NUCLEO_G491RE
	select SOC_STM32G491XX
```

## boards/st/nucleo_g491re/board.yml
```yaml
board:
  name: nucleo_g491re
  full_name: Nucleo G491RE
  vendor: st
  socs:
    - name: stm32g491xx
```
