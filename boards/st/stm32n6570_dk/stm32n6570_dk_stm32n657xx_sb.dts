/*
 * Copyright (c) 2025 STMicroelectronics
 *
 * SPDX-License-Identifier: Apache-2.0
 */

/dts-v1/;
#include "stm32n6570_dk_common.dtsi"

/ {
	model = "STMicroelectronics STM32N6570 Discovery Kit board";
	compatible = "st,stm32n6570-dk-serial-boot";

	chosen {
		zephyr,flash-controller = &mx66uw1g45g_xspi2;
		zephyr,flash = &mx66uw1g45g_xspi2;
	};

};

&xspi2 {
	status = "okay";
};

&mx66uw1g45g_xspi2{
	#include "partitions.dtsi"
};
