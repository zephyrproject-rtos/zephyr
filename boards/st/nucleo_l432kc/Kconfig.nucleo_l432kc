## boards/st/nucleo_l432kc/Kconfig.nucleo_l432kc
```kconfig
# Copyright (c) 2016 BayLibre, SAS
# SPDX-License-Identifier: Apache-2.0

config BOARD_NUCLEO_L432KC
	select SOC_STM32L432XX
```

## boards/st/nucleo_l432kc/board.yml
```yaml
board:
  name: nucleo_l432kc
  full_name: Nucleo L432KC
  vendor: st
  socs:
    - name: stm32l432xx
```

## boards/st/nucleo_l433rc_p/Kconfig.defconfig
```kconfig
# STM32L433RC Nucleo board configuration

# Copyright (c) 2021 Matija Tudan
# SPDX-License-Identifier: Apache-2.0

if BOARD_NUCLEO_L433RC_P

config SPI_STM32_INTERRUPT
	default y
	depends on SPI

endif # BOARD_NUCLEO_L433RC_P
```

## boards/st/nucleo_l433rc_p/Kconfig.nucleo_l433rc_p
```kconfig
# Copyright (c) 2021 Matija Tudan
# SPDX-License-Identifier: Apache-2.0

config BOARD_NUCLEO_L433RC_P
	select SOC_STM32L433XX
```

## boards/st/nucleo_l433rc_p/board.yml
```yaml
board:
  name: nucleo_l433rc_p
  full_name: Nucleo L433RC
  vendor: st
  socs:
    - name: stm32l433xx
```

## boards/st/nucleo_l452re/Kconfig.defconfig
```kconfig
# STM32L452RE Nucleo board configuration
#
# Copyright (c) 2019 Libre Solar Technologies GmbH
#
# SPDX-License-Identifier: Apache-2.0

if BOARD_NUCLEO_L452RE

config SPI_STM32_INTERRUPT
	default y
	depends on SPI

endif # BOARD_NUCLEO_L452RE
```

## boards/st/nucleo_l452re/Kconfig.nucleo_l452re
```kconfig
# Copyright (c) 2019 Libre Solar Technologies GmbH
# SPDX-License-Identifier: Apache-2.0

config BOARD_NUCLEO_L452RE
	select SOC_STM32L452XX
```

## boards/st/nucleo_l452re/board.yml
```yaml
board:
  name: nucleo_l452re
  full_name: Nucleo L452RE
  vendor: st
  socs:
    - name: stm32l452xx
      variants:
        - name: p
```

## boards/st/nucleo_l476rg/Kconfig.defconfig
```kconfig
# STM32L476RG Nucleo board configuration

# Copyright (c) 2016 Open-RnD Sp. z o.o.
# Copyright (c) 2016 BayLibre, SAS
# SPDX-License-Identifier: Apache-2.0

if BOARD_NUCLEO_L476RG

config SPI_STM32_INTERRUPT
	default y
	depends on SPI

endif # BOARD_NUCLEO_L476RG
```

## boards/st/nucleo_l476rg/Kconfig.nucleo_l476rg
```kconfig
# Copyright (c) 2016 BayLibre, SAS
# SPDX-License-Identifier: Apache-2.0

config BOARD_NUCLEO_L476RG
	select SOC_STM32L476XX
```

## boards/st/nucleo_l476rg/board.yml
```yaml
board:
  name: nucleo_l476rg
  full_name: Nucleo L476RG
  vendor: st
  socs:
    - name: stm32l476xx
```

## boards/st/nucleo_l476rg/nucleo_l476rg_defconfig
```kconfig
# SPDX-License-Identifier: Apache-2.0

# enable uart driver
CONFIG_SERIAL=y

# enable GPIO
CONFIG_GPIO=y

# enable clocks
CONFIG_CLOCK_CONTROL=y

# console
CONFIG_CONSOLE=y
CONFIG_UART_CONSOLE=y

#enable MPU
CONFIG_ARM_MPU=y

# Enable HW stack protection
CONFIG_HW_STACK_PROTECTION=y

# enable pin controller
CONFIG_PINCTRL=y
```

## boards/st/nucleo_l496zg/Kconfig.nucleo_l496zg
```kconfig
# Copyright (c) 2018-2019 Centaur Analytics, Inc
# SPDX-License-Identifier: Apache-2.0

config BOARD_NUCLEO_L496ZG
	select SOC_STM32L496XX
```

## boards/st/nucleo_l496zg/board.yml
```yaml
board:
  name: nucleo_l496zg
  full_name: Nucleo L496ZG
  vendor: st
  socs:
    - name: stm32l496xx
```

## boards/st/nucleo_l4a6zg/Kconfig.defconfig
```kconfig
# STM32L4A6ZG Nucleo board configuration

# Copyright (c) 2022 Tomislav Milkovic
# SPDX-License-Identifier: Apache-2.0

if BOARD_NUCLEO_L4A6ZG

config SPI_STM32_INTERRUPT
	default y
	depends on SPI

endif # BOARD_NUCLEO_L4A6ZG
```

## boards/st/nucleo_l4a6zg/Kconfig.nucleo_l4a6zg
```kconfig
# Copyright (c) 2022 Tomislav Milkovic
# SPDX-License-Identifier: Apache-2.0

config BOARD_NUCLEO_L4A6ZG
	select SOC_STM32L4A6XX
```

## boards/st/nucleo_l4a6zg/board.yml
```yaml
board:
  name: nucleo_l4a6zg
  full_name: Nucleo L4A6ZG
  vendor: st
  socs:
    - name: stm32l4a6xx
```

## boards/st/nucleo_l4r5zi/Kconfig.defconfig
```kconfig
# STM32L4R5ZI Nucleo board configuration

# Copyright (c) 2018 Pushpal Sidhu
# SPDX-License-Identifier: Apache-2.0

if BOARD_NUCLEO_L4R5ZI

config SPI_STM32_INTERRUPT
	default y
	depends on SPI

endif # BOARD_NUCLEO_L4R5ZI
```

## boards/st/nucleo_l4r5zi/Kconfig.nucleo_l4r5zi
```kconfig
# Copyright (c) 2018 Pushpal Sidhu
# SPDX-License-Identifier: Apache-2.0

config BOARD_NUCLEO_L4R5ZI
	select SOC_STM32L4R5XX
```

## boards/st/nucleo_l4r5zi/board.yml
```yaml
board:
  name: nucleo_l4r5zi
  full_name: Nucleo L4R5ZI
  vendor: st
  socs:
    - name: stm32l4r5xx
```

## boards/st/nucleo_l552ze_q/Kconfig.defconfig
```kconfig
# STM32L552ZE-Q Nucleo board configuration

# Copyright (c) 2024 STMicroelectronics
# SPDX-License-Identifier: Apache-2.0

if BOARD_NUCLEO_L552ZE_Q

if BUILD_WITH_TFM

# Not defining LIBC malloc arena has the effect of declaring all available RAM
# as available for malloc.
# This currently conflicts with TF-M MPU setting, resulting in a hard fault.
# Define a specific size to avoid this situation.

config COMMON_LIBC_MALLOC_ARENA_SIZE
	default 2048

endif # BUILD_WITH_TFM

endif # BOARD_NUCLEO_L552ZE_Q
```

## boards/st/nucleo_l552ze_q/Kconfig.nucleo_l552ze_q
```kconfig
# Copyright (c) 2020 Linaro Limited
# SPDX-License-Identifier: Apache-2.0

config BOARD_NUCLEO_L552ZE_Q
	select SOC_STM32L552XX
```

## boards/st/nucleo_l552ze_q/board.yml
```yaml
board:
  name: nucleo_l552ze_q
  full_name: Nucleo L552ZE Q
  vendor: st
  socs:
    - name: stm32l552xx
      variants:
        - name: ns
```

## boards/st/nucleo_l552ze_q/nucleo_l552ze_q_stm32l552xx_ns_defconfig
```kconfig
# SPDX-License-Identifier: Apache-2.0

# enable uart driver
CONFIG_SERIAL=y

# enable GPIO
CONFIG_GPIO=y

# Enable clock
CONFIG_CLOCK_CONTROL=y

# console
CONFIG_CONSOLE=y
CONFIG_UART_CONSOLE=y

# Enable MPU
CONFIG_ARM_MPU=y

CONFIG_ARM_TRUSTZONE_M=y
CONFIG_RUNTIME_NMI=y
CONFIG_TRUSTED_EXECUTION_NONSECURE=y

# enable pin controller
CONFIG_PINCTRL=y
```

## boards/st/nucleo_n657x0_q/Kconfig.defconfig
```kconfig
# STM32N657X0_Q Nucleo board configuration

# Copyright (c) 2025 STMicroelectronics
# SPDX-License-Identifier: Apache-2.0

if BOARD_NUCLEO_N657X0_Q

configdefault NET_L2_ETHERNET
	default y

configdefault OTP
	default y if ETH_STM32_HAL && NVMEM

endif # BOARD_NUCLEO_N657X0_Q
```
