## boards/st/disco_l475_iot1/disco_l475_iot1_defconfig
```kconfig
# SPDX-License-Identifier: Apache-2.0

# enable uart driver
CONFIG_SERIAL=y
CONFIG_UART_INTERRUPT_DRIVEN=y

# enable GPIO
CONFIG_GPIO=y

# console
CONFIG_CONSOLE=y
CONFIG_UART_CONSOLE=y

# enable MPU
CONFIG_ARM_MPU=y

# Enable HW stack protection
CONFIG_HW_STACK_PROTECTION=y
```

## boards/st/nucleo_c031c6/Kconfig.nucleo_c031c6
```kconfig
# Copyright (c) 2023 Benjamin Björnsson <benjamin.bjornsson@gmail.com>
# SPDX-License-Identifier: Apache-2.0

config BOARD_NUCLEO_C031C6
	select SOC_STM32C031XX
```

## boards/st/nucleo_c031c6/board.yml
```yaml
board:
  name: nucleo_c031c6
  full_name: Nucleo C031C6
  vendor: st
  socs:
    - name: stm32c031xx
```

## boards/st/nucleo_c071rb/Kconfig.nucleo_c071rb
```kconfig
# Copyright (c) 2024 STMicroelectronics
# SPDX-License-Identifier: Apache-2.0

config BOARD_NUCLEO_C071RB
	select SOC_STM32C071XX
```

## boards/st/nucleo_c071rb/board.yml
```yaml
board:
  name: nucleo_c071rb
  full_name: Nucleo C071RB
  vendor: st
  socs:
    - name: stm32c071xx
```

## boards/st/nucleo_c092rc/Kconfig.nucleo_c092rc
```kconfig
# Copyright (c) 2025 Thomas Stranger
# SPDX-License-Identifier: Apache-2.0

config BOARD_NUCLEO_C092RC
	select SOC_STM32C092XX
```

## boards/st/nucleo_c092rc/board.yml
```yaml
board:
  name: nucleo_c092rc
  full_name: Nucleo C092RC
  vendor: st
  socs:
    - name: stm32c092xx
```

## boards/st/nucleo_c092rc/nucleo_c092rc_defconfig
```kconfig
# SPDX-License-Identifier: Apache-2.0

# Enable serial
CONFIG_SERIAL=y
CONFIG_UART_INTERRUPT_DRIVEN=y

# Enable console
CONFIG_CONSOLE=y
CONFIG_UART_CONSOLE=y

# Enable GPIO
CONFIG_GPIO=y
```

## boards/st/nucleo_c542rc/Kconfig.nucleo_c542rc
```kconfig
# Copyright (c) 2026 STMicroelectronics
# SPDX-License-Identifier: Apache-2.0

config BOARD_NUCLEO_C542RC
	select SOC_STM32C542XX
```

## boards/st/nucleo_c542rc/board.yml
```yaml
board:
  name: nucleo_c542rc
  full_name: Nucleo C542RC
  vendor: st
  socs:
    - name: stm32c542xx
```

## boards/st/nucleo_c562re/Kconfig.nucleo_c562re
```kconfig
# Copyright (c) 2026 STMicroelectronics
# SPDX-License-Identifier: Apache-2.0

config BOARD_NUCLEO_C562RE
	select SOC_STM32C562XX
```

## boards/st/nucleo_c562re/board.yml
```yaml
board:
  name: nucleo_c562re
  full_name: Nucleo C562RE
  vendor: st
  socs:
    - name: stm32c562xx
```

## boards/st/nucleo_c5a3zg/Kconfig.nucleo_c5a3zg
```kconfig
# Copyright (c) 2026 STMicroelectronics
# SPDX-License-Identifier: Apache-2.0

config BOARD_NUCLEO_C5A3ZG
	select SOC_STM32C5A3XX
```

## boards/st/nucleo_c5a3zg/board.yml
```yaml
board:
  name: nucleo_c5a3zg
  full_name: Nucleo C5A3ZG
  vendor: st
  socs:
    - name: stm32c5a3xx
```

## boards/st/nucleo_f030r8/Kconfig.nucleo_f030r8
```kconfig
# Copyright (c) 2017 RnDity Sp. z o.o.
# SPDX-License-Identifier: Apache-2.0

config BOARD_NUCLEO_F030R8
	select SOC_STM32F030X8
```

## boards/st/nucleo_f030r8/board.yml
```yaml
board:
  name: nucleo_f030r8
  full_name: Nucleo F030R8
  vendor: st
  revision:
    format: number
    default: "1"
    revisions:
      - name: "1"
      - name: "2"
  socs:
    - name: stm32f030x8
```

## boards/st/nucleo_f031k6/Kconfig.nucleo_f031k6
```kconfig
# Copyright (c) 2021 Sebastian Schwabe <sebastian.schwabe@mailbox.tu-dresden.de>
# SPDX-License-Identifier: Apache-2.0

config BOARD_NUCLEO_F031K6
	select SOC_STM32F031X6
```

## boards/st/nucleo_f031k6/board.yml
```yaml
board:
  name: nucleo_f031k6
  full_name: Nucleo F031K6
  vendor: st
  socs:
    - name: stm32f031x6
```

## boards/st/nucleo_f031k6/nucleo_f031k6_defconfig
```kconfig
# SPDX-License-Identifier: Apache-2.0

CONFIG_LOG_BUFFER_SIZE=256
# Prevent Interrupt Vector Table in RAM
CONFIG_SRAM_VECTOR_TABLE=n

# Serial Drivers
CONFIG_SERIAL=y
CONFIG_UART_INTERRUPT_DRIVEN=y
# enable console
CONFIG_CONSOLE=y
CONFIG_UART_CONSOLE=y

# GPIO Controller
CONFIG_GPIO=y
```

## boards/st/nucleo_f042k6/Kconfig.nucleo_f042k6
```kconfig
# Copyright (c) 2023 STMicroelectronics
# SPDX-License-Identifier: Apache-2.0

config BOARD_NUCLEO_F042K6
	select SOC_STM32F042X6
```

## boards/st/nucleo_f042k6/board.yml
```yaml
board:
  name: nucleo_f042k6
  full_name: Nucleo F042K6
  vendor: st
  socs:
    - name: stm32f042x6
```

## boards/st/nucleo_f042k6/nucleo_f042k6_defconfig
```kconfig
# SPDX-License-Identifier: Apache-2.0

# Serial Drivers
CONFIG_SERIAL=y
CONFIG_UART_INTERRUPT_DRIVEN=y
# enable console
CONFIG_CONSOLE=y
CONFIG_UART_CONSOLE=y

# GPIO Controller
CONFIG_GPIO=y
```

## boards/st/nucleo_f070rb/Kconfig.defconfig
```kconfig
# NUCLEO_F070RB board configuration

# Copyright (c) 2018 qianfan Zhao
# SPDX-License-Identifier: Apache-2.0

if BOARD_NUCLEO_F070RB

config SPI_STM32_INTERRUPT
	default y
	depends on SPI

endif # BOARD_NUCLEO_F070RB
```

## boards/st/nucleo_f070rb/Kconfig.nucleo_f070rb
```kconfig
# Copyright (c) 2018 qianfan Zhao
# SPDX-License-Identifier: Apache-2.0

config BOARD_NUCLEO_F070RB
	select SOC_STM32F070XB
```

## boards/st/nucleo_f070rb/board.yml
```yaml
board:
  name: nucleo_f070rb
  full_name: Nucleo F070RB
  vendor: st
  socs:
    - name: stm32f070xb
```
