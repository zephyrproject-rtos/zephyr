## boards/st/nucleo_h5e5zj/board.yml
```yaml
# SPDX-FileCopyrightText: Copyright The Zephyr Project Contributors
# SPDX-License-Identifier: Apache-2.0

board:
  name: nucleo_h5e5zj
  full_name: Nucleo H5E5ZJ
  vendor: st
  socs:
    - name: stm32h5e5xx
```

## boards/st/nucleo_h745zi_q/Kconfig.defconfig
```kconfig
# STM32H745ZI Nucleo board configuration

# Copyright (c) 2020 Alexander Kozhinov <ak.alexander.kozhinov@gmail.com>
# SPDX-License-Identifier: Apache-2.0

if BOARD_NUCLEO_H745ZI_Q

configdefault ETH_DRIVER
	default y

endif # BOARD_NUCLEO_H745ZI_Q
```

## boards/st/nucleo_h7p5ii/Kconfig.nucleo_h7p5ii
```kconfig
# SPDX-FileCopyrightText: Copyright (c) 2026 STMicroelectronics
# SPDX-License-Identifier: Apache-2.0

config BOARD_NUCLEO_H7P5II
	select SOC_STM32H7P5XX
```

## boards/st/nucleo_h7p5ii/board.yml
```yaml
# SPDX-FileCopyrightText: Copyright (c) 2026 STMicroelectronics
# SPDX-License-Identifier: Apache-2.0

board:
  name: nucleo_h7p5ii
  full_name: Nucleo H7P5II
  vendor: st
  socs:
    - name: stm32h7p5xx
```

## boards/st/nucleo_n657x0_q/Kconfig
```kconfig
# Copyright (c) 2026 Lubor Witkowski
# SPDX-License-Identifier: Apache-2.0

config BOARD_NUCLEO_N657X0_Q
	select BOARD_EARLY_INIT_HOOK
```

## boards/st/nucleo_wl33cc1/board.yml
```yaml
board:
  name: nucleo_wl33cc1
  full_name: Nucleo WL33CC1
  vendor: st
  socs:
    - name: stm32wl33xx
```

## boards/st/sensortile_box/Kconfig.defconfig
```kconfig
# SensorTile.box board configuration

# Copyright (c) 2019 STMicroelectronics
# SPDX-License-Identifier: Apache-2.0

if BOARD_SENSORTILE_BOX

if BT

config BT_BLUENRG_ACI
	default y
# Disable Flow control
config BT_HCI_ACL_FLOW_CONTROL
	default n
config BT_HCI_VS
	default n

endif # BT

endif # BOARD_SENSORTILE_BOX
```

## boards/st/sensortile_box_pro/Kconfig.defconfig
```kconfig
# SENSORTILE_BOX_PRO board configuration

# Copyright (c) 2023 STMicroelectronics
# SPDX-License-Identifier: Apache-2.0

if BOARD_SENSORTILE_BOX_PRO

if BT

config BT_BLUENRG_ACI
	default y

# Disable Flow control
config BT_HCI_ACL_FLOW_CONTROL
	default n

endif # BT

source "boards/common/usb/Kconfig.cdc_acm_serial.defconfig"

endif # BOARD_SENSORTILE_BOX_PRO
```

## boards/st/stm32_micrium/Kconfig.defconfig
```kconfig
# SPDX-FileCopyrightText: Copyright The Zephyr Project Contributors
# SPDX-License-Identifier: Apache-2.0

if BOARD_STM32_MICRIUM

configdefault ETH_DRIVER
	default y

endif # BOARD_STM32_MICRIUM
```

## boards/st/stm32_micrium/Kconfig.stm32_micrium
```kconfig
# SPDX-FileCopyrightText: Copyright The Zephyr Project Contributors
# SPDX-License-Identifier: Apache-2.0

config BOARD_STM32_MICRIUM
	select SOC_STM32F107XC
```

## boards/st/stm32_micrium/board.yml
```yaml
board:
  name: stm32_micrium
  full_name: STM32-MICRIUM
  vendor: st
  socs:
    - name: stm32f107xc
```

## boards/st/stm32_micrium/stm32_micrium_defconfig
```kconfig
# SPDX-FileCopyrightText: Copyright The Zephyr Project Contributors
# SPDX-License-Identifier: Apache-2.0

# Enable uart driver
CONFIG_SERIAL=y

# Console
CONFIG_CONSOLE=y
CONFIG_UART_CONSOLE=y
```

## boards/st/stm32f429i_disc1/Kconfig.defconfig
```kconfig
# STM32F4DISCOVERY board configuration

# Copyright (c) 2016 Linaro Limited.
# SPDX-License-Identifier: Apache-2.0

if BOARD_STM32F429I_DISC1

config MEMC
	default y if STM32_LTDC

if LVGL

# Let LVGL fully handle the buffers
configdefault STM32_LTDC_FB_NUM
	default 0

configdefault LV_Z_VDB_ZEPHYR_REGION
	default y
configdefault LV_Z_VDB_ZEPHYR_REGION_NAME
	default "SDRAM2"
configdefault LV_Z_DOUBLE_VDB
	default y

choice LV_Z_RENDERING_MODE
	default LV_Z_DIRECT_RENDERING
endchoice

endif # LVGL

endif # BOARD_STM32F429I_DISC1
```

## boards/st/stm32f769i_disco/Kconfig.defconfig
```kconfig
# STM32F769I DISCOVERY board configuration

# Copyright (c) 2018 Yong Jin
# SPDX-License-Identifier: Apache-2.0

if BOARD_STM32F769I_DISCO

configdefault ETH_DRIVER
	default y

if LVGL

# Let LVGL fully handle the buffers
configdefault STM32_LTDC_FB_NUM
	default 0

configdefault LV_Z_VDB_ZEPHYR_REGION
	default y
configdefault LV_Z_VDB_ZEPHYR_REGION_NAME
	default "SDRAM1"
configdefault LV_Z_DOUBLE_VDB
	default y

choice LV_Z_RENDERING_MODE
	default LV_Z_DIRECT_RENDERING
endchoice

endif # LVGL

endif # BOARD_STM32F769I_DISCO
```

## boards/st/stm32f769i_eval/Kconfig.defconfig
```kconfig
# STM32F769I EVAL board configuration

# SPDX-FileCopyrightText: Copyright 2026 STMicroelectronics
# SPDX-License-Identifier: Apache-2.0

if BOARD_STM32F769I_EVAL

configdefault MEMC
	default y if STM32_LTDC

endif # BOARD_STM32F769I_EVAL
```

## boards/st/stm32f769i_eval/Kconfig.stm32f769i_eval
```kconfig
# SPDX-FileCopyrightText: Copyright 2026 STMicroelectronics
# SPDX-License-Identifier: Apache-2.0

config BOARD_STM32F769I_EVAL
	select SOC_STM32F769XX
```

## boards/st/stm32f769i_eval/board.yml
```yaml
board:
  name: stm32f769i_eval
  full_name: STM32F769I Evaluation
  vendor: st
  socs:
    - name: stm32f769xx
```

## boards/st/stm32h573i_dk/Kconfig
```kconfig
# SPDX-FileCopyrightText: Copyright The Zephyr Project Contributors
# SPDX-License-Identifier: Apache-2.0

config BOARD_STM32H573I_DK
	select TFM_PARTITION_FIRMWARE_UPDATE_SUPPORTED if BOARD_STM32H573I_DK_STM32H573XX_NS
```

## boards/st/stm32h573i_dk/Kconfig.defconfig
```kconfig
# STM32H573I DISCOVERY KIT board configuration
#
# Copyright (c) 2023 STMicroelectronics
#
# SPDX-License-Identifier: Apache-2.0
#

if BOARD_STM32H573I_DK

configdefault ETH_DRIVER
	default y

configdefault SDMMC_STM32_CLOCK_CHECK
	default n

# Required by the WM8904 MCLK fixed-clock node (revision D1)
configdefault CLOCK_CONTROL_FIXED_RATE_CLOCK
	default y if AUDIO_CODEC_WM8904

if DISPLAY

# Required to enable LCD backlight
config REGULATOR
	default y

configdefault I2C_STM32_V2_TIMING
	default y if INPUT

endif # DISPLAY

endif # BOARD_STM32H573I_DK
```

## boards/st/stm32h573i_dk/board.yml
```yaml
board:
  name: stm32h573i_dk
  full_name: STM32H573I-DK Discovery
  vendor: st
  revision:
    format: "custom"
    revisions:
      - name: "C2"
      - name: "D1"
  socs:
    - name: stm32h573xx
      variants:
        - name: ext_flash_app
        - name: ns
```

## boards/st/stm32h5f5j_dk/Kconfig.defconfig
```kconfig
# STM32H5F5J DISCOVERY KIT board configuration
#
# Copyright (c) 2026 STMicroelectronics
#
# SPDX-License-Identifier: Apache-2.0
#

if BOARD_STM32H5F5J_DK

configdefault ETH_DRIVER
	default y if NETWORKING

configdefault SDMMC_STM32_CLOCK_CHECK
	default n if DISK_DRIVER_SDMMC

if DISPLAY

# Default display framebuffer is located in PSRAM
configdefault MEMC
	default y

configdefault I2C_STM32_V2_TIMING
	default y if INPUT

endif # DISPLAY

if LVGL

# Let LVGL fully handle the buffers
configdefault STM32_LTDC_FB_NUM
	default 0

configdefault LV_Z_VDB_ZEPHYR_REGION
	default y

configdefault LV_Z_VDB_ZEPHYR_REGION_NAME
	default "PSRAM"

configdefault LV_Z_DOUBLE_VDB
	default y

choice LV_Z_RENDERING_MODE
	default LV_Z_DIRECT_RENDERING
endchoice

endif # LVGL

endif # BOARD_STM32H5F5J_DK
```

## boards/st/stm32h735g_disco/Kconfig.defconfig
```kconfig
# STM32H735G DISCOVERY board configuration

# Copyright (c) 2021 SILA Embedded Solutions GmbH
# SPDX-License-Identifier: Apache-2.0

if BOARD_STM32H735G_DISCO

configdefault ETH_DRIVER
	default y

endif # BOARD_STM32H735G_DISCO
```

## boards/st/stm32h7p5i_dk/Kconfig.stm32h7p5i_dk
```kconfig
# SPDX-FileCopyrightText: Copyright (c) 2026 STMicroelectronics
# SPDX-License-Identifier: Apache-2.0

config BOARD_STM32H7P5I_DK
	select SOC_STM32H7P5XX
```
