## boards/st/nucleo_h755zi_q/nucleo_h755zi_q_stm32h755xx_m4_defconfig
```kconfig
# SPDX-License-Identifier: Apache-2.0
# Copyright (c) 2024 S&C Electric Company <Michael.Banducci@sandc.com>

# Enable GPIO
CONFIG_GPIO=y

# Enable clock
CONFIG_CLOCK_CONTROL=y

# By default SERIAL peripherals are assigned to m7

# Enable uart driver
#CONFIG_SERIAL=y

# Console
#CONFIG_CONSOLE=y
#CONFIG_UART_CONSOLE=y

# Enable pin controller
CONFIG_PINCTRL=y
```

## boards/st/nucleo_h755zi_q/nucleo_h755zi_q_stm32h755xx_m7_defconfig
```kconfig
# SPDX-License-Identifier: Apache-2.0
# Copyright (c) 2024 S&C Electric Company <Michael.Banducci@sandc.com>

# Enable the internal SMPS regulator
CONFIG_POWER_SUPPLY_DIRECT_SMPS=y

# Enable MPU
CONFIG_ARM_MPU=y

# Enable HW stack protection
CONFIG_HW_STACK_PROTECTION=y

# Enable UART (disable to assign to M4 core)
CONFIG_SERIAL=y

# Console (disable to assign to M4 core)
CONFIG_CONSOLE=y
CONFIG_UART_CONSOLE=y

# Enable GPIO
CONFIG_GPIO=y

# Enable Clock
CONFIG_CLOCK_CONTROL=y

# Enable pin controller
CONFIG_PINCTRL=y
```

## boards/st/nucleo_h7a3zi_q/Kconfig.defconfig
```kconfig
# STM32H7A3ZI-Q Nucleo board configuration

# Copyright (c) 2021 Electrolance Solutions
# SPDX-License-Identifier: Apache-2.0

if BOARD_NUCLEO_H7A3ZI_Q

config USB_DC_HAS_HS_SUPPORT
	default y
	depends on USB_DC_STM32

endif # BOARD_NUCLEO_H7A3ZI_Q
```

## boards/st/nucleo_h7a3zi_q/Kconfig.nucleo_h7a3zi_q
```kconfig
# Copyright (c) 2021 Electrolance Solutions
# SPDX-License-Identifier: Apache-2.0

config BOARD_NUCLEO_H7A3ZI_Q
	select SOC_STM32H7A3XXQ
```

## boards/st/nucleo_h7a3zi_q/board.yml
```yaml
board:
  name: nucleo_h7a3zi_q
  full_name: Nucleo H7A3ZI-Q
  vendor: st
  socs:
    - name: stm32h7a3xx
```

## boards/st/nucleo_h7s3l8/Kconfig.defconfig
```kconfig
# STM32H7S3L8 NUCLEO board configuration
#
# Copyright (c) 2024 STMicroelectronics
#
# SPDX-License-Identifier: Apache-2.0

if BOARD_NUCLEO_H7S3L8

configdefault NET_L2_ETHERNET
	default y

endif # BOARD_NUCLEO_H7S3L8
```

## boards/st/nucleo_h7s3l8/Kconfig.nucleo_h7s3l8
```kconfig
# Copyright (c) 2024 STMicroelectronics
# SPDX-License-Identifier: Apache-2.0

config BOARD_NUCLEO_H7S3L8
	select SOC_STM32H7S3XX
```

## boards/st/nucleo_h7s3l8/Kconfig.sysbuild
```kconfig
# Copyright (c) 2024-2025 STMicroelectronics
# Copyright (c) 2025 JB-Lighting Lichtanlagentechnik
# SPDX-License-Identifier: Apache-2.0

if BOARD_NUCLEO_H7S3L8_STM32H7S3XX_EXT_FLASH_APP

choice BOOTLOADER
	default BOOTLOADER_MCUBOOT
endchoice

choice BOOT_SIGNATURE_TYPE
	default BOOT_SIGNATURE_TYPE_NONE
endchoice

endif # BOARD_NUCLEO_H7S3L8_STM32H7S3XX_EXT_FLASH_APP
```

## boards/st/nucleo_h7s3l8/board.yml
```yaml
board:
  name: nucleo_h7s3l8
  full_name: Nucleo H7S3L8
  vendor: st
  socs:
    - name: stm32h7s3xx
```

## boards/st/nucleo_h7s3l8/nucleo_h7s3l8_defconfig
```kconfig
# Copyright (c) 2024 STMicroelectronics
# SPDX-License-Identifier: Apache-2.0

# Disable SMPS
CONFIG_POWER_SUPPLY_DIRECT_SMPS=n

# Enable MPU
CONFIG_ARM_MPU=y

# Enable HW stack protection
CONFIG_HW_STACK_PROTECTION=y

# Enable UART driver
CONFIG_SERIAL=y

# Enable console
CONFIG_CONSOLE=y
CONFIG_UART_CONSOLE=y

# Enable GPIO
CONFIG_GPIO=y
```

## boards/st/nucleo_l011k4/Kconfig.defconfig
```kconfig
# STM32 Nucleo-32 development board with STM32L011K4 MCU

# Copyright (c) 2020 Steven Daglish <s.c.daglish@gmail.com>
# SPDX-License-Identifier: Apache-2.0

if BOARD_NUCLEO_L011K4

config SPI_STM32_INTERRUPT
	default y
	depends on SPI

endif # BOARD_NUCLEO_L011K4
```

## boards/st/nucleo_l011k4/Kconfig.nucleo_l011k4
```kconfig
# Copyright (c) 2020 Steven Daglish <s.c.daglish@gmail.com>
# SPDX-License-Identifier: Apache-2.0

config BOARD_NUCLEO_L011K4
	select SOC_STM32L011XX
```

## boards/st/nucleo_l011k4/board.yml
```yaml
board:
  name: nucleo_l011k4
  full_name: Nucleo L011K4
  vendor: st
  socs:
    - name: stm32l011xx
```

## boards/st/nucleo_l011k4/nucleo_l011k4_defconfig
```kconfig
# SPDX-License-Identifier: Apache-2.0

# Kernel Options due to Low Memory (2k)
CONFIG_MAIN_STACK_SIZE=320
CONFIG_IDLE_STACK_SIZE=100
CONFIG_ISR_STACK_SIZE=256

# Serial Drivers
CONFIG_SERIAL=y
CONFIG_UART_INTERRUPT_DRIVEN=y
# enable console
CONFIG_CONSOLE=y
CONFIG_UART_CONSOLE=y

# GPIO Controller
CONFIG_GPIO=y

# Enable Clocks
CONFIG_CLOCK_CONTROL=y

# enable pin controller
CONFIG_PINCTRL=y
```

## boards/st/nucleo_l031k6/Kconfig.nucleo_l031k6
```kconfig
# Copyright (c) 2020 Steven Daglish <s.c.daglish@gmail.com>
# SPDX-License-Identifier: Apache-2.0

config BOARD_NUCLEO_L031K6
	select SOC_STM32L031XX
```

## boards/st/nucleo_l031k6/board.yml
```yaml
board:
  name: nucleo_l031k6
  full_name: Nucleo L031K6
  vendor: st
  socs:
    - name: stm32l031xx
```

## boards/st/nucleo_l053r8/Kconfig.nucleo_l053r8
```kconfig
# Copyright (c) 2018 Anthony Kreft <anthony.kreft@gmail.com>
# SPDX-License-Identifier: Apache-2.0

config BOARD_NUCLEO_L053R8
	select SOC_STM32L053XX
```

## boards/st/nucleo_l053r8/board.yml
```yaml
board:
  name: nucleo_l053r8
  full_name: Nucleo L053R8
  vendor: st
  socs:
    - name: stm32l053xx
```

## boards/st/nucleo_l073rz/Kconfig.defconfig
```kconfig
# STM32 Nucleo-64 development board with STM32L073RZ MCU

# Copyright (c) 2018 Ilya Tagunov <tagunil@gmail.com>
# SPDX-License-Identifier: Apache-2.0

if BOARD_NUCLEO_L073RZ

config SPI_STM32_INTERRUPT
	default y
	depends on SPI

endif # BOARD_NUCLEO_L073RZ
```

## boards/st/nucleo_l073rz/Kconfig.nucleo_l073rz
```kconfig
# Copyright (c) 2018 Ilya Tagunov <tagunil@gmail.com>
# SPDX-License-Identifier: Apache-2.0

config BOARD_NUCLEO_L073RZ
	select SOC_STM32L073XX
```

## boards/st/nucleo_l073rz/board.yml
```yaml
board:
  name: nucleo_l073rz
  full_name: Nucleo L073RZ
  vendor: st
  socs:
    - name: stm32l073xx
```

## boards/st/nucleo_l152re/Kconfig.nucleo_l152re
```kconfig
# Copyright (c) 2019 Antony Pavlov <antonynpavlov@gmail.com>
# SPDX-License-Identifier: Apache-2.0

config BOARD_NUCLEO_L152RE
	select SOC_STM32L152XE
```

## boards/st/nucleo_l152re/board.yml
```yaml
board:
  name: nucleo_l152re
  full_name: Nucleo L152RE
  vendor: st
  socs:
    - name: stm32l152xe
```

## boards/st/nucleo_l412rb_p/Kconfig.nucleo_l412rb_p
```kconfig
# Copyright (c) 2021 Guðni Már Gilbert
# SPDX-License-Identifier: Apache-2.0

config BOARD_NUCLEO_L412RB_P
	select SOC_STM32L412XX
```

## boards/st/nucleo_l412rb_p/board.yml
```yaml
board:
  name: nucleo_l412rb_p
  full_name: Nucleo L412RB-P
  vendor: st
  socs:
    - name: stm32l412xx
```
