/*
 * Copyright (c) 2018 Linaro Limited
 *
 * SPDX-License-Identifier: Apache-2.0
 */

/dts-v1/;

#include <microchip/microchip-miv.dtsi>

/ {
	compatible = "microchip,m2gl025-miv";
	model = "Microchip M2GL025 with MiV target";

	chosen {
		zephyr,console = &uart0;
		zephyr,shell-uart = &uart0;
		zephyr,flash = &flash0;
		zephyr,sram = &sram0;
	};
};

&uart0 {
	current-speed = <115200>;
	clock-frequency = <66000000>;
	status = "okay";
};
