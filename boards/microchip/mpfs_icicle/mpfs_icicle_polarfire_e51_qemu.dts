/*
 * SPDX-FileCopyrightText: Copyright The Zephyr Project Contributors
 *
 * SPDX-License-Identifier: Apache-2.0
 *
 * PolarFire SoC Icicle Kit as emulated by the microchip-icicle-kit machine of QEMU.
 */

#include "mpfs_icicle_polarfire_e51.dts"
#include "mpfs_icicle_qemu.dtsi"
