## boards/microchip/mec172xevb_assy6906/Kconfig.mec172xevb_assy6906
```kconfig
# Copyright (c) 2021, Microchip Technology Inc.
# SPDX-License-Identifier: Apache-2.0

config BOARD_MEC172XEVB_ASSY6906
	select SOC_MEC172X_NSZ
```

## boards/microchip/mec172xevb_assy6906/board.yml
```yaml
board:
  name: mec172xevb_assy6906
  full_name: MEC172xEVB ASSY6906
  vendor: microchip
  socs:
    - name: mec172x_nsz
```

## boards/microchip/mec172xevb_assy6906/mec172xevb_assy6906_defconfig
```kconfig
#
# Copyright (c) 2021, Microchip Technology Inc.
#
# SPDX-License-Identifier: Apache-2.0
#

CONFIG_CLOCK_CONTROL=y
CONFIG_GPIO=y
CONFIG_SERIAL=y
CONFIG_CONSOLE=y
CONFIG_UART_CONSOLE=y
```

## boards/microchip/mec172xmodular_assy6930/Kconfig.mec172xmodular_assy6930
```kconfig
# Copyright (c) 2022, Microchip Technology Inc.
# SPDX-License-Identifier: Apache-2.0

config BOARD_MEC172XMODULAR_ASSY6930
	select SOC_MEC172X_NSZ
```

## boards/microchip/mec172xmodular_assy6930/board.yml
```yaml
board:
  name: mec172xmodular_assy6930
  full_name: MEC172x Modular Card ASSY6930 (Rev. B)
  vendor: microchip
  socs:
    - name: mec172x_nsz
```

## boards/microchip/mec172xmodular_assy6930/mec172xmodular_assy6930_defconfig
```kconfig
#
# Copyright (c) 2022, Microchip Technology Inc.
#
# SPDX-License-Identifier: Apache-2.0
#

CONFIG_RTOS_TIMER=y

CONFIG_CLOCK_CONTROL=y
CONFIG_GPIO=y
CONFIG_SERIAL=y
CONFIG_CONSOLE=y
CONFIG_UART_CONSOLE=y
CONFIG_ADC=y
CONFIG_I2C=y
CONFIG_ESPI=y
CONFIG_SPI=y
CONFIG_SPI_ASYNC=y
```

## boards/microchip/mec_assy6906/Kconfig.defconfig
```kconfig
# Copyright (c) 2024 Microchip Technology Inc.
# SPDX-License-Identifier: Apache-2.0

if BOARD_MEC_ASSY6906_MECH1723NSZ || BOARD_MEC_ASSY6906_MECH1723NLJ

# Use ARM Cortex-M SYSTICK. SYSTICK frequency is 96 MHz divided down by the MEC174x PCR
# processor clock divider register. Boot-ROM sets PCR processor clock divider to 1.
# Refer to SOC_MEC_PROC_CLK_DIV
#
config SYS_CLOCK_HW_CYCLES_PER_SEC
	default 96000000

config SYS_CLOCK_TICKS_PER_SEC
	default 1000

endif # BOARD_MEC_ASSY6906_MECH1723NSZ or _MECH1723NLJ
```

## boards/microchip/mec_assy6906/Kconfig.mec_assy6906_mech1723nsz
```kconfig
# Copyright (c) 2024, Microchip Technology Inc.
# SPDX-License-Identifier: Apache-2.0

config BOARD_MEC_ASSY6906_MECH1723NSZ
	select SOC_MECH1723_NSZ
```

## boards/microchip/mec_assy6906/board.yml
```yaml
boards:
  - name: mec_assy6906_mech1723nlj
    vendor: microchip
    socs:
      - name: mech1723_nlj
  - name: mec_assy6906_mech1723nsz
    vendor: microchip
    socs:
      - name: mech1723_nsz
```

## boards/microchip/mec_assy6941/Kconfig.defconfig
```kconfig
# Copyright (c) 2024 Microchip Technology Inc.
# SPDX-License-Identifier: Apache-2.0

if BOARD_MEC_ASSY6941_MEC1743QLJ || BOARD_MEC_ASSY6941_MEC1743QSZ ||\
	BOARD_MEC_ASSY6941_MEC1753QLJ || BOARD_MEC_ASSY6941_MEC1753QSZ

if MCHP_MEC5_KTIMER
config SYS_CLOCK_HW_CYCLES_PER_SEC
	default 32768

config SYS_CLOCK_TICKS_PER_SEC
	default 32768

endif # MCHP_MEC5_KTIMER

if !MCHP_MEC5_KTIMER
# Use ARM Cortex-M SYSTICK. SYSTICK frequency is 96 MHz divided down by the MEC174x PCR
# processor clock divider register. Boot-ROM sets PCR processor clock divider to 1.
# Refer to SOC_MEC_PROC_CLK_DIV
#
config SYS_CLOCK_HW_CYCLES_PER_SEC
	default 96000000

config SYS_CLOCK_TICKS_PER_SEC
	default 1000

endif # !MCHP_MEC5_KTIMER
endif # BOARD_MEC_ASSY6941_MEC1743QLJ or _MEC1743QSZ or _MEC1753QLJ or _MEC1753QSZ
```

## boards/microchip/mec_assy6941/Kconfig.mec_assy6941
```kconfig
# Copyright (c) 2025 Microchip Technology Inc.
# SPDX-License-Identifier: Apache-2.0

config BOARD_MEC_ASSY6941
	select SOC_MEC1743_QLJ if BOARD_MEC_ASSY6941_MEC1743_QLJ
	select SOC_MEC1743_QSZ if BOARD_MEC_ASSY6941_MEC1743_QSZ
	select SOC_MEC1753_QLJ if BOARD_MEC_ASSY6941_MEC1753_QLJ
	select SOC_MEC1753_QSZ if BOARD_MEC_ASSY6941_MEC1753_QSZ
```

## boards/microchip/mec_assy6941/Kconfig.mec_assy6941_mec1653b_nsz
```kconfig
# Copyright (c) 2025, Microchip Technology Inc.
# SPDX-License-Identifier: Apache-2.0

config BOARD_MEC_ASSY6941_MEC1653B_NSZ
	select SOC_MEC1653B_NSZ
```

## boards/microchip/mec_assy6941/Kconfig.mec_assy6941_mec1743_qsz
```kconfig
# Copyright (c) 2025, Microchip Technology Inc.
# SPDX-License-Identifier: Apache-2.0

config BOARD_MEC_ASSY6941_MEC1743_QSZ
	select SOC_MEC1743_QSZ
```

## boards/microchip/mec_assy6941/Kconfig.mec_assy6941_mec1753_qsz
```kconfig
# Copyright (c) 2025, Microchip Technology Inc.
# SPDX-License-Identifier: Apache-2.0

config BOARD_MEC_ASSY6941_MEC1753_QSZ
	select SOC_MEC1753_QSZ
```

## boards/microchip/mec_assy6941/board.yml
```yaml
board:
  name: mec_assy6941
  full_name: MEC17xxEVB ASSY6941
  vendor: microchip
  socs:
  - name: mec1653b_nsz
  - name: mec1743_qlj
  - name: mec1743_qsz
  - name: mec1753_qlj
  - name: mec1753_qsz
```

## boards/microchip/mec_assy6941/mec_assy6941_mec1753_qsz_defconfig
```kconfig
# Copyright (c) 2025, Microchip Technology Inc.
# SPDX-License-Identifier: Apache-2.0
#

CONFIG_GPIO=y
CONFIG_SERIAL=y
CONFIG_CONSOLE=y
CONFIG_UART_CONSOLE=y
```

## boards/microchip/mpfs_icicle/Kconfig.mpfs_icicle
```kconfig
# Copyright (c) 2021-2022 Microchip Technology Inc
# SPDX-License-Identifier: Apache-2.0

config BOARD_MPFS_ICICLE
	select SOC_POLARFIRE_U54 if BOARD_MPFS_ICICLE_POLARFIRE_U54 || \
				       BOARD_MPFS_ICICLE_POLARFIRE_U54_SMP
	select SOC_POLARFIRE_E51 if BOARD_MPFS_ICICLE_POLARFIRE_E51
```

## boards/microchip/mpfs_icicle/mpfs_icicle_polarfire_u54_smp_defconfig
```kconfig
# Copyright (c) 2020-2021 Microchip Technology Inc
# SPDX-License-Identifier: Apache-2.0

CONFIG_MPFS_HAL=n
CONFIG_BASE64=y
CONFIG_INCLUDE_RESET_VECTOR=y
CONFIG_CONSOLE=y
CONFIG_SERIAL=y
CONFIG_UART_CONSOLE=y
CONFIG_XIP=n
CONFIG_INIT_STACKS=y
CONFIG_SYS_CLOCK_TICKS_PER_SEC=1000
# GPIO driver options
CONFIG_GPIO=y
CONFIG_I2C=y
CONFIG_RV_BOOT_HART=1
CONFIG_SMP=y
```

## boards/microchip/pic32c/pic32ck_gc01_cult/Kconfig.pic32ck_gc01_cult
```kconfig
# Copyright (c) 2026 Microchip Technology Inc.
# SPDX-License-Identifier: Apache-2.0

config BOARD_PIC32CK_GC01_CULT
	select SOC_PIC32CK2051GC01144
```

## boards/microchip/pic32c/pic32ck_gc01_cult/board.yml
```yaml
# Copyright (c) 2026 Microchip Technology Inc.
# SPDX-License-Identifier: Apache-2.0

board:
  name: pic32ck_gc01_cult
  full_name: PIC32CK GC01 Curiosity Ultra
  vendor: microchip
  socs:
    - name: pic32ck2051gc01144
```

## boards/microchip/pic32c/pic32ck_sg01_cult/Kconfig.pic32ck_sg01_cult
```kconfig
# Copyright (c) 2026 Microchip Technology Inc.
# SPDX-License-Identifier: Apache-2.0

config BOARD_PIC32CK_SG01_CULT
	select SOC_PIC32CK2051SG01144
```

## boards/microchip/pic32c/pic32ck_sg01_cult/board.yml
```yaml
# Copyright (c) 2026 Microchip Technology Inc.
# SPDX-License-Identifier: Apache-2.0

board:
  name: pic32ck_sg01_cult
  full_name: PIC32CK SG01 Curiosity Ultra
  vendor: microchip
  socs:
    - name: pic32ck2051sg01144
```

## boards/microchip/pic32c/pic32cm_gc00_cpro/Kconfig.pic32cm_gc00_cpro
```kconfig
# Copyright (c) 2026 Microchip Technology Inc.
# SPDX-License-Identifier: Apache-2.0

config BOARD_PIC32CM_GC00_CPRO
	select SOC_PIC32CM5112GC00100
```
