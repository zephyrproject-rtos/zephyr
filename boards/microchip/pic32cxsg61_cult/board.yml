## boards/microchip/pic32cxsg61_cult/board.yml
```yaml
board:
  name: pic32cxsg61_cult
  vendor: microchip
  socs:
    - name: pic32cx1025sg61128
```

## boards/microchip/pic64gx_curiosity_kit/Kconfig.board
```kconfig
# Copyright (c) 2024 Microchip Technology Inc
# SPDX-License-Identifier: Apache-2.0

config BOARD_PIC64GX_CURIOSITY_KIT
	bool "Microchip PIC64GX Curiosity kit"
	depends on SOC_PIC64GX
	select 64BIT
	select SCHED_IPI_SUPPORTED
	select CPU_HAS_FPU_DOUBLE_PRECISION
```

## boards/microchip/pic64gx_curiosity_kit/Kconfig.pic64gx_curiosity_kit
```kconfig
# Copyright (c) 2025 Microchip Technology Inc
# SPDX-License-Identifier: Apache-2.0

config BOARD_PIC64GX_CURIOSITY_KIT
	select SOC_PIC64GX1000_U54 if BOARD_PIC64GX_CURIOSITY_KIT_PIC64GX1000_U54 || \
				      BOARD_PIC64GX_CURIOSITY_KIT_PIC64GX1000_U54_SMP
	select SOC_PIC64GX1000_E51 if BOARD_PIC64GX_CURIOSITY_KIT_PIC64GX1000_E51
```

## boards/microchip/pic64gx_curiosity_kit/board.yml
```yaml
board:
  name: pic64gx_curiosity_kit
  full_name: PIC64GX1000 Curiosity kit
  vendor: microchip
  socs:
  - name: pic64gx1000
    variants:
    - name: smp
      cpucluster: u54
```

## boards/microchip/pic64gx_curiosity_kit/pic64gx_curiosity_kit_defconfig
```kconfig
# Copyright (c) 2024 Microchip Technology Inc
# SPDX-License-Identifier: Apache-2.0

CONFIG_SOC_SERIES_PIC64GX=y
CONFIG_SOC_PIC64GX=y
CONFIG_BASE64=y
CONFIG_INCLUDE_RESET_VECTOR=y
CONFIG_BOARD_PIC64GX_CURIOSITY_KIT=y
CONFIG_CONSOLE=y
CONFIG_SERIAL=y
CONFIG_UART_CONSOLE=y
CONFIG_XIP=n
CONFIG_INIT_STACKS=y
CONFIG_SYS_CLOCK_TICKS_PER_SEC=1000
CONFIG_FPU=n
# GPIO driver options
CONFIG_GPIO=y
CONFIG_I2C=y
```

## boards/microchip/sam/sam9x75_curiosity/Kconfig.sam9x75_curiosity
```kconfig
# Copyright (C) 2025 Microchip Technology Inc. and its subsidiaries
#
# SPDX-License-Identifier: Apache-2.0
#

config BOARD_SAM9X75_CURIOSITY
	select SOC_SAM9X75
```

## boards/microchip/sam/sam9x75_curiosity/board.yml
```yaml
board:
  name: sam9x75_curiosity
  full_name: SAM9X75 Curiosity LAN Kit
  vendor: microchip
  socs:
    - name: sam9x75
```

## boards/microchip/sam/sam9x75_curiosity/sam9x75_curiosity_defconfig
```kconfig
# Copyright (C) 2025 Microchip Technology Inc. and its subsidiaries
#
# SPDX-License-Identifier: Apache-2.0
#

CONFIG_CLOCK_CONTROL_FIXED_RATE_CLOCK=y
CONFIG_CONSOLE=y
CONFIG_SERIAL=y
CONFIG_UART_CONSOLE=y
CONFIG_SHELL_BACKEND_SERIAL_FORCE_TX_BLOCKING_MODE=y
```

## boards/microchip/sam/sam_e54_cult/Kconfig.sam_e54_cult
```kconfig
# Copyright (c) 2025 Microchip Technology Inc.
# SPDX-License-Identifier: Apache-2.0

config BOARD_SAM_E54_CULT
	select SOC_ATSAME54P20A
```

## boards/microchip/sam/sam_e54_cult/board.yml
```yaml
# Copyright (c) 2025 Microchip Technology Inc.
# SPDX-License-Identifier: Apache-2.0

board:
  name: sam_e54_cult
  full_name: SAM E54 Curiosity Ultra
  vendor: microchip
  socs:
    - name: atsame54p20a
```

## boards/microchip/sam/sam_e54_xpro/Kconfig.sam_e54_xpro
```kconfig
# Copyright (c) 2025 Microchip Technology Inc.
# SPDX-License-Identifier: Apache-2.0

config BOARD_SAM_E54_XPRO
	select SOC_ATSAME54P20A
```

## boards/microchip/sam/sam_e54_xpro/board.yml
```yaml
# Copyright (c) 2025 Microchip Technology Inc.
# SPDX-License-Identifier: Apache-2.0

board:
  name: sam_e54_xpro
  full_name: SAM E54 Xplained Pro
  vendor: microchip
  socs:
    - name: atsame54p20a
```

## boards/microchip/sam/sam_e54_xpro/sam_e54_xpro_defconfig
```kconfig
# Copyright (c) 2025 Microchip Technology Inc.
# SPDX-License-Identifier: Apache-2.0

CONFIG_BUILD_OUTPUT_HEX=y

CONFIG_ARM_MPU=y
CONFIG_HW_STACK_PROTECTION=y

CONFIG_CONSOLE=y
CONFIG_SERIAL=y
CONFIG_UART_CONSOLE=y
```

## boards/microchip/sam/sama5d27_som1_ek1/Kconfig.sama5d27_som1_ek1
```kconfig
# Copyright (C) 2026 Microchip Technology Inc.
#
# SPDX-License-Identifier: Apache-2.0
#

config BOARD_SAMA5D27_SOM1_EK1
	select SOC_SAMA5D27SOM1
```

## boards/microchip/sam/sama5d27_som1_ek1/board.yml
```yaml
board:
  name: sama5d27_som1_ek1
  full_name: SAMA5D27 SOM1 Kit1
  vendor: microchip
  socs:
    - name: sama5d27som1
```

## boards/microchip/sam/sama7d65_curiosity/Kconfig.sama7d65_curiosity
```kconfig
# Copyright (C) 2025 Microchip Technology Inc. and its subsidiaries
#
# SPDX-License-Identifier: Apache-2.0
#

config BOARD_SAMA7D65_CURIOSITY
	select SOC_SAMA7D65
```

## boards/microchip/sam/sama7d65_curiosity/board.yml
```yaml
board:
  name: sama7d65_curiosity
  full_name: SAMA7D65 Curiosity Kit
  vendor: microchip
  socs:
    - name: sama7d65
```

## boards/microchip/sam/sama7g54_ek/Kconfig.defconfig
```kconfig
# Copyright (C) 2025 Microchip Technology Inc. and its subsidiaries
#
# SPDX-License-Identifier: Apache-2.0
#

configdefault NET_L2_ETHERNET
	default y if NETWORKING
```

## boards/microchip/sam/sama7g54_ek/Kconfig.sama7g54_ek
```kconfig
# Copyright (C) 2025 Microchip Technology Inc. and its subsidiaries
#
# SPDX-License-Identifier: Apache-2.0
#

config BOARD_SAMA7G54_EK
	select SOC_SAMA7G54
```

## boards/microchip/sam/sama7g54_ek/board.yml
```yaml
board:
  name: sama7g54_ek
  full_name: SAMA7G54 Evaluation Kit
  vendor: microchip
  socs:
    - name: sama7g54
```

## boards/microchip/sam/sama7g54_ek/sama7g54_ek_defconfig
```kconfig
# Copyright (C) 2025 Microchip Technology Inc. and its subsidiaries
#
# SPDX-License-Identifier: Apache-2.0
#

CONFIG_CLOCK_CONTROL_FIXED_RATE_CLOCK=y
CONFIG_CONSOLE=y
CONFIG_SERIAL=y
CONFIG_UART_CONSOLE=y
```

## boards/mikroe/clicker_2/Kconfig.defconfig
```kconfig
# MikroE Clicker 2 board configuration

# Copyright (c) 2020 Trifork
# SPDX-License-Identifier: Apache-2.0

if BOARD_MIKROE_CLICKER_2

config SPI_STM32_INTERRUPT
	default y
	depends on SPI

endif #BOARD_MIKROE_CLICKER_2
```

## boards/mikroe/clicker_2/Kconfig.mikroe_clicker_2
```kconfig
# Copyright (c) 2020 Trifork
# SPDX-License-Identifier: Apache-2.0

config BOARD_MIKROE_CLICKER_2
	select SOC_STM32F407XG
```

## boards/mikroe/clicker_2/board.yml
```yaml
board:
  name: mikroe_clicker_2
  full_name: Clicker 2 for STM32
  vendor: mikroe
  socs:
    - name: stm32f407xx
```

## boards/mikroe/clicker_2/mikroe_clicker_2_defconfig
```kconfig
# Enable MPU
CONFIG_ARM_MPU=y

CONFIG_SERIAL=y

# console
CONFIG_CONSOLE=y
CONFIG_UART_CONSOLE=y

# Enable Clocks
CONFIG_CLOCK_CONTROL=y
```
