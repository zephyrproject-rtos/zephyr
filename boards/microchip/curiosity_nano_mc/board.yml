## boards/microchip/curiosity_nano_mc/board.yml
```yaml
board:
  name: curiosity_nano_mc
  full_name: PIC32CM MC00 Curiosity Nano Evaluation Kit
  vendor: microchip
  socs:
    - name: pic32cm1216mc00032
```

## boards/microchip/curiosity_nano_mc/curiosity_nano_mc_defconfig
```kconfig
# Copyright (c) 2025 GP Orcullo
# SPDX-License-Identifier: Apache-2.0

CONFIG_GPIO=y
CONFIG_CONSOLE=y
CONFIG_SERIAL=y
CONFIG_UART_CONSOLE=y
CONFIG_UART_INTERRUPT_DRIVEN=y
```

## boards/microchip/dspic33/dspic33a_curiosity/Kconfig.dspic33a_curiosity
```kconfig
# Copyright (c) 2025, Microchip Technology Inc.
# SPDX-License-Identifier: Apache-2.0

config BOARD_DSPIC33A_CURIOSITY
	select SOC_P33AK512MPS512 if BOARD_DSPIC33A_CURIOSITY_P33AK512MPS512
	select SOC_P33AK128MC106 if BOARD_DSPIC33A_CURIOSITY_P33AK128MC106
```

## boards/microchip/dspic33/dspic33a_curiosity/board.yml
```yaml
# Copyright (c) 2025 Microchip Technology Inc.
# SPDX-License-Identifier: Apache-2.0

board:
  name: dspic33a_curiosity
  full_name: dsPIC33A Curiosity Platform Development Board
  vendor: microchip
  socs:
    - name: p33ak128mc106
    - name: p33ak512mps512
```

## boards/microchip/dspic33/dspic33a_curiosity/dspic33a_curiosity_p33ak512mps512_defconfig
```kconfig
# Copyright (c) 2025, Microchip Technology Inc.
# SPDX-License-Identifier: Apache-2.0

CONFIG_LOG=y
CONFIG_PRINTK=y
CONFIG_CONSOLE=y
CONFIG_STDOUT_CONSOLE=n
CONFIG_UART_INTERRUPT_DRIVEN=y

CONFIG_UART_CONSOLE=y
CONFIG_LOG_MODE_MINIMAL=y
CONFIG_EARLY_CONSOLE=y
CONFIG_SERIAL=y

# Disable unwanted libraries
CONFIG_EXTERNAL_LIBC=y
CONFIG_SPIN_VALIDATE=n

# Enables support for GPIO drivers on the target platform.
CONFIG_GPIO=y

# For XC-DSC toolchain the default check init script of zephyr will fail
# because of an extra prepended underscore on symbols generated,
# For this reason keeping it disabled
CONFIG_CHECK_INIT_PRIORITIES=n

CONFIG_HW_STACK_PROTECTION=y
```

## boards/microchip/ev11l78a/Kconfig.ev11l78a
```kconfig
# Copyright (c) 2023 Meta Platforms, Inc. and its affiliates.
# Copyright (c) 2024 Gerson Fernando Budke <nandojve@gmail.com>
# SPDX-License-Identifier: Apache-2.0

config BOARD_EV11L78A
	select SOC_SAMD20E16
```

## boards/microchip/ev11l78a/board.yml
```yaml
board:
  name: ev11l78a
  full_name: UPD301C Basic Sink Application Example
  vendor: microchip
  socs:
    - name: samd20e16
```

## boards/microchip/ev48h83a/Kconfig.ev48h83a
```kconfig
# Copyright (c) 2025 Microchip Technology Inc.
# SPDX-License-Identifier: Apache-2.0

config BOARD_EV48H83A
	select SOC_MEC1653B_NSZ if BOARD_EV48H83A_MEC1653B_NSZ
	select SOC_MEC1743_QLJ if BOARD_EV48H83A_MEC1743_QLJ
	select SOC_MEC1743_QSZ if BOARD_EV48H83A_MEC1743_QSZ
	select SOC_MEC1753_QLJ if BOARD_EV48H83A_MEC1753_QLJ
	select SOC_MEC1753_QSZ if BOARD_EV48H83A_MEC1753_QSZ
```

## boards/microchip/ev48h83a/board.yml
```yaml
board:
  name: ev48h83a
  full_name: EV48H83A
  vendor: microchip
  socs:
  - name: mec1653b_nsz
  - name: mec1743_qlj
  - name: mec1743_qsz
  - name: mec1753_qlj
  - name: mec1753_qsz
```

## boards/microchip/ev74h48a/Kconfig.ev74h48a
```kconfig
# Copyright (c) 2025, Microchip Technology Inc.
# SPDX-License-Identifier: Apache-2.0

config BOARD_EV74H48A
	select SOC_P33AK128MC106 if BOARD_EV74H48A_P33AK128MC106
```

## boards/microchip/ev74h48a/ev74h48a_p33ak128mc106_defconfig
```kconfig
# Enables the RAM-based console backend for logging output.
CONFIG_CONSOLE=y
CONFIG_RAM_CONSOLE=y

# Enables support for GPIO drivers on the target platform.
# CONFIG_GPIO=y

# Defines the system hardware clock frequency as 8 MHz.
CONFIG_SYS_CLOCK_HW_CYCLES_PER_SEC=8000000

# Configures the system tick rate to 1000 ticks per second (1 ms tick interval).
CONFIG_SYS_CLOCK_TICKS_PER_SEC=1000

# Specifies a single-core configuration for the SoC.
CONFIG_MP_MAX_NUM_CPUS=1

# For XC-DSC toolchain the default check init script of zephyr will fail
# because of an extra prepended underscore on symbols generated,
# For this reason keeping it disabled
CONFIG_CHECK_INIT_PRIORITIES=n
```

## boards/microchip/m2gl025_miv/Kconfig.m2gl025_miv
```kconfig
# Copyright (c) 2018 Linaro Limited
# SPDX-License-Identifier: Apache-2.0

config BOARD_M2GL025_MIV
	select SOC_MIV
```

## boards/microchip/m2gl025_miv/board.yml
```yaml
board:
  name: m2gl025_miv
  full_name: M2GL025 Mi-V
  vendor: microchip
  socs:
  - name: miv
```

## boards/microchip/m2s010_mkr_kit/Kconfig.m2s010_mkr_kit
```kconfig
# SPDX-FileCopyrightText: Copyright Bavariamatic GmbH
# SPDX-License-Identifier: Apache-2.0

config BOARD_M2S010_MKR_KIT
	select SOC_M2S010 if BOARD_M2S010_MKR_KIT_M2S010
```

## boards/microchip/m2s010_mkr_kit/board.yml
```yaml
# SPDX-FileCopyrightText: Copyright Bavariamatic GmbH
# SPDX-License-Identifier: Apache-2.0

board:
  name: m2s010_mkr_kit
  full_name: Microchip M2S010 MKR Kit
  vendor: microchip
  socs:
    - name: m2s010
```

## boards/microchip/m2s010_mkr_kit/m2s010_mkr_kit_m2s010_defconfig
```kconfig
# SPDX-FileCopyrightText: Copyright Bavariamatic GmbH
# SPDX-License-Identifier: Apache-2.0

CONFIG_SERIAL=y
CONFIG_UART_NS16550=y
CONFIG_CONSOLE=y
CONFIG_UART_CONSOLE=y
CONFIG_CLOCK_CONTROL=y
CONFIG_GPIO=y
CONFIG_MINIMAL_LIBC=y
CONFIG_PICOLIBC=n
CONFIG_SYS_CLOCK_TICKS_PER_SEC=100
```

## boards/microchip/mec1501modular_assy6885/Kconfig.defconfig
```kconfig
# Copyright (c) 2019 Intel Corporation
# SPDX-License-Identifier: Apache-2.0

if BOARD_MEC1501MODULAR_ASSY6885

#PS/2 driver is compiled in terms of this flag.
config ESPI_PERIPHERAL_8042_KBC
	default y
	depends on ESPI_XEC

if ESPI

config ESPI_PERIPHERAL_UART_SOC_MAPPING
	default 1

endif # ESPI

endif # BOARD_MEC1501MODULAR_ASSY6885
```

## boards/microchip/mec1501modular_assy6885/Kconfig.mec1501modular_assy6885
```kconfig
# Copyright (c) 2019, Intel Corporation
# SPDX-License-Identifier: Apache-2.0

config BOARD_MEC1501MODULAR_ASSY6885
	select SOC_MEC1501_HSZ
```

## boards/microchip/mec1501modular_assy6885/board.yml
```yaml
board:
  name: mec1501modular_assy6885
  full_name: MEC1501 Modular card ASSY6885
  vendor: microchip
  socs:
    - name: mec1501_hsz
```

## boards/microchip/mec1501modular_assy6885/mec1501modular_assy6885_defconfig
```kconfig
#
# Copyright (c) 2019, Intel Corporation
#
# SPDX-License-Identifier: Apache-2.0
#

# Make sure external power management setup is as indicated in documentation
CONFIG_SOC_MEC1501_VTR3_1_8V=y
CONFIG_SOC_MEC1501_VCI_PINS_AS_GPIOS=n
CONFIG_RTOS_TIMER=y

CONFIG_CLOCK_CONTROL=y
CONFIG_PINCTRL=y
CONFIG_CONSOLE=y
CONFIG_UART_CONSOLE=y
CONFIG_SERIAL=y
CONFIG_GPIO=y
CONFIG_PINCTRL=y

CONFIG_PM=y
```

## boards/microchip/mec15xxevb_assy6853/Kconfig.defconfig
```kconfig
# Copyright (c) 2019 Intel Corporation
# SPDX-License-Identifier: Apache-2.0

if BOARD_MEC15XXEVB_ASSY6853

config ESPI_XEC
	default y
	depends on ESPI

endif # BOARD_MEC15XXEVB_ASSY6853
```

## boards/microchip/mec15xxevb_assy6853/Kconfig.mec15xxevb_assy6853
```kconfig
# Copyright (c) 2019, Intel Corporation
# SPDX-License-Identifier: Apache-2.0

config BOARD_MEC15XXEVB_ASSY6853
	select SOC_MEC1501_HSZ
```

## boards/microchip/mec15xxevb_assy6853/board.yml
```yaml
board:
  name: mec15xxevb_assy6853
  full_name: MEC15xxEVB ASSY6853
  vendor: microchip
  socs:
    - name: mec1501_hsz
```

## boards/microchip/mec15xxevb_assy6853/mec15xxevb_assy6853_defconfig
```kconfig
#
# Copyright (c) 2019, Intel Corporation
#
# SPDX-License-Identifier: Apache-2.0
#

CONFIG_SOC_MEC1501_VTR3_1_8V=y
CONFIG_RTOS_TIMER=y

CONFIG_CLOCK_CONTROL=y
CONFIG_CONSOLE=y
CONFIG_UART_CONSOLE=y
CONFIG_SERIAL=y
CONFIG_GPIO=y

# power management stuff
CONFIG_PM=y
```
