/dts-v1/;
#include "p33ak128mc106.dtsi"

/ {
	model = "Microchip dsPIC33A Curiosity Platform Development Board";
	compatible = "microchip,ev74h48a-p33ak128mc106";

	chosen {
		zephyr,flash = &flash0;
		zephyr,sram = &sram0;
	};
};

&cpu0 {
	clock-frequency = <8000000>;
	status = "okay";
	cpu-power-states = <&idle>;
};

&timer1 {
	status = "okay";
};
