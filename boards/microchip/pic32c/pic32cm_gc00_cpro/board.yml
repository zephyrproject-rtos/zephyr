## boards/microchip/pic32c/pic32cm_gc00_cpro/board.yml
```yaml
# Copyright (c) 2026 Microchip Technology Inc.
# SPDX-License-Identifier: Apache-2.0

board:
  name: pic32cm_gc00_cpro
  full_name: PIC32CM GC00 Curiosity Pro
  vendor: microchip
  socs:
    - name: pic32cm5112gc00100
```

## boards/microchip/pic32c/pic32cm_jh01_cnano/board.yml
```yaml
# Copyright (c) 2025 Microchip Technology Inc.
# SPDX-License-Identifier: Apache-2.0

board:
  name: pic32cm_jh01_cnano
  full_name: PIC32CM JH01 Curiosity Nano+ Touch Evaluation Kit
  vendor: microchip
  socs:
    - name: pic32cm5164jh01048
```

## boards/microchip/pic32c/pic32cm_jh01_cpro/Kconfig.pic32cm_jh01_cpro
```kconfig
# Copyright (c) 2025 Microchip Technology Inc.
# SPDX-License-Identifier: Apache-2.0

config BOARD_PIC32CM_JH01_CPRO
	select SOC_PIC32CM5164JH01100
```

## boards/microchip/pic32c/pic32cm_jh01_cpro/board.yml
```yaml
# Copyright (c) 2025 Microchip Technology Inc.
# SPDX-License-Identifier: Apache-2.0

board:
  name: pic32cm_jh01_cpro
  full_name: PIC32CM JH01 Curiosity Pro
  vendor: microchip
  socs:
    - name: pic32cm5164jh01100
```

## boards/microchip/pic32c/pic32cm_pl10_cnano/Kconfig.pic32cm_pl10_cnano
```kconfig
# Copyright (c) 2026 Microchip Technology Inc.
# SPDX-License-Identifier: Apache-2.0

config BOARD_PIC32CM_PL10_CNANO
	select SOC_PIC32CM6408PL10048
```

## boards/microchip/pic32c/pic32cm_pl10_cnano/board.yml
```yaml
# Copyright (c) 2026 Microchip Technology Inc.
# SPDX-License-Identifier: Apache-2.0

board:
  name: pic32cm_pl10_cnano
  full_name: PIC32CM PL10 Curiosity Nano
  vendor: microchip
  socs:
    - name: pic32cm6408pl10048
```

## boards/microchip/pic32c/pic32cm_pl10_cnano/pic32cm_pl10_cnano_defconfig
```kconfig
# Copyright (c) 2026 Microchip Technology Inc.
# SPDX-License-Identifier: Apache-2.0

CONFIG_BUILD_OUTPUT_HEX=y
CONFIG_USE_DT_CODE_PARTITION=y
```

## boards/microchip/pic32c/pic32cm_sg00_cpro/Kconfig.pic32cm_sg00_cpro
```kconfig
# Copyright (c) 2026 Microchip Technology Inc.
# SPDX-License-Identifier: Apache-2.0

config BOARD_PIC32CM_SG00_CPRO
	select SOC_PIC32CM5112SG00100
```

## boards/microchip/pic32c/pic32cm_sg00_cpro/board.yml
```yaml
# Copyright (c) 2026 Microchip Technology Inc.
# SPDX-License-Identifier: Apache-2.0

board:
  name: pic32cm_sg00_cpro
  full_name: PIC32CM SG00 Curiosity Pro
  vendor: microchip
  socs:
    - name: pic32cm5112sg00100
```

## boards/microchip/pic32c/pic32cx_sg41_cult/Kconfig.pic32cx_sg41_cult
```kconfig
# Copyright (c) 2025 Microchip Technology Inc.
# SPDX-License-Identifier: Apache-2.0

config BOARD_PIC32CX_SG41_CULT
	select SOC_PIC32CX1025SG41128
```

## boards/microchip/pic32c/pic32cx_sg41_cult/board.yml
```yaml
# Copyright (c) 2025 Microchip Technology Inc.
# SPDX-License-Identifier: Apache-2.0

board:
  name: pic32cx_sg41_cult
  full_name: PIC32CX SG41 Curiosity Ultra
  vendor: microchip
  socs:
    - name: pic32cx1025sg41128
```

## boards/microchip/pic32c/pic32cx_sg61_cult/Kconfig.pic32cx_sg61_cult
```kconfig
# Copyright (c) 2025 Microchip Technology Inc.
# SPDX-License-Identifier: Apache-2.0

config BOARD_PIC32CX_SG61_CULT
	select SOC_PIC32CX1025SG61128
```

## boards/microchip/pic32c/pic32cx_sg61_cult/board.yml
```yaml
# Copyright (c) 2025 Microchip Technology Inc.
# SPDX-License-Identifier: Apache-2.0

board:
  name: pic32cx_sg61_cult
  full_name: PIC32CX SG61 Curiosity Ultra
  vendor: microchip
  socs:
    - name: pic32cx1025sg61128
```

## boards/microchip/pic32c/pic32cz_ca80_cult/Kconfig.pic32cz_ca80_cult
```kconfig
# Copyright (c) 2025 Microchip Technology Inc.
# SPDX-License-Identifier: Apache-2.0

config BOARD_PIC32CZ_CA80_CULT
	select SOC_PIC32CZ8110CA80208
```

## boards/microchip/pic32c/pic32cz_ca80_cult/board.yml
```yaml
# Copyright (c) 2025 Microchip Technology Inc.
# SPDX-License-Identifier: Apache-2.0

board:
  name: pic32cz_ca80_cult
  full_name: PIC32CZ CA80 Curiosity Ultra
  vendor: microchip
  socs:
    - name: pic32cz8110ca80208
```

## boards/microchip/pic32c/pic32cz_ca90_cult/Kconfig.pic32cz_ca90_cult
```kconfig
# Copyright (c) 2026 Microchip Technology Inc.
# SPDX-License-Identifier: Apache-2.0

config BOARD_PIC32CZ_CA90_CULT
	select SOC_PIC32CZ8110CA90208
```

## boards/microchip/pic32c/pic32cz_ca90_cult/board.yml
```yaml
# Copyright (c) 2026 Microchip Technology Inc.
# SPDX-License-Identifier: Apache-2.0

board:
  name: pic32cz_ca90_cult
  full_name: PIC32CZ CA90 Curiosity Ultra
  vendor: microchip
  socs:
    - name: pic32cz8110ca90208
```

## boards/microchip/pic32cx_sg41_cult/board.yml
```yaml
board:
  name: pic32cx_sg41_cult
  vendor: microchip
  socs:
    - name: pic32cx1025sg41128
```

## boards/microchip/pic32cx_sg61_cult/Kconfig.pic32cxsg61_cult
```kconfig
# Copyright (c) 2024 Microchip
# SPDX-License-Identifier: Apache-2.0

config BOARD_PIC32CXSG61_CULT
	select SOC_PIC32CXSG61
```

## boards/microchip/pic32cx_sg61_cult/board.yml
```yaml
board:
  name: pic32cx_sg61_cult
  vendor: microchip
  socs:
    - name: pic32cx1025sg61128
```

## boards/microchip/pic32cxsg41_cult/Kconfig.pic32cxsg41_cult
```kconfig
# Copyright (c) 2024 Microchip
# SPDX-License-Identifier: Apache-2.0

config BOARD_PIC32CXSG41_CULT
	select SOC_PIC32CX1025SG41128
```

## boards/microchip/pic32cxsg41_cult/board.yml
```yaml
board:
  name: pic32cxsg41_cult
  full_name: PIC32CX SG41 Curiosity Ultra Evaluation Kit
  vendor: microchip
  socs:
    - name: pic32cx1025sg41128
```

## boards/microchip/pic32cxsg41_cult/pic32cxsg41_cult_defconfig
```kconfig
# Copyright (c) 2024 Microchip
# SPDX-License-Identifier: Apache-2.0

CONFIG_SOC_MICROCHIP_PIC32CXSG_XOSC32K=y
CONFIG_SOC_MICROCHIP_PIC32CXSG_XOSC32K_AS_MAIN=y

CONFIG_BUILD_OUTPUT_HEX=y

CONFIG_ARM_MPU=y
CONFIG_HW_STACK_PROTECTION=y

CONFIG_CONSOLE=y
CONFIG_SERIAL=y
CONFIG_UART_CONSOLE=y
CONFIG_UART_INTERRUPT_DRIVEN=y
```

## boards/microchip/pic32cxsg61_cult/Kconfig.defconfig
```kconfig
# PIC32CX SG61 Curiosity Ultra board configuration
#
# Copyright (c) 2024 Microchip
# SPDX-License-Identifier: Apache-2.0

if ETH_SAM_GMAC

# Read MAC address from AT24MAC402 EEPROM

config ETH_SAM_GMAC_MAC_I2C_INT_ADDRESS
	default 0x9A

config ETH_SAM_GMAC_MAC_I2C_INT_ADDRESS_SIZE
	default 1

config ETH_SAM_GMAC_MAC_I2C_EEPROM
	default y
	select I2C

endif # ETH_SAM_GMAC

if NETWORKING

config NET_L2_ETHERNET
	default y

endif # NETWORKING
```

## boards/microchip/pic32cxsg61_cult/Kconfig.pic32cxsg61_cult
```kconfig
# Copyright (c) 2024 Microchip
# SPDX-License-Identifier: Apache-2.0

config BOARD_PIC32CXSG61_CULT
	select SOC_PIC32CX1025SG61128
```
