/*
 * SPDX-FileCopyrightText: Copyright The Zephyr Project Contributors
 * SPDX-FileCopyrightText: Copyright 2026 Siemens Mobility GmbH
 * SPDX-License-Identifier: Apache-2.0
 */

/dts-v1/;
#include "pic32cm_gc00_cpro.dts"

/ {
	chosen {
		/delete-property/ zephyr,romstart;
	};
};
