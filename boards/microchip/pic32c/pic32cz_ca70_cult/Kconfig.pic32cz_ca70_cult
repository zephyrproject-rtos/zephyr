## boards/microchip/pic32c/pic32cz_ca70_cult/Kconfig.pic32cz_ca70_cult
```kconfig
# SPDX-FileCopyrightText: Copyright The Zephyr Project Contributors
# SPDX-License-Identifier: Apache-2.0

config BOARD_PIC32CZ_CA70_CULT
	select SOC_PIC32CZ2051CA70144
```

## boards/microchip/pic32c/pic32cz_ca70_cult/board.yml
```yaml
# SPDX-FileCopyrightText: Copyright The Zephyr Project Contributors
# SPDX-License-Identifier: Apache-2.0

board:
  name: pic32cz_ca70_cult
  full_name: PIC32CZ CA70 Curiosity Ultra
  vendor: microchip
  socs:
    - name: pic32cz2051ca70144
```

## boards/microchip/pic32wm/pic32wm_bz6204_curiosity/board.yml
```yaml
# SPDX-FileCopyrightText: Copyright (c) 2026 Microchip Technology Inc.
# SPDX-License-Identifier: Apache-2.0

board:
  name: pic32wm_bz6204_curiosity
  full_name: Microchip PIC32WM BZ6204 Curiosity Board
  vendor: microchip
  socs:
    - name: pic32cx2051bz62132
```

## boards/microchip/pic32wm/pic32wm_bz6204_curiosity/pic32wm_bz6204_curiosity_defconfig
```kconfig
# SPDX-FileCopyrightText: Copyright (c) 2026 Microchip Technology Inc.
# SPDX-License-Identifier: Apache-2.0

CONFIG_ARM_MPU=y
CONFIG_HW_STACK_PROTECTION=y
```

## boards/nxp/frdm_a_s32k344/Kconfig.defconfig
```kconfig
# Copyright 2023-2024 NXP
# SPDX-License-Identifier: Apache-2.0

if SERIAL

configdefault UART_CONSOLE
	default y

endif # SERIAL

if SPI

configdefault GPIO_INIT_PRIORITY
	default 10

configdefault SPI_INIT_PRIORITY
	default 10

if WDT_NXP_FS26

configdefault WDT_NXP_FS26_INIT_PRIORITY
	default 10

endif # WDT_NXP_FS26

endif # SPI

configdefault NET_L2_ETHERNET
	default y if !NET_LOOPBACK && !NET_TEST
```

## boards/nxp/frdm_imx937/Kconfig.frdm_imx937
```kconfig
# Copyright 2026 NXP
# SPDX-License-Identifier: Apache-2.0

config BOARD_FRDM_IMX937
	select SOC_MIMX9375_M7 if BOARD_FRDM_IMX937_MIMX9375_M7 || \
				BOARD_FRDM_IMX937_MIMX9375_M7_DDR || \
				BOARD_FRDM_IMX937_MIMX9375_M7_FLASH
	select SOC_PART_NUMBER_MIMX9375XXVZX
```

## boards/nxp/frdm_imx937/board.yml
```yaml
board:
  name: frdm_imx937
  full_name: FRDM-IMX937
  vendor: nxp
  socs:
  - name: mimx9375
    variants:
    - name: ddr
      cpucluster: m7
    - name: flash
      cpucluster: m7
```

## boards/nxp/frdm_mcxe32b/Kconfig.defconfig
```kconfig
# SPDX-FileCopyrightText: Copyright 2026 NXP
# SPDX-License-Identifier: Apache-2.0

if BOARD_FRDM_MCXE32B_MCXE32B_CPU0

configdefault ETH_DRIVER
	default y

endif # BOARD_FRDM_MCXE32B_MCXE32B_CPU0
```

## boards/nxp/frdm_mcxe32b/frdm_mcxe32b_mcxe32b_cpu1_defconfig
```kconfig
# SPDX-FileCopyrightText: Copyright 2026 NXP
#
# SPDX-License-Identifier: Apache-2.0

CONFIG_CONSOLE=y
CONFIG_UART_CONSOLE=y
CONFIG_SERIAL=y
CONFIG_UART_INTERRUPT_DRIVEN=y

# CPU0 owns the clock tree
CONFIG_CLOCK_CONTROL_NXP_MC_CGM_INIT=n
```

## boards/nxp/frdm_mcxw23/Kconfig.frdm_mcxw23
```kconfig
# Copyright 2025-2026 NXP
# SPDX-License-Identifier: Apache-2.0

config BOARD_FRDM_MCXW23
	select SOC_PART_NUMBER_MCXW236BIHNAR
```

## boards/nxp/frdm_mcxw71/Kconfig.frdm_mcxw71
```kconfig
# Copyright 2024-2026 NXP
# SPDX-License-Identifier: Apache-2.0

config BOARD_FRDM_MCXW71
	select SOC_PART_NUMBER_MCXW716CMFTA
```

## boards/nxp/frdm_mcxw72/Kconfig.frdm_mcxw72
```kconfig
# Copyright 2024-2026 NXP
# SPDX-License-Identifier: Apache-2.0

config BOARD_FRDM_MCXW72
	select SOC_PART_NUMBER_MCXW727CMFTA
```

## boards/nxp/mcxw23_evk/Kconfig.mcxw23_evk
```kconfig
# Copyright 2025-2026 NXP
# SPDX-License-Identifier: Apache-2.0

config BOARD_MCXW23_EVK
	select SOC_PART_NUMBER_MCXW236BIHNAR
```

## boards/nxp/mcxw72_evk/Kconfig.mcxw72_evk
```kconfig
# Copyright 2024-2026 NXP
# SPDX-License-Identifier: Apache-2.0

config BOARD_MCXW72_EVK
	select SOC_PART_NUMBER_MCXW727CMFTA
```

## boards/nxp/mimxrt1170_evk/board.yml
```yaml
board:
  name: mimxrt1170_evk
  full_name: MIMXRT1170-EVK
  vendor: nxp
  socs:
    - name: mimxrt1176
      variants:
        - name: "enet_qos"
          cpucluster: "cm7"
  revision:
    format: "letter"
    default: "B"
    revisions:
      - name: "A"
      - name: "B"
```

## boards/nxp/mimxrt2660_evk/Kconfig.defconfig
```kconfig
# MIMXRT266x-EVK board

# Copyright 2026 NXP
# SPDX-License-Identifier: Apache-2.0

if BOARD_MIMXRT2660_EVK

configdefault NXP_FW_DUMP_FLASH_START_ADDR
	default 0x60500000

endif # BOARD_MIMXRT266x_EVK
```

## boards/openisa/rv32m1_vega/Kconfig
```kconfig
# SPDX-License-Identifier: Apache-2.0
# Copyright 2018 Foundries.io Ltd

if BT

config HAS_RV32M1_CAU3_BLE
	bool
	default y if BT_CTLR_CRYPTO && \
		(BT_CTLR_LE_ENC_SUPPORT || BT_CTLR_PRIVACY_SUPPORT)

endif # BT
```

## boards/openisa/rv32m1_vega/Kconfig.defconfig
```kconfig
# SPDX-License-Identifier: Apache-2.0
# Copyright 2018 Foundries.io Ltd

if BOARD_RV32M1_VEGA

if BT

config RV32M1_INTMUX_CHANNEL_2
	default n

config RV32M1_INTMUX_CHANNEL_3
	default n

endif # BT

endif # BOARD_RV32M1_VEGA
```

## boards/phytium/e2000q_come/Kconfig.defconfig
```kconfig
# Copyright (c) 2026 Process Mission
# SPDX-License-Identifier: Apache-2.0

if BOARD_E2000Q_COME

choice ARM64_VA_BITS
	default ARM64_VA_BITS_42
endchoice

choice ARM64_PA_BITS
	default ARM64_PA_BITS_42
endchoice

endif # BOARD_E2000Q_COME
```

## boards/phytium/e2000q_come/Kconfig.e2000q_come
```kconfig
# Copyright (c) 2026 Process Mission
# SPDX-License-Identifier: Apache-2.0

config BOARD_E2000Q_COME
	select SOC_PE2204
```

## boards/phytium/e2000q_come/board.yml
```yaml
board:
  name: e2000q_come
  full_name: Phytium E2000Q COM Express
  vendor: phytium
  socs:
    - name: pe2204
      variants:
        - name: smp
```
