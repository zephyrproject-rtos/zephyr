## boards/microchip/pic32c/pic32cz_ca90_cult/Kconfig.defconfig
```kconfig
# SPDX-FileCopyrightText: Copyright The Zephyr Project Contributors
# SPDX-License-Identifier: Apache-2.0

if BOARD_PIC32CZ_CA90_CULT

configdefault ETH_DRIVER
	default y

endif # BOARD_PIC32CZ_CA90_CULT
```

## boards/microchip/pic32c/pic32wm_bz6204_curiosity/Kconfig.pic32wm_bz6204_curiosity
```kconfig
# Copyright (c) 2025 Microchip Technology Inc.
# SPDX-License-Identifier: Apache-2.0

config BOARD_PIC32WM_BZ6204_CURIOSITY
	select SOC_PIC32CX2051BZ62132
```

## boards/microchip/pic32c/pic32wm_bz6204_curiosity/board.yml
```yaml
# Copyright (c) 2025 Microchip Technology Inc.
# SPDX-License-Identifier: Apache-2.0

board:
  name: pic32wm_bz6204_curiosity
  full_name: PIC32WM_BZ6204 Curiosity
  vendor: microchip
  socs:
    - name: pic32cx2051bz62132
```

## boards/microchip/pic64gx_curiosity_kit/Kconfig.defconfig
```kconfig
# SPDX-FileCopyrightText: Copyright The Zephyr Project Contributors
# SPDX-License-Identifier: Apache-2.0

if BOARD_PIC64GX_CURIOSITY_KIT

configdefault ETH_DRIVER
	default y

configdefault NET_TX_STACK_SIZE
	default 8192

configdefault NET_RX_STACK_SIZE
	default 8192

configdefault NET_TCP_WORKQ_STACK_SIZE
	default 8192

configdefault NET_MGMT_EVENT_STACK_SIZE
	default 8192

configdefault NET_SOCKETS_SERVICE_STACK_SIZE
	default 8192

endif # BOARD_PIC64GX_CURIOSITY_KIT
```

## boards/microchip/sam/sam_e54_xpro/Kconfig.defconfig
```kconfig
# Copyright (c) 2026 Microchip Technology Inc.
# SPDX-License-Identifier: Apache-2.0

if BOARD_SAM_E54_XPRO

config EEPROM
	default y if NVMEM

configdefault ETH_DRIVER
	default y

endif # BOARD_SAM_E54_XPRO
```

## boards/microchip/sam/sama7d65_cpro/Kconfig.sama7d65_cpro
```kconfig
# Copyright (C) 2026 Microchip Technology Inc.
#
# SPDX-License-Identifier: Apache-2.0
#

config BOARD_SAMA7D65_CPRO
	select SOC_SAMA7D65
```

## boards/microchip/sam/sama7d65_cpro/board.yml
```yaml
board:
  name: sama7d65_cpro
  full_name: SAMA7D65 Curiosity Pro Kit
  vendor: microchip
  socs:
    - name: sama7d65
```

## boards/microchip/sam/sama7d65_curiosity/Kconfig.defconfig
```kconfig
# Copyright (C) 2026 Microchip Technology Inc. and its subsidiaries
#
# SPDX-License-Identifier: Apache-2.0
#

configdefault EEPROM
	default y if NVMEM

configdefault ETH_DRIVER
	default y
```

## boards/microchip/sam/sama7g54_cpro/Kconfig.defconfig
```kconfig
# Copyright (C) 2026 Microchip Technology Inc.
#
# SPDX-License-Identifier: Apache-2.0
#

configdefault EEPROM
	default y if NVMEM

configdefault ETH_DRIVER
	default y if NETWORKING
```

## boards/microchip/sam/sama7g54_cpro/Kconfig.sama7g54_cpro
```kconfig
# Copyright (C) 2026 Microchip Technology Inc.
#
# SPDX-License-Identifier: Apache-2.0
#

config BOARD_SAMA7G54_CPRO
	select SOC_SAMA7G54
```

## boards/microchip/sam/sama7g54_cpro/board.yml
```yaml
board:
  name: sama7g54_cpro
  full_name: SAMA7G54 Curiosity Pro Kit
  vendor: microchip
  socs:
    - name: sama7g54
```

## boards/microchip/sam/sama7g54_cpro/sama7g54_cpro_defconfig
```kconfig
# Copyright (C) 2026 Microchip Technology Inc.
#
# SPDX-License-Identifier: Apache-2.0
#

CONFIG_CLOCK_CONTROL_FIXED_RATE_CLOCK=y
CONFIG_CONSOLE=y
CONFIG_SERIAL=y
CONFIG_UART_CONSOLE=y
```

## boards/mikroe/hexiwear/hexiwear_mk64f12_defconfig
```kconfig
# SPDX-License-Identifier: Apache-2.0

CONFIG_CONSOLE=y
CONFIG_UART_CONSOLE=y
CONFIG_SERIAL=y
CONFIG_GPIO=y
CONFIG_OSC_LOW_POWER=y
CONFIG_ARM_MPU=y
CONFIG_HW_STACK_PROTECTION=y
```

## boards/mikroe/hexiwear/hexiwear_mkw40z4_defconfig
```kconfig
# SPDX-License-Identifier: Apache-2.0

CONFIG_CONSOLE=y
CONFIG_RTT_CONSOLE=y
CONFIG_USE_SEGGER_RTT=y
CONFIG_GPIO=y
CONFIG_OSC_EXTERNAL=y
```

## boards/mikroe/quail/Kconfig.defconfig
```kconfig
# MikroE Quail board configuration

# Copyright (c) 2025 ThoseBoards
# SPDX-License-Identifier: Apache-2.0

source "boards/common/usb/Kconfig.cdc_acm_serial.defconfig"
```

## boards/mikroe/sibrain_stm32l162ze/Kconfig.mikroe_sibrain_stm32l162ze
```kconfig
# Copyright (c) 2026 Filip Stojanovic <filipembedded@gmail.com>
# SPDX-License-Identifier: Apache-2.0

config BOARD_MIKROE_SIBRAIN_STM32L162ZE
	select SOC_STM32L162XE
```

## boards/mikroe/sibrain_stm32l162ze/board.yml
```yaml
board:
  name: mikroe_sibrain_stm32l162ze
  full_name: SiBRAIN for STM32L162ZE
  vendor: mikroe
  socs:
    - name: stm32l162xe
```

## boards/mikroe/sibrain_stm32l162ze/mikroe_sibrain_stm32l162ze_defconfig
```kconfig
# Copyright (c) 2026 Filip Stojanovic <filipembedded@gmail.com>
# SPDX-License-Identifier: Apache-2.0

# Enable MPU
CONFIG_ARM_MPU=y

# Enable HW stack protection
CONFIG_HW_STACK_PROTECTION=y

# Console
CONFIG_SERIAL=y
CONFIG_CONSOLE=y
CONFIG_UART_CONSOLE=y

# Enable GPIO
CONFIG_GPIO=y
```

## boards/mikroe/uni_clicker/Kconfig.defconfig
```kconfig
# Copyright (c) 2026 Mario Paja
# SPDX-License-Identifier: Apache-2.0

if BOARD_MIKROE_UNI_CLICKER

source "boards/common/usb/Kconfig.cdc_acm_serial.defconfig"

if NETWORKING

config NET_L2_ETHERNET
	default y if DT_HAS_ST_STM32_ETHERNET_ENABLED

endif # NETWORKING

endif # BOARD_MIKROE_UNI_CLICKER
```

## boards/mikroe/uni_clicker/Kconfig.mikroe_uni_clicker
```kconfig
# Copyright (c) 2026 Mario Paja
# SPDX-License-Identifier: Apache-2.0

config BOARD_MIKROE_UNI_CLICKER
	select SOC_STM32F429XX if BOARD_MIKROE_UNI_CLICKER_STM32F429XX_MCU_CARD_4
```

## boards/mikroe/uni_clicker/board.yml
```yaml
board:
  name: mikroe_uni_clicker
  full_name: UNI Clicker
  vendor: mikroe
  socs:
    - name: stm32f429xx
      variants:
        - name: mcu_card_4
```

## boards/mikroe/uni_clicker/dts/bindings/mikroe,mcu-card-connector.yaml
```yaml
# Copyright (c) 2026 Mario Paja
# SPDX-License-Identifier: Apache-2.0

description: GPIO pins exposed on MikroE MCU card connectors.

compatible: "mikroe,mcu-card-connector"

include: [gpio-nexus.yaml, base.yaml]
```

## boards/muselab/nano_ch32v305/Kconfig.nano_ch32v305
```kconfig
# Copyright (c) 2026 nanoCH32V305 contributors
# SPDX-License-Identifier: Apache-2.0

config BOARD_NANO_CH32V305
	select SOC_CH32V305
```

## boards/muselab/nano_ch32v305/board.yml
```yaml
board:
  name: nano_ch32v305
  full_name: MuseLab nanoCH32V305
  vendor: muselab
  socs:
    - name: ch32v305
```

## boards/muselab/nano_ch32v305/nano_ch32v305_defconfig
```kconfig
# Copyright (c) 2026 nanoCH32V305 contributors
# SPDX-License-Identifier: Apache-2.0

CONFIG_GPIO=y

CONFIG_SERIAL=y
CONFIG_CONSOLE=y
CONFIG_UART_CONSOLE=y
```
