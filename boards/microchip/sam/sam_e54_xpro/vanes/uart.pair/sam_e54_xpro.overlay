/*
 * Copyright (c) 2025-2026 Microchip Technology Inc.
 *
 * SPDX-License-Identifier: Apache-2.0
 */

/*connect PB16 to PC23 and PB17 to PC22*/

dut: &sercom1 {
	status = "okay";
};

dut_aux: &sercom5 {
	status = "okay";
};
