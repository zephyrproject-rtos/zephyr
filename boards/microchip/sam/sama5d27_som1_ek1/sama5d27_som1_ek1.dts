/*
 * Copyright (C) 2026 Microchip Technology Inc.
 *
 * SPDX-License-Identifier: Apache-2.0
 *
 */

/dts-v1/;
#include <common/freq.h>
#include <microchip/sam/sama5/sama5d2/sama5d27som1.dtsi>

/ {
	model = "SAMA5D27-SOM1-EK1 board";
	compatible = "microchip,sama5d27_som1_ek1", "microchip,sama5d2", "microchip,sama5";

	chosen {
		zephyr,console = &uart1;
		zephyr,sram = &ddram;
		zephyr,shell-uart = &uart1;
		zephyr,system-timer = &pit;
	};
};

&pit {
	clock-frequency = <DT_FREQ_K(5125)>;
	status = "okay";
};

&uart1 {
	current-speed = <115200>;
	status = "okay";
};
