## boards/vicharak/shrike_fi/Kconfig
```kconfig
# Copyright (C) 2026 Dhruv Menon <dhruvmenon1104@gmail.com>
# SPDX-License-Identifier: Apache-2.0

config HEAP_MEM_POOL_ADD_SIZE_BOARD
	int
	default 4096 if BOARD_SHRIKE_FI_ESP32S3_PROCPU
	default 256 if BOARD_SHRIKE_FI_ESP32S3_APPCPU
```

## boards/vicharak/shrike_fi/Kconfig.shrike_fi
```kconfig
# Copyright (C) 2026 Dhruv Menon <dhruvmenon1104@gmail.com>
# SPDX-License-Identifier: Apache-2.0

config BOARD_SHRIKE_FI
	select SOC_ESP32S3_FN8
	select SOC_ESP32S3_PROCPU if BOARD_SHRIKE_FI_ESP32S3_PROCPU
	select SOC_ESP32S3_APPCPU if BOARD_SHRIKE_FI_ESP32S3_APPCPU
```

## boards/vicharak/shrike_fi/Kconfig.sysbuild
```kconfig
# Copyright (C) 2026 Dhruv Menon <dhruvmenon1104@gmail.com>
# SPDX-License-Identifier: Apache-2.0

choice BOOTLOADER
	default BOOTLOADER_MCUBOOT
endchoice

choice BOOT_SIGNATURE_TYPE
	default BOOT_SIGNATURE_TYPE_NONE
endchoice
```

## boards/vicharak/shrike_fi/board.yml
```yaml
board:
  name: shrike_fi
  full_name: Shrike-fi
  vendor: vicharak
  socs:
  - name: esp32s3
```

## boards/vicharak/shrike_fi/shrike_fi_appcpu_defconfig
```kconfig
# Copyright (C) 2026 Dhruv Menon <dhruvmenon1104@gmail.com>
# SPDX-License-Identifier: Apache-2.0

CONFIG_CLOCK_CONTROL=y
```

## boards/vicharak/shrike_fi/shrike_fi_procpu_defconfig
```kconfig
# Copyright (C) 2026 Dhruv Menon <dhruvmenon1104@gmail.com>
# SPDX-License-Identifier: Apache-2.0

CONFIG_CONSOLE=y
CONFIG_SERIAL=y
CONFIG_UART_CONSOLE=y
CONFIG_GPIO=y
CONFIG_CLOCK_CONTROL=y
```

## boards/viewe/uedx24320028e_wb_a/Kconfig.defconfig
```kconfig
# SPDX-FileCopyrightText: Copyright The Zephyr Project Contributors
# SPDX-License-Identifier: Apache-2.0

if BOARD_UEDX24320028E_WB_A_ESP32S3_PROCPU

config SOC_FAMILY_ESPRESSIF_SPIRAM
	default y if !MCUBOOT

choice SOC_FAMILY_ESPRESSIF_SPIRAM_MODE
	default SOC_FAMILY_ESPRESSIF_SPIRAM_MODE_OCT
endchoice

if DISPLAY

if LVGL

configdefault LV_COLOR_16_SWAP
	default y

endif # LVGL

config REGULATOR
	default y

endif # DISPLAY

endif # BOARD_UEDX24320028E_WB_A_ESP32S3_PROCPU
```

## boards/viewe/uedx32480035e_wb_a/Kconfig.defconfig
```kconfig
# Copyright (c) 2024 Espressif Systems (Shanghai) Co., Ltd.
# Copyright (c) 2026 VIEWE Display Co., Ltd.
# SPDX-License-Identifier: Apache-2.0

if BOARD_UEDX32480035E_WB_A_ESP32S3_PROCPU

config ESP_SPIRAM
	default y

choice SPIRAM_MODE
	default SPIRAM_MODE_OCT
endchoice

if DISPLAY

config DMA
	default y

config REGULATOR
	default y

endif # DISPLAY

endif # BOARD_UEDX32480035E_WB_A_ESP32S3_PROCPU
```

## boards/waiken-smart/gd32f470z_start/Kconfig.gd32f470z_start
```kconfig
# Copyright (c) 2026 Zhijian Han
# SPDX-License-Identifier: Apache-2.0

config BOARD_GD32F470Z_START
	select SOC_GD32F470
```

## boards/waiken-smart/gd32f470z_start/board.yml
```yaml
board:
  name: gd32f470z_start
  full_name: GD32F470Z-START
  vendor: waiken-smart
  socs:
    - name: gd32f470
```

## boards/waiken-smart/gd32f470zit6_core/Kconfig.gd32f470zit6_core
```kconfig
# Copyright (c) 2026 Zhijian Han
# SPDX-License-Identifier: Apache-2.0

config BOARD_GD32F470ZIT6_CORE
	select SOC_GD32F470
```

## boards/waiken-smart/gd32f470zit6_core/board.yml
```yaml
board:
  name: gd32f470zit6_core
  full_name: GD32F470ZIT6 Core Board
  vendor: waiken-smart
  socs:
    - name: gd32f470
```

## boards/waveshare/core2350b/Kconfig.core2350b
```kconfig
# SPDX-FileCopyrightText: Copyright (c) 2026 MASSDRIVER EI (massdriver.space)
# SPDX-FileCopyrightText: Copyright (c) 2026 Fabrizio Carlassara (iomico)
# SPDX-License-Identifier: Apache-2.0

config BOARD_CORE2350B
	select SOC_RP2350B_HAZARD3_0 if BOARD_CORE2350B_RP2350B_HAZARD3_0
	select SOC_RP2350B_M33_0 if BOARD_CORE2350B_RP2350B_M33_0
```

## boards/waveshare/core2350b/Kconfig.defconfig
```kconfig
# SPDX-FileCopyrightText: Copyright (c) 2026 MASSDRIVER EI (massdriver.space)
# SPDX-FileCopyrightText: Copyright (c) 2026 Fabrizio Carlassara (iomico)
# SPDX-License-Identifier: Apache-2.0

if BOARD_CORE2350B

config USB_SELF_POWERED
	default n

source "boards/common/usb/Kconfig.cdc_acm_serial.defconfig"

endif # BOARD_CORE2350B
```

## boards/waveshare/core2350b/board.yml
```yaml
board:
  name: core2350b
  full_name: Waveshare Core2350B
  vendor: waveshare
  socs:
    - name: rp2350b
```

## boards/waveshare/esp32c6_lcd_1_47/esp32c6_lcd_1_47_hpcore_defconfig
```kconfig
# Copyright (c) 2026 Shankar Sridhar
# SPDX-License-Identifier: Apache-2.0

CONFIG_CONSOLE=y
CONFIG_SERIAL=y
CONFIG_UART_CONSOLE=y
CONFIG_GPIO=y
CONFIG_I2S=y
CONFIG_LED_STRIP=y
CONFIG_WS2812_STRIP_I2S=y
```

## boards/waveshare/esp32p4_eth/board.yml
```yaml
board:
  name: waveshare_esp32p4_eth
  full_name: Waveshare ESP32-P4-ETH
  vendor: waveshare
  socs:
  - name: esp32p4
```

## boards/waveshare/esp32p4_wifi6/Kconfig.defconfig
```kconfig
# Copyright (c) 2026 Matheus Alencar
# SPDX-License-Identifier: Apache-2.0

if BOARD_ESP32P4_WIFI6

configdefault NET_L2_ETHERNET
	default y

endif # BOARD_ESP32P4_WIFI6
```

## boards/waveshare/esp32p4_wifi6/Kconfig.sysbuild
```kconfig
# Copyright (c) 2026 Hongquan Li
# SPDX-License-Identifier: Apache-2.0

choice BOOTLOADER
	default BOOTLOADER_MCUBOOT
endchoice
```

## boards/waveshare/esp32p4_wifi6_dev_kit/Kconfig.defconfig
```kconfig
# Copyright (c) 2026 Process Mission
#
# SPDX-License-Identifier: Apache-2.0

if BOARD_ESP32P4_WIFI6_DEV_KIT_ESP32P4_HPCORE

configdefault ETH_DRIVER
	default y if DT_HAS_ESPRESSIF_ESP32_ETH_ENABLED

endif # BOARD_ESP32P4_WIFI6_DEV_KIT_ESP32P4_HPCORE
```

## boards/waveshare/esp32p4_wifi6_touch_lcd_4_3/Kconfig.esp32p4_wifi6_touch_lcd_4_3
```kconfig
# Waveshare ESP32-P4-WIFI6-Touch-LCD-4.3 configuration
#
# SPDX-FileCopyrightText: Copyright The Zephyr Project Contributors
#
# SPDX-License-Identifier: Apache-2.0

config BOARD_ESP32P4_WIFI6_TOUCH_LCD_4_3
	select SOC_ESP32P4_HPCORE if BOARD_ESP32P4_WIFI6_TOUCH_LCD_4_3_ESP32P4_HPCORE
	select SOC_ESP32P4_LPCORE if BOARD_ESP32P4_WIFI6_TOUCH_LCD_4_3_ESP32P4_LPCORE
	select SOC_ESP32P4_REV_3_0
```

## boards/waveshare/esp32p4_wifi6_touch_lcd_4_3/board.yml
```yaml
board:
  name: esp32p4_wifi6_touch_lcd_4_3
  full_name: ESP32-P4-WIFI6-Touch-LCD-4.3
  vendor: waveshare
  socs:
  - name: esp32p4
```
