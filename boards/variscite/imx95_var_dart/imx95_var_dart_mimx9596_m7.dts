/*
 * Copyright 2024 NXP
 *
 * SPDX-License-Identifier: Apache-2.0
 */

/dts-v1/;

#include <nxp/imx/nxp_imx95_m7.dtsi>
#include "imx95_var_dart-pinctrl.dtsi"

/ {
	model = "Variscite DART-MX95 M7";
	compatible = "nxp,imx95_var_dart";

	chosen {
		/* TCM */
		zephyr,flash = &itcm;
		zephyr,sram = &dtcm;

		zephyr,console = &lpuart3;
		zephyr,shell-uart = &lpuart3;
	};
};

&lptmr1 {
	status = "okay";
};

&lpuart3 {
	status = "okay";
	current-speed = <115200>;
	pinctrl-0 = <&lpuart3_default>;
	pinctrl-names = "default";
};
