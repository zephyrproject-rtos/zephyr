## boards/madmachine/mm_feather/board.yml
```yaml
board:
  name: mm_feather
  full_name: SwiftIO Feather
  vendor: madmachine
  socs:
    - name: mimxrt1062
```

## boards/madmachine/mm_swiftio/Kconfig.defconfig
```kconfig
# MM-SWIFTIO board

# Copyright (c) 2019, MADMACHINE LIMITED
# Copyright 2023 NXP
# SPDX-License-Identifier: Apache-2.0

if BOARD_MM_SWIFTIO

config DEVICE_CONFIGURATION_DATA
	default y

config NXP_IMX_EXTERNAL_SDRAM
	default y

config DISK_DRIVER_SDMMC
	default y if DISK_DRIVERS

endif # BOARD_MM_SWIFTIO
```

## boards/madmachine/mm_swiftio/Kconfig.mm_swiftio
```kconfig
# Copyright (c) 2019, MADMACHINE LIMITED
# Copyright 2024 NXP
# SPDX-License-Identifier: Apache-2.0

config BOARD_MM_SWIFTIO
	select SOC_PART_NUMBER_MIMXRT1052DVL6B
```

## boards/madmachine/mm_swiftio/board.yml
```yaml
board:
  name: mm_swiftio
  full_name: SwiftIO
  vendor: madmachine
  socs:
    - name: mimxrt1052
```

## boards/maker_diary/nrf52832_mdk/Kconfig.nrf52832_mdk
```kconfig
# nRF52832-MDK board configuration

# Copyright (c) 2018 makerdiary.com.
# SPDX-License-Identifier: Apache-2.0

config BOARD_NRF52832_MDK
	select SOC_NRF52832_QFAA
```

## boards/maker_diary/nrf52840_mdk_usb_dongle/Kconfig
```kconfig
# nRF52840 MDK USB Dongle board configuration

# Copyright (c) 2022 Nikola Trifunovic
# Copyright (c) 2018 Nordic Semiconductor ASA
# SPDX-License-Identifier: Apache-2.0

if BOARD_NRF52840_MDK_USB_DONGLE

config BOARD_ENABLE_DCDC
	bool "DCDC mode"
	select SOC_DCDC_NRF52X
	default y

config BOARD_HAS_NRF5_BOOTLOADER
	bool "Board has nRF5 bootloader"
	default y
	help
	  If selected, applications are linked so that they can be loaded by Nordic
	  nRF5 bootloader.

endif # BOARD_NRF52840_MDK_USB_DONGLE
```

## boards/maker_diary/nrf52840_mdk_usb_dongle/board.yml
```yaml
board:
  name: nrf52840_mdk_usb_dongle
  vendor: Maker Diary
  socs:
  - name: nrf52840
```

## boards/makerbase/mks_canable_v10/Kconfig.mks_canable_v10
```kconfig
# SPDX-FileCopyrightText: Copyright (c) 2026 Navimatix GmbH
# SPDX-FileCopyrightText: Copyright (c) 2026 TiaC Systems
# SPDX-License-Identifier: Apache-2.0

config BOARD_MKS_CANABLE_V10
	select SOC_STM32F072X8
```

## boards/makerbase/mks_canable_v10/board.yml
```yaml
# SPDX-FileCopyrightText: Copyright (c) 2026 Navimatix GmbH
# SPDX-FileCopyrightText: Copyright (c) 2026 TiaC Systems
# SPDX-License-Identifier: Apache-2.0

board:
  name: mks_canable_v10
  full_name: MKS CANable V1.0
  vendor: makerbase
  socs:
    - name: stm32f072xb
```

## boards/makerbase/mks_canable_v20/Kconfig.mks_canable_v20
```kconfig
# Copyright (c) 2024 Alexander Kozhinov <ak.alexander.kozhinov@gmail.com>
# SPDX-License-Identifier: Apache-2.0

config BOARD_MKS_CANABLE_V20
	select SOC_STM32G431XX
```

## boards/makerbase/mks_canable_v20/board.yml
```yaml
board:
  name: mks_canable_v20
  full_name: MKS CANable V2.0
  vendor: makerbase
  socs:
    - name: stm32g431xx
```

## boards/makerbase/mks_canable_v20/mks_canable_v20_defconfig
```kconfig
# Copyright (c) 2024 Alexander Kozhinov <ak.alexander.kozhinov@gmail.com>
# SPDX-License-Identifier: Apache-2.0

CONFIG_GPIO=y
CONFIG_ARM_MPU=y
```

## boards/makerdiary/nrf52832_mdk/board.yml
```yaml
board:
  name: nrf52832_mdk
  full_name: nRF52832-mdk
  vendor: makerdiary
  socs:
  - name: nrf52832
```

## boards/makerdiary/nrf52840_m2/Kconfig
```kconfig
# nRF52840-M2 board configuration

# Copyright (c) 2024 Stavros Avramidis <stavros9899@gmail.com>
# SPDX-License-Identifier: Apache-2.0

if BOARD_NRF52840_M2

config BOARD_ENABLE_DCDC
	bool "Enable DCDC mode"
	select SOC_DCDC_NRF52X
	default y

config BOARD_ENABLE_DCDC_HV
	bool "High Voltage DCDC converter"
	select SOC_DCDC_NRF52X_HV
	default y

endif # BOARD_NRF52840_M2
```

## boards/makerdiary/nrf52840_m2/Kconfig.defconfig
```kconfig
# Maker Diary nRF52840-M2 Development board configuration
#
# Copyright (c) 2024 Stavros Avramidis <stavros9899@gmail.com>
# SPDX-License-Identifier: Apache-2.0

if BOARD_NRF52840_M2

config BT_CTLR
	default BT

endif # BOARD_NRF52840_M2
```

## boards/makerdiary/nrf52840_m2/Kconfig.nrf52840_m2
```kconfig
# Copyright (c) 2024 Stavros Avramidis <stavros9899@gmail.com>
# SPDX-License-Identifier: Apache-2.0

config BOARD_NRF52840_M2
	select 	NRF52840_QIAA
```

## boards/makerdiary/nrf52840_m2/nrf52840_m2_defconfig
```kconfig
# Copyright (c) 2022 Stavros Avramidis <stavros9899@gmail.com>
# SPDX-License-Identifier: Apache-2.0


# Enable MPU
CONFIG_ARM_MPU=y

# Enable hardware stack protection
CONFIG_HW_STACK_PROTECTION=y

# Enable RTT
CONFIG_USE_SEGGER_RTT=y

# Enable GPIO
CONFIG_GPIO=y

# Enable UART driver
CONFIG_SERIAL=y

# Enable console
CONFIG_CONSOLE=y
CONFIG_UART_CONSOLE=y

# Additional board options
CONFIG_GPIO_AS_PINRESET=y

CONFIG_PINCTRL=y
```

## boards/makerdiary/nrf52840_mdk/Kconfig.nrf52840_mdk
```kconfig
# nRF52840-MDK board configuration

# Copyright (c) 2018 makerdiary.com
# SPDX-License-Identifier: Apache-2.0

config BOARD_NRF52840_MDK
	select SOC_NRF52840_QIAA
```

## boards/makerdiary/nrf52840_mdk/board.yml
```yaml
board:
  name: nrf52840_mdk
  full_name: nRF52840-mdk
  vendor: makerdiary
  socs:
  - name: nrf52840
```

## boards/makerdiary/nrf52840_mdk_usb_dongle/Kconfig
```kconfig
# nRF52840 MDK USB Dongle board configuration

# Copyright (c) 2022 Nikola Trifunovic
# Copyright (c) 2018 Nordic Semiconductor ASA
# SPDX-License-Identifier: Apache-2.0

config BOARD_HAS_NRF5_BOOTLOADER
	bool "Board has nRF5 bootloader"
	default y
	depends on BOARD_NRF52840_MDK_USB_DONGLE
	help
	  If selected, applications are linked so that they can be loaded by Nordic
	  nRF5 bootloader.
```
