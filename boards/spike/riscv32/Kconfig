## boards/spike/riscv32/Kconfig
```kconfig
# Copyright (c) 2024 Tim-Marek Thomas <thomas@sra.uni-hannover.de>
# SPDX-License-Identifier: Apache-2.0
config BOARD_SPIKE_RISCV32
	select SPIKE_TARGET
```

## boards/spike/riscv32/board.yml
```yaml
board:
  name: spike_riscv32
  vendor: spike
  socs:
    - name: spike_virt_riscv32
```

## boards/spike/riscv32/spike_riscv32_defconfig
```kconfig
# Copyright (c) 2024 Tim-Marek Thomas <thomas@sra.uni-hannover.de>
# SPDX-License-Identifier: Apache-2.0

CONFIG_CONSOLE=y
CONFIG_SERIAL=y
CONFIG_UART_CONSOLE=y
CONFIG_STACK_SENTINEL=y
CONFIG_XIP=n
CONFIG_RISCV_PMP=y
```

## boards/spike/riscv64/Kconfig.spike_riscv64
```kconfig
# Copyright (c) 2024 Antmicro <www.antmicro.com>
# SPDX-License-Identifier: Apache-2.0

config BOARD_SPIKE_RISCV64
	select SOC_SPIKE_VIRT_RISCV64
```

## boards/spike/riscv64/board.yml
```yaml
board:
  name: spike_riscv64
  full_name: SPIKE Emulation for RISCV64
  vendor: spike 
  socs:
    - name: rocketchip_virt_riscv64
      variants:
        - name: smp
```

## boards/spike/riscv64/spike_riscv64_defconfig
```kconfig
# SPDX-License-Identifier: Apache-2.0

CONFIG_PRIVILEGED_STACK_SIZE=2048
CONFIG_REBOOT=y
CONFIG_UART_HTIF=y
CONFIG_CONSOLE=y
CONFIG_UART_CONSOLE=y
CONFIG_SERIAL=y
CONFIG_PRINTK=y
CONFIG_EARLY_CONSOLE=y
CONFIG_STACK_SENTINEL=y
CONFIG_XIP=n
CONFIG_RISCV_PMP=n
CONFIG_SMP=n
CONFIG_MP_MAX_NUM_CPUS=1
CONFIG_IDLE_STACK_SIZE=1024
CONFIG_QEMU_ICOUNT=n

CONFIG_FPU=y
CONFIG_FLOAT_HARD=y
CONFIG_FPU_SHARING=y
CONFIG_RISCV_ISA_EXT_V=n
CONFIG_RISCV_VECTOR_MAX_LEN=256
```

## boards/st/b_g474e_dpow1/Kconfig.b_g474e_dpow1
```kconfig
# Copyright 2022 The Chromium OS Authors
# SPDX-License-Identifier: Apache-2.0

config BOARD_B_G474E_DPOW1
	select SOC_STM32G474XX
```

## boards/st/b_g474e_dpow1/board.yml
```yaml
board:
  name: b_g474e_dpow1
  full_name: B-G474E-DPOW1 Discovery
  vendor: st
  socs:
    - name: stm32g474xx
```

## boards/st/b_l072z_lrwan1/Kconfig.b_l072z_lrwan1
```kconfig
# Copyright (c) 2018 Aleksandr Makarov <aleksandr.o.makarov@gmail.com>
# SPDX-License-Identifier: Apache-2.0

config BOARD_B_L072Z_LRWAN1
	select SOC_STM32L072XX
```

## boards/st/b_l072z_lrwan1/b_l072z_lrwan1_stm32l072xx_defconfig
```kconfig
# SPDX-License-Identifier: Apache-2.0

# Enable MPU
CONFIG_ARM_MPU=y

# Enable Clocks
CONFIG_CLOCK_CONTROL=y

# Serial Drivers
CONFIG_SERIAL=y
CONFIG_UART_INTERRUPT_DRIVEN=y
# enable console
CONFIG_CONSOLE=y
CONFIG_UART_CONSOLE=y

# GPIO Controller
CONFIG_GPIO=y

# enable pin controller
CONFIG_PINCTRL=y
```

## boards/st/b_l072z_lrwan1/board.yml
```yaml
board:
  name: b_l072z_lrwan1
  full_name: B-L072Z-LRWAN1 Discovery kit
  vendor: st
  socs:
    - name: stm32l072xx
```

## boards/st/b_l475e_iot01a/Kconfig.b_l475e_iot01a
```kconfig
# STM32L475E Discovery board configuration

# Copyright (c) 2023 Mohammed Billoo
# SPDX-License-Identifier: Apache-2.0

config BOARD_B_L475E_IOT01A
	select SOC_STM32L475XX
```

## boards/st/b_l475e_iot01a/Kconfig.defconfig.old
```kconfig
# STM32L475E DISCOVERY board configuration

# Copyright (c) 2023 Mohammed Billoo
# SPDX-License-Identifier: Apache-2.0

if BOARD_B_L475E_IOT01A

config BOARD
	default "stm32l475e_disco"

endif # BOARD_STM32L475E_DISCO
```

## boards/st/b_l4s5i_iot01a/Kconfig.b_l4s5i_iot01a
```kconfig
# Copyright (c) 2020 STMicroelectronics
# SPDX-License-Identifier: Apache-2.0

config BOARD_B_L4S5I_IOT01A
	select SOC_STM32L4S5XX
```

## boards/st/b_l4s5i_iot01a/Kconfig.defconfig
```kconfig
# B_L4S5I_IOT01A discovery kit board configuration

# Copyright (c) 2020 STMicroelectronics
# SPDX-License-Identifier: Apache-2.0

if BOARD_B_L4S5I_IOT01A

config SPI_STM32_INTERRUPT
	default y
	depends on SPI

choice LIS3MDL_TRIGGER_MODE
	default LIS3MDL_TRIGGER_NONE
endchoice

choice HTS221_TRIGGER_MODE
	default HTS221_TRIGGER_NONE
endchoice

choice LSM6DSL_TRIGGER_MODE
	default LSM6DSL_TRIGGER_GLOBAL_THREAD
	depends on LSM6DSL
endchoice

if BT

config SPI
	default y

config BT_SPI
	default y

config BT_BLUENRG_ACI
	default y
# Disable Flow control
config BT_HCI_ACL_FLOW_CONTROL
	default n
config BT_HCI_VS
	default n

endif # BT

endif # BOARD_B_L4S5I_IOT01A
```

## boards/st/b_l4s5i_iot01a/b_l4s5i_iot01a_defconfig
```kconfig
# SPDX-License-Identifier: Apache-2.0

# enable uart driver
CONFIG_SERIAL=y

# enable GPIO
CONFIG_GPIO=y

# console
CONFIG_CONSOLE=y
CONFIG_UART_CONSOLE=y
```

## boards/st/b_l4s5i_iot01a/board.yml
```yaml
board:
  name: b_l4s5i_iot01a
  full_name: B-L4S5I-IOT01A Discovery kit
  vendor: st
  socs:
    - name: stm32l4s5xx
```

## boards/st/b_u585i_iot02a/Kconfig.b_u585i_iot02a
```kconfig
# Copyright (c) 2021 STMicroelectronics
# SPDX-License-Identifier: Apache-2.0

config BOARD_B_U585I_IOT02A
	select SOC_STM32U585XX
```

## boards/st/b_u585i_iot02a/Kconfig.defconfig
```kconfig
# B_U585I_IOT02A discovery kit board configuration

# Copyright (c) 2021 STMicroelectronics
# SPDX-License-Identifier: Apache-2.0

if BOARD_B_U585I_IOT02A

config SPI_STM32_INTERRUPT
	default y
	depends on SPI

if BUILD_WITH_TFM

# Initial Attestation key provisioned by the BL1 bootloader
config TFM_INITIAL_ATTESTATION_KEY
	default y

config TFM_DUMMY_PROVISIONING
	default n

endif # BUILD_WITH_TFM

# Disable Flow control
if BT

config BT_HCI_ACL_FLOW_CONTROL
	default n

endif # BT

endif # BOARD_B_U585I_IOT02A
```

## boards/st/b_u585i_iot02a/b_u585i_iot02a_stm32u585xx_ns_defconfig
```kconfig
# SPDX-License-Identifier: Apache-2.0

# enable uart driver
CONFIG_SERIAL=y

# console
CONFIG_CONSOLE=y
CONFIG_UART_CONSOLE=y

# Enable TZ non-secure configuration
CONFIG_TRUSTED_EXECUTION_NONSECURE=y
CONFIG_RUNTIME_NMI=y

# Set HEX file to program non-secure image through flash secure address range
CONFIG_SOC_FAMILY_STM32_HEX_FILE_NS_APPLI_IN_SECURE_RANGE=y
```

## boards/st/b_u585i_iot02a/board.yml
```yaml
board:
  name: b_u585i_iot02a
  full_name: B-U585I-IOT02A Discovery kit
  vendor: st
  socs:
    - name: stm32u585xx
      variants:
        - name: ns
```

## boards/st/disco_l475_iot1/Kconfig.defconfig
```kconfig
# Discovery IoT L475 board configuration

# Copyright (c) 2017 Linaro Limited
# SPDX-License-Identifier: Apache-2.0

if BOARD_DISCO_L475_IOT1

config SPI_STM32_INTERRUPT
	default y
	depends on SPI

choice LIS3MDL_TRIGGER_MODE
	default LIS3MDL_TRIGGER_NONE
endchoice

choice HTS221_TRIGGER_MODE
	default HTS221_TRIGGER_NONE
endchoice

choice LSM6DSL_TRIGGER_MODE
	default LSM6DSL_TRIGGER_GLOBAL_THREAD
	depends on LSM6DSL
endchoice

if BT

config BT_BLUENRG_ACI
	default y
# Disable Flow control
config BT_HCI_ACL_FLOW_CONTROL
	default n
config BT_HCI_VS
	default n

endif # BT

endif # BOARD_DISCO_L475_IOT1
```

## boards/st/disco_l475_iot1/Kconfig.disco_l475_iot1
```kconfig
# Copyright (c) 2017 Linaro Limited
# SPDX-License-Identifier: Apache-2.0

config BOARD_DISCO_L475_IOT1
	select SOC_STM32L475XX
```

## boards/st/disco_l475_iot1/board.yml
```yaml
board:
  name: disco_l475_iot1
  full_name: Disco L475 IOT01 (B-L475E-IOT01A)
  vendor: st
  socs:
    - name: stm32l475xx
```
