## boards/openhwgroup/cv32a6_arty_a7_100/Kconfig.cv32a6_arty_a7_100
```kconfig
# Copyright 2024 CISPA Helmholtz Center for Information Security gGmbH
# SPDX-License-Identifier: Apache-2.0
config BOARD_CV32A6_ARTY_A7_100
	select SOC_CV32A6
	select SOC_FAMILY_CVA6_PROVIDE_FPGA_POWEROFF
```

## boards/openhwgroup/cv32a6_arty_a7_100/board.yml
```yaml
# Copyright 2024 CISPA Helmholtz Center for Information Security gGmbH
# SPDX-License-Identifier: Apache-2.0
board:
  name: cv32a6_arty_a7_100
  vendor: openhwgroup
  socs:
    - name: cv32a6
```

## boards/openhwgroup/cv32a6_arty_a7_100/cv32a6_arty_a7_100_defconfig
```kconfig
# Copyright 2024 CISPA Helmholtz Center for Information Security gGmbH
# SPDX-License-Identifier: Apache-2.0
CONFIG_BASE64=y
CONFIG_INCLUDE_RESET_VECTOR=y
CONFIG_CONSOLE=y
CONFIG_SERIAL=y
CONFIG_UART_CONSOLE=y
CONFIG_UART_NS16550=y
CONFIG_UART_NS16550_ACCESS_WORD_ONLY=y
CONFIG_CONSOLE_HANDLER=y
CONFIG_XIP=n
CONFIG_INIT_STACKS=y
CONFIG_SYS_CLOCK_TICKS_PER_SEC=100
CONFIG_POWEROFF=y

# RNG
CONFIG_TIMER_RANDOM_GENERATOR=y
CONFIG_TEST_RANDOM_GENERATOR=y

# IRQs
CONFIG_MULTI_LEVEL_INTERRUPTS=y
CONFIG_2ND_LEVEL_INTERRUPTS=y
# 1 PLIC
CONFIG_NUM_2ND_LEVEL_AGGREGATORS=1
CONFIG_PLIC=y
CONFIG_3RD_LEVEL_INTERRUPTS=n

# no networking support on this board

# logging
CONFIG_LOG=y
CONFIG_LOG_DEFAULT_LEVEL=3
CONFIG_THREAD_NAME=y

# increased stack sizes
CONFIG_ISR_STACK_SIZE=524288
CONFIG_MAIN_STACK_SIZE=524288
CONFIG_SYSTEM_WORKQUEUE_STACK_SIZE=524288
CONFIG_IDLE_STACK_SIZE=524288

# slower clock on Arty
CONFIG_SYS_CLOCK_HW_CYCLES_PER_SEC=12500000
```

## boards/openhwgroup/cv32a6_genesysII/board.yml
```yaml
# Copyright 2024 CISPA Helmholtz Center for Information Security gGmbH
# SPDX-License-Identifier: Apache-2.0
board:
  name: cv32a6_genesysII
  vendor: openhwgroup
  socs:
    - name: cv32a6
```

## boards/openhwgroup/cv32a6_genesys_2/Kconfig.cv32a6_genesys_2
```kconfig
# Copyright 2024 CISPA Helmholtz Center for Information Security gGmbH
# SPDX-License-Identifier: Apache-2.0
config BOARD_CV32A6_GENESYS_2
	select SOC_CV32A6
```

## boards/openhwgroup/cv32a6_genesys_2/board.yml
```yaml
# Copyright 2024 CISPA Helmholtz Center for Information Security gGmbH
# SPDX-License-Identifier: Apache-2.0
board:
  name: cv32a6_genesys_2
  full_name: Digilent CV32A6 on Genesys 2
  vendor: openhwgroup
  socs:
    - name: cv32a6
```

## boards/openhwgroup/cv32a6_genesys_2/cv32a6_genesys_2_defconfig
```kconfig
# Copyright 2024 CISPA Helmholtz Center for Information Security gGmbH
# SPDX-License-Identifier: Apache-2.0
CONFIG_INCLUDE_RESET_VECTOR=y
CONFIG_CONSOLE=y
CONFIG_SERIAL=y
CONFIG_UART_CONSOLE=y
CONFIG_UART_NS16550_ACCESS_WORD_ONLY=y
CONFIG_CONSOLE_HANDLER=y
CONFIG_XIP=n
```

## boards/openhwgroup/cv32a6_testbench/Kconfig.cv32a6_testbench
```kconfig
# Copyright 2024 CISPA Helmholtz Center for Information Security gGmbH
# SPDX-License-Identifier: Apache-2.0
config BOARD_CV32A6_TESTBENCH
	select SOC_CV32A6
	select SOC_FAMILY_CVA6_PROVIDE_TEST_POWEROFF
```

## boards/openhwgroup/cv32a6_testbench/board.yml
```yaml
# Copyright 2024 CISPA Helmholtz Center for Information Security gGmbH
# SPDX-License-Identifier: Apache-2.0
board:
  name: cv32a6_testbench
  vendor: openhwgroup
  socs:
    - name: cv32a6
```

## boards/openhwgroup/cv64a6_arty_a7_100/Kconfig.cv64a6_arty_a7_100
```kconfig
# Copyright 2024 CISPA Helmholtz Center for Information Security gGmbH
# SPDX-License-Identifier: Apache-2.0
config BOARD_CV64A6_ARTY_A7_100
	select SOC_CV64A6_IMAC
	select SOC_FAMILY_CVA6_PROVIDE_FPGA_POWEROFF
```

## boards/openhwgroup/cv64a6_arty_a7_100/board.yml
```yaml
# Copyright 2024 CISPA Helmholtz Center for Information Security gGmbH
# SPDX-License-Identifier: Apache-2.0
board:
  name: cv64a6_arty_a7_100
  vendor: openhwgroup
  socs:
    - name: cv64a6
```

## boards/openhwgroup/cv64a6_genesysII/board.yml
```yaml
# Copyright 2024 CISPA Helmholtz Center for Information Security gGmbH
# SPDX-License-Identifier: Apache-2.0
board:
  name: cv64a6_genesysII
  vendor: openhwgroup
  socs:
    - name: cv64a6
```

## boards/openhwgroup/cv64a6_genesysII/cv64a6_genesysII_defconfig
```kconfig
# Copyright 2024 CISPA Helmholtz Center for Information Security gGmbH
# SPDX-License-Identifier: Apache-2.0
CONFIG_BASE64=y
CONFIG_INCLUDE_RESET_VECTOR=y
CONFIG_CONSOLE=y
CONFIG_SERIAL=y
CONFIG_UART_CONSOLE=y
CONFIG_UART_NS16550=y
CONFIG_UART_NS16550_ACCESS_WORD_ONLY=y
CONFIG_CONSOLE_HANDLER=y
CONFIG_XIP=n
CONFIG_INIT_STACKS=y
CONFIG_SYS_CLOCK_TICKS_PER_SEC=25000000
CONFIG_FPU=y
CONFIG_POWEROFF=y

# RNG
CONFIG_TIMER_RANDOM_GENERATOR=y
CONFIG_TEST_RANDOM_GENERATOR=y

# IRQs
CONFIG_MULTI_LEVEL_INTERRUPTS=y
CONFIG_2ND_LEVEL_INTERRUPTS=y
# 1 PLIC
CONFIG_NUM_2ND_LEVEL_AGGREGATORS=1
CONFIG_1ST_LEVEL_INTERRUPT_BITS=7
CONFIG_2ND_LEVEL_INTERRUPT_BITS=23
CONFIG_PLIC=y
CONFIG_3RD_LEVEL_INTERRUPTS=n
CONFIG_3RD_LEVEL_INTERRUPT_BITS=0

# no networking support on this board

# required for the DMA, as no cache coherency in this configuration
CONFIG_SOC_SERIES_CV64A6_PROVIDE_NONSTANDARD_CACHE_OPTIONS=y
CONFIG_DMA_XILINX_AXI_DMA_DISABLE_CACHE_WHEN_ACCESSING_SG_DESCRIPTORS=y

# logging
CONFIG_LOG=y
CONFIG_LOG_DEFAULT_LEVEL=3
CONFIG_THREAD_NAME=y

# increased stack sizes
CONFIG_ISR_STACK_SIZE=524288
CONFIG_MAIN_STACK_SIZE=524288
CONFIG_SYSTEM_WORKQUEUE_STACK_SIZE=524288
CONFIG_IDLE_STACK_SIZE=524288
CONFIG_NET_TCP_WORKQ_STACK_SIZE=524288
CONFIG_NET_TX_STACK_SIZE=524288
CONFIG_NET_RX_STACK_SIZE=524288
CONFIG_NET_MGMT_EVENT_STACK_SIZE=524288
```

## boards/openhwgroup/cv64a6_genesysII_cispa/Kconfig.cv64a6_genesysII_cispa
```kconfig
# Copyright 2024 CISPA Helmholtz Center for Information Security gGmbH
# SPDX-License-Identifier: Apache-2.0
config BOARD_CV64A6_GENESYSII_CISPA
	select SOC_CV64A6_IMAFDC
	select SOC_FAMILY_CVA6_PROVIDE_FPGA_POWEROFF
```

## boards/openhwgroup/cv64a6_genesysII_cispa/cv64a6_genesysII_cispa_defconfig
```kconfig
# Copyright 2024 CISPA Helmholtz Center for Information Security gGmbH
# SPDX-License-Identifier: Apache-2.0
CONFIG_BASE64=y
CONFIG_INCLUDE_RESET_VECTOR=y
CONFIG_CONSOLE=y
CONFIG_SERIAL=y
CONFIG_UART_CONSOLE=y
CONFIG_UART_NS16550=y
CONFIG_UART_NS16550_ACCESS_WORD_ONLY=y
CONFIG_CONSOLE_HANDLER=y
CONFIG_XIP=n
CONFIG_INIT_STACKS=y
CONFIG_SYS_CLOCK_TICKS_PER_SEC=25000000
CONFIG_FPU=y
CONFIG_POWEROFF=y

# RNG
CONFIG_TIMER_RANDOM_GENERATOR=y
CONFIG_TEST_RANDOM_GENERATOR=y

# IRQs
CONFIG_MULTI_LEVEL_INTERRUPTS=y
CONFIG_2ND_LEVEL_INTERRUPTS=y
# 1 PLIC
CONFIG_NUM_2ND_LEVEL_AGGREGATORS=1
CONFIG_PLIC=y
CONFIG_3RD_LEVEL_INTERRUPTS=n

# Ethernet / Networking
CONFIG_DMA=y
CONFIG_DMA_64BIT=y
CONFIG_DMA_XILINX_AXI_DMA=y
CONFIG_ETH_DRIVER=y
CONFIG_NET_L2_ETHERNET=y
CONFIG_ETH_XILINX_AXIENET=y
CONFIG_MDIO=y
CONFIG_PHY_GENERIC_MII=y
CONFIG_MDIO_XILINX_AXI_ENET=y
CONFIG_NET_IPV4=y
CONFIG_NET_TCP=y
CONFIG_NETWORKING=y
CONFIG_NET_PKT_RX_COUNT=64
CONFIG_NET_TC_RX_COUNT=1
CONFIG_NET_TC_TX_COUNT=1

# this is the choice that is safe in all scenarios
# overwrite in project if you know a less restrictive choice works for your project
CONFIG_DMA_XILINX_AXI_DMA_LOCK_ALL_IRQS=y
CONFIG_DMA_XILINX_AXI_DMA_SG_DESCRIPTOR_NUM_RX=16
CONFIG_DMA_XILINX_AXI_DMA_SG_DESCRIPTOR_NUM_TX=16
CONFIG_DMA_LOG_LEVEL_INF=y

# required for the DMA, as no cache coherency in this configuration
CONFIG_SOC_FAMILY_CVA6_PROVIDE_NONSTANDARD_CACHE_OPTIONS=y
CONFIG_DMA_XILINX_AXI_DMA_DISABLE_CACHE_WHEN_ACCESSING_SG_DESCRIPTORS=y

# logging
CONFIG_LOG=y
CONFIG_LOG_DEFAULT_LEVEL=3
CONFIG_THREAD_NAME=y

# increased stack sizes
CONFIG_ISR_STACK_SIZE=524288
CONFIG_MAIN_STACK_SIZE=524288
CONFIG_SYSTEM_WORKQUEUE_STACK_SIZE=524288
CONFIG_IDLE_STACK_SIZE=524288
CONFIG_NET_TCP_WORKQ_STACK_SIZE=524288
CONFIG_NET_TX_STACK_SIZE=524288
CONFIG_NET_RX_STACK_SIZE=524288
```

## boards/openhwgroup/cv64a6_genesys_2/Kconfig.cv64a6_genesys_2
```kconfig
# Copyright 2024 CISPA Helmholtz Center for Information Security gGmbH
# SPDX-License-Identifier: Apache-2.0
config BOARD_CV64A6_GENESYS_2
	select SOC_CV64A6_IMAFDC
```

## boards/openhwgroup/cv64a6_genesys_2/board.yml
```yaml
# Copyright 2024 CISPA Helmholtz Center for Information Security gGmbH
# SPDX-License-Identifier: Apache-2.0
board:
  name: cv64a6_genesys_2
  full_name: Digilent CV64A6 on Genesys 2
  vendor: openhwgroup
  socs:
    - name: cv64a6_imafdc
```

## boards/openhwgroup/cv64a6_genesys_2/cv64a6_genesys_2_defconfig
```kconfig
# Copyright 2024 CISPA Helmholtz Center for Information Security gGmbH
# SPDX-License-Identifier: Apache-2.0
CONFIG_INCLUDE_RESET_VECTOR=y
CONFIG_CONSOLE=y
CONFIG_SERIAL=y
CONFIG_UART_CONSOLE=y
CONFIG_UART_NS16550_ACCESS_WORD_ONLY=y
CONFIG_CONSOLE_HANDLER=y
CONFIG_XIP=n
CONFIG_INIT_STACKS=y
CONFIG_SYS_CLOCK_TICKS_PER_SEC=25000000
# RNG
CONFIG_TIMER_RANDOM_GENERATOR=y
CONFIG_TEST_RANDOM_GENERATOR=y
```

## boards/openhwgroup/cv64a6_testbench/Kconfig.cv64a6_testbench
```kconfig
# Copyright 2024 CISPA Helmholtz Center for Information Security gGmbH
# SPDX-License-Identifier: Apache-2.0
config BOARD_CV64A6_TESTBENCH
	select SOC_CV64A6_IMAFDC
	select SOC_FAMILY_CVA6_PROVIDE_TEST_POWEROFF
```

## boards/openhwgroup/cv64a6_testbench/board.yml
```yaml
# Copyright 2024 CISPA Helmholtz Center for Information Security gGmbH
# SPDX-License-Identifier: Apache-2.0
board:
  name: cv64a6_testbench
  vendor: openhwgroup
  socs:
    - name: cv64a6
```

## boards/openisa/rv32m1_vega/Kconfig.defconfig
```kconfig
# SPDX-License-Identifier: Apache-2.0
# Copyright 2018 Foundries.io Ltd

if BOARD_RV32M1_VEGA

if BT

config BT_CTLR
	default y

#TODO: Resolve the complete non-BLE support for crypto CAU3 firmware/driver
#config HAS_RV32M1_CAU3
#	bool
#	default y if BT_CTLR_CRYPTO && !BT_CTLR_LE_ENC_SUPPORT

config HAS_RV32M1_CAU3_BLE
	bool
	default y if BT_CTLR_CRYPTO && \
		(BT_CTLR_LE_ENC_SUPPORT || BT_CTLR_PRIVACY_SUPPORT)

config RV32M1_INTMUX_CHANNEL_2
	default n

config RV32M1_INTMUX_CHANNEL_3
	default n

endif # BT

endif # BOARD_RV32M1_VEGA
```

## boards/openisa/rv32m1_vega/Kconfig.rv32m1_vega
```kconfig
# Copyright 2018 Foundries.io Ltd
# SPDX-License-Identifier: Apache-2.0

config BOARD_RV32M1_VEGA
	select SOC_OPENISA_RV32M1_RI5CY if BOARD_RV32M1_VEGA_OPENISA_RV32M1_RI5CY
	select SOC_OPENISA_RV32M1_ZERO_RISCY if BOARD_RV32M1_VEGA_OPENISA_RV32M1_ZERO_RISCY
```

## boards/openisa/rv32m1_vega/board.yml
```yaml
board:
  name: rv32m1_vega
  full_name: OpenISA VEGAboard
  vendor: openisa
  socs:
  - name: openisa_rv32m1
```

## boards/openisa/rv32m1_vega/rv32m1_vega_openisa_rv32m1_zero_riscy_defconfig
```kconfig
# SPDX-License-Identifier: Apache-2.0
# Copyright 2018 Foundries.io Ltd

CONFIG_GPIO=y
CONFIG_PINCTRL=y
CONFIG_SERIAL=y
CONFIG_CONSOLE=y
CONFIG_UART_CONSOLE=y
CONFIG_UART_INTERRUPT_DRIVEN=y
CONFIG_MULTI_LEVEL_INTERRUPTS=y
```

## boards/others/black_f407ve/Kconfig.black_f407ve
```kconfig
# Copyright (c) 2020 Intel Corporation
# SPDX-License-Identifier: Apache-2.0

config BOARD_BLACK_F407VE
	select SOC_STM32F407XE
```
