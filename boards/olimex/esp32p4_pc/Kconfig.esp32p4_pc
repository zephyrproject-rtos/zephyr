## boards/olimex/esp32p4_pc/Kconfig.esp32p4_pc
```kconfig
# SPDX-FileCopyrightText: Copyright The Zephyr Project Contributors
# SPDX-License-Identifier: Apache-2.0

config BOARD_ESP32P4_PC
	select SOC_ESP32P4_HPCORE if BOARD_ESP32P4_PC_ESP32P4_HPCORE
	select SOC_ESP32P4_LPCORE if BOARD_ESP32P4_PC_ESP32P4_LPCORE
	select SOC_ESP32P4_REV_1_3
```

## boards/olimex/esp32p4_pc/board.yml
```yaml
# SPDX-FileCopyrightText: Copyright The Zephyr Project Contributors
# SPDX-License-Identifier: Apache-2.0

board:
  name: esp32p4_pc
  full_name: ESP32-P4-PC
  vendor: olimex
  socs:
  - name: esp32p4
```

## boards/openhwgroup/erbium/board.yml
```yaml
board:
  name: erbium
  full_name: Erbium
  vendor: openhwgroup
  socs:
  - name: erbium
```

## boards/openhwgroup/erbium/erbium_defconfig
```kconfig
# Copyright (c) 2026 AIFoundry
# SPDX-License-Identifier: Apache-2.0

CONFIG_SYS_CLOCK_TICKS_PER_SEC=1000
CONFIG_XIP=n

CONFIG_SERIAL=y
CONFIG_CONSOLE=y
CONFIG_UART_CONSOLE=y
```

## boards/openisa/rv32m1_vega/Kconfig
```kconfig
# Copyright The Zephyr Project Contributors
# SPDX-License-Identifier: Apache-2.0

if BT

config HAS_RV32M1_CAU3_BLE
	bool
	default y if BT_CTLR_CRYPTO && \
		(BT_CTLR_LE_ENC_SUPPORT || BT_CTLR_PRIVACY_SUPPORT)

endif # BT
```

## boards/others/bl704l_dvk/Kconfig.bl704l_dvk
```kconfig
# Copyright (c) 2026 MASSDRIVER EI (massdriver.space)
# SPDX-License-Identifier: Apache-2.0

config BOARD_BL704L_DVK
	select SOC_BL704L20Q2IW
```

## boards/others/bl704l_dvk/board.yml
```yaml
board:
  name: bl704l_dvk
  full_name: BL704L Development Board
  vendor: others
  socs:
    - name: bl704l20q2iw
```

## boards/others/lxb407zgt6_p1/Kconfig.lxb407zgt6_p1
```kconfig
# Copyright (c) 2026
# SPDX-License-Identifier: Apache-2.0

config BOARD_LXB407ZGT6_P1
	select SOC_STM32F407XG
```

## boards/others/lxb407zgt6_p1/board.yml
```yaml
board:
  name: lxb407zgt6_p1
  full_name: LXB STM32F407ZGT6 Core Board (LXB407ZGT6-P1)
  vendor: others
  socs:
    - name: stm32f407xx
```

## boards/others/stm32_min_dev/Kconfig.stm32_min_dev
```kconfig
# STM32 Minimum Development Board Configuration

# Copyright (c) 2017, embedjournal.com
# SPDX-License-Identifier: Apache-2.0

config BOARD_STM32_MIN_DEV
	select SOC_STM32F103X6 if BOARD_STM32_MIN_DEV_STM32F103X6
	select SOC_STM32F103X8 if BOARD_STM32_MIN_DEV_STM32F103X8
```

## boards/others/stm32_min_dev/stm32_min_dev_stm32f103x6_defconfig
```kconfig
# STM32 Minimum Development Board Configuration
#
# Copyright (c) 2019, embedjournal.com
#
# SPDX-License-Identifier: Apache-2.0

# Enable UART driver
CONFIG_SERIAL=y

# Enable console
CONFIG_CONSOLE=y
CONFIG_UART_CONSOLE=y
```

## boards/others/stm32h743_coreboard/Kconfig.stm32h743_coreboard
```kconfig
# Copyright (c) 2026 Davi Alexandre Volcan <davi.volcan2@gmail.com>
# SPDX-License-Identifier: Apache-2.0

config BOARD_STM32H743_COREBOARD
	bool
	select SOC_STM32H743XX
```

## boards/others/stm32h743_coreboard/board.yml
```yaml
board:
  name: stm32h743_coreboard
  full_name: STM32H743IIT6 Core Board
  vendor: others
  socs:
    - name: stm32h743xx
```

## boards/others/xh_s3e_ai/Kconfig.defconfig
```kconfig
# Copyright (c) 2026 Anuj Deshpande
# SPDX-License-Identifier: Apache-2.0

if BOARD_XH_S3E_AI_ESP32S3_PROCPU

choice SPIRAM_MODE
	default SPIRAM_MODE_OCT
endchoice

endif # BOARD_XH_S3E_AI_ESP32S3_PROCPU
```

## boards/others/xh_s3e_ai/Kconfig.sysbuild
```kconfig
# Copyright (c) 2026 Anuj Deshpande
# SPDX-License-Identifier: Apache-2.0

choice BOOTLOADER
	default BOOTLOADER_MCUBOOT
endchoice
```

## boards/panasonic/pan1783/Kconfig
```kconfig
# Copyright The Zephyr Project Contributors
# SPDX-License-Identifier: Apache-2.0

if SOC_NRF5340_CPUAPP_QKAA

config HEAP_MEM_POOL_ADD_SIZE_BOARD
	int
	default 4096 if BT_HCI_IPC

endif # SOC_NRF5340_CPUAPP_QKAA
```

## boards/pcbcupid/glyph_h2/Kconfig.sysbuild
```kconfig
# Copyright (c) 2025 Espressif Systems (Shanghai) Co., Ltd.
# SPDX-License-Identifier: Apache-2.0

choice BOOTLOADER
	default BOOTLOADER_MCUBOOT
endchoice
```

## boards/pcbcupid/glyph_mini_2040/Kconfig
```kconfig
# Copyright (c) 2024 PCB Cupid
# SPDX-License-Identifier: Apache-2.0

config BOARD_GLYPH_MINI_2040
	select RP2_FLASH_W25Q080
```

## boards/pcbcupid/glyph_mini_2040/Kconfig.glyph_mini_2040
```kconfig
# glyph mini 2040 board configuration

# Copyright (c) 2024 PCB Cupid
# SPDX-License-Identifier: Apache-2.0

config BOARD_GLYPH_MINI_2040
	select SOC_RP2040
```

## boards/pcbcupid/glyph_mini_2040/board.yml
```yaml
board:
  name: glyph_mini_2040
  full_name: Glyph-Mini-2040
  vendor: pcbcupid
  socs:
  - name: rp2040
```

## boards/pcbcupid/glyph_s3/Kconfig.glyph_s3
```kconfig
# glyph s3 board configuration

# Copyright (c) 2024 Espressif Systems (Shanghai) Co., Ltd.
# SPDX-License-Identifier: Apache-2.0

config BOARD_GLYPH_S3
	select SOC_ESP32S3_MINI_N8
	select SOC_ESP32S3_PROCPU if BOARD_GLYPH_S3_ESP32S3_PROCPU
	select SOC_ESP32S3_APPCPU if BOARD_GLYPH_S3_ESP32S3_APPCPU
```

## boards/pcbcupid/glyph_s3/board.yml
```yaml
board:
  name: glyph_s3
  full_name: Glyph-S3
  vendor: pcbcupid
  socs:
  - name: esp32s3
```

## boards/phytec/phyboard_pollux/Kconfig.defconfig
```kconfig
# SPDX-FileCopyrightText: 2026 PHYTEC Messtechnik GmbH
# SPDX-License-Identifier: Apache-2.0

configdefault MAIN_STACK_SIZE
	default 3072 if BOARD_PHYBOARD_POLLUX_MIMX8ML8_ADSP
```

## boards/pine64/ox64/Kconfig.ox64
```kconfig
# Copyright (c) 2026 MASSDRIVER EI (massdriver.space)
#
# SPDX-License-Identifier: Apache-2.0

config BOARD_OX64
	select SOC_BL808C09Q2I
```
