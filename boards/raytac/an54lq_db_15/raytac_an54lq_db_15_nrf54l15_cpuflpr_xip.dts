/*
 * Copyright (c) 2024 Nordic Semiconductor ASA
 * Copyright (c) 2025 Raytac Corporation.
 *
 * SPDX-License-Identifier: Apache-2.0
 */

#include "raytac_an54lq_db_15_nrf54l15_cpuflpr.dts"

&cpuflpr_sram {
	reg = <0x2002f000 DT_SIZE_K(68)>;
	ranges = <0x0 0x2002f000 0x11000>;
};
