/*
 * Copyright (c) 2024 Nordic Semiconductor ASA
 * Copyright (c) 2024 Raytac Corporation.
 *
 * SPDX-License-Identifier: Apache-2.0
 */

/dts-v1/;

#include <nordic/nrf54l15_cpuapp.dtsi>
#include "raytac_an54lq_db_15_cpuapp_common.dtsi"

/ {
	compatible = "raytac,an54lq_db_15_nrf54l15-cpuapp";
	model = "Raytac AN54LQ-DB-15 nRF54L15 Application MCU";

	chosen {
		zephyr,code-partition = &slot0_partition;
		zephyr,sram = &cpuapp_sram;
	};
};

/* Include default memory partition configuration file */
#include <nordic/nrf54l15_partition.dtsi>
