## boards/raytac/mdbt53v_db_40/Kconfig.sysbuild
```kconfig
# Sysbuild configuration
# Copyright (c) 2024 Embeint Inc

config DOMAIN_CPUNET_BOARD
	string
	default "raytac_mdbt53v_db_40/nrf5340/cpunet"
	help
	  The board which will be used for CPUNET domain when creating a multi
	  image application where one or more images should be located on
	  another board. For example hci_ipc for Bluetooth applications.
```

## boards/raytac/mdbt53v_db_40/board.yml
```yaml
board:
  name: raytac_mdbt53v_db_40
  full_name: MDBT53V-DB-40
  vendor: raytac
  socs:
  - name: 'nrf5340'
    variants:
    - name: 'ns'
      cpucluster: 'cpuapp'
```

## boards/raytac/raytac_mdbt50q_db_33/board.yml
```yaml
board:
  name: raytac_mdbt50q_db_33
  vendor: Raytac Corporation
  socs:
  - name: nrf52833
```

## boards/raytac/raytac_mdbt50q_db_40/Kconfig
```kconfig
# Raytac MDBT50Q-DB-40 nRF52840 board configuration

# Copyright (c) 2022 Raytac Corporation
# SPDX-License-Identifier: Apache-2.0

if BOARD_RAYTAC_MDBT50Q_DB_40

config BOARD_ENABLE_DCDC
	bool "DCDC mode"
	select SOC_DCDC_NRF52X
	default y

config BOARD_ENABLE_DCDC_HV
	bool "High Voltage DCDC converter"
	select SOC_DCDC_NRF52X_HV
	default y

endif # BOARD_RAYTAC_MDBT50Q_DB_40
```

## boards/raytac/raytac_mdbt50q_db_40/Kconfig.raytac_mdbt50q_db_40
```kconfig
# Raytac MDBT50Q-DB-40 nRF52840 board configuration

# Copyright (c) 2022 Raytac Corporation
# SPDX-License-Identifier: Apache-2.0

config BOARD_RAYTAC_MDBT50Q_DB_40
	bool
	default y
	select SOC_NRF52840_QIAA
```

## boards/raytac/raytac_mdbt50q_db_40/board.yml
```yaml
board:
  name: raytac_mdbt50q_db_40
  vendor: Raytac Corporation
  socs:
  - name: nrf52840
```

## boards/raytac/raytac_mdbt53_db_40/board.yml
```yaml
board:
  name: raytac_mdbt53_db_40
  vendor: Raytac Corporation
  socs:
  - name: 'nrf5340'
    variants:
    - name: 'ns'
      cpucluster: 'cpuapp'
```

## boards/raytac/raytac_mdbt53v_db_40/board.yml
```yaml
board:
  name: raytac_mdbt53v_db_40
  vendor: Raytac Corporation
  socs:
  - name: 'nrf5340'
    variants:
    - name: 'ns'
      cpucluster: 'cpuapp'
```

## boards/realtek/pke8721daf_c13_f10/Kconfig.pke8721daf_c13_f10
```kconfig
# Copyright (c) 2026 Realtek Semiconductor Corp.
# SPDX-License-Identifier: Apache-2.0

config BOARD_PKE8721DAF_C13_F10
	select SOC_RTL8721DX
```

## boards/realtek/pke8721daf_c13_f10/board.yml
```yaml
board:
  name: pke8721daf_c13_f10
  full_name: RTL8721Dx Evaluation Board
  vendor: realtek
  socs:
    - name: rtl8721dx
```

## boards/realtek/pke8721daf_c13_f10/pke8721daf_c13_f10_defconfig
```kconfig
# Copyright (c) 2026 Realtek Semiconductor Corp.
# SPDX-License-Identifier: Apache-2.0

CONFIG_CONSOLE=y
CONFIG_UART_CONSOLE=y

# Enable LogUart
CONFIG_SERIAL=y

CONFIG_GPIO=y
```

## boards/realtek/rtl8721f_evb/Kconfig.rtl8721f_evb
```kconfig
# Copyright (c) 2024 Realtek Semiconductor Corp.
# SPDX-License-Identifier: Apache-2.0

config BOARD_RTL8721F_EVB
	select SOC_RTL8721F
```

## boards/realtek/rtl8721f_evb/board.yml
```yaml
board:
  name: rtl8721f_evb
  full_name: RTL8721F Evaluation Board
  vendor: realtek
  socs:
    - name: rtl8721f
```

## boards/realtek/rtl8721f_evb/rtl8721f_evb_defconfig
```kconfig
# Copyright (c) 2024 Realtek Semiconductor Corp.
# SPDX-License-Identifier: Apache-2.0

# Enable Hardware Stack Protection
CONFIG_HW_STACK_PROTECTION=y

CONFIG_CONSOLE=y
CONFIG_UART_CONSOLE=y

# Enable LogUart
CONFIG_SERIAL=y

CONFIG_GPIO=y

CONFIG_NOCACHE_MEMORY=y
```

## boards/realtek/rtl872xd_evb/Kconfig.rtl872xd_evb
```kconfig
# Copyright (c) 2024 Realtek Semiconductor Corp.
# SPDX-License-Identifier: Apache-2.0

config BOARD_RTL872XD_EVB
	select SOC_RTL872XD
```

## boards/realtek/rtl872xd_evb/board.yml
```yaml
board:
  name: rtl872xd_evb
  full_name: RTL872xD Evaluation Board
  vendor: realtek
  socs:
    - name: rtl872xd
```

## boards/realtek/rtl872xd_evb/rtl872xd_evb_defconfig
```kconfig
# Copyright (c) 2024 Realtek Semiconductor Corp.
# SPDX-License-Identifier: Apache-2.0

CONFIG_HW_STACK_PROTECTION=y

# This board implies building Non-Secure firmware
CONFIG_TRUSTED_EXECUTION_NONSECURE=y

CONFIG_CONSOLE=y
CONFIG_UART_CONSOLE=y

# Enable LogUart
CONFIG_SERIAL=y

CONFIG_GPIO=y
```

## boards/realtek/rtl872xda_evb/Kconfig.rtl872xda_evb
```kconfig
# Copyright (c) 2024 Realtek Semiconductor Corp.
# SPDX-License-Identifier: Apache-2.0

config BOARD_RTL872XDA_EVB
	select SOC_AMEBADPLUS
```

## boards/realtek/rtl872xda_evb/board.yml
```yaml
board:
  name: rtl872xda_evb
  full_name: RTL8721Dx Evaluation Board
  vendor: realtek
  socs:
    - name: rtl8721dx
```

## boards/realtek/rtl872xda_evb/rtl872xda_evb_defconfig
```kconfig
# Copyright (c) 2024 Realtek Semiconductor Corp.
# SPDX-License-Identifier: Apache-2.0

# Console
CONFIG_CONSOLE=y
CONFIG_UART_CONSOLE=y

# Enable LogUart
CONFIG_SERIAL=y
```

## boards/realtek/rtl8752h_evb/Kconfig.rtl8752h_evb
```kconfig
# Copyright (c) 2026, Realtek Semiconductor Corporation.
# SPDX-License-Identifier: Apache-2.0

config BOARD_RTL8752H_EVB
	select SOC_RTL8752HJL if BOARD_RTL8752H_EVB_RTL8752HJL
	select SOC_RTL8752HMF if BOARD_RTL8752H_EVB_RTL8752HMF
	select SOC_RTL8752HJF if BOARD_RTL8752H_EVB_RTL8752HJF
	select SOC_RTL8752HKF if BOARD_RTL8752H_EVB_RTL8752HKF
```

## boards/realtek/rtl8752h_evb/board.yml
```yaml
board:
  name: rtl8752h_evb
  full_name: RTL8752H Evaluation Board
  vendor: realtek
  socs:
  - name: rtl8752hjl
  - name: rtl8752hmf
  - name: rtl8752hjf
  - name: rtl8752hkf
```

## boards/realtek/rtl8752h_evb/rtl8752h_evb_rtl8752hmf_defconfig
```kconfig
# Copyright (c) 2026, Realtek Semiconductor Corporation.
# SPDX-License-Identifier: Apache-2.0

# Console Driver
CONFIG_CONSOLE=y
CONFIG_UART_CONSOLE=y

# UART Driver
CONFIG_SERIAL=y
CONFIG_UART_INTERRUPT_DRIVEN=y
```

## boards/realtek/rtl87x2g_evb_a/Kconfig.defconfig
```kconfig
# Copyright (c) 2026, Realtek Semiconductor Corporation
# SPDX-License-Identifier: Apache-2.0

if BOARD_RTL87X2G_EVB_A

config HW_STACK_PROTECTION
	default ARCH_HAS_STACK_PROTECTION

endif # BOARD_RTL87X2G_EVB_A
```
