## boards/gd/gd32e103v_eval/board.yml
```yaml
board:
  name: gd32e103v_eval
  full_name: GD32E103V-EVAL
  vendor: gd
  socs:
    - name: gd32e103
```

## boards/gd/gd32e103v_eval/gd32e103v_eval_defconfig
```kconfig
# Copyright (c) 2021, YuLong Yao <feilongphone@gmail.com>
# SPDX-License-Identifier: Apache-2.0

CONFIG_GD32_HXTAL_8MHZ=y

CONFIG_CONSOLE=y
CONFIG_UART_CONSOLE=y
CONFIG_SERIAL=y
```

## boards/gd/gd32e507v_start/Kconfig.gd32e507v_start
```kconfig
# Copyright (c) 2024 Nordic Semiconductor ASA
# SPDX-License-Identifier: Apache-2.0

config BOARD_GD32E507V_START
	select SOC_GD32E507
```

## boards/gd/gd32e507v_start/board.yml
```yaml
board:
  name: gd32e507v_start
  full_name: GD32E507V-START
  vendor: gd
  socs:
    - name: gd32e507
```

## boards/gd/gd32e507z_eval/Kconfig.gd32e507z_eval
```kconfig
# Copyright (c) 2024 Nordic Semiconductor ASA
# SPDX-License-Identifier: Apache-2.0

config BOARD_GD32E507Z_EVAL
	select SOC_GD32E507
```

## boards/gd/gd32e507z_eval/board.yml
```yaml
board:
  name: gd32e507z_eval
  full_name: GD32E507Z-EVAL
  vendor: gd
  socs:
    - name: gd32e507
```

## boards/gd/gd32f350r_eval/board.yml
```yaml
board:
  name: gd32f350r_eval
  full_name: GD32F350R-EVAL
  vendor: gd
  socs:
    - name: gd32f350
```

## boards/gd/gd32f403z_eval/Kconfig.gd32f403z_eval
```kconfig
# Copyright (c) 2024 Nordic Semiconductor ASA
# SPDX-License-Identifier: Apache-2.0

config BOARD_GD32F403Z_EVAL
	select SOC_GD32F403
```

## boards/gd/gd32f403z_eval/board.yml
```yaml
board:
  name: gd32f403z_eval
  full_name: GD32F403Z-EVAL
  vendor: gd
  socs:
    - name: gd32f403
```

## boards/gd/gd32f407v_start/board.yml
```yaml
board:
  name: gd32f407v_start
  full_name: GD32F407V-START
  vendor: gd
  socs:
    - name: gd32f407
```

## boards/gd/gd32f407v_start/gd32f407v_start_defconfig
```kconfig
# Copyright (c) 2022, TOKITA Hiroshi <tokita.hiroshi@gmail.com>
# SPDX-License-Identifier: Apache-2.0

CONFIG_ARM_MPU=y
CONFIG_HW_STACK_PROTECTION=y

CONFIG_CONSOLE=y
CONFIG_UART_CONSOLE=y
CONFIG_SERIAL=y

CONFIG_GPIO=y
```

## boards/gd/gd32f450i_eval/Kconfig.gd32f450i_eval
```kconfig
# Copyright (c) 2024 Nordic Semiconductor ASA
# SPDX-License-Identifier: Apache-2.0

config BOARD_GD32F450I_EVAL
	select SOC_GD32F450
```

## boards/gd/gd32f450i_eval/board.yml
```yaml
board:
  name: gd32f450i_eval
  full_name: GD32F450I-EVAL
  vendor: gd
  socs:
    - name: gd32f450
```

## boards/gd/gd32f450v_start/Kconfig.gd32f450v_start
```kconfig
# Copyright (c) 2024 Nordic Semiconductor ASA
# SPDX-License-Identifier: Apache-2.0

config BOARD_GD32F450V_START
	select SOC_GD32F450
```

## boards/gd/gd32f450v_start/board.yml
```yaml
board:
  name: gd32f450v_start
  full_name: GD32F450V-START
  vendor: gd
  socs:
    - name: gd32f450
```

## boards/gd/gd32f450z_eval/board.yml
```yaml
board:
  name: gd32f450z_eval
  full_name: GD32F450Z-EVAL
  vendor: gd
  socs:
    - name: gd32f450
```

## boards/gd/gd32f470i_eval/board.yml
```yaml
board:
  name: gd32f470i_eval
  full_name: GD32F470I-EVAL
  vendor: gd
  socs:
    - name: gd32f470
```

## boards/gd/gd32f527i_eval/board.yml
```yaml
board:
  name: gd32f527i_eval
  full_name: GD32F527I-EVAL
  vendor: gd
  socs:
    - name: gd32f527
```

## boards/gd/gd32f527i_eval/gd32f527i_eval_defconfig
```kconfig
# Copyright (c) 2026 GigaDevice Semiconductor Inc.
# SPDX-License-Identifier: Apache-2.0

CONFIG_ARM_MPU=y
CONFIG_HW_STACK_PROTECTION=y

CONFIG_CONSOLE=y
CONFIG_SERIAL=y
CONFIG_UART_CONSOLE=y

CONFIG_GPIO=y
```

## boards/gd/gd32l233r_eval/Kconfig.gd32l233r_eval
```kconfig
# Copyright (c) 2024 Nordic Semiconductor ASA
# SPDX-License-Identifier: Apache-2.0

config BOARD_GD32L233R_EVAL
	select SOC_GD32L233
```

## boards/gd/gd32l233r_eval/board.yml
```yaml
board:
  name: gd32l233r_eval
  full_name: GD32L233R-EVA
  vendor: gd
  socs:
    - name: gd32l233
```

## boards/gd/gd32vf103c_starter/Kconfig.gd32vf103c_starter
```kconfig
# Copyright (c) 2022 YuLong Yao <feilongphone@gmail.com>
# SPDX-License-Identifier: Apache-2.0

config BOARD_GD32VF103C_STARTER
	select SOC_GD32VF103
```

## boards/gd/gd32vf103c_starter/board.yml
```yaml
board:
  name: gd32vf103c_starter
  full_name: GD32VF103C-STARTER
  vendor: gd
  socs:
    - name: gd32vf103
```

## boards/gd/gd32vf103c_starter/gd32vf103c_starter_defconfig
```kconfig
# Copyright (c) 2022 YuLong Yao <feilongphone@gmail.com>
# SPDX-License-Identifier: Apache-2.0

CONFIG_GD32_HXTAL_8MHZ=y
```

## boards/gd/gd32vf103v_eval/Kconfig.gd32vf103v_eval
```kconfig
# Copyright (c) 2021, Teslabs Engineering S.L.
# SPDX-License-Identifier: Apache-2.0

config BOARD_GD32VF103V_EVAL
	select SOC_GD32VF103
```
