/*
 * SPDX-License-Identifier: Apache-2.0
 *
 * Copyright (c) 2022 BrainCo Inc.
 */

/ {
	dma_test_dma: dma-test-dma {
		compatible = "test-dma-memory-to-memory";
		dma = <&dma>;
	};
};

&dma {
	status = "okay";
};
