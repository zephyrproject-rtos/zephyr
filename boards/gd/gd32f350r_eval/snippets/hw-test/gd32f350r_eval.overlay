/*
 * SPDX-License-Identifier: Apache-2.0
 *
 * Copyright (c) 2022 BrainCo Inc.
 */

&adc0 {
	#address-cells = <1>;
	#size-cells = <0>;

	channel@b {
		reg = <11>;
		zephyr,gain = "ADC_GAIN_1";
		zephyr,reference = "ADC_REF_INTERNAL";
		zephyr,acquisition-time = <ADC_ACQ_TIME_DEFAULT>;
		zephyr,resolution = <12>;
	};
};
