## boards/gd/gd32vf103v_eval/board.yml
```yaml
board:
  name: gd32vf103v_eval
  full_name: GD32VF103V-EVAL
  vendor: gd
  socs:
    - name: gd32vf103
```

## boards/gd/gd32vf103v_eval/gd32vf103v_eval_defconfig
```kconfig
# Copyright (c) 2021, Teslabs Engineering S.L.
# SPDX-License-Identifier: Apache-2.0

CONFIG_GD32_HXTAL_8MHZ=y

CONFIG_GPIO=y

CONFIG_CONSOLE=y
CONFIG_UART_CONSOLE=y
CONFIG_SERIAL=y
```

## boards/google/dragonclaw/Kconfig.google_dragonclaw
```kconfig
# Copyright (c) 2022 Google LLC
# SPDX-License-Identifier: Apache-2.0

config BOARD_GOOGLE_DRAGONCLAW
	select SOC_STM32F412CX
```

## boards/google/dragonclaw/board.yml
```yaml
board:
  name: google_dragonclaw
  full_name: Dragonclaw Development Board
  vendor: google
  socs:
    - name: stm32f412cx
```

## boards/google/dragonclaw/google_dragonclaw_defconfig
```kconfig
# Copyright (c) 2022 Google Inc
# SPDX-License-Identifier: Apache-2.0

# Serial Drivers
CONFIG_SERIAL=y
CONFIG_UART_INTERRUPT_DRIVEN=y

# Console
CONFIG_CONSOLE=y
CONFIG_UART_CONSOLE=y

# GPIO Controller
CONFIG_GPIO=y

# Enable MPU and HW stack protection
CONFIG_ARM_MPU=y
CONFIG_HW_STACK_PROTECTION=y
```

## boards/google/icetower/Kconfig.google_icetower
```kconfig
# Copyright (c) 2024 Google LLC
# SPDX-License-Identifier: Apache-2.0

config BOARD_GOOGLE_ICETOWER
	select SOC_STM32H743XX
```

## boards/google/icetower/board.yml
```yaml
board:
  name: google_icetower
  full_name: Icetower Development Board
  vendor: google
  socs:
    - name: stm32h743xx
```

## boards/google/kukui/Kconfig.google_kukui
```kconfig
# Copyright 2019 The Chromium OS Authors
# SPDX-License-Identifier: Apache-2.0

config BOARD_GOOGLE_KUKUI
	select SOC_STM32F098XX
```

## boards/google/quincy/Kconfig.google_quincy
```kconfig
# Copyright (c) 2024 Google LLC
# SPDX-License-Identifier: Apache-2.0

config BOARD_GOOGLE_QUINCY
	select SOC_NPCX9MFP
```

## boards/google/quincy/board.yml
```yaml
board:
  name: google_quincy
  full_name: Quincy
  vendor: google
  socs:
    - name: npcx9mfp
```

## boards/google/quincy/google_quincy_defconfig
```kconfig
# Copyright (c) 2024 Google Inc
# SPDX-License-Identifier: Apache-2.0

# General Kernel Options
CONFIG_SYS_CLOCK_HW_CYCLES_PER_SEC=15000000

# Serial Drivers
CONFIG_SERIAL=y
CONFIG_UART_INTERRUPT_DRIVEN=y

# Console
CONFIG_CONSOLE=y
CONFIG_UART_CONSOLE=y

# GPIO Controller
CONFIG_GPIO=y

# Clock Controller
CONFIG_CLOCK_CONTROL=y

# Enable MPU and HW stack protection
CONFIG_ARM_MPU=y
CONFIG_HW_STACK_PROTECTION=y
```

## boards/google/twinkie_v2/Kconfig.google_twinkie_v2
```kconfig
# Copyright 2023 The ChromiumOS Authors
# SPDX-License-Identifier: Apache-2.0

config BOARD_GOOGLE_TWINKIE_V2
	select SOC_STM32G0B1XX
```

## boards/google/twinkie_v2/board.yml
```yaml
board:
  name: google_twinkie_v2
  full_name: Twinkie V2
  vendor: google
  socs:
    - name: stm32g0b1xx
```

## boards/google/twinkie_v2/google_twinkie_v2_defconfig
```kconfig
# Copyright 2023 The ChromiumOS Authors
#
# SPDX-License-Identifier: Apache-2.0

# GPIO Controller
CONFIG_GPIO=y

# Enable MPU
CONFIG_ARM_MPU=y
```

## boards/google/twinkie_v2/google_twinkie_v2_stm32g0b1xx_defconfig
```kconfig
# Copyright 2023 The ChromiumOS Authors
#
# SPDX-License-Identifier: Apache-2.0

# GPIO Controller
CONFIG_GPIO=y

# Enable Clocks
CONFIG_CLOCK_CONTROL=y

# enable pin controller
CONFIG_PINCTRL=y

# Enable MPU
CONFIG_ARM_MPU=y
```

## boards/hardkernel/odroid_go/Kconfig
```kconfig
# Copyright (c) 2024 Espressif Systems (Shanghai) Co., Ltd.
# SPDX-License-Identifier: Apache-2.0

config BOARD_ODROID_GO
	select SOC_ESP32_PROCPU if BOARD_ODROID_GO_ESP32_PROCPU
	select SOC_ESP32_APPCPU if BOARD_ODROID_GO_ESP32_APPCPU
```

## boards/hardkernel/odroid_go/Kconfig.odroid_go
```kconfig
# ODROID-GO Game Kit configuration

# Copyright (c) 2019 Yannis Damigos
# SPDX-License-Identifier: Apache-2.0

config BOARD_ODROID_GO
	select SOC_ESP32_WROVER_E_N16R2
	select SOC_ESP32_PROCPU if BOARD_ODROID_GO_ESP32_PROCPU
	select SOC_ESP32_APPCPU if BOARD_ODROID_GO_ESP32_APPCPU
```

## boards/hardkernel/odroid_go/board.yml
```yaml
board:
  name: odroid_go
  full_name: ODROID-GO
  vendor: hardkernel
  socs:
  - name: esp32
```

## boards/hardkernel/odroid_go/odroid_go_procpu_defconfig
```kconfig
# SPDX-License-Identifier: Apache-2.0

CONFIG_CONSOLE=y
CONFIG_SERIAL=y
CONFIG_UART_CONSOLE=y

CONFIG_GPIO=y

# required to enable LCD backlight
CONFIG_REGULATOR=y

CONFIG_ESP32_USE_UNSUPPORTED_REVISION=y
```

## boards/heimann/htpa_eval/Kconfig.defconfig
```kconfig
# Heimann HTPA Eval Board configuration

# Copyright (c) 2026 sensry.io
# SPDX-License-Identifier: Apache-2.0

if ETH_SAM_GMAC

# Read MAC address from AT24MAC402 EEPROM

config EEPROM
	default y if NVMEM

endif # ETH_SAM_GMAC

configdefault NET_L2_ETHERNET
	default y

configdefault MEMC
	default y

configdefault SOC_PREP_HOOK
	default y

config SPI_SAM_DMA
	default y
```

## boards/heimann/htpa_eval/Kconfig.htpa_eval
```kconfig
# Copyright (c) 2026 sensry.io
# SPDX-License-Identifier: Apache-2.0

config BOARD_HTPA_EVAL
	select SOC_SAME70Q20B if BOARD_HTPA_EVAL_SAME70Q20B
	select SOC_SAME70Q21 if BOARD_HTPA_EVAL_SAME70Q21
	select SOC_SAME70Q21B if BOARD_HTPA_EVAL_SAME70Q21B

config BOARD_HTPA_SENSOR_160x120
	bool
	default y
	help
	  Enable 160x120 sensor.
```

## boards/heimann/htpa_eval/board.yml
```yaml
board:
  name: htpa_eval
  full_name: Heimann HTPA Eval Board (rev0)
  vendor: heimann
  socs:
    - name: same70q20b
    - name: same70q21
    - name: same70q21b
```

## boards/heltec/heltec_mesh_node_t114/Kconfig.defconfig
```kconfig
# Copyright (c) 2026 Yeray Lois Sanchez
# SPDX-License-Identifier: Apache-2.0

if BOARD_HELTEC_MESH_NODE_T114

if BOARD_HELTEC_MESH_NODE_T114_NRF52840_UF2

source "boards/common/usb/Kconfig.cdc_acm_serial.defconfig"

endif

endif # BOARD_HELTEC_MESH_NODE_T114
```
