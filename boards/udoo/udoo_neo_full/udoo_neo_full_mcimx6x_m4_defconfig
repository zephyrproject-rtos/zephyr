## boards/udoo/udoo_neo_full/udoo_neo_full_mcimx6x_m4_defconfig
```kconfig
#
# Copyright (c) 2018, NXP
#
# SPDX-License-Identifier: Apache-2.0
#

CONFIG_CONSOLE=y
CONFIG_UART_CONSOLE=y
CONFIG_SERIAL=y
CONFIG_UART_INTERRUPT_DRIVEN=y
CONFIG_GPIO=y
CONFIG_SYS_CLOCK_HW_CYCLES_PER_SEC=227000000
```

## boards/uiap/uiapduino_pro_micro_ch32v003/Kconfig.uiapduino_pro_micro_ch32v003
```kconfig
# Copyright (c) 2026 Yasushi SHOJI <yashi@spacecubics.com>
# SPDX-License-Identifier: Apache-2.0

config BOARD_UIAPDUINO_PRO_MICRO_CH32V003
	select SOC_CH32V003
```

## boards/uiap/uiapduino_pro_micro_ch32v003/board.yml
```yaml
board:
  name: uiapduino_pro_micro_ch32v003
  full_name: UIAPduino Pro Micro CH32V003
  vendor: uiap
  socs:
    - name: ch32v003
```

## boards/uiap/uiapduino_pro_micro_ch32v003/uiapduino_pro_micro_ch32v003_defconfig
```kconfig
# Copyright (c) 2026 Yasushi SHOJI <yashi@spacecubics.com>
# SPDX-License-Identifier: Apache-2.0

CONFIG_GPIO=y
```

## boards/um/feathers3/Kconfig
```kconfig
# Unexpected Maker FeatherS3 board configuration

# SPDX-FileCopyrightText: Copyright (c) 2024 Espressif Systems (Shanghai) Co., Ltd.
# SPDX-FileCopyrightText: Copyright (c) 2024 Leon Rinkel <leon@rinkel.me>
# SPDX-FileCopyrightText: Copyright (c) 2026 Perry Naseck, MIT Media Lab <pnaseck@media.mit.edu>
# SPDX-License-Identifier: Apache-2.0

config HEAP_MEM_POOL_ADD_SIZE_BOARD
	int
	default 4096 if BOARD_UM_FEATHERS3_ESP32S3_PROCPU
	default 256 if BOARD_UM_FEATHERS3_ESP32S3_APPCPU
```

## boards/um/feathers3/Kconfig.um_feathers3
```kconfig
# SPDX-FileCopyrightText: Copyright (c) 2024 Espressif Systems (Shanghai) Co., Ltd.
# SPDX-FileCopyrightText: Copyright (c) 2024 Leon Rinkel <leon@rinkel.me>
# SPDX-FileCopyrightText: Copyright (c) 2026 Perry Naseck, MIT Media Lab <pnaseck@media.mit.edu>
# SPDX-License-Identifier: Apache-2.0

config BOARD_UM_FEATHERS3
	select SOC_ESP32S3_WROOM_N16R8
	select SOC_ESP32S3_PROCPU if BOARD_UM_FEATHERS3_ESP32S3_PROCPU
	select SOC_ESP32S3_APPCPU if BOARD_UM_FEATHERS3_ESP32S3_APPCPU
```

## boards/um/feathers3/board.yml
```yaml
board:
  name: um_feathers3
  full_name: Unexpected Maker FeatherS3
  vendor: um
  revision:
    format: custom
    default: p8
    exact: true
    revisions:
    - name: p4
    - name: p7
    - name: p8
  socs:
  - name: esp32s3
```

## boards/up-bridge-the-gap/up_squared/Kconfig.up_squared
```kconfig
# Copyright (c) 2018-2024 Intel Corporation
# SPDX-License-Identifier: Apache-2.0

config BOARD_UP_SQUARED
	select SOC_APOLLO_LAKE
```

## boards/up-bridge-the-gap/up_squared/board.yml
```yaml
board:
  name: up_squared
  full_name: UP Squared
  vendor: up-bridge-the-gap
  socs:
    - name: apollo_lake
```

## boards/up-bridge-the-gap/up_squared/up_squared_defconfig
```kconfig
# SPDX-License-Identifier: Apache-2.0
# Copyright (c) 2018 Intel Corporation

CONFIG_PIC_DISABLE=y
CONFIG_LOAPIC=y
CONFIG_CONSOLE=y
CONFIG_UART_CONSOLE=y
CONFIG_SERIAL=y
CONFIG_X2APIC=y
CONFIG_SMP=y
CONFIG_BUILD_OUTPUT_EFI=y

CONFIG_APIC_TSC_DEADLINE_TIMER=n
CONFIG_HPET_TIMER=y
```

## boards/up-bridge-the-gap/up_squared_pro_7000/Kconfig.up_squared_pro_7000
```kconfig
# Copyright (c) 2018-2024 Intel Corporation
# SPDX-License-Identifier: Apache-2.0

config BOARD_UP_SQUARED_PRO_7000
	select SOC_ALDER_LAKE
```

## boards/up-bridge-the-gap/up_squared_pro_7000/board.yml
```yaml
board:
  name: up_squared_pro_7000
  full_name: UP Squared Pro 7000
  vendor: up-bridge-the-gap
  socs:
    - name: alder_lake
```

## boards/v2/adafruit/adafruit_kb2040/board.yml
```yaml
board:
  name: adafruit_kb2040
  vendor: Adafruit Industries LLC
  socs:
  - name: rp2040
```

## boards/v2/altera/altera_max10/Kconfig.altera_max10
```kconfig
# SPDX-License-Identifier: Apache-2.0

config BOARD_ALTERA_MAX10
	select SOC_NIOS2F_ZEPHYR
```

## boards/v2/altera/altera_max10/board.yml
```yaml
board:
  name: altera_max10
  vendor: Altera Corporation
  socs:
  - name: nios2f-zephyr
```

## boards/v2/arm/mps3/Kconfig.mps3
```kconfig
# Copyright (c) 2023 Nordic Semiconductor
#
# SPDX-License-Identifier: Apache-2.0

config BOARD_MPS3
	select SOC_SERIES_MPS3
	select SOC_MPS3_AN547
```

## boards/v2/arm/mps3/board.yml
```yaml
board:
  name: mps3
  vendor: arm
  socs:
  - name: 'an547'
    variants:
    - name: 'ns'
```

## boards/v2/cadence/xt-sim/board.yml
```yaml
board:
  name: xt-sim
  vendor: Cadence Design Systems
  socs:
  - name: xtensa_sample_controller
```

## boards/v2/firefly/roc_rk3568_pc/board.yml
```yaml
board:
  name: roc_rk3568_pc
  vendor: Firefly
  socs:
  - name: rk3568
    variants:
    - name: smp
```

## boards/v2/gd/gd32a503v_eval/board.yml
```yaml
board:
  name: gd32a503v_eval
  vendor: GigaDevice Semiconductor
  socs:
    - name: gd32a503
```

## boards/v2/gd/gd32e103v_eval/board.yml
```yaml
board:
  name: gd32e103v_eval
  vendor: GigaDevice Semiconductor
  socs:
    - name: gd32e103
```
