/*
 * Copyright (c) 2026, Mohan Nagaraj
 * SPDX-License-Identifier: Apache-2.0
 */

#include <zephyr/dt-bindings/pinctrl/rpi-pico-rp2040-pinctrl.h>

#include "../../raspberrypi/common/rpi_pico-pinctrl-common.dtsi"
