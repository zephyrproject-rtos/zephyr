## boards/seagate/faze/board.yml
```yaml
board:
  name: faze
  full_name: FireCuda Gaming SSD (FaZe) board
  vendor: seagate
  socs:
    - name: lpc11u67
```

## boards/seagate/legend/Kconfig.legend
```kconfig
# Copyright (c) 2021 Seagate Technology
# SPDX-License-Identifier: Apache-2.0

config BOARD_LEGEND
	select SOC_STM32F070XB
```

## boards/seagate/legend/board.yml
```yaml
board:
  name: legend
  full_name: Legend
  vendor: seagate
  revision:
    format: custom
    default: "25hdd"
    revisions:
      - name: "25hdd"
      - name: "25ssd"
      - name: "35"
  socs:
    - name: stm32f070xb
```

## boards/seagate/legend/legend_defconfig
```kconfig
# SPDX-License-Identifier: Apache-2.0

# Serial Drivers
CONFIG_SERIAL=y
CONFIG_UART_INTERRUPT_DRIVEN=y

# Enable console
CONFIG_CONSOLE=y
CONFIG_UART_CONSOLE=y

# GPIO Controller
CONFIG_GPIO=y

# Clock Control
CONFIG_CLOCK_CONTROL=y

# Enable pin controller
CONFIG_PINCTRL=y
```

## boards/seco/stm32f3_seco_d23/Kconfig.stm32f3_seco_d23
```kconfig
# Copyright (c) 2022, SECO Spa
# SPDX-License-Identifier: Apache-2.0

config BOARD_STM32F3_SECO_D23
	select SOC_STM32F302XC
```

## boards/seco/stm32f3_seco_d23/board.yml
```yaml
board:
  name: stm32f3_seco_d23
  full_name: SECO SBC-3.5-PX30 (JUNO - D23) (STM32F302)
  vendor: seco
  socs:
    - name: stm32f302xc
```

## boards/seco/stm32f3_seco_d23/stm32f3_seco_d23_defconfig
```kconfig
# SPDX-License-Identifier: Apache-2.0
# SECO SBC-3.5-PX30 board defconfig
#
# Copyright (c) 2022, SECO Spa

# Enable MPU
CONFIG_ARM_MPU=y

# Enable HW stack protection
CONFIG_HW_STACK_PROTECTION=y

# enable uart driver
CONFIG_SERIAL=y

# enable console
CONFIG_CONSOLE=y
CONFIG_UART_CONSOLE=y

# enable GPIO
CONFIG_GPIO=y

# clock configuration
CONFIG_CLOCK_CONTROL=y

# enable regulators
CONFIG_REGULATOR=y

# enable pin controller
CONFIG_PINCTRL=y
```

## boards/seeed/96b_carbon/Kconfig.96b_carbon
```kconfig
# Copyright (c) 2016 Linaro Limited.
# SPDX-License-Identifier: Apache-2.0

config BOARD_96B_CARBON
	select SOC_STM32F401XE
```

## boards/seeed/lora_e5_dev_board/Kconfig.lora_e5_dev_board
```kconfig
# Copyright (c) 2021 Thomas Stranger
# SPDX-License-Identifier: Apache-2.0

config BOARD_LORA_E5_DEV_BOARD
	select SOC_STM32WLE5XX
```

## boards/seeed/lora_e5_dev_board/board.yml
```yaml
board:
  name: lora_e5_dev_board
  full_name: LoRa-E5 Dev Board
  vendor: seeed
  socs:
    - name: stm32wle5xx
```

## boards/seeed/lora_e5_dev_board/lora_e5_dev_board_defconfig
```kconfig
# SPDX-License-Identifier: Apache-2.0
# Copyright (c) 2021 Thomas Stranger

# Enable UART driver
CONFIG_SERIAL=y

# Enable GPIO
CONFIG_GPIO=y

# Console
CONFIG_CONSOLE=y
CONFIG_UART_CONSOLE=y

# Enable MPU
CONFIG_ARM_MPU=y

# Enable HW stack protection
CONFIG_HW_STACK_PROTECTION=y

# Enable regulator for the power-rails
CONFIG_REGULATOR=y
```

## boards/seeed/lora_e5_mini/Kconfig.lora_e5_mini
```kconfig
# Copyright (c) 2023 Marcin Niestroj
# SPDX-License-Identifier: Apache-2.0

config BOARD_LORA_E5_MINI
	select SOC_STM32WLE5XX
```

## boards/seeed/lora_e5_mini/board.yml
```yaml
board:
  name: lora_e5_mini
  full_name: LoRa-E5 mini
  vendor: seeed
  socs:
    - name: stm32wle5xx
```

## boards/seeed/reterminal_e1001/Kconfig.defconfig
```kconfig
# SPDX-FileCopyrightText: Copyright The Zephyr Project Contributors
# SPDX-License-Identifier: Apache-2.0

if BOARD_RETERMINAL_E1001_ESP32S3_PROCPU

if LVGL

config LV_Z_COLOR_MONO_HW_INVERSION
	default y

choice LV_COLOR_DEPTH
	default LV_COLOR_DEPTH_1
endchoice

endif # LVGL

if FUEL_GAUGE

# Composite fuel gauge gets battery voltage from ADC-based voltage-divider sensor

config ADC
	default y

config SENSOR
	default y

endif # FUEL_GAUGE

endif # BOARD_RETERMINAL_E1001_ESP32S3_PROCPU
```

## boards/seeed/reterminal_e1001/Kconfig.reterminal_e1001
```kconfig
# SPDX-FileCopyrightText: Copyright The Zephyr Project Contributors
# SPDX-License-Identifier: Apache-2.0

config BOARD_RETERMINAL_E1001
	select SOC_ESP32S3_R8
	select SOC_ESP32S3_PROCPU if BOARD_RETERMINAL_E1001_ESP32S3_PROCPU
	select SOC_ESP32S3_APPCPU if BOARD_RETERMINAL_E1001_ESP32S3_APPCPU
```

## boards/seeed/reterminal_e1001/board.yml
```yaml
board:
  name: reterminal_e1001
  full_name: reTerminal E1001
  vendor: seeed
  socs:
  - name: esp32s3
```

## boards/seeed/reterminal_e1002/Kconfig
```kconfig
# Copyright (c) 2025 Benjamin Lemouzy
# SPDX-License-Identifier: Apache-2.0

config HEAP_MEM_POOL_ADD_SIZE_BOARD
	int
	default 4096 if BOARD_RETERMINAL_E1002_ESP32S3_PROCPU
	default 256 if BOARD_RETERMINAL_E1002_ESP32S3_APPCPU
```

## boards/seeed/reterminal_e1002/Kconfig.defconfig
```kconfig
# SPDX-FileCopyrightText: Copyright The Zephyr Project Contributors
# SPDX-License-Identifier: Apache-2.0

if BOARD_RETERMINAL_E1002_ESP32S3_PROCPU

if FUEL_GAUGE

# Composite fuel gauge gets battery voltage from ADC-based voltage-divider sensor

config ADC
	default y

config SENSOR
	default y

endif # FUEL_GAUGE

if LVGL

choice LV_COLOR_DEPTH
	default LV_COLOR_DEPTH_24
endchoice

config LV_Z_FULL_REFRESH
	default y

config LV_Z_VDB_CUSTOM_SECTION
	default y

config ESP_SPIRAM
	default y

endif # LVGL

choice SPIRAM_MODE
	default SPIRAM_MODE_OCT
endchoice

endif # BOARD_RETERMINAL_E1002_ESP32S3_PROCPU
```

## boards/seeed/reterminal_e1002/Kconfig.reterminal_e1002
```kconfig
# Copyright (c) 2025 Benjamin Lemouzy
# SPDX-License-Identifier: Apache-2.0

config BOARD_RETERMINAL_E1002
	select SOC_ESP32S3
	select SOC_ESP32S3_PROCPU if BOARD_RETERMINAL_E1002_ESP32S3_PROCPU
	select SOC_ESP32S3_APPCPU if BOARD_RETERMINAL_E1002_ESP32S3_APPCPU
```

## boards/seeed/reterminal_e1002/board.yml
```yaml
board:
  name: reterminal_e1002
  full_name: reTerminal E1002
  vendor: seeed
  socs:
  - name: esp32s3
```

## boards/seeed/reterminal_e1003/Kconfig.defconfig
```kconfig
# SPDX-FileCopyrightText: Copyright The Zephyr Project Contributors
# SPDX-License-Identifier: Apache-2.0

if BOARD_RETERMINAL_E1003_ESP32S3_PROCPU

if FUEL_GAUGE

# Composite fuel gauge gets battery voltage from ADC-based voltage-divider sensor

config ADC
	default y

config SENSOR
	default y

endif # FUEL_GAUGE

endif # BOARD_RETERMINAL_E1003_ESP32S3_PROCPU
```

## boards/seeed/reterminal_e1003/board.yml
```yaml
board:
  name: reterminal_e1003
  full_name: reTerminal E1003
  vendor: seeed
  socs:
  - name: esp32s3
```

## boards/seeed/reterminal_e1004/board.yml
```yaml
board:
  name: reterminal_e1004
  full_name: reTerminal E1004
  vendor: seeed
  socs:
  - name: esp32s3
```

## boards/seeed/seeeduino_xiao/Kconfig.seeeduino_xiao
```kconfig
# Copyright (c) 2020 Google LLC.
# Copyright (c) 2024 Gerson Fernando Budke <nandojve@gmail.com>
# SPDX-License-Identifier: Apache-2.0

config BOARD_SEEEDUINO_XIAO
	select SOC_SAMD21G18A
```
