## boards/qemu_nios2/qemu_nios2_defconfig
```kconfig
CONFIG_NIOS2=y
CONFIG_SOC_NIOS2F_QEMU=y
CONFIG_BOARD_QEMU_NIOS2=y
CONFIG_XIP=n
CONFIG_INIT_STACKS=y
CONFIG_CONSOLE=y
CONFIG_PRINTK=y
CONFIG_RAM_CONSOLE=y
CONFIG_DEBUG=y
```

## boards/qemu_x86/Kconfig
```kconfig
if BOARD_QEMU_X86

config BOARD
        default qemu_x86

endif # BOARD_QEMU_X86
```

## boards/qemu_x86/Kconfig.board
```kconfig
config  BOARD_QEMU_X86
        bool "QEMU x86"
        select PLATFORM_IA32
	depends on X86
```

## boards/qemu_x86/Kconfig.defconfig
```kconfig
if BOARD_QEMU_X86

config BOARD
	default qemu_x86

config CPU_HAS_FPU
	def_bool y if !X86_IAMCU

endif # BOARD_QEMU_X86
```

## boards/qemu_x86_iamcu/Kconfig
```kconfig
if BOARD_QEMU_X86_IAMCU

config BOARD
        default qemu_x86_iamcu

config TOOLCHAIN_VARIANT
	default "iamcu"

endif # BOARD_QEMU_X86
```

## boards/qemu_x86_iamcu/Kconfig.board
```kconfig
config  BOARD_QEMU_X86_IAMCU
        bool "QEMU x86"
        select SOC_IA32
	select X86_IAMCU
	depends on X86
```

## boards/qorvo/decawave_dwm1001_dev/Kconfig.defconfig
```kconfig
# DecaWave DWM1001 board configuration

# Copyright (c) 2019 Stéphane D'Alu
# SPDX-License-Identifier: Apache-2.0

if BOARD_DECAWAVE_DWM1001_DEV

config I2C
	default SENSOR

config SPI
	default y
	depends on IEEE802154

endif # BOARD_DECAWAVE_DWM1001_DEV
```

## boards/qorvo/decawave_dwm1001_dev/board.yml
```yaml
board:
  name: decawave_dwm1001_dev
  full_name: Decawave DWM1001
  vendor: qorvo
  socs:
  - name: nrf52832
```

## boards/qorvo/decawave_dwm3001cdk/Kconfig
```kconfig
# DecaWave DWM3001CDK board configuration

# Copyright (c) 2024 The Zephyr Project Contributors
# # SPDX-License-Identifier: Apache-2.0

if BOARD_DECAWAVE_DWM3001CDK

config BOARD_SERIAL_BACKEND_CDC_ACM
	bool "Use USB CDC as serial console backend"
	default y

endif # BOARD_DECAWAVE_DWM3001CDK
```

## boards/qorvo/decawave_dwm3001cdk/Kconfig.decawave_dwm3001cdk
```kconfig
# DecaWave DWM3001CDK board configuration

# Copyright (c) 2019 Stéphane D'Alu
# SPDX-License-Identifier: Apache-2.0

config BOARD_DECAWAVE_DWM3001CDK
	select SOC_NRF52833_QDAA
```

## boards/qorvo/decawave_dwm3001cdk/Kconfig.defconfig
```kconfig
# DecaWave DWM3001CDK board configuration

# Copyright (c) 2019 Stéphane D'Alu
# SPDX-License-Identifier: Apache-2.0

if BOARD_DECAWAVE_DWM3001CDK

config I2C
	default SENSOR

endif # BOARD_DECAWAVE_DWM3001CDK
```

## boards/qorvo/decawave_dwm3001cdk/board.yml
```yaml
board:
  name: decawave_dwm3001cdk
  full_name: Decawave DWM3001CDK
  vendor: qorvo
  socs:
  - name: nrf52833
```

## boards/qualcomm/qcc744m_evk/Kconfig.qcc744m_evk
```kconfig
# Copyright (c) 2025 MASSDRIVER EI (massdriver.space)
#
# SPDX-License-Identifier: Apache-2.0

config BOARD_QCC744M_EVK
	select SOC_BL618M05Q2I
```

## boards/qualcomm/qcc744m_evk/board.yml
```yaml
board:
  name: qcc744m_evk
  full_name: Qualcomm QCC744M Evaluation Board
  vendor: qcom
  socs:
    - name: bl618m05q2i
```

## boards/quark_d2000_crb/Kconfig
```kconfig
if BOARD_QUARK_D2000_CRB

config BOARD
	default "quark_d2000_crb"

endif # BOARD_QUARK_D2000_CRB
```

## boards/quark_d2000_crb/Kconfig.board
```kconfig
config  BOARD_QUARK_D2000_CRB
        bool "Quark D2000 CRB"
        depends on SOC_QUARK_D2000
```

## boards/quark_d2000_crb/Kconfig.defconfig
```kconfig
if BOARD_QUARK_D2000_CRB

config BOARD
	default "quark_d2000_crb"

if COUNTER && AON_TIMER_QMSI

config AON_TIMER_IRQ
	default 3
config AON_TIMER_IRQ_PRI
	default 2

endif

endif # BOARD_QUARK_D2000_CRB
```

## boards/quark_d2000_reference/Kconfig
```kconfig
if BOARD_QUARK_D2000_REFERENCE

config BOARD
	default "quark_d2000_reference"

endif # BOARD_QUARK_D2000_REFERENCE
```

## boards/quark_d2000_reference/Kconfig.board
```kconfig
config  BOARD_QUARK_D2000_REFERENCE
        bool "Quark D2000 CRB"
        select PLATFORM_QUARK_D2000
```

## boards/quark_se_c1000_devboard/Kconfig.board
```kconfig
config BOARD_QUARK_SE_C1000_DEVBOARD
	bool "Quark SE C1000 Devboard"
	depends on SOC_QUARK_SE_C1000
```

## boards/quark_se_c1000_ss_devboard/Kconfig.defconfig
```kconfig
if BOARD_QUARK_SE_C1000_DEVBOARD_SS

config BOARD
	default "quark_se_c1000_ss_devboard"

endif # BOARD_QUARK_SE_C1000_DEVBOARD_SS
```

## boards/quark_se_ctb/Kconfig
```kconfig
if BOARD_QUARK_SE_CTB

config BOARD
        default "quark_se_ctb"

endif # BOARD_QUARK_SE_CTB
```

## boards/quark_se_ctb/Kconfig.board
```kconfig
config  BOARD_QUARK_SE_CTB
        bool "Quark SE Test Board"
        select PLATFORM_QUARK_SE
	depends on X86
```

## boards/quark_se_devboard/Kconfig
```kconfig
if BOARD_QUARK_SE_DEVBOARD

config BOARD
        default "quark_se_devboard"

if NETWORKING_WITH_15_4_TI_CC2520

config SPI
	def_bool y
config GPIO
	def_bool y

config TI_CC2520_SPI_DRV_NAME
	default SPI_DW_PORT_1_DRV_NAME
config TI_CC2520_SPI_FREQ
	default 32
config TI_CC2520_SPI_SLAVE
	default 1

if SPI_DW
config SPI_DW_CS_GPIO
	def_bool y
config SPI_DW_PORT_1_CS_GPIO_PORT
	default GPIO_DW_0_NAME
config SPI_DW_PORT_1_CS_GPIO_PIN
	default 11
config TI_CC2520_GPIO_CS_NAME
       default GPIO_DW_0_NAME
config TI_CC2520_GPIO_AON_NAME
       default GPIO_DW_1_NAME
endif

if SPI_QMSI
config SPI_QMSI_CS_GPIO
	def_bool y
config SPI_QMSI_PORT_1_CS_GPIO_PORT
	default GPIO_QMSI_0_NAME
config SPI_QMSI_PORT_1_CS_GPIO_PIN
	default 11
config TI_CC2520_GPIO_CS_NAME
       string
       default GPIO_QMSI_0_NAME
config TI_CC2520_GPIO_AON_NAME
       string
       default GPIO_QMSI_AON_NAME
endif

endif # NETWORKING_WITH_15_4_TI_CC2520

endif # BOARD_QUARK_SE_DEVBOARD
```
