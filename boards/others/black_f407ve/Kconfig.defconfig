## boards/others/black_f407ve/Kconfig.defconfig
```kconfig
# black_f407ve board configuration

# Copyright (c) 2020 Intel Corporation
# SPDX-License-Identifier: Apache-2.0

if BOARD_BLACK_F407VE

config SPI_STM32_INTERRUPT
	default y
	depends on SPI

endif # BOARD_BLACK_F407VE
```

## boards/others/black_f407ve/black_f407ve_defconfig
```kconfig
# SPDX-License-Identifier: Apache-2.0

# Enable MPU
CONFIG_ARM_MPU=y

# Enable HW stack protection
CONFIG_HW_STACK_PROTECTION=y

# Enable UART
CONFIG_SERIAL=y

# Console
CONFIG_CONSOLE=y
CONFIG_UART_CONSOLE=y

# Enable Clocks
CONFIG_CLOCK_CONTROL=y

# Enable GPIO
CONFIG_GPIO=y

# enable pin controller
CONFIG_PINCTRL=y
```

## boards/others/black_f407ve/board.yml
```yaml
board:
  name: black_f407ve
  full_name: Black STM32 F407VE Development Board
  vendor: others
  socs:
    - name: stm32f407xx
```

## boards/others/black_f407zg_pro/Kconfig.black_f407zg_pro
```kconfig
# Copyright (c) 2020 Intel Corporation
# SPDX-License-Identifier: Apache-2.0

config BOARD_BLACK_F407ZG_PRO
	select SOC_STM32F407XG
```

## boards/others/black_f407zg_pro/Kconfig.defconfig
```kconfig
# black_f407zg board configuration

# Copyright (c) 2020 Intel Corporation
# SPDX-License-Identifier: Apache-2.0

if BOARD_BLACK_F407ZG_PRO

config SPI_STM32_INTERRUPT
	default y
	depends on SPI

endif # BOARD_BLACK_F407ZG_PRO
```

## boards/others/black_f407zg_pro/board.yml
```yaml
board:
  name: black_f407zg_pro
  full_name: Black STM32 F407ZG Pro Development Board
  vendor: others
  socs:
    - name: stm32f407xx
```

## boards/others/canbardo/Kconfig.canbardo
```kconfig
# Copyright (c) 2024-2025 Henrik Brix Andersen <henrik@brixandersen.dk>
# SPDX-License-Identifier: Apache-2.0

config BOARD_CANBARDO
	select SOC_SAME70N20B
```

## boards/others/canbardo/board.yml
```yaml
board:
  name: canbardo
  full_name: CANbardo
  vendor: others
  socs:
    - name: same70n20b
```

## boards/others/canbardo/canbardo_defconfig
```kconfig
# Copyright (c) 2024-2025 Henrik Brix Andersen <henrik@brixandersen.dk>
# SPDX-License-Identifier: Apache-2.0

CONFIG_ARM_MPU=y
CONFIG_CACHE_MANAGEMENT=y
CONFIG_HW_STACK_PROTECTION=y

CONFIG_CONSOLE=y
CONFIG_SERIAL=y
CONFIG_UART_CONSOLE=y

CONFIG_WDT_DISABLE_AT_BOOT=y
```

## boards/others/candlelight/Kconfig.candlelight
```kconfig
# Copyright (c) 2024 Henrik Brix Andersen <henrik@brixandersen.dk>
# SPDX-License-Identifier: Apache-2.0

config BOARD_CANDLELIGHT
	select SOC_STM32F072XB
```

## boards/others/candlelight/board.yml
```yaml
board:
  name: candlelight
  full_name: candleLight
  vendor: others
  socs:
    - name: stm32f072xb
```

## boards/others/candlelightfd/Kconfig.candlelightfd
```kconfig
# Copyright (c) 2024 Sean Nyekjaer <sean@geanix.com>
# SPDX-License-Identifier: Apache-2.0

config BOARD_CANDLELIGHTFD
	select SOC_STM32G0B1XX
```

## boards/others/candlelightfd/board.yml
```yaml
board:
  name: candlelightfd
  full_name: candleLightFD
  vendor: others
  socs:
    - name: stm32g0b1xx
      variants:
        - name: 'dual'
```

## boards/others/candlelightfd/candlelightfd_stm32g0b1xx_dual_defconfig
```kconfig
# Enable MPU
CONFIG_ARM_MPU=y

# Enable HW stack protection
CONFIG_HW_STACK_PROTECTION=y

# Enable GPIO
CONFIG_GPIO=y
```

## boards/others/doit_esp32_devkit_v1/Kconfig
```kconfig
# Copyright (c) 2025 Siratul Islam
# SPDX-License-Identifier: Apache-2.0

config HEAP_MEM_POOL_ADD_SIZE_BOARD
	int
	default 4096 if BOARD_DOIT_ESP32_DEVKIT_V1_ESP32_PROCPU
	default 256 if BOARD_DOIT_ESP32_DEVKIT_V1_ESP32_APPCPU
```

## boards/others/doit_esp32_devkit_v1/Kconfig.doit_esp32_devkit_v1
```kconfig
# Copyright (c) 2025 Siratul Islam
# SPDX-License-Identifier: Apache-2.0

config BOARD_DOIT_ESP32_DEVKIT_V1
	select SOC_ESP32_WROOM_32UE_N4
	select SOC_ESP32_PROCPU if BOARD_DOIT_ESP32_DEVKIT_V1_ESP32_PROCPU
	select SOC_ESP32_APPCPU if BOARD_DOIT_ESP32_DEVKIT_V1_ESP32_APPCPU
```

## boards/others/doit_esp32_devkit_v1/board.yml
```yaml
board:
  name: doit_esp32_devkit_v1
  full_name: DOIT ESP32-DevKit-V1
  vendor: others
  socs:
    - name: esp32
```

## boards/others/doit_esp32_devkit_v1/doit_esp32_devkit_v1_appcpu_defconfig
```kconfig
# SPDX-License-Identifier: Apache-2.0

CONFIG_CLOCK_CONTROL=y

# Enable support for ESP32 chip revision 1.1
CONFIG_ESP32_USE_UNSUPPORTED_REVISION=y
```

## boards/others/doit_esp32_devkit_v1/doit_esp32_devkit_v1_procpu_defconfig
```kconfig
# Copyright (c) 2025 Siratul Islam
# SPDX-License-Identifier: Apache-2.0

CONFIG_CONSOLE=y
CONFIG_SERIAL=y
CONFIG_UART_CONSOLE=y

CONFIG_GPIO=y

# Enable support for ESP32 chip revision 1.1
CONFIG_ESP32_USE_UNSUPPORTED_REVISION=y
```

## boards/others/esp32c3_lckfb/Kconfig.esp32c3_lckfb
```kconfig
# ESP32C3 LCKFB board configuration
#
# Copyright (c) 2025 LCKFB
# SPDX-License-Identifier: Apache-2.0

config BOARD_ESP32C3_LCKFB
	select SOC_ESP32C3
```

## boards/others/esp32c3_lckfb/board.yml
```yaml
board:
  name: esp32c3_lckfb
  full_name: ESP32-C3 Development Board (LCKFB)
  vendor: others
  socs:
  - name: esp32c3
```

## boards/others/esp32c3_supermini/Kconfig
```kconfig
# ESP32C3 supermini board configuration

# Copyright (c) 2024 Arrel Neumiller
# SPDX-License-Identifier: Apache-2.0

config HEAP_MEM_POOL_ADD_SIZE_BOARD
	int
	default 2048
```

## boards/others/esp32c3_supermini/Kconfig.esp32c3_supermini
```kconfig
# Copyright (c) 2024 Arrel Neumiller
# SPDX-License-Identifier: Apache-2.0

config BOARD_ESP32C3_SUPERMINI
	select SOC_ESP32C3_FH4
```

## boards/others/esp32c3_supermini/board.yml
```yaml
# Copyright (c) 2024 Arrel Neumiller
# SPDX-License-Identifier: Apache-2.0

board:
  name: esp32c3_supermini
  full_name: ESP32-C3-SUPERMINI
  vendor: others
  socs:
  - name: esp32c3
```

## boards/others/esp32h2_supermini/Kconfig.esp32h2_supermini
```kconfig
# Copyright (c) 2024 Arrel Neumiller
# SPDX-License-Identifier: Apache-2.0

config BOARD_ESP32H2_SUPERMINI
	select SOC_ESP32_H2_MINI_H4
```
