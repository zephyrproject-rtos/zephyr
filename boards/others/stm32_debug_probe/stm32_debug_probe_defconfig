## boards/others/stm32_debug_probe/stm32_debug_probe_defconfig
```kconfig
# Copyright (c) 2026 Muhammad Waleed Badar
# SPDX-License-Identifier: Apache-2.0

# Enable console over segger RTT
CONFIG_CONSOLE=y
CONFIG_RTT_CONSOLE=y
CONFIG_USE_SEGGER_RTT=y

# Enable GPIO
CONFIG_GPIO=y

# Enable UART
CONFIG_SERIAL=y
```

## boards/others/stm32_min_dev/board.yml
```yaml
board:
  name: stm32_min_dev
  full_name: STM32 Minimum Development Board
  vendor: others
  revision:
    format: custom
    default: "blue"
    revisions:
      - name: "blue"
      - name: "black"
  socs:
    - name: stm32f103xb
```

## boards/others/stm32_min_dev/stm32_min_dev_defconfig
```kconfig
# STM32 Minimum Development Board Configuration
#
# Copyright (c) 2019, embedjournal.com
#
# SPDX-License-Identifier: Apache-2.0

# enable uart driver
CONFIG_SERIAL=y

# enable console
CONFIG_CONSOLE=y
CONFIG_UART_CONSOLE=y

# enable GPIO
CONFIG_GPIO=y

# enable clock control
CONFIG_CLOCK_CONTROL=y

# enable pin controller
CONFIG_PINCTRL=y
```

## boards/others/stm32f030_demo/board.yml
```yaml
board:
  name: stm32f030_demo
  full_name: STM32F030 DEMO BOARD
  vendor: others
  socs:
    - name: stm32f030x6
```

## boards/others/stm32f030_demo/stm32f030_demo_defconfig
```kconfig
# SPDX-License-Identifier: Apache-2.0

# Kernel Options due to Low Memory (4k)
CONFIG_MAIN_STACK_SIZE=640
CONFIG_IDLE_STACK_SIZE=200
CONFIG_ISR_STACK_SIZE=512
# Prevent Interrupt Vector Table in RAM
CONFIG_SRAM_VECTOR_TABLE=n

# Serial Drivers
CONFIG_SERIAL=y
CONFIG_UART_INTERRUPT_DRIVEN=y
# enable console
CONFIG_CONSOLE=y
CONFIG_UART_CONSOLE=y

# GPIO Controller
CONFIG_GPIO=y
```

## boards/others/stm32f103_mini/board.yml
```yaml
board:
  name: stm32f103_mini
  full_name: STM32F103 Mini
  vendor: st
  socs:
    - name: stm32f103xe
```

## boards/others/stm32f401_mini/Kconfig.defconfig
```kconfig
# Copyright (c) 2022 Brian Bradley
# SPDX-License-Identifier: Apache-2.0

# STM32 Mini F401 board definitions

if BOARD_STM32F401_MINI

config SPI_STM32_INTERRUPT
	default y
	depends on SPI

endif # BOARD_STM32F401_MINI
```

## boards/others/stm32f401_mini/Kconfig.stm32f401_mini
```kconfig
# Copyright (c) 2022 Brian Bradley
# SPDX-License-Identifier: Apache-2.0

config BOARD_STM32F401_MINI
	select SOC_STM32F401XC
```

## boards/others/stm32f401_mini/board.yml
```yaml
board:
  name: stm32f401_mini
  full_name: STM32 Mini F401
  vendor: others
  socs:
    - name: stm32f401xc
```

## boards/others/supermini_nrf52840/board.yml
```yaml
board:
  name: supermini_nrf52840
  full_name: Supermini Pro Micro nRF52840
  socs:
  - name: nrf52840
    variants:
    - name: uf2
```

## boards/others/xh_s3e_ai/Kconfig.xh_s3e_ai
```kconfig
# Copyright (c) 2026 Anuj Deshpande
# SPDX-License-Identifier: Apache-2.0

config BOARD_XH_S3E_AI
	select SOC_ESP32S3_WROOM_N16R8
	select SOC_ESP32S3_PROCPU if BOARD_XH_S3E_AI_ESP32S3_PROCPU
	select SOC_ESP32S3_APPCPU if BOARD_XH_S3E_AI_ESP32S3_APPCPU
```

## boards/others/xh_s3e_ai/board.yml
```yaml
# Copyright (c) 2026 Anuj Deshpande
# SPDX-License-Identifier: Apache-2.0

board:
  name: xh_s3e_ai
  full_name: XH-S3E-AI
  vendor: others
  socs:
  - name: esp32s3
```

## boards/panasonic/pan1770_evb/Kconfig
```kconfig
# PAN1770 EVB configuration

# Copyright (c) 2022 Panasonic Industrial Devices Europe GmbH
# SPDX-License-Identifier: Apache-2.0

if BOARD_PAN1770_EVB

config BOARD_ENABLE_DCDC
	bool "DCDC mode"
	select SOC_DCDC_NRF52X
	default y

config BOARD_ENABLE_DCDC_HV
	bool "High Voltage DCDC converter"
	select SOC_DCDC_NRF52X_HV
	default y

endif # BOARD_PAN1770_EVB
```

## boards/panasonic/pan1770_evb/Kconfig.pan1770_evb
```kconfig
# PAN1770 EVB configuration

# Copyright (c) 2022 Panasonic Industrial Devices Europe GmbH
# SPDX-License-Identifier: Apache-2.0

config BOARD_PAN1770_EVB
	select SOC_NRF52840_QIAA
```

## boards/panasonic/pan1770_evb/board.yml
```yaml
board:
  name: pan1770_evb
  full_name: PAN1770 Evaluation Board
  vendor: panasonic
  socs:
  - name: nrf52840
```

## boards/panasonic/pan1780_evb/Kconfig.pan1780_evb
```kconfig
# PAN1780 EVB configuration

# Copyright (c) 2022 Panasonic Industrial Devices Europe GmbH
# SPDX-License-Identifier: Apache-2.0

config BOARD_PAN1780_EVB
	select SOC_NRF52840_QIAA
```

## boards/panasonic/pan1780_evb/board.yml
```yaml
board:
  name: pan1780_evb
  full_name: PAN1780 Evaluation Board
  vendor: panasonic
  socs:
  - name: nrf52840
```

## boards/panasonic/pan1781_evb/Kconfig.pan1781_evb
```kconfig
# PAN1781 EVB configuration

# Copyright (c) 2022 Panasonic Industrial Devices Europe GmbH
# SPDX-License-Identifier: Apache-2.0

config BOARD_PAN1781_EVB
	select SOC_NRF52820_QDAA
```

## boards/panasonic/pan1781_evb/board.yml
```yaml
board:
  name: pan1781_evb
  full_name: PAN1781 Evaluation Board
  vendor: panasonic
  socs:
  - name: nrf52820
```

## boards/panasonic/pan1782_evb/Kconfig
```kconfig
# PAN1782 EVB configuration

# Copyright (c) 2022 Panasonic Industrial Devices Europe GmbH
# SPDX-License-Identifier: Apache-2.0

config BOARD_ENABLE_DCDC
	bool "DCDC mode"
	select SOC_DCDC_NRF52X
	default y
	depends on BOARD_PAN1782_EVB
```

## boards/panasonic/pan1782_evb/Kconfig.pan1782_evb
```kconfig
# PAN1782 EVB configuration

# Copyright (c) 2022 Panasonic Industrial Devices Europe GmbH
# SPDX-License-Identifier: Apache-2.0

config BOARD_PAN1782_EVB
	select SOC_NRF52833_QIAA
```

## boards/panasonic/pan1782_evb/board.yml
```yaml
board:
  name: pan1782_evb
  full_name: PAN1782 Evaluation Board
  vendor: panasonic
  socs:
  - name: nrf52833
```
