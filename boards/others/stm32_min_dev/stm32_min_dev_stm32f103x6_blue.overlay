/*
 * SPDX-FileCopyrightText: Copyright The Zephyr Project Contributors
 *
 * SPDX-License-Identifier: Apache-2.0
 */

/ {
	compatible = "stm32_min_dev_blue", "st,stm32f103c6";
	model = "STM32 Minimum Development Board (Blue)";

	leds {
		led: led {
			gpios = <&gpioc 13 GPIO_ACTIVE_LOW>;
		};
	};
};
