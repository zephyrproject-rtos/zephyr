/*
 * Copyright (c) 2019, embedjournal.com
 *
 * SPDX-License-Identifier: Apache-2.0
 */

/dts-v1/;
#include <st/f1/stm32f103X8.dtsi>
#include <st/f1/stm32f103r(8-b)tx-pinctrl.dtsi>
#include "stm32_min_dev_common.dtsi"

/ {
	model = "STM32 Minimum Development Board";
	compatible = "st,stm32f103c8";
};

&usart3 {
	pinctrl-0 = <&usart3_tx_pb10 &usart3_rx_pb11>;
	current-speed = <115200>;
	pinctrl-names = "default";
	status = "okay";
};

&i2c2 {
	pinctrl-0 = <&i2c2_scl_pb10 &i2c2_sda_pb11>;
	pinctrl-names = "default";
	scl-gpios = <&gpiob 10 GPIO_ACTIVE_HIGH>;
	sda-gpios = <&gpiob 11 GPIO_ACTIVE_HIGH>;
	status = "okay";
	clock-frequency = <I2C_BITRATE_FAST>;
};

&spi2 {
	pinctrl-0 = <&spi2_nss_master_pb12 &spi2_sck_master_pb13
		     &spi2_miso_master_pb14 &spi2_mosi_master_pb15>;
	pinctrl-names = "default";
	status = "okay";
};
