/*
 * SPDX-FileCopyrightText: Copyright The Zephyr Project Contributors
 *
 * SPDX-License-Identifier: Apache-2.0
 */

/ {
	compatible = "stm32_min_dev_black", "st,stm32f103c6";
	model = "STM32 Minimum Development Board (Black)";

	leds {
		led: led {
			gpios = <&gpiob 12 GPIO_ACTIVE_LOW>;
		};
	};
};
