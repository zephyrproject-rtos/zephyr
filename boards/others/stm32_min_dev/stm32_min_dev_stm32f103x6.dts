/*
 * SPDX-FileCopyrightText: Copyright The Zephyr Project Contributors
 *
 * SPDX-License-Identifier: Apache-2.0
 */

/dts-v1/;
#include <st/f1/stm32f103X6.dtsi>
#include <st/f1/stm32f103c(4-6)tx-pinctrl.dtsi>
#include "stm32_min_dev_common.dtsi"

/ {
	model = "STM32 Minimum Development Board";
	compatible = "st,stm32f103c6";
};
