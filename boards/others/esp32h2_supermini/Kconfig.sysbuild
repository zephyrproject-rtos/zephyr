## boards/others/esp32h2_supermini/Kconfig.sysbuild
```kconfig
# Copyright (c) 2024 Arrel Neumiller
# SPDX-License-Identifier: Apache-2.0

choice BOOTLOADER
	default BOOTLOADER_MCUBOOT
endchoice

choice BOOT_SIGNATURE_TYPE
	default BOOT_SIGNATURE_TYPE_NONE
endchoice
```

## boards/others/icev_wireless/Kconfig
```kconfig
# Copyright (c) 2022 Friedt Professional Engineering Services, Inc
# SPDX-License-Identifier: Apache-2.0

config HEAP_MEM_POOL_ADD_SIZE_BOARD
	int
	default 4096
```

## boards/others/icev_wireless/Kconfig.defconfig
```kconfig
# Copyright (c) 2022 Friedt Professional Engineering Services, Inc
# SPDX-License-Identifier: Apache-2.0

config HEAP_MEM_POOL_ADD_SIZE_BOARD
	int
	default $(UINT16_MAX) if WIFI && BT
	default 51200 if WIFI
	default 40960 if BT
	default 4096
```

## boards/others/icev_wireless/Kconfig.icev_wireless
```kconfig
# Copyright (c) 2022 Friedt Professional Engineering Services, Inc
# SPDX-License-Identifier: Apache-2.0

config BOARD_ICEV_WIRELESS
	select SOC_ESP32C3_MINI_N4
```

## boards/others/icev_wireless/board.yml
```yaml
board:
  name: icev_wireless
  full_name: ICE-V Wireless
  vendor: others
  socs:
  - name: esp32c3
```

## boards/others/jz_f407vet6/Kconfig.jz_f407vet6
```kconfig
# SPDX-FileCopyrightText: Copyright The Zephyr Project Contributors
# SPDX-License-Identifier: Apache-2.0

config BOARD_JZ_F407VET6
	select SOC_STM32F407XE
```

## boards/others/jz_f407vet6/board.yml
```yaml
board:
  name: jz_f407vet6
  full_name: JZ-F407VET6 Industrial Control Board
  vendor: others
  socs:
    - name: stm32f407xx
```

## boards/others/neorv32/Kconfig
```kconfig
# Copyright (c) 2021,2025 Henrik Brix Andersen <henrik@brixandersen.dk>
# SPDX-License-Identifier: Apache-2.0

if BOARD_NEORV32_NEORV32_MINIMALBOOT

config BOARD_NEORV32
	select RISCV_ISA_RV32I
	select ATOMIC_OPERATIONS_C

endif # BOARD_NEORV32_NEORV32_MINIMALBOOT

if BOARD_NEORV32_NEORV32_UP5KDEMO

config BOARD_NEORV32
	select RISCV_ISA_RV32I
	select RISCV_ISA_EXT_M
	select ATOMIC_OPERATIONS_C

endif # BOARD_NEORV32_NEORV32_UP5KDEMO
```

## boards/others/neorv32/Kconfig.neorv32
```kconfig
# Copyright (c) 2021 Henrik Brix Andersen <henrik@brixandersen.dk>
# SPDX-License-Identifier: Apache-2.0

config BOARD_NEORV32
	select SOC_NEORV32
```

## boards/others/neorv32/board.yml
```yaml
board:
  name: neorv32
  full_name: NEORV32
  vendor: others
  socs:
    - name: neorv32
      variants:
        - name: "up5kdemo"
```

## boards/others/neorv32/neorv32_defconfig
```kconfig
# Copyright (c) 2021 Henrik Brix Andersen <henrik@brixandersen.dk>
# SPDX-License-Identifier: Apache-2.0

CONFIG_SOC_NEORV32_ISA_C=y
CONFIG_SERIAL=y
CONFIG_CONSOLE=y
CONFIG_UART_CONSOLE=y
CONFIG_UART_INTERRUPT_DRIVEN=y
CONFIG_GPIO=y
```

## boards/others/neorv32/neorv32_neorv32_minimalboot_defconfig
```kconfig
# Copyright (c) 2025 Henrik Brix Andersen <henrik@brixandersen.dk>
# SPDX-License-Identifier: Apache-2.0

CONFIG_SERIAL=y
CONFIG_CONSOLE=y
CONFIG_UART_CONSOLE=y
CONFIG_UART_INTERRUPT_DRIVEN=y
```

## boards/others/promicro_nrf52840/Kconfig
```kconfig
# Copyright (c) 2024 MASSDRIVER EI (massdriver.space)
# SPDX-License-Identifier: Apache-2.0

if BOARD_PROMICRO_NRF52840

config BOARD_HAS_NRF5_BOOTLOADER
	bool "Board has nRF5 bootloader"
	default y
	help
	  If selected, applications are linked so that they can be loaded by Nordic
	  nRF5 bootloader.

endif # BOARD_PROMICRO_NRF52840
```

## boards/others/promicro_nrf52840/Kconfig.defconfig
```kconfig
# Copyright (c) 2024 MASSDRIVER EI (massdriver.space)
# Copyright (c) 2018-2023 Nordic Semiconductor ASA
#
# SPDX-License-Identifier: Apache-2.0

if BOARD_PROMICRO_NRF52840

source "boards/common/usb/Kconfig.cdc_acm_serial.defconfig"

# To let the nRF5 bootloader load an application, the application
# must be linked after Nordic MBR, that is factory-programmed on the board.

# Nordic nRF5 bootloader exists outside of the partitions specified in the
# DTS file, so we manually override FLASH_LOAD_OFFSET to link the application
# correctly, after Nordic MBR.

# When building MCUBoot, MCUBoot itself will select USE_DT_CODE_PARTITION
# which will make it link into the correct partition specified in DTS file,
# the offset is applied here so that the full partition size can be used when
# the bootloader Kconfig option has been disabled.

config FLASH_LOAD_OFFSET
	default 0x1000
	depends on BOARD_HAS_NRF5_BOOTLOADER && (MCUBOOT || !USE_DT_CODE_PARTITION)

endif # BOARD_PROMICRO_NRF52840
```

## boards/others/promicro_nrf52840/Kconfig.promicro_nrf52840
```kconfig
# Copyright (c) 2024 MASSDRIVER EI (massdriver.space)
# SPDX-License-Identifier: Apache-2.0

config BOARD_PROMICRO_NRF52840
	select SOC_NRF52840_QIAA
```

## boards/others/promicro_nrf52840/board.yml
```yaml
board:
  name: promicro_nrf52840
  full_name: Pro Micro nRF52840
  vendor: others
  socs:
  - name: nrf52840
    variants:
    - name: uf2
```

## boards/others/promicro_nrf52840/promicro_nrf52840_nrf52840_defconfig
```kconfig
# SPDX-License-Identifier: Apache-2.0

# Enable MPU
CONFIG_ARM_MPU=y

# Enable hardware stack protection
CONFIG_HW_STACK_PROTECTION=y

# Enable GPIO
CONFIG_GPIO=y

# Even though these boards have an external crystal, they are notoriously
# faulty/poorly tuned, so use the internal RC by default
CONFIG_CLOCK_CONTROL_NRF_K32SRC_RC=y

# Board Kconfig.defconfig enables USB CDC ACM and should disable USB remote
# wakeup by default. It needs to be disabled here, because the USB nrfx
# driver always overwrites option from Kconfig mentioned above with the
# imply from CONFIG_USB_NRFX.
CONFIG_USB_DEVICE_REMOTE_WAKEUP=n
```

## boards/others/promicro_nrf52840/promicro_nrf52840_nrf52840_uf2_defconfig
```kconfig
# SPDX-License-Identifier: Apache-2.0

# Enable MPU
CONFIG_ARM_MPU=y

# Enable hardware stack protection
CONFIG_HW_STACK_PROTECTION=y

# Enable GPIO
CONFIG_GPIO=y

# Board Kconfig.defconfig enables USB CDC ACM and should disable USB remote
# wakeup by default. It needs to be disabled here, because the USB nrfx
# driver always overwrites option from Kconfig mentioned above with the
# imply from CONFIG_USB_NRFX.
CONFIG_USB_DEVICE_REMOTE_WAKEUP=n

# Build UF2 by default, supported by the Adafruit nRF52 Bootloader
CONFIG_BUILD_OUTPUT_UF2=y

# UF2 Bootloader can use DT offset
CONFIG_BOARD_HAS_NRF5_BOOTLOADER=n
CONFIG_USE_DT_CODE_PARTITION=y
```

## boards/others/serpente/board.yml
```yaml
board:
  name: serpente
  full_name: Arturo182 Serpente
  vendor: others
  socs:
    - name: samd21e18a
```

## boards/others/serpente/serpente_defconfig
```kconfig
# Copyright (c) 2024 Gerson Fernando Budke <nandojve@gmail.com>
# SPDX-License-Identifier: Apache-2.0

CONFIG_SOC_ATMEL_SAMD_OSC8M=y
CONFIG_SOC_ATMEL_SAMD_OSC8M_AS_MAIN=y

CONFIG_BOOTLOADER_BOSSA=y
CONFIG_BOOTLOADER_BOSSA_ADAFRUIT_UF2=y

CONFIG_CONSOLE=y
CONFIG_SERIAL=y
CONFIG_UART_CONSOLE=y
CONFIG_UART_INTERRUPT_DRIVEN=y
```

## boards/others/stm32_LD_min_dev/Kconfig.stm32_LD_min_dev
```kconfig
# STM32 Low Density Minimum Development Board Configuration
#
# SPDX-FileCopyrightText: Copyright The Zephyr Project Contributors
#
# SPDX-License-Identifier: Apache-2.0

config BOARD_STM32_LD_MIN_DEV
	select SOC_STM32F103X6
```

## boards/others/stm32_LD_min_dev/board.yml
```yaml
board:
  name: stm32_LD_min_dev
  full_name: STM32 Low Density Minimum Development Board
  vendor: others
  socs:
    - name: stm32f103x6
```

## boards/others/stm32_LD_min_dev/stm32_LD_min_dev_defconfig
```kconfig
# STM32 Low Density Minimum Development Board Configuration
#
# SPDX-FileCopyrightText: Copyright The Zephyr Project Contributors
#
# SPDX-License-Identifier: Apache-2.0

# enable uart driver
CONFIG_SERIAL=y

# enable console
CONFIG_CONSOLE=y
CONFIG_UART_CONSOLE=y

# enable GPIO
CONFIG_GPIO=y
```

## boards/others/stm32_debug_probe/Kconfig.stm32_debug_probe
```kconfig
# Copyright (c) 2026 Muhammad Waleed Badar
# SPDX-License-Identifier: Apache-2.0

config BOARD_STM32_DEBUG_PROBE
	select SOC_STM32F103XB
```

## boards/others/stm32_debug_probe/board.yml
```yaml
board:
  name: stm32_debug_probe
  full_name: STM32 Debug Probe
  vendor: others
  socs:
    - name: stm32f103xb
```
