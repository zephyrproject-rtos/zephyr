/*
 * Copyright (c) 2026 Realtek Semiconductor Corp.
 *
 * SPDX-License-Identifier: Apache-2.0
 */

#include <zephyr/dt-bindings/pinctrl/amebasmart-pinctrl.h>

&pinctrl {
	/* SPI0: PB17=CS, PB18=CLK, PB19=MOSI, PB20=MISO */
	spi0_default: spi0_default {
		group1 {
			pinmux = <AMEBA_PINMUX('B', 18, AMEBA_SPI)>,
				 <AMEBA_PINMUX('B', 19, AMEBA_SPI)>,
				 <AMEBA_PINMUX('B', 20, AMEBA_SPI)>;
			bias-pull-up;
		};
		group2 {
			pinmux = <AMEBA_PINMUX('B', 17, AMEBA_SPI)>;
			bias-pull-up;
		};
	};
};
