## boards/realtek/rtl8730e_evb/board.yml
```yaml
board:
  name: rtl8730e_evb
  full_name: RTL8730E EVB Board
  vendor: realtek
  socs:
    - name: rtl8730e
```

## boards/renesas/aik_ra8d1/Kconfig.defconfig
```kconfig
# Copyright (c) 2026 Renesas Electronics Corporation
# SPDX-License-Identifier: Apache-2.0

if BOARD_AIK_RA8D1

configdefault ETH_DRIVER
	default y

endif # BOARD_AIK_RA8D1
```

## boards/renesas/ek_ra6b1/Kconfig.ek_ra6b1
```kconfig
# SPDX-FileCopyrightText: 2026 Renesas Electronics Corporation
# SPDX-License-Identifier: Apache-2.0

config BOARD_EK_RA6B1
	select SOC_R7KA6B1BG4ZNQ if BOARD_EK_RA6B1_R7KA6B1BG4ZNQ
	select SOC_R7KA6B1BG4ZDC if BOARD_EK_RA6B1_R7KA6B1BG4ZDC
	select SOC_R7KA6B1BG4ZAK if BOARD_EK_RA6B1_R7KA6B1BG4ZAK
```

## boards/renesas/ek_ra6b1/board.yml
```yaml
board:
  name: ek_ra6b1
  full_name: RA6B1 Evaluation Kit
  vendor: renesas
  socs:
  - name: r7ka6b1bg4znq
  - name: r7ka6b1bg4zdc
  - name: r7ka6b1bg4zak
```

## boards/renesas/ek_ra6b1/ek_ra6b1_r7ka6b1bg4znq_defconfig
```kconfig
# SPDX-FileCopyrightText: 2026 Renesas Electronics Corporation
# SPDX-License-Identifier: Apache-2.0

# Enable GPIO
CONFIG_GPIO=y

CONFIG_CONSOLE=y
CONFIG_UART_CONSOLE=y
CONFIG_SERIAL=y

# Enable hardware stack protection
CONFIG_HW_STACK_PROTECTION=y
```

## boards/renesas/ek_ra6m3/Kconfig.defconfig
```kconfig
# Copyright (c) 2025 Renesas Electronics Corporation
# SPDX-License-Identifier: Apache-2.0

if BOARD_EK_RA6M3

configdefault ETH_DRIVER
	default y

endif # BOARD_EK_RA6M3
```

## boards/renesas/ek_ra8d1/Kconfig.defconfig
```kconfig
# Copyright (c) 2024-2025 Renesas Electronics Corporation
# SPDX-License-Identifier: Apache-2.0

if BOARD_EK_RA8D1

configdefault ETH_DRIVER
	default y

endif # BOARD_EK_RA8D1
```

## boards/renesas/ek_ra8m1/Kconfig.defconfig
```kconfig
# Copyright (c) 2024 Renesas Electronics Corporation
# SPDX-License-Identifier: Apache-2.0

if BOARD_EK_RA8M1

configdefault ETH_DRIVER
	default y

endif # BOARD_EK_RA8M1
```

## boards/renesas/ek_ra8t2/Kconfig.defconfig
```kconfig
# Copyright (c) 2026 Renesas Electronics Corporation
# SPDX-License-Identifier: Apache-2.0

if BOARD_EK_RA8T2

configdefault ETH_DRIVER
	default y

endif # BOARD_EK_RA8T2
```

## boards/renesas/ek_rx74m/Kconfig.ek_rx74m
```kconfig
# Copyright (c) 2026 Renesas Electronics Corporation
# SPDX-License-Identifier: Apache-2.0

config BOARD_EK_RX74M
	select SOC_R5K574MCB4AE
```

## boards/renesas/ek_rx74m/board.yml
```yaml
board:
  name: ek_rx74m
  full_name: RX74M Evaluation Kit
  vendor: renesas
  socs:
    - name: r5k574mcb4ae
```

## boards/renesas/ek_rx74m/ek_rx74m_defconfig
```kconfig
# Copyright (c) 2026 Renesas Electronics Corporation
# SPDX-License-Identifier: Apache-2.0

# Enable GPIO
CONFIG_GPIO=y

# Enable console
CONFIG_SERIAL=y
CONFIG_CONSOLE=y
CONFIG_UART_CONSOLE=y
```

## boards/renesas/ek_rx74n/Kconfig.ek_rx74n
```kconfig
# Copyright (c) 2026 Renesas Electronics Corporation
# SPDX-License-Identifier: Apache-2.0

config BOARD_EK_RX74N
	select SOC_R5K574NCB4AE
```

## boards/renesas/ek_rx74n/board.yml
```yaml
board:
  name: ek_rx74n
  full_name: RX74N Evaluation Kit
  vendor: renesas
  socs:
    - name: r5k574ncb4ae
```

## boards/renesas/mck_ra8t1/Kconfig.defconfig
```kconfig
# Copyright (c) 2024 Renesas Electronics Corporation
# SPDX-License-Identifier: Apache-2.0

if BOARD_MCK_RA8T1

configdefault ETH_DRIVER
	default y

endif # BOARD_MCK_RA8T1
```

## boards/renesas/mck_ra8t2/Kconfig.defconfig
```kconfig
# Copyright (c) 2025 Renesas Electronics Corporation
# SPDX-License-Identifier: Apache-2.0

if BOARD_MCK_RA8T2

configdefault ETH_DRIVER
	default y

endif # BOARD_MCK_RA8T2
```

## boards/renesas/pb_rh850u2b_468pin/Kconfig.pb_rh850u2b_468pin
```kconfig
# Copyright (c) 2026 Renesas Electronics Corporation
# SPDX-License-Identifier: Apache-2.0

config BOARD_PB_RH850U2B_468PIN
	select SOC_R7F70254XAFABG_C if BOARD_PB_RH850U2B_468PIN_R7F70254XAFABG_C
```

## boards/renesas/pb_rh850u2b_468pin/pb_rh850u2b_468pin_r7f70254xafabg-c_defconfig
```kconfig
# Copyright (c) 2026 Renesas Electronics Corporation
# SPDX-License-Identifier: Apache-2.0

# Enable GPIO
CONFIG_GPIO=n

# Serial Drivers
CONFIG_SERIAL=y
CONFIG_UART_INTERRUPT_DRIVEN=y

# Enable Console
CONFIG_CONSOLE=y
CONFIG_UART_CONSOLE=y

# Enable Timer and Sys clock
CONFIG_TICKLESS_KERNEL=y
CONFIG_SYS_CLOCK_TICKS_PER_SEC=1000
```

## boards/renesas/rcar_salvator_x/rcar_salvator_x_r8a77951_r7_defconfig
```kconfig
CONFIG_CLOCK_CONTROL=y
CONFIG_CONSOLE=y
CONFIG_RAM_CONSOLE=y
CONFIG_FLASH_SIZE=0
CONFIG_FLASH_BASE_ADDRESS=0
CONFIG_GPIO=y
CONFIG_SERIAL=y
CONFIG_UART_CONSOLE=y
CONFIG_UART_INTERRUPT_DRIVEN=y
```

## boards/renode/cortex_r8_virtual/Kconfig.defconfig
```kconfig
#
# Copyright The Zephyr Project Contributors
#
# SPDX-License-Identifier: Apache-2.0
#

configdefault ISR_STACK_SIZE
	default 512
```

## boards/renode/cortex_r8_virtual/cortex_r8_virtual_cortex_r8_virtual_smp_defconfig
```kconfig
# Copyright (c) 2024 Antmicro <www.antmicro.com>
# SPDX-License-Identifier: Apache-2.0

CONFIG_THREAD_STACK_INFO=y

CONFIG_MAX_DOMAIN_PARTITIONS=24

# Enable UART driver
CONFIG_SERIAL=y

# Enable console
CONFIG_CONSOLE=y
CONFIG_UART_CONSOLE=y

CONFIG_SYS_CLOCK_TICKS_PER_SEC=1000
CONFIG_ARM_MPU=y

CONFIG_USE_SWITCH=y
CONFIG_SMP=y
CONFIG_MP_MAX_NUM_CPUS=2
```
