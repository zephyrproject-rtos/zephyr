## boards/realtek/rtl87x2g_evb_a/Kconfig.rtl87x2g_evb_a
```kconfig
# Copyright (c) 2026, Realtek Semiconductor Corporation
# SPDX-License-Identifier: Apache-2.0

config BOARD_RTL87X2G_EVB_A
	select SOC_RTL8762GKH if BOARD_RTL87X2G_EVB_A_RTL8762GKH
	select SOC_RTL8762GKU if BOARD_RTL87X2G_EVB_A_RTL8762GKU
	select SOC_RTL8762GRH if BOARD_RTL87X2G_EVB_A_RTL8762GRH
	select SOC_RTL8762GRU if BOARD_RTL87X2G_EVB_A_RTL8762GRU
```

## boards/realtek/rtl87x2g_evb_a/board.yml
```yaml
board:
  name: rtl87x2g_evb_a
  full_name: RTL87x2G Model A Evaluation Board
  vendor: realtek
  socs:
    - name: rtl8762gru
    - name: rtl8762grh
    - name: rtl8762gku
    - name: rtl8762gkh
```

## boards/realtek/rtl87x2g_evb_a/rtl87x2g_evb_a_rtl8762gku_defconfig
```kconfig
# Console Driver
CONFIG_CONSOLE=y
CONFIG_UART_CONSOLE=y

# UART Driver
CONFIG_SERIAL=y
CONFIG_UART_INTERRUPT_DRIVEN=y

# CAN Driver
CONFIG_CAN=y
CONFIG_CAN_FD_MODE=n

# Build a secure image by default
CONFIG_TRUSTED_EXECUTION_SECURE=y
CONFIG_ARM_SECURE_BUSFAULT_HARDFAULT_NMI=y
```

## boards/realtek/rtl87x2g_evb_a/rtl87x2g_evb_a_rtl8762gru_defconfig
```kconfig
# Console Driver
CONFIG_CONSOLE=y
CONFIG_UART_CONSOLE=y

# UART Driver
CONFIG_SERIAL=y
CONFIG_UART_INTERRUPT_DRIVEN=y

# Build a secure image by default
CONFIG_TRUSTED_EXECUTION_SECURE=y
CONFIG_ARM_SECURE_BUSFAULT_HARDFAULT_NMI=y
```

## boards/realtek/rts5817_maa_evb/Kconfig.rts5817_maa_evb
```kconfig
# Copyright (c) 2025 Realtek Semiconductor, Inc.
# SPDX-License-Identifier: Apache-2.0

config BOARD_RTS5817_MAA_EVB
	select SOC_RTS5817
```

## boards/realtek/rts5817_maa_evb/board.yml
```yaml
# Copyright (c) 2025 Realtek Semiconductor, Inc.
# SPDX-License-Identifier: Apache-2.0

board:
  name: rts5817_maa_evb
  full_name: RTS5817 MAA Evaluation Board
  vendor: realtek
  socs:
    - name: rts5817
```

## boards/realtek/rts5817_maa_evb/rts5817_maa_evb_defconfig
```kconfig
# Copyright (c) 2025 Realtek Semiconductor, Inc.
# SPDX-License-Identifier: Apache-2.0

# Enable clocks
CONFIG_CLOCK_CONTROL=y

# Enable reset
CONFIG_RESET=y

# Enable serial console
CONFIG_SERIAL=y
CONFIG_CONSOLE=y
CONFIG_UART_CONSOLE=y

# Enable watchdog
CONFIG_WATCHDOG=y
CONFIG_WDT_DISABLE_AT_BOOT=y

# Enable USB device
CONFIG_UDC_DRIVER=y
CONFIG_USB_DEVICE_STACK_NEXT=y
```

## boards/realtek/rts5912_evb/Kconfig.rts5912_evb
```kconfig
# SPDX-License-Identifier: Apache-2.0
#
# Copyright (c) 2024 Realtek Semiconductor Corporation, SIBG-SD7
#

config BOARD_RTS5912_EVB
	select SOC_RTS5912
```

## boards/realtek/rts5912_evb/board.yml
```yaml
board:
  name: rts5912_evb
  full_name: RTS5912 Evaluation Board
  vendor: realtek
  socs:
  - name: rts5912
```

## boards/realtek/rts5912_evb/rts5912_evb_defconfig
```kconfig
# SPDX-License-Identifier: Apache-2.0
#
# Copyright (c) 2024 Realtek Semiconductor Corporation, SIBG-SD7
#

# Enable RTS5912 image tool
CONFIG_REALTEK_RTS5912_BOOTROM_HEADER=y

# Serial Driver
CONFIG_SERIAL=y
CONFIG_UART_NS16550=y
CONFIG_UART_INTERRUPT_DRIVEN=y

# Console
CONFIG_CONSOLE=y
CONFIG_UART_CONSOLE=y

# Enable GPIO
CONFIG_GPIO=y

# Input Driver
CONFIG_INPUT=y

# Enable ADC
CONFIG_ADC=y
```

## boards/renesas/aik_ra8d1/Kconfig.aik_ra8d1
```kconfig
# Copyright (c) 2026 Renesas Electronics Corporation
# SPDX-License-Identifier: Apache-2.0

config BOARD_AIK_RA8D1
	select SOC_R7FA8D1BHECBD
```

## boards/renesas/aik_ra8d1/board.yml
```yaml
board:
  name: aik_ra8d1
  full_name: RA8D1 AI Kit Development Platform
  vendor: renesas
  socs:
  - name: r7fa8d1bhecbd
```

## boards/renesas/cpkcor_ra8d1b/Kconfig.cpkcor_ra8d1b
```kconfig
# Copyright (c) 2025 Jisheng Zhang <jszhang@kernel.org>
# SPDX-License-Identifier: Apache-2.0

config BOARD_CPKCOR_RA8D1B
	select SOC_R7FA8D1BHECBD
```

## boards/renesas/cpkcor_ra8d1b/board.yml
```yaml
board:
  name: cpkcor_ra8d1b
  full_name: CPKCOR RA8D1B board
  vendor: renesas
  socs:
  - name: r7fa8d1bhecbd
```

## boards/renesas/da14695_dk_usb/Kconfig.da14695_dk_usb
```kconfig
# DA14695 Development Kit USB board configuration

# Copyright (c) 2023 Renesas Electronics Corporation and/or its affiliates
# SPDX-License-Identifier: Apache-2.0

config BOARD_DA14695_DK_USB
	select SOC_DA14695
```

## boards/renesas/da14695_dk_usb/board.yml
```yaml
board:
  name: da14695_dk_usb
  full_name: DA14695 Development Kit USB
  vendor: renesas
  socs:
  - name: da14695
```

## boards/renesas/da14695_dk_usb/da14695_dk_usb_defconfig
```kconfig
#
# Copyright (c) 2023 Renesas Electronics Corporation and/or its affiliates
#
# SPDX-License-Identifier: Apache-2.0
#

CONFIG_HW_STACK_PROTECTION=y

CONFIG_GPIO=y

CONFIG_CONSOLE=y
CONFIG_UART_CONSOLE=y
CONFIG_SERIAL=y

CONFIG_BUILD_OUTPUT_HEX=n

CONFIG_ARM_MPU=y
```

## boards/renesas/da1469x_dk_pro/Kconfig.da1469x_dk_pro
```kconfig
# DA1469x series Development Kit Pro board configuration

# Copyright (c) 2022 Renesas Electronics Corporation
# SPDX-License-Identifier: Apache-2.0

config BOARD_DA1469X_DK_PRO
	select SOC_DA14699
```

## boards/renesas/da1469x_dk_pro/Kconfig.defconfig
```kconfig
# DA1469x series Development Kit Pro board configuration

# Copyright (c) 2024 Renesas Electronics Corporation
# SPDX-License-Identifier: Apache-2.0

if BOARD_DA1469X_DK_PRO

config I2C_CALLBACK
	default y if I2C_SMARTBOND

if LVGL

config LV_Z_BITS_PER_PIXEL
	default 16

# LCDC imposes display buffer's stride be word aligned
config LV_Z_AREA_X_ALIGNMENT_WIDTH
	default 2 if MIPI_DBI_SMARTBOND

config LV_Z_FLUSH_THREAD
	default y if DISPLAY_RENESAS_LCDC

# Use double buffering to avoid visual artifacts as long as
# the DMA is copying data into driver's frame buffer.
config LV_Z_DOUBLE_VDB
	default y if DISPLAY_RENESAS_LCDC

endif # LVGL

if INPUT

config INPUT_FT5336_INTERRUPT
	default y

config LV_Z_POINTER_INPUT_MSGQ_COUNT
	default 70

endif # INPUT

if PM || PM_DEVICE || PM_DEVICE_RUNTIME

# Increase stack size to avoid raising usage-fault
# exceptions due to stack overflow.
config IDLE_STACK_SIZE
	default 2048

# Make sure the serial device has higher
# initialization priority.
config SERIAL_INIT_PRIORITY
	default KERNEL_INIT_PRIORITY_DEFAULT

endif # PM || PM_DEVICE

if BT

config BT_WAIT_NOP
	default y

config TEST_RANDOM_GENERATOR
	default y

endif # BT

endif # BOARD_DA1469X_DK_PRO
```

## boards/renesas/da1469x_dk_pro/board.yml
```yaml
board:
  name: da1469x_dk_pro
  full_name: DA1469x Development Kit Pro
  vendor: renesas
  socs:
  - name: da14699
```

## boards/renesas/da1469x_dk_pro/da1469x_dk_pro_defconfig
```kconfig
# SPDX-License-Identifier: Apache-2.0

CONFIG_HW_STACK_PROTECTION=y

CONFIG_GPIO=y

CONFIG_CONSOLE=y
CONFIG_UART_CONSOLE=y
CONFIG_SERIAL=y

CONFIG_BUILD_OUTPUT_HEX=n

CONFIG_I2C=y
CONFIG_I2C_CALLBACK=y
```

## boards/renesas/ek_ra2a1/Kconfig.defconfig
```kconfig
# Copyright (c) 2025 Renesas Electronics Corporation
# SPDX-License-Identifier: Apache-2.0

if !INPUT_RENESAS_RA_QE_TOUCH_CFG

config INPUT_RENESAS_RA_CTSU_NUM_SELF_ELEMENTS
	default 1

endif # INPUT_RENESAS_RA_QE_TOUCH_CFG
```

## boards/renesas/ek_ra2a1/Kconfig.ek_ra2a1
```kconfig
# Copyright (c) 2024 TOKITA Hiroshi
# SPDX-License-Identifier: Apache-2.0

config BOARD_EK_RA2A1
	select SOC_R7FA2A1AB3CFM
```
