## boards/ezurio/veda_sl917_explorer/Kconfig.veda_sl917_explorer
```kconfig
# Copyright (c) 2026 Ezurio LLC
# SPDX-License-Identifier: Apache-2.0

config BOARD_VEDA_SL917_EXPLORER
	select SOC_SIWG917M111MGTBA

config SIWX917_PSRAM_PRESENT
	bool "Enable PSRAM support for SiWx917 SoC"
	default n
	select MEMC

if SIWX917_PSRAM_PRESENT

config CLOCK_CONTROL_INIT_PRIORITY
	int
	default 28

config MEMC_INIT_PRIORITY
	int
	default 29

endif
```

## boards/ezurio/veda_sl917_explorer/board.yml
```yaml
board:
  name: veda_sl917_explorer
  full_name: Veda SL917 Wi-Fi 6 and Bluetooth LE SoC Explorer Board
  vendor: ezurio
  socs:
    - name: siwg917m111mgtba
```

## boards/ezurio/veda_sl917_explorer/veda_sl917_explorer_defconfig
```kconfig
# Copyright (c) 2026 Ezurio
# SPDX-License-Identifier: Apache-2.0

CONFIG_USE_DT_CODE_PARTITION=y
CONFIG_CONSOLE=y
CONFIG_UART_CONSOLE=y
CONFIG_SERIAL=y
```

## boards/fanke/fk723m1_zgt6/Kconfig.defconfig
```kconfig
# FK723M1-ZGT6 board configuration
#
# Copyright The Zephyr Project Contributors
#
# SPDX-License-Identifier: Apache-2.0
#

if BOARD_FK723M1_ZGT6

config SDMMC_STM32_CLOCK_CHECK
	default n

endif # BOARD_FK723M1_ZGT6
```

## boards/fanke/fk723m1_zgt6/Kconfig.fk723m1_zgt6
```kconfig
# Copyright (c) 2025 Paul Wedeck <paulwedeck@gmail.com>
# SPDX-License-Identifier: Apache-2.0

config BOARD_FK723M1_ZGT6
	select SOC_STM32H723XX
```

## boards/fanke/fk723m1_zgt6/board.yml
```yaml
board:
  name: fk723m1_zgt6
  full_name: FK723M1-ZGT6
  vendor: fanke
  socs:
    - name: stm32h723xx
```

## boards/fanke/fk743m5_xih6/Kconfig.fk743m5_xih6
```kconfig
# Copyright (c) 2024 zack jiang, Honbo He <hehongbo918@gmail.com>
# SPDX-License-Identifier: Apache-2.0

config BOARD_FK743M5_XIH6
	select SOC_STM32H743XX
```

## boards/fanke/fk743m5_xih6/board.yml
```yaml
board:
  name: fk743m5_xih6
  full_name: FK743M5-XIH6
  vendor: fanke
  socs:
    - name: stm32h743xx
```

## boards/fanke/fk750m1_vbt6/Kconfig.fk750m1_vbt6
```kconfig
# Copyright (c) 2024 zack jiang <1125934312@qq.com>
# SPDX-License-Identifier: Apache-2.0

config BOARD_FK750M1_VBT6
	select SOC_STM32H750XX
```

## boards/fanke/fk750m1_vbt6/board.yml
```yaml
board:
  name: fk750m1_vbt6
  full_name: FK750M1-VBT6
  vendor: fanke
  socs:
    - name: stm32h750xx
```

## boards/fanke/fk750m1_vbt6/fk750m1_vbt6_defconfig
```kconfig
# Copyright (c) zack jiang <1125934312@qq.com>
# SPDX-License-Identifier: Apache-2.0

# Enable MPU
CONFIG_ARM_MPU=y

# Enable HW stack protection
CONFIG_HW_STACK_PROTECTION=y

# Enable UART
CONFIG_SERIAL=y

# Console
CONFIG_CONSOLE=y
CONFIG_UART_CONSOLE=y

# Enable GPIO
CONFIG_GPIO=y
```

## boards/fanke/fk7b0m1_vbt6/Kconfig.fk7b0m1_vbt6
```kconfig
# Copyright (c) 2023 Charles Dias <charlesdias.cd@outlook.com>
# SPDX-License-Identifier: Apache-2.0

config BOARD_FK7B0M1_VBT6
	select SOC_STM32H7B0XX
```

## boards/fanke/fk7b0m1_vbt6/board.yml
```yaml
board:
  name: fk7b0m1_vbt6
  full_name: FK7B0M1-VBT6
  vendor: fanke
  socs:
    - name: stm32h7b0xx
```

## boards/fanstel/fanstel_ev_bm15/Kconfig.defconfig
```kconfig
# Copyright (c) 2024 Nordic Semiconductor ASA
# SPDX-License-Identifier: Apache-2.0

config HW_STACK_PROTECTION
	default ARCH_HAS_STACK_PROTECTION

if BOARD_FANSTEL_EV_BM15_NRF54L15_CPUAPP_NS

config BOARD_FANSTEL_EV_BM15
	select USE_DT_CODE_PARTITION if BOARD_FANSTEL_EV_BM15_NRF54L15_CPUAPP_NS
config HAS_BT_CTLR
	default BT

# By default, if we build for a Non-Secure version of the board,
# enable building with TF-M as the Secure Execution Environment.
config BUILD_WITH_TFM
	default y

endif # BOARD_FANSTEL_EV_BM15_NRF54L15_CPUAPP_NS
```

## boards/fanstel/fanstel_ev_bm15/Kconfig.fanstel_ev_bm15
```kconfig
# SPDX-License-Identifier: Apache-2.0

config BOARD_FANSTEL_EV_BM15
	select SOC_NRF54L15_CPUAPP if BOARD_FANSTEL_EV_BM15_NRF54L15_CPUAPP || BOARD_FANSTEL_EV_BM15_NRF54L15_CPUAPP_NS
	select SOC_NRF54L15_CPUFLPR if BOARD_FANSTEL_EV_BM15_NRF54L15_CPUFLPR || \
				      BOARD_FANSTEL_EV_BM15_NRF54L15_CPUFLPR_XIP
```

## boards/fanstel/fanstel_ev_bm15/board.yml
```yaml
board:
  name: fanstel_ev_bm15
  full_name: Fanstel EV-BM15 Evaluation Board
  vendor: fanstel
  socs:
    - name: nrf54l15
      variants:
        - name: xip
          cpucluster: cpuflpr
        - name: ns
          cpucluster: cpuapp

runners:
  run_once:
    '--recover':
      - runners:
          - nrfjprog
          - nrfutil
        run: first
        groups:
          - boards:
              - fanstel_ev_bm15/nrf54l15/cpuapp
              - fanstel_ev_bm15/nrf54l15/cpuapp/ns
              - fanstel_ev_bm15/nrf54l15/cpuflpr
              - fanstel_ev_bm15/nrf54l15/cpuflpr/xip

    '--erase':
      - runners:
          - nrfjprog
          - jlink
          - nrfutil
        run: first
        groups:
          - boards:
              - fanstel_ev_bm15/nrf54l15/cpuapp
              - fanstel_ev_bm15/nrf54l15/cpuapp/ns
              - fanstel_ev_bm15/nrf54l15/cpuflpr
              - fanstel_ev_bm15/nrf54l15/cpuflpr/xip

    '--reset':
      - runners:
          - nrfjprog
          - jlink
          - nrfutil
        run: last
        groups:
          - boards:
              - fanstel_ev_bm15/nrf54l15/cpuapp
              - fanstel_ev_bm15/nrf54l15/cpuapp/ns
              - fanstel_ev_bm15/nrf54l15/cpuflpr
              - fanstel_ev_bm15/nrf54l15/cpuflpr/xip
```

## boards/firefly/roc_rk3568_pc/Kconfig.roc_rk3568_pc
```kconfig
# Copyright 2022 HNU-ESNL
# Copyright 2022 openEuler SIG-Zephyr
# SPDX-License-Identifier: Apache-2.0

config BOARD_ROC_RK3568_PC
	select SOC_RK3568
```

## boards/firefly/roc_rk3568_pc/board.yml
```yaml
board:
  name: roc_rk3568_pc
  full_name: ROC-RK3568-PC (Quad-core Cortex-A55)
  vendor: firefly
  socs:
  - name: rk3568
    variants:
    - name: smp
```

## boards/firefly/roc_rk3568_pc/roc_rk3568_pc_defconfig
```kconfig
# Copyright 2021 HNU-ESNL
# Copyright 2022 openEuler SIG-Zephyr
# SPDX-License-Identifier: Apache-2.0

# Platform Configuration
CONFIG_ARM_ARCH_TIMER=y

# Serial Drivers
CONFIG_SERIAL=y
CONFIG_UART_NS16550=y
CONFIG_UART_INTERRUPT_DRIVEN=y

# Enable console
CONFIG_CONSOLE=y
CONFIG_UART_CONSOLE=y

# ARMv8 NS world with cache management
CONFIG_ARMV8_A_NS=y
CONFIG_CACHE_MANAGEMENT=y

# Clock support
CONFIG_CLOCK_CONTROL=y
CONFIG_TICKLESS_KERNEL=y
```

## boards/firefly/roc_rk3568_pc/roc_rk3568_pc_rk3568_smp_defconfig
```kconfig
# Copyright 2022 HNU-ESNL
# Copyright 2022 openEuler SIG-Zephyr
# SPDX-License-Identifier: Apache-2.0

# Platform Configuration
CONFIG_ARM_ARCH_TIMER=y

# Serial Drivers
CONFIG_SERIAL=y
CONFIG_UART_NS16550=y
CONFIG_UART_INTERRUPT_DRIVEN=y

# Enable console
CONFIG_CONSOLE=y
CONFIG_UART_CONSOLE=y

# ARMv8 NS world with cache management
CONFIG_ARMV8_A_NS=y
CONFIG_CACHE_MANAGEMENT=y
CONFIG_DCACHE=y

# Clock support
CONFIG_CLOCK_CONTROL=y
CONFIG_TICKLESS_KERNEL=y

# SMP support
CONFIG_SMP=y
CONFIG_MP_MAX_NUM_CPUS=4
CONFIG_MAX_THREAD_BYTES=4

# PSCI support
CONFIG_PM_CPU_OPS=y
CONFIG_PM_CPU_OPS_PSCI=y
```

## boards/firefly/roc_rk3588/Kconfig.roc_rk3588
```kconfig
# Copyright The Zephyr Project Contributors
# SPDX-License-Identifier: Apache-2.0

config BOARD_ROC_RK3588
	select SOC_RK3588
```

## boards/firefly/roc_rk3588/board.yml
```yaml
board:
  name: roc_rk3588
  full_name: ROC-RK3588 (Quad-core Cortex-A55)
  vendor: firefly
  socs:
  - name: rk3588
    variants:
    - name: smp
```

## boards/firefly/roc_rk3588/roc_rk3588_defconfig
```kconfig
# Copyright The Zephyr Project Contributors
# SPDX-License-Identifier: Apache-2.0

# Platform Configuration
CONFIG_ARM_ARCH_TIMER=y

# Serial Drivers
CONFIG_SERIAL=y
CONFIG_UART_NS16550=y
CONFIG_UART_INTERRUPT_DRIVEN=y

# Enable console
CONFIG_CONSOLE=y
CONFIG_UART_CONSOLE=y

# ARMv8 NS world with cache management
CONFIG_ARMV8_A_NS=y
CONFIG_CACHE_MANAGEMENT=y

CONFIG_TICKLESS_KERNEL=y
```

## boards/firefly/roc_rk3588_pc/Kconfig.roc_rk3588_pc
```kconfig
# Copyright (c) 2025 Syswonder
# SPDX-License-Identifier: Apache-2.0

config BOARD_ROC_RK3588_PC
	select SOC_RK3588
```

## boards/firefly/roc_rk3588_pc/roc_rk3588_pc_defconfig
```kconfig
# Copyright (c) 2025 Syswonder
# SPDX-License-Identifier: Apache-2.0

# Platform Configuration
CONFIG_ARM_ARCH_TIMER=y

# Serial Drivers
CONFIG_SERIAL=y
CONFIG_UART_NS16550=y
CONFIG_UART_INTERRUPT_DRIVEN=y

# Enable console
CONFIG_CONSOLE=y
CONFIG_UART_CONSOLE=y

# ARMv8 NS world with cache management
CONFIG_ARMV8_A_NS=y
CONFIG_CACHE_MANAGEMENT=y

CONFIG_TICKLESS_KERNEL=y
```
