/*
 * Copyright (c) 2025 Nordic Semiconductor ASA
 * Copyright (c) 2025 Ezurio LLC
 *
 * SPDX-License-Identifier: Apache-2.0
 */

/dts-v1/;

#define USE_NON_SECURE_ADDRESS_MAP 1

#include <arm/nordic/nrf54l10_cpuapp_ns.dtsi>
#include "nrf54l_10_15_cpuapp_common.dtsi"

/ {
	compatible = "ezurio,bl54l15_dvk_nrf54l10-cpuapp";
	model = "Ezurio BL54L15 DVK nRF54L10 Application MCU";

	chosen {
		zephyr,code-partition = &slot0_ns_partition;
		zephyr,sram = &sram0_ns;
		zephyr,entropy = &psa_rng;
	};

	/delete-node/ rng;

	psa_rng: psa-rng {
		status = "okay";
	};
};

&uart30 {
	/* Disable so that TF-M can use this UART */
	status = "disabled";
};

/* Include default memory partition configuration file */
#include <vendor/nordic/nrf54l10_cpuapp_ns_partition.dtsi>
