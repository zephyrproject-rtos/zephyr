/*
 * Copyright (c) 2024 Nordic Semiconductor ASA
 * Copyright (c) 2025 Ezurio LLC
 *
 * SPDX-License-Identifier: Apache-2.0
 */

/dts-v1/;

#include <nordic/nrf54l10_cpuapp.dtsi>
#include "nrf54l_10_15_cpuapp_common.dtsi"

/ {
	compatible = "ezurio,bl54l15_dvk_nrf54l10-cpuapp";
	model = "Ezurio BL54L15 DVK nRF54L10 Application MCU";

	chosen {
		zephyr,code-partition = &slot0_partition;
		zephyr,sram = &cpuapp_sram;
	};
};

/* Include default memory partition configuration file */
#include <vendor/nordic/nrf54l10_cpuapp_partition.dtsi>
