.. SPDX-License-Identifier: Apache-2.0
..
.. Copyright (c) 2026 Ezurio LLC

Overview
********

The Lyra |Lyra variant| Development Kit provides support for the Ezurio Lyra |Lyra variant| Bluetooth Low Energy v5.3 module.

The module is based on the Silicon Laboratories |SoC| module and includes an EFR32BG22 Arm Cortex-M33 CPU.

The Lyra |Lyra variant| module incorporates the QFN package EFR32BG22 (512kB Flash, 32kB RAM). The part features
up to |Number of IO| configurable GPIOs and BLE Radio TX Power up to |BLE TX Power|.

The kit features a USB interface, an on-board SEGGER J-Link debugger, one user-LED and button, and
support for hardware add-on boards via a `mikroBUS`_ socket and a `Qwiic`_ connector.

.. note::
   You can find more information about the Lyra family of modules in the `Lyra product brief`_ and on the `Lyra website`_.

   You can find more information about the Lyra |Lyra variant| module in the |Datasheet Ref|.

   You can find more information about the underlying |SoC| module in the |SoC Datasheet Ref|.

   You can find more information about the underlying EFR32BG22 SoC in the `EFR32BG22 datasheet`_
   and `EFR32BG22 reference manual`_.
