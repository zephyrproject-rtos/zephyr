/*
 * Copyright The Zephyr Project Contributors
 * Copyright (c) 2026 Ezurio LLC
 *
 * SPDX-License-Identifier: Apache-2.0
 */

/dts-v1/;
#include <silabs/xg22/bgm220sc22hna.dtsi>
#include "lyra_dvk.dtsi"

/ {
	compatible = "ezurio,lyra_dvk_s", "silabs,efr32bg22";
	model = "Ezurio Lyra S DVK";

	buttons {
		compatible = "gpio-keys";

		button0: button_0 {
			gpios = <&gpioa 6 GPIO_ACTIVE_LOW>;
			zephyr,code = <INPUT_KEY_0>;
		};
	};
};
