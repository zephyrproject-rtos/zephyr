/*
 * Copyright The Zephyr Project Contributors
 * Copyright (c) 2026 Ezurio LLC
 *
 * SPDX-License-Identifier: Apache-2.0
 */

/dts-v1/;
#include <silabs/xg22/bgm220pc22hna.dtsi>
#include "lyra_dvk.dtsi"

/ {
	model = "Ezurio Lyra P DVK";
	compatible = "ezurio,lyra_dvk_p", "silabs,efr32bg22";

	buttons {
		compatible = "gpio-keys";

		button0: button_0 {
			gpios = <&gpioc 7 GPIO_ACTIVE_LOW>;
			zephyr,code = <INPUT_KEY_0>;
		};
	};
};
