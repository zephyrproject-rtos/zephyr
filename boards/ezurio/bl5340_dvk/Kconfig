## boards/ezurio/bl5340_dvk/Kconfig
```kconfig
# Copyright The Zephyr Project Contributors
# SPDX-License-Identifier: Apache-2.0

if BOARD_BL5340_DVK_NRF5340_CPUAPP || BOARD_BL5340_DVK_NRF5340_CPUAPP_NS

config HEAP_MEM_POOL_ADD_SIZE_BOARD
	int
	default 4096 if BT_HCI_IPC

endif # BOARD_BL5340_DVK_NRF5340_CPUAPP || BOARD_BL5340_DVK_NRF5340_CPUAPP_NS
```

## boards/ezurio/nitrogen93_smarc/Kconfig.nitrogen93_smarc
```kconfig
# SPDX-FileCopyrightText: Copyright 2025 NXP
# SPDX-FileCopyrightText: Copyright 2026 Ezurio
# SPDX-License-Identifier: Apache-2.0

config BOARD_NITROGEN93_SMARC
	select SOC_MIMX9352_A55
	select SOC_PART_NUMBER_MIMX9352DVVXM
```

## boards/ezurio/nitrogen93_smarc/board.yml
```yaml
# SPDX-FileCopyrightText: Copyright 2026 Ezurio
# SPDX-License-Identifier: Apache-2.0

board:
  name: nitrogen93_smarc
  full_name: Ezurio Nitrogen93 SMARC
  vendor: ezurio
  socs:
    - name: mimx9352
      variants:
        - name: smp
          cpucluster: a55
        - name: nx611
          cpucluster: a55
```

## boards/ezurio/nitrogen93_smarc/nitrogen93_smarc_mimx9352_a55_nx611_defconfig
```kconfig
# SPDX-FileCopyrightText: Copyright 2026 Ezurio
# SPDX-License-Identifier: Apache-2.0

# ARM Options
CONFIG_AARCH64_IMAGE_HEADER=y
CONFIG_ARMV8_A_NS=y

# MMU Options
CONFIG_MAX_XLAT_TABLES=64

# Cache Options
CONFIG_CACHE_MANAGEMENT=y

# Zephyr Kernel Configuration
CONFIG_XIP=n

# Serial Drivers
CONFIG_SERIAL=y
CONFIG_UART_INTERRUPT_DRIVEN=y

# Enable Console
CONFIG_CONSOLE=y
CONFIG_UART_CONSOLE=y

CONFIG_CLOCK_CONTROL=y

# CPU power operations (needed for SMP via PSCI)
CONFIG_PM_CPU_OPS=y
```

## boards/fastbit/fastbit_stm32_nano/Kconfig.fastbit_stm32_nano
```kconfig
# Copyright (c) 2026 Fastbit Embedded Technologies
# SPDX-License-Identifier: Apache-2.0

config BOARD_FASTBIT_STM32_NANO
	select SOC_STM32F303XC
```

## boards/fastbit/fastbit_stm32_nano/board.yml
```yaml
board:
  name: fastbit_stm32_nano
  full_name: Fastbit STM32 Nano
  vendor: fastbit
  socs:
    - name: stm32f303xc
```

## boards/firefly/roc_rk3588_pc/Kconfig.defconfig
```kconfig
# Copyright (c) 2025 Syswonder
# SPDX-License-Identifier: Apache-2.0

if BOARD_ROC_RK3588_PC_RK3588 || BOARD_ROC_RK3588_PC_RK3588_SMP

configdefault ETH_DRIVER
	default y

endif
```

## boards/firefly/roc_rk3588_pc/board.yml
```yaml
board:
  name: roc_rk3588_pc
  full_name: ROC-RK3588-PC
  vendor: firefly
  socs:
  - name: rk3588
    variants:
    - name: smp
```

## boards/flextechakt/flextechakt_t1susb/Kconfig.defconfig
```kconfig
# Copyright (c) 2026 Analog Devices, Inc.
# SPDX-License-Identifier: Apache-2.0

if BOARD_FLEXTECHAKT_T1SUSB

configdefault SPI_MAX32_DMA
	default y

configdefault NET_IF_MAX_IPV4_COUNT
	default 2

configdefault NET_IF_MAX_IPV6_COUNT
	default 2

configdefault ETH_DRIVER
	default y

endif # BOARD_FLEXTECHAKT_T1SUSB
```

## boards/flextechakt/flextechakt_t1susb/Kconfig.flextechakt_t1susb
```kconfig
# FlextechAKT T1SUSB board configuration

# Copyright (c) 2026 Analog Devices, Inc.
# SPDX-License-Identifier: Apache-2.0

config BOARD_FLEXTECHAKT_T1SUSB
	select SOC_MAX32690_M4 if BOARD_FLEXTECHAKT_T1SUSB_MAX32690_M4
```

## boards/flextechakt/flextechakt_t1susb/board.yml
```yaml
# Copyright (c) 2026 Analog Devices, Inc.
# SPDX-License-Identifier: Apache-2.0

board:
  name: flextechakt_t1susb
  full_name: FlextechAKT T1SUSB Development Board
  vendor: flextechakt
  socs:
    - name: max32690
```

## boards/flextechakt/flextechakt_t1susb/flextechakt_t1susb_max32690_m4_defconfig
```kconfig
# Copyright (c) 2026 Analog Devices, Inc.
# SPDX-License-Identifier: Apache-2.0

CONFIG_ARM_MPU=y
CONFIG_GPIO=y
CONFIG_CONSOLE=y
CONFIG_UART_CONSOLE=y
CONFIG_SERIAL=y
CONFIG_UART_INTERRUPT_DRIVEN=y
CONFIG_USE_DT_CODE_PARTITION=y
```

## boards/gaisler/generic_leon3/Kconfig.defconfig
```kconfig
# Copyright (c) 2019-2020 Cobham Gaisler AB
#
# SPDX-License-Identifier: Apache-2.0

if BOARD_GENERIC_LEON3

config SPARC_CASA
	default n

config UART_INTERRUPT_DRIVEN
	default y

endif
```

## boards/gd/gd32f527i_eval/Kconfig.gd32f527i_eval
```kconfig
# Copyright (c) 2026 GigaDevice Semiconductor Inc.
# SPDX-License-Identifier: Apache-2.0

config BOARD_GD32F527I_EVAL
	select SOC_GD32F527
```

## boards/hardkernel/odroid_go/Kconfig.defconfig
```kconfig
# ODROID-GO Game Kit configuration

# Copyright (c) 2019 Yannis Damigos
# SPDX-License-Identifier: Apache-2.0

if BOARD_ODROID_GO_ESP32_PROCPU

config SPI
	default y if DISK_DRIVER_SDMMC

config SOC_FAMILY_ESPRESSIF_SPIRAM
	default y if !MCUBOOT && !SOC_ESP32_USE_UNSUPPORTED_REVISION

endif # BOARD_ODROID_GO_ESP32_PROCPU
```

## boards/holyiot/yj16019/holyiot_yj16019_defconfig
```kconfig
# SPDX-License-Identifier: Apache-2.0

# Enable MPU
CONFIG_ARM_MPU=y

# Enable RTT
CONFIG_USE_SEGGER_RTT=y

# Enable GPIO
CONFIG_GPIO=y
```

## boards/hpmicro/hpm5300evk/Kconfig.defconfig
```kconfig
# Copyright (C) 2026 Cody Gu <gujiaqi@iscas.ac.cn>
# SPDX-License-Identifier: Apache-2.0

if BOARD_HPM5300EVK

config BUILD_OUTPUT_HEX
	default y if XIP

endif # BOARD_HPM5300EVK
```

## boards/hpmicro/hpm5300evk/Kconfig.hpm5300evk
```kconfig
# Copyright (C) 2026 Cody Gu <gujiaqi@iscas.ac.cn>
# SPDX-License-Identifier: Apache-2.0

config BOARD_HPM5300EVK
	bool
	select SOC_HPM5361
```

## boards/hpmicro/hpm5300evk/board.yml
```yaml
# Copyright (C) 2026 Cody Gu <gujiaqi@iscas.ac.cn>
# SPDX-License-Identifier: Apache-2.0

board:
  name: hpm5300evk
  full_name: HPMicro HPM5300EVK
  vendor: hpmicro
  socs:
    - name: hpm5361
```

## boards/hpmicro/hpm5300evk/hpm5300evk_defconfig
```kconfig
# Copyright (C) 2026 Cody Gu <gujiaqi@iscas.ac.cn>
# SPDX-License-Identifier: Apache-2.0

CONFIG_CONSOLE=y
CONFIG_SERIAL=y
CONFIG_UART_CONSOLE=y
CONFIG_GPIO=y
CONFIG_XIP=y
CONFIG_USE_DT_CODE_PARTITION=y
```

## boards/ie/nrf52840_stamp/Kconfig
```kconfig
# Copyright (c) 2026 Icy Electronics
# SPDX-License-Identifier: Apache-2.0

if BOARD_NRF52840_STAMP

config BOARD_HAS_NRF5_BOOTLOADER
	bool
	default y
	help
	  If selected, applications are linked so that they can be loaded by Nordic
	  nRF5 bootloader.

endif # BOARD_NRF52840_STAMP
```

## boards/ie/nrf52840_stamp/board.yml
```yaml
board:
  name: nrf52840_stamp
  full_name: nRF52840 Stamp
  vendor: ie
  socs:
  - name: nrf52840
    variants:
    - name: uf2
```
