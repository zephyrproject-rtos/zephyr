## boards/ezurio/bl5340_dvk/Kconfig.bl5340_dvk
```kconfig
# BL5340-DVK board configuration

# Copyright (c) 2021 Laird Connectivity
# SPDX-License-Identifier: Apache-2.0

config BOARD_BL5340_DVK
	select SOC_NRF5340_CPUAPP_QKAA if BOARD_BL5340_DVK_NRF5340_CPUAPP
	select SOC_NRF5340_CPUAPP_QKAA if BOARD_BL5340_DVK_NRF5340_CPUAPP_NS
	select SOC_NRF5340_CPUNET_QKAA if BOARD_BL5340_DVK_NRF5340_CPUNET
```

## boards/ezurio/bl5340_dvk/board.yml
```yaml
board:
  name: bl5340_dvk
  full_name: BL5340 DVK
  vendor: ezurio
  socs:
  - name: 'nrf5340'
    variants:
    - name: 'ns'
      cpucluster: 'cpuapp'
```

## boards/ezurio/bl54l15_dvk/Kconfig
```kconfig
# Copyright (c) 2026 Nordic Semiconductor ASA
# Copyright (c) 2026 Ezurio LLC
# SPDX-License-Identifier: Apache-2.0

config BOARD_BL54L15_DVK
	select SOC_NRF54L10_DEVELOP_IN_NRF54L15 if SOC_NRF54L10
```

## boards/ezurio/bl54l15_dvk/Kconfig.bl54l15_dvk
```kconfig
# Copyright (c) 2024 Nordic Semiconductor ASA
# Copyright (c) 2025 Ezurio LLC
# SPDX-License-Identifier: Apache-2.0

config BOARD_BL54L15_DVK
	select SOC_NRF54L10_CPUAPP if BOARD_BL54L15_DVK_NRF54L10_CPUAPP
	select SOC_NRF54L15_CPUAPP if BOARD_BL54L15_DVK_NRF54L15_CPUAPP
	select SOC_NRF54L15_CPUFLPR if BOARD_BL54L15_DVK_NRF54L15_CPUFLPR || \
					    BOARD_BL54L15_DVK_NRF54L15_CPUFLPR_XIP
```

## boards/ezurio/bl54l15_dvk/Kconfig.defconfig
```kconfig
# Copyright (c) 2024 Nordic Semiconductor ASA
# Copyright (c) 2025 Ezurio LLC
# SPDX-License-Identifier: Apache-2.0

if BOARD_BL54L15_DVK_NRF54L10_CPUAPP_NS || BOARD_BL54L15_DVK_NRF54L15_CPUAPP_NS

config BOARD_BL54L15_DVK
	select USE_DT_CODE_PARTITION

config HAS_BT_CTLR
	default BT

# By default, if we build for a Non-Secure version of the board,
# enable building with TF-M as the Secure Execution Environment.
config BUILD_WITH_TFM
	default y

endif # BOARD_BL54L15_DVK_NRF54L10_CPUAPP_NS || BOARD_BL54L15_DVK_NRF54L15_CPUAPP_NS
```

## boards/ezurio/bl54l15_dvk/bl54l15_dvk_nrf54l15_cpuflpr_defconfig
```kconfig
# Copyright (c) 2024 Nordic Semiconductor ASA
# Copyright (c) 2025 Ezurio LLC
# SPDX-License-Identifier: Apache-2.0

# Enable UART driver
CONFIG_SERIAL=y

# Enable console
CONFIG_CONSOLE=y
CONFIG_UART_CONSOLE=y

# Enable GPIO
CONFIG_GPIO=y

CONFIG_USE_DT_CODE_PARTITION=y

# Execute from SRAM
CONFIG_XIP=n
```

## boards/ezurio/bl54l15_dvk/board.yml
```yaml
board:
  name: bl54l15_dvk
  full_name: BL54L15 DVK
  vendor: ezurio
  socs:
  - name: nrf54l10
  - name: nrf54l15
    variants:
    - name: xip
      cpucluster: cpuflpr
```

## boards/ezurio/bl54l15u_dvk/Kconfig
```kconfig
# Copyright (c) 2025 Nordic Semiconductor ASA
# Copyright (c) 2025 Ezurio LLC
# SPDX-License-Identifier: Apache-2.0

# BL54L15U DVK board configuration

if BOARD_BL54L15U_DVK_NRF54L15_CPUAPP_NS

DT_NRF_MPC := $(dt_nodelabel_path,nrf_mpc)

config NRF_TRUSTZONE_FLASH_REGION_SIZE
	hex
	default $(dt_node_int_prop_hex,$(DT_NRF_MPC),override-granularity)
	help
	  This defines the flash region size from the TrustZone perspective.
	  It is used when configuring the TrustZone and when setting alignments
	  requirements for the partitions.
	  This abstraction allows us to configure TrustZone without depending
	  on peripheral-specific symbols.

config NRF_TRUSTZONE_RAM_REGION_SIZE
	hex
	default $(dt_node_int_prop_hex,$(DT_NRF_MPC),override-granularity)
	help
	  This defines the RAM region size from the TrustZone perspective.
	  It is used when configuring the TrustZone and when setting alignments
	  requirements for the partitions.
	  This abstraction allows us to configure TrustZone without depending
	  on peripheral specific symbols.

endif # BOARD_BL54L15U_DVK_NRF54L15_CPUAPP_NS
```

## boards/ezurio/bl54l15u_dvk/Kconfig.bl54l15u_dvk
```kconfig
# Copyright (c) 2024 Nordic Semiconductor ASA
# Copyright (c) 2025 Ezurio LLC
# SPDX-License-Identifier: Apache-2.0

config BOARD_BL54L15U_DVK
	select SOC_NRF54L15_CPUAPP if BOARD_BL54L15U_DVK_NRF54L15_CPUAPP || BOARD_BL54L15U_DVK_NRF54L15_CPUAPP_NS
	select SOC_NRF54L15_CPUFLPR if BOARD_BL54L15U_DVK_NRF54L15_CPUFLPR || \
					    BOARD_BL54L15U_DVK_NRF54L15_CPUFLPR_XIP
```

## boards/ezurio/bl54l15u_dvk/Kconfig.defconfig
```kconfig
# Copyright (c) 2024 Nordic Semiconductor ASA
# Copyright (c) 2025 Ezurio LLC
# SPDX-License-Identifier: Apache-2.0

# Workaround for not being able to have commas in macro arguments
DT_CHOSEN_Z_CODE_PARTITION := zephyr,code-partition
DT_CHOSEN_Z_SRAM_PARTITION := zephyr,sram-secure-partition

if BOARD_BL54L15U_DVK_NRF54L15_CPUAPP_NS

config HAS_BT_CTLR
	default BT

config FLASH_LOAD_OFFSET
	default $(dt_chosen_reg_addr_hex,$(DT_CHOSEN_Z_CODE_PARTITION))

config FLASH_LOAD_SIZE
	default $(dt_chosen_reg_size_hex,$(DT_CHOSEN_Z_CODE_PARTITION))

# By default, if we build for a Non-Secure version of the board,
# enable building with TF-M as the Secure Execution Environment.
config BUILD_WITH_TFM
	default y

endif # BOARD_BL54L15U_DVK_NRF54L15_CPUAPP_NS
```

## boards/ezurio/bl54l15u_dvk/board.yml
```yaml
board:
  name: bl54l15u_dvk
  full_name: BL54L15u DVK
  vendor: ezurio
  socs:
    - name: nrf54l15
      variants:
        - name: xip
          cpucluster: cpuflpr
        - name: ns
          cpucluster: cpuapp
runners:
  run_once:
    '--recover':
      - runners:
          - nrfjprog
          - nrfutil
        run: first
        groups:
          - boards:
              - bl54l15u_dvk/nrf54l15/cpuapp
              - bl54l15u_dvk/nrf54l15/cpuapp/ns
              - bl54l15u_dvk/nrf54l15/cpuflpr
              - bl54l15u_dvk/nrf54l15/cpuflpr/xip
    '--erase':
      - runners:
          - nrfjprog
          - jlink
          - nrfutil
        run: first
        groups:
          - boards:
              - bl54l15u_dvk/nrf54l15/cpuapp
              - bl54l15u_dvk/nrf54l15/cpuapp/ns
              - bl54l15u_dvk/nrf54l15/cpuflpr
              - bl54l15u_dvk/nrf54l15/cpuflpr/xip
    '--reset':
      - runners:
          - nrfjprog
          - jlink
          - nrfutil
        run: last
        groups:
          - boards:
              - bl54l15u_dvk/nrf54l15/cpuapp
              - bl54l15u_dvk/nrf54l15/cpuapp/ns
              - bl54l15u_dvk/nrf54l15/cpuflpr
              - bl54l15u_dvk/nrf54l15/cpuflpr/xip
```

## boards/ezurio/bl652_dvk/Kconfig.bl652_dvk
```kconfig
# BL652 DVK board configuration

# Copyright (c) 2019 Laird Connectivity
# SPDX-License-Identifier: Apache-2.0

config BOARD_BL652_DVK
	select SOC_NRF52832_QFAA
```

## boards/ezurio/bl652_dvk/Kconfig.defconfig
```kconfig
# BL652 DVK board configuration

# Copyright (c) 2019 Laird Connectivity
# SPDX-License-Identifier: Apache-2.0

if BOARD_BL652_DVK

if DAC

config I2C
	default y

endif # DAC

endif # BOARD_BL652_DVK
```

## boards/ezurio/bl653_dvk/Kconfig.bl653_dvk
```kconfig
# BL653 DVK board configuration

# Copyright (c) 2020 Laird Connectivity
# SPDX-License-Identifier: Apache-2.0

config BOARD_BL653_DVK
	select SOC_NRF52833_QIAA
```

## boards/ezurio/bl653_dvk/Kconfig.defconfig
```kconfig
# BL653 DVK board configuration

# Copyright (c) 2020 Laird Connectivity
# SPDX-License-Identifier: Apache-2.0

if BOARD_BL653_DVK

if DAC

config I2C
	default y

endif # DAC

endif # BOARD_BL653_DVK
```

## boards/ezurio/bl653_dvk/board.yml
```yaml
board:
  name: bl653_dvk
  full_name: BL653 DVK
  vendor: ezurio
  socs:
  - name: nrf52833
```

## boards/ezurio/bl654_dvk/Kconfig.bl654_dvk
```kconfig
# BL654 DVK board configuration

# Copyright (c) 2019 Laird Connectivity
# SPDX-License-Identifier: Apache-2.0

config BOARD_BL654_DVK
	select SOC_NRF52840_QIAA
```

## boards/ezurio/bl654_dvk/Kconfig.defconfig
```kconfig
# BL654 DVK board configuration

# Copyright (c) 2019 Laird Connectivity
# SPDX-License-Identifier: Apache-2.0

if BOARD_BL654_DVK

if DAC

config I2C
	default y

endif # DAC

endif # BOARD_BL654_DVK

if BOARD_BL654_DVK_NRF52840_PA

# Limit max power for FCC compliance with power amplifier
choice BT_CTLR_TX_PWR
	default BT_CTLR_TX_PWR_MINUS_4
endchoice

endif # BOARD_BL654_DVK_NRF52840_PA
```

## boards/ezurio/bl654_dvk/board.yml
```yaml
board:
  name: bl654_dvk
  full_name: BL654 DVK
  vendor: ezurio
  socs:
  - name: nrf52840
    variants:
    - name: pa
```

## boards/ezurio/bl654_sensor_board/Kconfig
```kconfig
# BL654 Sensor Board configuration

# Copyright (c) 2021 Laird Connectivity
# SPDX-License-Identifier: Apache-2.0

config BOARD_ENABLE_DCDC
	bool "DCDC mode"
	select SOC_DCDC_NRF52X
	default y
	depends on BOARD_BL654_SENSOR_BOARD
```

## boards/ezurio/bl654_sensor_board/board.yml
```yaml
board:
  name: bl654_sensor_board
  full_name: BL654 Sensor Board
  vendor: ezurio
  socs:
  - name: nrf52840
```

## boards/ezurio/bl654_usb/Kconfig
```kconfig
# BL654 USB board configuration

# Copyright (c) 2018-2023 Nordic Semiconductor ASA
# Copyright (c) 2025 Ezurio LLC
# SPDX-License-Identifier: Apache-2.0

config BOARD_BL654_USB
	select BOARD_EARLY_INIT_HOOK

config BOARD_HAS_NRF5_BOOTLOADER
	bool
	default y if !BOARD_BL654_USB_NRF52840_BARE
	help
	  If selected, applications are linked so that they can be loaded by Nordic
	  nRF5 bootloader.
```

## boards/ezurio/bl654_usb/Kconfig.bl654_usb
```kconfig
# BL654 USB adapter board configuration

# Copyright (c) 2018 Nordic Semiconductor ASA
# Copyright (c) 2021-2025 Ezurio LLC
# SPDX-License-Identifier: Apache-2.0

config BOARD_BL654_USB
	select SOC_NRF52840_QIAA
```
