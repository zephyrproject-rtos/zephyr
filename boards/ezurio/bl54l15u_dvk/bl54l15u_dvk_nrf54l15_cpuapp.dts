/*
 * Copyright (c) 2024 Nordic Semiconductor ASA
 * Copyright (c) 2025 Ezurio LLC
 *
 * SPDX-License-Identifier: Apache-2.0
 */

/dts-v1/;

#include <nordic/nrf54l15_cpuapp.dtsi>
#include "nrf54l15_cpuapp_common.dtsi"

/ {
	compatible = "ezurio,bl54l15u_dvk_nrf54l15-cpuapp";
	model = "Ezurio BL54L15u_DVK nRF54L15 Application MCU";

	chosen {
		zephyr,code-partition = &slot0_partition;
		zephyr,sram = &cpuapp_sram;
	};
};

/* Include default memory partition configuration file */
#include <nordic/nrf54l15_partition.dtsi>
