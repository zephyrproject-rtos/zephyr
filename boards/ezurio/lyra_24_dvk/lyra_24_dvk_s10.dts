/*
 * Copyright The Zephyr Project Contributors
 * Copyright (c) 2026 Ezurio LLC
 *
 * SPDX-License-Identifier: Apache-2.0
 */

/dts-v1/;
#include <silabs/xg24/bgm240sb22vna.dtsi>
#include "lyra_24_dvk.dtsi"

/ {
	model = "Ezurio Lyra 24 S10 DVK";
	compatible = "ezurio,lyra_24_dvk_s10", "silabs,efr32bg24";
};
