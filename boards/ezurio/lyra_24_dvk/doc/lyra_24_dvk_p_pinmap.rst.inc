.. SPDX-License-Identifier: Apache-2.0
..
.. Copyright (c) 2026 Ezurio LLC

+-------+-------------+-------------------------------------+-----------+
| Name  | Function    | Usage                               | Direction |
+=======+=============+=====================================+===========+
| PA0   | USART0_TX   | UART Console VCOM_TX                | O         |
+-------+-------------+-------------------------------------+-----------+
| PA1   | SWD_SWCLK   | JLink SWCLK                         | I         |
+-------+-------------+-------------------------------------+-----------+
| PA2   | SWD_SWDIO   | JLink SWDIO                         | I/O       |
+-------+-------------+-------------------------------------+-----------+
| PA3   | SWD_SWO     | JLink SWO                           | O         |
+-------+-------------+-------------------------------------+-----------+
| PA4   | USART0_RTS  | UART Console VCOM_RTS               | O         |
+-------+-------------+-------------------------------------+-----------+
| PA5   | USART0_CTS  | UART Console VCOM_CTS               | I         |
+-------+-------------+-------------------------------------+-----------+
| PA6   | GPIO        | Breakout Connector GPIO             | I/O       |
+-------+-------------+-------------------------------------+-----------+
| PA7   | USART0_RX   | UART Console VCOM_RX                | I         |
+-------+-------------+-------------------------------------+-----------+
| PA8   | GPIO        | LED 0                               | O         |
+-------+-------------+-------------------------------------+-----------+
| PB0   | GPIO        | mikroBUS AN                         | I         |
+-------+-------------+-------------------------------------+-----------+
| PB1   | EUSART0_TX  | mikroBUS TX                         | O         |
+-------+-------------+-------------------------------------+-----------+
| PB2   | EUSART0_RX  | mikroBUS RX                         | I         |
+-------+-------------+-------------------------------------+-----------+
| PB3   | GPIO        | mikroBUS INT                        | I         |
+-------+-------------+-------------------------------------+-----------+
| PB4   | GPIO        | mikroBUS PWM                        | O         |
+-------+-------------+-------------------------------------+-----------+
| PC0   | PTI_FRAME   | Packet Trace Interface FRAME        | O         |
+-------+-------------+-------------------------------------+-----------+
| PC1   | PTI_DATA    | Packet Trace Interface DATA         | O         |
+-------+-------------+-------------------------------------+-----------+
| PC2   | EUSART1_SCK | mikroBUS SCK                        | O         |
+-------+-------------+-------------------------------------+-----------+
| PC3   | GPIO        | mikroBUS CS                         | O         |
+-------+-------------+-------------------------------------+-----------+
| PC4   | EUSART1_TX  | mikroBUS MOSI                       | O         |
+-------+-------------+-------------------------------------+-----------+
| PC5   | EUSART1_RX  | mikroBUS MISO                       | I         |
+-------+-------------+-------------------------------------+-----------+
| PC6   | GPIO        | mikroBUS RST                        | O         |
+-------+-------------+-------------------------------------+-----------+
| PC7   | GPIO        | Button 0                            | I         |
+-------+-------------+-------------------------------------+-----------+
| PD0   | LFXO        | LFXO                                | N/A       |
+-------+-------------+-------------------------------------+-----------+
| PD1   | LFXO        | LFXO                                | N/A       |
+-------+-------------+-------------------------------------+-----------+
| PD2   | I2C0_SCL    | mikroBUS SCL / Qwiic SCL            | I/O       |
+-------+-------------+-------------------------------------+-----------+
| PD3   | I2C0_SDA    | mikroBUS SDA / Qwiic SDA            | I/O       |
+-------+-------------+-------------------------------------+-----------+
