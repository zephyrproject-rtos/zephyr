## boards/ezurio/bl654_usb/Kconfig.defconfig
```kconfig
# BL654 USB adapter board configuration

# Copyright (c) 2018-2023 Nordic Semiconductor ASA
# Copyright (c) 2021-2025 Ezurio LLC
# SPDX-License-Identifier: Apache-2.0

if BOARD_BL654_USB

config HW_STACK_PROTECTION
	default ARCH_HAS_STACK_PROTECTION

# To let the nRF5 bootloader load an application, the application
# must be linked after Nordic MBR, that is factory-programmed on the board.

# If the application wants to use the full partition size, a "bare" board
# variant should be used instead.

# Nordic nRF5 bootloader exists outside of the partitions specified in the
# DTS file, so we manually override FLASH_LOAD_OFFSET to link the application
# correctly, after Nordic MBR, and limit the maximum size to not protrude into
# the bootloader at the end of flash.

# When building MCUBoot, MCUBoot itself will select USE_DT_CODE_PARTITION
# which will make it link into the correct partition specified in DTS file,
# the offset is applied here so that the full partition size can be used when
# the bootloader Kconfig option has been disabled.

config FLASH_LOAD_OFFSET
	default 0x1000
	depends on BOARD_HAS_NRF5_BOOTLOADER && !USE_DT_CODE_PARTITION

config FLASH_LOAD_SIZE
	default 0xdf000
	depends on !USE_DT_CODE_PARTITION

source "boards/common/usb/Kconfig.cdc_acm_serial.defconfig"

endif # BOARD_BL654_USB
```

## boards/ezurio/bl654_usb/bl654_usb_nrf52840_bare_defconfig
```kconfig
# SPDX-License-Identifier: Apache-2.0

# Enable MPU
CONFIG_ARM_MPU=y

# Enable hardware stack protection
CONFIG_HW_STACK_PROTECTION=y

# Enable GPIO
CONFIG_GPIO=y

# 32KHz clock source
CONFIG_CLOCK_CONTROL_NRF_K32SRC_XTAL=y
CONFIG_CLOCK_CONTROL_NRF_K32SRC_150PPM=y

# Board Kconfig.defconfig enables USB CDC ACM and should disable USB remote
# wakeup by default. It needs to be disabled here, because the USB nrfx
# driver always overwrites option from Kconfig mentioned above with the
# imply from CONFIG_USB_NRFX.
CONFIG_USB_DEVICE_REMOTE_WAKEUP=n
```

## boards/ezurio/bl654_usb/board.yml
```yaml
board:
  name: bl654_usb
  full_name: BL654 USB (451-00004)
  vendor: ezurio
  socs:
  - name: nrf52840
    variants:
    - name: bare
```

## boards/ezurio/bt510/board.yml
```yaml
board:
  name: bt510
  full_name: Sentrius BT510 Sensor
  vendor: ezurio
  socs:
  - name: nrf52840
```

## boards/ezurio/bt610/Kconfig.bt610
```kconfig
# BT610 board configuration

# Copyright (c) 2021 Laird Connectivity
# SPDX-License-Identifier: Apache-2.0

config BOARD_BT610
	select SOC_NRF52840_QIAA
```

## boards/ezurio/bt610/Kconfig.defconfig
```kconfig
# BT6X0 Sensor configuration

# Copyright (c) 2021 Laird Connectivity
# SPDX-License-Identifier: Apache-2.0

if BOARD_BT610

config I2C
	default $(dt_compat_on_bus,$(DT_COMPAT_TI_TCA9538),i2c)

endif # BOARD_BT610
```

## boards/ezurio/bt610/board.yml
```yaml
board:
  name: bt610
  full_name: Sentrius BT610 Sensor
  vendor: ezurio
  socs:
  - name: nrf52840
```

## boards/ezurio/lyra_24_dvk/Kconfig.defconfig
```kconfig
# Copyright (c) 2021, Sateesh Kotapati
# Copyright (c) 2026 Ezurio LLC
# SPDX-License-Identifier: Apache-2.0

if BOARD_LYRA_24_DVK_P10 || BOARD_LYRA_24_DVK_P20 || BOARD_LYRA_24_DVK_P20RF || BOARD_LYRA_24_DVK_S10

config REGULATOR
	default y

config LOG_BACKEND_SWO_FREQ_HZ
	default 875000
	depends on LOG_BACKEND_SWO

config FPU
	default y if SOC_GECKO_USE_RAIL || BT

if BT

config MAIN_STACK_SIZE
	default 3072 if PM
	default 2304

endif # BT

endif # BOARD_LYRA_24_DVK_P10 || BOARD_LYRA_24_DVK_P20 || BOARD_LYRA_24_DVK_P20RF || BOARD_LYRA_24_DVK_S10
```

## boards/ezurio/lyra_24_dvk/Kconfig.lyra_24_dvk_p10
```kconfig
# Copyright (c) 2021, Sateesh Kotapati
# Copyright (c) 2026 Ezurio LLC
# SPDX-License-Identifier: Apache-2.0

config BOARD_LYRA_24_DVK_P10
	select SOC_BGM240PB22VNA
```

## boards/ezurio/lyra_24_dvk/Kconfig.lyra_24_dvk_p20rf
```kconfig
# Copyright (c) 2021, Sateesh Kotapati
# Copyright (c) 2026 Ezurio LLC
# SPDX-License-Identifier: Apache-2.0

config BOARD_LYRA_24_DVK_P20RF
	select SOC_BGM240PB32VNN
```

## boards/ezurio/lyra_24_dvk/Kconfig.lyra_24_dvk_s10
```kconfig
# Copyright (c) 2021, Sateesh Kotapati
# Copyright (c) 2026 Ezurio LLC
# SPDX-License-Identifier: Apache-2.0

config BOARD_LYRA_24_DVK_S10
	select SOC_BGM240SB22VNA
```

## boards/ezurio/lyra_24_dvk/board.yml
```yaml
boards:
  - name: lyra_24_dvk_p10
    vendor: ezurio
    full_name: Lyra 24 P10 DVK
    socs:
      - name: bgm240pb22vna
  - name: lyra_24_dvk_p20
    vendor: ezurio
    full_name: Lyra 24 P20 DVK
    socs:
      - name: bgm240pb32vna
  - name: lyra_24_dvk_p20rf
    vendor: ezurio
    full_name: Lyra 24 P20RF DVK
    socs:
      - name: bgm240pb32vnn
  - name: lyra_24_dvk_s10
    vendor: ezurio
    full_name: Lyra 24 S10 DVK
    socs:
      - name: bgm240sb22vna
```

## boards/ezurio/lyra_24_dvk/lyra_24_dvk_p20rf_defconfig
```kconfig
# Copyright (c) 2022 Silicon Labs
# Copyright (c) 2026 Ezurio LLC
# SPDX-License-Identifier: Apache-2.0

CONFIG_ARM_MPU=y
CONFIG_CONSOLE=y
CONFIG_UART_CONSOLE=y
CONFIG_SERIAL=y
CONFIG_GPIO=y
CONFIG_HW_STACK_PROTECTION=y
CONFIG_REGULATOR=y
```

## boards/ezurio/lyra_dvk/Kconfig.defconfig
```kconfig
# Copyright The Zephyr Project Contributors
# Copyright (c) 2026 Ezurio LLC
# SPDX-License-Identifier: Apache-2.0

if BOARD_LYRA_DVK_P || BOARD_LYRA_DVK_S

config LOG_BACKEND_SWO_FREQ_HZ
	default 875000
	depends on LOG_BACKEND_SWO

config FPU
	default y if SOC_GECKO_USE_RAIL || BT

if BT

config MAIN_STACK_SIZE
	default 3072 if PM
	default 2304

endif # BT

endif
```

## boards/ezurio/lyra_dvk/Kconfig.lyra_dvk_p
```kconfig
# Copyright The Zephyr Project Contributors
# Copyright (c) 2026 Ezurio LLC
# SPDX-License-Identifier: Apache-2.0

config BOARD_LYRA_DVK_P
	select SOC_BGM220PC22HNA
```

## boards/ezurio/lyra_dvk/Kconfig.lyra_dvk_s
```kconfig
# Copyright The Zephyr Project Contributors
# Copyright (c) 2026 Ezurio LLC
# SPDX-License-Identifier: Apache-2.0

config BOARD_LYRA_DVK_S
	select SOC_BGM220SC22HNA
```

## boards/ezurio/lyra_dvk/board.yml
```yaml
boards:
  - name: lyra_dvk_p
    full_name: Lyra P DVK
    vendor: ezurio
    socs:
      - name: bgm220pc22hna
  - name: lyra_dvk_s
    full_name: Lyra S DVK
    vendor: ezurio
    socs:
      - name: bgm220sc22hna
```

## boards/ezurio/mg100/Kconfig.defconfig
```kconfig
# Copyright (c) 2022 Laird Connectivity
# SPDX-License-Identifier: Apache-2.0

if BOARD_MG100

config MODEM
	default NETWORKING

config MODEM_HL7800
	default NETWORKING

config NORDIC_QSPI_NOR_FLASH_LAYOUT_PAGE_SIZE
	default 4096

config REGULATOR
	default DISK_DRIVER_SDMMC

endif # BOARD_MG100
```

## boards/ezurio/mg100/board.yml
```yaml
board:
  name: mg100
  full_name: Sentrius™ MG100 Gateway
  vendor: ezurio
  socs:
  - name: nrf52840
```

## boards/ezurio/pinnacle_100_dvk/Kconfig.defconfig
```kconfig
# Pinnacle(TM) 100 DVK board configuration

# Copyright (c) 2019 Laird Connectivity
# SPDX-License-Identifier: Apache-2.0

if BOARD_PINNACLE_100_DVK

config MODEM
	default NETWORKING

config MODEM_HL7800
	default NETWORKING

config NORDIC_QSPI_NOR_FLASH_LAYOUT_PAGE_SIZE
	default 4096

config BT_CTLR
	default BT

endif # BOARD_PINNACLE_100_DVK
```

## boards/ezurio/pinnacle_100_dvk/board.yml
```yaml
board:
  name: pinnacle_100_dvk
  full_name: Pinnacle 100 DVK
  vendor: ezurio
  socs:
  - name: nrf52840
```

## boards/ezurio/rm126x_dvk/Kconfig.defconfig
```kconfig
# Copyright The Zephyr Project Contributors
# Copyright (c) 2026 Ezurio LLC
# SPDX-License-Identifier: Apache-2.0

if BOARD_RM126X_DVK_RM1261 || BOARD_RM126X_DVK_RM1262

config LOG_BACKEND_SWO_FREQ_HZ
	default 875000
	depends on LOG_BACKEND_SWO

config FPU
	default y

endif
```

## boards/ezurio/rm126x_dvk/Kconfig.rm126x_dvk_rm1261
```kconfig
# Copyright The Zephyr Project Contributors
# Copyright (c) 2026 Ezurio LLC
# SPDX-License-Identifier: Apache-2.0

config BOARD_RM126X_DVK_RM1261
	select SOC_EFR32BG22C224F512IM40
```

## boards/ezurio/rm126x_dvk/board.yml
```yaml
boards:
  - name: rm126x_dvk_rm1261
    full_name: RM1261 DVK
    vendor: ezurio
    socs:
      - name: efr32bg22c224f512im40
  - name: rm126x_dvk_rm1262
    full_name: RM1262 DVK
    vendor: ezurio
    socs:
      - name: efr32bg22c224f512im40
```

## boards/ezurio/rm1xx_dvk/board.yml
```yaml
board:
  name: rm1xx_dvk
  full_name: RM1xx DVK
  vendor: ezurio
  socs:
  - name: nrf51822
```
