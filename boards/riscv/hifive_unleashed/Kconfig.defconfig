## boards/riscv/hifive_unleashed/Kconfig.defconfig
```kconfig
# Copyright (c) 2021 Katsuhiro Suzuki
# SPDX-License-Identifier: Apache-2.0

config SYS_CLOCK_TICKS_PER_SEC
	default 1000

config SYS_CLOCK_HW_CYCLES_PER_SEC
	default 1000000
```

## boards/riscv/hifive_unleashed/hifive_unleashed_defconfig
```kconfig
CONFIG_SOC_SERIES_RISCV_SIFIVE_FREEDOM=y
CONFIG_SOC_RISCV_SIFIVE_FU540=y
CONFIG_BOARD_HIFIVE_UNLEASHED=y
CONFIG_CONSOLE=y
CONFIG_GPIO=y
CONFIG_SERIAL=y
CONFIG_UART_SIFIVE_PORT_0=y
CONFIG_UART_CONSOLE=y
CONFIG_XIP=n
```

## boards/riscv/hifive_unmatched/Kconfig.board
```kconfig
# Copyright (c) 2021 Katsuhiro Suzuki
# SPDX-License-Identifier: Apache-2.0

config BOARD_HIFIVE_UNMATCHED
	bool "HiFive Unmatched target"
	depends on SOC_RISCV_SIFIVE_FU740
```

## boards/riscv/hifive_unmatched/Kconfig.hifive_unmatched
```kconfig
# Copyright (c) 2022 Zephyr Project members and individual contributors
# SPDX-License-Identifier: Apache-2.0

config BOARD_HIFIVE_UNMATCHED
	bool
	default y
	select SOC_SERIES_RISCV_SIFIVE_FREEDOM
	select SOC_RISCV_SIFIVE_FU740
```

## boards/riscv/hifive_unmatched/hifive_unmatched_defconfig
```kconfig
CONFIG_SOC_SERIES_RISCV_SIFIVE_FREEDOM=y
CONFIG_SOC_RISCV_SIFIVE_FU740=y
CONFIG_BOARD_HIFIVE_UNMATCHED=y
CONFIG_CONSOLE=y
CONFIG_SERIAL=y
CONFIG_UART_SIFIVE_PORT_0=y
CONFIG_UART_CONSOLE=y
CONFIG_XIP=n
```

## boards/riscv/hihope_wifi_iot/Kconfig.board
```kconfig
# Copyright (c) 2023 Chen Xingyu <hi@xingrz.me>
# SPDX-License-Identifier: Apache-2.0

config BOARD_HIHOPE_WIFI_IOT
	bool "HiHope WiFi-IoT"
	depends on SOC_HI3861V100
```

## boards/riscv/hihope_wifi_iot/Kconfig.defconfig
```kconfig
# Copyright (c) 2023 Chen Xingyu <hi@xingrz.me>
# SPDX-License-Identifier: Apache-2.0

if BOARD_HIHOPE_WIFI_IOT

config BOARD
	default "hihope_wifi_iot"

endif # BOARD_HIHOPE_WIFI_IOT
```

## boards/riscv/hihope_wifi_iot/hihope_wifi_iot_defconfig
```kconfig
# Copyright (c) 2023 Chen Xingyu <hi@xingrz.me>
# SPDX-License-Identifier: Apache-2.0

CONFIG_SOC_SERIES_HI3861=y
CONFIG_SOC_HI3861V100=y
CONFIG_BOARD_HIHOPE_WIFI_IOT=y
CONFIG_PINCTRL=y
CONFIG_GPIO=y
CONFIG_SERIAL=y
CONFIG_CONSOLE=y
CONFIG_UART_CONSOLE=y
```

## boards/riscv/hpm6750evkmini/Kconfig.board
```kconfig
# Copyright (c) 2022 HPMicro
# SPDX-License-Identifier: Apache-2.0

config BOARD_HPM6750EVKMINI
	bool "HPMicro HPM6750EVKMINI"
	depends on SOC_SERIES_ANDES_HPMICRO
	depends on SOC_HPM675X
	select CPU_HAS_FPU_DOUBLE_PRECISION
```

## boards/riscv/hpm6750evkmini/Kconfig.defconfig
```kconfig
# Copyright (c) 2022 HPMicro
# SPDX-License-Identifier: Apache-2.0

if BOARD_HPM6750EVKMINI

DT_CHOSEN_Z_CODE_PARTITION := zephyr,code-partition

config BOARD
	default "hpm6750evkmini"

config FLASH_LOAD_OFFSET
	default $(dt_chosen_reg_addr_hex,$(DT_CHOSEN_Z_CODE_PARTITION))

config FLASH_LOAD_SIZE
	default $(dt_chosen_reg_size_hex,$(DT_CHOSEN_Z_CODE_PARTITION))

endif # BOARD_HPM6750EVKMINI
```

## boards/riscv/hpm6750evkmini/hpm6750evkmini_defconfig
```kconfig
CONFIG_SOC_SERIES_ANDES_HPMICRO=y
CONFIG_SOC_SERIES_HPM67XX_64XX=y
CONFIG_SOC_HPM675X=y
CONFIG_BOARD_HPM6750EVKMINI=y
CONFIG_XIP=n
CONFIG_PLIC=y
CONFIG_RISCV_MACHINE_TIMER=y
CONFIG_CONSOLE=y
CONFIG_UART_CONSOLE=y
CONFIG_PINCTRL=y
CONFIG_BUILD_OUTPUT_HEX=y
CONFIG_CLOCK_CONTROL=y

# Serial driver options
CONFIG_SERIAL=y
CONFIG_UART_INTERRUPT_DRIVEN=y

# GPIO driver options
CONFIG_GPIO=y

# HW DSP options
#CONFIG_SOC_ANDES_V5_HWDSP=y

# not support hardware info
CONFIG_HWINFO_ANDES=n
```

## boards/riscv/icev_wireless/Kconfig.defconfig
```kconfig
# Copyright (c) 2022 Friedt Professional Engineering Services, Inc
# SPDX-License-Identifier: Apache-2.0

config BOARD
	default "icev_wireless"
	depends on BOARD_ICEV_WIRELESS

config HEAP_MEM_POOL_SIZE
	default 98304 if WIFI
	default 40960 if BT
	default 4096

choice BT_HCI_BUS_TYPE
	default BT_ESP32 if BT
endchoice
```

## boards/riscv/icev_wireless/Kconfig.icev_wireless
```kconfig
# Copyright (c) 2022 Zephyr Project members and individual contributors
# SPDX-License-Identifier: Apache-2.0

config BOARD_ICEV_WIRELESS
	bool
	default y
	select SOC_ESP32C3
```

## boards/riscv/icev_wireless/icev_wireless_defconfig
```kconfig
# SPDX-License-Identifier: Apache-2.0

CONFIG_BOARD_ICEV_WIRELESS=y
CONFIG_SOC_ESP32C3=y
CONFIG_MAIN_STACK_SIZE=2048
CONFIG_SYS_CLOCK_TICKS_PER_SEC=1000
CONFIG_CONSOLE=y
CONFIG_SERIAL=y
CONFIG_UART_CONSOLE=y
CONFIG_GPIO=y
CONFIG_CLOCK_CONTROL=y
```

## boards/riscv/it82xx2_evb/Kconfig.defconfig
```kconfig
# Copyright (c) 2023 ITE Corporation. All Rights Reserved.
# SPDX-License-Identifier: Apache-2.0

if BOARD_IT82XX2_EVB

config BOARD
	default "it82xx2_evb"
endif
```

## boards/riscv/it82xx2_evb/it82xx2_evb_defconfig
```kconfig
# Copyright (c) 2023 ITE Corporation. All Rights Reserved.
# SPDX-License-Identifier: Apache-2.0

CONFIG_SOC_SERIES_RISCV32_IT8XXX2=y
CONFIG_SOC_IT8XXX2=y
CONFIG_SOC_IT82202_AX=y
CONFIG_BOARD_IT82XX2_EVB=y

CONFIG_GEN_IRQ_VECTOR_TABLE=n

# General Kernel Options
CONFIG_SYS_CLOCK_HW_CYCLES_PER_SEC=32768
CONFIG_XIP=y
CONFIG_INIT_STACKS=y

# UART Driver
CONFIG_SERIAL=y
CONFIG_UART_INTERRUPT_DRIVEN=y

# Console Driver
CONFIG_CONSOLE=y
CONFIG_UART_CONSOLE=y

# GPIO Driver
CONFIG_GPIO=y

# Power Management
CONFIG_PM=y
CONFIG_PM_DEVICE=y
CONFIG_PM_POLICY_CUSTOM=y
```

## boards/riscv/it8xxx2_evb/Kconfig.board
```kconfig
# Copyright (c) 2020 ITE Corporation. All Rights Reserved.
# SPDX-License-Identifier: Apache-2.0

config BOARD_IT8XXX2_EVB
	bool "IT8XXX2 EV-board"
	depends on SOC_IT8XXX2
```

## boards/riscv/it8xxx2_evb/Kconfig.defconfig
```kconfig
# Copyright (c) 2020 ITE Corporation. All Rights Reserved.
# SPDX-License-Identifier: Apache-2.0

if BOARD_IT8XXX2_EVB

config BOARD
	default "it8xxx2_evb"
endif
```

## boards/riscv/it8xxx2_evb/Kconfig.it8xxx2_evb
```kconfig
# Copyright (c) 2022 Zephyr Project members and individual contributors
# SPDX-License-Identifier: Apache-2.0

config BOARD_IT8XXX2_EVB
	bool
	default y
	select SOC_SERIES_RISCV32_IT8XXX2
	select SOC_IT8XXX2
```

## boards/riscv/it8xxx2_evb/it8xxx2_evb_defconfig
```kconfig
# Copyright (c) 2020 ITE Corporation. All Rights Reserved.
# SPDX-License-Identifier: Apache-2.0

CONFIG_SOC_SERIES_RISCV32_IT8XXX2=y
CONFIG_SOC_IT8XXX2=y
CONFIG_BOARD_IT8XXX2_EVB=y
CONFIG_BOOT_DELAY=1

CONFIG_GEN_IRQ_VECTOR_TABLE=n
CONFIG_CONSOLE=y
CONFIG_SERIAL=y
CONFIG_UART_INTERRUPT_DRIVEN=y
CONFIG_UART_CONSOLE=y

CONFIG_SYS_CLOCK_HW_CYCLES_PER_SEC=32768

CONFIG_XIP=y
CONFIG_INIT_STACKS=y
CONFIG_LINKER_ORPHAN_SECTION_PLACE=y
CONFIG_COMPILER_OPT="-mcmodel=medlow"
CONFIG_GPIO=y
# Power Management
CONFIG_PM=y
CONFIG_PM_DEVICE=y
CONFIG_PM_POLICY_CUSTOM=y
```

## boards/riscv/lichee_tang/Kconfig.board
```kconfig
# Copyright (c) 2021 TOKITA Hiroshi
# SPDX-License-Identifier: Apache-2.0

config BOARD_LICHEE_TANG
	bool "Sipeed Lichee Tang target"
```

## boards/riscv/lichee_tang/Kconfig.defconfig
```kconfig
# Sipeed Lichee Tang Development Board Configuration

# Copyright (c) 2021 TOKITA Hiroshi
# SPDX-License-Identifier: Apache-2.0

if BOARD_LICHEE_TANG

config BOARD
	default "lichee_tang"

endif
```

## boards/riscv/lichee_tang/lichee_tang_defconfig
```kconfig
# Sipeed Lichee Tang Development Board Configuration
#
# Copyright (c) 2021 TOKITA Hiroshi
#
# SPDX-License-Identifier: Apache-2.0
#

CONFIG_SOC_SERIES_HUMMINGBIRD=y
CONFIG_SOC_HUMMINGBIRD=y
CONFIG_RISCV_MACHINE_TIMER=y
```

## boards/riscv/litex_vexriscv/Kconfig.board
```kconfig
# Board with LiteX/VexRiscV CPU

# Copyright (c) 2018 - 2019 Antmicro <www.antmicro.com>
# SPDX-License-Identifier: Apache-2.0

config BOARD_LITEX_VEXRISCV
	def_bool "$(BOARD)" = "litex_vexriscv"
	depends on SOC_RISCV32_LITEX_VEXRISCV
```

## boards/riscv/litex_vexriscv/Kconfig.defconfig
```kconfig
# Copyright (c) 2018 - 2019 Antmicro <www.antmicro.com>
# SPDX-License-Identifier: Apache-2.0

if NETWORKING

config NET_L2_ETHERNET
	default y

endif # NETWORKING
```
