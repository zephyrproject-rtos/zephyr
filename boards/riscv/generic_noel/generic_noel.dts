/*
 * Copyright (c) 2020 Cobham Gaisler AB
 *
 * SPDX-License-Identifier: Apache-2.0
 */

/dts-v1/;

#include <noel.dtsi>

/ {
	chosen {
		zephyr,console = &uart0;
		zephyr,sram = &ram0;
	};
};

&ram0 {
	reg = <0x00000000 0x00400000>;
};

&uart0 {
	interrupts = <1 1>;
	status = "okay";
};
