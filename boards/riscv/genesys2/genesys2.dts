/* Copyright (c) 2019 SiFive, Inc. */
/* SPDX-License-Identifier: Apache-2.0 */

/dts-v1/;

#include <rv64_ariane.dtsi>

/ {
	model = "Recogni Genesys2 FPGA";
	//compatible = "sifive,hifive1-revb";

	chosen {
		zephyr,console = &uart0;
		zephyr,shell-uart = &uart0;
        /***
		zephyr,sram = &dtim;
		zephyr,flash = &flash0;
        ***/
	};

};

&xlnx_gpio0 {
	status = "okay";
};

&uart0 {
	status = "okay";
	current-speed = <115200>;
	clock-frequency = <50000000>;
};

