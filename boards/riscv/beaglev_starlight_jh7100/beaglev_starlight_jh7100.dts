/*
 * Copyright (c) 2021 Rajnesh Kanwal <rajnesh.kanwal49@gmail.com>
 *
 * SPDX-License-Identifier: Apache-2.0
 */

/dts-v1/;

#include "starfive/starfive_jh7100_beagle_v.dtsi"

/ {
	model = "BeagleV StarLight JH7100";
	compatible = "beagle,beaglev-starlight-jh7100";

	chosen {
		zephyr,console = &uart3;
		zephyr,shell-uart = &uart3;
		zephyr,sram = &ram0;
	};
};

&uart3 {
	status = "okay";
	current-speed = <115200>;
};
