## boards/riscv/dt_bl10_devkit/Kconfig.board
```kconfig
# Bouffalo Lab BL602 DevKit
#
# Copyright (c) 2021 ATL Electronics
# SPDX-License-Identifier: Apache-2.0

config BOARD_DT_BL10_DEVKIT
	bool "2.4GHz Wi-Fi and BLE coexistence Module Development Kit"
	depends on SOC_PART_NUMBER_BL602C20Q2I
```

## boards/riscv/dt_bl10_devkit/Kconfig.defconfig
```kconfig
# Bouffalo Lab BL602 DevKit
#
# Copyright (c) 2021 ATL Electronics
# SPDX-License-Identifier: Apache-2.0

if BOARD_DT_BL10_DEVKIT

config BOARD
	default "dt_bl10_devkit"

endif   # BOARD_DT_BL10_DEVKIT
```

## boards/riscv/dt_bl10_devkit/dt_bl10_devkit_defconfig
```kconfig
# Copyright (c) 2021, ATL Electronics
# SPDX-License-Identifier: Apache-2.0

CONFIG_SOC_SERIES_BL6=y
CONFIG_SOC_PART_NUMBER_BL602C20Q2I=y
CONFIG_BOARD_DT_BL10_DEVKIT=y

CONFIG_CONSOLE=y
CONFIG_UART_CONSOLE=y
CONFIG_SERIAL=y
```

## boards/riscv/esp32c3_devkitm/Kconfig.board
```kconfig
# ESP32C3 devkitm board configuration

# Copyright (c) 2021 Espressif Systems (Shanghai) Co., Ltd.
# SPDX-License-Identifier: Apache-2.0

config BOARD_ESP32C3_DEVKITM
	bool "ESP32C3 Devkit-M Board"
	depends on SOC_ESP32C3
	select CONSOLE_HAS_DRIVER
```

## boards/riscv/esp32c3_devkitm/Kconfig.defconfig
```kconfig
# ESP32C3 devkitm board configuration

# Copyright (c) 2021 Espressif Systems (Shanghai) Co., Ltd.
# SPDX-License-Identifier: Apache-2.0

config BOARD
	default "esp32c3_devkitm"
	depends on BOARD_ESP32C3_DEVKITM

config HEAP_MEM_POOL_ADD_SIZE_BOARD
	int
	default 65535 if WIFI && BT
	default 51200 if WIFI
	default 40960 if BT
	default 4096

choice BT_HCI_BUS_TYPE
	default BT_ESP32 if BT
endchoice
```

## boards/riscv/esp32c3_devkitm/Kconfig.esp32c3_devkitm
```kconfig
# Copyright (c) 2022 Zephyr Project members and individual contributors
# SPDX-License-Identifier: Apache-2.0

config BOARD_ESP32C3_DEVKITM
	bool
	default y
	select SOC_ESP32C3
	select CONSOLE_HAS_DRIVER
```

## boards/riscv/esp32c3_devkitm/esp32c3_devkitm_defconfig
```kconfig
# SPDX-License-Identifier: Apache-2.0

CONFIG_BOARD_ESP32C3_DEVKITM=y
CONFIG_SOC_SERIES_ESP32C3=y

CONFIG_MAIN_STACK_SIZE=2048

CONFIG_CONSOLE=y
CONFIG_SERIAL=y
CONFIG_UART_CONSOLE=y
CONFIG_GPIO=y
```

## boards/riscv/esp32c3_luatos_core/Kconfig.defconfig
```kconfig
# ESP32C3 core board configuration

# Copyright (c) 2023 YuLong Yao<feilongphone@gmail.com>
# SPDX-License-Identifier: Apache-2.0

config BOARD
	default "esp32c3_luatos_core"
	depends on BOARD_ESP32C3_LUATOS_CORE || BOARD_ESP32C3_LUATOS_CORE_USB

config HEAP_MEM_POOL_ADD_SIZE_BOARD
	int
	default 65535 if WIFI && BT
	default 51200 if WIFI
	default 40960 if BT
	default 4096

choice BT_HCI_BUS_TYPE
	default BT_ESP32 if BT
endchoice
```

## boards/riscv/esp32c3_luatos_core/esp32c3_luatos_core_usb_defconfig
```kconfig
# SPDX-License-Identifier: Apache-2.0

CONFIG_BOARD_ESP32C3_LUATOS_CORE_USB=y
CONFIG_SOC_SERIES_ESP32C3=y

CONFIG_MAIN_STACK_SIZE=2048

CONFIG_CONSOLE=y
CONFIG_SERIAL=y
CONFIG_UART_CONSOLE=y
CONFIG_GPIO=y
```

## boards/riscv/gd32vf103c_starter/Kconfig.defconfig
```kconfig
# Copyright (c) 2022 YuLong Yao <feilongphone@gmail.com>
# SPDX-License-Identifier: Apache-2.0

if BOARD_GD32VF103C_STARTER

config BOARD
	default "gd32vf103c_starter"

endif # BOARD_GD32VF103C_STARTER
```

## boards/riscv/gd32vf103c_starter/gd32vf103c_starter_defconfig
```kconfig
# Copyright (c) 2022 YuLong Yao <feilongphone@gmail.com>
# SPDX-License-Identifier: Apache-2.0

CONFIG_SOC_SERIES_GD32VF103=y
CONFIG_SOC_GD32VF103=y
CONFIG_BOARD_GD32VF103C_STARTER=y

CONFIG_GD32_HXTAL_8MHZ=y
```

## boards/riscv/gd32vf103v_eval/Kconfig.defconfig
```kconfig
# Copyright (c) 2021 Teslabs Engineering S.L.
# SPDX-License-Identifier: Apache-2.0

if BOARD_GD32VF103V_EVAL

config BOARD
	default "gd32vf103v_eval"

endif # BOARD_GD32VF103V_EVAL
```

## boards/riscv/gd32vf103v_eval/gd32vf103v_eval_defconfig
```kconfig
# Copyright (c) 2021, Teslabs Engineering S.L.
# SPDX-License-Identifier: Apache-2.0

CONFIG_SOC_SERIES_GD32VF103=y
CONFIG_SOC_GD32VF103=y
CONFIG_BOARD_GD32VF103V_EVAL=y

CONFIG_GD32_HXTAL_8MHZ=y
CONFIG_RISCV_MACHINE_TIMER=y

CONFIG_GPIO=y

CONFIG_CONSOLE=y
CONFIG_UART_CONSOLE=y
CONFIG_SERIAL=y
```

## boards/riscv/generic_noel/Kconfig.board
```kconfig
# Copyright (c) 2020 Cobham Gaisler AB
#
# SPDX-License-Identifier: Apache-2.0

config BOARD_GENERIC_NOEL
	bool "Generic NOEL-V system"
	depends on SOC_RISCV_NOEL
```

## boards/riscv/generic_noel/Kconfig.defconfig
```kconfig
# Copyright (c) 2020 Cobham Gaisler AB
#
# SPDX-License-Identifier: Apache-2.0

config BOARD
	default "generic_noel"
	depends on BOARD_GENERIC_NOEL

config SYS_CLOCK_TICKS_PER_SEC
	default 100
```

## boards/riscv/generic_noel/generic_noel_defconfig
```kconfig
# SPDX-License-Identifier: Apache-2.0

CONFIG_SOC_SERIES_RISCV_NOEL=y
CONFIG_SOC_RISCV_NOEL=y
CONFIG_BOARD_GENERIC_NOEL=y
CONFIG_CONSOLE=y
CONFIG_SERIAL=y
CONFIG_UART_APBUART=y
CONFIG_UART_CONSOLE=y
CONFIG_PLIC=y
CONFIG_RISCV_MACHINE_TIMER=y
CONFIG_XIP=n
```

## boards/riscv/genesys2/Kconfig.board
```kconfig
# Copyright (c) 2019 SiFive Inc.
# SPDX-License-Identifier: Apache-2.0

config BOARD_GENESYS2
	bool "Recogni Genesys2 FPGA target"
	depends on SOC_RISCV64_ARIANE
    select 64BIT
```

## boards/riscv/genesys2/genesys2_defconfig
```kconfig
CONFIG_BOARD_GENESYS2=y
CONFIG_SOC_RISCV64_ARIANE=y
CONFIG_SOC_SERIES_RISCV64_ARIANE=y
CONFIG_PLIC=y
CONFIG_GPIO=y
CONFIG_GPIO_XLNX_AXI=y
CONFIG_PINMUX=y
CONFIG_RISCV_MACHINE_TIMER=y
CONFIG_MAIN_STACK_SIZE=4096

#Console/uart
CONFIG_SERIAL=y
CONFIG_CONSOLE=y
CONFIG_UART_CONSOLE=y
CONFIG_BOOT_BANNER=y
CONFIG_UART_NS16550=y
CONFIG_UART_NS16550_ACCESS_WORD_ONLY=y
CONFIG_UART_INTERRUPT_DRIVEN=y


# SRAM SIZE (64*1024)
CONFIG_SRAM_SIZE=65536
CONFIG_SRAM_BASE_ADDRESS=0x80060000

# Compile for debugging
CONFIG_DEBUG=y
CONFIG_DEBUG_OPTIMIZATIONS=y

# Ramdisk size (in Kbytes)
CONFIG_DISK_ACCESS_RAM=y
CONFIG_DISK_RAM_VOLUME_SIZE=512   

#Enable Filesystems
CONFIG_DISK_ACCESS=y
CONFIG_FILE_SYSTEM=y
CONFIG_FAT_FILESYSTEM_ELM=y

#CONFIG_LOG=y
#CONFIG_PRINTK=y

# Networking
CONFIG_NETWORKING=y
CONFIG_NET_TCP=y
CONFIG_NET_L2_ETHERNET=y
CONFIG_ETH_LOWRISC=y
CONFIG_NET_CONFIG_SETTINGS=y
CONFIG_NET_CONFIG_NEED_IPV4=y
CONFIG_NET_CONFIG_MY_IPV4_ADDR="192.168.1.78"
CONFIG_NET_STATISTICS=y

CONFIG_NEWLIB_LIBC=y

#ping needs a random number generator
CONFIG_TEST_RANDOM_GENERATOR=y
```

## boards/riscv/hifive1/Kconfig.board
```kconfig
# SPDX-License-Identifier: Apache-2.0

config BOARD_HIFIVE1
	bool "HiFive1 target"
	depends on SOC_SIFIVE_FREEDOM_E340
```

## boards/riscv/hifive1/Kconfig.defconfig
```kconfig
# SPDX-License-Identifier: Apache-2.0

if BOARD_HIFIVE1

config BOARD
	default "hifive1"

config SYS_CLOCK_TICKS_PER_SEC
	default 128

endif
```

## boards/riscv/hifive1/hifive1_defconfig
```kconfig
# SPDX-License-Identifier: Apache-2.0

CONFIG_SOC_SERIES_SIFIVE_FREEDOM_E300=y
CONFIG_SOC_SIFIVE_FREEDOM_E340=y
CONFIG_BOARD_HIFIVE1=y
CONFIG_CONSOLE=y
CONFIG_SERIAL=y
CONFIG_UART_SIFIVE_PORT_0=y
CONFIG_UART_CONSOLE=y
CONFIG_PINCTRL=y
CONFIG_GPIO=y
CONFIG_QEMU_ICOUNT_SHIFT=6
CONFIG_BUILD_OUTPUT_HEX=y
```

## boards/riscv/hifive1_revb/Kconfig.board
```kconfig
# HiFive1 Rev B target

# Copyright (c) 2019 SiFive Inc.
# SPDX-License-Identifier: Apache-2.0

config BOARD_HIFIVE1_REVB
	def_bool "$(BOARD)" = "hifive1_revb"
	depends on SOC_RISCV_SIFIVE_FREEDOM
```

## boards/riscv/hifive1_revb/Kconfig.defconfig
```kconfig
# Copyright (c) 2019 SiFive Inc.
# SPDX-License-Identifier: Apache-2.0

if BOARD_HIFIVE1_REVB

config BOARD
	default "hifive1_revb"

config HAS_FLASH_LOAD_OFFSET
	default y

config FLASH_BASE_ADDRESS
	default $(dt_node_reg_addr_hex,/soc/spi@10014000,1)

config FLASH_LOAD_OFFSET
	default 0x0

config SYS_CLOCK_TICKS_PER_SEC
	default 128

config I2C_SIFIVE
	default y
	depends on I2C

endif
```

## boards/riscv/hifive1_revb/hifive1_revb_defconfig
```kconfig
CONFIG_SOC_SERIES_RISCV_SIFIVE_FREEDOM=y
CONFIG_SOC_RISCV_SIFIVE_FREEDOM=y
CONFIG_BOARD_HIFIVE1_REVB=y
CONFIG_RISCV_MACHINE_TIMER=y
CONFIG_PLIC=y
CONFIG_GPIO=y
CONFIG_GPIO_SIFIVE=y
CONFIG_PINCTRL=y
CONFIG_CONSOLE=y
CONFIG_SERIAL=y
CONFIG_UART_SIFIVE=y
CONFIG_UART_SIFIVE_PORT_0=y
CONFIG_UART_CONSOLE=y
CONFIG_RISCV_CORE_E31=y
```

## boards/riscv/hifive_unleashed/Kconfig.board
```kconfig
# Copyright (c) 2021 Katsuhiro Suzuki
# SPDX-License-Identifier: Apache-2.0

config BOARD_HIFIVE_UNLEASHED
	bool "HiFive Unleashed target"
	depends on SOC_RISCV_SIFIVE_FU540
```
