/* SPDX-License-Identifier: Apache-2.0 */

/dts-v1/;

#include <qemu-virt.dtsi>

/ {
	compatible = "riscv-virtio";
	model = "riscv-virtio,qemu";

	chosen {
		zephyr,console = &uart0;
		zephyr,shell-uart = &uart0;
		zephyr,sram = &sram0;
	};
};

&uart0 {
	status = "okay";
	current-speed = <115200>;
	clock-frequency = <16000000>;
};
