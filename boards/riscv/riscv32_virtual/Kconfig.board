## boards/riscv/riscv32_virtual/Kconfig.board
```kconfig
# Copyright (c) 2023 Meta
# SPDX-License-Identifier: Apache-2.0

config BOARD_RISCV32_VIRTUAL
	bool "riscv32_virtual"
	depends on SOC_RISCV32_VIRTUAL_RENODE
```

## boards/riscv/riscv32_virtual/riscv32_virtual_defconfig
```kconfig
# Copyright (c) 2023 Meta
# SPDX-License-Identifier: Apache-2.0

CONFIG_SOC_RISCV32_VIRTUAL_RENODE=y
CONFIG_BOARD_RISCV32_VIRTUAL=y
CONFIG_CONSOLE=y
CONFIG_SERIAL=y
CONFIG_UART_CONSOLE=y
CONFIG_GPIO=n
CONFIG_XIP=y

# Workaround for incorrect SYS_CLOCK_HW_CYCLES_PER_SEC
CONFIG_SYS_CLOCK_TICKS_PER_SEC=100
```

## boards/riscv/rv32m1_vega/Kconfig
```kconfig
# OpenISA VEGAboard board configuration

# Copyright (c) 2022 Henrik Brix Andersen <henrik@brixandersen.dk>
# SPDX-License-Identifier: Apache-2.0

config BOARD_INIT_PRIORITY
	int "Board initialization priority"
	default 45
	depends on BOARD_RV32M1_VEGA && BT_CTLR_DEBUG_PINS
	help
	  Board initialization priority. The board initialization must take
	  place after the GPIO driver is initialized.
```

## boards/riscv/rv32m1_vega/Kconfig.board
```kconfig
# RV32M1 RISC-V cores

# SPDX-License-Identifier: Apache-2.0

config BOARD_RV32M1_VEGA
	def_bool "$(BOARD)" = "rv32m1_vega"
	depends on SOC_OPENISA_RV32M1_RISCV32
```

## boards/riscv/rv32m1_vega/Kconfig.defconfig
```kconfig
# SPDX-License-Identifier: Apache-2.0

if BOARD_RV32M1_VEGA

config BOARD
	default "rv32m1_vega_ri5cy" if SOC_OPENISA_RV32M1_RI5CY
	default "rv32m1_vega_zero_riscy" if SOC_OPENISA_RV32M1_ZERO_RISCY

config UART_RV32M1_LPUART
	default y
	depends on SERIAL

if BT

config BT_CTLR
	default y

#TODO: Resolve the complete non-BLE support for crypto CAU3 firmware/driver
#config HAS_RV32M1_CAU3
#	bool
#	default y if BT_CTLR_CRYPTO && !BT_CTLR_LE_ENC_SUPPORT

config HAS_RV32M1_CAU3_BLE
	bool
	default y if BT_CTLR_CRYPTO && \
		(BT_CTLR_LE_ENC_SUPPORT || BT_CTLR_PRIVACY_SUPPORT)

config RV32M1_INTMUX_CHANNEL_2
	default n

config RV32M1_INTMUX_CHANNEL_3
	default n

endif # BT

endif # BOARD_RV32M1_VEGA
```

## boards/riscv/rv32m1_vega/Kconfig.rv32m1_vega_zero_riscy
```kconfig
# SPDX-License-Identifier: Apache-2.0

config BOARD_RV32M1_VEGA_ZERO_RISCY
	bool
	default y
	select SOC_OPENISA_RV32M1_RISCV32
	select SOC_OPENISA_RV32M1_ZERO_RISCY
```

## boards/riscv/rv32m1_vega/rv32m1_vega_ri5cy_defconfig
```kconfig
# SPDX-License-Identifier: Apache-2.0

CONFIG_SOC_OPENISA_RV32M1_RISCV32=y
CONFIG_SOC_OPENISA_RV32M1_RI5CY=y
CONFIG_BOARD_RV32M1_VEGA=y
CONFIG_CLOCK_CONTROL_RV32M1_PCC=y
CONFIG_GPIO=y
CONFIG_PINCTRL=y
CONFIG_SERIAL=y
CONFIG_CONSOLE=y
CONFIG_UART_CONSOLE=y
CONFIG_UART_INTERRUPT_DRIVEN=y
CONFIG_MULTI_LEVEL_INTERRUPTS=y
```

## boards/riscv/rv32m1_vega/rv32m1_vega_zero_riscy_defconfig
```kconfig
CONFIG_GPIO=y
CONFIG_PINCTRL=y
CONFIG_SERIAL=y
CONFIG_CONSOLE=y
CONFIG_UART_CONSOLE=y
CONFIG_UART_INTERRUPT_DRIVEN=y
CONFIG_MULTI_LEVEL_INTERRUPTS=y
```

## boards/riscv/secure-iot/Kconfig.board
```kconfig
config BOARD_SECURE_IOT
	bool "Secure IoT target"
	depends on SOC_RISCV64_SHAKTI
        select HAS_DTS
        select RISCV_HAS_PLIC
        select RISCV_HAS_FPU
        select CPU_HAS_FPU
```

## boards/riscv/secure-iot/secure-iot_defconfig
```kconfig
CONFIG_SOC_SERIES_RISCV64_SHAKTI=y
CONFIG_SOC_RISCV64_SHAKTI=y
CONFIG_BOARD_SECURE_IOT=y
CONFIG_CONSOLE=y
CONFIG_PRINTK=y
CONFIG_SERIAL=y
CONFIG_UART_SHAKTI=y
CONFIG_GPIO=y
CONFIG_GPIO_SHAKTI=y
CONFIG_UART_SHAKTI_PORT_0=y
CONFIG_UART_CONSOLE=y
CONFIG_XIP=n
CONFIG_RISCV_MACHINE_TIMER=y
CONFIG_PLIC=y
CONFIG_BOOT_BANNER=y
CONFIG_SRAM_BASE_ADDRESS=0x80000000
CONFIG_SRAM_SIZE=256000
CONFIG_RAM_CONSOLE=y
CONFIG_TIMING_FUNCTIONS=y
CONFIG_FPU=y
CONFIG_MULTITHREADING=n
CONFIG_I2C=y
CONFIG_I2C_SECURE_IOT=y
CONFIG_SPI=y
CONFIG_SPI_SHAKTI=y

CONFIG_ILI9341=y
# Below 2 configs for FPGA 40MHZ clk
CONFIG_SYS_CLOCK_HW_CYCLES_PER_SEC=156250
CONFIG_SYS_CLOCK_TICKS_PER_SEC=10000

# Below 2 configs for FPGA 700MHZ clk
# CONFIG_SYS_CLOCK_HW_CYCLES_PER_SEC=156250
# CONFIG_SYS_CLOCK_TICKS_PER_SEC=10000


# CONFIG_MINIMAL_LIBC_RAND=y
# CONFIG_POSIX_CLOCK=y
```

## boards/riscv/shakti-vajra/Kconfig.board
```kconfig
config BOARD_SHAKTI_VAJRA
	bool "shakti vajra target"
	depends on SOC_RISCV64_SHAKTI
        select HAS_DTS
        select RISCV_HAS_PLIC
        select CPU_HAS_FPU
```

## boards/riscv/shakti-vajra/shakti-vajra_defconfig
```kconfig
CONFIG_SOC_SERIES_RISCV64_SHAKTI=y
CONFIG_SOC_RISCV64_SHAKTI=y
CONFIG_BOARD_SHAKTI_VAJRA=y
#CONFIG_CONSOLE=y
CONFIG_PRINTK=y
CONFIG_SERIAL=y
CONFIG_UART_SHAKTI=y
CONFIG_UART_SHAKTI_PORT_0=y
CONFIG_UART_CONSOLE=y
CONFIG_XIP=n
CONFIG_RISCV_MACHINE_TIMER=y
CONFIG_PLIC=n
CONFIG_BOOT_BANNER=y
CONFIG_SRAM_BASE_ADDRESS=0x80000000
CONFIG_SRAM_SIZE=256000
```

## boards/riscv/sparkfun_red_v_things_plus/Kconfig.board
```kconfig
# Copyright (c) 2022 TOKITA Hiroshi <tokita.hiroshi@fujitsu.com>
# SPDX-License-Identifier: Apache-2.0

config BOARD_SPARKFUN_RED_V_THINGS_PLUS
	bool "SparkFun RED-V Things Plus board"
	depends on SOC_RISCV_SIFIVE_FREEDOM
```

## boards/riscv/sparkfun_red_v_things_plus/Kconfig.defconfig
```kconfig
# Copyright (c) 2022 TOKITA Hiroshi <tokita.hiroshi@fujitsu.com>
# SPDX-License-Identifier: Apache-2.0

if BOARD_SPARKFUN_RED_V_THINGS_PLUS

config BOARD
	default "sparkfun_red_v_things_plus"

config HAS_FLASH_LOAD_OFFSET
	default y

config FLASH_BASE_ADDRESS
	default $(dt_node_reg_addr_hex,/soc/spi@10014000,1)

config FLASH_LOAD_OFFSET
	default 0x0

config SYS_CLOCK_TICKS_PER_SEC
	default 128

endif
```

## boards/riscv/stamp_c3/Kconfig.defconfig
```kconfig
# M5Stack STAMP-C3 board configuration

# Copyright 2022 TOKITA Hiroshi <tokita.hiroshi@fujitsu.com>
# SPDX-License-Identifier: Apache-2.0

config BOARD
	default "stamp_c3"
	depends on BOARD_STAMP_C3

config HEAP_MEM_POOL_SIZE
	default 98304 if WIFI
	default 16384 if BT
	default 4096

if BT

choice BT_HCI_BUS_TYPE
	default BT_ESP32
endchoice

endif # BT
```

## boards/riscv/stamp_c3/stamp_c3_defconfig
```kconfig
# SPDX-License-Identifier: Apache-2.0

CONFIG_BOARD_STAMP_C3=y
CONFIG_SOC_SERIES_ESP32C3=y

CONFIG_MAIN_STACK_SIZE=2048

CONFIG_SYS_CLOCK_HW_CYCLES_PER_SEC=1000000

CONFIG_CONSOLE=y
CONFIG_SERIAL=y
CONFIG_UART_CONSOLE=y
CONFIG_GPIO=y
```

## boards/riscv/titanium_ti60_f225/Kconfig.board
```kconfig
# Copyright (c) 2023 Efinix Inc.
# SPDX-License-Identifier: Apache-2.0

config BOARD_TITANIUM_TI60_F225
	bool "Board with Efinix Sapphire riscv SoC"
	depends on SOC_SERIES_EFINIX_SAPPHIRE
```

## boards/riscv/titanium_ti60_f225/Kconfig.defconfig
```kconfig
# Copyright (c) 2023 Efinix Inc.
# SPDX-License-Identifier: Apache-2.0

if BOARD_TITANIUM_TI60_F225

config BOARD
	default "titanium_ti60_f225"

endif # BOARD_TITANIUM_TI60_F225
```

## boards/riscv/titanium_ti60_f225/titanium_ti60_f225_defconfig
```kconfig
# Copyright (c) 2023 Efinix Inc.
# SPDX-License-Identifier: Apache-2.0

CONFIG_SOC_SERIES_EFINIX_SAPPHIRE=y
CONFIG_BOARD_TITANIUM_TI60_F225=y
CONFIG_CONSOLE=y
CONFIG_SERIAL=y
CONFIG_UART_CONSOLE=y
CONFIG_GPIO=y
CONFIG_CLOCK_CONTROL=n
CONFIG_XIP=n
CONFIG_HEAP_MEM_POOL_SIZE=16384
CONFIG_INIT_STACKS=n
```

## boards/riscv/tl321x/Kconfig.board
```kconfig
# Copyright (c) 2023 Telink Semiconductor
# SPDX-License-Identifier: Apache-2.0

config BOARD_TL3218X
	bool "Telink TL321X Platform"
	depends on SOC_RISCV_TELINK_TL321X

config BOARD_TL3218X_RETENTION
	bool "Telink TL321X Platform with retention"
	depends on SOC_RISCV_TELINK_TL321X
```

## boards/riscv/tl321x/Kconfig.defconfig
```kconfig
# Copyright (c) 2024 Telink Semiconductor
# SPDX-License-Identifier: Apache-2.0

if BOARD_TL3218X

config BOARD
	default "tl3218x"

endif

if BOARD_TL3218X_RETENTION

config BOARD
	default "tl3218x_retention"

endif

config HEAP_MEM_POOL_SIZE
	default 4096

if BOARD_TL3218X || BOARD_TL3218X_RETENTION

config SOC_FLASH_TELINK_TLX
	default y if FLASH

config USB_TELINK_TLX
	default y

if BT

# BLE Controller SDK from hal_telink requires
# Telink's toolchain with FPU support
config FPU
	default y if "$(ZEPHYR_TOOLCHAIN_VARIANT)" != "zephyr"

config BT_HCI_ACL_FLOW_CONTROL
	default n

choice BT_HCI_BUS_TYPE
	default BT_TLX
endchoice

endif # BT

# Workaround for not being able to have commas in macro arguments
DT_CHOSEN_Z_CODE_PARTITION := zephyr,code-partition

config FLASH_LOAD_OFFSET
	default $(dt_chosen_reg_addr_hex,$(DT_CHOSEN_Z_CODE_PARTITION)) if USE_DT_CODE_PARTITION

# Buffer for image writter shall be less(multiple of access alignment) or
# equal to flash page. tl3218x boards use external P25Q16 IC as
# flesh memory. Flash page size of the IC is 256 bytes. So that, it is
# maximum image writer buffer size for such kind of boards.
config IMG_BLOCK_BUF_SIZE
	default 256 if MCUBOOT_IMG_MANAGER

# MCU boot application options
config MCUBOOT_SIGNATURE_KEY_FILE
	default "bootloader/mcuboot/root-rsa-2048.pem" if BOOTLOADER_MCUBOOT

config MCUBOOT_EXTRA_IMGTOOL_ARGS
	default "--max-sectors 4096" if BOOTLOADER_MCUBOOT

endif
```

## boards/riscv/tlsr9118bdk40d/Kconfig.board
```kconfig
# Copyright (c) 2023 Telink Semiconductor
# SPDX-License-Identifier: Apache-2.0

config BOARD_TLSR9118BDK40D
	bool "Telink W91 Platform"
	depends on SOC_RISCV_TELINK_W91
```

## boards/riscv/tlsr9118bdk40d/Kconfig.defconfig
```kconfig
# Copyright (c) 2023 Telink Semiconductor
# SPDX-License-Identifier: Apache-2.0

if BOARD_TLSR9118BDK40D

config BOARD
	default "tlsr9118bdk40d"

endif

config HEAP_MEM_POOL_SIZE
	default 4096

if BOARD_TLSR9118BDK40D

if BT

config BT_HCI_ACL_FLOW_CONTROL
	default n

choice BT_HCI_BUS_TYPE
	default BT_W91
endchoice

endif # BT

# Workaround for not being able to have commas in macro arguments
DT_CHOSEN_Z_CODE_PARTITION := zephyr,code-partition

config FLASH_LOAD_OFFSET
	default $(dt_chosen_reg_addr_hex,$(DT_CHOSEN_Z_CODE_PARTITION)) if USE_DT_CODE_PARTITION

# Buffer for image writter shall be less(multiple of access alignment) or
# equal to flash page. tlsr9118bdk40d boards use external P25Q16 IC as
# flesh memory. Flash page size of the IC is 256 bytes. So that, it is
# maximum image writer buffer size for such kind of boards.
config IMG_BLOCK_BUF_SIZE
	default 256 if MCUBOOT_IMG_MANAGER

# MCU boot application options
config MCUBOOT_SIGNATURE_KEY_FILE
	default "bootloader/mcuboot/root-rsa-2048.pem" if BOOTLOADER_MCUBOOT

config MCUBOOT_EXTRA_IMGTOOL_ARGS
	default "--max-sectors 4096" if BOOTLOADER_MCUBOOT

endif
```
