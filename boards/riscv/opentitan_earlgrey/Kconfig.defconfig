## boards/riscv/opentitan_earlgrey/Kconfig.defconfig
```kconfig
# Copyright (c) 2023 by Rivos Inc.
# SPDX-License-Identifier: Apache-2.0

if BOARD_OPENTITAN_EARLGREY

config BOARD
	default "opentitan_earlgrey"

endif # BOARD_OPENTITAN_EARLGREY
```

## boards/riscv/opentitan_earlgrey/opentitan_earlgrey_defconfig
```kconfig
# Copyright (c) 2023 by Rivos Inc.
# SPDX-License-Identifier: Apache-2.0

CONFIG_SOC_SERIES_RISCV_OPENTITAN=y
CONFIG_SOC_RISCV_OPENTITAN=y
CONFIG_BOARD_OPENTITAN_EARLGREY=y
CONFIG_XIP=y
CONFIG_SERIAL=y
CONFIG_CONSOLE=y
CONFIG_UART_CONSOLE=y
CONFIG_BUILD_OUTPUT_BIN=n
```

## boards/riscv/qemu_riscv32/Kconfig.board
```kconfig
# SPDX-License-Identifier: Apache-2.0

config BOARD_QEMU_RISCV32
	bool "QEMU RISCV32 target"
	depends on SOC_RISCV_VIRT
	select QEMU_TARGET
	select CPU_HAS_FPU
	select RISCV_ISA_RV32I
	select RISCV_ISA_EXT_ZICSR
	select RISCV_ISA_EXT_ZIFENCEI

config BOARD_QEMU_RISCV32_SMP
	bool "QEMU RISCV32 SMP target"
	depends on SOC_RISCV_VIRT
	select QEMU_TARGET
	select CPU_HAS_FPU
	select RISCV_ISA_RV32I
	select RISCV_ISA_EXT_ZICSR
	select RISCV_ISA_EXT_ZIFENCEI

config BOARD_QEMU_RISCV32_XIP
	bool "QEMU RISCV32 XIP target"
	depends on SOC_RISCV_SIFIVE_FREEDOM
	select QEMU_TARGET
	select CPU_HAS_FPU
	select RISCV_ISA_RV32I
	select RISCV_ISA_EXT_ZICSR
	select RISCV_ISA_EXT_ZIFENCEI
```

## boards/riscv/qemu_riscv32/Kconfig.defconfig
```kconfig
# SPDX-License-Identifier: Apache-2.0

config BUILD_OUTPUT_BIN
	default n

config BOARD
	default "qemu_riscv32" if BOARD_QEMU_RISCV32
	default "qemu_riscv32_xip" if BOARD_QEMU_RISCV32_XIP
	default "qemu_riscv32_smp" if BOARD_QEMU_RISCV32_SMP

# Use thread local storage by default so that
# this feature gets more CI coverage.
config THREAD_LOCAL_STORAGE
	default y
```

## boards/riscv/qemu_riscv32/Kconfig.qemu_riscv32
```kconfig
# Copyright (c) 2022 Zephyr Project members and individual contributors
# SPDX-License-Identifier: Apache-2.0

config BOARD_QEMU_RISCV32
	bool
	default y
	select SOC_SERIES_RISCV_VIRT
	select SOC_RISCV_VIRT
	select QEMU_TARGET
	select CPU_HAS_FPU
	select RISCV_ISA_RV32I
	select RISCV_ISA_EXT_ZICSR
	select RISCV_ISA_EXT_ZIFENCEI
```

## boards/riscv/qemu_riscv32/Kconfig.qemu_riscv32_xip
```kconfig
# SPDX-License-Identifier: Apache-2.0

config BOARD_QEMU_RISCV32_XIP
	bool
	default y
	select SOC_SERIES_RISCV_SIFIVE_FREEDOM
	select SOC_RISCV_SIFIVE_FREEDOM
	select QEMU_TARGET
	select CPU_HAS_FPU
	select RISCV_ISA_RV32I
	select RISCV_ISA_EXT_ZICSR
	select RISCV_ISA_EXT_ZIFENCEI
```

## boards/riscv/qemu_riscv32/qemu_riscv32_defconfig
```kconfig
# SPDX-License-Identifier: Apache-2.0

CONFIG_SOC_SERIES_RISCV_VIRT=y
CONFIG_SOC_RISCV_VIRT=y
CONFIG_BOARD_QEMU_RISCV32=y
CONFIG_CONSOLE=y
CONFIG_SERIAL=y
CONFIG_UART_CONSOLE=y
CONFIG_PLIC=y
CONFIG_RISCV_MACHINE_TIMER=y
CONFIG_STACK_SENTINEL=y
CONFIG_QEMU_ICOUNT_SHIFT=6
CONFIG_XIP=n
CONFIG_RISCV_PMP=y
```

## boards/riscv/qemu_riscv32/qemu_riscv32_xip_defconfig
```kconfig
# SPDX-License-Identifier: Apache-2.0

CONFIG_SOC_SERIES_RISCV_SIFIVE_FREEDOM=y
CONFIG_SOC_RISCV_SIFIVE_FREEDOM=y
CONFIG_BOARD_QEMU_RISCV32_XIP=y
CONFIG_CONSOLE=y
CONFIG_SERIAL=y
CONFIG_UART_SIFIVE_PORT_0=y
CONFIG_UART_CONSOLE=y
CONFIG_PINCTRL=y
CONFIG_GPIO=y
CONFIG_SYS_CLOCK_HW_CYCLES_PER_SEC=10000000
CONFIG_QEMU_ICOUNT_SHIFT=6
CONFIG_RISCV_CORE_E31=y
```

## boards/riscv/qemu_riscv32e/Kconfig.board
```kconfig
# Copyright (c) 2022 Carlo Caione <ccaione@baylibre.com>
# SPDX-License-Identifier: Apache-2.0

config BOARD_QEMU_RISCV32E
	bool "QEMU RISCV32E target"
	depends on SOC_RISCV_VIRT
	select QEMU_TARGET
	select HAS_COVERAGE_SUPPORT
	select RISCV_ISA_RV32E
	select RISCV_ISA_EXT_ZICSR
	select RISCV_ISA_EXT_ZIFENCEI
```

## boards/riscv/qemu_riscv32e/Kconfig.defconfig
```kconfig
# Copyright (c) 2022 Carlo Caione <ccaione@baylibre.com>
# SPDX-License-Identifier: Apache-2.0

config BUILD_OUTPUT_BIN
	default n

config BOARD
	default "qemu_riscv32e" if BOARD_QEMU_RISCV32E

# Use thread local storage by default so that
# this feature gets more CI coverage.
config THREAD_LOCAL_STORAGE
	default y
```

## boards/riscv/qemu_riscv32e/Kconfig.qemu_riscv32e
```kconfig
# Copyright (c) 2022 Zephyr Project members and individual contributors
# SPDX-License-Identifier: Apache-2.0

config BOARD_QEMU_RISCV32E
	bool
	default y
	select SOC_SERIES_RISCV_VIRT
	select SOC_RISCV_VIRT
	select QEMU_TARGET
	select RISCV_ISA_RV32E
	select RISCV_ISA_EXT_ZICSR
	select RISCV_ISA_EXT_ZIFENCEI
```

## boards/riscv/qemu_riscv64/Kconfig.board
```kconfig
# Copyright (c) 2019 BayLibre SAS
# SPDX-License-Identifier: Apache-2.0

config BOARD_QEMU_RISCV64
	bool "QEMU RISCV64 target"
	depends on SOC_RISCV_VIRT
	select QEMU_TARGET
	select 64BIT
	select CPU_HAS_FPU_DOUBLE_PRECISION
	select RISCV_ISA_RV64I
	select RISCV_ISA_EXT_ZICSR
	select RISCV_ISA_EXT_ZIFENCEI

config BOARD_QEMU_RISCV64_SMP
	bool "QEMU RISCV64 SMP target"
	depends on SOC_RISCV_VIRT
	select QEMU_TARGET
	select 64BIT
	select CPU_HAS_FPU_DOUBLE_PRECISION
	select RISCV_ISA_RV64I
	select RISCV_ISA_EXT_ZICSR
	select RISCV_ISA_EXT_ZIFENCEI
```

## boards/riscv/qemu_riscv64/Kconfig.defconfig
```kconfig
# Copyright (c) 2019 BayLibre SAS
# SPDX-License-Identifier: Apache-2.0

config BUILD_OUTPUT_BIN
	default n
```

## boards/riscv/qemu_riscv64/Kconfig.qemu_riscv64_smp
```kconfig
# Copyright (c) 2022 Zephyr Project members and individual contributors
# SPDX-License-Identifier: Apache-2.0

config BOARD_QEMU_RISCV64_SMP
	bool
	default y
	select SOC_SERIES_RISCV_VIRT
	select SOC_RISCV_VIRT
	select QEMU_TARGET
	select 64BIT
	select CPU_HAS_FPU_DOUBLE_PRECISION
	select RISCV_ISA_RV64I
	select RISCV_ISA_EXT_ZICSR
	select RISCV_ISA_EXT_ZIFENCEI
```

## boards/riscv/qemu_riscv64/qemu_riscv64_defconfig
```kconfig
# SPDX-License-Identifier: Apache-2.0

CONFIG_SOC_SERIES_RISCV_SIFIVE_FREEDOM=y
CONFIG_SOC_RISCV_SIFIVE_FREEDOM=y
CONFIG_BOARD_QEMU_RISCV64=y
CONFIG_CONSOLE=y
CONFIG_PRINTK=y
CONFIG_SERIAL=y
CONFIG_UART_SIFIVE=y
CONFIG_UART_SIFIVE_PORT_0=y
CONFIG_UART_CONSOLE=y
CONFIG_PLIC=y
CONFIG_PINMUX=y
CONFIG_PINMUX_SIFIVE=y
CONFIG_RISCV_MACHINE_TIMER=y
CONFIG_GPIO=y
CONFIG_GPIO_SIFIVE=y
CONFIG_SYS_CLOCK_HW_CYCLES_PER_SEC=10000000
CONFIG_STACK_SENTINEL=y
CONFIG_TEST_EXTRA_STACKSIZE=256
CONFIG_QEMU_ICOUNT_SHIFT=6
```

## boards/riscv/qemu_riscv64/qemu_riscv64_smp_defconfig
```kconfig
# SPDX-License-Identifier: Apache-2.0

CONFIG_SOC_SERIES_RISCV_VIRT=y
CONFIG_SOC_RISCV_VIRT=y
CONFIG_BOARD_QEMU_RISCV64_SMP=y
CONFIG_PRIVILEGED_STACK_SIZE=2048
CONFIG_CONSOLE=y
CONFIG_SERIAL=y
CONFIG_UART_CONSOLE=y
CONFIG_STACK_SENTINEL=y
CONFIG_XIP=n
CONFIG_SMP=y
CONFIG_MP_NUM_CPUS=2
CONFIG_QEMU_ICOUNT=n

CONFIG_IDLE_STACK_SIZE=1024
CONFIG_RISCV_PMP=y
```

## boards/riscv/qemu_riscv_virt/Kconfig.board
```kconfig
# SPDX-License-Identifier: Apache-2.0

config BOARD_QEMU_RISCV32_VIRT_SMP
	bool "QEMU RISCV32 Virt Machine target"
	depends on SOC_RISCV_QEMU_VIRT
	select QEMU_TARGET
	select USE_SWITCH

config BOARD_QEMU_RISCV64_VIRT_SMP
	bool "QEMU RISCV64 Virt Machine target"
	depends on SOC_RISCV_QEMU_VIRT
	select QEMU_TARGET
	select 64BIT
	select USE_SWITCH
```

## boards/riscv/qemu_riscv_virt/Kconfig.defconfig
```kconfig
# SPDX-License-Identifier: Apache-2.0

config BUILD_OUTPUT_BIN
	default n if BOARD_QEMU_RISCV32_VIRT_SMP || BOARD_QEMU_RISCV64_VIRT_SMP

config BOARD
	default "qemu_riscv32_virt_smp" if BOARD_QEMU_RISCV32_VIRT_SMP
	default "qemu_riscv64_virt_smp" if BOARD_QEMU_RISCV64_VIRT_SMP
```

## boards/riscv/qemu_riscv_virt/qemu_riscv64_virt_smp_defconfig
```kconfig
# SPDX-License-Identifier: Apache-2.0

CONFIG_SOC_SERIES_RISCV_QEMU_VIRT=y
CONFIG_SOC_RISCV_QEMU_VIRT=y
CONFIG_BOARD_QEMU_RISCV64_VIRT_SMP=y
CONFIG_CONSOLE=y
CONFIG_PRINTK=y
CONFIG_SERIAL=y
CONFIG_UART_NS16550=y
CONFIG_UART_CONSOLE=y
CONFIG_PLIC=y
CONFIG_RISCV_MACHINE_TIMER=y
CONFIG_CLINT_IPI=y
CONFIG_STACK_SENTINEL=n
CONFIG_TEST_EXTRA_STACKSIZE=256
CONFIG_XIP=n
CONFIG_SMP=y
CONFIG_MP_NUM_CPUS=4
CONFIG_QEMU_ICOUNT=n
```

## boards/riscv/qemu_rv32_virt/Kconfig.board
```kconfig
# Copyright (c) 2020 Katsuhiro Suzuki
# SPDX-License-Identifier: Apache-2.0

config BOARD_QEMU_RV32_VIRT
	bool "QEMU RV32 virt target"
	depends on SOC_QEMU_RV32_VIRT
	select USE_SWITCH
	select USE_SWITCH_SUPPORTED
```

## boards/riscv/qemu_rv32_virt/Kconfig.defconfig
```kconfig
# Copyright (c) 2020 Katsuhiro Suzuki
# SPDX-License-Identifier: Apache-2.0

if BOARD_QEMU_RV32_VIRT

config BOARD
	default "QEMU RV32 virt board"

endif
```

## boards/riscv/qemu_rv32_virt/qemu_rv32_virt_defconfig
```kconfig
# SPDX-License-Identifier: Apache-2.0

CONFIG_XIP=n
CONFIG_SOC_SERIES_QEMU_RV32_VIRT=y
CONFIG_SOC_QEMU_RV32_VIRT=y
CONFIG_BOARD_QEMU_RV32_VIRT=y
CONFIG_PLIC=y
CONFIG_CONSOLE=y
CONFIG_PRINTK=y
CONFIG_SERIAL=y
CONFIG_UART_NS16550=y
CONFIG_UART_NS16550_ACCESS_WORD_ONLY=n
CONFIG_UART_CONSOLE=y
CONFIG_RISCV_MACHINE_TIMER=y
CONFIG_SYS_CLOCK_HW_CYCLES_PER_SEC=10000000
CONFIG_QEMU_ICOUNT=n
CONFIG_SMP=y
CONFIG_MP_NUM_CPUS=2
CONFIG_LOG_PROCESS_THREAD_STACK_SIZE=3072

CONFIG_MAIN_STACK_SIZE=8192
CONFIG_IDLE_STACK_SIZE=4096
CONFIG_ISR_STACK_SIZE=16384
CONFIG_TEST_EXTRA_STACKSIZE=4096
CONFIG_SYSTEM_WORKQUEUE_STACK_SIZE=8192
```

## boards/riscv/qemu_rv64_virt/Kconfig.board
```kconfig
# Copyright (c) 2020 Katsuhiro Suzuki
# SPDX-License-Identifier: Apache-2.0

config BOARD_QEMU_RV64_VIRT
	bool "QEMU RV64 virt target"
	depends on SOC_QEMU_RV64_VIRT
	select QEMU_TARGET
	select USE_SWITCH
	select USE_SWITCH_SUPPORTED
	select 64BIT
```

## boards/riscv/qemu_rv64_virt/Kconfig.defconfig
```kconfig
# Copyright (c) 2020 Katsuhiro Suzuki
# SPDX-License-Identifier: Apache-2.0

if BOARD_QEMU_RV64_VIRT

config BOARD
	default "QEMU RV64 virt board"

endif
```

## boards/riscv/qemu_rv64_virt/qemu_rv64_virt_defconfig
```kconfig
# SPDX-License-Identifier: Apache-2.0

CONFIG_XIP=n
CONFIG_SOC_SERIES_QEMU_RV64_VIRT=y
CONFIG_SOC_QEMU_RV64_VIRT=y
CONFIG_BOARD_QEMU_RV64_VIRT=y
CONFIG_PLIC=y
CONFIG_CONSOLE=y
CONFIG_PRINTK=y
CONFIG_SERIAL=y
CONFIG_UART_NS16550=y
CONFIG_UART_NS16550_ACCESS_WORD_ONLY=n
CONFIG_UART_CONSOLE=y
CONFIG_RISCV_MACHINE_TIMER=y
CONFIG_SYS_CLOCK_HW_CYCLES_PER_SEC=10000000
CONFIG_QEMU_ICOUNT_SHIFT=6

CONFIG_CMSIS_THREAD_MAX_STACK_SIZE=2048
CONFIG_CMSIS_V2_THREAD_MAX_STACK_SIZE=2048
CONFIG_TEST_EXTRA_STACKSIZE=4096
CONFIG_LOG_PROCESS_THREAD_STACK_SIZE=2048
```
