/*
 * Copyright (c) 2024 Nordic Semiconductor ASA
 *
 * SPDX-License-Identifier: Apache-2.0
 */

#include "nrf54h20dk_nrf54h20_cpuppr.dts"

&cpuppr_code_partition {
	reg = <0x126000 DT_SIZE_K(62)>;
};
