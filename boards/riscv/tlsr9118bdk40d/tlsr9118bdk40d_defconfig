## boards/riscv/tlsr9118bdk40d/tlsr9118bdk40d_defconfig
```kconfig
# Copyright (c) 2023 Telink Semiconductor
# SPDX-License-Identifier: Apache-2.0

CONFIG_SOC_SERIES_RISCV_TELINK_W91=y
CONFIG_SOC_RISCV_TELINK_W91=y
CONFIG_BOARD_TLSR9118BDK40D=y
CONFIG_GPIO=y
CONFIG_SYS_CLOCK_TICKS_PER_SEC=1000
CONFIG_UART_INTERRUPT_DRIVEN=n
CONFIG_SERIAL=n
CONFIG_CONSOLE=n
CONFIG_UART_CONSOLE=n

# BLE part:
CONFIG_BT_ATT_ENFORCE_FLOW=n
CONFIG_BT_HCI_TX_STACK_SIZE_WITH_PROMPT=y
CONFIG_BT_HCI_TX_STACK_SIZE=2048
CONFIG_BT_RX_STACK_SIZE=2048
```

## boards/riscv/tlsr9253b/Kconfig.board
```kconfig
# Copyright (c) 2024 Telink Semiconductor
# SPDX-License-Identifier: Apache-2.0

config BOARD_TLSR9253B
	bool "Telink B93 Platform"
	depends on SOC_RISCV_TELINK_B93

config BOARD_TLSR9253B_RETENTION
	bool "Telink B93 Platform with retention"
	depends on SOC_RISCV_TELINK_B93

config BOARD_TLSR9X_NON_RETENTION_RAM_CODE
	bool "Place Telink RAM code into non retention memory"
	depends on SOC_SERIES_RISCV_TELINK_B9X && BOARD_TLSR9253B_RETENTION
	help
		Place Telink RAM code into non retention memory and restore ram code on each boot.
```

## boards/riscv/tlsr9258a/Kconfig.board
```kconfig
# Copyright (c) 2024 Telink Semiconductor
# SPDX-License-Identifier: Apache-2.0

config BOARD_TLSR9258A
	bool "Telink B95 Platform"
	depends on SOC_RISCV_TELINK_B95

config BOARD_TLSR9258A_RETENTION
	bool "Telink B95 Platform with retention"
	depends on SOC_RISCV_TELINK_B95
```

## boards/riscv/tlsr9518adk80d/Kconfig.board
```kconfig
# Copyright (c) 2023 Telink Semiconductor
# SPDX-License-Identifier: Apache-2.0

config BOARD_TLSR9518ADK80D
	bool "Telink B91 Platform"
	depends on SOC_RISCV_TELINK_B91

config BOARD_TLSR9518ADK80D_RETENTION
	bool "Telink B91 Platform with retention"
	depends on SOC_RISCV_TELINK_B91
```

## boards/riscv/tlsr9518adk80d/Kconfig.defconfig
```kconfig
# Copyright (c) 2023 Telink Semiconductor
# SPDX-License-Identifier: Apache-2.0

if BOARD_TLSR9518ADK80D

config BOARD
	default "tlsr9518adk80d"

endif

if BOARD_TLSR9518ADK80D_RETENTION

config BOARD
	default "tlsr9518adk80d_retention"

config BOARD_TLSR9518ADK80D_NON_RETENTION_RAM_CODE
	default n

endif

if BOARD_TLSR9518ADK80D || BOARD_TLSR9518ADK80D_RETENTION

config SOC_FLASH_TELINK_B91
	default y if FLASH

config USB_TELINK_B91
	default y

if BT

# BLE Controller SDK from hal_telink requires
# Telink's toolchain with FPU support
config FPU
	default y if "$(ZEPHYR_TOOLCHAIN_VARIANT)" != "zephyr"

config BT_HCI_ACL_FLOW_CONTROL
	default n

choice BT_HCI_BUS_TYPE
	default BT_B91
endchoice

endif # BT

# Workaround for not being able to have commas in macro arguments
DT_CHOSEN_Z_CODE_PARTITION := zephyr,code-partition

config FLASH_LOAD_OFFSET
	default $(dt_chosen_reg_addr_hex,$(DT_CHOSEN_Z_CODE_PARTITION)) if USE_DT_CODE_PARTITION

# Buffer for image writter shall be less(multiple of access alignment) or
# equal to flash page. tlsr9518adk80d boards use external P25Q16 IC as
# flesh memory. Flash page size of the IC is 256 bytes. So that, it is
# maximum image writer buffer size for such kind of boards.
config IMG_BLOCK_BUF_SIZE
	default 256 if MCUBOOT_IMG_MANAGER

# MCU boot application options
config MCUBOOT_SIGNATURE_KEY_FILE
	default "bootloader/mcuboot/root-rsa-2048.pem" if BOOTLOADER_MCUBOOT

config MCUBOOT_EXTRA_IMGTOOL_ARGS
	default "--max-sectors 4096" if BOOTLOADER_MCUBOOT

endif
```

## boards/riscv/tlsr9518adk80d/Kconfig.tlsr9518adk80d
```kconfig
# SPDX-License-Identifier: Apache-2.0

config BOARD_TLSR9518ADK80D
	bool
	default y
	select SOC_SERIES_RISCV_TELINK_B91
	select SOC_RISCV_TELINK_B91
```

## boards/riscv/tlsr9518adk80d/tlsr9518adk80d_defconfig
```kconfig
# Copyright (c) 2021 Telink Semiconductor
# SPDX-License-Identifier: Apache-2.0

CONFIG_SOC_SERIES_RISCV_TELINK_B91=y
CONFIG_SOC_RISCV_TELINK_B91=y
CONFIG_BOARD_TLSR9518ADK80D=y
CONFIG_GPIO=y
CONFIG_SYS_CLOCK_TICKS_PER_SEC=1000
CONFIG_HEAP_MEM_POOL_SIZE=4096
CONFIG_UART_INTERRUPT_DRIVEN=y
CONFIG_SERIAL=y
CONFIG_CONSOLE=y
CONFIG_UART_CONSOLE=y

# HW DSP options
CONFIG_TELINK_B91_HWDSP=n

# MCU boot application options
CONFIG_MCUBOOT_SIGNATURE_KEY_FILE="bootloader/mcuboot/root-rsa-2048.pem"
CONFIG_MCUBOOT_EXTRA_IMGTOOL_ARGS="--max-sectors 4096"
```

## boards/riscv/tlsr9528a/Kconfig.board
```kconfig
# Copyright (c) 2023 Telink Semiconductor
# SPDX-License-Identifier: Apache-2.0

config BOARD_TLSR9528A
	bool "Telink B92 Platform"
	depends on SOC_RISCV_TELINK_B92

config BOARD_TLSR9528A_RETENTION
	bool "Telink B92 Platform with retention"
	depends on SOC_RISCV_TELINK_B92
```

## boards/riscv/tlsr9528a/tlsr9528a_defconfig
```kconfig
# Copyright (c) 2023 Telink Semiconductor
# SPDX-License-Identifier: Apache-2.0

CONFIG_SOC_SERIES_RISCV_TELINK_B9x=y
CONFIG_SOC_RISCV_TELINK_B92=y
CONFIG_BOARD_TLSR9528A=y
CONFIG_GPIO=y
CONFIG_SYS_CLOCK_TICKS_PER_SEC=1000
CONFIG_HEAP_MEM_POOL_SIZE=4096
CONFIG_UART_INTERRUPT_DRIVEN=y
CONFIG_SERIAL=y
CONFIG_CONSOLE=y
CONFIG_UART_CONSOLE=y

# HW DSP options
CONFIG_TELINK_B9x_HWDSP=n
```

## boards/riscv/visionfive2_jh7110/Kconfig.board
```kconfig
# Copyright (c) 2024 Kanak Shilledar <kanakshilledar111@protonmail.com>
# SPDX-License-Identifier: Apache-2.0

config BOARD_VISIONFIVE2_JH7110
        bool "VISIONFIVE2 JH7110 RISCV64 target"
        depends on SOC_JH7110
        select 64BIT
```

## boards/riscv/visionfive2_jh7110/Kconfig.defconfig
```kconfig
# Copyright (c) 2024 Pratik Farkase <pratik.farkase@wsisweden.com> 
# Copyright (c) 2024 Sigma Connectivity WSI AB

# SPDX-License-Identifier: Apache-2.0


config BOARD
        default "visionfive2_jh7110"
        depends on BOARD_VISIONFIVE2_JH7110
```

## boards/riscv/visionfive2_jh7110/board.yml
```yaml
# Copyright (c) 2024 Kanak Shilledar <kanakshilledar111@protonmail.com>
# SPDX-License-Identifier: Apache-2.0
 
board:
  name: StarFive VisionFive 2
  vendor: StarFive Tech
  revision:
    format: major.minor|letter
    default: 1.3B
    revisions:
    - name: 1.3B
  socs:
  - name: JH7110
```

## boards/riscv/xiao_esp32c3/Kconfig.board
```kconfig
# Copyright 2022 Google LLC
# SPDX-License-Identifier: Apache-2.0

config BOARD_XIAO_ESP32C3
	bool "XIAO ESP32C3 Board"
	depends on SOC_SERIES_ESP32C3

choice SOC_PART_NUMBER
	default SOC_ESP32C3_FX4
endchoice
```

## boards/riscv/xiao_esp32c3/Kconfig.defconfig
```kconfig
# Copyright 2022 Google LLC
# SPDX-License-Identifier: Apache-2.0

config BOARD
	default "xiao_esp32c3"
	depends on BOARD_XIAO_ESP32C3

config HEAP_MEM_POOL_SIZE
	default 98304 if WIFI
	default 40960 if BT
	default 4096

choice BT_HCI_BUS_TYPE
	default BT_ESP32 if BT
endchoice
```

## boards/riscv32/arty/arty_defconfig
```kconfig
CONFIG_RISCV32=y
CONFIG_SOC_SERIES_RISCV32_GOTHAM=y
CONFIG_SOC_RISCV32_GOTHAM=y
CONFIG_BOARD_ARTY=y

# UART
CONFIG_SERIAL=y
CONFIG_SERIAL_HAS_DRIVER=y
CONFIG_UART_GOTHAM=y

# enable console
CONFIG_CONSOLE=y
CONFIG_UART_CONSOLE=y
```

## boards/riscv32/arty_bm310/Kconfig.board
```kconfig
config BOARD_ARTY_BM310
	bool "Arty BM-310 target"
	depends on SOC_RISCV32_CLOUDBEAR_BM310
```

## boards/riscv32/arty_bm310/Kconfig.defconfig
```kconfig
if BOARD_ARTY_BM310

config BOARD
	default "arty_bm310"

config BEAR_PERIPH_CLK_FREQ
	int
	default 25000000

config BEAR_UART_IRQ_PRIORITY
	int
	default 1

endif
```

## boards/riscv32/arty_bm310/arty_bm310_defconfig
```kconfig
CONFIG_RISCV32=y
CONFIG_SOC_SERIES_RISCV32_CLOUDBEAR_BM310=y
CONFIG_SOC_RISCV32_CLOUDBEAR_BM310=y
CONFIG_BOARD_ARTY_BM310=y
CONFIG_CONSOLE=y
CONFIG_PRINTK=y
CONFIG_SERIAL=y
CONFIG_UART_DRV_CMD=y
CONFIG_UART_CLOUDBEAR=y
CONFIG_UART_CONSOLE=y
CONFIG_XIP=n
CONFIG_PLIC=y
CONFIG_RISCV_MACHINE_TIMER=y
CONFIG_BOOT_BANNER=y
```

## boards/riscv32/hifive1/Kconfig.board
```kconfig
config BOARD_HIFIVE1
	bool "HiFive1 target"
	depends on SOC_RISCV32_SIFIVE_FREEDOM
	select HAS_DTS
```

## boards/riscv32/hifive1/Kconfig.defconfig
```kconfig
# SPDX-License-Identifier: Apache-2.0

if BOARD_HIFIVE1

config BOARD
	default "hifive1"

if PWM

config PWM_SIFIVE
	def_bool y

endif

endif
```

## boards/riscv32/hifive1/hifive1_defconfig
```kconfig
CONFIG_RISCV32=y
CONFIG_SOC_SERIES_RISCV32_SIFIVE_FREEDOM=y
CONFIG_SOC_RISCV32_SIFIVE_FREEDOM=y
CONFIG_BOARD_HIFIVE1=y
CONFIG_CONSOLE=y
CONFIG_PRINTK=y
CONFIG_SERIAL=y
CONFIG_UART_SIFIVE=y
CONFIG_UART_SIFIVE_PORT_0=y
CONFIG_UART_CONSOLE=y
CONFIG_PLIC=y
CONFIG_PINMUX=y
CONFIG_PINMUX_SIFIVE=y
CONFIG_RISCV_MACHINE_TIMER=y
CONFIG_GPIO=y
CONFIG_GPIO_SIFIVE=y
CONFIG_BOOT_BANNER=y
```

## boards/riscv32/hifive1_revb/Kconfig.defconfig
```kconfig
# Copyright (c) 2019 SiFive Inc.
# SPDX-License-Identifier: Apache-2.0
if BOARD_HIFIVE1_REVB

config BOARD
	default "hifive1_revb"

config HAS_FLASH_LOAD_OFFSET
	default y

config FLASH_BASE_ADDRESS
	default $(dt_hex_val,DT_FLASH_BASE_ADDRESS)

config FLASH_LOAD_OFFSET
	default 0x0

if PWM
config PWM_SIFIVE
	default y
endif

if SPI
config SPI_SIFIVE
	default y
endif

if I2C
config I2C_SIFIVE
	default y
endif

config HAS_DTS_I2C
	default y

endif
```

## boards/riscv32/litex_vexriscv/litex_vexriscv_defconfig
```kconfig
#
# Copyright (c) 2019 Antmicro <www.antmicro.com>
#
# SPDX-License-Identifier: Apache-2.0
#

CONFIG_RISCV32=y
CONFIG_SOC_RISCV32_LITEX_VEXRISCV=y
CONFIG_BOARD_LITEX_VEXRISCV=y
CONFIG_VEXRISCV_LITEX_IRQ=y
CONFIG_LITEX_TIMER=y
CONFIG_CONSOLE=y
CONFIG_SERIAL=y
CONFIG_UART_LITEUART=y
CONFIG_UART_LITEUART_PORT_0=y
CONFIG_UART_CONSOLE=y
```
