/*
 * Copyright (c) 2020 Nordic Semiconductor ASA
 *
 * SPDX-License-Identifier: Apache-2.0
 */

/ {
	zephyr,fixture {
		gpio-loopback {
			compatible = "zephyr,fixture,gpio-loopback";
			out-gpios = <&arduino_header 4 0>; /* Arduino A4 */
			in-gpios = <&arduino_header 5 0>;  /* Arduino A5 */
		};
	};
};
