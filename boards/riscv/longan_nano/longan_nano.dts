/*
 * Copyright (c) 2021 Tokita, Hiroshi <tokita.hiroshi@gmail.com>
 *
 * SPDX-License-Identifier: Apache-2.0
 */

/dts-v1/;
#include <gigadevice/gd32vf103Xb.dtsi>

/ {
	model = "Sipeed Longan Nano";
	compatible = "sipeed,longan_nano";

	chosen {
		zephyr,sram = &sram0;
		zephyr,flash = &flash0;
	};
};
