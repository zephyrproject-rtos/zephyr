## boards/riscv/litex_vexriscv/Kconfig.litex_vexriscv
```kconfig
# Copyright (c) 2022 Zephyr Project members and individual contributors
# SPDX-License-Identifier: Apache-2.0

config BOARD_LITEX_VEXRISCV
	bool
	default y
	select SOC_RISCV32_LITEX_VEXRISCV
```

## boards/riscv/litex_vexriscv/litex_vexriscv_defconfig
```kconfig
#
# Copyright (c) 2019 Antmicro <www.antmicro.com>
#
# SPDX-License-Identifier: Apache-2.0
#

CONFIG_SOC_RISCV32_LITEX_VEXRISCV=y
CONFIG_BOARD_LITEX_VEXRISCV=y
CONFIG_CONSOLE=y
CONFIG_SERIAL=y
CONFIG_UART_CONSOLE=y
CONFIG_GPIO=y
CONFIG_XIP=n
CONFIG_CLOCK_CONTROL=y
CONFIG_HEAP_MEM_POOL_SIZE=4096
```

## boards/riscv/longan_nano/Kconfig.defconfig
```kconfig
# Sipeed longan nano Development Board Configuration

# Copyright (c) 2021 Tokita, Hiroshi <tokita.hiroshi@gmail.com>

config DISK_DRIVER_SDMMC
	default y if DISK_DRIVERS
```

## boards/riscv/longan_nano/Kconfig.longan_nano
```kconfig
# Copyright (c) 2022 Zephyr Project members and individual contributors
# SPDX-License-Identifier: Apache-2.0

config BOARD_LONGAN_NANO
	bool
	default y
	select SOC_SERIES_GD32VF103
	select SOC_GD32VF103
```

## boards/riscv/longan_nano/longan_nano_defconfig
```kconfig
# Sipeed longan nano Development Board Configuration
#
# Copyright (c) 2021 Tokita, Hiroshi <tokita.hiroshi@gmail.com>
#
# SPDX-License-Identifier: Apache-2.0

CONFIG_SOC_SERIES_GD32VF103=y
CONFIG_SOC_GD32VF103=y
CONFIG_BOARD_LONGAN_NANO=y

CONFIG_GD32_HXTAL_8MHZ=y
CONFIG_RISCV_MACHINE_TIMER=y

CONFIG_SERIAL=y
CONFIG_UART_INTERRUPT_DRIVEN=y

CONFIG_CONSOLE=y
CONFIG_UART_CONSOLE=y

CONFIG_GPIO=y
```

## boards/riscv/longan_nano/longan_nano_lite_defconfig
```kconfig
# Sipeed Longan Nano Lite board Configuration
#
# Copyright (c) 2021 Tokita, Hiroshi <tokita.hiroshi@gmail.com>
#
# SPDX-License-Identifier: Apache-2.0

CONFIG_SOC_SERIES_GD32VF103=y
CONFIG_SOC_GD32VF103=y
CONFIG_BOARD_LONGAN_NANO_LITE=y

CONFIG_GD32_HXTAL_8MHZ=y

CONFIG_SERIAL=y
CONFIG_UART_INTERRUPT_DRIVEN=y

CONFIG_CONSOLE=y
CONFIG_UART_CONSOLE=y

CONFIG_GPIO=y
```

## boards/riscv/m2gl025_miv/Kconfig.board
```kconfig
# Microsemi M2GL025 IGLOO2 dev board with Mi-V CPU

# SPDX-License-Identifier: Apache-2.0

config BOARD_M2GL025_MIV
	def_bool "$(BOARD)" = "m2gl025_miv"
	depends on SOC_RISCV32_MIV
```

## boards/riscv/m2gl025_miv/Kconfig.defconfig
```kconfig
# SPDX-License-Identifier: Apache-2.0

config BOARD
	default "m2gl025_miv"
	depends on BOARD_M2GL025_MIV
```

## boards/riscv/m2gl025_miv/Kconfig.m2gl025_miv
```kconfig
# Copyright (c) 2022 Zephyr Project members and individual contributors
# SPDX-License-Identifier: Apache-2.0

config BOARD_M2GL025_MIV
	bool
	default y
	select SOC_SERIES_RISCV32_MIV
	select SOC_RISCV32_MIV
```

## boards/riscv/mpfs_icicle/Kconfig
```kconfig
# Icicle board configuration

# Copyright (c) 2020 Tobias Svehagen
# SPDX-License-Identifier: Apache-2.0

config BOARD_USE_DDR
	bool "Enable running in DDR instead of LIM"
	select SOC_ICICLE_IN_DDR
	default n
	depends on BOARD_MPFS_ICICLE
	
	
	
```

## boards/riscv/mpfs_icicle/Kconfig.board
```kconfig
# Copyright (c) 2021-2022 Microchip Technology Inc
# SPDX-License-Identifier: Apache-2.0

config BOARD_MPFS_ICICLE
	bool "Microchip PolarFire SoC ICICLE kit"
	depends on SOC_MPFS
	select 64BIT
	select SCHED_IPI_SUPPORTED
	select CPU_HAS_FPU_DOUBLE_PRECISION
```

## boards/riscv/mpfs_icicle/Kconfig.defconfig
```kconfig
# Copyright (c) 2020-2021 Microchip Technology Inc
# SPDX-License-Identifier: Apache-2.0

config BOARD
	default "mpfs_icicle"
	depends on BOARD_MPFS_ICICLE
```

## boards/riscv/mpfs_icicle/Kconfig.mpfs_icicle
```kconfig
# Copyright (c) 2022 Zephyr Project members and individual contributors
# SPDX-License-Identifier: Apache-2.0

config BOARD_MPFS_ICICLE
	bool
	default y
	select SOC_SERIES_RISCV64_MIV
	select SOC_MPFS
	select 64BIT
	select SCHED_IPI_SUPPORTED
	select CPU_HAS_FPU_DOUBLE_PRECISION
```

## boards/riscv/mpfs_icicle/mpfs_icicle_defconfig
```kconfig
# Copyright (c) 2020-2021 Microchip Technology Inc
# SPDX-License-Identifier: Apache-2.0

CONFIG_SOC_SERIES_RISCV64_MIV=y
CONFIG_SOC_MPFS=y
CONFIG_MPFS_HAL=n
CONFIG_BASE64=y
CONFIG_INCLUDE_RESET_VECTOR=y
CONFIG_BOARD_MPFS_ICICLE=y
CONFIG_NO_OPTIMIZATIONS=y
CONFIG_CONSOLE=y
CONFIG_SERIAL=y
CONFIG_UART_CONSOLE=y
CONFIG_RISCV_SOC_INTERRUPT_INIT=y
CONFIG_RISCV_HAS_PLIC=y
CONFIG_XIP=n
CONFIG_INIT_STACKS=y
CONFIG_SYS_CLOCK_TICKS_PER_SEC=1000
CONFIG_FPU=n
# GPIO driver options
CONFIG_GPIO=y
```

## boards/riscv/neorv32/Kconfig.defconfig
```kconfig
# Copyright (c) 2021 Henrik Brix Andersen <henrik@brixandersen.dk>
# SPDX-License-Identifier: Apache-2.0

if BOARD_NEORV32

config BOARD
	default "neorv32"

endif # BOARD_NEORV32
```

## boards/riscv/neorv32/Kconfig.neorv32
```kconfig
# Copyright (c) 2022 Zephyr Project members and individual contributors
# SPDX-License-Identifier: Apache-2.0

config BOARD_NEORV32
	bool
	default y
	select SOC_SERIES_NEORV32
	select SOC_NEORV32_ISA_C
```

## boards/riscv/neorv32/neorv32_defconfig
```kconfig
# Copyright (c) 2021 Henrik Brix Andersen <henrik@brixandersen.dk>
# SPDX-License-Identifier: Apache-2.0

CONFIG_SOC_SERIES_NEORV32=y
CONFIG_SOC_NEORV32_ISA_C=y
CONFIG_BOARD_NEORV32=y
CONFIG_RISCV_MACHINE_TIMER=y
CONFIG_SERIAL=y
CONFIG_CONSOLE=y
CONFIG_UART_CONSOLE=y
CONFIG_UART_INTERRUPT_DRIVEN=y
CONFIG_GPIO=y
```

## boards/riscv/niosv_g/niosv_g_defconfig
```kconfig
# Copyright (C) 2023, Intel Corporation
# SPDX-License-Identifier: Apache-2.0

CONFIG_SOC_SERIES_NIOSV=y
CONFIG_SOC_NIOSV_G=y
CONFIG_BOARD_NIOSV_G=y
CONFIG_CONSOLE=y
CONFIG_PRINTK=y
CONFIG_SERIAL=y
CONFIG_UART_CONSOLE=y
CONFIG_XIP=n
```

## boards/riscv/niosv_m/Kconfig.board
```kconfig
# Copyright (C) 2023, Intel Corporation
# SPDX-License-Identifier: Apache-2.0

config BOARD_NIOSV_M
	bool "Intel FPGA NIOSV Microcontroller Core Processor"
	depends on SOC_NIOSV_M
```

## boards/riscv/niosv_m/Kconfig.defconfig
```kconfig
# Copyright (C) 2023, Intel Corporation
# SPDX-License-Identifier: Apache-2.0

if BOARD_NIOSV_M

config BOARD
	default "niosv_m"

endif # BOARD_NIOSV_M
```

## boards/riscv/nrf54h20dk_nrf54h20/Kconfig.board
```kconfig
# Copyright (c) 2024 Nordic Semiconductor ASA
# SPDX-License-Identifier: Apache-2.0

config BOARD_NRF54H20DK_NRF54H20_CPUPPR
	bool "nRF54H20 DK nRF54H20 PPR MCU"
	depends on SOC_NRF54H20_CPUPPR

config BOARD_NRF54H20DK_NRF54H20_CPUPPR_RAM
	bool "nRF54H20 DK nRF54H20 PPR MCU (executing from RAM)"
	depends on SOC_NRF54H20_CPUPPR
```

## boards/riscv/nrf54h20dk_nrf54h20/Kconfig.defconfig
```kconfig
# Copyright (c) 2024 Nordic Semiconductor ASA
# SPDX-License-Identifier: Apache-2.0

config BOARD
	default "nrf54h20dk_nrf54h20_cpuppr"
	depends on BOARD_NRF54H20DK_NRF54H20_CPUPPR || BOARD_NRF54H20DK_NRF54H20_CPUPPR_RAM
```

## boards/riscv/nrf54h20pdk_nrf54h20/Kconfig.defconfig
```kconfig
# Copyright (c) 2024 Nordic Semiconductor ASA
# SPDX-License-Identifier: Apache-2.0

config BOARD
	default "nrf54h20pdk_nrf54h20_cpuppr"
	depends on BOARD_NRF54H20PDK_NRF54H20_CPUPPR
```

## boards/riscv/nrf54h20pdk_nrf54h20/nrf54h20pdk_nrf54h20_cpuppr_defconfig
```kconfig
# Copyright (c) 2024 Nordic Semiconductor ASA
# SPDX-License-Identifier: Apache-2.0

CONFIG_SOC_SERIES_NRF54HX=y
CONFIG_SOC_NRF54H20=y
CONFIG_SOC_NRF54H20_ENGA_CPUPPR=y
CONFIG_BOARD_NRF54H20PDK_NRF54H20_CPUPPR=y

CONFIG_USE_DT_CODE_PARTITION=y

CONFIG_SERIAL=y

CONFIG_CONSOLE=y
CONFIG_UART_CONSOLE=y
```

## boards/riscv/opentitan_earlgrey/Kconfig.board
```kconfig
# Copyright (c) 2023 by Rivos Inc.
# SPDX-License-Identifier: Apache-2.0

config BOARD_OPENTITAN_EARLGREY
	bool "OpenTitan Earl Grey Target"
	depends on SOC_RISCV_OPENTITAN
```
