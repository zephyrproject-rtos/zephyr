/*
 * Copyright (c) 2023-2024 Telink Semiconductor
 *
 * SPDX-License-Identifier: Apache-2.0
 */

/dts-v1/;

#include "tlsr9518adk80d-common.dtsi"

zephyr_udc0: &usbd {
	status = "okay";
};

&wdt {
	status = "okay";
};
