/*
 * Copyright (c) 2023-2024 Telink Semiconductor
 *
 * SPDX-License-Identifier: Apache-2.0
 */

/dts-v1/;

#include "tlsr9528a-common.dtsi"

zephyr_udc0: &usbd {
	status = "okay";
};

&wdt {
	status = "okay";
};
