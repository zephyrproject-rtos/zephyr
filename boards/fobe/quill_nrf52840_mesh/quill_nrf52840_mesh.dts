/*
 * Copyright (c) 2025 Chiho Sin
 *
 * SPDX-License-Identifier: Apache-2.0
 */

/dts-v1/;
#include "quill_nrf52840_mesh_common.dtsi"

/ {
	model = "FoBE Quill nRF52840 Mesh";
	compatible = "fobe,quill-nrf52840-mesh";
};
