/*
 * Copyright (c) 2023 Panasonic Industrial Devices Europe GmbH
 *
 * SPDX-License-Identifier: Apache-2.0
 */

/dts-v1/;
#include <nordic/nrf5340_cpunet_qkaa.dtsi>
#include "pan1783_nrf5340_cpunet_common.dtsi"

/ {
	model = "Panasonic PAN1783 EVB (NRF5340) Network";
	compatible = "panasonic,pan1783-evb-cpunet";

	chosen {
		zephyr,sram = &sram1;
		zephyr,flash = &flash1;
		zephyr,code-partition = &slot0_partition;
	};
};

/* Include shared RAM configuration file */
#include "pan1783_nrf5340_shared_sram_planning_conf.dtsi"
