## boards/panasonic/pan1783/Kconfig.defconfig
```kconfig
# PAN1783 EVB board configuration

# Copyright (c) 2023 Panasonic Industrial Devices Europe GmbH
# SPDX-License-Identifier: Apache-2.0

if SOC_NRF5340_CPUAPP_QKAA

config BT_HCI_IPC
	default y if BT

config HEAP_MEM_POOL_ADD_SIZE_BOARD
	int
	default 4096 if BT_HCI_IPC

endif # SOC_NRF5340_CPUAPP_QKAA

if SOC_NRF5340_CPUNET_QKAA

endif # SOC_NRF5340_CPUNET_QKAA
```

## boards/panasonic/pan1783/Kconfig.pan1783_evb
```kconfig
# PAN1783 EVB board configuration

# Copyright (c) 2023 Panasonic Industrial Devices Europe GmbH
# SPDX-License-Identifier: Apache-2.0

config BOARD_PAN1783_EVB
	select SOC_NRF5340_CPUAPP_QKAA if BOARD_PAN1783_EVB_NRF5340_CPUAPP
	select SOC_NRF5340_CPUNET_QKAA if BOARD_PAN1783_EVB_NRF5340_CPUNET
```

## boards/panasonic/pan1783/Kconfig.sysbuild
```kconfig
# Sysbuild configuration
# Copyright (c) 2024 Embeint Inc

config DOMAIN_CPUNET_BOARD
	string
	default "pan1783_evb/nrf5340/cpunet" if BOARD_PAN1783_EVB
	default "pan1783a_evb/nrf5340/cpunet" if BOARD_PAN1783A_EVB
	default "pan1783a_pa_evb/nrf5340/cpunet" if BOARD_PAN1783A_PA_EVB
	help
	  The board which will be used for CPUNET domain when creating a multi
	  image application where one or more images should be located on
	  another board. For example hci_ipc for Bluetooth applications.
```

## boards/panasonic/pan1783/board.yml
```yaml
boards:
- name: pan1783_evb
  full_name: PAN1783 Evaluation Board
  vendor: panasonic
  socs:
  - name: nrf5340
- name: pan1783a_evb
  full_name: PAN1783A Evaluation Board
  vendor: panasonic
  socs:
  - name: nrf5340
- name: pan1783a_pa_evb
  full_name: PAN1783A-PA Evaluation Board
  vendor: panasonic
  socs:
  - name: nrf5340
```

## boards/panasonic/pan1783/pan1783_evb_nrf5340_cpunet_defconfig
```kconfig
# SPDX-License-Identifier: Apache-2.0

# Enable MPU
CONFIG_ARM_MPU=y

# Enable hardware stack protection
CONFIG_HW_STACK_PROTECTION=y

# Enable GPIO
CONFIG_GPIO=y

# Clock config
CONFIG_CLOCK_CONTROL_NRF_K32SRC_RC=y
CONFIG_CLOCK_CONTROL_NRF_K32SRC_XTAL=n
```

## boards/panasonic/panb511evb/Kconfig.defconfig
```kconfig
# Copyright (c) 2025 Panasonic Industrial Devices Europe GmbH
# SPDX-License-Identifier: Apache-2.0

if BOARD_PANB511EVB_NRF54L15_CPUAPP

config ROM_START_OFFSET
	default 0x800 if BOOTLOADER_MCUBOOT

endif # BOARD_PANB511EVB_NRF54L15_CPUAPP
```

## boards/panasonic/panb511evb/Kconfig.panb511evb
```kconfig
# Copyright (c) 2025 Panasonic Industrial Devices Europe GmbH
# SPDX-License-Identifier: Apache-2.0

config BOARD_PANB511EVB
	select SOC_NRF54L15_CPUAPP if BOARD_PANB511EVB_NRF54L15_CPUAPP
	select SOC_NRF54L15_CPUFLPR if BOARD_PANB511EVB_NRF54L15_CPUFLPR || \
					    BOARD_PANB511EVB_NRF54L15_CPUFLPR_XIP
```

## boards/panasonic/panb511evb/board.yml
```yaml
board:
  name: panb511evb
  full_name: PAN B511 Evaluation Board
  vendor: panasonic
  socs:
  - name: nrf54l15
    variants:
    - name: xip
      cpucluster: cpuflpr
    - name: ns
      cpucluster: cpuapp
runners:
  run_once:
    '--recover':
    - runners:
      - nrfjprog
      - nrfutil
      run: first
      groups:
      - boards:
        - panb511evb/nrf54l15/cpuapp
        - panb511evb/nrf54l15/cpuapp/ns
        - panb511evb/nrf54l15/cpuflpr
        - panb511evb/nrf54l15/cpuflpr/xip
    '--erase':
    - runners:
      - nrfjprog
      - jlink
      - nrfutil
      run: first
      groups:
      - boards:
        - panb511evb/nrf54l15/cpuapp
        - panb511evb/nrf54l15/cpuapp/ns
        - panb511evb/nrf54l15/cpuflpr
        - panb511evb/nrf54l15/cpuflpr/xip
    '--reset':
    - runners:
      - nrfjprog
      - jlink
      - nrfutil
      run: last
      groups:
      - boards:
        - panb511evb/nrf54l15/cpuapp
        - panb511evb/nrf54l15/cpuapp/ns
        - panb511evb/nrf54l15/cpuflpr
        - panb511evb/nrf54l15/cpuflpr/xip
```

## boards/panasonic/panb611evb/Kconfig
```kconfig
# Copyright (c) 2025 Panasonic Industrial Devices Europe GmbH
# SPDX-License-Identifier: Apache-2.0

# PANB611EVB configuration

if BOARD_PANB611EVB_NRF54L15_CPUAPP_NS

DT_NRF_MPC := $(dt_nodelabel_path,nrf_mpc)

config NRF_TRUSTZONE_FLASH_REGION_SIZE
	hex
	default $(dt_node_int_prop_hex,$(DT_NRF_MPC),override-granularity)
	help
	  This defines the flash region size from the TrustZone perspective.
	  It is used when configuring the TrustZone and when setting alignments
	  requirements for the partitions.
	  This abstraction allows us to configure TrustZone without depending
	  on peripheral-specific symbols.

config NRF_TRUSTZONE_RAM_REGION_SIZE
	hex
	default $(dt_node_int_prop_hex,$(DT_NRF_MPC),override-granularity)
	help
	  This defines the RAM region size from the TrustZone perspective.
	  It is used when configuring the TrustZone and when setting alignments
	  requirements for the partitions.
	  This abstraction allows us to configure TrustZone without depending
	  on peripheral specific symbols.

endif # BOARD_PANB611EVB_NRF54L15_CPUAPP_NS
```

## boards/panasonic/panb611evb/Kconfig.defconfig
```kconfig
# Copyright (c) 2025 Panasonic Industrial Devices Europe GmbH
# SPDX-License-Identifier: Apache-2.0

if BOARD_PANB611EVB_NRF54L15_CPUAPP_NS

config BOARD_PANB611EVB
	select USE_DT_CODE_PARTITION

config HAS_BT_CTLR
	default BT

# By default, if we build for a Non-Secure version of the board,
# enable building with TF-M as the Secure Execution Environment.
config BUILD_WITH_TFM
	default y

endif # BOARD_PANB611EVB_NRF54L15_CPUAPP_NS
```

## boards/panasonic/panb611evb/Kconfig.panb611evb
```kconfig
# Copyright (c) 2025 Panasonic Industrial Devices Europe GmbH
# SPDX-License-Identifier: Apache-2.0

config BOARD_PANB611EVB
	select SOC_NRF54L15_CPUAPP if BOARD_PANB611EVB_NRF54L15_CPUAPP || BOARD_PANB611EVB_NRF54L15_CPUAPP_NS
	select SOC_NRF54L15_CPUFLPR if BOARD_PANB611EVB_NRF54L15_CPUFLPR || \
					    BOARD_PANB611EVB_NRF54L15_CPUFLPR_XIP
```

## boards/panasonic/panb611evb/board.yml
```yaml
board:
  name: panb611evb
  full_name: PAN B611 Evaluation Board
  vendor: panasonic
  socs:
  - name: nrf54l15
    variants:
    - name: xip
      cpucluster: cpuflpr
    - name: ns
      cpucluster: cpuapp
runners:
  run_once:
    '--recover':
    - runners:
      - nrfjprog
      - nrfutil
      run: first
      groups:
      - boards:
        - panb611evb/nrf54l15/cpuapp
        - panb611evb/nrf54l15/cpuapp/ns
        - panb611evb/nrf54l15/cpuflpr
        - panb611evb/nrf54l15/cpuflpr/xip
    '--erase':
    - runners:
      - nrfjprog
      - jlink
      - nrfutil
      run: first
      groups:
      - boards:
        - panb611evb/nrf54l15/cpuapp
        - panb611evb/nrf54l15/cpuapp/ns
        - panb611evb/nrf54l15/cpuflpr
        - panb611evb/nrf54l15/cpuflpr/xip
    '--reset':
    - runners:
      - nrfjprog
      - jlink
      - nrfutil
      run: last
      groups:
      - boards:
        - panb611evb/nrf54l15/cpuapp
        - panb611evb/nrf54l15/cpuapp/ns
        - panb611evb/nrf54l15/cpuflpr
        - panb611evb/nrf54l15/cpuflpr/xip
```

## boards/panasonic/panb611evb/panb611evb_nrf54l15_cpuflpr_xip_defconfig
```kconfig
# Copyright (c) 2025 Panasonic Industrial Devices Europe GmbH
# SPDX-License-Identifier: Apache-2.0

# Enable UART driver
CONFIG_SERIAL=y

# Enable console
CONFIG_CONSOLE=y
CONFIG_UART_CONSOLE=y

# Enable GPIO
CONFIG_GPIO=y

# Execute from RRAM
CONFIG_XIP=y
```

## boards/particle/argon/board.yml
```yaml
board:
  name: particle_argon
  full_name: Argon
  vendor: particle
  socs:
  - name: nrf52840
```

## boards/particle/argon/particle_argon_defconfig
```kconfig
#
# Copyright (c) 2018 Matthias Boesl
# Copyright (c) 2018 Peter Bigot Consulting, LLC
#
# SPDX-License-Identifier: Apache-2.0

# Enable MPU
CONFIG_ARM_MPU=y

# enable GPIO
CONFIG_GPIO=y

# enable uart driver
CONFIG_SERIAL=y

# enable console
CONFIG_CONSOLE=y
CONFIG_UART_CONSOLE=y
```

## boards/particle/boron/Kconfig
```kconfig
# Particle Boron configuration

# Copyright (c) 2018 Peter Bigot Consulting, LLC
# SPDX-License-Identifier: Apache-2.0

config BOARD_ENABLE_DCDC
	bool "DCDC mode"
	select SOC_DCDC_NRF52X
	default y
	depends on BOARD_PARTICLE_BORON
```

## boards/particle/boron/Kconfig.defconfig
```kconfig
# Particle Boron board configuration

# Copyright (c) 2018 Peter Bigot Consulting, LLC
# SPDX-License-Identifier: Apache-2.0

if BOARD_PARTICLE_BORON

config BT_CTLR
	default BT

if MODEM

config MODEM_UBLOX_SARA
	default y

choice MODEM_UBLOX_SARA_VARIANT
	default MODEM_UBLOX_SARA_R4
endchoice

config UART_INTERRUPT_DRIVEN
	default y

endif # MODEM

endif # BOARD_PARTICLE_BORON
```

## boards/particle/boron/Kconfig.particle_boron
```kconfig
# Particle Boron configuration

# Copyright (c) 2018 Peter Bigot Consulting, LLC
# SPDX-License-Identifier: Apache-2.0

config BOARD_PARTICLE_BORON
	select SOC_NRF52840_QIAA
```

## boards/particle/boron/board.yml
```yaml
board:
  name: particle_boron
  full_name: Boron
  vendor: particle
  socs:
  - name: nrf52840
```

## boards/particle/boron/particle_boron_defconfig
```kconfig
#
# Copyright (c) 2018 Peter Bigot Consulting, LLC
#
# SPDX-License-Identifier: Apache-2.0

# Enable MPU
CONFIG_ARM_MPU=y

# enable GPIO
CONFIG_GPIO=y

# enable uart driver
CONFIG_SERIAL=y

# enable console
CONFIG_CONSOLE=y
CONFIG_UART_CONSOLE=y

# Fix the priority to enable the modem line's serial buffer
# before the modem driver starts (gsm_ppp or ublox-sara-r4).
CONFIG_REGULATOR=y
CONFIG_REGULATOR_FIXED_INIT_PRIORITY=41
```

## boards/particle/nrf51_blenano/Kconfig.defconfig
```kconfig
# nRF51 BLENANO board configuration

# Copyright (c) 2016 Nordic Semiconductor ASA
# SPDX-License-Identifier: Apache-2.0

if BOARD_NRF51_BLENANO

config BT_CTLR
	default BT

endif # BOARD_NRF51_BLENANO
```

## boards/particle/nrf51_blenano/Kconfig.nrf51_blenano
```kconfig
# nRF51 BLENANO board configuration

# Copyright (c) 2016 Linaro Limited.
# SPDX-License-Identifier: Apache-2.0

config BOARD_NRF51_BLENANO
	select SOC_NRF51822_QFAA
```

## boards/particle/nrf51_blenano/board.yml
```yaml
board:
  name: nrf51_blenano
  full_name: Redbear Labs Nano
  vendor: particle
  socs:
  - name: nrf51822
```
