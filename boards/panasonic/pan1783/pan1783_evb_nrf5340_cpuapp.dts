/*
 * Copyright (c) 2023 Panasonic Industrial Devices Europe GmbH
 *
 * SPDX-License-Identifier: Apache-2.0
 */

/dts-v1/;
#include <nordic/nrf5340_cpuapp_qkaa.dtsi>
#include "pan1783_nrf5340_cpuapp_common.dtsi"

/ {
	model = "Panasonic PAN1783 EVB (NRF5340) Application";
	compatible = "panasonic,pan1783-evb-cpuapp";

	chosen {
		zephyr,sram = &sram0_image;
		zephyr,flash = &flash0;
		zephyr,code-partition = &slot0_partition;
		zephyr,sram-secure-partition = &sram0_s;
	};
};

/* Include default memory partition configuration file */
#include <nordic/nrf5340_cpuapp_partition.dtsi>
