/*
 * Copyright (c) 2023 Panasonic Industrial Devices Europe GmbH
 *
 * SPDX-License-Identifier: Apache-2.0
 */

/dts-v1/;
#include <nordic/nrf5340_cpunet_qkaa.dtsi>
#include "pan1783_nrf5340_cpunet_common.dtsi"

/ {
	model = "Panasonic PAN1783A EVB (NRF5340) Network";
	compatible = "panasonic,pan1783a-evb-cpunet";

	chosen {
		zephyr,sram = &sram1;
		zephyr,flash = &flash1;
		zephyr,code-partition = &slot0_partition;
	};
};

/* Include default shared RAM configuration file */
#include <common/nordic/nrf5340_shared_sram_partition.dtsi>
