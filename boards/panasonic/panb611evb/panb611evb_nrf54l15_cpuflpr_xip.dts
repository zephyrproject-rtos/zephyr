/*
 * Copyright (c) 2025 Panasonic Industrial Devices Europe GmbH
 *
 * SPDX-License-Identifier: Apache-2.0
 */

#include "panb611evb_nrf54l15_cpuflpr.dts"

&cpuflpr_sram {
	reg = <0x2002ec00 DT_SIZE_K(68)>;
	ranges = <0x0 0x2002ec00 0x11000>;
};
