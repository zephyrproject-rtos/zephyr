/*
 * Copyright (c) 2025 Panasonic Industrial Devices Europe GmbH
 *
 * SPDX-License-Identifier: Apache-2.0
 */

/dts-v1/;

#include <nordic/nrf54l15_cpuapp.dtsi>
#include "panb611evb_nrf54l15_cpuapp_common.dtsi"

/ {
	compatible = "panasonic-industrial-devices-europe-gmbh,panb611evb-cpuapp";
	model = "Panasonic PAN B611 EVB nRF54L15 Application MCU";

	chosen {
		zephyr,code-partition = &slot0_partition;
		zephyr,sram = &cpuapp_sram;
	};
};

/* Include default memory partition configuration file */
#include <nordic/nrf54l15_partition.dtsi>
