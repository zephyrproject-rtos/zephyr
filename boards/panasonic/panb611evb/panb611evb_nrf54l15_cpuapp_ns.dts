/*
 * Copyright (c) 2025 Panasonic Industrial Devices Europe GmbH
 *
 * SPDX-License-Identifier: Apache-2.0
 */

/dts-v1/;

#define USE_NON_SECURE_ADDRESS_MAP 1

#include <arm/nordic/nrf54l15_cpuapp_ns.dtsi>
#include "panb611evb_nrf54l15_cpuapp_common.dtsi"

/ {
	model = "Panasonic PAN B611 EVB nRF54L15 Application MCU";
	compatible = "panasonic-industrial-devices-europe-gmbh,panb611evb-cpuapp";

	chosen {
		zephyr,code-partition = &slot0_ns_partition;
		zephyr,sram = &sram0_ns;
		zephyr,entropy = &psa_rng;
	};

	/delete-node/ rng;

	psa_rng: psa-rng {
		status = "okay";
	};
};

&uart20 {
	/* Disable so that TF-M can use this UART */
	status = "disabled";

	current-speed = <115200>;
	pinctrl-0 = <&uart20_default>;
	pinctrl-1 = <&uart20_sleep>;
	pinctrl-names = "default", "sleep";
};

/* Include default memory partition configuration file */
#include <vendor/nordic/nrf54l15_cpuapp_ns_partition.dtsi>
