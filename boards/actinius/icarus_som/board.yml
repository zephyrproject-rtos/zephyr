## boards/actinius/icarus_som/board.yml
```yaml
board:
  name: actinius_icarus_som
  full_name: Icarus SoM
  vendor: actinius
  socs:
  - name: nrf9160
    variants:
    - name: 'ns'
```

## boards/actinius/icarus_som_dk/Kconfig
```kconfig
# Copyright The Zephyr Project Contributors
# SPDX-License-Identifier: Apache-2.0

config BOARD_ACTINIUS_ICARUS_SOM_DK
	select BOARD_LATE_INIT_HOOK
```

## boards/actinius/icarus_som_dk/Kconfig.actinius_icarus_som_dk
```kconfig
# Actinius Icarus SoM DK board configuration

# Copyright (c) 2022 Actinius
# SPDX-License-Identifier: Apache-2.0

config BOARD_ACTINIUS_ICARUS_SOM_DK
	select SOC_NRF9160_SICA
```

## boards/actinius/icarus_som_dk/board.yml
```yaml
board:
  name: actinius_icarus_som_dk
  full_name: Icarus SoM DK
  vendor: actinius
  socs:
  - name: nrf9160
    variants:
    - name: 'ns'
```

## boards/adafruit/adafruit_feather/Kconfig.adafruit_feather
```kconfig
# Adafruit Feather nRF52840 Express board configuration

# Copyright (c) 2020 Tobias Svehagen
# SPDX-License-Identifier: Apache-2.0

config BOARD_ADAFRUIT_FEATHER
	bool
	default y
	select SOC_NRF52840_QIAA
```

## boards/adafruit/adafruit_feather/board.yml
```yaml
board:
  name: adafruit_feather
  vendor: Adafruit Industries LLC
  socs:
  - name: nrf52840
```

## boards/adafruit/adafruit_itsybitsy/board.yml
```yaml
board:
  name: adafruit_itsybitsy
  vendor: Adafruit Industries LLC
  socs:
  - name: nrf52840
```

## boards/adafruit/adafruit_kb2040/Kconfig.adafruit_kb2040
```kconfig
# Copyright (c) 2022 Pete Johanson
# SPDX-License-Identifier: Apache-2.0

config BOARD_ADAFRUIT_KB2040
	select SOC_RP2040
```

## boards/adafruit/adafruit_qt_py_rp2040/adafruit_qt_py_rp2040_defconfig
```kconfig
# SPDX-License-Identifier: Apache-2.0

CONFIG_SYS_CLOCK_HW_CYCLES_PER_SEC=125000000

# Enable UART driver
CONFIG_SERIAL=y
CONFIG_UART_INTERRUPT_DRIVEN=y

# Enable console
CONFIG_CONSOLE=y
CONFIG_UART_CONSOLE=y

# Enable reset by default
CONFIG_RESET=y

# Enable clock control by default
CONFIG_CLOCK_CONTROL=y

# Code partition needed to target the correct flash range
CONFIG_USE_DT_CODE_PARTITION=y

# Output UF2 by default, native bootloader supports it.
CONFIG_BUILD_OUTPUT_UF2=y
```

## boards/adafruit/adafruit_qt_py_rp2040/board.yml
```yaml
board:
  name: adafruit_qt_py_rp2040
  vendor: adafruit
  socs:
  - name: rp2040
```

## boards/adafruit/feather/Kconfig
```kconfig
# Adafruit Feather nRF52840 Express board configuration

# Copyright (c) 2020 Tobias Svehagen
# SPDX-License-Identifier: Apache-2.0

config BOARD_ENABLE_DCDC
	bool "DCDC mode"
	select SOC_DCDC_NRF52X
	default y
	depends on BOARD_ADAFRUIT_FEATHER
```

## boards/adafruit/feather/Kconfig.defconfig
```kconfig
# Adafruit Feather nRF52840 Express board configuration

# Copyright (c) 2020 Tobias Svehagen
# SPDX-License-Identifier: Apache-2.0

if BOARD_ADAFRUIT_FEATHER

config BT_CTLR
	default BT

endif # BOARD_ADAFRUIT_FEATHER
```

## boards/adafruit/feather_adalogger_rp2040/Kconfig.adafruit_feather_adalogger_rp2040
```kconfig
# Copyright (c) 2025 Jonas Berg
# SPDX-License-Identifier: Apache-2.0

config BOARD_ADAFRUIT_FEATHER_ADALOGGER_RP2040
	select SOC_RP2040
```

## boards/adafruit/feather_adalogger_rp2040/board.yml
```yaml
board:
  name: adafruit_feather_adalogger_rp2040
  full_name: Feather RP2040 Adalogger
  vendor: adafruit
  socs:
  - name: rp2040
```

## boards/adafruit/feather_canbus_rp2040/Kconfig.defconfig
```kconfig
# Copyright (c) 2022 Peter Johanson
# SPDX-License-Identifier: Apache-2.0

if BOARD_ADAFRUIT_FEATHER_CANBUS_RP2040

if I2C_DW

config I2C_DW_CLOCK_SPEED
	default 125

endif # I2C_DW

config USB_SELF_POWERED
	default n

endif # BOARD_ADAFRUIT_FEATHER_CANBUS_RP2040
```

## boards/adafruit/feather_canbus_rp2040/board.yml
```yaml
board:
  name: adafruit_feather_canbus_rp2040
  full_name: Feather RP2040 CAN bus
  vendor: adafruit
  socs:
  - name: rp2040
```

## boards/adafruit/feather_esp32/Kconfig
```kconfig
# Copyright (c) 2025 Lena Voytek <lena@voytek.dev>
# SPDX-License-Identifier: Apache-2.0

config HEAP_MEM_POOL_ADD_SIZE_BOARD
	int
	default 4096 if BOARD_ADAFRUIT_FEATHER_ESP32_ESP32_PROCPU
	default 256 if BOARD_ADAFRUIT_FEATHER_ESP32_ESP32_APPCPU
```

## boards/adafruit/feather_esp32/Kconfig.adafruit_feather_esp32
```kconfig
# Adafruit Feather ESP32 board configuration

# Copyright (c) 2025 Lena Voytek <lena@voytek.dev>
# SPDX-License-Identifier: Apache-2.0

config BOARD_ADAFRUIT_FEATHER_ESP32
	select SOC_ESP32_PICO_V3_02
	select SOC_ESP32_PROCPU if BOARD_ADAFRUIT_FEATHER_ESP32_ESP32_PROCPU
	select SOC_ESP32_APPCPU if BOARD_ADAFRUIT_FEATHER_ESP32_ESP32_APPCPU
```

## boards/adafruit/feather_esp32/adafruit_feather_esp32_procpu_defconfig
```kconfig
# SPDX-License-Identifier: Apache-2.0

CONFIG_GPIO=y
CONFIG_CONSOLE=y
CONFIG_SERIAL=y
CONFIG_UART_CONSOLE=y
```

## boards/adafruit/feather_esp32/board.yml
```yaml
board:
  name: adafruit_feather_esp32
  full_name: Adafruit Feather ESP32
  vendor: adafruit
  socs:
  - name: esp32
  revision:
    format: number
    default: "2"
    revisions:
    - name: "2"
```

## boards/adafruit/feather_esp32_v2/Kconfig.adafruit_feather_esp32_v2
```kconfig
# Adafruit Feather ESP32 V2 board configuration

# Copyright (c) 2025 Lena Voytek <lena@voytek.dev>
# SPDX-License-Identifier: Apache-2.0

config BOARD_ADAFRUIT_FEATHER_ESP32_V2
	select SOC_ESP32_PICO_V3_02
	select SOC_ESP32_PROCPU if BOARD_ADAFRUIT_FEATHER_ESP32_V2_ESP32_PROCPU
	select SOC_ESP32_APPCPU if BOARD_ADAFRUIT_FEATHER_ESP32_V2_ESP32_APPCPU
```

## boards/adafruit/feather_esp32_v2/board.yml
```yaml
board:
  name: adafruit_feather_esp32_v2
  full_name: Adafruit Feather ESP32 V2
  vendor: adafruit
  socs:
  - name: esp32
```

## boards/adafruit/feather_esp32c6/Kconfig
```kconfig
# Copyright (c) 2026 Hong Nguyen <hong.nguyen.k54@gmail.com>
# SPDX-License-Identifier: Apache-2.0

config HEAP_MEM_POOL_ADD_SIZE_BOARD
	int
	default 4096 if BOARD_ADAFRUIT_FEATHER_ESP32C6_ESP32C6_HPCORE
	default 256 if BOARD_ADAFRUIT_FEATHER_ESP32C6_ESP32C6_LPCORE
```

## boards/adafruit/feather_esp32c6/Kconfig.adafruit_feather_esp32c6
```kconfig
# Copyright (c) 2026 Hong Nguyen <hong.nguyen.k54@gmail.com>
# SPDX-License-Identifier: Apache-2.0

config BOARD_ADAFRUIT_FEATHER_ESP32C6
	select SOC_ESP32_C6_MINI_1U_N4
	select SOC_ESP32C6_HPCORE if BOARD_ADAFRUIT_FEATHER_ESP32C6_ESP32C6_HPCORE
	select SOC_ESP32C6_LPCORE if BOARD_ADAFRUIT_FEATHER_ESP32C6_ESP32C6_LPCORE
```
