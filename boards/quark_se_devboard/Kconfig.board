## boards/quark_se_devboard/Kconfig.board
```kconfig
config BOARD_QUARK_SE_DEVBOARD
	bool "Quark SE Development Board"
	depends on SOC_QUARK_SE
```

## boards/quark_se_devboard/Kconfig.defconfig
```kconfig
if BOARD_QUARK_SE_DEVBOARD

config BOARD
        default "quark_se_devboard"

if NBLE

config GPIO
	def_bool y

config BLUETOOTH_NRF51_PM
	def_bool y

config NBLE_UART_ON_DEV_NAME
	default UART_NS16550_PORT_0_NAME

endif

if BLUETOOTH_H4

config GPIO
	def_bool y

config BLUETOOTH_NRF51_PM
	def_bool y

config BLUETOOTH_WAIT_NOP
	def_bool y

config BLUETOOTH_UART_ON_DEV_NAME
        default UART_NS16550_PORT_0_NAME

endif

if UART_PIPE

config UART_PIPE_ON_DEV_NAME
	default UART_NS16550_PORT_1_NAME

endif

config BLUETOOTH_MONITOR_ON_DEV_NAME
	default UART_NS16550_PORT_1_NAME if BLUETOOTH_DEBUG_MONITOR

if NETWORKING_WITH_15_4_TI_CC2520

config SPI
	def_bool y
config GPIO
	def_bool y

config TI_CC2520_SPI_DRV_NAME
	default SPI_DW_PORT_1_DRV_NAME
config TI_CC2520_SPI_FREQ
	default 4
config TI_CC2520_SPI_SLAVE
	default 1

if SPI_DW

config SPI_DW_CS_GPIO
	def_bool y

if SPI_DW_PORT_1 && SPI_DW_CS_GPIO

config SPI_DW_PORT_1_CS_GPIO_PORT
	default GPIO_DW_0_NAME
config SPI_DW_PORT_1_CS_GPIO_PIN
	default 11

endif # SPI_DW_PORT_1 && SPI_DW_CS_GPIO

if GPIO_DW

config TI_CC2520_GPIO_NAME
       default GPIO_DW_0_NAME
config TI_CC2520_GPIO_AON_NAME
       default GPIO_DW_1_NAME

endif # GPIO_DW

endif # SPI_DW

if SPI_QMSI
config SPI_QMSI_CS_GPIO
	def_bool y
config SPI_QMSI_PORT_1_CS_GPIO_PORT
	default GPIO_QMSI_0_NAME
config SPI_QMSI_PORT_1_CS_GPIO_PIN
	default 11
config TI_CC2520_GPIO_NAME
       string
       default GPIO_QMSI_0_NAME
config TI_CC2520_GPIO_AON_NAME
       string
       default GPIO_QMSI_AON_NAME
endif

endif # NETWORKING_WITH_15_4_TI_CC2520

endif # BOARD_QUARK_SE_DEVBOARD
```

## boards/quark_se_devboard/quark_se_devboard_defconfig
```kconfig
CONFIG_X86=y
CONFIG_SOC_QUARK_SE=y
CONFIG_BOARD_QUARK_SE_DEVBOARD=y
CONFIG_CPU_MINUTEIA=y
CONFIG_CONSOLE=y
CONFIG_UART_QMSI=y
CONFIG_UART_CONSOLE=y
CONFIG_SERIAL=y
CONFIG_PRINTK=y
CONFIG_PINMUX=y
```

## boards/quark_se_sss_ctb/Kconfig
```kconfig
if BOARD_QUARK_SE_SSS_CTB

config BOARD
        default "quark_se_sss_ctb"

endif # BOARD_QUARK_SE_SSS_CTB
```

## boards/quark_se_sss_ctb/Kconfig.board
```kconfig
config  BOARD_QUARK_SE_SSS_CTB
        bool "Quark SE Test Board - Sensor Sub System"
        select SOC_QUARK_SE_SS
	depends on ARC
```

## boards/quark_se_sss_ctb/quark_se_sss_ctb_defconfig
```kconfig
CONFIG_ARC=y
CONFIG_SOC_QUARK_SE_SS=y
CONFIG_BOARD_QUARK_SE_SSS_CTB=y
CONFIG_SYS_CLOCK_TICKS_PER_SEC=100
CONFIG_SYS_CLOCK_HW_CYCLES_PER_SEC=32000000
CONFIG_XIP=y
CONFIG_NANO_TIMERS=y
CONFIG_PRINTK=y
CONFIG_CPU_ARCEM4=y
CONFIG_CPU_ARCV2=y
CONFIG_ARCV2_INTERRUPT_UNIT=y
CONFIG_ARCV2_TIMER=y
CONFIG_IPM=y
CONFIG_IPM_QUARK_SE=y
CONFIG_IPM_CONSOLE_SENDER=y
CONFIG_CONSOLE=y
```

## boards/quark_se_sss_devboard/Kconfig.board
```kconfig
config BOARD_QUARK_SE_SSS_DEVBOARD
	bool "Quark SE Development Board - Sensor Sub System"
	depends on SOC_QUARK_SE_SS
```

## boards/quark_se_sss_devboard/Kconfig.defconfig
```kconfig
if BOARD_QUARK_SE_SSS_DEVBOARD

config BOARD
        default "quark_se_sss_devboard"

endif # BOARD_QUARK_SE_SSS_DEVBOARD
```

## boards/quark_se_test/Kconfig
```kconfig
if BOARD_QUARK_SE_TEST

config BOARD
        default "quark_se_test"

endif # BOARD_QUARK_SE_TEST
```

## boards/quark_se_test/Kconfig.board
```kconfig
config  BOARD_QUARK_SE_TEST
        bool "Quark SE Test Board"
        select PLATFORM_QUARK_SE
```

## boards/quark_se_test_sss/Kconfig
```kconfig
if BOARD_QUARK_SE_TEST_SSS

config BOARD
        default "quark_se_test_sss"

endif # BOARD_QUARK_SE_TEST_SSS
```

## boards/quark_se_test_sss/Kconfig.board
```kconfig
config  BOARD_QUARK_SE_TEST_SSS
        bool "Quark SE Test Board - Sensor Sub System"
        select PLATFORM_QUARK_SE_SS
	depends on ARC
```

## boards/quicklogic/qomu/Kconfig
```kconfig
# QuickLogic Qomu board

# Copyright (c) 2022 Antmicro <www.antmicro.com>
# SPDX-License-Identifier: Apache-2.0

config BOARD_INIT_PRIORITY
	int
	default KERNEL_INIT_PRIORITY_DEFAULT
	help
	  Board initialization priority.
```

## boards/quicklogic/qomu/Kconfig.qomu
```kconfig
# QuickLogic Qomu board

# Copyright (c) 2022 Antmicro <www.antmicro.com>
# SPDX-License-Identifier: Apache-2.0

config BOARD_QOMU
	select SOC_EOS_S3
```

## boards/quicklogic/qomu/board.yml
```yaml
board:
  name: qomu
  full_name: Qomu
  vendor: quicklogic
  socs:
  - name: quicklogic_eos_s3
```

## boards/quicklogic/quick_feather/Kconfig.quick_feather
```kconfig
# Quick Feather board

# Copyright (c) 2020 Antmicro <www.antmicro.com>
# SPDX-License-Identifier: Apache-2.0

config BOARD_QUICK_FEATHER
	select SOC_EOS_S3
```

## boards/quicklogic/quick_feather/board.yml
```yaml
board:
  name: quick_feather
  full_name: QuickFeather
  vendor: quicklogic
  socs:
  - name: quicklogic_eos_s3
```

## boards/quicklogic/quick_feather/quick_feather_defconfig
```kconfig
# Copyright (c) 2020 Antmicro <www.antmicro.com>
# SPDX-License-Identifier: Apache-2.0

CONFIG_ARM_MPU=n

# System clock
CONFIG_SYS_CLOCK_HW_CYCLES_PER_SEC=61440000

# Console
CONFIG_SERIAL=y
CONFIG_CONSOLE=y
CONFIG_UART_CONSOLE=y

# EOS S3 Configuration Manager copies software from external flash to MCU
# memory using preconfigured DMA and execute it there.
# Thus we do not use flash directly.

CONFIG_XIP=n
CONFIG_FLASH=n
CONFIG_FLASH_SIZE=0
CONFIG_FLASH_BASE_ADDRESS=0x0

# GPIO
CONFIG_GPIO=y
```

## boards/radxa/rock_3b/Kconfig.rock_3b
```kconfig
# SPDX-FileCopyrightText: 2026 TOKITA Hiroshi
# SPDX-License-Identifier: Apache-2.0

config BOARD_ROCK_3B
	select SOC_RK3568
```

## boards/radxa/rock_3b/board.yml
```yaml
board:
  name: rock_3b
  full_name: Radxa ROCK 3B
  vendor: radxa
  socs:
  - name: rk3568
    variants:
    - name: smp
```

## boards/radxa/rock_5b_plus/Kconfig.rock_5b_plus
```kconfig
# Copyright (c) 2026 Process Mission
# SPDX-License-Identifier: Apache-2.0

config BOARD_ROCK_5B_PLUS
	select SOC_RK3588
```

## boards/radxa/rock_5b_plus/board.yml
```yaml
board:
  name: rock_5b_plus
  full_name: ROCK 5B+
  vendor: radxa
  socs:
  - name: rk3588
    variants:
    - name: smp
```

## boards/rak/rak3172/Kconfig.rak3172
```kconfig
# SPDX-License-Identifier: Apache-2.0

config BOARD_RAK3172
	select SOC_STM32WLE5XX
```
