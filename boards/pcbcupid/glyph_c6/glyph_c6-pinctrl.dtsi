/*
 * Copyright (c) 2023 Espressif Systems (Shanghai) Co., Ltd.
 * Copyright (c) 2025 Muhammed Asif
 *
 * SPDX-License-Identifier: Apache-2.0
 */

#include <zephyr/dt-bindings/pinctrl/esp-pinctrl-common.h>
#include <dt-bindings/pinctrl/esp32c6-pinctrl.h>
#include <zephyr/dt-bindings/pinctrl/esp32c6-gpio-sigmap.h>

&pinctrl {
	uart0_default: uart0_default {
		group1 {
			pinmux = <UART0_TX_GPIO16>;
			output-high;
		};

		group2 {
			pinmux = <UART0_RX_GPIO17>;
			bias-pull-up;
		};
	};
};
