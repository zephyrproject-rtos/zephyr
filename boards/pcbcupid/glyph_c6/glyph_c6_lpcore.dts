/*
 * Copyright (c) 2025 Espressif Systems (Shanghai) Co., Ltd.
 * Copyright (c) 2025 Muhammed Asif
 *
 * SPDX-License-Identifier: Apache-2.0
 */
/dts-v1/;

#include <espressif/esp32c6/esp32c6_lpcore.dtsi>
#include <espressif/partitions_0x0_default.dtsi>

/ {
	model = "PCB Cupid Glyph ESP32C6 LPCORE";
	compatible = "pcbcupid,glyph-c6";

	chosen {
		zephyr,flash = &flash0;
		zephyr,sram = &ulp_ram;
		zephyr,code-partition = &slot0_lpcore_partition;
	};
};

&flash0 {
	reg = <0x0 DT_SIZE_M(4)>;
	ranges = <0x0 0x0 DT_SIZE_M(4)>;
};
