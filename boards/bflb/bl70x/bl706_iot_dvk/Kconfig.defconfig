## boards/bflb/bl70x/bl706_iot_dvk/Kconfig.defconfig
```kconfig
# Copyright The Zephyr Project Contributors
# SPDX-License-Identifier: Apache-2.0

if BOARD_BL706_IOT_DVK

source "boards/common/usb/Kconfig.cdc_acm_serial.defconfig"

endif # BOARD_BL706_IOT_DVK
```

## boards/bflb/bl70x/bl706_iot_dvk/bl706_iot_dvk_defconfig
```kconfig
# SPDX-FileCopyrightText: Copyright The Zephyr Project Contributors
# SPDX-License-Identifier: Apache-2.0

CONFIG_GPIO=y
CONFIG_CONSOLE=y
CONFIG_SERIAL=y
CONFIG_UART_CONSOLE=y
CONFIG_USBD_CDC_ACM_CLASS=y
```

## boards/bflb/bl70x/bl706_iot_dvk/board.yml
```yaml
board:
  name: bl706_iot_dvk
  full_name: Bouffalo Lab BL706-IoT-DVK
  vendor: bflb
  socs:
    - name: bl706c00q2i
```

## boards/blackberry/qnxhv_vm/Kconfig.qnxhv_vm
```kconfig
# Copyright (c) 2025 TOKITA Hiroshi
# SPDX-License-Identifier: Apache-2.0

config BOARD_QNXHV_VM
	select SOC_QNXHV_VM
```

## boards/blackberry/qnxhv_vm/board.yml
```yaml
board:
  name: qnxhv_vm
  full_name: QNX Hypervisor Virtual Machine
  vendor: blackberry
  socs:
  - name: qnxhv_vm
```

## boards/blackberry/qnxhv_vm/qnxhv_vm_defconfig
```kconfig
# Copyright (c) 2025 TOKITA Hiroshi
# SPDX-License-Identifier: Apache-2.0

CONFIG_SERIAL=y
CONFIG_CONSOLE=y
CONFIG_UART_CONSOLE=y
CONFIG_UART_INTERRUPT_DRIVEN=y
```

## boards/bliiot/am62x_m4_bl350/Kconfig.am62x_m4_bl350
```kconfig
# Copyright (c) 2026 Chrispine Tinega <dev@chrispinetinega.com>
# SPDX-License-Identifier: Apache-2.0

config BOARD_AM62X_M4_BL350
	select SOC_AM6254_M4 if BOARD_AM62X_M4_BL350_AM6254_M4
```

## boards/bliiot/am62x_m4_bl350/Kconfig.board
```kconfig
# Copyright (c) 2026 Chrispine Tinega <chrispinetinega@gmail.com>
# SPDX-License-Identifier: Apache-2.0

config BOARD_AM62X_M4_BL350
	select SOC_AM6234_M4
```

## boards/bliiot/am62x_m4_bl350/Kconfig.defconfig
```kconfig
# Copyright (c) 2026 Chrispine Tinega <chrispinetinega@gmail.com>
# SPDX-License-Identifier: Apache-2.0

if BOARD_AM62X_M4_BL350

config BOARD
	default "am62x_m4_bl350"

endif # BOARD_AM62X_M4_BL350
```

## boards/bliiot/am62x_m4_bl350/am62x_m4_bl350_am6234_m4_defconfig
```kconfig
# Copyright (c) 2026 Chrispine Tinega <chrispinetinega@gmail.com>
# SPDX-License-Identifier: Apache-2.0

# Platform Configuration
CONFIG_CORTEX_M_SYSTICK=y

# Zephyr Kernel Configuration
CONFIG_XIP=n

# Serial Driver
CONFIG_SERIAL=y

# Enable Console
CONFIG_CONSOLE=y
CONFIG_UART_CONSOLE=y

# We will provide our own custom resource table in the application

# Peripherals
CONFIG_CAN=y
CONFIG_CAN_FD_MODE=y
CONFIG_GPIO=y
CONFIG_WATCHDOG=y
```

## boards/bliiot/am62x_m4_bl350/am62x_m4_bl350_am6254_m4_defconfig
```kconfig
# Copyright (c) 2026 Chrispine Tinega <dev@chrispinetinega.com>
# SPDX-License-Identifier: Apache-2.0

# Platform Configuration
CONFIG_CORTEX_M_SYSTICK=y

# XIP is required to place TEXT and DATA in I-Code SRAM (0x0) and D-Code
# SRAM (0x30000) respectively. The M4F boots from its internal SRAM.
CONFIG_XIP=y

# Serial Driver
CONFIG_SERIAL=y

# Enable Console
CONFIG_CONSOLE=y
CONFIG_UART_CONSOLE=y

# Enable OpenAMP resource table needed for remoteproc booting
CONFIG_OPENAMP_RSC_TABLE=y
```

## boards/bliiot/am62x_m4_bl350/board.yml
```yaml
# Copyright (c) 2026 Chrispine Tinega <dev@chrispinetinega.com>
# SPDX-License-Identifier: Apache-2.0

board:
  name: am62x_m4_bl350
  full_name: BLIIoT ARMxy BL350 AM62x M4
  vendor: bliiot
  socs:
  - name: am6254
```

## boards/blue_clover/blueclover_plt_demo_v2/Kconfig.blueclover_plt_demo_v2
```kconfig
# Blue Clover PLT Demo V2 Configuration

# Copyright (c) 2021 Blue Clover
# SPDX-License-Identifier: Apache-2.0

config BOARD_BLUECLOVER_PLT_DEMO_V2_NRF52832
	select SOC_NRF52832_QFAA
```

## boards/blue_clover/blueclover_plt_demo_v2/board.yml
```yaml
board:
  name: blueclover_plt_demo_v2
  vendor: Blue Clover Devices
  socs:
  - name: nrf52832
```

## boards/blue_clover/plt_demo_v2/Kconfig
```kconfig
# Blue Clover PLT Demo V2 Configuration

# Copyright (c) 2021 Blue Clover
# SPDX-License-Identifier: Apache-2.0

config BOARD_ENABLE_DCDC
	bool "DCDC mode"
	select SOC_DCDC_NRF52X
	default y
	depends on BOARD_BLUECLOVER_PLT_DEMO_V2_NRF52832
```

## boards/blue_clover/plt_demo_v2/board.yml
```yaml
board:
  name: blueclover_plt_demo_v2
  vendor: bcdevices
  socs:
  - name: nrf52832
```

## boards/blues/cygnet/Kconfig.cygnet
```kconfig
# Copyright (c) 2025 Blues
# SPDX-License-Identifier: Apache-2.0

config BOARD_CYGNET
	select SOC_STM32L433XX
```

## boards/blues/cygnet/Kconfig.defconfig
```kconfig
# STM32L433CC Cygnet board configuration

# Copyright (c) 2025 Blues
# SPDX-License-Identifier: Apache-2.0

if BOARD_CYGNET

config SPI_STM32_INTERRUPT
	default y
	depends on SPI

endif # BOARD_CYGNET
```

## boards/blues/cygnet/board.yml
```yaml
board:
  name: cygnet
  full_name: Cygnet
  vendor: blues
  socs:
    - name: stm32l433xx
```

## boards/blues/cygnet/cygnet_defconfig
```kconfig
# SPDX-License-Identifier: Apache-2.0

# Enable MPU
CONFIG_ARM_MPU=y

# Enable HW stack protection
CONFIG_HW_STACK_PROTECTION=y

# Enable UART driver
CONFIG_SERIAL=y

# Enable GPIO
CONFIG_GPIO=y

# Enable console
CONFIG_CONSOLE=y
CONFIG_UART_CONSOLE=y
```

## boards/blues/swan_r5/Kconfig.defconfig
```kconfig
# Blues Wireless Swan board configuration

# Copyright (c) 2022 Blues Inc.
# SPDX-License-Identifier: Apache-2.0

if BOARD_SWAN_R5

config SPI_STM32_INTERRUPT
	default y
	depends on SPI

endif # BOARD_SWAN_R5
```

## boards/blues/swan_r5/Kconfig.swan_r5
```kconfig
# Copyright (c) 2022 Blues Inc.
# SPDX-License-Identifier: Apache-2.0

config BOARD_SWAN_R5
	select SOC_STM32L4R5XX
```

## boards/blues/swan_r5/board.yml
```yaml
board:
  name: swan_r5
  full_name: Swan
  vendor: blues
  socs:
    - name: stm32l4r5xx
```

## boards/blues/swan_r5/swan_r5_defconfig
```kconfig
# SPDX-License-Identifier: Apache-2.0

# enable uart driver
CONFIG_SERIAL=y

# Enable GPIO
CONFIG_GPIO=y

# Console
CONFIG_CONSOLE=y
CONFIG_UART_CONSOLE=y

# Enable MPU
CONFIG_ARM_MPU=y

# Enable HW stack protection
CONFIG_HW_STACK_PROTECTION=y

CONFIG_REGULATOR=y
```

## boards/boards_legacy/arc/em_starterkit/Kconfig.defconfig
```kconfig
# SPDX-License-Identifier: Apache-2.0

if BOARD_EM_STARTERKIT

config BOARD
	default "em_starterkit"

if I2C_DW

config I2C_DW_CLOCK_SPEED
	default 100

endif # I2C_DW

endif # BOARD_EM_STARTERKIT
```
