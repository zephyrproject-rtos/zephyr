;*******************************************************************************
;   Copyright 2023 NXP                                                         *
;   SPDX-License-Identifier: Apache-2.0                                        *
;                                                                              *
;   Lauterbach TRACE32 start-up script for debugging mr_canhubk3               *
;                                                                              *
;*******************************************************************************

ENTRY %LINE &args

DO ~~~~/startup.cmm command=debug &args

ENDDO
