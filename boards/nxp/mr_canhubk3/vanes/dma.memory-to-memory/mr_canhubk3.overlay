/*
 * Copyright 2023 NXP
 *
 * SPDX-License-Identifier: Apache-2.0
 */

/ {
	dma_test_edma0: dma-test-edma0 {
		compatible = "test-dma-memory-to-memory";
		dma = <&edma0>;
		channels = <12 31>;
	};
};

&edma0 {
	status = "okay";
};
