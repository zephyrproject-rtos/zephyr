## boards/nxp/mr_canhubk3/Kconfig.mr_canhubk3_s32k344_mcuboot
```kconfig
# Copyright 2025 NXP
# SPDX-License-Identifier: Apache-2.0

config BOARD_MR_CANHUBK3_S32K344_MCUBOOT
        bool "MR-CANHUBK3 (MCUboot variant)"
        select SOC_S32K344
        select SOC_PART_NUMBER_PS32K344EHVPBS
        # App will XIP from internal flash when chainloaded by MCUboot
        select XIP
```

## boards/nxp/mr_canhubk3/Kconfig.sysbuild
```kconfig
# Copyright 2025 NXP
# SPDX-License-Identifier: Apache-2.0


if BOARD_MR_CANHUBK3_S32K344_MCUBOOT

choice BOOTLOADER
	default BOOTLOADER_MCUBOOT
endchoice

# Use direct-XIP mode (dual-slot) on S32K3
choice MCUBOOT_MODE
	default MCUBOOT_MODE_DIRECT_XIP
endchoice

choice BOOT_SIGNATURE_TYPE
	default BOOT_SIGNATURE_TYPE_RSA
endchoice

endif # BOARD_MR_CANHUBK3_S32K344_MCUBOOT
```

## boards/nxp/mr_canhubk3/board.yml
```yaml
board:
  name: mr_canhubk3
  full_name: MR-CANHUBK3
  vendor: nxp
  socs:
    - name: s32k344
      variants:
        - name: mcuboot
```

## boards/nxp/mr_canhubk3/mr_canhubk3_s32k344_defconfig
```kconfig
# Copyright 2023-2024 NXP
# SPDX-License-Identifier: Apache-2.0

CONFIG_BUILD_OUTPUT_HEX=y

# Use Systick as system clock
CONFIG_SYS_CLOCK_HW_CYCLES_PER_SEC=160000000

# Run from internal Flash
CONFIG_XIP=y

# Enable MPU
CONFIG_ARM_MPU=y

# Use no-cached memory for HAL
CONFIG_NOCACHE_MEMORY=y

# Drivers
CONFIG_PINCTRL=y
CONFIG_SERIAL=y
CONFIG_WATCHDOG=y

# Serial console
CONFIG_CONSOLE=y
```

## boards/nxp/mr_canhubk3/mr_canhubk3_s32k344_mcuboot_defconfig
```kconfig
# Copyright 2023-2024 NXP
# SPDX-License-Identifier: Apache-2.0

CONFIG_BUILD_OUTPUT_HEX=y

# Enable MPU
CONFIG_ARM_MPU=y

# Use no-cached memory for HAL
CONFIG_NOCACHE_MEMORY=y

# Drivers
CONFIG_SERIAL=y
CONFIG_WATCHDOG=y

# Serial console
CONFIG_CONSOLE=y
```

## boards/nxp/mr_navq95b/Kconfig.mr_navq95b
```kconfig
#
# Copyright 2026 NXP
#
# SPDX-License-Identifier: Apache-2.0
#

config BOARD_MR_NAVQ95B
	select SOC_MIMX9596_M7 if BOARD_MR_NAVQ95B_MIMX9596_M7 || \
			BOARD_MR_NAVQ95B_MIMX9596_M7_DDR || \
			BOARD_MR_NAVQ95B_MIMX9596_M7_FLASH
	select SOC_PART_NUMBER_MIMX9596AVZXN
```

## boards/nxp/mr_navq95b/board.yml
```yaml
board:
  name: mr_navq95b
  full_name: MR-NavQ95B
  vendor: nxp
  socs:
  - name: mimx9596
    variants:
    - name: ddr
      cpucluster: m7
    - name: flash
      cpucluster: m7
```

## boards/nxp/mr_navq95b/mr_navq95b_mimx9596_m7_defconfig
```kconfig
#
# Copyright 2026 NXP
#
# SPDX-License-Identifier: Apache-2.0
#

# Clock-related configurations
CONFIG_CLOCK_CONTROL=y

# Serial interface-related configurations
CONFIG_SERIAL=y
CONFIG_UART_CONSOLE=y
CONFIG_UART_INTERRUPT_DRIVEN=y
CONFIG_CONSOLE=y

# SCMI-related configurations
CONFIG_MBOX=y
CONFIG_MBOX_INIT_PRIORITY=0
CONFIG_ARM_SCMI=y
CONFIG_ARM_SCMI_NXP_VENDOR_EXTENSIONS=y

# Kernel-related configurations
CONFIG_XIP=y

# Peripheral-related configurations
CONFIG_GPIO=y
CONFIG_FLASH_MCUX_FLEXSPI_FORCE_USING_OVRDVAL=y
CONFIG_FLASH_MCUX_FLEXSPI_OVRDVAL=27
```

## boards/nxp/rd_rw612_bga/Kconfig
```kconfig
# Copyright 2025 NXP
# SPDX-License-Identifier: Apache-2.0

config BOARD_RD_RW612_BGA
	select BOARD_EARLY_INIT_HOOK
```

## boards/nxp/rd_rw612_bga/Kconfig.defconfig
```kconfig
# RD_RW612_BGA board

# Copyright 2022-2024 NXP
# SPDX-License-Identifier: Apache-2.0

if BOARD_RD_RW612_BGA

if LVGL

# Enable DMA for LCDIC
config MIPI_DBI_NXP_LCDIC_DMA
	default y if MIPI_DBI

# Increase descriptor count. LVGL will allocate a 30KB buffer,
# and the SPI driver sets up RX and TX side. Since LPC DMA has
# 1KB limit per descriptor, we need 60
config DMA_MCUX_LPC_NUMBER_OF_DESCRIPTORS
	default 60

# Allocate buffer that is 10% of screen size
config LV_Z_VDB_SIZE
	default 10

# Enable double buffering and offloaded render thread to improve performance
config LV_Z_DOUBLE_VDB
	default y

config LV_Z_FLUSH_THREAD
	default y

endif # LVGL

# Enable interrupt support when using FT5336 driver
config INPUT_FT5336_INTERRUPT
	default y if INPUT

if DT_HAS_NXP_ENET_MAC_ENABLED && NETWORKING

config NET_L2_ETHERNET
	default y

endif # DT_HAS_NXP_ENET_MAC_ENABLED && NETWORKING

endif # BOARD_RD_RW612_BGA
```

## boards/nxp/rd_rw612_bga/Kconfig.rd_rw612_bga
```kconfig
# Copyright 2024 NXP
# SPDX-License-Identifier: Apache-2.0

config BOARD_RD_RW612_BGA
	select SOC_PART_NUMBER_RW612ETA1I
```

## boards/nxp/rd_rw612_bga/board.yml
```yaml
board:
  name: rd_rw612_bga
  full_name: RD-RW612-BGA
  vendor: nxp
  socs:
    - name: rw612
      variants:
        - name: ethernet
```

## boards/nxp/rddrone_fmuk66/Kconfig.rddrone_fmuk66
```kconfig
# Copyright 2024 NXP
# SPDX-License-Identifier: Apache-2.0

config BOARD_RDDRONE_FMUK66
	select SOC_MK66F18
	select SOC_PART_NUMBER_MK66FN2M0VLQ18
```

## boards/nxp/rddrone_fmuk66/board.yml
```yaml
board:
  name: rddrone_fmuk66
  full_name: RDDRONE-FMUK66
  vendor: nxp
  socs:
    - name: mk66f18
```

## boards/nxp/s32k148_evb/Kconfig.s32k148_evb
```kconfig
# Copyright 2023-2024 NXP
# SPDX-License-Identifier: Apache-2.0

config BOARD_S32K148_EVB
	select SOC_S32K148
	select SOC_PART_NUMBER_FS32K148HAT0MLUT
```

## boards/nxp/s32k148_evb/board.yml
```yaml
board:
  name: s32k148_evb
  full_name: S32K148EVB-Q176
  vendor: nxp
  socs:
    - name: s32k148
```

## boards/nxp/s32k148_evb/s32k148_evb_defconfig
```kconfig
# Copyright 2023-2024 NXP
# SPDX-License-Identifier: Apache-2.0

CONFIG_BUILD_OUTPUT_HEX=y

# Run from internal program flash
CONFIG_XIP=y

# Enable MPU
CONFIG_ARM_MPU=y

CONFIG_SERIAL=y
CONFIG_CONSOLE=y
```

## boards/nxp/s32k3x4evb/Kconfig.defconfig
```kconfig
# SPDX-FileCopyrightText: Copyright The Zephyr Project Contributors
# SPDX-License-Identifier: Apache-2.0

if BOARD_S32K3X4EVB_T172

if SERIAL

config UART_CONSOLE
	default y

endif # SERIAL

endif # BOARD_S32K3X4EVB_T172
```

## boards/nxp/s32k3x4evb/Kconfig.s32k3x4evb
```kconfig
# SPDX-FileCopyrightText: Copyright (c) 2026 Sachin Kumar
# SPDX-License-Identifier: Apache-2.0

config BOARD_S32K3X4EVB
	bool "NXP S32K3X4EVB"
	select SOC_S32K344
```

## boards/nxp/s32k3x4evb/Kconfig.s32k3x4evb_t172
```kconfig
# SPDX-FileCopyrightText: Copyright The Zephyr Project Contributors
# SPDX-License-Identifier: Apache-2.0

config BOARD_S32K3X4EVB_T172
	select SOC_S32K344
```

## boards/nxp/s32k3x4evb/board.yml
```yaml
board:
  name: s32k3x4evb_t172
  full_name: S32K3X4EVB-T172
  vendor: nxp
  socs:
    - name: s32k344
```

## boards/nxp/s32k3x4evb/s32k3x4evb_s32k344_defconfig
```kconfig
# SPDX-FileCopyrightText: Copyright (c) 2026 Sachin Kumar
# SPDX-License-Identifier: Apache-2.0

# Enable MPU
CONFIG_ARM_MPU=y
CONFIG_CLOCK_CONTROL=y
CONFIG_GPIO=y

CONFIG_SERIAL=y
CONFIG_CONSOLE=y
CONFIG_UART_CONSOLE=y
CONFIG_LOG=y
CONFIG_LOG_BACKEND_UART=y

CONFIG_XIP=n
```

## boards/nxp/s32k3x4evb/s32k3x4evb_t172_s32k344_defconfig
```kconfig
# SPDX-FileCopyrightText: Copyright The Zephyr Project Contributors
# SPDX-License-Identifier: Apache-2.0
# Run from internal Flash
CONFIG_XIP=y

CONFIG_ARM_MPU=y
CONFIG_CLOCK_CONTROL=y
CONFIG_GPIO=y
CONFIG_SERIAL=y
CONFIG_CONSOLE=y
CONFIG_BUILD_OUTPUT_HEX=y
CONFIG_MAIN_STACK_SIZE=4096
CONFIG_ISR_STACK_SIZE=4096
CONFIG_SYSTEM_WORKQUEUE_STACK_SIZE=4096
```

## boards/nxp/s32k5xxcvb/Kconfig.s32k5xxcvb
```kconfig
# Copyright 2025 NXP
# SPDX-License-Identifier: Apache-2.0

config BOARD_S32K5XXCVB
	select SOC_S32K566_M7 if BOARD_S32K5XXCVB_S32K566_M7
	select SOC_S32K566_R52 if BOARD_S32K5XXCVB_S32K566_R52
	select SOC_PART_NUMBER_S32K566JAMJGS if BOARD_S32K5XXCVB
```

## boards/nxp/s32k5xxcvb/board.yml
```yaml
board:
  name: s32k5xxcvb
  full_name: S32K5XXCVB
  vendor: nxp
  socs:
    - name: s32k566
```
