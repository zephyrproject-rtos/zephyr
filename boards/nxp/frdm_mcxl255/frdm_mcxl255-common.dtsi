/*
 * Copyright 2026 NXP
 *
 * SPDX-License-Identifier: Apache-2.0
 */

/ {
	gpio_keys {
		compatible = "gpio-keys";

		user_button_5: button_5 {
			label = "User SW5";
			gpios = <&aon_gpio0 9 GPIO_ACTIVE_HIGH>;
		};
	};
};
