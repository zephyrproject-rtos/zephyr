/*
 * Copyright 2025 NXP
 *
 * SPDX-License-Identifier: Apache-2.0
 */

/dts-v1/;

#include "frdm_mcxl255_mcxl255_cpu0.dtsi"

/ {
	model = "NXP FRDM_MCXL255 board";
	compatible = "nxp,mcxl255", "nxp,mcx";
};

&aon_kpp0 {
	status = "okay";
	pinctrl-0 = <&pinmux_aon_kpp0>;
	pinctrl-names = "default";
};
