## boards/nxp/frdm_mcxl255/board.yml
```yaml
board:
  name: frdm_mcxl255
  full_name: FRDM-MCXL255
  vendor: nxp
  socs:
  - name: mcxl255
    variants:
    - name: ns
      cpucluster: 'cpu0'
```

## boards/nxp/frdm_mcxn236/Kconfig.defconfig
```kconfig
# Copyright 2025 NXP
# SPDX-License-Identifier: Apache-2.0

if BOARD_FRDM_MCXN236

if BOOTLOADER_MCUBOOT
choice MCUBOOT_BOOTLOADER_MODE
	# Board only supports MCUBoot via "upgrade only" method:
	default MCUBOOT_BOOTLOADER_MODE_OVERWRITE_ONLY
endchoice
endif #BOOTLOADER_MCUBOOT

endif
```

## boards/nxp/frdm_mcxn236/Kconfig.frdm_mcxn236
```kconfig
# Copyright 2024 NXP
# SPDX-License-Identifier: Apache-2.0

config BOARD_FRDM_MCXN236
	select SOC_MCXN236
	select SOC_PART_NUMBER_MCXN236VDF
```

## boards/nxp/frdm_mcxn236/board.yml
```yaml
board:
  name: frdm_mcxn236
  full_name: FRDM-MCXN236
  vendor: nxp
  socs:
  - name: mcxn236
```

## boards/nxp/frdm_mcxn947/Kconfig
```kconfig
# Copyright 2024-2025 NXP
# SPDX-License-Identifier: Apache-2.0

config BOARD_FRDM_MCXN947
	select BOARD_EARLY_INIT_HOOK
```

## boards/nxp/frdm_mcxn947/Kconfig.frdm_mcxn947
```kconfig
# Copyright 2024 NXP
# SPDX-License-Identifier: Apache-2.0

config BOARD_FRDM_MCXN947
	select SOC_MCXN947_CPU0 if BOARD_FRDM_MCXN947_MCXN947_CPU0
	select SOC_MCXN947_CPU1 if BOARD_FRDM_MCXN947_MCXN947_CPU1
	select SOC_PART_NUMBER_MCXN947VDF
```

## boards/nxp/frdm_mcxn947/Kconfig.sysbuild
```kconfig
# Copyright 2024 NXP
# SPDX-License-Identifier: Apache-2.0

choice MCUBOOT_MODE
	default MCUBOOT_MODE_OVERWRITE_ONLY
endchoice

choice BOOTLOADER
	default BOOTLOADER_MCUBOOT if CONFIG_BOOTLOADER_MCUBOOT
endchoice
```

## boards/nxp/frdm_mcxn947/board.yml
```yaml
board:
  name: frdm_mcxn947
  full_name: FRDM-MCXN947
  vendor: nxp
  socs:
  - name: mcxn947
    variants:
    - name: qspi
      cpucluster: 'cpu0'
```

## boards/nxp/frdm_mcxn947/frdm_mcxn947_mcxn947_cpu0_defconfig
```kconfig
#
# Copyright 2024 NXP
#
# SPDX-License-Identifier: Apache-2.0
#

CONFIG_CONSOLE=y
CONFIG_UART_CONSOLE=y
CONFIG_SERIAL=y
CONFIG_UART_INTERRUPT_DRIVEN=y
CONFIG_GPIO=y
CONFIG_PINCTRL=y

CONFIG_ARM_MPU=y
CONFIG_HW_STACK_PROTECTION=y

# Enable TrustZone-M
CONFIG_TRUSTED_EXECUTION_SECURE=y
```

## boards/nxp/frdm_mcxn947/frdm_mcxn947_mcxn947_cpu0_ns_defconfig
```kconfig
#
# Copyright 2025-2026 NXP
#
# SPDX-License-Identifier: Apache-2.0
#

CONFIG_CONSOLE=y
CONFIG_UART_CONSOLE=y
CONFIG_SERIAL=y
CONFIG_UART_INTERRUPT_DRIVEN=y
CONFIG_GPIO=y

CONFIG_ARM_MPU=y
CONFIG_HW_STACK_PROTECTION=y
CONFIG_TRUSTED_EXECUTION_NONSECURE=y

CONFIG_TFM_BL2=y
CONFIG_BUILD_WITH_TFM=y
CONFIG_FLASH_BASE_ADDRESS=0x58000
```

## boards/nxp/frdm_mcxn947/frdm_mcxn947_mcxn947_cpu0_qspi_defconfig
```kconfig
#
# Copyright 2024 NXP
#
# SPDX-License-Identifier: Apache-2.0
#

CONFIG_CONSOLE=y
CONFIG_UART_CONSOLE=y
CONFIG_SERIAL=y
CONFIG_UART_INTERRUPT_DRIVEN=y
CONFIG_GPIO=y

CONFIG_ARM_MPU=y
CONFIG_HW_STACK_PROTECTION=y

# Enable TrustZone-M
CONFIG_TRUSTED_EXECUTION_SECURE=y
CONFIG_MCUBOOT_SIGNATURE_KEY_FILE="bootloader/mcuboot/root-rsa-2048.pem"
CONFIG_BOOTLOADER_MCUBOOT=y
```

## boards/nxp/frdm_mcxw23/Kconfig.frdm_mcxw23
```kconfig
# Copyright 2025 NXP
# SPDX-License-Identifier: Apache-2.0

config BOARD_FRDM_MCXW23
	select SOC_MCXW236
	select SOC_PART_NUMBER_MCXW236BIHNAR
```

## boards/nxp/frdm_mcxw23/board.yml
```yaml
board:
  name: frdm_mcxw23
  full_name: FRDM-MCXW23
  vendor: nxp
  socs:
    - name: mcxw236
```

## boards/nxp/frdm_mcxw70/Kconfig.frdm_mcxw70
```kconfig
# Copyright 2026 NXP
# SPDX-License-Identifier: Apache-2.0

config BOARD_FRDM_MCXW70
	select SOC_MCXW70AC
	select SOC_PART_NUMBER_MCXW70ACMFTA
```

## boards/nxp/frdm_mcxw70/board.yml
```yaml
board:
  name: frdm_mcxw70
  full_name: FRDM-MCXW70
  vendor: nxp
  socs:
    - name: mcxw70ac
```

## boards/nxp/frdm_mcxw70/frdm_mcxw70_defconfig
```kconfig
#
# Copyright 2026 NXP
#
# SPDX-License-Identifier: Apache-2.0
#

CONFIG_ARM_MPU=y
CONFIG_TRUSTED_EXECUTION_SECURE=y
CONFIG_SERIAL=y
CONFIG_CONSOLE=y
CONFIG_UART_CONSOLE=y
CONFIG_GPIO=y
# On FPGA, fixed at 32MHz
CONFIG_SYS_CLOCK_HW_CYCLES_PER_SEC=32000000
```

## boards/nxp/frdm_mcxw71/Kconfig.frdm_mcxw71
```kconfig
# Copyright 2024 NXP
# SPDX-License-Identifier: Apache-2.0

config BOARD_FRDM_MCXW71
	select SOC_MCXW716C
	select SOC_PART_NUMBER_MCXW716CMFTA
```

## boards/nxp/frdm_mcxw71/board.yml
```yaml
board:
  name: frdm_mcxw71
  full_name: FRDM-MCXW71
  vendor: nxp
  socs:
    - name: mcxw716c
```

## boards/nxp/frdm_mcxw71/frdm_mcxw71_defconfig
```kconfig
#
# Copyright 2023 NXP
#
# SPDX-License-Identifier: Apache-2.0
#

CONFIG_ARM_MPU=y
CONFIG_TRUSTED_EXECUTION_SECURE=y
CONFIG_SERIAL=y
CONFIG_CONSOLE=y
CONFIG_UART_CONSOLE=y
CONFIG_GPIO=y
```

## boards/nxp/frdm_mcxw72/Kconfig.frdm_mcxw72
```kconfig
# Copyright 2024 NXP
# SPDX-License-Identifier: Apache-2.0

config BOARD_FRDM_MCXW72
	select SOC_MCXW727C
	select SOC_PART_NUMBER_MCXW727CMFTA
```

## boards/nxp/frdm_mcxw72/board.yml
```yaml
board:
  name: frdm_mcxw72
  full_name: FRDM-MCXW72
  vendor: nxp
  socs:
    - name: mcxw727c
```

## boards/nxp/frdm_mcxw72/frdm_mcxw72_mcxw727c_cpu1_defconfig
```kconfig
#
# Copyright 2026 NXP
#
# SPDX-License-Identifier: Apache-2.0
#

CONFIG_SERIAL=y
CONFIG_CONSOLE=y
CONFIG_UART_CONSOLE=y
CONFIG_UART_INTERRUPT_DRIVEN=y

# CPU1 is a constrained/secondary core; keep config minimal for hello_world.
```

## boards/nxp/frdm_rw612/Kconfig
```kconfig
# Copyright 2025 NXP
# SPDX-License-Identifier: Apache-2.0

config BOARD_FRDM_RW612
	select BOARD_EARLY_INIT_HOOK
```

## boards/nxp/frdm_rw612/Kconfig.frdm_rw612
```kconfig
# Copyright 2024 NXP
# SPDX-License-Identifier: Apache-2.0

config BOARD_FRDM_RW612
	select SOC_PART_NUMBER_RW612ETA2I
```

## boards/nxp/frdm_rw612/board.yml
```yaml
board:
  name: frdm_rw612
  full_name: FRDM_RW612
  vendor: nxp
  socs:
    - name: rw612
```
