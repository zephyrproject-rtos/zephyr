/*
 * Copyright 2025 NXP
 *
 * SPDX-License-Identifier: Apache-2.0
 */

/dts-v1/;

#include <nxp/nxp_mimx9111.dtsi>
#include "imx91_qsb-pinctrl.dtsi"

/ {
	compatible = "fsl,mimx91";
	model = "NXP i.MX91 A55";

	chosen {
		zephyr,console = &lpuart1;
		zephyr,shell-uart = &lpuart1;
		/* sram node actually locates at DDR DRAM */
		zephyr,sram = &dram;
	};

	dram: memory@80000000 {
		reg = <0x80000000 DT_SIZE_M(1)>;
	};
};

&lpuart1 {
	current-speed = <115200>;
	pinctrl-0 = <&uart1_default>;
	pinctrl-names = "default";
	status = "okay";
};
