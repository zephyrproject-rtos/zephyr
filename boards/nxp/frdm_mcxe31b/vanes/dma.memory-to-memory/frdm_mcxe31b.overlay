/*
 * Copyright 2025 NXP
 *
 * SPDX-License-Identifier: Apache-2.0
 */

/ {
	dma_test_edma: dma-test-edma {
		compatible = "test-dma-memory-to-memory";
		dma = <&edma>;
		channel-link;
		scatter-gather;
	};
};

&edma {
	status = "okay";
};
