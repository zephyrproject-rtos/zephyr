## boards/nxp/frdm_rw612/frdm_rw612_defconfig
```kconfig
#
# Copyright 2022 NXP
#
# SPDX-License-Identifier: Apache-2.0
#

CONFIG_CONSOLE=y
CONFIG_UART_CONSOLE=y
CONFIG_SERIAL=y
CONFIG_UART_INTERRUPT_DRIVEN=y
CONFIG_GPIO=y
CONFIG_ARM_MPU=y
CONFIG_HW_STACK_PROTECTION=y
CONFIG_TRUSTED_EXECUTION_SECURE=y
```

## boards/nxp/hexiwear/Kconfig.defconfig
```kconfig
# Hexiwear K64 board

# Copyright (c) 2016, Freescale Semiconductor, Inc.
# Copyright 2017,2024 NXP
# SPDX-License-Identifier: Apache-2.0

if BOARD_HEXIWEAR_MK64F12

config OSC_XTAL0_FREQ
	default 12000000

config MCG_PRDIV0
	default 0x02

config MCG_VDIV0
	default 0x06

config MCG_FCRDIV
	default 1

config REGULATOR
	default y if ADC || SENSOR

endif # BOARD_HEXIWEAR_MK64F12

# Hexiwear KW40Z board

if BOARD_HEXIWEAR_MKW40Z4

config OSC_XTAL0_FREQ
	default 32000000

config MCG_FRDIV
	default 5

config MCG_FCRDIV
	default 0

endif # BOARD_HEXIWEAR_MKW40Z4
```

## boards/nxp/hexiwear/board.yml
```yaml
board:
  name: hexiwear
  full_name: Hexiwear
  vendor: nxp
  socs:
    - name: mk64f12
    - name: mkw40z4
```

## boards/nxp/hexiwear/hexiwear_mkw40z4_defconfig
```kconfig
# SPDX-License-Identifier: Apache-2.0

CONFIG_CONSOLE=y
CONFIG_RTT_CONSOLE=y
CONFIG_USE_SEGGER_RTT=y
CONFIG_PINCTRL=y
CONFIG_GPIO=y
CONFIG_SYS_CLOCK_HW_CYCLES_PER_SEC=40000000
CONFIG_OSC_EXTERNAL=y
```

## boards/nxp/imx8mm_evk/Kconfig.defconfig
```kconfig
# MIMX8MM EVK board defconfig

# Copyright (c) 2020, Manivannan Sadhasivam <mani@kernel.org>
# SPDX-License-Identifier: Apache-2.0

if BOARD_IMX8MM_EVK_MIMX8MM6_M4

if !XIP
config FLASH_SIZE
	default 0
config FLASH_BASE_ADDRESS
	default 0
endif

endif # BOARD_IMX8MM_EVK_MIMX8MM6_M4
```

## boards/nxp/imx8mm_evk/Kconfig.imx8mm_evk
```kconfig
# Copyright 2021-2022,2024 NXP
# SPDX-License-Identifier: Apache-2.0

config BOARD_IMX8MM_EVK
	select SOC_MIMX8MM6_A53 if BOARD_IMX8MM_EVK_MIMX8MM6_A53 || BOARD_IMX8MM_EVK_MIMX8MM6_A53_SMP
	select SOC_MIMX8MM6_M4 if BOARD_IMX8MM_EVK_MIMX8MM6_M4
	select SOC_PART_NUMBER_MIMX8MM6DVTLZ
```

## boards/nxp/imx8mm_evk/board.yml
```yaml
board:
  name: imx8mm_evk
  full_name: i.MX8MM EVK
  vendor: nxp
  socs:
  - name: mimx8mm6
    variants:
    - name: smp
      cpucluster: a53
```

## boards/nxp/imx8mm_evk/imx8mm_evk_mimx8mm6_a53_defconfig
```kconfig
# SPDX-License-Identifier: Apache-2.0

# ARM Options
CONFIG_AARCH64_IMAGE_HEADER=y
CONFIG_ARMV8_A_NS=y
CONFIG_ARM64_VA_BITS_36=y
CONFIG_ARM64_PA_BITS_36=y

# Cache Options
CONFIG_CACHE_MANAGEMENT=y
CONFIG_DCACHE_LINE_SIZE_DETECT=y
CONFIG_ICACHE_LINE_SIZE_DETECT=y

# Zephyr Kernel Configuration
CONFIG_XIP=n
CONFIG_KERNEL_DIRECT_MAP=y

# Serial Drivers
CONFIG_SERIAL=y
CONFIG_UART_INTERRUPT_DRIVEN=y

# Enable Console
CONFIG_CONSOLE=y
CONFIG_UART_CONSOLE=y

CONFIG_CLOCK_CONTROL=y
CONFIG_PINCTRL=y
```

## boards/nxp/imx8mm_evk/imx8mm_evk_mimx8mm6_m4_defconfig
```kconfig
#
# Copyright (c) 2020, Manivannan Sadhasivam <mani@kernel.org>
# Copyright 2024 NXP
#
# SPDX-License-Identifier: Apache-2.0
#

CONFIG_CLOCK_CONTROL=y
CONFIG_UART_CONSOLE=y
CONFIG_SERIAL=y
CONFIG_UART_INTERRUPT_DRIVEN=y
CONFIG_CONSOLE=y
CONFIG_XIP=y
CONFIG_PINCTRL=y
```

## boards/nxp/imx8mn_evk/Kconfig.defconfig
```kconfig
# Copyright 2024 NXP
# SPDX-License-Identifier: Apache-2.0

if BOARD_IMX8MN_EVK

if BOARD_IMX8MN_EVK_MIMX8MN6_A53 || BOARD_IMX8MN_EVK_MIMX8MN6_A53_SMP

configdefault NET_L2_ETHERNET
	default y

configdefault NET_TX_STACK_SIZE
	default 8192

configdefault NET_RX_STACK_SIZE
	default 8192

configdefault NET_TCP_WORKQ_STACK_SIZE
	default 8192

configdefault NET_MGMT_EVENT_STACK_SIZE
	default 8192

configdefault NET_SOCKETS_SERVICE_STACK_SIZE
	default 8192

endif # BOARD_IMX8MN_EVK_MIMX8MN6_A53 || BOARD_IMX8MN_EVK_MIMX8MN6_A53_SMP

endif # BOARD_IMX8MN_EVK
```

## boards/nxp/imx8mn_evk/Kconfig.imx8mn_evk
```kconfig
# Copyright 2022,2024 NXP
# SPDX-License-Identifier: Apache-2.0

config BOARD_IMX8MN_EVK
	select SOC_MIMX8MN6_A53 if BOARD_IMX8MN_EVK_MIMX8MN6_A53 || BOARD_IMX8MN_EVK_MIMX8MN6_A53_SMP
	select SOC_PART_NUMBER_MIMX8MN6DVTJZ if BOARD_IMX8MN_EVK_MIMX8MN6_A53 || BOARD_IMX8MN_EVK_MIMX8MN6_A53_SMP
```

## boards/nxp/imx8mn_evk/board.yml
```yaml
board:
  name: imx8mn_evk
  full_name: 8MNANOLPD4-EVK
  vendor: nxp
  socs:
  - name: mimx8mn6
    variants:
    - name: smp
      cpucluster: a53
```

## boards/nxp/imx8mp_evk/Kconfig.defconfig
```kconfig
# Copyright 2024-2025 NXP
# SPDX-License-Identifier: Apache-2.0

if BOARD_IMX8MP_EVK

if BOARD_IMX8MP_EVK_MIMX8ML8_A53 || BOARD_IMX8MP_EVK_MIMX8ML8_A53_SMP

configdefault NET_L2_ETHERNET
	default y

configdefault NET_TX_STACK_SIZE
	default 8192

configdefault NET_RX_STACK_SIZE
	default 8192

configdefault NET_TCP_WORKQ_STACK_SIZE
	default 8192

configdefault NET_MGMT_EVENT_STACK_SIZE
	default 8192

configdefault NET_SOCKETS_SERVICE_STACK_SIZE
	default 8192

if CAN && GPIO_PCA_SERIES

# For FlexCAN2, SAI5 PDM/CAN2 IOMUX select is controlled by IO expander PCA6416A
# IO port, so CAN transceiver must be initialized after PCA6416A initialization
config CAN_TRANSCEIVER_INIT_PRIORITY
	default 75

endif # CAN && GPIO_PCA_SERIES

endif # BOARD_IMX8MP_EVK_MIMX8ML8_A53 || BOARD_IMX8MP_EVK_MIMX8ML8_A53_SMP

endif # BOARD_IMX8MP_EVK
```

## boards/nxp/imx8mp_evk/Kconfig.imx8mp_evk
```kconfig
# Copyright 2021-2022, 2024 NXP
# SPDX-License-Identifier: Apache-2.0

config BOARD_IMX8MP_EVK
	select SOC_MIMX8ML8_A53 if BOARD_IMX8MP_EVK_MIMX8ML8_A53 || BOARD_IMX8MP_EVK_MIMX8ML8_A53_SMP
	select SOC_MIMX8ML8_ADSP if BOARD_IMX8MP_EVK_MIMX8ML8_ADSP
	select SOC_MIMX8ML8_M7 if BOARD_IMX8MP_EVK_MIMX8ML8_M7 || BOARD_IMX8MP_EVK_MIMX8ML8_M7_DDR
	select SOC_PART_NUMBER_MIMX8ML8DVNLZ
```

## boards/nxp/imx8mp_evk/board.yml
```yaml
board:
  name: imx8mp_evk
  full_name: 8MPLUSLPD4-EVK
  vendor: nxp
  socs:
  - name: mimx8ml8
    variants:
    - name: smp
      cpucluster: a53
    - name: ddr
      cpucluster: m7
```

## boards/nxp/imx8mp_evk/imx8mp_evk_mimx8ml8_adsp_defconfig
```kconfig
# SPDX-License-Identifier: Apache-2.0

# size of stack for initialization and main thread
CONFIG_MAIN_STACK_SIZE=3072

# enable logger
CONFIG_LOG=y

# no need for a "raw" binary zephyr/zephyr.bin in the build directory
CONFIG_BUILD_OUTPUT_BIN=n

# enable uart driver
CONFIG_SERIAL=y

# clock configuration
CONFIG_CLOCK_CONTROL=y

# console (remote proc console by default)
CONFIG_CONSOLE=y

# uart console (overrides remote proc console)
CONFIG_UART_CONSOLE=y

CONFIG_MULTI_LEVEL_INTERRUPTS=y
CONFIG_2ND_LEVEL_INTERRUPTS=y
CONFIG_2ND_LVL_ISR_TBL_OFFSET=32
CONFIG_MAX_IRQ_PER_AGGREGATOR=64
CONFIG_NUM_2ND_LEVEL_AGGREGATORS=3
CONFIG_2ND_LVL_INTR_00_OFFSET=19
CONFIG_2ND_LVL_INTR_01_OFFSET=20
CONFIG_2ND_LVL_INTR_02_OFFSET=21
```

## boards/nxp/imx8mp_evk/imx8mp_evk_mimx8ml8_m7_ddr_defconfig
```kconfig
#
# Copyright (c) 2021, Laird Connectivity
#
# SPDX-License-Identifier: Apache-2.0
#

CONFIG_CLOCK_CONTROL=y
CONFIG_UART_CONSOLE=y
CONFIG_SERIAL=y
CONFIG_UART_INTERRUPT_DRIVEN=y
CONFIG_CONSOLE=y
CONFIG_XIP=y
CONFIG_CODE_DDR=y
CONFIG_PINCTRL=y
```

## boards/nxp/imx8mq_evk/Kconfig.defconfig
```kconfig
# MIMX8MQ EVK board defconfig

# Copyright (c) 2021, Kwon Tae-young <tykwon@m2i.co.kr>
# Copyright 2024 NXP
# SPDX-License-Identifier: Apache-2.0

if BOARD_IMX8MQ_EVK

if !XIP
config FLASH_SIZE
	default 0
config FLASH_BASE_ADDRESS
	default 0
endif

endif # BOARD_IMX8MQ_EVK
```

## boards/nxp/imx8mq_evk/Kconfig.imx8mq_evk
```kconfig
# MIMX8MQ EVK board

# Copyright (c) 2021, Kwon Tae-young <tykwon@m2i.co.kr>
# Copyright 2024 NXP
# SPDX-License-Identifier: Apache-2.0

config BOARD_IMX8MQ_EVK
	select SOC_PART_NUMBER_MIMX8MQ6DVAJZ
	select SOC_MIMX8MQ6_M4 if BOARD_IMX8MQ_EVK_MIMX8MQ6_M4
```

## boards/nxp/imx8mq_evk/board.yml
```yaml
board:
  name: imx8mq_evk
  full_name: MCIMX8M-EVK
  vendor: nxp
  socs:
  - name: mimx8mq6
```

## boards/nxp/imx8mq_evk/imx8mq_evk_mimx8mq6_m4_defconfig
```kconfig
#
# Copyright (c) 2021, Kwon Tae-young <tykwon@m2i.co.kr>
# Copyright 2024
#
# SPDX-License-Identifier: Apache-2.0
#

CONFIG_CLOCK_CONTROL=y
CONFIG_UART_CONSOLE=y
CONFIG_SERIAL=y
CONFIG_UART_INTERRUPT_DRIVEN=y
CONFIG_CONSOLE=y
CONFIG_XIP=y
CONFIG_PINCTRL=y
```

## boards/nxp/imx8qm_mek/Kconfig.imx8qm_mek
```kconfig
#
# Copyright 2024 NXP
#
# SPDX-License-Identifier: Apache-2.0

config BOARD_IMX8QM_MEK
	select SOC_MIMX8QM_ADSP if BOARD_IMX8QM_MEK_MIMX8QM6_ADSP
	select SOC_PART_NUMBER_MIMX8QM6AVUFF
```

## boards/nxp/imx8qm_mek/board.yml
```yaml
board:
  name: imx8qm_mek
  full_name: i.MX8QM-MEK
  vendor: nxp
  socs:
    - name: mimx8qm6
```

## boards/nxp/imx8qm_mek/imx8qm_mek_mimx8qm6_adsp_defconfig
```kconfig
# SPDX-License-Identifier: Apache-2.0

CONFIG_MAIN_STACK_SIZE=3072
CONFIG_PM_DEVICE=y
CONFIG_PM_DEVICE_RUNTIME=y
CONFIG_POWER_DOMAIN=y

# board/soc-related configurations
CONFIG_LOG=y

# TODO: maybe move this to SOF?
CONFIG_DYNAMIC_INTERRUPTS=y
CONFIG_BUILD_OUTPUT_BIN=n

# clock-related configurations
CONFIG_CLOCK_CONTROL=y

# serial-related configurations
CONFIG_SERIAL=y
CONFIG_CONSOLE=y
CONFIG_UART_CONSOLE=y

# interrupt-related configurations
CONFIG_MULTI_LEVEL_INTERRUPTS=y
CONFIG_2ND_LEVEL_INTERRUPTS=y
CONFIG_2ND_LVL_ISR_TBL_OFFSET=32
CONFIG_MAX_IRQ_PER_AGGREGATOR=64
CONFIG_NUM_2ND_LEVEL_AGGREGATORS=8
CONFIG_2ND_LVL_INTR_00_OFFSET=19
CONFIG_2ND_LVL_INTR_01_OFFSET=20
CONFIG_2ND_LVL_INTR_02_OFFSET=21
CONFIG_2ND_LVL_INTR_03_OFFSET=22
CONFIG_2ND_LVL_INTR_04_OFFSET=23
CONFIG_2ND_LVL_INTR_05_OFFSET=24
CONFIG_2ND_LVL_INTR_06_OFFSET=25
CONFIG_2ND_LVL_INTR_07_OFFSET=26
CONFIG_2ND_LEVEL_INTERRUPT_BITS=9
```

## boards/nxp/imx8qm_mek/imx8qm_mek_mimx8qm6_defconfig
```kconfig
# SPDX-License-Identifier: Apache-2.0

CONFIG_MAIN_STACK_SIZE=3072

# board/soc-related configurations
CONFIG_LOG=y

# TODO: maybe move this to SOF?
CONFIG_DYNAMIC_INTERRUPTS=y
CONFIG_BUILD_OUTPUT_BIN=n

# clock-related configurations
CONFIG_CLOCK_CONTROL=y

# serial-related configurations
CONFIG_SERIAL=y
CONFIG_CONSOLE=y
CONFIG_UART_CONSOLE=y
```
