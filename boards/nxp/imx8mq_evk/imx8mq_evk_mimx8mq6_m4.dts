/*
 * Copyright (c) 2021, Kwon Tae-young <tykwon@m2i.co.kr>
 *
 * SPDX-License-Identifier: Apache-2.0
 */

/dts-v1/;

#include <nxp/nxp_imx8mq_m4.dtsi>
#include "imx8mq_evk-pinctrl.dtsi"

/ {
	model = "NXP i.MX8MQ EVK board";
	compatible = "nxp,mimx8mq_evk";

	aliases {
		uart-2 = &uart2;
	};

	chosen {
		zephyr,flash = &tcml_code;
		zephyr,sram = &tcmu_sys;
		zephyr,console = &uart2;
		zephyr,shell-uart = &uart2;
	};
};

&uart2 {
	status = "okay";
	current-speed = <115200>;
	pinctrl-0 = <&uart2_default>;
	pinctrl-names = "default";
};
