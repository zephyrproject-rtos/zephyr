/*
 * Copyright 2025 NXP
 *
 * SPDX-License-Identifier: Apache-2.0
 */

/dts-v1/;

#include <nxp/nxp_mcxw236_ns.dtsi>
#include "mcxw23_evk_common.dtsi"

/ {
	compatible = "nxp,mcxw236", "nxp,mcx";
	model = "NXP MCXW23-EVK board";
};
