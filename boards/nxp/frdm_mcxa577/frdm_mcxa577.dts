/*
 * Copyright 2025-2026 NXP
 *
 * SPDX-License-Identifier: Apache-2.0
 */

/dts-v1/;

#include <nxp/mcx/mcxa/nxp_mcxa5x.dtsi>
#include "frdm_mcxa577.dtsi"

/ {
	compatible = "nxp,mcxa577", "nxp,mcx";
	model = "NXP FRDM_MCXA577 board";

	chosen {
		zephyr,sram = &sram0;
		zephyr,flash = &flash;
		zephyr,flash-controller = &fmu;
		zephyr,code-partition = &slot0_partition;
		zephyr,console = &lpuart1;
		zephyr,shell-uart = &lpuart1;
		zephyr,edac = &erm0;
		zephyr,crc = &crc;
		zephyr,canbus = &flexcan0;
		zephyr,system-timer-companion = &lptmr0;
	};
};

&dac0 {
	pinctrl-0 = <&pinmux_dac0>;
	pinctrl-names = "default";
	status = "okay";
};
