/*
 * Copyright 2026 NXP
 * SPDX-License-Identifier: Apache-2.0
 */

/* Replace existing SRAM bus mapping */
&sram {
	reg = <0x20000000 0x480000>;
	ranges = <0x20000000 0x20000000 0x480000>;
};

/* Fix actual SRAM physical region */
&sram0 {
	reg = <0x20080000 DT_SIZE_K(4608)>;
};
