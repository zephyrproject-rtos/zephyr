/*
 * Copyright 2025 NXP
 * SPDX-License-Identifier: Apache-2.0
 */

/ {
	dma_test_edma0: dma-test-edma0 {
		compatible = "test-dma-memory-to-memory";
		dma = <&edma0>;
		max-transfer-size = <1024>;
	};
};

&edma0 {
	status = "okay";
};
