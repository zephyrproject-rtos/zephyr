/*
 * Copyright 2025 NXP
 *
 * SPDX-License-Identifier: Apache-2.0
 */

/dts-v1/;

#include "mcx_n9xx_evk_mcxn947_cpu0.dtsi"

/ {
	model = "NXP MCX-N9XX-EVK board";
	compatible = "nxp,mcxn947", "nxp,mcx";
};
