/*
 * Copyright 2025 Filip Stojanovic <filipembedded@gmail.com>
 *
 * SPDX-License-Identifier: Apache-2.0
 */

/dts-v1/;

#include "frdm_imx93_mimx9352_m33.dts"

/ {
	model = "NXP FRDM-IMX93 M33 DDR variant";

	chosen {
		zephyr,sram = &ddr;
		/delete-property/ zephyr,flash;
	};

	ddr: memory@84000000 {
		device_type = "memory";
		reg = <0x84000000 DT_SIZE_M(4)>;
	};
};
