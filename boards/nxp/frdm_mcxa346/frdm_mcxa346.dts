/*
 * Copyright 2025 NXP
 *
 * SPDX-License-Identifier: Apache-2.0
 */

/dts-v1/;

#include <nxp/nxp_mcxa346.dtsi>
#include "frdm_mcxa346-pinctrl.dtsi"
#include "../common/frdm_mcxa266_a346_a366_common.dtsi"

/ {
	model = "NXP FRDM_MCXA346 board";
	compatible = "nxp,mcxa346", "nxp,mcx";
};

&cpu0 {
	clock-frequency = <180000000>;
};
