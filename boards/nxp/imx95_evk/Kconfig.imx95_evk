## boards/nxp/imx95_evk/Kconfig.imx95_evk
```kconfig
# Copyright 2024 NXP
# SPDX-License-Identifier: Apache-2.0

config BOARD_IMX95_EVK
	select SOC_MIMX9596_M7 if BOARD_IMX95_EVK_MIMX9596_M7 || BOARD_IMX95_EVK_MIMX9596_M7_DDR || BOARD_IMX95_EVK_MIMX9596_M7_FLASH
	select SOC_MIMX9596_A55 if BOARD_IMX95_EVK_MIMX9596_A55 || BOARD_IMX95_EVK_MIMX9596_A55_SMP
	select SOC_PART_NUMBER_MIMX9596AVZXN
```

## boards/nxp/imx95_evk/board.yml
```yaml
board:
  name: imx95_evk
  full_name: i.MX95 EVK
  vendor: nxp
  socs:
  - name: mimx9596
    variants:
    - name: smp
      cpucluster: a55
    - name: ddr
      cpucluster: m7
```

## boards/nxp/imx95_evk/imx95_evk_mimx9596_a55_defconfig
```kconfig
#
# Copyright 2024 NXP
#
# SPDX-License-Identifier: Apache-2.0

# ARM Options
CONFIG_AARCH64_IMAGE_HEADER=y
CONFIG_ARMV8_A_NS=y

# MMU Options
CONFIG_MAX_XLAT_TABLES=64

# Cache Options
CONFIG_CACHE_MANAGEMENT=y
CONFIG_DCACHE_LINE_SIZE_DETECT=y
CONFIG_ICACHE_LINE_SIZE_DETECT=y

# Zephyr Kernel Configuration
CONFIG_XIP=n
CONFIG_KERNEL_DIRECT_MAP=y

# Serial Drivers
CONFIG_SERIAL=y
CONFIG_UART_INTERRUPT_DRIVEN=y

# Enable Console
CONFIG_CONSOLE=y
CONFIG_UART_CONSOLE=y

CONFIG_CLOCK_CONTROL=y

CONFIG_MBOX=y
CONFIG_ARM_SCMI=y
CONFIG_INTC_INIT_PRIORITY=2
CONFIG_MBOX_INIT_PRIORITY=3
```

## boards/nxp/imx95_evk/imx95_evk_mimx9596_m7_ddr_defconfig
```kconfig
#
# Copyright 2024 NXP
#
# SPDX-License-Identifier: Apache-2.0
#

# clock-related configurations
CONFIG_CLOCK_CONTROL=y

# serial interface-related configurations
CONFIG_SERIAL=y
CONFIG_UART_INTERRUPT_DRIVEN=y
CONFIG_UART_CONSOLE=y
CONFIG_CONSOLE=y

# SCMI-related configurations
CONFIG_MBOX=y
CONFIG_MBOX_INIT_PRIORITY=0
CONFIG_ARM_SCMI=y
CONFIG_ARM_SCMI_NXP_VENDOR_EXTENSIONS=y

# kernel-related configurations
CONFIG_XIP=n
```

## boards/nxp/imx95_evk/imx95_evk_mimx9596_m7_flash_defconfig
```kconfig
#
# Copyright 2025 NXP
#
# SPDX-License-Identifier: Apache-2.0
#

CONFIG_CLOCK_CONTROL=y
CONFIG_SERIAL=y
CONFIG_UART_CONSOLE=y
CONFIG_UART_INTERRUPT_DRIVEN=y
CONFIG_CONSOLE=y
CONFIG_XIP=y
CONFIG_MBOX=y
CONFIG_MBOX_INIT_PRIORITY=0
CONFIG_ARM_SCMI=y
CONFIG_ARM_SCMI_NXP_VENDOR_EXTENSIONS=y

CONFIG_FLASH_BASE_ADDRESS=0x2000000
CONFIG_FLASH_SIZE=131072
```

## boards/nxp/imx95_evk_15x15/Kconfig.imx95_evk_15x15
```kconfig
# Copyright 2025 NXP
# SPDX-License-Identifier: Apache-2.0

config BOARD_IMX95_EVK_15X15
	select SOC_MIMX9596_A55 if BOARD_IMX95_EVK_15X15_MIMX9596_A55
	select SOC_MIMX9596_M7 if BOARD_IMX95_EVK_15X15_MIMX9596_M7
	# Use a part number that exists in MCUX device headers for both A55 and M7.
	select SOC_PART_NUMBER_MIMX9596AVZXN
```

## boards/nxp/imx95_evk_15x15/board.yml
```yaml
board:
  name: imx95_evk_15x15
  full_name: i.MX95 15x15 EVK
  vendor: nxp
  socs:
  - name: mimx9596
```

## boards/nxp/kw45b41z_evk/Kconfig
```kconfig
# Copyright 2025 NXP
# SPDX-License-Identifier: Apache-2.0

config BOARD_INIT_PRIORITY
	int "Board initialization priority"
	default 45
	help
	  Board initialization priority.
```

## boards/nxp/kw45b41z_evk/Kconfig.defconfig
```kconfig
# KW45B41Z-EVK board

# Copyright 2025 NXP
# SPDX-License-Identifier: Apache-2.0

if BOARD_KW45B41Z_EVK

config BT_DIS_MANUF
	default "NXP"

endif # BOARD_KW45B41Z_EVK
```

## boards/nxp/kw45b41z_evk/Kconfig.kw45b41z_evk
```kconfig
# Copyright 2025 NXP
# SPDX-License-Identifier: Apache-2.0

config BOARD_KW45B41Z_EVK
	select SOC_KW45B41Z83
	select SOC_PART_NUMBER_KW45B41Z83AFTA
```

## boards/nxp/kw45b41z_evk/board.yml
```yaml
# Copyright 2025 NXP
# SPDX-License-Identifier: Apache-2.0

board:
  name: kw45b41z_evk
  vendor: nxp
  socs:
    - name: kw45b41z83
```

## boards/nxp/kw45b41z_evk/kw45b41z_evk_defconfig
```kconfig
# Copyright 2025 NXP
# SPDX-License-Identifier: Apache-2.0

CONFIG_ARM_MPU=y
CONFIG_TRUSTED_EXECUTION_SECURE=y
CONFIG_PINCTRL=y
CONFIG_SERIAL=y
CONFIG_CONSOLE=y
CONFIG_UART_CONSOLE=y
CONFIG_GPIO=y
```

## boards/nxp/lpc845_brk/Kconfig.lpc845_brk
```kconfig
config BOARD_LPC845_BRK
	select SOC_LPC845
	select SOC_PART_NUMBER_LPC845M301JBD48
```

## boards/nxp/lpc845_brk/board.yml
```yaml
board:
  name: lpc845_brk
  full_name: LPC845_BRK
  vendor: nxp
  socs:
    - name: lpc845
```

## boards/nxp/lpc845_brk/lpc845_brk_defconfig
```kconfig
CONFIG_SYS_CLOCK_HW_CYCLES_PER_SEC=30000000
CONFIG_GPIO=y
CONFIG_BUILD_OUTPUT_HEX=y
```

## boards/nxp/lpc845brk/board.yml
```yaml
board:
  name: lpc845brk
  full_name: LPC845-BRK
  vendor: nxp
  socs:
    - name: lpc845
```

## boards/nxp/lpc845brk/lpc845brk_defconfig
```kconfig
# Copyright (c) 2026, Aerlync Labs Inc.
#
# SPDX-License-Identifier: Apache-2.0

# Enable clock control subsystem
CONFIG_CLOCK_CONTROL=y

# Enable serial subsystem
CONFIG_SERIAL=y

# Enable LPC84x UART driver
CONFIG_UART_LPC84X=y

# Enable console over UART
CONFIG_CONSOLE=y
CONFIG_UART_CONSOLE=y

# Build additional HEX output image
CONFIG_BUILD_OUTPUT_HEX=y
```

## boards/nxp/lpcxpresso11u68/Kconfig.lpcxpresso11u68
```kconfig
# Copyright (c) 2020, Seagate
# Copyright 2024 NXP
#
# SPDX-License-Identifier: Apache-2.0

config BOARD_LPCXPRESSO11U68
	select SOC_LPC11U68
	select SOC_PART_NUMBER_LPC11U68JBD100
```

## boards/nxp/lpcxpresso11u68/board.yml
```yaml
board:
  name: lpcxpresso11u68
  full_name: LPCXpresso11U68
  vendor: nxp
  socs:
    - name: lpc11u68
```

## boards/nxp/lpcxpresso51u68/Kconfig.lpcxpresso51u68
```kconfig
# Copyright (c) 2021 metraTec GmbH
# Copyright 2024 NXP
#
# SPDX-License-Identifier: Apache-2.0

config BOARD_LPCXPRESSO51U68
	select SOC_LPC51U68
	select SOC_PART_NUMBER_LPC51U68JBD64
```

## boards/nxp/lpcxpresso51u68/board.yml
```yaml
board:
  name: lpcxpresso51u68
  full_name: LPCXPRESSO51U68
  vendor: nxp
  socs:
    - name: lpc51u68
```

## boards/nxp/lpcxpresso54114/Kconfig.lpcxpresso54114
```kconfig
# LPCXpresso54114 board

# Copyright 2017, 2024 NXP
# SPDX-License-Identifier: Apache-2.0

config BOARD_LPCXPRESSO54114
	select SOC_LPC54114_M4 if BOARD_LPCXPRESSO54114_LPC54114_M4
	select SOC_LPC54114_M0 if BOARD_LPCXPRESSO54114_LPC54114_M0
	select SOC_PART_NUMBER_LPC54114J256BD64
```

## boards/nxp/lpcxpresso54114/board.yml
```yaml
board:
  name: lpcxpresso54114
  full_name: LPCXPRESSO54114
  vendor: nxp
  socs:
    - name: lpc54114
```

## boards/nxp/lpcxpresso54114/lpcxpresso54114_lpc54114_m0_defconfig
```kconfig
#
# Copyright (c) 2017, 2024 NXP
#
# SPDX-License-Identifier: Apache-2.0
#

CONFIG_USE_SEGGER_RTT=y
CONFIG_SERIAL=n
CONFIG_GPIO=n
CONFIG_SYS_CLOCK_HW_CYCLES_PER_SEC=48000000
CONFIG_PINCTRL=y
```

## boards/nxp/lpcxpresso54628/Kconfig.lpcxpresso54628
```kconfig
# Copyright 2026 NXP
#
# SPDX-License-Identifier: Apache-2.0

config BOARD_LPCXPRESSO54628
	select SOC_LPC54628
	select SOC_PART_NUMBER_LPC54628J512ET180
```
