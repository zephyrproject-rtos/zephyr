/*
 * Copyright 2025 NXP
 *
 * SPDX-License-Identifier: Apache-2.0
 */

/dts-v1/;

#include "imx93_evk_mimx9352_a55.dts"

/ {
	cpus {
		cpu@0 {
			status = "okay";
		};
	};

	psci {
		compatible = "arm,psci-1.1";
		method = "smc";
	};
};
