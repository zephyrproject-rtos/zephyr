/* SPDX-License-Identifier: Apache-2.0 */
/* SPDX-FileCopyrightText: Copyright (c) 2026 Filip Stojanovic <filipembedded@gmail.com> */

/dts-v1/;

#include "frdm_imx8mp_mimx8ml8_m7.dtsi"

/ {
	chosen {
		zephyr,flash = &ddr_code;
		zephyr,sram = &ddr_sys;
	};
};
