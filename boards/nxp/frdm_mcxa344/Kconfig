## boards/nxp/frdm_mcxa344/Kconfig
```kconfig
# Copyright 2025 NXP
# SPDX-License-Identifier: Apache-2.0

config BOARD_FRDM_MCXA344
	select BOARD_EARLY_INIT_HOOK
```

## boards/nxp/frdm_mcxa344/Kconfig.frdm_mcxa344
```kconfig
# Copyright 2025 NXP
# SPDX-License-Identifier: Apache-2.0

config BOARD_FRDM_MCXA344
	select SOC_MCXA344
	select SOC_PART_NUMBER_MCXA344VLL
```

## boards/nxp/frdm_mcxa344/board.yml
```yaml
board:
  name: frdm_mcxa344
  full_name: FRDM-MCXA344
  vendor: nxp
  socs:
  - name: mcxa344
```

## boards/nxp/frdm_mcxa346/Kconfig
```kconfig
# Copyright 2025 NXP
# SPDX-License-Identifier: Apache-2.0

config BOARD_FRDM_MCXA346
	select BOARD_EARLY_INIT_HOOK
```

## boards/nxp/frdm_mcxa346/board.yml
```yaml
board:
  name: frdm_mcxa346
  full_name: FRDM-MCXA346
  vendor: nxp
  socs:
  - name: mcxa346
```

## boards/nxp/frdm_mcxa346/frdm_mcxa346_defconfig
```kconfig
#
# Copyright 2025 NXP
#
# SPDX-License-Identifier: Apache-2.0
#

CONFIG_CONSOLE=y
CONFIG_UART_CONSOLE=y
CONFIG_SERIAL=y
CONFIG_UART_INTERRUPT_DRIVEN=y
CONFIG_GPIO=y
CONFIG_LPADC_DO_OFFSET_CALIBRATION=y
CONFIG_SYS_CLOCK_HW_CYCLES_PER_SEC=180000000
```

## boards/nxp/frdm_mcxa366/board.yml
```yaml
board:
  name: frdm_mcxa366
  full_name: FRDM-MCXA366
  vendor: nxp
  socs:
  - name: mcxa366
```

## boards/nxp/frdm_mcxa577/Kconfig.frdm_mcxa577
```kconfig
# Copyright 2025 NXP
# SPDX-License-Identifier: Apache-2.0

config BOARD_FRDM_MCXA577
	select SOC_MCXA577
	select SOC_PART_NUMBER_MCXA577VLL
```

## boards/nxp/frdm_mcxa577/board.yml
```yaml
board:
  name: frdm_mcxa577
  full_name: FRDM-MCXA577
  vendor: nxp
  socs:
  - name: mcxa577
```

## boards/nxp/frdm_mcxa577/frdm_mcxa577_mcxa577_ns_defconfig
```kconfig
#
# Copyright 2026 NXP
#
# SPDX-License-Identifier: Apache-2.0
#

CONFIG_CONSOLE=y
CONFIG_UART_CONSOLE=y
CONFIG_SERIAL=y
CONFIG_UART_INTERRUPT_DRIVEN=y
CONFIG_GPIO=y
CONFIG_LPADC_DO_OFFSET_CALIBRATION=y

CONFIG_ARM_MPU=y
CONFIG_HW_STACK_PROTECTION=y

# Enable TrustZone-M
CONFIG_TRUSTED_EXECUTION_NONSECURE=y

CONFIG_TFM_BL2=y
CONFIG_BUILD_WITH_TFM=y
CONFIG_FLASH_BASE_ADDRESS=0x40000
```

## boards/nxp/frdm_mcxaxx6/Kconfig
```kconfig
# Copyright 2025 NXP
# SPDX-License-Identifier: Apache-2.0

config BOARD_NEEDS_EARLY_HOOK
	bool
	default y if BOARD_FRDM_MCXA266 || BOARD_FRDM_MCXA346 || BOARD_FRDM_MCXA366
	select BOARD_EARLY_INIT_HOOK
```

## boards/nxp/frdm_mcxaxx6/Kconfig.frdm_mcxa346
```kconfig
# Copyright 2025 NXP
# SPDX-License-Identifier: Apache-2.0

config BOARD_FRDM_MCXA346
	select SOC_MCXA346
	select SOC_PART_NUMBER_MCXA346VLQ
```

## boards/nxp/frdm_mcxaxx6/Kconfig.frdm_mcxa366
```kconfig
# Copyright 2025 NXP
# SPDX-License-Identifier: Apache-2.0

config BOARD_FRDM_MCXA366
	select SOC_MCXA366
	select SOC_PART_NUMBER_MCXA366VLQ
```

## boards/nxp/frdm_mcxaxx6/board.yml
```yaml
boards:
  - name: frdm_mcxa266
    full_name: FRDM-MCXA266
    vendor: nxp
    socs:
      - name: mcxa266
  - name: frdm_mcxa346
    full_name: FRDM-MCXA346
    vendor: nxp
    socs:
      - name: mcxa346
  - name: frdm_mcxa366
    full_name: FRDM-MCXA366
    vendor: nxp
    socs:
      - name: mcxa366
```

## boards/nxp/frdm_mcxaxx6/frdm_mcxa266_defconfig
```kconfig
#
# Copyright 2025 NXP
#
# SPDX-License-Identifier: Apache-2.0
#

CONFIG_CONSOLE=y
CONFIG_UART_CONSOLE=y
CONFIG_SERIAL=y
CONFIG_UART_INTERRUPT_DRIVEN=y
CONFIG_GPIO=y
CONFIG_LPADC_DO_OFFSET_CALIBRATION=y
CONFIG_AUXDISPLAY_MCUX_SLCD_LCD_OD_6010=y
```

## boards/nxp/frdm_mcxc242/board.yml
```yaml
board:
  name: frdm_mcxc242
  full_name: FRDM-MCXC242
  vendor: nxp
  socs:
    - name: mcxc242
```

## boards/nxp/frdm_mcxc444/Kconfig.defconfig
```kconfig
#
# Copyright 2025 NXP
#
# SPDX-License-Identifier: Apache-2.0
#

if BOARD_FRDM_MCXC444

config WDT_DISABLE_AT_BOOT
	default y

endif #BOARD_FRDM_MCXC444
```

## boards/nxp/frdm_mcxc444/Kconfig.frdm_mcxc444
```kconfig
# Copyright 2024 NXP
# SPDX-License-Identifier: Apache-2.0

config BOARD_FRDM_MCXC444
	select SOC_MCXC444
	select SOC_PART_NUMBER_MCXC444VLH
```

## boards/nxp/frdm_mcxc444/board.yml
```yaml
board:
  name: frdm_mcxc444
  full_name: FRDM-MCXC444
  vendor: nxp
  socs:
    - name: mcxc444
```

## boards/nxp/frdm_mcxe247/Kconfig
```kconfig
# Copyright 2025 NXP
# SPDX-License-Identifier: Apache-2.0

config BOARD_FRDM_MCXE247
	select BOARD_EARLY_INIT_HOOK
```

## boards/nxp/frdm_mcxe247/Kconfig.frdm_mcxe247
```kconfig
# Copyright 2025 NXP
# SPDX-License-Identifier: Apache-2.0

config BOARD_FRDM_MCXE247
	select SOC_MCXE247
	select SOC_PART_NUMBER_MCXE247VLQ
```

## boards/nxp/frdm_mcxe31b/Kconfig
```kconfig
# Copyright 2025 NXP
# SPDX-License-Identifier: Apache-2.0

config BOARD_FRDM_MCXE31B
	select BOARD_EARLY_INIT_HOOK

config BOARD_NXP_MCXE31X_BOOT_HEADER
	bool "MCXE31x boot header support"
	select SOC_NXP_MCXE31X_BOOT_HEADER
	default y
	help
	  Enable this option to include the MCXE31x boot header in the final
	  image. The boot header is required for proper operation of the
	  on-chip bootloader.
	  See the MCXE31x reference manual for more details.

config CLEAR_DESTRUCTIVE_RESET_FLAG
	hex "Clear destructive reset flag"
	default 0x0
	help
	  Clear the destructive reset flag to ensure proper system initialization

config CLEAR_FUNCTIONAL_RESET_FLAG
	hex "Clear functional reset flag"
	default 0x0
	help
	  Clear the functional reset flag to ensure proper system initialization
```

## boards/nxp/frdm_mcxe31b/Kconfig.frdm_mcxe31b
```kconfig
# Copyright 2025 NXP
# SPDX-License-Identifier: Apache-2.0

config BOARD_FRDM_MCXE31B
	select SOC_PART_NUMBER_MCXE31BMPB
```

## boards/nxp/frdm_mcxe31b/frdm_mcxe31b_defconfig
```kconfig
# Copyright 2025-2026 NXP
# SPDX-License-Identifier: Apache-2.0

CONFIG_CONSOLE=y
CONFIG_UART_CONSOLE=y
CONFIG_SERIAL=y
CONFIG_GPIO=y
CONFIG_UART_INTERRUPT_DRIVEN=y
CONFIG_SOC_FLASH_MCUX_C40_APPLY_PROTECTION=y
```

## boards/nxp/frdm_mcxl255/Kconfig.frdm_mcxl255
```kconfig
# Copyright 2025 NXP
# SPDX-License-Identifier: Apache-2.0

config BOARD_FRDM_MCXL255
	select SOC_MCXL255_CPU0 if BOARD_FRDM_MCXL255_MCXL255_CPU0
	select SOC_MCXL255_CPU1 if BOARD_FRDM_MCXL255_MCXL255_CPU1
	select SOC_PART_NUMBER_MCXL255VDF
```
