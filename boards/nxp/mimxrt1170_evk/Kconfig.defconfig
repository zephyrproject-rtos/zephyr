## boards/nxp/mimxrt1170_evk/Kconfig.defconfig
```kconfig
# MIMXRT1170-EVK board

# Copyright 2021,2023 NXP
# SPDX-License-Identifier: Apache-2.0

if BOARD_MIMXRT1170_EVK

# Only use DCD when booting primary core (M7)
config DEVICE_CONFIGURATION_DATA
	default y if CPU_CORTEX_M7

config NXP_IMX_EXTERNAL_SDRAM
	default y if CPU_CORTEX_M7

if SECOND_CORE_MCUX && CPU_CORTEX_M4

config BUILD_OUTPUT_INFO_HEADER
	default y

DT_CHOSEN_IMAGE_M4 = nxp,m4-partition

# Adjust the offset of the output image if building for RT11xx SOC
config BUILD_OUTPUT_ADJUST_LMA
	default "($(dt_chosen_reg_addr_hex,$(DT_CHOSEN_IMAGE_M4)) + \
	$(dt_node_reg_addr_hex,/soc/spi@400cc000,1)) - \
	$(dt_node_reg_addr_hex,/soc/ocram@20200000)"

endif

if DISK_DRIVERS

config IMX_USDHC_DAT3_PWR_TOGGLE
	default y

endif # DISK_DRIVERS

if FLASH_MCUX_FLEXSPI_XIP && MEMC_MCUX_FLEXSPI

choice FLASH_MCUX_FLEXSPI_XIP_MEM_TARGET
	default FLASH_MCUX_FLEXSPI_XIP_MEM_ITCM if CPU_CORTEX_M7
	default FLASH_MCUX_FLEXSPI_XIP_MEM_SRAM if CPU_CORTEX_M4
endchoice

endif # FLASH_MCUX_FLEXSPI_XIP && MEMC_MCUX_FLEXSPI

if NETWORKING

config NET_L2_ETHERNET
	default y if CPU_CORTEX_M7 # No cache memory support is required for driver

config ETH_MCUX_PHY_RESET
	default y

endif # NETWORKING

endif
```

## boards/nxp/mimxrt1170_evk/Kconfig.mimxrt1170_evk
```kconfig
#
# Copyright 2024 NXP
#
# SPDX-License-Identifier: Apache-2.0

config BOARD_MIMXRT1170_EVK
	select SOC_PART_NUMBER_MIMXRT1176DVMAA
	select SOC_MIMXRT1176_CM7 if BOARD_MIMXRT1170_EVK_MIMXRT1176_CM7
	select SOC_MIMXRT1176_CM4 if BOARD_MIMXRT1170_EVK_MIMXRT1176_CM4
```

## boards/nxp/mimxrt1170_evk/Kconfig.sysbuild
```kconfig
# Copyright (c) 2024 Nordic Semiconductor ASA
# SPDX-License-Identifier: Apache-2.0

choice MCUBOOT_MODE
	default MCUBOOT_MODE_SWAP_WITHOUT_SCRATCH if BOARD_MIMXRT1170_EVK_MIMXRT1176_CM7
endchoice
```

## boards/nxp/mimxrt1170_evk/board.yml
```yaml
board:
  name: mimxrt1170_evk
  full_name: MIMXRT1170-EVK
  vendor: nxp
  socs:
    - name: mimxrt1176
  revision:
    format: "letter"
    default: "B"
    revisions:
      - name: "A"
      - name: "B"
```

## boards/nxp/mimxrt1170_evk/mimxrt1170_evk_mimxrt1176_cm4_defconfig
```kconfig
#
# Copyright 2021,2023,2025 NXP
#
# SPDX-License-Identifier: Apache-2.0
#

CONFIG_CONSOLE=y
CONFIG_UART_CONSOLE=y
CONFIG_SERIAL=y
CONFIG_GPIO=y
CONFIG_ARM_MPU=y
CONFIG_HW_STACK_PROTECTION=y
CONFIG_SECOND_CORE_MCUX=y
```

## boards/nxp/mimxrt1180_evk/Kconfig
```kconfig
# Copyright 2025 NXP
# SPDX-License-Identifier: Apache-2.0

config BOARD_MIMXRT1180_EVK
	select BOARD_EARLY_INIT_HOOK

# CM7 execution mode
config CM7_BOOT_FROM_FLASH
	bool "Run CM7 core from Flash (XIP)"
	depends on SECOND_CORE_MCUX && (SOC_MIMXRT1189_CM7 || SOC_MIMXRT1189_CM33)
	default n
	help
	  If enabled, the CM7 core will run directly from flash (XIP).
	  If disabled, the CM7 core will run from ITCM memory.

# Define the FlexSPI offset for CM7
config CM7_FLEXSPI_OFFSET
	hex "CM7 FlexSPI offset"
	depends on SECOND_CORE_MCUX && BOARD_MIMXRT1180_EVK_MIMXRT1189_CM33
	default 0x28000000
	help
	  This is the FlexSPI offset for CM7.
```

## boards/nxp/mimxrt1180_evk/Kconfig.mimxrt1180_evk
```kconfig
#
# Copyright 2024-2025 NXP
#
# SPDX-License-Identifier: Apache-2.0
#

config BOARD_MIMXRT1180_EVK
	select SOC_PART_NUMBER_MIMXRT1189CVM8C
	select SOC_MIMXRT1189_CM33 if BOARD_MIMXRT1180_EVK_MIMXRT1189_CM33
	select SOC_MIMXRT1189_CM7 if BOARD_MIMXRT1180_EVK_MIMXRT1189_CM7
```

## boards/nxp/mimxrt1180_evk/mimxrt1180_evk_mimxrt1189_cm7_defconfig
```kconfig
#
# Copyright 2024 NXP
#
# SPDX-License-Identifier: Apache-2.0
#

CONFIG_CONSOLE=y
CONFIG_UART_CONSOLE=y
CONFIG_SERIAL=y
CONFIG_GPIO=y
CONFIG_ARM_MPU=y
CONFIG_HW_STACK_PROTECTION=y
CONFIG_PINCTRL=y
CONFIG_NXP_IMXRT_BOOT_HEADER=n
```

## boards/nxp/mimxrt595_evk/Kconfig
```kconfig
# Copyright 2022, 2025 NXP
# Copyright (c) 2023 Google LLC.
# SPDX-License-Identifier: Apache-2.0

config BOARD_MIMXRT595_EVK
	select BOARD_EARLY_INIT_HOOK if BOARD_MIMXRT595_EVK_MIMXRT595S_CM33

DT_ADSP_RESET_MEM := $(dt_nodelabel_path,adsp_reset)
DT_ADSP_DATA_MEM := $(dt_nodelabel_path,adsp_data)
DT_ADSP_TEXT_MEM := $(dt_nodelabel_path,adsp_text)

if BOARD_MIMXRT595_EVK_MIMXRT595S_F1

config RT595_ADSP_STACK_SIZE
	hex "Boot time stack size"
	default 0x1000
	help
	  Stack space is reserved at the end of the RT595_ADSP_DATA_MEM
	  region, starting at RT595_ADSP_DATA_MEM_ADDR - RT595_ADSP_STACK_SIZE

config RT595_ADSP_RESET_MEM_ADDR
	hex
	default $(dt_node_reg_addr_hex,$(DT_ADSP_RESET_MEM))

config RT595_ADSP_RESET_MEM_SIZE
	hex
	default $(dt_node_reg_size_hex,$(DT_ADSP_RESET_MEM))

config RT595_ADSP_DATA_MEM_ADDR
	hex
	default $(dt_node_reg_addr_hex,$(DT_ADSP_DATA_MEM))

config RT595_ADSP_DATA_MEM_SIZE
	hex
	default $(dt_node_reg_size_hex,$(DT_ADSP_DATA_MEM))

config RT595_ADSP_TEXT_MEM_ADDR
	hex
	default $(dt_node_reg_addr_hex,$(DT_ADSP_TEXT_MEM))

config RT595_ADSP_TEXT_MEM_SIZE
	hex
	default $(dt_node_reg_size_hex,$(DT_ADSP_TEXT_MEM))

endif # BOARD_MIMXRT595_EVK_RT595_F1
```

## boards/nxp/mimxrt595_evk/Kconfig.mimxrt595_evk
```kconfig
#
# Copyright 2024 NXP
#
# SPDX-License-Identifier: Apache-2.0
#

config BOARD_MIMXRT595_EVK
	select SOC_PART_NUMBER_MIMXRT595SFFOC
	select SOC_MIMXRT595S_CM33 if BOARD_MIMXRT595_EVK_MIMXRT595S_CM33
	select SOC_MIMXRT595S_F1 if BOARD_MIMXRT595_EVK_MIMXRT595S_F1
```

## boards/nxp/mimxrt595_evk/mimxrt595_evk_mimxrt595s_f1_defconfig
```kconfig
CONFIG_GEN_ISR_TABLES=y
CONFIG_GEN_IRQ_VECTOR_TABLE=n
CONFIG_XTENSA_SMALL_VECTOR_TABLE_ENTRY=y
CONFIG_NXP_IMXRT_BOOT_HEADER=n
```

## boards/nxp/mimxrt685_aud_evk/Kconfig
```kconfig
# SPDX-FileCopyrightText: Copyright 2026 NXP
# SPDX-License-Identifier: Apache-2.0

config BOARD_MIMXRT685_AUD_EVK
	select BOARD_EARLY_INIT_HOOK
```

## boards/nxp/mimxrt685_aud_evk/Kconfig.defconfig
```kconfig
# MIMXRT685-AUD-EVK board

# SPDX-FileCopyrightText: Copyright 2026 NXP
# SPDX-License-Identifier: Apache-2.0

if BOARD_MIMXRT685_AUD_EVK_MIMXRT685S_CM33

config NXP_IMXRT_BOOT_HEADER
	default y if !BOOTLOADER_MCUBOOT

config XTAL_SYS_CLK_HZ
	default 24000000

config SYSOSC_SETTLING_US
	default 260

endif # BOARD_MIMXRT685_AUD_EVK_MIMXRT685S_CM33
```

## boards/nxp/mimxrt685_aud_evk/Kconfig.mimxrt685_aud_evk
```kconfig
# SPDX-FileCopyrightText: Copyright 2026 NXP
# SPDX-License-Identifier: Apache-2.0

config BOARD_MIMXRT685_AUD_EVK
	select SOC_PART_NUMBER_MIMXRT685SFVKB
	select SOC_MIMXRT685S_CM33 if BOARD_MIMXRT685_AUD_EVK_MIMXRT685S_CM33
```

## boards/nxp/mimxrt685_aud_evk/board.yml
```yaml
board:
  name: mimxrt685_aud_evk
  full_name: MIMXRT685-AUD-EVK
  vendor: nxp
  socs:
    - name: mimxrt685s
```

## boards/nxp/mimxrt685_evk/Kconfig
```kconfig
# Copyright 2025 NXP
# Copyright (c) 2022 Nordic Semiconductor ASA
# SPDX-License-Identifier: Apache-2.0

config BOARD_MIMXRT685_EVK
	select BOARD_EARLY_INIT_HOOK
```

## boards/nxp/mimxrt685_evk/Kconfig.defconfig
```kconfig
# MIMXRT685-EVK board

# Copyright 2020, 2024 NXP
# SPDX-License-Identifier: Apache-2.0

if BOARD_MIMXRT685_EVK_MIMXRT685S_CM33

config NXP_IMXRT_BOOT_HEADER
	default y if !BOOTLOADER_MCUBOOT

config XTAL_SYS_CLK_HZ
	default 24000000

config SYSOSC_SETTLING_US
	default 260

choice FLASH_MCUX_FLEXSPI_MX25UM51345G_OPI_MODE
	default FLASH_MCUX_FLEXSPI_MX25UM51345G_OPI_STR
endchoice

choice FLASH_MCUX_FLEXSPI_XIP_MEM_TARGET
	default FLASH_MCUX_FLEXSPI_XIP_MEM_SRAM
endchoice

config FXOS8700_DRDY_INT1
	default y
	depends on FXOS8700_TRIGGER

endif # BOARD_MIMXRT685_EVK_MIMXRT685S_CM33
```

## boards/nxp/mimxrt685_evk/Kconfig.mimxrt685_evk
```kconfig
# Copyright 2020, 2024 NXP
# SPDX-License-Identifier: Apache-2.0

config BOARD_MIMXRT685_EVK
	select SOC_PART_NUMBER_MIMXRT685SFVKB
	select SOC_MIMXRT685S_CM33 if BOARD_MIMXRT685_EVK_MIMXRT685S_CM33
```

## boards/nxp/mimxrt685_evk/board.yml
```yaml
board:
  name: mimxrt685_evk
  full_name: MIMXRT685-EVK
  vendor: nxp
  socs:
    - name: mimxrt685s
```

## boards/nxp/mimxrt700_evk/Kconfig
```kconfig
# Copyright 2025 NXP
# SPDX-License-Identifier: Apache-2.0

config BOARD_MIMXRT700_EVK
	select BOARD_EARLY_INIT_HOOK if \
		BOARD_MIMXRT700_EVK_MIMXRT798S_CM33_CPU0 || \
		BOARD_MIMXRT700_EVK_MIMXRT798S_CM33_CPU1
```

## boards/nxp/mimxrt700_evk/Kconfig.defconfig
```kconfig
# MIMXRT700-EVK board

# Copyright 2025 NXP
# SPDX-License-Identifier: Apache-2.0

if BOARD_MIMXRT700_EVK

if SECOND_CORE_MCUX && SOC_MIMXRT798S_CM33_CPU1

config BUILD_OUTPUT_INFO_HEADER
	default y

# RT700 CPU1 LMA offset calculation:
# CPU1 doesn't have access to flash partitions, so we use known values:
# - CPU0 will store CPU1 image at flash offset 0x720000 (slot1_partition)
# - Flash is memory-mapped at 0x28000000 (RT700 XSPI0 base)
# - CPU1 executes from 0x600000 (CPU1 alias space)
#
# LMA = flash_base + partition_offset = 0x28000000 + 0x720000 = 0x28720000
# Adjustment = LMA - VMA = 0x28720000 - 0x600000 = 0x28120000
config BUILD_OUTPUT_ADJUST_LMA
	default "0x28720000 - 0x00600000"

endif

endif
```

## boards/nxp/mimxrt700_evk/Kconfig.mimxrt700_evk
```kconfig
# Copyright 2024-2025 NXP
# SPDX-License-Identifier: Apache-2.0

config BOARD_MIMXRT700_EVK
	select SOC_MIMXRT798S_CM33_CPU0 if BOARD_MIMXRT700_EVK_MIMXRT798S_CM33_CPU0
	select SOC_MIMXRT798S_CM33_CPU1 if BOARD_MIMXRT700_EVK_MIMXRT798S_CM33_CPU1
	select SOC_MIMXRT798S_HIFI4 if BOARD_MIMXRT700_EVK_MIMXRT798S_HIFI4
	select SOC_MIMXRT798S_HIFI1 if BOARD_MIMXRT700_EVK_MIMXRT798S_HIFI1
	select SOC_PART_NUMBER_MIMXRT798SGFOA
```

## boards/nxp/mimxrt700_evk/board.yml
```yaml
board:
  name: mimxrt700_evk
  full_name: MIMXRT700-EVK
  vendor: nxp
  revision:
    format: custom
    default: "mx25um51345g"
    revisions:
    - name: "mx25um51345g"
    - name: "w25q512nw"
  socs:
  - name: mimxrt798s
```

## boards/nxp/mr_canhubk3/Kconfig.defconfig
```kconfig
# Copyright 2023-2024 NXP
# SPDX-License-Identifier: Apache-2.0

if BOARD_MR_CANHUBK3

if SERIAL

config UART_CONSOLE
	default y

endif # SERIAL

if SPI

config GPIO_INIT_PRIORITY
	default 10

config SPI_INIT_PRIORITY
	default 10

if WDT_NXP_FS26

config WDT_NXP_FS26_INIT_PRIORITY
	default 10

endif # WDT_NXP_FS26
endif # SPI

configdefault NET_L2_ETHERNET
	default y if !NET_LOOPBACK && !NET_TEST

endif # BOARD_MR_CANHUBK3
```

## boards/nxp/mr_canhubk3/Kconfig.mr_canhubk3
```kconfig
# Copyright 2023-2024 NXP
# SPDX-License-Identifier: Apache-2.0

config BOARD_MR_CANHUBK3
	select SOC_S32K344
	select SOC_PART_NUMBER_PS32K344EHVPBS
```
