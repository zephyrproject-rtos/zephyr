/*
 * SPDX-License-Identifier: Apache-2.0
 *
 * Copyright 2023 NXP
 */

/ {
	dma_test_edma0: dma-test-edma0 {
		compatible = "test-dma-memory-to-memory";
		dma = <&edma0>;
		channel-link;
	};
};

&edma0 {
	status = "okay";
};
