/*
 * Copyright 2024 NXP
 * SPDX-License-Identifier: Apache-2.0
 */

#include <nxp/kinetis/MKE16Z64VLF4-pinctrl.h>

&pinctrl {
	lpuart0_default: lpuart0_default {
		group0 {
			pinmux = <LPUART0_RX_PTB0>,
				 <LPUART0_TX_PTB1>;
			drive-strength = "low";
			slew-rate = "slow";
		};
	};
};
