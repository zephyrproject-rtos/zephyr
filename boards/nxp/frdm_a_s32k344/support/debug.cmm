;*******************************************************************************
;   Copyright 2023 NXP                                                         *
;   SPDX-License-Identifier: Apache-2.0                                        *
;                                                                              *
;   Lauterbach TRACE32 start-up script for debugging frdm_a_s32k344           *
;                                                                              *
;*******************************************************************************

ENTRY %LINE &args

DO ~~~~/startup.cmm command=debug &args

ENDDO
