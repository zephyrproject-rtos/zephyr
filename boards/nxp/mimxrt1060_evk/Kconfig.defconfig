## boards/nxp/mimxrt1060_evk/Kconfig.defconfig
```kconfig
# MIMXRT1060-EVK board

# Copyright 2018,2023 NXP
# SPDX-License-Identifier: Apache-2.0

if BOARD_MIMXRT1060_EVK

config DEVICE_CONFIGURATION_DATA
	default y

config NXP_IMX_EXTERNAL_SDRAM
	default y

configdefault NET_L2_ETHERNET
	default y

configdefault NXP_FW_DUMP_FLASH_START_ADDR
	default 0x60500000

configdefault BT_RX_STACK_SIZE
	default 2048 if BT_SETTINGS && !BT_MESH_GATT_CLIENT && !BT_MESH_PB_GATT && !BT_MESH

endif # BOARD_MIMXRT1060_EVK
```

## boards/nxp/mimxrt1180_evk/board.yml
```yaml
board:
  name: mimxrt1180_evk
  full_name: MIMXRT1180-EVK
  vendor: nxp
  socs:
    - name: mimxrt1189
  revision:
    format: custom
    default: hyperram
    revisions:
      - name: hyperram
        description: >
          Default hardware configuration with on-board HyperRAM installed.
      - name: sdram
        description: >
          SDRAM variant: HyperRAM removed, SEMC SDRAM (W9825G6KH x2, 64MB)
          installed.
```

## boards/nxp/mimxrt2660_evk/Kconfig.defconfig
```kconfig
#
# SPDX-FileCopyrightText: Copyright 2026 NXP
#
# SPDX-License-Identifier: Apache-2.0
#

if BOARD_MIMXRT2660_EVK

if NETWORKING

config ETH_DRIVER
	default y if DT_HAS_NXP_ENET_MAC_ENABLED

endif # NETWORKING

endif # BOARD_MIMXRT2660_EVK
```

## boards/nxp/mimxrt2660_evk/board.yml
```yaml
board:
  name: mimxrt2660_evk
  full_name: MIMXRT2660-EVK
  vendor: nxp
  socs:
    - name: mimxrt2663
```

## boards/nxp/mimxrt595_evk/board.yml
```yaml
board:
  name: mimxrt595_evk
  full_name: MIMXRT595-EVK
  vendor: nxp
  socs:
    - name: mimxrt595s
      variants:
        - name: sram
          cpucluster: cm33
```

## boards/nxp/mr_mcxn_t1/Kconfig
```kconfig
# SPDX-FileCopyrightText: 2025 NXP
# SPDX-FileCopyrightText: 2026 CogniPilot Foundation
# SPDX-License-Identifier: Apache-2.0

config BOARD_MR_MCXN_T1
	select BOARD_EARLY_INIT_HOOK
```

## boards/nxp/mr_mcxn_t1/Kconfig.defconfig
```kconfig
# SPDX-FileCopyrightText: 2025 NXP
# SPDX-FileCopyrightText: 2026 CogniPilot Foundation
# SPDX-License-Identifier: Apache-2.0

if BOARD_MR_MCXN_T1

configdefault ETH_DRIVER
	default y

endif
```

## boards/nxp/mr_mcxn_t1/Kconfig.mr_mcxn_t1
```kconfig
# SPDX-FileCopyrightText: 2024-2025 NXP
# SPDX-FileCopyrightText: 2026 CogniPilot Foundation
# SPDX-License-Identifier: Apache-2.0

config BOARD_MR_MCXN_T1
	select SOC_MCXN947_CPU0 if BOARD_MR_MCXN_T1_MCXN947_CPU0
	select SOC_MCXN947_CPU1 if BOARD_MR_MCXN_T1_MCXN947_CPU1
	select SOC_PART_NUMBER_MCXN947VDF
```

## boards/nxp/mr_mcxn_t1/board.yml
```yaml
board:
  name: mr_mcxn_t1
  full_name: MR-MCXN-T1
  vendor: nxp
  socs:
  - name: mcxn947
```

## boards/nxp/mr_mcxn_t1/mr_mcxn_t1_mcxn947_cpu0_defconfig
```kconfig
#
# SPDX-FileCopyrightText: 2025 NXP
# SPDX-FileCopyrightText: 2026 CogniPilot Foundation
#
# SPDX-License-Identifier: Apache-2.0
#

CONFIG_CONSOLE=y
CONFIG_UART_CONSOLE=y
CONFIG_SERIAL=y
CONFIG_UART_INTERRUPT_DRIVEN=y
CONFIG_GPIO=y

CONFIG_ARM_MPU=y
CONFIG_HW_STACK_PROTECTION=y
CONFIG_MAIN_STACK_SIZE=4096

# Enable TrustZone-M
CONFIG_TRUSTED_EXECUTION_SECURE=y
```

## boards/nxp/mr_mcxn_t1/mr_mcxn_t1_mcxn947_cpu1_defconfig
```kconfig
#
# SPDX-FileCopyrightText: 2025 NXP
# SPDX-FileCopyrightText: 2026 CogniPilot Foundation
#
# SPDX-License-Identifier: Apache-2.0
#

CONFIG_USE_DT_CODE_PARTITION=y
```

## boards/nxp/mr_vmu_tropic/Kconfig
```kconfig
# Copyright 2025 NXP
# Copyright (c) 2026 CogniPilot Foundation
# SPDX-License-Identifier: Apache-2.0

config BOARD_MR_VMU_TROPIC
	select BOARD_EARLY_INIT_HOOK
	select MCUX_XBARA
```

## boards/nxp/mr_vmu_tropic/Kconfig.defconfig
```kconfig
# NXP MR-VMU-TROPIC board

# Copyright 2018,2023 NXP
# Copyright (c) 2026 CogniPilot Foundation
# SPDX-License-Identifier: Apache-2.0

if BOARD_MR_VMU_TROPIC

configdefault ETH_DRIVER
	default y

endif # BOARD_MR_VMU_TROPIC
```

## boards/nxp/mr_vmu_tropic/Kconfig.mr_vmu_tropic
```kconfig
# Copyright (c) 2018, NXP
# Copyright (c) 2026 CogniPilot Foundation
# SPDX-License-Identifier: Apache-2.0

config BOARD_MR_VMU_TROPIC
	select SOC_PART_NUMBER_MIMXRT1064DVL6A
```

## boards/nxp/mr_vmu_tropic/board.yml
```yaml
board:
  name: mr_vmu_tropic
  full_name: MR-VMU-TROPIC
  vendor: nxp
  socs:
    - name: mimxrt1064
```

## boards/nxp/rd_rw612_bga/rd_rw612_bga_rw612_ns_defconfig
```kconfig
#
# Copyright 2024-2026 NXP
#
# SPDX-License-Identifier: Apache-2.0
#

CONFIG_CONSOLE=y
CONFIG_UART_CONSOLE=y
CONFIG_SERIAL=y
CONFIG_PINCTRL=y
CONFIG_UART_INTERRUPT_DRIVEN=y
CONFIG_GPIO=y
CONFIG_ARM_MPU=y
CONFIG_HW_STACK_PROTECTION=y
CONFIG_TRUSTED_EXECUTION_NONSECURE=y

CONFIG_TFM_BL2=y
CONFIG_BUILD_WITH_TFM=y

# Update the flash base address of ns image
CONFIG_FLASH_BASE_ADDRESS=0x08000000
CONFIG_FLASH_LOAD_OFFSET=0xC0000
```

## boards/nxp/s32k148_evb/Kconfig.defconfig
```kconfig
# Copyright 2023-2024 NXP
# SPDX-License-Identifier: Apache-2.0

if BOARD_S32K148_EVB

if SERIAL

config UART_CONSOLE
	default y

endif # SERIAL

configdefault ETH_DRIVER
	default y if !MODEM

endif # BOARD_S32K148_EVB
```

## boards/olimex/esp32p4_pc/Kconfig
```kconfig
# SPDX-FileCopyrightText: Copyright The Zephyr Project Contributors
# SPDX-License-Identifier: Apache-2.0

config HEAP_MEM_POOL_ADD_SIZE_BOARD
	int
	default 4096 if BOARD_ESP32P4_PC_ESP32P4_HPCORE
	default 256 if BOARD_ESP32P4_PC_ESP32P4_LPCORE
```
