## boards/nxp/frdm_kl25z/Kconfig.frdm_kl25z
```kconfig
# Copyright 2024 NXP
# SPDX-License-Identifier: Apache-2.0

config BOARD_FRDM_KL25Z
	select SOC_MKL25Z4
	select SOC_PART_NUMBER_MKL25Z128VLK4
```

## boards/nxp/frdm_kl25z/board.yml
```yaml
board:
  name: frdm_kl25z
  full_name: FRDM-KL25Z
  vendor: nxp
  socs:
    - name: mkl25z4
```

## boards/nxp/frdm_kl25z/frdm_kl25z_defconfig
```kconfig
# SPDX-License-Identifier: Apache-2.0

CONFIG_CONSOLE=y
CONFIG_UART_CONSOLE=y
CONFIG_SERIAL=y
CONFIG_GPIO=y
CONFIG_SYS_CLOCK_HW_CYCLES_PER_SEC=48000000
CONFIG_OSC_LOW_POWER=y
```

## boards/nxp/frdm_kw41z/Kconfig.defconfig
```kconfig
# FRDM-KW41Z board

# Copyright (c) 2017, NXP
# SPDX-License-Identifier: Apache-2.0

if BOARD_FRDM_KW41Z

config OSC_XTAL0_FREQ
	default 32000000

config MCG_FRDIV
	default 5

config MCG_FCRDIV
	default 0

config FXOS8700_DRDY_INT1
	default y
	depends on FXOS8700_TRIGGER

config WDT_DISABLE_AT_BOOT
	default y

choice ADC_MCUX_ADC16_VREF
	default ADC_MCUX_ADC16_VREF_ALTERNATE
endchoice

endif # BOARD_FRDM_KW41Z
```

## boards/nxp/frdm_kw41z/Kconfig.frdm_kw41z
```kconfig
# Copyright 2024 NXP
# SPDX-License-Identifier: Apache-2.0

config BOARD_FRDM_KW41Z
	select SOC_MKW41Z4
	select SOC_PART_NUMBER_MKW41Z512VHT4
```

## boards/nxp/frdm_kw41z/board.yml
```yaml
board:
  name: frdm_kw41z
  full_name: FRDM-KW41Z
  vendor: nxp
  socs:
    - name: mkw41z4
```

## boards/nxp/frdm_kw41z/frdm_kw41z_defconfig
```kconfig
# SPDX-License-Identifier: Apache-2.0

CONFIG_CONSOLE=y
CONFIG_UART_CONSOLE=y
CONFIG_SERIAL=y
CONFIG_GPIO=y
CONFIG_PINCTRL=y
CONFIG_SYS_CLOCK_HW_CYCLES_PER_SEC=40000000
CONFIG_OSC_EXTERNAL=y
```

## boards/nxp/frdm_mcxa153/Kconfig
```kconfig
# Copyright 2025 NXP
# SPDX-License-Identifier: Apache-2.0

config BOARD_FRDM_MCXA153
	select BOARD_EARLY_INIT_HOOK
```

## boards/nxp/frdm_mcxa153/Kconfig.defconfig
```kconfig
# FRDM-MCXA153 board

# Copyright 2025 NXP
# SPDX-License-Identifier: Apache-2.0

if BOARD_FRDM_MCXA153

config BOARD_EARLY_INIT_HOOK
	default y

endif # BOARD_FRDM_MCXA156
```

## boards/nxp/frdm_mcxa153/Kconfig.frdm_mcxa153
```kconfig
# Copyright 2025 NXP
# SPDX-License-Identifier: Apache-2.0

config BOARD_FRDM_MCXA153
	select SOC_MCXA153 if BOARD_FRDM_MCXA153
	select SOC_PART_NUMBER_MCXA153VLH
```

## boards/nxp/frdm_mcxa153/board.yml
```yaml
board:
  name: frdm_mcxa153
  full_name: FRDM-MCXA153
  vendor: nxp
  socs:
  - name: mcxa153
```

## boards/nxp/frdm_mcxa153/frdm_mcxa153_defconfig
```kconfig
#
# Copyright 2025 NXP
#
# SPDX-License-Identifier: Apache-2.0
#

CONFIG_CONSOLE=y
CONFIG_UART_CONSOLE=y
CONFIG_SERIAL=y
CONFIG_UART_INTERRUPT_DRIVEN=y
CONFIG_GPIO=y
```

## boards/nxp/frdm_mcxa156/Kconfig
```kconfig
# Copyright 2024-2025 NXP
# SPDX-License-Identifier: Apache-2.0

config BOARD_FRDM_MCXA156
	select BOARD_EARLY_INIT_HOOK
```

## boards/nxp/frdm_mcxa156/Kconfig.defconfig
```kconfig
# FRDM-MCXA156 board

# Copyright 2024 NXP
# SPDX-License-Identifier: Apache-2.0

if BOARD_FRDM_MCXA156

if BOOTLOADER_MCUBOOT
choice MCUBOOT_BOOTLOADER_MODE
	# Board only supports MCUBoot via "upgrade only" method:
	default MCUBOOT_BOOTLOADER_MODE_OVERWRITE_ONLY
endchoice
endif #BOOTLOADER_MCUBOOT

endif # BOARD_FRDM_MCXA156
```

## boards/nxp/frdm_mcxa156/Kconfig.frdm_mcxa156
```kconfig
# Copyright 2024 NXP
# SPDX-License-Identifier: Apache-2.0

config BOARD_FRDM_MCXA156
	select SOC_MCXA156 if BOARD_FRDM_MCXA156
	select SOC_PART_NUMBER_MCXA156VLL
```

## boards/nxp/frdm_mcxa156/board.yml
```yaml
board:
  name: frdm_mcxa156
  full_name: FRDM-MCXA156
  vendor: nxp
  socs:
  - name: mcxa156
```

## boards/nxp/frdm_mcxa156/frdm_mcxa156_defconfig
```kconfig
#
# Copyright 2024, 2026 NXP
#
# SPDX-License-Identifier: Apache-2.0
#

CONFIG_CONSOLE=y
CONFIG_UART_CONSOLE=y
CONFIG_SERIAL=y
CONFIG_UART_INTERRUPT_DRIVEN=y
CONFIG_GPIO=y
CONFIG_LPADC_DO_OFFSET_CALIBRATION=y
CONFIG_TEST_RANDOM_GENERATOR=y

# Allow wwdt callback
CONFIG_WDT_MCUX_WWDT_WARNING_INTERRUPT_CFG=512
```

## boards/nxp/frdm_mcxa166/Kconfig
```kconfig
# Copyright 2025 NXP
# SPDX-License-Identifier: Apache-2.0

config BOARD_EARLY_INIT_HOOK
	bool "Run early board hook"
	default y
	help
	  Run an early board initialization hook.
```

## boards/nxp/frdm_mcxa166/Kconfig.frdm_mcxa166
```kconfig
# Copyright 2025 NXP
# SPDX-License-Identifier: Apache-2.0

config BOARD_FRDM_MCXA166
	select SOC_MCXA166
	select SOC_PART_NUMBER_MCXA166VLQ
```

## boards/nxp/frdm_mcxa166/board.yml
```yaml
board:
  name: frdm_mcxa166
  full_name: FRDM-MCXA166
  vendor: nxp
  socs:
  - name: mcxa166
```

## boards/nxp/frdm_mcxa266/Kconfig
```kconfig
# Copyright 2025 NXP
# SPDX-License-Identifier: Apache-2.0

config BOARD_FRDM_MCXA266
	select BOARD_EARLY_INIT_HOOK
```

## boards/nxp/frdm_mcxa266/Kconfig.frdm_mcxa266
```kconfig
# Copyright 2025 NXP
# SPDX-License-Identifier: Apache-2.0

config BOARD_FRDM_MCXA266
	select SOC_MCXA266
	select SOC_PART_NUMBER_MCXA266VLQ
```

## boards/nxp/frdm_mcxa266/board.yml
```yaml
board:
  name: frdm_mcxa266
  full_name: FRDM-MCXA266
  vendor: nxp
  socs:
  - name: mcxa266
```

## boards/nxp/frdm_mcxa276/Kconfig.frdm_mcxa276
```kconfig
# Copyright 2025 NXP
# SPDX-License-Identifier: Apache-2.0

config BOARD_FRDM_MCXA276
	select SOC_MCXA276
	select SOC_PART_NUMBER_MCXA276VLQ
```

## boards/nxp/frdm_mcxa276/board.yml
```yaml
board:
  name: frdm_mcxa276
  full_name: FRDM-MCXA276
  vendor: nxp
  socs:
  - name: mcxa276
```
