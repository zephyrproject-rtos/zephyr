## boards/nxp/lpcxpresso54628/board.yml
```yaml
board:
  name: lpcxpresso54628
  full_name: LPCXpresso54628
  vendor: nxp
  socs:
    - name: lpc54628
```

## boards/nxp/lpcxpresso54628/lpcxpresso54628_defconfig
```kconfig
#
# Copyright 2026 NXP
#
# SPDX-License-Identifier: Apache-2.0
#

CONFIG_CONSOLE=y
CONFIG_UART_CONSOLE=y
CONFIG_SERIAL=y
CONFIG_UART_INTERRUPT_DRIVEN=y
CONFIG_GPIO=y
CONFIG_SYS_CLOCK_HW_CYCLES_PER_SEC=220000000
CONFIG_ARM_MPU=y
CONFIG_HW_STACK_PROTECTION=y
```

## boards/nxp/lpcxpresso54s018/Kconfig.board
```kconfig
config BOARD_LPCXPRESSO54S018
	bool "NXP LPCXpresso54S018M Development Board"
	depends on SOC_SERIES_LPC54XXX
	select SOC_LPC54S018
	select SOC_PART_NUMBER_LPC54S018J4MET180E
	help
	  LPCXpresso54S018M development board with LPC54S018J4MET180E SoC.
	  Single-core ARM Cortex-M4F with 4MB SPIFI flash and 360KB SRAM.

# Include secure boot configuration
# Note: For out-of-tree boards, secure options are included via board-specific prj.conf
# source "boards/arm/lpcxpresso54s018/Kconfig.secure"
```

## boards/nxp/lpcxpresso54s018/Kconfig.defconfig
```kconfig
if BOARD_LPCXPRESSO54S018

config BOARD
	default "lpcxpresso54s018"

# Select the LPC54S018 SOC  
config SOC_LPC54S018
	default y

endif # BOARD_LPCXPRESSO54S018
```

## boards/nxp/lpcxpresso54s018/board.yml
```yaml
board:
  name: lpcxpresso54s018
  full_name: LPCXpresso54S018
  vendor: nxp
  socs:
    - name: lpc54s018
```

## boards/nxp/lpcxpresso54s018/lpcxpresso54s018_defconfig
```kconfig
# LPCXpresso54S018M Board Configuration
# Copyright (c) 2024 VCI Development - LPC54S018J4MET180E single-core M4
# SPDX-License-Identifier: Apache-2.0

# Console and UART
CONFIG_CONSOLE=y
CONFIG_UART_CONSOLE=y
CONFIG_SERIAL=y
CONFIG_UART_INTERRUPT_DRIVEN=y

# GPIO support
CONFIG_GPIO=y

# Pinctrl support
CONFIG_PINCTRL=y
CONFIG_PINCTRL_NXP_IOCON=y

# Clock control
CONFIG_CLOCK_CONTROL=y

# Flash support - External SPIFI flash
CONFIG_FLASH=y
CONFIG_FLASH_LPC_SPIFI_NOR=y

# SoC Flash driver - Disable as we use external SPIFI
CONFIG_SOC_FLASH_LPC=n

# Enable XIP (Execute In Place) from SPIFI
CONFIG_XIP=y

# Memory configuration
CONFIG_FLASH_SIZE=4096
CONFIG_MAIN_STACK_SIZE=2048
CONFIG_IDLE_STACK_SIZE=512
CONFIG_ISR_STACK_SIZE=1024

# For debugging
CONFIG_THREAD_NAME=y
CONFIG_ASSERT=y
CONFIG_EARLY_CONSOLE=y

# ISR table generation
CONFIG_GEN_ISR_TABLES=y
CONFIG_GEN_SW_ISR_TABLE=y
CONFIG_GEN_IRQ_VECTOR_TABLE=y
CONFIG_DYNAMIC_INTERRUPTS=y

# PINT interrupt controller
CONFIG_NXP_PINT=y

# Memory controller support
CONFIG_MEMC=y
```

## boards/nxp/lpcxpresso55s06/Kconfig.defconfig
```kconfig
# LPCXpresso55S06 board

# Copyright (c) 2022 metraTec
# Copyright 2024 NXP
# SPDX-License-Identifier: Apache-2.0

if BOARD_LPCXPRESSO55S06

if BOOTLOADER_MCUBOOT
choice MCUBOOT_BOOTLOADER_MODE
	# Board only supports MCUBoot via "upgrade only" method:
	default MCUBOOT_BOOTLOADER_MODE_OVERWRITE_ONLY
endchoice
endif #BOOTLOADER_MCUBOOT

endif # BOARD_LPCXPRESSO55S06
```

## boards/nxp/lpcxpresso55s06/Kconfig.lpcxpresso55s06
```kconfig
# Copyright (c) 2022 metraTec
# Copyright 2024 NXP
#
# SPDX-License-Identifier: Apache-2.0

config BOARD_LPCXPRESSO55S06
	select SOC_LPC55S06
	select SOC_PART_NUMBER_LPC55S06JBD64
```

## boards/nxp/lpcxpresso55s06/board.yml
```yaml
board:
  name: lpcxpresso55s06
  full_name: LPCXpresso55S06
  vendor: nxp
  socs:
    - name: lpc55s06
```

## boards/nxp/lpcxpresso55s16/Kconfig.defconfig
```kconfig
# LPCXpresso55S16 board

# Copyright (c) 2020 Henrik Brix Andersen <henrik@brixandersen.dk>
# SPDX-License-Identifier: Apache-2.0

if BOARD_LPCXPRESSO55S16

config FXOS8700_DRDY_INT1
	default y
	depends on FXOS8700_TRIGGER

if BOOTLOADER_MCUBOOT
choice MCUBOOT_BOOTLOADER_MODE
	# Board only supports MCUBoot via "upgrade only" method:
	default MCUBOOT_BOOTLOADER_MODE_OVERWRITE_ONLY
endchoice
endif #BOOTLOADER_MCUBOOT

endif # BOARD_LPCXPRESSO55S16
```

## boards/nxp/lpcxpresso55s16/Kconfig.lpcxpresso55s16
```kconfig
# Copyright (c) 2020 Henrik Brix Andersen <henrik@brixandersen.dk>
# Copyright 2024 NXP
#
# SPDX-License-Identifier: Apache-2.0

config BOARD_LPCXPRESSO55S16
	select SOC_LPC55S16
	select SOC_PART_NUMBER_LPC55S16JBD100
```

## boards/nxp/lpcxpresso55s16/Kconfig.sysbuild
```kconfig
# Copyright (c) 2024 Nordic Semiconductor ASA
# SPDX-License-Identifier: Apache-2.0

choice MCUBOOT_MODE
	default MCUBOOT_MODE_OVERWRITE_ONLY
endchoice
```

## boards/nxp/lpcxpresso55s16/board.yml
```yaml
board:
  name: lpcxpresso55s16
  full_name: LPCXpresso55S16
  vendor: nxp
  socs:
    - name: lpc55s16
```

## boards/nxp/lpcxpresso55s16/lpcxpresso55s16_defconfig
```kconfig
#
# Copyright (c) 2020 Henrik Brix Andersen <henrik@brixandersen.dk>
#
# SPDX-License-Identifier: Apache-2.0
#

CONFIG_CONSOLE=y
CONFIG_UART_CONSOLE=y
CONFIG_SERIAL=y
CONFIG_UART_INTERRUPT_DRIVEN=y
CONFIG_GPIO=y
CONFIG_PINCTRL=y
CONFIG_ARM_MPU=y

CONFIG_RUNTIME_NMI=y
```

## boards/nxp/lpcxpresso55s28/Kconfig.lpcxpresso55s28
```kconfig
# Copyright (c) 2020 Lemonbeat GmbH
# Copyright 2024 NXP
#
# SPDX-License-Identifier: Apache-2.0

config BOARD_LPCXPRESSO55S28
	select SOC_LPC55S28
	select SOC_PART_NUMBER_LPC55S28JBD100
```

## boards/nxp/lpcxpresso55s28/board.yml
```yaml
board:
  name: lpcxpresso55s28
  full_name: LPCXpresso55S28
  vendor: nxp
  socs:
    - name: lpc55s28
```

## boards/nxp/lpcxpresso55s28/lpcxpresso55s28_defconfig
```kconfig
#
# Copyright (c) 2020 Lemonbeat GmbH
# Copyright 2024, 2026 NXP
#
# SPDX-License-Identifier: Apache-2.0
#

CONFIG_CONSOLE=y
CONFIG_UART_CONSOLE=y
CONFIG_SERIAL=y
CONFIG_UART_INTERRUPT_DRIVEN=y
CONFIG_GPIO=y
CONFIG_ARM_MPU=y
CONFIG_HW_STACK_PROTECTION=y

CONFIG_RUNTIME_NMI=y

CONFIG_BUILD_OUTPUT_HEX=y

# Allow wwdt callback
CONFIG_WDT_MCUX_WWDT_WARNING_INTERRUPT_CFG=512
```

## boards/nxp/lpcxpresso55s36/Kconfig.defconfig
```kconfig
# LPCXpresso55S36 board

# Copyright 2022 NXP
# SPDX-License-Identifier: Apache-2.0

if BOARD_LPCXPRESSO55S36

if BOOTLOADER_MCUBOOT
choice MCUBOOT_BOOTLOADER_MODE
	# Board only supports MCUBoot via "upgrade only" method:
	default MCUBOOT_BOOTLOADER_MODE_OVERWRITE_ONLY
endchoice
endif #BOOTLOADER_MCUBOOT

endif # BOARD_LPCXPRESSO55S36
```

## boards/nxp/lpcxpresso55s36/Kconfig.lpcxpresso55s36
```kconfig
# Copyright 2022, 2024 NXP
# SPDX-License-Identifier: Apache-2.0

config BOARD_LPCXPRESSO55S36
	select SOC_LPC55S36
	select SOC_PART_NUMBER_LPC55S36JBD100
```

## boards/nxp/lpcxpresso55s36/board.yml
```yaml
board:
  name: lpcxpresso55s36
  full_name: LPCXpresso55S36
  vendor: nxp
  socs:
    - name: lpc55s36
```

## boards/nxp/lpcxpresso55s36/lpcxpresso55s36_defconfig
```kconfig
#
# Copyright 2022, 2024 NXP
#
# SPDX-License-Identifier: Apache-2.0
#

CONFIG_CONSOLE=y
CONFIG_UART_CONSOLE=y
CONFIG_SERIAL=y
CONFIG_UART_INTERRUPT_DRIVEN=y
CONFIG_GPIO=y
CONFIG_ARM_MPU=y

CONFIG_RUNTIME_NMI=y
```

## boards/nxp/lpcxpresso55s69/Kconfig
```kconfig
# Copyright 2024-2025 NXP
# SPDX-License-Identifier: Apache-2.0

config BOARD_LPCXPRESSO55S69
	select BOARD_EARLY_INIT_HOOK
```

## boards/nxp/lpcxpresso55s69/Kconfig.defconfig
```kconfig
# Copyright 2019,2024 NXP
# SPDX-License-Identifier: Apache-2.0

if BOARD_LPCXPRESSO55S69

if FXOS8700

choice FXOS8700_MODE
	default FXOS8700_MODE_ACCEL
endchoice

config FXOS8700_DRDY_INT1
	default y
	depends on FXOS8700_TRIGGER

endif # FXOS8700

# For the secure version of the board the firmware is linked at the beginning
# of the flash, or into the code-partition defined in DT if it is intended to
# be loaded by MCUboot. If the secure firmware is to be combined with a non-
# secure image (TRUSTED_EXECUTION_SECURE=y), the secure FW image shall always
# be restricted to the size of its code partition.
# For the non-secure version of the board, the firmware
# must be linked into the code-partition (non-secure) defined in DT, regardless.
# Apply this configuration below by setting the Kconfig symbols used by
# the linker according to the information extracted from DT partitions.

# Workaround for not being able to have commas in macro arguments
DT_CHOSEN_Z_CODE_PARTITION := zephyr,code-partition

config FLASH_LOAD_SIZE
	default $(dt_chosen_reg_size_hex,$(DT_CHOSEN_Z_CODE_PARTITION))
	depends on BOARD_LPCXPRESSO55S69_LPC55S69_CPU0 && TRUSTED_EXECUTION_SECURE

if TRUSTED_EXECUTION_NONSECURE || BOARD_LPCXPRESSO55S69_LPC55S69_CPU1

config FLASH_LOAD_OFFSET
	default 0x50000 if (!TFM_BL2 && BUILD_WITH_TFM)
	default $(dt_chosen_reg_addr_hex,$(DT_CHOSEN_Z_CODE_PARTITION))

config FLASH_LOAD_SIZE
	default 0x40000 if (!TFM_BL2 && BUILD_WITH_TFM)
	default $(dt_chosen_reg_size_hex,$(DT_CHOSEN_Z_CODE_PARTITION))

endif # TRUSTED_EXECUTION_NONSECURE || BOARD_LPCXPRESSO55S69_LPC55S69_CPU1

choice TFM_PROFILE_TYPE
	depends on BUILD_WITH_TFM
	default TFM_PROFILE_TYPE_MEDIUM
endchoice

if BOOTLOADER_MCUBOOT
choice MCUBOOT_BOOTLOADER_MODE
	# Board only supports MCUBoot via "upgrade only" method:
	default MCUBOOT_BOOTLOADER_MODE_OVERWRITE_ONLY
endchoice
endif #BOOTLOADER_MCUBOOT

endif # BOARD_LPCXPRESSO55S69
```

## boards/nxp/lpcxpresso55s69/Kconfig.lpcxpresso55s69
```kconfig
# Copyright 2024 NXP
# SPDX-License-Identifier: Apache-2.0

config BOARD_LPCXPRESSO55S69
	select SOC_LPC55S69_CPU0 if BOARD_LPCXPRESSO55S69_LPC55S69_CPU0 ||	\
								BOARD_LPCXPRESSO55S69_LPC55S69_CPU0_NS
	select SOC_LPC55S69_CPU1 if BOARD_LPCXPRESSO55S69_LPC55S69_CPU1
	select SOC_PART_NUMBER_LPC55S69JBD100
```

## boards/nxp/lpcxpresso55s69/board.yml
```yaml
board:
  name: lpcxpresso55s69
  full_name: LPCXPRESSO55S69
  vendor: nxp
  socs:
  - name: lpc55s69
    variants:
    - name: "ns"
      cpucluster: 'cpu0'
```
