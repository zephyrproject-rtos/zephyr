/*
 * Copyright (c) 2023-2024 NXP
 *
 * SPDX-License-Identifier: Apache-2.0
 */

/dts-v1/;

#include <nxp/nxp_imx8ulp.dtsi>
#include "imx8ulp_evk_mimx8ud7_adsp-pinctrl.dtsi"

/ {
	compatible = "nxp";
	model = "NXP i.MX 8ULP Audio DSP";

	chosen {
		zephyr,sram = &sram0;
		zephyr,console = &lpuart7;
		zephyr,shell-uart = &lpuart7;
	};
};

&lpuart7 {
	current-speed = <115200>;
	pinctrl-0 = <&lpuart7_default>;
	pinctrl-names = "default";
	status = "okay";
};

&sai5 {
	rx-dataline = <3>;
};
