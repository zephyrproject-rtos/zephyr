/*
 * NOTE: Autogenerated file by gen_board_pinctrl.py
 *       for MKW24D512VHA5/signal_configuration.xml
 *
 * Copyright (c) 2022, NXP
 * SPDX-License-Identifier: Apache-2.0
 */

#include <nxp/kinetis/MKW24D512VHA5-pinctrl.h>

&pinctrl {
	uart0_default: uart0_default {
		group0 {
			pinmux = <UART0_RX_PTA1>,
				 <UART0_TX_PTA2>;
			drive-strength = "high";
			bias-pull-up;
			slew-rate = "fast";
		};
	};
};
