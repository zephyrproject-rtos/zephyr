## boards/nxp/vmu_rt1170/vmu_rt1170_mimxrt1176_cm7_defconfig
```kconfig
#
# Copyright (c) 2021, NXP
#
# SPDX-License-Identifier: Apache-2.0
#

CONFIG_CONSOLE=y
CONFIG_SHELL=y
CONFIG_UART_CONSOLE=y
CONFIG_SERIAL=y
CONFIG_GPIO=y
CONFIG_ARM_MPU=y
CONFIG_HW_STACK_PROTECTION=y
CONFIG_FLEXSPI_CONFIG_BLOCK_OFFSET=0x400
CONFIG_PINCTRL=y

# Enable Regulators
CONFIG_REGULATOR=y
CONFIG_REGULATOR_FIXED_INIT_PRIORITY=75

CONFIG_TICKLESS_KERNEL=n
```

## boards/oct/osd32mp1_brk/Kconfig.defconfig
```kconfig
# Copyright (c) 2024 Antmicro <www.antmicro.com>
# SPDX-License-Identifier: Apache-2.0

if BOARD_OSD32MP1_BRK

config SPI_STM32_INTERRUPT
	default y
	depends on SPI

endif # BOARD_OSD32MP1_BRK
```

## boards/oct/osd32mp1_brk/Kconfig.osd32mp1_brk
```kconfig
# Copyright (c) 2024 Antmicro <www.antmicro.com>
# SPDX-License-Identifier: Apache-2.0

config BOARD_OSD32MP1_BRK
	select SOC_OSD32MP15X
```

## boards/oct/osd32mp1_brk/board.yml
```yaml
board:
  name: osd32mp1_brk
  full_name: OSD32MP1-BRK
  vendor: oct
  socs:
    - name: osd32mp15x
```

## boards/oct/osd32mp1_brk/osd32mp1_brk_defconfig
```kconfig
# Enable GPIO
CONFIG_GPIO=y

# Enable MPU
CONFIG_ARM_MPU=y

# Enable HW stack protection
CONFIG_HW_STACK_PROTECTION=y

# Enable UART driver
CONFIG_SERIAL=y
CONFIG_UART_INTERRUPT_DRIVEN=y

# Console (remote proc console by default)
CONFIG_CONSOLE=y
CONFIG_RAM_CONSOLE=y
CONFIG_RAM_CONSOLE_BUFFER_SIZE=1024

# UART console (overrides remote proc console)
CONFIG_UART_CONSOLE=n
```

## boards/olimex/lora_stm32wl_devkit/board.yml
```yaml
board:
  name: olimex_lora_stm32wl_devkit
  full_name: LoRa STM32WL DevKit
  vendor: olimex
  revision:
    format: letter
    default: "C"
    revisions:
      - name: "C"
      - name: "D"
  socs:
    - name: stm32wle5xx
```

## boards/olimex/olimex_esp32_evb/Kconfig
```kconfig
# Copyright (c) 2022 Henrik Brix Andersen <henrik@brixandersen.dk>
# SPDX-License-Identifier: Apache-2.0

config HEAP_MEM_POOL_ADD_SIZE_BOARD
	int
	default 4096 if BOARD_OLIMEX_ESP32_EVB_ESP32_PROCPU
	default 256 if BOARD_OLIMEX_ESP32_EVB_ESP32_APPCPU
```

## boards/olimex/olimex_esp32_evb/Kconfig.defconfig
```kconfig
# Olimex ESP32-EVB board configuration

# Copyright (c) 2022 Henrik Brix Andersen <henrik@brixandersen.dk>
# SPDX-License-Identifier: Apache-2.0

if BOARD_OLIMEX_ESP32_EVB_ESP32_PROCPU

config HEAP_MEM_POOL_ADD_SIZE_BOARD
	int
	default 8192

endif # BOARD_OLIMEX_ESP32_EVB_ESP32_PROCPU

if BOARD_OLIMEX_ESP32_EVB_ESP32_APPCPU

config HEAP_MEM_POOL_ADD_SIZE_BOARD
	default 256

endif # BOARD_OLIMEX_ESP32_EVB_ESP32_APPCPU
```

## boards/olimex/olimex_esp32_evb/Kconfig.olimex_esp32_evb
```kconfig
# Olimex ESP32-EVB board configuration

# Copyright (c) 2022 Henrik Brix Andersen <henrik@brixandersen.dk>
# SPDX-License-Identifier: Apache-2.0

config BOARD_OLIMEX_ESP32_EVB
	select SOC_ESP32_WROVER_E_N8R2
	select SOC_ESP32_PROCPU if BOARD_OLIMEX_ESP32_EVB_ESP32_PROCPU
	select SOC_ESP32_APPCPU if BOARD_OLIMEX_ESP32_EVB_ESP32_APPCPU
```

## boards/olimex/olimex_esp32_evb/board.yml
```yaml
board:
  name: olimex_esp32_evb
  full_name: ESP32-EVB
  vendor: olimex
  socs:
  - name: esp32
```

## boards/olimex/olimex_esp32_evb/olimex_esp32_evb_esp32_appcpu_defconfig
```kconfig
# SPDX-License-Identifier: Apache-2.0

CONFIG_CLOCK_CONTROL=y
CONFIG_MINIMAL_LIBC=y
CONFIG_CONSOLE=n
CONFIG_SERIAL=n
CONFIG_UART_CONSOLE=n
CONFIG_GPIO=n
```

## boards/olimex/olimex_stm32_p405/board.yml
```yaml
board:
  name: olimex_stm32_p405
  vendor: olimex
  socs:
    - name: stm32f405xx
```

## boards/olimex/olimexino_stm32/Kconfig.defconfig
```kconfig
# OLIMEXINO-STM32 board configuration

# Copyright (c) 2016, I-SENSE group of ICCS
# SPDX-License-Identifier: Apache-2.0

if BOARD_OLIMEXINO_STM32

config SPI_STM32_INTERRUPT
	default y
	depends on SPI

endif # BOARD_OLIMEXINO_STM32
```

## boards/olimex/olimexino_stm32/Kconfig.olimexino_stm32
```kconfig
# Copyright (c) 2016, I-SENSE group of ICCS
# SPDX-License-Identifier: Apache-2.0

config BOARD_OLIMEXINO_STM32
	select SOC_STM32F103XB
```

## boards/olimex/olimexino_stm32/board.yml
```yaml
board:
  name: olimexino_stm32
  full_name: OLIMEXINO-STM32
  vendor: olimex
  socs:
    - name: stm32f103xb
```

## boards/olimex/stm32_e407/Kconfig.olimex_stm32_e407
```kconfig
# Copyright (c) 2017, Erwin Rol <erwin@erwinrol.com>
# SPDX-License-Identifier: Apache-2.0

config BOARD_OLIMEX_STM32_E407
	select SOC_STM32F407XG
```

## boards/olimex/stm32_e407/board.yml
```yaml
board:
  name: olimex_stm32_e407
  full_name: OLIMEX-STM32-E407
  vendor: olimex
  socs:
    - name: stm32f407xx
```

## boards/olimex/stm32_h103/Kconfig.olimex_stm32_h103
```kconfig
# Copyright (c) 2020, Josep Puigdemont
# SPDX-License-Identifier: Apache-2.0

config BOARD_OLIMEX_STM32_H103
	select SOC_STM32F103XB
```

## boards/olimex/stm32_h103/board.yml
```yaml
board:
  name: olimex_stm32_h103
  full_name: OLIMEX-STM32-H103
  vendor: olimex
  socs:
    - name: stm32f103xb
```

## boards/olimex/stm32_h405/Kconfig.olimex_stm32_h405
```kconfig
# Copyright (c) 2020, 2021 Antony Pavlov <antonynpavlov@gmail.com>
# SPDX-License-Identifier: Apache-2.0

config BOARD_OLIMEX_STM32_H405
	select SOC_STM32F405XX
```

## boards/olimex/stm32_h405/board.yml
```yaml
board:
  name: olimex_stm32_h405
  full_name: OLIMEX-STM32-H405
  vendor: olimex
  socs:
    - name: stm32f405xx
```

## boards/olimex/stm32_h407/Kconfig.olimex_stm32_h407
```kconfig
# Copyright (c) 2018, Reto Schneider <code@reto-schneider.ch>
# SPDX-License-Identifier: Apache-2.0

config BOARD_OLIMEX_STM32_H407
	select SOC_STM32F407XG
```

## boards/olimex/stm32_h407/board.yml
```yaml
board:
  name: olimex_stm32_h407
  full_name: OLIMEX-STM32-H407
  vendor: olimex
  socs:
    - name: stm32f407xx
```

## boards/olimex/stm32_p405/Kconfig.olimex_stm32_p405
```kconfig
# Copyright (c) 2017, Erwin Rol <erwin@erwinrol.com>
# SPDX-License-Identifier: Apache-2.0

config BOARD_OLIMEX_STM32_P405
	select SOC_STM32F405XX
```

## boards/olimex/stm32_p405/board.yml
```yaml
board:
  name: olimex_stm32_p405
  full_name: OLIMEX-STM32-P405
  vendor: olimex
  socs:
    - name: stm32f405xx
```
