/*
 * SPDX-License-Identifier: Apache-2.0
 *
 * Copyright 2023-2024 NXP
 */

/ {
	dma_test_dma0: dma-test-dma0 {
		compatible = "test-dma-memory-to-memory";
		dma = <&dma0>;
		channel-link;
		scatter-gather;
	};
};

&dma0 {
	status = "okay";
};
