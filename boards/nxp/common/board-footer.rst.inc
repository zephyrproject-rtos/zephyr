Support Resources for Zephyr
============================
- `NXP Board Support Status`_
- `NXP Zephyr Downstream Software Development Kit`_
- `MCUXpresso for VS Code documentation`_, and `Zephyr lab guides`_
- `NXP Zephyr Knowledge Hub`_
- `NXP’s Zephyr landing page`_  (including training resources)
- `NXP Support Community forum for Zephyr`_

.. _NXP Board Support Status:
   https://github.com/nxp-zephyr/nxp-zsdk/blob/main/doc/releases/Board-Support-Status.md

.. _NXP Zephyr Downstream Software Development Kit:
   https://github.com/nxp-zephyr/nxp-zsdk

.. _MCUXpresso for VS Code:
   https://www.nxp.com/design/design-center/software/embedded-software/mcuxpresso-for-visual-studio-code:MCUXPRESSO-VSC?tid=vanMCUXPRESSO-VSC

.. _MCUXpresso for VS Code documentation:
   https://mcuxpresso.nxp.com/mcux-vscode

.. _Zephyr lab guides:
   https://mcuxpresso.nxp.com/mcux-vscode/latest/html/Training-Zephyr-Getting-Started.html

.. _NXP Zephyr Knowledge Hub:
   https://community.nxp.com/t5/Zephyr-Project-Knowledge-Base/Zephyr-Knowledge-Hub/ta-p/2008548

.. _NXP’s Zephyr landing page:
   https://nxp.com/zephyr

.. _NXP Support Community forum for Zephyr:
   https://community.nxp.com/t5/Zephyr-Project/bd-p/Zephyr-Project
