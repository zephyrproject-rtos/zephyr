/*
 * SPDX-FileCopyrightText: Copyright 2025-2026 NXP
 *
 * SPDX-License-Identifier: Apache-2.0
 */

/dts-v1/;

#include <nxp/mcx/mcxa/nxp_mcxa287.dtsi>
#include "frdm_mcxa287.dtsi"

/ {
	model = "NXP FRDM_MCXA287 board";
	compatible = "nxp,mcxa287", "nxp,mcx";

	chosen {
		zephyr,sram = &sram0;
		zephyr,flash = &flash;
		zephyr,flash-controller = &fmu;
		zephyr,code-partition = &slot0_partition;
		zephyr,console = &lpuart1;
		zephyr,shell-uart = &lpuart1;
		zephyr,edac = &erm0;
		zephyr,crc = &crc;
		zephyr,canbus = &flexcan0;
		zephyr,system-timer-companion = &lptmr0;
	};
};

&dac0 {
	status = "okay";
	pinctrl-0 = <&pinmux_dac0>;
	pinctrl-names = "default";
};
