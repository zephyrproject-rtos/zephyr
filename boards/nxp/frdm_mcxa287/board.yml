## boards/nxp/frdm_mcxa287/board.yml
```yaml
# SPDX-FileCopyrightText: Copyright 2026 NXP
# SPDX-License-Identifier: Apache-2.0

board:
  name: frdm_mcxa287
  full_name: FRDM-MCXA287
  vendor: nxp
  socs:
  - name: mcxa287
    variants:
    - name: ns
```

## boards/nxp/frdm_mcxa577/Kconfig.defconfig
```kconfig
# Copyright 2026 NXP
# SPDX-License-Identifier: Apache-2.0

if BOARD_FRDM_MCXA577

configdefault ETH_DRIVER
	default y if DT_HAS_NXP_ENET_QOS_ENABLED

endif
```

## boards/nxp/frdm_mcxc242/Kconfig.defconfig
```kconfig
#
# Copyright 2025 NXP
#
# SPDX-License-Identifier: Apache-2.0
#

if BOARD_FRDM_MCXC242

config WDT_DISABLE_AT_BOOT
	default y

endif #BOARD_FRDM_MCXC242
```

## boards/nxp/frdm_mcxe247/Kconfig.defconfig
```kconfig
# Copyright 2026 NXP
# SPDX-License-Identifier: Apache-2.0

if BOARD_FRDM_MCXE247

configdefault ETH_DRIVER
	default y if NETWORKING

endif # BOARD_FRDM_MCXE247
```

## boards/nxp/frdm_mcxe247/board.yml
```yaml
board:
  name: frdm_mcxe247
  full_name: FRDM-MCXE247
  vendor: nxp
  revision:
    format: custom
    default: "default"
    revisions:
      - name: "default"
      - name: "w25q64"
  socs:
    - name: mcxe247
```

## boards/nxp/frdm_mcxe31b/Kconfig.defconfig
```kconfig
# SPDX-FileCopyrightText: Copyright The Zephyr Project Contributors
# SPDX-License-Identifier: Apache-2.0

if BOARD_FRDM_MCXE31B

configdefault ETH_DRIVER
	default y

endif # BOARD_FRDM_MCXE31B
```

## boards/nxp/frdm_mcxe31b/board.yml
```yaml
board:
  name: frdm_mcxe31b
  full_name: FRDM-MCXE31B
  vendor: nxp
  revision:
    format: custom
    default: "default"
    revisions:
      - name: "default"
      - name: "w25q64"
  socs:
    - name: mcxe31b
```

## boards/nxp/frdm_mcxe32b/Kconfig
```kconfig
# Copyright 2026 NXP
# SPDX-License-Identifier: Apache-2.0

config BOARD_FRDM_MCXE32B
	select BOARD_EARLY_INIT_HOOK

config BOARD_NXP_MCXE32X_BOOT_HEADER
	bool "MCXE32x boot header support"
	select SOC_NXP_MCXE32X_BOOT_HEADER
	default y if BOARD_FRDM_MCXE32B_MCXE32B_CPU0
	help
	  Enable this option to include the MCXE32x boot header in the final
	  image. The boot header is required for proper operation of the
	  on-chip bootloader.
	  See the MCXE32x reference manual for more details.

config CLEAR_DESTRUCTIVE_RESET_FLAG
	hex "Clear destructive reset flag"
	default 0x0
	help
	  Clear the destructive reset flag to ensure proper system initialization

config CLEAR_FUNCTIONAL_RESET_FLAG
	hex "Clear functional reset flag"
	default 0x0
	help
	  Clear the functional reset flag to ensure proper system initialization
```

## boards/nxp/frdm_mcxe32b/Kconfig.frdm_mcxe32b
```kconfig
# Copyright 2026 NXP
# SPDX-License-Identifier: Apache-2.0

config BOARD_FRDM_MCXE32B
	select SOC_MCXE32B_CPU0 if BOARD_FRDM_MCXE32B_MCXE32B_CPU0
	select SOC_MCXE32B_CPU1 if BOARD_FRDM_MCXE32B_MCXE32B_CPU1
	select SOC_PART_NUMBER_MCXE32BMPB
```

## boards/nxp/frdm_mcxe32b/board.yml
```yaml
board:
  name: frdm_mcxe32b
  full_name: FRDM-MCXE32B
  vendor: nxp
  socs:
  - name: mcxe32b
```

## boards/nxp/imx8qm_mek/Kconfig.defconfig
```kconfig
#
# Copyright The Zephyr Project Contributors
#
# SPDX-License-Identifier: Apache-2.0
#

configdefault MAIN_STACK_SIZE
	default 3072 if BOARD_IMX8QM_MEK_MIMX8QM6_ADSP
```

## boards/nxp/imx8qxp_mek/Kconfig.defconfig
```kconfig
#
# Copyright The Zephyr Project Contributors
#
# SPDX-License-Identifier: Apache-2.0
#

configdefault MAIN_STACK_SIZE
	default 3072 if BOARD_IMX8QXP_MEK_MIMX8QX6_ADSP
```

## boards/nxp/imx95_evk_15x15/Kconfig.defconfig
```kconfig
# Copyright 2024-2025 NXP
# SPDX-License-Identifier: Apache-2.0

if SOC_MIMX9596_A55

# Keep GIC, mailbox, and SCMI at the same priority. Devicetree dependencies
# determine the order of mailbox and SCMI initialization.
configdefault INTC_INIT_PRIORITY
	default 31

configdefault MBOX_INIT_PRIORITY
	default 31

configdefault ARM_SCMI_SHMEM_INIT_PRIORITY
	default 31

configdefault ARM_SCMI_TRANSPORT_INIT_PRIORITY
	default 31

configdefault CLOCK_CONTROL_INIT_PRIORITY
	default 31

if NETWORKING

configdefault GIC_V3_ITS
	default y

configdefault ETH_DRIVER
	default y

# Enlarge default networking stack
configdefault NET_TX_STACK_SIZE
	default 2048

configdefault NET_RX_STACK_SIZE
	default 2048

configdefault NET_TCP_WORKQ_STACK_SIZE
	default 2048

configdefault NET_MGMT_EVENT_STACK_SIZE
	default 2048

configdefault NET_SOCKETS_SERVICE_STACK_SIZE
	default 2048

endif # NETWORKING

endif # SOC_MIMX9596_A55
```

## boards/nxp/lpc845brk/Kconfig.lpc845brk
```kconfig
# Copyright (c) 2026 Aerlync Labs Inc.
# SPDX-License-Identifier: Apache-2.0

config BOARD_LPC845BRK
	select SOC_LPC845
	select SOC_PART_NUMBER_LPC845M301JBD48
```

## boards/nxp/lpcxpresso11u68/lpcxpresso11u68_defconfig
```kconfig
CONFIG_UART_INTERRUPT_DRIVEN=y
CONFIG_GPIO=y
CONFIG_BUILD_OUTPUT_HEX=y
CONFIG_CONSOLE=y
CONFIG_UART_CONSOLE=y
CONFIG_SERIAL=y
CONFIG_CLOCK_CONTROL_LPC11U6X_ENABLE_SRAM1=y
CONFIG_CLOCK_CONTROL_LPC11U6X_ENABLE_USB_RAM=y
CONFIG_CLOCK_CONTROL_LPC11U6X_PLL_SRC_SYSOSC=y
```

## boards/nxp/mimxrt1020_evk/Kconfig.defconfig
```kconfig
# MIMXRT1020-EVK board

# Copyright 2018,2023 NXP
# SPDX-License-Identifier: Apache-2.0

if BOARD_MIMXRT1020_EVK

config DEVICE_CONFIGURATION_DATA
	default y

config NXP_IMX_EXTERNAL_SDRAM
	default y

configdefault ETH_DRIVER
	default y

endif # BOARD_MIMXRT1020_EVK
```

## boards/nxp/mimxrt1050_evk/Kconfig.defconfig
```kconfig
# MIMXRT1050-EVK board

# Copyright (c) 2017, NXP
# SPDX-License-Identifier: Apache-2.0

if BOARD_MIMXRT1050_EVK

config DEVICE_CONFIGURATION_DATA
	default y

config NXP_IMX_EXTERNAL_SDRAM
	default y

configdefault ETH_DRIVER
	default y

endif # BOARD_MIMXRT1050_EVK
```
