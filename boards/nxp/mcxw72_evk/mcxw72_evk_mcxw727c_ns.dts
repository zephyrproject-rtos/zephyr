/*
 * Copyright 2026 NXP
 * SPDX-License-Identifier: Apache-2.0
 */

/dts-v1/;

#include <nxp/mcx/mcxw/nxp_mcxw727c_ns.dtsi>
#include "mcxw72_evk_common.dtsi"

/ {
	model = "NXP MCXW72-EVK board";

	chosen {
		zephyr,flash = &flash;
		zephyr,flash-controller = &fmu;
		zephyr,code-partition = &code_partition;
		zephyr,sram = &stcm0;
		zephyr,console = &lpuart1;
		zephyr,shell-uart = &lpuart1;
		zephyr,uart-pipe = &lpuart0;
		zephyr,canbus = &flexcan0;
		zephyr,bt-c2h-uart = &lpuart0;
		zephyr,crc = &crc;
	};
};
