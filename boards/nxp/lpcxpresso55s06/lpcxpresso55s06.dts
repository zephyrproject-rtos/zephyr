/*
 * Copyright (c) 2022 metraTec
 *
 * SPDX-License-Identifier: Apache-2.0
 */

/dts-v1/;

#include <nxp/nxp_lpc55S06_ns.dtsi>
#include "lpcxpresso55s06_common.dtsi"

/ {
	compatible = "nxp,lpc55xxx", "nxp,lpc";
	model = "NXP LPCXpresso55S06 board";
};
