## boards/nxp/frdm_imxrt1186/board.yml
```yaml
board:
  name: frdm_imxrt1186
  full_name: FRDM-iMXRT1186
  vendor: nxp
  socs:
    - name: mimxrt1186
      variants:
        - name: extmem
          cpucluster: cm7
```

## boards/nxp/frdm_imxrt700/Kconfig
```kconfig
# Copyright 2026 NXP
# SPDX-License-Identifier: Apache-2.0

config BOARD_FRDM_IMXRT700
	select BOARD_EARLY_INIT_HOOK if \
		BOARD_FRDM_IMXRT700_MIMXRT798S_CM33_CPU0 || \
		BOARD_FRDM_IMXRT700_MIMXRT798S_CM33_CPU1
```

## boards/nxp/frdm_imxrt700/Kconfig.frdm_imxrt700
```kconfig
# Copyright 2026 NXP
# SPDX-License-Identifier: Apache-2.0

config BOARD_FRDM_IMXRT700
	select SOC_MIMXRT798S_CM33_CPU0 if BOARD_FRDM_IMXRT700_MIMXRT798S_CM33_CPU0
	select SOC_MIMXRT798S_CM33_CPU1 if BOARD_FRDM_IMXRT700_MIMXRT798S_CM33_CPU1
	select SOC_PART_NUMBER_MIMXRT798SGFOB
```

## boards/nxp/frdm_imxrt700/board.yml
```yaml
board:
  name: frdm_imxrt700
  full_name: FRDM-IMXRT700
  vendor: nxp
  socs:
  - name: mimxrt798s
```

## boards/nxp/frdm_k22f/Kconfig.frdm_k22f
```kconfig
# Copyright 2024 NXP
# SPDX-License-Identifier: Apache-2.0

config BOARD_FRDM_K22F
	select SOC_MK22F51212
	select SOC_PART_NUMBER_MK22FN512VLH12
```

## boards/nxp/frdm_k22f/board.yml
```yaml
board:
  name: frdm_k22f
  full_name: FRDM-K22F
  vendor: nxp
  socs:
    - name: mk22f51212
```

## boards/nxp/frdm_k22f/frdm_k22f_mk22f51212_defconfig
```kconfig
#
# Copyright (c) 2018 Prevas A/S
# Copyright (c) 2019 Thomas Burdick <thomas.burdick@gmail.com>

#
# SPDX-License-Identifier: Apache-2.0
#

CONFIG_CONSOLE=y
CONFIG_UART_CONSOLE=y
CONFIG_SERIAL=y
CONFIG_GPIO=y
CONFIG_PINCTRL=y
CONFIG_SYS_CLOCK_HW_CYCLES_PER_SEC=72000000
CONFIG_OSC_LOW_POWER=y
```

## boards/nxp/frdm_k32l2b3/Kconfig.frdm_k32l2b3
```kconfig
#
# Copyright (c) 2025 Ishraq Ibne Ashraf <ishraq.i.ashraf@gmail.com>
#
# SPDX-License-Identifier: Apache-2.0
#

config BOARD_FRDM_K32L2B3
	select SOC_K32L2B31A
	select SOC_PART_NUMBER_K32L2B31VLH0A
```

## boards/nxp/frdm_k32l2b3/board.yml
```yaml
board:
  name: frdm_k32l2b3
  full_name: FRDM-K32L2B3
  vendor: nxp
  socs:
    - name: k32l2b31a
```

## boards/nxp/frdm_k64f/Kconfig.frdm_k64f
```kconfig
# Copyright 2024 NXP
# SPDX-License-Identifier: Apache-2.0

config BOARD_FRDM_K64F
	select SOC_MK64F12
	select SOC_PART_NUMBER_MK64FN1M0VLL12
```

## boards/nxp/frdm_k64f/board.yml
```yaml
board:
  name: frdm_k64f
  full_name: FRDM-K64F
  vendor: nxp
  socs:
    - name: mk64f12
```

## boards/nxp/frdm_k82f/Kconfig.frdm_k82f
```kconfig
# Copyright 2024 NXP
# SPDX-License-Identifier: Apache-2.0

config BOARD_FRDM_K82F
	select SOC_MK82F25615
	select SOC_PART_NUMBER_MK82FN256VLL15
```

## boards/nxp/frdm_k82f/board.yml
```yaml
board:
  name: frdm_k82f
  full_name: FRDM-K82F
  vendor: nxp
  socs:
    - name: mk82f25615
```

## boards/nxp/frdm_ke15z/Kconfig.frdm_ke15z
```kconfig
# Copyright 2024 NXP
# SPDX-License-Identifier: Apache-2.0

config BOARD_FRDM_KE15Z
	select SOC_MKE15Z7
	select SOC_PART_NUMBER_MKE15Z256VLL7
```

## boards/nxp/frdm_ke15z/board.yml
```yaml
board:
  name: frdm_ke15z
  full_name: FRDM-KE15Z
  vendor: nxp
  socs:
    - name: mke15z7
```

## boards/nxp/frdm_ke15z/frdm_ke15z_defconfig
```kconfig
# SPDX-License-Identifier: Apache-2.0

CONFIG_SERIAL=y
CONFIG_UART_INTERRUPT_DRIVEN=y

# Enable console
CONFIG_CONSOLE=y
CONFIG_UART_CONSOLE=y

# GPIO Controller
CONFIG_GPIO=y

# Clock Control
CONFIG_CLOCK_CONTROL=y
```

## boards/nxp/frdm_ke16z/Kconfig.frdm_ke16z
```kconfig
# Copyright 2024 NXP
# SPDX-License-Identifier: Apache-2.0

config BOARD_FRDM_KE16Z
	select SOC_MKE16Z4
	select SOC_PART_NUMBER_MKE16Z64VLF4
```

## boards/nxp/frdm_ke16z/board.yml
```yaml
board:
  name: frdm_ke16z
  full_name: FRDM-KE16Z
  vendor: nxp
  socs:
    - name: mke16z4
```

## boards/nxp/frdm_ke17z/Kconfig.defconfig
```kconfig
# FRDM-KE17Z board

# Copyright 2024 NXP
# SPDX-License-Identifier: Apache-2.0

if BOARD_FRDM_KE17Z

config FXOS8700_DRDY_INT1
	default y
	depends on FXOS8700_TRIGGER

endif # BOARD_FRDM_KE17Z
```

## boards/nxp/frdm_ke17z/Kconfig.frdm_ke17z
```kconfig
# FRDM-KE17Z board configuration
# Copyright 2024 NXP
# SPDX-License-Identifier: Apache-2.0

config BOARD_FRDM_KE17Z
	select SOC_MKE17Z7
	select SOC_PART_NUMBER_MKE17Z256VLL7
```

## boards/nxp/frdm_ke17z/board.yml
```yaml
board:
  name: frdm_ke17z
  full_name: FRDM-KE17Z
  vendor: nxp
  socs:
    - name: mke17z7
```

## boards/nxp/frdm_ke17z/frdm_ke17z_defconfig
```kconfig
#
# Copyright 2024 NXP
#
# SPDX-License-Identifier: Apache-2.0
#

# Enable console
CONFIG_CONSOLE=y
CONFIG_UART_CONSOLE=y
CONFIG_SERIAL=y

# GPIO Controller
CONFIG_GPIO=y

# Clock Control
CONFIG_CLOCK_CONTROL=y

# Enable pin controller
CONFIG_PINCTRL=y
```

## boards/nxp/frdm_ke17z512/Kconfig.frdm_ke17z512
```kconfig
# Copyright 2024 NXP
# SPDX-License-Identifier: Apache-2.0

config BOARD_FRDM_KE17Z512
	select SOC_MKE17Z9
	select SOC_PART_NUMBER_MKE17Z512VLL9
```

## boards/nxp/frdm_ke17z512/board.yml
```yaml
board:
  name: frdm_ke17z512
  full_name: FRDM-KE17Z512
  vendor: nxp
  socs:
    - name: mke17z9
```

## boards/nxp/frdm_ke17z512/frdm_ke17z512_defconfig
```kconfig
#
# Copyright 2024 NXP
#
# SPDX-License-Identifier: Apache-2.0
#

CONFIG_CONSOLE=y
CONFIG_UART_CONSOLE=y
CONFIG_SERIAL=y
CONFIG_GPIO=y
CONFIG_PINCTRL=y
```
