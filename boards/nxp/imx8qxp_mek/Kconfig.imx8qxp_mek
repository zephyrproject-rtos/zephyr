## boards/nxp/imx8qxp_mek/Kconfig.imx8qxp_mek
```kconfig
#
# Copyright 2024 NXP
#
# SPDX-License-Identifier: Apache-2.0

config BOARD_IMX8QXP_MEK
	select SOC_MIMX8QX6_ADSP if BOARD_IMX8QXP_MEK_MIMX8QX6_ADSP
	select SOC_PART_NUMBER_MIMX8QX6AVLFZ
```

## boards/nxp/imx8qxp_mek/board.yml
```yaml
board:
  name: imx8qxp_mek
  full_name: i.MX 8QuadXPlus Multisensory Enablement Kit (MEK)
  vendor: nxp
  socs:
    - name: mimx8qx6
```

## boards/nxp/imx8ulp_evk/Kconfig.imx8ulp_evk
```kconfig
#
# Copyright 2024 NXP
#
# SPDX-License-Identifier: Apache-2.0

config BOARD_IMX8ULP_EVK
	select SOC_MIMX8UD7_ADSP if BOARD_IMX8ULP_EVK_MIMX8UD7_ADSP
	select SOC_PART_NUMBER_MIMX8UD7DVK08
```

## boards/nxp/imx8ulp_evk/board.yml
```yaml
board:
  name: imx8ulp_evk
  full_name: i.MX8ULP-EVK
  vendor: nxp
  socs:
    - name: mimx8ud7
```

## boards/nxp/imx8ulp_evk/imx8ulp_evk_imx8ulp_adsp_defconfig
```kconfig
# SPDX-License-Identifier: Apache-2.0

CONFIG_BUILD_OUTPUT_BIN=n

CONFIG_DYNAMIC_INTERRUPTS=y

CONFIG_LOG=y
```

## boards/nxp/imx8ulp_evk/imx8ulp_evk_mimx8ud7_adsp_defconfig
```kconfig
# SPDX-License-Identifier: Apache-2.0

CONFIG_BUILD_OUTPUT_BIN=n

CONFIG_DYNAMIC_INTERRUPTS=y

CONFIG_LOG=y

CONFIG_CLOCK_CONTROL=y

# serial-related configurations
CONFIG_SERIAL=y
CONFIG_CONSOLE=y
CONFIG_UART_CONSOLE=y
```

## boards/nxp/imx91_evk/Kconfig.imx91_evk
```kconfig
# Copyright 2025 NXP
# SPDX-License-Identifier: Apache-2.0

config BOARD_IMX91_EVK
	select SOC_MIMX9131
	select SOC_PART_NUMBER_MIMX9131CVVXJ
```

## boards/nxp/imx91_evk/board.yml
```yaml
board:
  name: imx91_evk
  full_name: i.MX91 EVK
  vendor: nxp
  socs:
  - name: mimx9131
```

## boards/nxp/imx91_evk/imx91_evk_mimx9131_defconfig
```kconfig
#
# Copyright 2025 NXP
#
# SPDX-License-Identifier: Apache-2.0

# ARM Options
CONFIG_AARCH64_IMAGE_HEADER=y
CONFIG_ARMV8_A_NS=y

# MMU Options
# Increase the value when encounter the assert on the MAX_XLAT_TABLES
CONFIG_MAX_XLAT_TABLES=24

# Cache Options
CONFIG_CACHE_MANAGEMENT=y
CONFIG_DCACHE_LINE_SIZE_DETECT=y
CONFIG_ICACHE_LINE_SIZE_DETECT=y

# Zephyr Kernel Configuration
CONFIG_XIP=n

# Serial Drivers
CONFIG_SERIAL=y
CONFIG_UART_INTERRUPT_DRIVEN=y

# Enable Console
CONFIG_CONSOLE=y
CONFIG_UART_CONSOLE=y

CONFIG_CLOCK_CONTROL=y
```

## boards/nxp/imx91_qsb/Kconfig.imx91_qsb
```kconfig
# Copyright 2025 NXP
# SPDX-License-Identifier: Apache-2.0

config BOARD_IMX91_QSB
	select SOC_MIMX9111
	select SOC_PART_NUMBER_MIMX9111CVXXJ
```

## boards/nxp/imx91_qsb/board.yml
```yaml
board:
  name: imx91_qsb
  full_name: i.MX91 QSB
  vendor: nxp
  socs:
  - name: mimx9111
```

## boards/nxp/imx93_evk/Kconfig
```kconfig
# i.MX 93 EVK board configuration

# Copyright 2024 NXP
# SPDX-License-Identifier: Apache-2.0

config BOARD_MIMX93_EVK_EXP_SEL_INIT
	bool "Configure i.MX 93 EVK board mux control during init"
	default n

config BOARD_MIMX93_EVK_EXP_SEL_INIT_PRIO
	int "i.MX 93 EVK board mux control init priority"
	default 60

module = BOARD_MIMX93_EVK
module-str = Board Control
source "subsys/logging/Kconfig.template.log_config"
```

## boards/nxp/imx93_evk/Kconfig.defconfig
```kconfig
# Copyright 2024 NXP
# SPDX-License-Identifier: Apache-2.0

if BOARD_IMX93_EVK

if BOARD_IMX93_EVK_MIMX9352_A55 || BOARD_IMX93_EVK_MIMX9352_A55_SMP

if CAN

# Enable board mux configure during init
config BOARD_MIMX93_EVK_EXP_SEL_INIT
	default y

# CAN Phy must be initialized after board mux
config CAN_TRANSCEIVER_INIT_PRIORITY
	default 65

endif # CAN

if BOARD_MIMX93_EVK_EXP_SEL_INIT

# Enable I2C, MFD, MFD_APD5585 and GPIO_ADP5585
config GPIO
	default y

config MFD_ADP5585_INIT_PRIORITY
	default 55

config GPIO_ADP5585_INIT_PRIORITY
	default 56

endif # BOARD_MIMX93_EVK_EXP_SEL_INIT

configdefault NET_L2_ETHERNET
	default y

configdefault NET_TX_STACK_SIZE
	default 8192

configdefault NET_RX_STACK_SIZE
	default 8192

configdefault NET_TCP_WORKQ_STACK_SIZE
	default 8192

configdefault NET_MGMT_EVENT_STACK_SIZE
	default 8192

configdefault NET_SOCKETS_SERVICE_STACK_SIZE
	default 8192

endif # BOARD_IMX93_EVK_MIMX9352_A55

if IMX_USDHC

config GPIO
	default y

endif # IMX_USDHC

endif # BOARD_IMX93_EVK
```

## boards/nxp/imx93_evk/Kconfig.imx93_evk
```kconfig
# Copyright 2022,2024 NXP
# SPDX-License-Identifier: Apache-2.0

config BOARD_IMX93_EVK
	select SOC_MIMX9352_A55 if BOARD_IMX93_EVK_MIMX9352_A55
	select SOC_PART_NUMBER_MIMX9352CVUXK
```

## boards/nxp/imx93_evk/board.yml
```yaml
board:
  name: imx93_evk
  full_name: i.MX93 EVK
  vendor: nxp
  socs:
  - name: mimx9352
    variants:
    - name: smp
      cpucluster: a55
    - name: ddr
      cpucluster: m33
```

## boards/nxp/imx93_evk/dts/bindings/imx93evk-exp-sel.yaml
```yaml
# Copyright 2024 NXP
# SPDX-License-Identifier: Apache-2.0

description: |
  The i.MX 93 EVK boards has a series of MUXes that selects between 2 pin
  functions. They are controlled by EXP_SEL signal from gpio_exp0, an
  ADP5585 GPIO expander.

compatible: "imx93evk-exp-sel"

include: base.yaml

properties:
  mux-gpios:
    type: phandle-array
    required: true
    description: Pin used to select the MUX

  mux:
    type: string
    required: true
    enum:
      - "A"
      - "B"
    description: MUX choice
```

## boards/nxp/imx93_evk/imx93_evk_mimx9352_a55_defconfig
```kconfig
#
# Copyright 2022 NXP
#
# SPDX-License-Identifier: Apache-2.0

# ARM Options
CONFIG_AARCH64_IMAGE_HEADER=y
CONFIG_ARMV8_A_NS=y

# MMU Options
CONFIG_MAX_XLAT_TABLES=64

# Cache Options
CONFIG_CACHE_MANAGEMENT=y

# Zephyr Kernel Configuration
CONFIG_XIP=n

# Serial Drivers
CONFIG_SERIAL=y
CONFIG_UART_INTERRUPT_DRIVEN=y

# Enable Console
CONFIG_CONSOLE=y
CONFIG_UART_CONSOLE=y

CONFIG_CLOCK_CONTROL=y
```

## boards/nxp/imx943_evk/Kconfig.defconfig
```kconfig
# Copyright 2025 NXP
# SPDX-License-Identifier: Apache-2.0

if SOC_MIMX94398_A55

if ETH_NXP_IMX_NETC

config GIC_V3_ITS
	default y

endif # ETH_NXP_IMX_NETC

# GIC ITS depends on kernel heap which init priority is 30, so set
# GIC to be 31, mailbox and SCMI will be initialized by the order
# according to dts dependency although they use the same init priority.
config INTC_INIT_PRIORITY
	default 31

config MBOX_INIT_PRIORITY
	default 31

config ARM_SCMI_SHMEM_INIT_PRIORITY
	default 31 if SOC_MIMX94398_A55

config ARM_SCMI_TRANSPORT_INIT_PRIORITY
	default 31 if SOC_MIMX94398_A55

config CLOCK_CONTROL_INIT_PRIORITY
	default 31 if SOC_MIMX94398_A55

# Enlarge default networking stack
if NETWORKING

config NET_L2_ETHERNET
	default y

config NET_TX_STACK_SIZE
	default 8192

config NET_RX_STACK_SIZE
	default 8192

if NET_TCP

config NET_TCP_WORKQ_STACK_SIZE
	default 8192

endif # NET_TCP

if NET_MGMT_EVENT

config NET_MGMT_EVENT_STACK_SIZE
	default 8192

endif # NET_MGMT_EVENT

if NET_SOCKETS_SERVICE

config NET_SOCKETS_SERVICE_STACK_SIZE
	default 8192

endif # NET_SOCKETS_SERVICE

endif # NETWORKING

endif # SOC_MIMX94398_A55

if SOC_MIMX94398_M33

config INTC_INIT_PRIORITY
	default 2

config MBOX_INIT_PRIORITY
	default 3

endif # SOC_MIMX94398_M33

if ETH_NXP_IMX_NETC

config ETH_NXP_IMX_RX_RING_LEN
	default 16

config ETH_NXP_IMX_TX_RING_LEN
	default 16

config NET_IF_MAX_IPV4_COUNT
	default 6

config NET_IF_MAX_IPV6_COUNT
	default 6

endif # ETH_NXP_IMX_NETC

if NET_GPTP

config NET_GPTP_MONITOR_SYNC_STATUS
	default y

endif # NET_GPTP
```

## boards/nxp/imx943_evk/Kconfig.imx943_evk
```kconfig
# Copyright 2025 NXP
# SPDX-License-Identifier: Apache-2.0

config BOARD_IMX943_EVK
	select SOC_MIMX94398_A55 if BOARD_IMX943_EVK_MIMX94398_A55
	select SOC_MIMX94398_M33 if BOARD_IMX943_EVK_MIMX94398_M33 || BOARD_IMX943_EVK_MIMX94398_M33_DDR
	select SOC_MIMX94398_M7_0 if BOARD_IMX943_EVK_MIMX94398_M7_0
	select SOC_MIMX94398_M7_1 if BOARD_IMX943_EVK_MIMX94398_M7_1
	select SOC_PART_NUMBER_MIMX94398AVKM
```

## boards/nxp/imx943_evk/board.yml
```yaml
board:
  name: imx943_evk
  full_name: i.MX943 EVK
  vendor: nxp
  socs:
  - name: mimx94398
    variants:
    - name: ddr
      cpucluster: m33
```

## boards/nxp/imx943_evk/imx943_evk_mimx94398_m33_defconfig
```kconfig
#
# Copyright 2025 NXP
#
# SPDX-License-Identifier: Apache-2.0
#

# clock-related configurations
CONFIG_CLOCK_CONTROL=y

# serial interface-related configurations
CONFIG_SERIAL=y
CONFIG_UART_CONSOLE=y
CONFIG_UART_INTERRUPT_DRIVEN=y
CONFIG_CONSOLE=y

# SCMI-related configurations
CONFIG_MBOX=y
CONFIG_MBOX_INIT_PRIORITY=0
CONFIG_ARM_SCMI=y
CONFIG_ARM_SCMI_NXP_VENDOR_EXTENSIONS=y

# kernel-related configurations
CONFIG_XIP=y

# i2c multiplexer related configurations
CONFIG_I2C_TCA954X_CHANNEL_INIT_PRIO=51

# i2s related configurations
CONFIG_I2S_HAS_PLL_SETTING=n

# nocache section related configurations
CONFIG_NOCACHE_MEMORY=y
```

## boards/nxp/imx952_evk/Kconfig.defconfig
```kconfig
# Copyright 2026 NXP
# SPDX-License-Identifier: Apache-2.0

if SOC_MIMX9529_A55

# GIC ITS depends on kernel heap which init priority is 30, so set
# GIC to be 31, mailbox and SCMI will be initialized by the order
# according to dts dependency although they use the same init priority.
config INTC_INIT_PRIORITY
	default 31

config MBOX_INIT_PRIORITY
	default 31

config ARM_SCMI_SHMEM_INIT_PRIORITY
	default 31 if SOC_MIMX9529_A55

config ARM_SCMI_TRANSPORT_INIT_PRIORITY
	default 31 if SOC_MIMX9529_A55

config CLOCK_CONTROL_INIT_PRIORITY
	default 31 if SOC_MIMX9529_A55

# I2C multiplexer channels must be initialized after their root
configdefault I2C_TCA954X_ROOT_INIT_PRIO
	default 60

configdefault I2C_TCA954X_CHANNEL_INIT_PRIO
	default 61

endif # SOC_MIMX9529_A55
```

## boards/nxp/imx952_evk/Kconfig.imx952_evk
```kconfig
# Copyright 2026 NXP
# SPDX-License-Identifier: Apache-2.0

config BOARD_IMX952_EVK
	select SOC_MIMX9529_M7 if BOARD_IMX952_EVK_MIMX9529_M7 || \
				BOARD_IMX952_EVK_MIMX9529_M7_DDR || \
				BOARD_IMX952_EVK_MIMX9529_M7_FLASH
	select SOC_MIMX9529_A55 if BOARD_IMX952_EVK_MIMX9529_A55 || \
				BOARD_IMX952_EVK_MIMX9529_A55_SMP
	select SOC_PART_NUMBER_MIMX9529xxVZx
```

## boards/nxp/imx952_evk/board.yml
```yaml
board:
  name: imx952_evk
  full_name: i.MX952 EVK
  vendor: nxp
  socs:
  - name: mimx9529
    variants:
    - name: ddr
      cpucluster: m7
    - name: flash
      cpucluster: m7
    - name: smp
      cpucluster: a55
```

## boards/nxp/imx95_evk/Kconfig.defconfig
```kconfig
# Copyright 2024-2025 NXP
# SPDX-License-Identifier: Apache-2.0

if SOC_MIMX9596_A55

if ETH_NXP_IMX_NETC

config GIC_V3_ITS
	default y

endif # ETH_NXP_IMX_NETC

# GIC ITS depends on kernel heap which init priority is 30, so set
# GIC to be 31, mailbox and SCMI will be initialized by the order
# according to dts dependency although they use the same init priority.
config INTC_INIT_PRIORITY
	default 31

config MBOX_INIT_PRIORITY
	default 31

config ARM_SCMI_SHMEM_INIT_PRIORITY
	default 31

config ARM_SCMI_TRANSPORT_INIT_PRIORITY
	default 31

config CLOCK_CONTROL_INIT_PRIORITY
	default 31

# Enlarge default networking stack
configdefault NET_L2_ETHERNET
	default y

configdefault NET_TX_STACK_SIZE
	default 8192

configdefault NET_RX_STACK_SIZE
	default 8192

configdefault NET_TCP_WORKQ_STACK_SIZE
	default 8192

configdefault NET_MGMT_EVENT_STACK_SIZE
	default 8192

configdefault NET_SOCKETS_SERVICE_STACK_SIZE
	default 8192

endif # SOC_MIMX9596_A55
```
