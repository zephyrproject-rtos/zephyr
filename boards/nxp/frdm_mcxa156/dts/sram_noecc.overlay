/*
 * Copyright 2026 NXP
 *
 * SPDX-License-Identifier: Apache-2.0
 */

/ {
	sram0_noecc: memory@20002000 {
		compatible = "mmio-sram";
		reg = <0x20002000 DT_SIZE_K(112)>;
	};

	chosen {
		zephyr,sram = &sram0_noecc;
	};
};
