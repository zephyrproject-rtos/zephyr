;*******************************************************************************
;   Copyright 2022,2024 NXP                                                    *
;   SPDX-License-Identifier: Apache-2.0                                        *
;                                                                              *
;   Lauterbach TRACE32 start-up script for debugging s32z2xxdc2                *
;                                                                              *
;*******************************************************************************

ENTRY %LINE &args

DO ~~~~/startup.cmm command=debug &args

ENDDO
