/*
 * Copyright 2021 NXP
 *
 * SPDX-License-Identifier: Apache-2.0
 */

/dts-v1/;

#include <freq.h>
#include <nxp/nxp_ls1046a.dtsi>

/ {
	compatible = "nxp,ls1046ardb";
	model = "NXP ls1046a RDB";

	chosen {
		zephyr,console = &uart1;
		zephyr,shell-uart = &uart1;
		zephyr,sram = &sram0;
	};
};

&{/cpus} {
	timebase-frequency = <DT_FREQ_M(25)>;
};

&uart1 {
	current-speed = <115200>;
	status = "okay";
};
