/*
 * Copyright 2025 NXP
 *
 * SPDX-License-Identifier: Apache-2.0
 */

/dts-v1/;

#include <nxp/mcx/nxp_mcxa346.dtsi>
#include "frdm_mcxa346-pinctrl.dtsi"
#include "board_common.dtsi"

/ {
	compatible = "nxp,mcxa346", "nxp,mcx";
	model = "NXP FRDM_MCXA346 board";
};

&cpu0 {
	clock-frequency = <180000000>;
};

/* OPAMP configuration */
&opamp0 {
	pinctrl-0 = <&pinmux_opamp0>;
	pinctrl-names = "default";
	status = "okay";
};

&opamp1 {
	status = "okay";
};
