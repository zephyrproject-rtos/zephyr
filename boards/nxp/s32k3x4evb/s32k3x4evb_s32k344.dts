/*
 * SPDX-FileCopyrightText: Copyright (c) 2026 Sachin Kumar
 *
 * SPDX-License-Identifier: Apache-2.0
 */
/dts-v1/;

#include <arm/nxp/nxp_s32k344_m7.dtsi>
#include "s32k3x4evb_s32k344.dtsi"

/ {
	model = "NXP S32K3x4EVB on Cortex-M7 cores";
	compatible = "nxp,s32k3x4evb";

	chosen {
		zephyr,flash = &flash0;
		zephyr,sram  = &sram0_1;
	};
};

&{/cpus/cpu@0} {
	clock-frequency = <DT_FREQ_M(160)>;
};
