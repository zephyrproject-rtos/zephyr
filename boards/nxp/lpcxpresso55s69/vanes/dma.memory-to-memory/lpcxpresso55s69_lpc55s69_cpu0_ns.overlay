/*
 * SPDX-License-Identifier: Apache-2.0
 *
 * Copyright (c) 2023 Benjamin Björnsson <benjamin.bjornsson@gmail.com>
 */

/ {
	dma_test_dma0: dma-test-dma0 {
		compatible = "test-dma-memory-to-memory";
		dma = <&dma0>;
	};
};

&dma0 {
	status = "okay";
};
