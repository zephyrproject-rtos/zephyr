## boards/nxp/lpcxpresso55s69/lpcxpresso55s69_defconfig
```kconfig
#
# Copyright 2024 NXP
#
# SPDX-License-Identifier: Apache-2.0
#
# Common Kconfigs for all board targets
#

CONFIG_GPIO=y
CONFIG_PINCTRL=y

CONFIG_RUNTIME_NMI=y
```

## boards/nxp/lpcxpresso55s69/lpcxpresso55s69_lpc55s69_cpu0_ns_defconfig
```kconfig
#
# Copyright 2019,2024 NXP
#
# SPDX-License-Identifier: Apache-2.0
#

CONFIG_GPIO=y

CONFIG_RUNTIME_NMI=y

CONFIG_CONSOLE=y
CONFIG_UART_CONSOLE=y
CONFIG_SERIAL=y
CONFIG_UART_INTERRUPT_DRIVEN=y

CONFIG_ARM_MPU=n

# Enable TrustZone-M
CONFIG_TRUSTED_EXECUTION_SECURE=n
CONFIG_TRUSTED_EXECUTION_NONSECURE=y
CONFIG_ARM_TRUSTZONE_M=y
CONFIG_BUILD_WITH_TFM=y

CONFIG_BUILD_OUTPUT_HEX=y
```

## boards/nxp/ls1046ardb/Kconfig.ls1046ardb
```kconfig
#
# Copyright 2021,2024 NXP
# SPDX-License-Identifier: Apache-2.0
#

config BOARD_LS1046ARDB
	select SOC_LS1046A
	select SOC_PART_NUMBER_LS1046A
```

## boards/nxp/ls1046ardb/board.yml
```yaml
board:
  name: ls1046ardb
  full_name: LS1046A RDB
  vendor: nxp
  socs:
  - name: ls1046a
    variants:
    - name: smp
      variants:
      - name: 4cores
```

## boards/nxp/ls1046ardb/ls1046ardb_ls1046a_defconfig
```kconfig
# Copyright 2024 NXP
# SPDX-License-Identifier: Apache-2.0

# Platform Configuration
CONFIG_ARM64_VA_BITS_40=y
CONFIG_ARM64_PA_BITS_40=y
# 25 MHz system clock
CONFIG_SYS_CLOCK_HW_CYCLES_PER_SEC=25000000

# Zephyr Kernel Configuration
CONFIG_XIP=n
CONFIG_AARCH64_IMAGE_HEADER=y

# Serial Drivers
CONFIG_SERIAL=y
CONFIG_UART_INTERRUPT_DRIVEN=y

# Enable Console
CONFIG_CONSOLE=y
CONFIG_UART_CONSOLE=y
```

## boards/nxp/ls1046ardb/ls1046ardb_ls1046a_smp_defconfig
```kconfig
# SPDX-License-Identifier: Apache-2.0

# Zephyr Kernel Configuration
CONFIG_MAX_THREAD_BYTES=5
CONFIG_MAX_XLAT_TABLES=10

# SMP support
CONFIG_SMP=y
CONFIG_MP_MAX_NUM_CPUS=2
CONFIG_CACHE_MANAGEMENT=y
CONFIG_ARMV8_A_NS=y

# PSCI is supported
CONFIG_PM_CPU_OPS=y
```

## boards/nxp/mcx_n9xx_evk/Kconfig
```kconfig
# Copyright 2024-2025 NXP
# SPDX-License-Identifier: Apache-2.0

config BOARD_MCX_N9XX_EVK
	select BOARD_EARLY_INIT_HOOK
```

## boards/nxp/mcx_n9xx_evk/board.yml
```yaml
board:
  name: mcx_n9xx_evk
  full_name: MCX-N9XX-EVK
  vendor: nxp
  socs:
  - name: mcxn947
    variants:
    - name: qspi
      cpucluster: 'cpu0'
```

## boards/nxp/mcx_nx4x_evk/Kconfig
```kconfig
# Copyright 2024-2025 NXP
# SPDX-License-Identifier: Apache-2.0

config BOARD_MCX_NXXX_EVK
	bool
	default y if BOARD_MCX_N9XX_EVK || BOARD_MCX_N5XX_EVK
	select BOARD_EARLY_INIT_HOOK
```

## boards/nxp/mcx_nx4x_evk/Kconfig.defconfig
```kconfig
# Copyright 2024-2025 NXP
# SPDX-License-Identifier: Apache-2.0

if BOARD_MCX_N9XX_EVK || BOARD_MCX_N5XX_EVK

configdefault NET_L2_ETHERNET
	default y

if SD_STACK

# SD stack requires larger main stack size
config MAIN_STACK_SIZE
	default 1536

endif

endif
```

## boards/nxp/mcx_nx4x_evk/Kconfig.mcx_n9xx_evk
```kconfig
# Copyright 2025 NXP
# SPDX-License-Identifier: Apache-2.0

config BOARD_MCX_N9XX_EVK
	select SOC_MCXN947_CPU0 if BOARD_MCX_N9XX_EVK_MCXN947_CPU0 || BOARD_MCX_N9XX_EVK_MCXN947_CPU0_QSPI
	select SOC_MCXN947_CPU1 if BOARD_MCX_N9XX_EVK_MCXN947_CPU1
	select SOC_PART_NUMBER_MCXN947VDF
```

## boards/nxp/mcx_nx4x_evk/board.yml
```yaml
boards:
  - name: mcx_n9xx_evk
    full_name: MCX-N9XX-EVK
    vendor: nxp
    socs:
      - name: mcxn947
        variants:
          - name: qspi
            cpucluster: 'cpu0'
  - name: mcx_n5xx_evk
    full_name: MCX-N5XX-EVK
    vendor: nxp
    socs:
      - name: mcxn547
```

## boards/nxp/mcx_nx4x_evk/mcx_n5xx_evk_mcxn547_cpu1_defconfig
```kconfig
#
# Copyright 2026 NXP
#
# SPDX-License-Identifier: Apache-2.0
#

CONFIG_CONSOLE=y
CONFIG_UART_CONSOLE=y
CONFIG_SERIAL=y
CONFIG_UART_INTERRUPT_DRIVEN=y

# CPU1 should not enable TrustZone/MPU/FPU features meant for CPU0
# (SoC Kconfig for CPU1 already avoids selecting them)
```

## boards/nxp/mcx_nxxx_evk/Kconfig
```kconfig
# Copyright 2024-2025 NXP
# SPDX-License-Identifier: Apache-2.0

config BOARD_MCX_N9XX_EVK
	bool
	select BOARD_EARLY_INIT_HOOK

config BOARD_MCX_N5XX_EVK
	bool
	select BOARD_EARLY_INIT_HOOK
```

## boards/nxp/mcx_nxxx_evk/Kconfig.mcx_n5xx_evk
```kconfig
# Copyright 2025 NXP
# SPDX-License-Identifier: Apache-2.0

config BOARD_MCX_N5XX_EVK
	select SOC_MCXN547_CPU0 if BOARD_MCX_N5XX_EVK_MCXN547_CPU0
	select SOC_PART_NUMBER_MCXN547VDF
```

## boards/nxp/mcxw23_evk/Kconfig.defconfig
```kconfig
# Copyright 2025 NXP
# SPDX-License-Identifier: Apache-2.0

if BOARD_MCXW23_EVK

config FXLS8974_DRDY_INT1
	default y
	depends on FXLS8974_TRIGGER

if BOOTLOADER_MCUBOOT

choice MCUBOOT_BOOTLOADER_MODE
	# Board only supports MCUBoot via "upgrade only" method:
	default MCUBOOT_BOOTLOADER_MODE_OVERWRITE_ONLY
endchoice

endif #BOOTLOADER_MCUBOOT

endif # BOARD_MCXW23_EVK
```

## boards/nxp/mcxw23_evk/Kconfig.mcxw23_evk
```kconfig
# Copyright 2025 NXP
# SPDX-License-Identifier: Apache-2.0

config BOARD_MCXW23_EVK
	select SOC_MCXW236
	select SOC_PART_NUMBER_MCXW236BIHNAR
```

## boards/nxp/mcxw23_evk/Kconfig.sysbuild
```kconfig
# Copyright 2025 NXP
# SPDX-License-Identifier: Apache-2.0

choice MCUBOOT_MODE
	default MCUBOOT_MODE_OVERWRITE_ONLY
endchoice
```

## boards/nxp/mcxw23_evk/board.yml
```yaml
board:
  name: mcxw23_evk
  full_name: MCXW23-EVK
  vendor: nxp
  socs:
    - name: mcxw236
```

## boards/nxp/mcxw72_evk/Kconfig.mcxw72_evk
```kconfig
# Copyright 2024 NXP
# SPDX-License-Identifier: Apache-2.0

config BOARD_MCXW72_EVK
	select SOC_MCXW727C_CPU0 if BOARD_MCXW72_EVK_MCXW727C_CPU0
	select SOC_PART_NUMBER_MCXW727CMFTA
```

## boards/nxp/mcxw72_evk/board.yml
```yaml
board:
  name: mcxw72_evk
  full_name: MCXW72-EVK
  vendor: nxp
  socs:
    - name: mcxw727c
```

## boards/nxp/mcxw72_evk/mcxw72_evk_mcxw727c_cpu1_defconfig
```kconfig
#
# Copyright 2026 NXP
#
# SPDX-License-Identifier: Apache-2.0
#

CONFIG_SERIAL=y
CONFIG_CONSOLE=y
CONFIG_UART_CONSOLE=y
CONFIG_UART_INTERRUPT_DRIVEN=y
```

## boards/nxp/mimxrt1010_evk/Kconfig.mimxrt1010_evk
```kconfig
# Copyright (c) 2019, NXP
# SPDX-License-Identifier: Apache-2.0

config BOARD_MIMXRT1010_EVK
	select SOC_PART_NUMBER_MIMXRT1011DAE5A
```

## boards/nxp/mimxrt1010_evk/board.yml
```yaml
board:
  name: mimxrt1010_evk
  full_name: MIMXRT1010-EVK
  vendor: nxp
  socs:
    - name: mimxrt1011
```
