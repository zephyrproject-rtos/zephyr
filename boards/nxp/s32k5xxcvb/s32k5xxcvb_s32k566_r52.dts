/*
 * Copyright 2025 NXP
 *
 * SPDX-License-Identifier: Apache-2.0
 */

/dts-v1/;
#include <arm/nxp/s32/nxp_s32k566_r52.dtsi>
#include "s32k5xxcvb_s32k566.dtsi"

/ {
	compatible = "nxp,s32k566cvb";
	model = "NXP S32K566CVB on Cortex-R52 cores";

	chosen {
		zephyr,sram = &cpe_sram;
		zephyr,flash = &cmram;
	};
};
