/*
 * Copyright 2025 NXP
 *
 * SPDX-License-Identifier: Apache-2.0
 */

/dts-v1/;

#include <arm/nxp/s32/nxp_s32k566_m7.dtsi>
#include "s32k5xxcvb_s32k566.dtsi"

/ {
	model = "NXP S32K566CVB on Cortex-M7 cores";
	compatible = "nxp,s32k566cvb";

	chosen {
		zephyr,sram = &sram0;
		zephyr,flash = &cmram;
	};
};
