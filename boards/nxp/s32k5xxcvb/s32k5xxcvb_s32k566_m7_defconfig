## boards/nxp/s32k5xxcvb/s32k5xxcvb_s32k566_m7_defconfig
```kconfig
# Copyright 2025 NXP
# SPDX-License-Identifier: Apache-2.0

# Run from Code MRAM
CONFIG_XIP=y

# Enable MPU
CONFIG_ARM_MPU=y
CONFIG_CLOCK_CONTROL=y
```

## boards/nxp/s32k5xxcvb/s32k5xxcvb_s32k566_r52_defconfig
```kconfig
# Copyright 2025 NXP
# SPDX-License-Identifier: Apache-2.0

CONFIG_ARM_MPU=y
CONFIG_CLOCK_CONTROL=y

# Run from Code MRAM
CONFIG_XIP=y
```

## boards/nxp/s32z2xxdc2/Kconfig.defconfig
```kconfig
# Copyright 2022,2024 NXP
# SPDX-License-Identifier: Apache-2.0

if BOARD_S32Z2XXDC2_S32Z270_RTU0 || BOARD_S32Z2XXDC2_S32Z270_RTU1

config BUILD_OUTPUT_BIN
	default n

if SERIAL

config UART_INTERRUPT_DRIVEN
	default y

config UART_CONSOLE
	default y

endif # SERIAL

if SHELL

config SHELL_STACK_SIZE
	default 4096

endif # SHELL

if NETWORKING

config NET_L2_ETHERNET
	default y  if !NET_LOOPBACK && !NET_TEST

endif # NETWORKING

if XIP
# Offset between CRAM AXIM and CRAM AXIF, code will be downloaded
# over AXIM interface
config BUILD_OUTPUT_ADJUST_LMA
	default "-0x47800000"

config CPU_CORTEX_R52_CACHE_SEGREGATION
	default y

config CPU_CORTEX_R52_ICACHE_FLASH_WAY
	default 4

config CPU_CORTEX_R52_DCACHE_FLASH_WAY
	default 1
endif # XIP

endif # BOARD_S32Z2XXDC2_S32Z270_RTU0 || BOARD_S32Z2XXDC2_S32Z270_RTU1
```

## boards/nxp/s32z2xxdc2/Kconfig.s32z2xxdc2
```kconfig
# Copyright 2022,2024 NXP
# SPDX-License-Identifier: Apache-2.0

config BOARD_S32Z2XXDC2
	select SOC_S32Z270_RTU0 if BOARD_S32Z2XXDC2_S32Z270_RTU0
	select SOC_S32Z270_RTU1 if BOARD_S32Z2XXDC2_S32Z270_RTU1
	select SOC_S32Z280_RTU0 if BOARD_S32Z2XXDC2_S32Z280_RTU0
	select SOC_S32Z280_RTU1 if BOARD_S32Z2XXDC2_S32Z280_RTU1
	select SOC_PART_NUMBER_P32Z270ADCK0MJFT if BOARD_S32Z2XXDC2_S32Z270_RTU0 || \
						BOARD_S32Z2XXDC2_S32Z270_RTU1
	select SOC_PART_NUMBER_P32Z280ABCMJF if BOARD_S32Z2XXDC2_S32Z280_RTU0 || \
						BOARD_S32Z2XXDC2_S32Z280_RTU1
```

## boards/nxp/s32z2xxdc2/board.yml
```yaml
board:
  name: s32z2xxdc2
  full_name: X-S32Z27X-DC (DC2)
  vendor: nxp
  revision:
    format: letter
    default: B
    revisions:
      - name: B
      - name: D
  socs:
    - name: s32z270
```

## boards/nxp/s32z2xxdc2/s32z2xxdc2_s32z270_rtu0_defconfig
```kconfig
# Copyright 2022,2024 NXP
# SPDX-License-Identifier: Apache-2.0

CONFIG_XIP=y
CONFIG_ISR_STACK_SIZE=512
CONFIG_SYS_CLOCK_TICKS_PER_SEC=1000
CONFIG_SYS_CLOCK_HW_CYCLES_PER_SEC=8000000
CONFIG_ARM_MPU=y
CONFIG_SERIAL=y
CONFIG_CONSOLE=y
```

## boards/nxp/twr_ke18f/Kconfig
```kconfig
# TWR-KE18F board configuration

# Copyright (c) 2019 Vestas Wind Systems A/S
# SPDX-License-Identifier: Apache-2.0

if BOARD_TWR_KE18F

config BOARD_TWR_KE18F_FLEXIO_CLKOUT
	bool "CLKOUT signal on FlexIO header"
	select PINCTRL
	help
	  Enable the CLKOUT signal on FlexIO header pin 7 (PTE10).

endif # BOARD_TWR_KE18F
```

## boards/nxp/twr_ke18f/Kconfig.twr_ke18f
```kconfig
# Copyright 2024 NXP
# SPDX-License-Identifier: Apache-2.0

config BOARD_TWR_KE18F
	select SOC_MKE18F16
	select SOC_PART_NUMBER_MKE18F512VLL16
```

## boards/nxp/twr_ke18f/board.yml
```yaml
board:
  name: twr_ke18f
  full_name: TWR-KE18F
  vendor: nxp
  socs:
    - name: mke18f16
```

## boards/nxp/twr_ke18f/twr_ke18f_defconfig
```kconfig
# SPDX-License-Identifier: Apache-2.0

CONFIG_SERIAL=y
CONFIG_CONSOLE=y
CONFIG_UART_CONSOLE=y
CONFIG_UART_INTERRUPT_DRIVEN=y
CONFIG_GPIO=y

# Enable MPU
CONFIG_ARM_MPU=y
```

## boards/nxp/twr_kv58f220m/Kconfig.twr_kv58f220m
```kconfig
# Copyright 2024 NXP
# SPDX-License-Identifier: Apache-2.0

config BOARD_TWR_KV58F220M
	select SOC_MKV58F24
	select SOC_PART_NUMBER_MKV58F1M0VLQ24
```

## boards/nxp/twr_kv58f220m/board.yml
```yaml
board:
  name: twr_kv58f220m
  full_name: TWR-KV58F220M
  vendor: nxp
  socs:
    - name: mkv58f24
```

## boards/nxp/twr_kv58f220m/twr_kv58f220m_defconfig
```kconfig
# SPDX-License-Identifier: Apache-2.0

CONFIG_SERIAL=y
CONFIG_CONSOLE=y
CONFIG_UART_CONSOLE=y
CONFIG_UART_INTERRUPT_DRIVEN=y
CONFIG_GPIO=y
CONFIG_SYS_CLOCK_HW_CYCLES_PER_SEC=237500000

# Enable MPU
CONFIG_ARM_MPU=y
CONFIG_HW_STACK_PROTECTION=y
```

## boards/nxp/ucans32k1sic/Kconfig.defconfig
```kconfig
# Copyright 2023-2024 NXP
# SPDX-License-Identifier: Apache-2.0

if BOARD_UCANS32K1SIC

if SERIAL

config UART_CONSOLE
	default y

endif # SERIAL

if CAN

config GPIO
	default y

endif # CAN

endif # BOARD_UCANS32K1SIC
```

## boards/nxp/ucans32k1sic/Kconfig.ucans32k1sic
```kconfig
# Copyright 2023-2024 NXP
# SPDX-License-Identifier: Apache-2.0

config BOARD_UCANS32K1SIC
	select SOC_S32K146
	select SOC_PART_NUMBER_FS32K146UAT0VLHT
```

## boards/nxp/ucans32k1sic/board.yml
```yaml
board:
  name: ucans32k1sic
  full_name: UCANS32K1SIC
  vendor: nxp
  socs:
    - name: s32k146
```

## boards/nxp/ucans32k1sic/ucans32k1sic_defconfig
```kconfig
# Copyright 2023-2024 NXP
# SPDX-License-Identifier: Apache-2.0

CONFIG_BUILD_OUTPUT_HEX=y

# Use Systick as system clock
CONFIG_SYS_CLOCK_HW_CYCLES_PER_SEC=80000000

# Run from internal program flash
CONFIG_XIP=y

# Enable MPU
CONFIG_ARM_MPU=y

CONFIG_PINCTRL=y
CONFIG_SERIAL=y
CONFIG_CONSOLE=y
```

## boards/nxp/usb_kw24d512/Kconfig.defconfig
```kconfig
# USB-KW24D512 board

# Copyright (c) 2017, Phytec Messtechnik GmbH
# SPDX-License-Identifier: Apache-2.0

if BOARD_USB_KW24D512

config OSC_XTAL0_FREQ
	# The MCU is configured to use 4 MHz external
	# clock from the transceiver provided at the CLK_OUT output.
	# CLK_OUT is internally connected to the input pin EXTAL0
	# of the MCU.
	default 4000000

config MCG_PRDIV0
	default 0x1

config MCG_VDIV0
	default 0x0

config MCG_FCRDIV
	default 2

config MCR20A_IS_PART_OF_KW2XD_SIP
	default y
	depends on IEEE802154_MCR20A

endif # BOARD_USB_KW24D512
```

## boards/nxp/usb_kw24d512/Kconfig.usb_kw24d512
```kconfig
# Copyright 2024 NXP
# SPDX-License-Identifier: Apache-2.0

config BOARD_USB_KW24D512
	select SOC_MKW24D5
	select SOC_PART_NUMBER_MKW24D512VHA5
```

## boards/nxp/usb_kw24d512/board.yml
```yaml
board:
  name: usb_kw24d512
  full_name: USB-KW24D512
  vendor: nxp
  socs:
    - name: mkw24d5
```

## boards/nxp/usb_kw24d512/usb_kw24d512_defconfig
```kconfig
# SPDX-License-Identifier: Apache-2.0

CONFIG_CONSOLE=y
CONFIG_RTT_CONSOLE=y
CONFIG_USE_SEGGER_RTT=y
CONFIG_SERIAL=y
CONFIG_GPIO=y
CONFIG_PINCTRL=y
CONFIG_SYS_CLOCK_HW_CYCLES_PER_SEC=48000000
CONFIG_OSC_EXTERNAL=y
```

## boards/nxp/vmu_rt1170/Kconfig.defconfig
```kconfig
# VMU_RT1170 board

# Copyright 2023 NXP
# SPDX-License-Identifier: Apache-2.0

if BOARD_VMU_RT1170

if DISK_DRIVERS

config IMX_USDHC_DAT3_PWR_TOGGLE
	default y

endif # DISK_DRIVERS

configdefault NET_L2_ETHERNET
	default y if CPU_CORTEX_M7 # No cache memory support is required for driver

configdefault ETH_NXP_ENET_RMII_EXT_CLK
	default y


config FLASH_MCUX_FLEXSPI_MX25UM51345G
	default y if FLASH
	imply FLASH_MCUX_FLEXSPI_NOR_WRITE_BUFFER

endif # BOARD_VMU_RT1170
```

## boards/nxp/vmu_rt1170/Kconfig.vmu_rt1170
```kconfig
# Copyright 2023 NXP
# SPDX-License-Identifier: Apache-2.0

config BOARD_VMU_RT1170
	select SOC_MIMXRT1176_CM7 if BOARD_VMU_RT1170_MIMXRT1176_CM7
	select SOC_PART_NUMBER_MIMXRT1176DVMAA
```

## boards/nxp/vmu_rt1170/board.yml
```yaml
board:
  name: vmu_rt1170
  full_name: MR-VMU-RT1176
  vendor: nxp
  socs:
    - name: mimxrt1176
```

## boards/nxp/vmu_rt1170/vmu_rt1170_mimxrt1176_cm4_defconfig
```kconfig
#
# Copyright 2026 NXP
# SPDX-License-Identifier: Apache-2.0
#

CONFIG_CONSOLE=y
CONFIG_UART_CONSOLE=y
CONFIG_SERIAL=y
CONFIG_GPIO=y

# CM4 core; keep minimal for hello_world.
```
