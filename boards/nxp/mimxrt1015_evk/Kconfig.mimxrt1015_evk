## boards/nxp/mimxrt1015_evk/Kconfig.mimxrt1015_evk
```kconfig
# Copyright (c) 2019, NXP
# SPDX-License-Identifier: Apache-2.0

config BOARD_MIMXRT1015_EVK
	select SOC_PART_NUMBER_MIMXRT1015DAF5A
```

## boards/nxp/mimxrt1015_evk/board.yml
```yaml
board:
  name: mimxrt1015_evk
  full_name: MIMXRT1015-EVK
  vendor: nxp
  socs:
    - name: mimxrt1015
```

## boards/nxp/mimxrt1020_evk/Kconfig.mimxrt1020_evk
```kconfig
# Copyright (c) 2018, NXP
# SPDX-License-Identifier: Apache-2.0

config BOARD_MIMXRT1020_EVK
	select SOC_PART_NUMBER_MIMXRT1021DAG5A
```

## boards/nxp/mimxrt1020_evk/board.yml
```yaml
board:
  name: mimxrt1020_evk
  full_name: MIMXRT1020-EVK
  vendor: nxp
  socs:
    - name: mimxrt1021
```

## boards/nxp/mimxrt1024_evk/Kconfig.defconfig
```kconfig
# MIMXRT1024-EVK board

# Copyright 2020,2023 NXP
# SPDX-License-Identifier: Apache-2.0

if BOARD_MIMXRT1024_EVK

config DEVICE_CONFIGURATION_DATA
	default y

config NXP_IMX_EXTERNAL_SDRAM
	default y

config I2C_MCUX_LPI2C_BUS_RECOVERY
	default y
	depends on I2C_MCUX_LPI2C && PINCTRL

configdefault NET_L2_ETHERNET
	default y

endif # BOARD_MIMXRT1024_EVK
```

## boards/nxp/mimxrt1024_evk/Kconfig.mimxrt1024_evk
```kconfig
# Copyright (c) 2020, NXP
# SPDX-License-Identifier: Apache-2.0

config BOARD_MIMXRT1024_EVK
	select SOC_PART_NUMBER_MIMXRT1024DAG5A
```

## boards/nxp/mimxrt1024_evk/board.yml
```yaml
board:
  name: mimxrt1024_evk
  full_name: MIMXRT1024-EVK
  vendor: nxp
  socs:
    - name: mimxrt1024
```

## boards/nxp/mimxrt1040_evk/Kconfig.defconfig
```kconfig
# Copyright 2023, NXP
# SPDX-License-Identifier: Apache-2.0

if BOARD_MIMXRT1040_EVK

config DEVICE_CONFIGURATION_DATA
	default y

config NXP_IMX_EXTERNAL_SDRAM
	default y

configdefault NET_L2_ETHERNET
	default y if DT_HAS_NXP_ENET_ENABLED

endif # BOARD_MIMXRT1040_EVK
```

## boards/nxp/mimxrt1040_evk/Kconfig.mimxrt1040_evk
```kconfig
# Copyright 2023, NXP
# SPDX-License-Identifier: Apache-2.0

config BOARD_MIMXRT1040_EVK
	select SOC_PART_NUMBER_MIMXRT1042XJM5B
```

## boards/nxp/mimxrt1040_evk/board.yml
```yaml
board:
  name: mimxrt1040_evk
  full_name: MIMXRT1040-EVK
  vendor: nxp
  socs:
    - name: mimxrt1042
```

## boards/nxp/mimxrt1050_evk/Kconfig.mimxrt1050_evk
```kconfig
# Copyright (c) 2017, NXP
# SPDX-License-Identifier: Apache-2.0

config BOARD_MIMXRT1050_EVK
	select SOC_PART_NUMBER_MIMXRT1052DVL6B
```

## boards/nxp/mimxrt1050_evk/board.yml
```yaml
board:
  name: mimxrt1050_evk
  full_name: MIMXRT1050-EVK
  vendor: nxp
  socs:
    - name: mimxrt1052
      variants:
        - name: hyperflash
        - name: qspi
```

## boards/nxp/mimxrt1060_evk/Kconfig.mimxrt1060_evkb
```kconfig
# Copyright 2024 NXP
# SPDX-License-Identifier: Apache-2.0

config BOARD_MIMXRT1060_EVKB
	select SOC_PART_NUMBER_MIMXRT1062DVL6A
```

## boards/nxp/mimxrt1060_evk/board.yml
```yaml
boards:
  - name: mimxrt1060_evk
    full_name: MIMXRT1060-EVK
    vendor: nxp
    socs:
      - name: mimxrt1062
        variants:
          - name: "qspi"
          - name: "hyperflash"
    revision:
      format: "letter"
      default: "C"
      revisions:
        - name: "A"
        - name: "B"
        - name: "C"
```

## boards/nxp/mimxrt1060_evk/mimxrt1060_evkb_defconfig
```kconfig
#
# Copyright (c) 2022, Whisper.ai
#
# SPDX-License-Identifier: Apache-2.0
#

CONFIG_CONSOLE=y
CONFIG_UART_CONSOLE=y
CONFIG_SERIAL=y
CONFIG_GPIO=y
CONFIG_ARM_MPU=y
CONFIG_HW_STACK_PROTECTION=y
CONFIG_PINCTRL=y
```

## boards/nxp/mimxrt1062_fmurt6/Kconfig.defconfig
```kconfig
# MIMXRT1062-FMURT6 board

# SPDX-License-Identifier: Apache-2.0
# Copyright 2023 NXP

if BOARD_MIMXRT1062_FMURT6

config DEVICE_CONFIGURATION_DATA
	default y

config NXP_IMX_EXTERNAL_SDRAM
	default y

configdefault NET_L2_ETHERNET
	default y


endif # BOARD_MIMXRT1062_FMURT6
```

## boards/nxp/mimxrt1062_fmurt6/Kconfig.mimxrt1062_fmurt6
```kconfig
# Copyright 2023 NXP
# SPDX-License-Identifier: Apache-2.0

config BOARD_MIMXRT1062_FMURT6
	select SOC_PART_NUMBER_MIMXRT1062DVL6A
```

## boards/nxp/mimxrt1062_fmurt6/board.yml
```yaml
board:
  name: mimxrt1062_fmurt6
  full_name: MIMXRT1062-FMURT6
  vendor: nxp
  socs:
    - name: mimxrt1062
```

## boards/nxp/mimxrt1062_fmurt6/mimxrt1062_fmurt6_defconfig
```kconfig
#
# SPDX-License-Identifier: Apache-2.0
#
# Copyright 2023 NXP
#

CONFIG_CONSOLE=y
CONFIG_UART_CONSOLE=y
CONFIG_SERIAL=y
CONFIG_GPIO=y
CONFIG_ARM_MPU=y
CONFIG_HW_STACK_PROTECTION=y
CONFIG_PINCTRL=y

# Enable Regulators
CONFIG_REGULATOR=y
CONFIG_REGULATOR_FIXED_INIT_PRIORITY=75
```

## boards/nxp/mimxrt1064_evk/Kconfig.defconfig
```kconfig
# MIMXRT1064-EVK board

# Copyright 2018,2023 NXP
# SPDX-License-Identifier: Apache-2.0

if BOARD_MIMXRT1064_EVK

config DEVICE_CONFIGURATION_DATA
	default y

config NXP_IMX_EXTERNAL_SDRAM
	default y

configdefault NET_L2_ETHERNET
	default y

endif # BOARD_MIMXRT1064_EVK
```

## boards/nxp/mimxrt1064_evk/Kconfig.mimxrt1064_evk
```kconfig
# Copyright (c) 2018, NXP
# SPDX-License-Identifier: Apache-2.0

config BOARD_MIMXRT1064_EVK
	select SOC_PART_NUMBER_MIMXRT1064DVL6A
```

## boards/nxp/mimxrt1064_evk/board.yml
```yaml
board:
  name: mimxrt1064_evk
  full_name: MIMXRT1064-EVK
  vendor: nxp
  socs:
    - name: mimxrt1064
```

## boards/nxp/mimxrt1160_evk/Kconfig.defconfig
```kconfig
# MIMXRT1160-EVK board

# Copyright 2021,2023-2024 NXP
# SPDX-License-Identifier: Apache-2.0

if BOARD_MIMXRT1160_EVK

# Only use DCD when booting primary core (M7)
config DEVICE_CONFIGURATION_DATA
	default y if CPU_CORTEX_M7

config NXP_IMX_EXTERNAL_SDRAM
	default y if CPU_CORTEX_M7

if SECOND_CORE_MCUX && BOARD_MIMXRT1160_EVK_MIMXRT1166_CM4

config BUILD_OUTPUT_INFO_HEADER
	default y

DT_CHOSEN_IMAGE_M4 = nxp,m4-partition

# Adjust the offset of the output image if building for RT11xx SOC
config BUILD_OUTPUT_ADJUST_LMA
	default "($(dt_chosen_reg_addr_hex,$(DT_CHOSEN_IMAGE_M4)) + \
	$(dt_node_reg_addr_hex,/soc/spi@400cc000,1)) - \
	$(dt_node_reg_addr_hex,/soc/ocram@20200000)"

endif

config SYS_CLOCK_HW_CYCLES_PER_SEC
	default 240000000 if BOARD_MIMXRT1160_EVK_MIMXRT1166_CM4 && CORTEX_M_SYSTICK
	default 600000000 if BOARD_MIMXRT1160_EVK_MIMXRT1166_CM7 && CORTEX_M_SYSTICK

if NETWORKING

config NET_L2_ETHERNET
	default y if CPU_CORTEX_M7 # No cache memory support is required for driver

endif # NETWORKING

endif # BOARD_MIMXRT1160_EVK
```

## boards/nxp/mimxrt1160_evk/Kconfig.mimxrt1160_evk
```kconfig
#
# Copyright 2024 NXP
#
# SPDX-License-Identifier: Apache-2.0
#

config BOARD_MIMXRT1160_EVK
	select SOC_PART_NUMBER_MIMXRT1166DVM6A
	select SOC_MIMXRT1166_CM7 if BOARD_MIMXRT1160_EVK_MIMXRT1166_CM7
	select SOC_MIMXRT1166_CM4 if BOARD_MIMXRT1160_EVK_MIMXRT1166_CM4
```

## boards/nxp/mimxrt1160_evk/board.yml
```yaml
board:
  name: mimxrt1160_evk
  full_name: MIMXRT1160-EVK
  vendor: nxp
  socs:
    - name: mimxrt1166
```
