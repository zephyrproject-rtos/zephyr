/*
 * SPDX-License-Identifier: Apache-2.0
 *
 * Copyright (c) 2023 Benjamin Björnsson <benjamin.bjornsson@gmail.com>
 */

/ {
	dma_test_edma0: dma-test-edma0 {
		compatible = "test-dma-memory-to-memory";
		dma = <&edma0>;
		channel-link;
		scatter-gather;
		max-transfer-size = <4096>;
	};
};

&edma0 {
	status = "okay";
};
