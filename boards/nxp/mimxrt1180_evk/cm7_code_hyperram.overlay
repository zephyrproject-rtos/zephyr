/*
 * Copyright 2025 NXP
 *
 * SPDX-License-Identifier: Apache-2.0
 */

/ {
	chosen {
		zephyr,flash = &hyperram0;
		zephyr,code-partition = &slot1_partition;
	};
};

&flexspi2 {
	status = "okay";
};

&hyperram0 {
	/*
	 * Currently, HyperRAM on this board must be accessed under XIP mode,
	 * so that the ROM bootloader can initialize it by reading the XMCD configuration.
	 * These XMCD configurations are stored in the default settings file
	 * `xip/evkmimxrt1180_flexspi_nor_config.c`. (If modifications are needed,
	 * please refer to the examples and the "System Boot" chapter in the
	 * RT1180 Reference Manual.)
	 * The CM33 core of the MIMXRT1180_EVK runs in XIP mode and uses the
	 * HyperRAM space as the RAM region by default. Therefore, the status of the
	 * full hyperram0 memory node is set to "okay" for cm33 core.
	 * At this point, the CM7 core can also access the HyperRAM.
	 * However, since the entire HyperRAM region is occupied in the CM33's DTS,
	 * users can allocate the HyperRAM reasonably so that both cores (CM33 and CM7)
	 * can use HyperRAM as their RAM region.
	 *
	 * If the HyperRAM is not initialized by the ROM bootloader, set
	 * 'status = "disabled"' here to prevent the MPU region from being created.
	 *
	 * Note: the MPU executable region for HyperRAM is created automatically by
	 * arm_mpu_regions.c because this node is selected as zephyr,flash above.
	 * No zephyr,memory-attr is needed on this node.
	 */
	status = "okay";
};
