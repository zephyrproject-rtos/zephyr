## boards/rak/rak4631/Kconfig
```kconfig
# RAKWIRELESS RAK4631 Board configuration

# Copyright (c) 2024 Kelly Helmut Lord
# SPDX-License-Identifier: Apache-2.0

if BOARD_RAK4631

config BOARD_ENABLE_DCDC
	bool "DCDC mode"
	select SOC_DCDC_NRF52X
	default y

config BOARD_ENABLE_DCDC_HV
	bool "High Voltage DCDC converter"
	select SOC_DCDC_NRF52X_HV
	default y

endif # BOARD_RAK4631
```

## boards/rak/rak5010/Kconfig.defconfig
```kconfig
# RAKWIRELESS RAK5010 Board configuration

# Copyright (c) 2020 Guillaume Paquet <guillaume.paquet@smile.fr>
# SPDX-License-Identifier: Apache-2.0

if BOARD_RAK5010

config BT_CTLR
	default BT

endif # BOARD_RAK5010
```

## boards/rak/rak5010/Kconfig.rak5010
```kconfig
# RAKWIRELESS RAK5010 selection

# Copyright (c) 2020 Guillaume Paquet <guillaume.paquet@smile.fr>
# SPDX-License-Identifier: Apache-2.0

config BOARD_RAK5010_NRF52840
	select SOC_NRF52840_QIAA
```

## boards/rakwireless/rak11160/Kconfig.rak11160
```kconfig
# Copyright (c) 2025 RAKwireless Technology Co., Ltd. <www.rakwireless.com>
# SPDX-License-Identifier: Apache-2.0

config BOARD_RAK11160
	select SOC_STM32WLE5XX
```

## boards/rakwireless/rak11160/board.yml
```yaml
board:
  name: rak11160
  full_name: RAK11160
  vendor: rakwireless
  socs:
  - name: stm32wle5xx
```

## boards/rakwireless/rak11161/Kconfig.defconfig
```kconfig
# Copyright (c) 2026 RAKwireless Technology Limited
# SPDX-License-Identifier: Apache-2.0

if BOARD_RAK11161

endif # BOARD_RAK11161

if BOARD_RAK11161_STM32WLE5XX

endif # BOARD_RAK11161_STM32WLE5XX

if BOARD_RAK11161_ESP32C2

config HEAP_MEM_POOL_SIZE
	default 4096

endif # BOARD_RAK11161_ESP32C2
```

## boards/rakwireless/rak11161/board.yml
```yaml
board:
  name: rak11161
  full_name: RAK11161 Breakout Board
  vendor: rakwireless
  socs:
  - name: stm32wle5xx
  - name: esp32c2
```

## boards/rakwireless/rak11162/Kconfig.defconfig
```kconfig
# Copyright (c) 2026 RAKwireless Technology Limited
# SPDX-License-Identifier: Apache-2.0

if BOARD_RAK11162

endif # BOARD_RAK11162

if BOARD_RAK11162_STM32WLE5XX

endif # BOARD_RAK11162_STM32WLE5XX

if BOARD_RAK11162_ESP32C2

config HEAP_MEM_POOL_SIZE
	default 4096

endif # BOARD_RAK11162_ESP32C2
```

## boards/rakwireless/rak11162/board.yml
```yaml
board:
  name: rak11162
  full_name: RAK11162 WisBlock Core Module
  vendor: rakwireless
  socs:
  - name: stm32wle5xx
  - name: esp32c2
```

## boards/rakwireless/rak11162/rak11162_stm32wle5xx_defconfig
```kconfig
# SPDX-License-Identifier: Apache-2.0

# Enable GPIO
CONFIG_GPIO=y

# Enable Clocks
CONFIG_CLOCK_CONTROL=y

# Enable MPU
CONFIG_ARM_MPU=y

# Enable HW stack protection
CONFIG_HW_STACK_PROTECTION=y

# Regulator
CONFIG_REGULATOR=y

# Required for board.c dynamic pinctrl (wisblock_init)
CONFIG_PINCTRL_DYNAMIC=y
CONFIG_PINCTRL_KEEP_SLEEP_STATE=y
```

## boards/rakwireless/rak11720/Kconfig.defconfig
```kconfig
# RAKWIRELESS RAK11720 Board configuration
# Copyright (c) 2024 RAKwireless Technology Co., Ltd. <www.rakwireless.com>
# Sercan Erat <sercanerat@gmail.com>
# SPDX-License-Identifier: Apache-2.0

if BOARD_RAK11720

config SYS_CLOCK_HW_CYCLES_PER_SEC
	default 32768 if AMBIQ_STIMER_TIMER

endif # BOARD_RAK11720
```

## boards/rakwireless/rak11720/Kconfig.rak11720
```kconfig
# Copyright (c) 2024 RAKwireless Technology Co., Ltd. <www.rakwireless.com>
# Sercan Erat <sercanerat@gmail.com>
# SPDX-License-Identifier: Apache-2.0

config BOARD_RAK11720
	select SOC_APOLLO3_BLUE
```

## boards/rakwireless/rak11720/board.yml
```yaml
board:
  name: rak11720
  full_name: RAK11720
  vendor: rakwireless
  socs:
  - name: apollo3_blue
```

## boards/rakwireless/rak11720/rak11720_defconfig
```kconfig
# Copyright (c) 2024 RAKwireless Technology Co., Ltd. <www.rakwireless.com>
# Sercan Erat <sercanerat@gmail.com>
# SPDX-License-Identifier: Apache-2.0

CONFIG_CONSOLE=y
CONFIG_UART_CONSOLE=y
CONFIG_SERIAL=y
CONFIG_UART_INTERRUPT_DRIVEN=y
```

## boards/rakwireless/rak11721/board.yml
```yaml
board:
  name: rak11721
  full_name: RAK11721 Breakout Board
  vendor: rakwireless
  socs:
  - name: apollo3_blue
```

## boards/rakwireless/rak11721/rak11721_defconfig
```kconfig
# Copyright (c) 2024 RAKwireless Technology Limited <www.rakwireless.com>
# Sercan Erat <sercanerat@gmail.com>
# JaeHwan Jin <jaehwan.jin@rakwireless.com>
# SPDX-License-Identifier: Apache-2.0

CONFIG_CONSOLE=y
CONFIG_UART_CONSOLE=y
CONFIG_SERIAL=y
CONFIG_UART_INTERRUPT_DRIVEN=y
```

## boards/rakwireless/rak11722/Kconfig.defconfig
```kconfig
# SPDX-License-Identifier: Apache-2.0
# Copyright (c) 2026 RAKwireless Technology Limited

if BOARD_RAK11722

config SYS_CLOCK_HW_CYCLES_PER_SEC
	default 32768 if AMBIQ_STIMER_TIMER

config WISBLOCK_CORE_BOARD_VENDOR
	string
	default "RAKwireless"

config WISBLOCK_CORE_BOARD_NAME
	string
	default "RAK11722 WisBlock LPWAN Module"

endif # BOARD_RAK11722
```

## boards/rakwireless/rak11722/Kconfig.rak11722
```kconfig
# SPDX-License-Identifier: Apache-2.0
# Copyright (c) 2026 RAKwireless Technology Limited

config BOARD_RAK11722
	select SOC_APOLLO3_BLUE
```

## boards/rakwireless/rak11722/rak11722_defconfig
```kconfig
# SPDX-License-Identifier: Apache-2.0
# Copyright (c) 2026 RAKwireless Technology Limited

CONFIG_PINCTRL_DYNAMIC=y
CONFIG_PINCTRL_KEEP_SLEEP_STATE=y
```

## boards/rakwireless/rak3112/Kconfig
```kconfig
# Copyright (c) 2025 Kenneth Lu
# SPDX-License-Identifier: Apache-2.0

config HEAP_MEM_POOL_ADD_SIZE_BOARD
	int
	default 4096 if BOARD_RAK3112_ESP32S3_PROCPU
	default 256 if BOARD_RAK3112_ESP32S3_APPCPU
```

## boards/rakwireless/rak3112/Kconfig.defconfig
```kconfig
# Copyright (c) 2025 Kenneth Lu
# SPDX-License-Identifier: Apache-2.0

if BOARD_RAK3112_ESP32S3_PROCPU

config KERNEL_MEM_POOL
	default y

endif # BOARD_RAK3112_ESP32S3_PROCPU
```

## boards/rakwireless/rak3112/Kconfig.rak3112
```kconfig
# Copyright (c) 2025 Kenneth Lu
# SPDX-License-Identifier: Apache-2.0

config BOARD_RAK3112
	select SOC_ESP32S3_R2
	select SOC_ESP32S3_PROCPU if BOARD_RAK3112_ESP32S3_PROCPU
	select SOC_ESP32S3_APPCPU if BOARD_RAK3112_ESP32S3_APPCPU
```
