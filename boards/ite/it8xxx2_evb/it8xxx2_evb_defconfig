## boards/ite/it8xxx2_evb/it8xxx2_evb_defconfig
```kconfig
# Copyright (c) 2020 ITE Corporation. All Rights Reserved.
# SPDX-License-Identifier: Apache-2.0

CONFIG_BOOT_DELAY=1

CONFIG_GEN_IRQ_VECTOR_TABLE=n
CONFIG_CONSOLE=y
CONFIG_SERIAL=y
CONFIG_UART_INTERRUPT_DRIVEN=y
CONFIG_UART_CONSOLE=y

CONFIG_SYS_CLOCK_HW_CYCLES_PER_SEC=32768

CONFIG_XIP=y
CONFIG_INIT_STACKS=y
CONFIG_LINKER_ORPHAN_SECTION_PLACE=y
CONFIG_COMPILER_OPT="-mcmodel=medlow"
CONFIG_GPIO=y
```

## boards/jhoinrch/rh02/board.yml
```yaml
# SPDX-FileCopyrightText: Copyright The Zephyr Project Contributors
# SPDX-License-Identifier: Apache-2.0

board:
  name: rh02
  full_name: RH02
  vendor: jhoinrch
  socs:
    - name: stm32f072xb
```

## boards/jhoinrch/rh02_plus_2026/Kconfig.rh02_plus_2026
```kconfig
# SPDX-FileCopyrightText: Copyright The Zephyr Project Contributors
# SPDX-License-Identifier: Apache-2.0

config BOARD_RH02_PLUS_2026
	select SOC_STM32G431XX
```

## boards/jhoinrch/rh02_plus_2026/board.yml
```yaml
board:
  name: rh02_plus_2026
  full_name: RH02 Plus (2026)
  vendor: jhoinrch
  socs:
    - name: stm32g431xx
```

## boards/jlc/skystar_gd32f407vet6/Kconfig.skystar_gd32f407vet6
```kconfig
# Copyright (c) 2025, Liu Changjie <liucj1228@outlook.com>
# SPDX-License-Identifier: Apache-2.0

config BOARD_SKYSTAR_GD32F407VET6
	select SOC_GD32F407
```

## boards/jlc/skystar_gd32f407vet6/board.yml
```yaml
board:
  name: skystar_gd32f407vet6
  full_name: SkyStar GD32F407VET6
  vendor: jlc
  socs:
    - name: gd32f407
```

## boards/jlc/skystar_hc32f4a0pitb/Kconfig.skystar_hc32f4a0pitb
```kconfig
# Copyright (c) 2026 Liu Changjie <liucj1228@outlook.com>
# SPDX-License-Identifier: Apache-2.0

config BOARD_SKYSTAR_HC32F4A0PITB
	select SOC_HC32F4A0
```

## boards/jlc/skystar_hc32f4a0pitb/board.yml
```yaml
board:
  name: skystar_hc32f4a0pitb
  full_name: SkyStar HC32F4A0PITB
  vendor: jlc
  socs:
    - name: hc32f4a0
```

## boards/jlc/skystar_stm32f407vet6/Kconfig.skystar_stm32f407vet6
```kconfig
# Copyright (c) 2026, Liu Changjie <liucj1228@outlook.com>
# SPDX-License-Identifier: Apache-2.0

config BOARD_SKYSTAR_STM32F407VET6
	select SOC_STM32F407XE
```

## boards/jlc/skystar_stm32f407vet6/board.yml
```yaml
board:
  name: skystar_stm32f407vet6
  full_name: SkyStar STM32F407VET6
  vendor: jlc
  socs:
    - name: stm32f407xx
```

## boards/kaga-fei/ec4l15ba1/Kconfig
```kconfig
# EC4L15BA1 board configuration

# Copyright (c) 2024 Nordic Semiconductor ASA
# Copyright (c) 2025 KAGA FEI Co., Ltd.
# SPDX-License-Identifier: Apache-2.0

if BOARD_EC4L15BA1_NRF54L15_CPUAPP_NS

config NRF_MPC_REGION_SIZE
	hex
	default 0x1000
	help
	  Region size for the Memory Protection Controller (MPC) in bytes.

config NRF_TRUSTZONE_FLASH_REGION_SIZE
	hex
	default NRF_MPC_REGION_SIZE
	help
	  This defines the flash region size from the TRUSTZONE perspective.
	  It is used when configuring the TRUSTZONE and when setting alignments
	  requirements for the partitions.
	  This abstraction allows us to configure TRUSTZONE without depending
	  on peripheral specific symbols.

config NRF_TRUSTZONE_RAM_REGION_SIZE
	hex
	default NRF_MPC_REGION_SIZE
	help
	  This defines the RAM region size from the TRUSTZONE perspective.
	  It is used when configuring the TRUSTZONE and when setting alignments
	  requirements for the partitions.
	  This abstraction allows us to configure TRUSTZONE without depending
	  on peripheral specific symbols.

endif #BOARD_EC4L15BA1_NRF54L15_CPUAPP_NS
```

## boards/kaga-fei/ec4l15ba1/Kconfig.defconfig
```kconfig
# Copyright (c) 2024 Nordic Semiconductor ASA
# Copyright (c) 2025 KAGA FEI Co., Ltd.
# SPDX-License-Identifier: Apache-2.0

config HW_STACK_PROTECTION
	default ARCH_HAS_STACK_PROTECTION

if BOARD_EC4L15BA1_NRF54L15_CPUAPP_NS

config BOARD_EC4L15BA1
	select USE_DT_CODE_PARTITION if BOARD_EC4L15BA1_NRF54L15_CPUAPP_NS

config HAS_BT_CTLR
	default BT

# By default, if we build for a Non-Secure version of the board,
# enable building with TF-M as the Secure Execution Environment.
config BUILD_WITH_TFM
	default y

endif #BOARD_EC4L15BA1_NRF54L15_CPUAPP_NS
```

## boards/kaga-fei/ec4l15ba1/Kconfig.ec4l15ba1
```kconfig
# Copyright (c) 2024 Nordic Semiconductor ASA
# Copyright (c) 2025 KAGA FEI Co., Ltd.
# SPDX-License-Identifier: Apache-2.0

config BOARD_EC4L15BA1
	select SOC_NRF54L15_CPUAPP if BOARD_EC4L15BA1_NRF54L15_CPUAPP || BOARD_EC4L15BA1_NRF54L15_CPUAPP_NS
	select SOC_NRF54L15_CPUFLPR if BOARD_EC4L15BA1_NRF54L15_CPUFLPR || \
					BOARD_EC4L15BA1_NRF54L15_CPUFLPR_XIP
```

## boards/kaga-fei/ec4l15ba1/board.yml
```yaml
board:
  name: ec4l15ba1
  full_name: EC4L15BA1-EVB
  vendor: kaga-fei
  socs:
  - name: nrf54l15
    variants:
    - name: xip
      cpucluster: cpuflpr
    - name: ns
      cpucluster: cpuapp
```

## boards/khadas/edge2/Kconfig.khadas_edge2
```kconfig
# Copyright 2024 Université Gustave Eiffel
# SPDX-License-Identifier: Apache-2.0

config BOARD_KHADAS_EDGE2
	select SOC_RK3588S
```

## boards/khadas/edge2/board.yml
```yaml
board:
  name: khadas_edge2
  full_name: Edge2
  vendor: khadas
  socs:
  - name: rk3588s
```

## boards/khadas/edgev/Kconfig.khadas_edgev
```kconfig
#
# Copyright 2022 Huawei France Technologies SASU
# SPDX-License-Identifier: Apache-2.0
#

config BOARD_KHADAS_EDGEV
	select SOC_RK3399
```

## boards/khadas/edgev/board.yml
```yaml
board:
  name: khadas_edgev
  full_name: Edge-V
  vendor: khadas
  socs:
  - name: rk3399
```

## boards/kincony/kincony_kc868_a32/Kconfig.defconfig
```kconfig
# Copyright (c) 2023 Bartosz Bilas
# SPDX-License-Identifier: Apache-2.0

if BOARD_KINCONY_KC868_A32_ESP32_PROCPU

config HEAP_MEM_POOL_ADD_SIZE_BOARD
	int
	default $(UINT16_MAX) if WIFI && BT
	default 51200 if WIFI
	default 40960 if BT
	default 4096

endif # BOARD_KINCONY_KC868_A32_ESP32_PROCPU

if BOARD_KINCONY_KC868_A32_ESP32_APPCPU

config HEAP_MEM_POOL_ADD_SIZE_BOARD
	default 256

endif # BOARD_KINCONY_KC868_A32_ESP32_APPCPU
```

## boards/kincony/kincony_kc868_a32/Kconfig.kincony_kc868_a32
```kconfig
# Copyright (c) 2023 Bartosz Bilas
# SPDX-License-Identifier: Apache-2.0

config BOARD_KINCONY_KC868_A32
	select SOC_ESP32_WROOM_32UE_N4
	select SOC_ESP32_PROCPU if BOARD_KINCONY_KC868_A32_ESP32_PROCPU
	select SOC_ESP32_APPCPU if BOARD_KINCONY_KC868_A32_ESP32_APPCPU
```

## boards/kincony/kincony_kc868_a32/Kconfig.sysbuild
```kconfig
# Copyright (c) Bartosz Bilas
# SPDX-License-Identifier: Apache-2.0

choice BOOTLOADER
	default BOOTLOADER_MCUBOOT
endchoice

choice BOOT_SIGNATURE_TYPE
	default BOOT_SIGNATURE_TYPE_NONE
endchoice
```

## boards/kincony/kincony_kc868_a32/board.yml
```yaml
board:
  name: kincony_kc868_a32
  full_name: KC868-A32
  vendor: kincony
  socs:
  - name: esp32
```

## boards/kincony/kincony_kc868_a8/Kconfig
```kconfig
# Copyright (c) 2026 Bartosz Bilas
# SPDX-License-Identifier: Apache-2.0

config HEAP_MEM_POOL_ADD_SIZE_BOARD
	int
	default 4096 if BOARD_KINCONY_KC868_A8_ESP32_PROCPU
	default 256 if BOARD_KINCONY_KC868_A8_ESP32_APPCPU
```
