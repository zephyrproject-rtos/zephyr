## boards/lilygo/ttgo_t8s3/Kconfig
```kconfig
# Copyright (c) 2024 Lothar Felten <lothar.felten@gmail.com>
# SPDX-License-Identifier: Apache-2.0

config HEAP_MEM_POOL_ADD_SIZE_BOARD
	int
	default 4096 if BOARD_TTGO_T8S3_ESP32S3_PROCPU
	default 256 if BOARD_TTGO_T8S3_ESP32S3_APPCPU
```

## boards/lilygo/ttgo_t8s3/Kconfig.ttgo_t8s3
```kconfig
# Copyright 2024 Lothar Felten <lothar.felten@gmail.com>
# SPDX-License-Identifier: Apache-2.0

config BOARD_TTGO_T8S3
	select SOC_ESP32S3_WROOM_N16R8
	select SOC_ESP32S3_PROCPU if BOARD_TTGO_T8S3_ESP32S3_PROCPU
	select SOC_ESP32S3_APPCPU if BOARD_TTGO_T8S3_ESP32S3_APPCPU
```

## boards/lilygo/ttgo_t8s3/board.yml
```yaml
board:
  name: ttgo_t8s3
  full_name: TTGO T8-S3
  vendor: lilygo
  socs:
  - name: esp32s3
```

## boards/lilygo/ttgo_tbeam/Kconfig
```kconfig
# Copyright (c) 2024 Espressif Systems (Shanghai) Co., Ltd.
# SPDX-License-Identifier: Apache-2.0

config HEAP_MEM_POOL_ADD_SIZE_BOARD
	int
	default 4096 if BOARD_TTGO_TBEAM_ESP32_PROCPU
	default 256 if BOARD_TTGO_TBEAM_ESP32_APPCPU

config GNSS_INIT_PRIORITY
	default 87

config MFD
	default y if !MCUBOOT

config REGULATOR
	default y if !MCUBOOT
```

## boards/lilygo/ttgo_tbeam/Kconfig.ttgo_tbeam
```kconfig
# Copyright (c) 2024 Lothar Felten <lothar.felten@gmail.com>
# SPDX-License-Identifier: Apache-2.0

config BOARD_TTGO_TBEAM
	select SOC_ESP32_PICO_D4
	select SOC_ESP32_PROCPU if BOARD_TTGO_TBEAM_ESP32_PROCPU
	select SOC_ESP32_APPCPU if BOARD_TTGO_TBEAM_ESP32_APPCPU
```

## boards/lilygo/ttgo_tbeam/board.yml
```yaml
board:
  name: ttgo_tbeam
  full_name: TTGO TBeam
  vendor: lilygo
  socs:
  - name: esp32
```

## boards/lilygo/ttgo_toiplus/Kconfig.ttgo_toiplus
```kconfig
# Copyright 2025 aisuneko icecat <iceneko@protonmail.ch>
# SPDX-License-Identifier: Apache-2.0

config BOARD_TTGO_TOIPLUS
	select SOC_ESP32C3_FN4
```

## boards/lilygo/ttgo_toiplus/board.yml
```yaml
board:
  name: ttgo_toiplus
  full_name: TTGO T-OI-PLUS
  vendor: lilygo
  socs:
  - name: esp32c3
```

## boards/lilygo/twatch_s3/Kconfig.sysbuild
```kconfig
# Copyright (c) 2025 BayLibre SAS
# SPDX-License-Identifier: Apache-2.0

choice BOOTLOADER
	default BOOTLOADER_MCUBOOT
endchoice

choice BOOT_SIGNATURE_TYPE
	default BOOT_SIGNATURE_TYPE_NONE
endchoice
```

## boards/lilygo/twatch_s3/Kconfig.twatch_s3
```kconfig
# Copyright 2025 BayLibre SAS
# SPDX-License-Identifier: Apache-2.0

config BOARD_TWATCH_S3
	select SOC_ESP32S3_WROOM_N16R8
	select SOC_ESP32S3_PROCPU if BOARD_TWATCH_S3_ESP32S3_PROCPU
	select SOC_ESP32S3_APPCPU if BOARD_TWATCH_S3_ESP32S3_APPCPU
```

## boards/lilygo/twatch_s3/board.yml
```yaml
board:
  name: twatch_s3
  full_name: T-Watch S3
  vendor: lilygo
  socs:
  - name: esp32s3
```

## boards/longan/canbed_rp2040/Kconfig.canbed_rp2040
```kconfig
# Copyright (c) 2026 Jonas Berg
# SPDX-License-Identifier: Apache-2.0

config BOARD_CANBED_RP2040
	select SOC_RP2040
```

## boards/longan/canbed_rp2040/board.yml
```yaml
board:
  name: canbed_rp2040
  full_name: CANBed RP2040
  vendor: longan
  socs:
  - name: rp2040
```

## boards/lowrisc/opentitan_earlgrey/Kconfig.opentitan_earlgrey
```kconfig
# Copyright (c) 2023 by Rivos Inc.
# SPDX-License-Identifier: Apache-2.0

config BOARD_OPENTITAN_EARLGREY
	select SOC_OPENTITAN
```

## boards/lowrisc/opentitan_earlgrey/opentitan_earlgrey_defconfig
```kconfig
# Copyright (c) 2023 by Rivos Inc.
# SPDX-License-Identifier: Apache-2.0

CONFIG_XIP=y
CONFIG_SERIAL=y
CONFIG_CONSOLE=y
CONFIG_UART_CONSOLE=y
CONFIG_BUILD_OUTPUT_BIN=n
```

## boards/luatos/esp32c3_luatos_core/Kconfig.defconfig
```kconfig
# ESP32C3 core board configuration

# Copyright (c) 2023 YuLong Yao<feilongphone@gmail.com>
# SPDX-License-Identifier: Apache-2.0

config HEAP_MEM_POOL_ADD_SIZE_BOARD
	int
	default 8192
```

## boards/luatos/esp32c3_luatos_core/board.yml
```yaml
board:
  name: esp32c3_luatos_core
  full_name: ESP32C3_LUATOS_CORE
  vendor: luatos
  socs:
  - name: esp32c3
    variants:
    - name: usb
```

## boards/luatos/esp32s3_luatos_core/Kconfig
```kconfig
# Copyright (c) 2024 Espressif Systems (Shanghai) Co., Ltd.
# SPDX-License-Identifier: Apache-2.0

config HEAP_MEM_POOL_ADD_SIZE_BOARD
	int
	default 4096 if BOARD_ESP32S3_LUATOS_CORE_ESP32S3_PROCPU || BOARD_ESP32S3_LUATOS_CORE_ESP32S3_PROCPU_USB
	default 256 if BOARD_ESP32S3_LUATOS_CORE_ESP32S3_APPCPU || BOARD_ESP32S3_LUATOS_CORE_ESP32S3_APPCPU_USB
```

## boards/luatos/esp32s3_luatos_core/Kconfig.defconfig
```kconfig
# ESP32S3 Core board configuration

# Copyright (c) 2023 YuLong Yao <feilongphone@gmail.com>
# SPDX-License-Identifier: Apache-2.0

if BOARD_ESP32S3_LUATOS_CORE_ESP32S3_PROCPU || BOARD_ESP32S3_LUATOS_CORE_ESP32S3_PROCPU_USB

config HEAP_MEM_POOL_ADD_SIZE_BOARD
	int
	default 65535 if WIFI && BT
	default 51200 if WIFI
	default 40960 if BT
	default 4096

endif # BOARD_ESP32S3_LUATOS_CORE_ESP32S3_PROCPU || BOARD_ESP32S3_LUATOS_CORE_ESP32S3_PROCPU_USB

if BOARD_ESP32S3_LUATOS_CORE_ESP32S3_APPCPU || BOARD_ESP32S3_LUATOS_CORE_ESP32S3_APPCPU_USB

config HEAP_MEM_POOL_ADD_SIZE_BOARD
	default 256

endif # BOARD_ESP32S3_LUATOS_CORE_ESP32S3_APPCPU || BOARD_ESP32S3_LUATOS_CORE_ESP32S3_APPCPU_USB
```

## boards/luatos/esp32s3_luatos_core/Kconfig.esp32s3_luatos_core
```kconfig
# Copyright (c) 2023 YuLong Yao <feilongphone@gmail.com>
# SPDX-License-Identifier: Apache-2.0

config BOARD_ESP32S3_LUATOS_CORE
	select SOC_ESP32S3_MINI_N8
	select SOC_ESP32S3_PROCPU if BOARD_ESP32S3_LUATOS_CORE_ESP32S3_PROCPU || BOARD_ESP32S3_LUATOS_CORE_ESP32S3_PROCPU_USB
	select SOC_ESP32S3_APPCPU if BOARD_ESP32S3_LUATOS_CORE_ESP32S3_APPCPU || BOARD_ESP32S3_LUATOS_CORE_ESP32S3_APPCPU_USB
```

## boards/luatos/esp32s3_luatos_core/board.yml
```yaml
board:
  name: esp32s3_luatos_core
  full_name: ESP32S3-Luatos-Core
  vendor: luatos
  socs:
  - name: esp32s3
    variants:
    - name: usb
      cpucluster: procpu
    - name: usb
      cpucluster: appcpu
```

## boards/luckfox/pico_ultra/Kconfig.pico_ultra
```kconfig
# Copyright 2026 Patryk Koscik
# SPDX-License-Identifier: Apache-2.0

config BOARD_PICO_ULTRA
	select SOC_RV1106
```

## boards/luckfox/pico_ultra/board.yml
```yaml
board:
  name: pico_ultra
  full_name: Pico Ultra
  vendor: luckfox
  socs:
  - name: rv1106
```

## boards/m5stack/m5stack_atom_lite/Kconfig.defconfig
```kconfig
# M5Stack ATOM Lite board configuration
# Copyright (c) 2023 Benjamin Cabé <benjamin@zephyrproject.org>
# Copyright (c) 2022 AVSystem Sławomir Wolf Sp.j. (AVSystem)
# SPDX-License-Identifier: Apache-2.0

if BOARD_M5STACK_ATOM_LITE_ESP32_PROCPU

config HEAP_MEM_POOL_ADD_SIZE_BOARD
	int
	default 65535 if WIFI && BT
	default 51200 if WIFI
	default 40960 if BT
	default 4096

endif # BOARD_M5STACK_ATOM_LITE_ESP32_PROCPU

if BOARD_M5STACK_ATOM_LITE_ESP32_APPCPU

config HEAP_MEM_POOL_ADD_SIZE_BOARD
	default 256

endif # BOARD_M5STACK_ATOM_LITE_ESP32_APPCPU
```

## boards/m5stack/m5stack_atom_lite/Kconfig.m5stack_atom_lite
```kconfig
# M5Stack Atom Lite board configuration

# Copyright (c) 2024 Nikola Trifunovic <nikola@trifunovic.at>
# Copyright (c) 2022 AVSystem Sławomir Wolf Sp.j. (AVSystem)
# SPDX-License-Identifier: Apache-2.0

config BOARD_M5STACK_ATOM_LITE
	select SOC_ESP32_PICO_D4
	select SOC_ESP32_PROCPU if BOARD_M5STACK_ATOM_LITE_ESP32_PROCPU
	select SOC_ESP32_APPCPU if BOARD_M5STACK_ATOM_LITE_ESP32_APPCPU
```
