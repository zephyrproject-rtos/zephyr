## boards/lilygo/t_deck/Kconfig.t_deck
```kconfig
# SPDX-FileCopyrightText: Copyright The Zephyr Project Contributors
# SPDX-License-Identifier: Apache-2.0

config BOARD_T_DECK
	bool "LilyGO T-Deck"
	select SOC_ESP32S3_WROOM_N16R8
	select SOC_ESP32S3_PROCPU if BOARD_T_DECK_ESP32S3_PROCPU
	select SOC_ESP32S3_APPCPU if BOARD_T_DECK_ESP32S3_APPCPU
```

## boards/lilygo/t_deck/board.yml
```yaml
# SPDX-FileCopyrightText: Copyright The Zephyr Project Contributors
# SPDX-License-Identifier: Apache-2.0

board:
  name: t_deck
  full_name: LilyGO T-Deck / T-Deck Plus
  vendor: lilygo
  revision:
    format: custom
    default: standard
    revisions:
    - name: standard
    - name: plus
  socs:
  - name: esp32s3
```

## boards/lilygo/t_deck/t_deck_appcpu_defconfig
```kconfig
# SPDX-FileCopyrightText: Copyright The Zephyr Project Contributors
# SPDX-License-Identifier: Apache-2.0

CONFIG_CLOCK_CONTROL=y
```

## boards/lilygo/t_deck/t_deck_procpu_defconfig
```kconfig
# SPDX-FileCopyrightText: Copyright The Zephyr Project Contributors
# SPDX-License-Identifier: Apache-2.0

CONFIG_CONSOLE=y
CONFIG_SERIAL=y
CONFIG_UART_INTERRUPT_DRIVEN=y
CONFIG_UART_CONSOLE=y
CONFIG_GPIO=y
CONFIG_CLOCK_CONTROL=y

CONFIG_POWER_DOMAIN=y
CONFIG_POWER_DOMAIN_GPIO=y
CONFIG_POWER_DOMAIN_GPIO_INIT_PRIORITY=45
```

## boards/lilygo/tdongle_s3/Kconfig
```kconfig
# Copyright (c) 2025 Stefan Golinschi <stefan.golinschi@gmail.com>
# SPDX-License-Identifier: Apache-2.0

config HEAP_MEM_POOL_ADD_SIZE_BOARD
	int
	default 4096 if BOARD_TDONGLE_S3_ESP32S3_PROCPU
	default 256 if BOARD_TDONGLE_S3_ESP32S3_APPCPU
```

## boards/lilygo/tdongle_s3/Kconfig.sysbuild
```kconfig
# Copyright (c) 2025 Stefan Golinschi <stefan.golinschi@gmail.com>
# SPDX-License-Identifier: Apache-2.0

choice BOOTLOADER
	default BOOTLOADER_MCUBOOT
endchoice

choice BOOT_SIGNATURE_TYPE
	default BOOT_SIGNATURE_TYPE_NONE
endchoice
```

## boards/lilygo/tdongle_s3/Kconfig.tdongle_s3
```kconfig
# Copyright (c) 2025 Stefan Golinschi <stefan.golinschi@gmail.com>
# SPDX-License-Identifier: Apache-2.0

config BOARD_TDONGLE_S3
	select SOC_ESP32S3_WROOM_N16R8
	select SOC_ESP32S3_PROCPU if BOARD_TDONGLE_S3_ESP32S3_PROCPU
	select SOC_ESP32S3_APPCPU if BOARD_TDONGLE_S3_ESP32S3_APPCPU
```

## boards/lilygo/tdongle_s3/board.yml
```yaml
board:
  name: tdongle_s3
  full_name: T-Dongle S3
  vendor: lilygo
  socs:
  - name: esp32s3
```

## boards/lilygo/tdongle_s3/tdongle_s3_appcpu_defconfig
```kconfig
# Copyright (c) 2025 Stefan Golinschi <stefan.golinschi@gmail.com>
# SPDX-License-Identifier: Apache-2.0

CONFIG_CLOCK_CONTROL=y
```

## boards/lilygo/tdongle_s3/tdongle_s3_procpu_defconfig
```kconfig
# Copyright (c) 2025 Stefan Golinschi <stefan.golinschi@gmail.com>
# SPDX-License-Identifier: Apache-2.0

CONFIG_CONSOLE=y
CONFIG_SERIAL=y
CONFIG_UART_CONSOLE=y
CONFIG_GPIO=y
CONFIG_CLOCK_CONTROL=y
```

## boards/lilygo/ttgo_lora32/Kconfig
```kconfig
# Copyright (c) 2024 Espressif Systems (Shanghai) Co., Ltd.
# SPDX-License-Identifier: Apache-2.0

config BOARD_TTGO_LORA32
	select SOC_ESP32_PROCPU if BOARD_TTGO_LORA32_ESP32_PROCPU
	select SOC_ESP32_APPCPU if BOARD_TTGO_LORA32_ESP32_APPCPU
```

## boards/lilygo/ttgo_lora32/Kconfig.board
```kconfig
# Lilygo ttgo LoRa32 board configuration

# Copyright (c) 2024 Lothar Felten <lothar.felten@gmail.com>
# SPDX-License-Identifier: Apache-2.0

config BOARD_LILYGO_TTGO_LORA32
	bool "Lilygo ttgo LoRa32 Development Board"
	depends on SOC_SERIES_ESP32

choice SOC_PART_NUMBER
	default SOC_ESP32_PICO_D4
endchoice
```

## boards/lilygo/ttgo_lora32/Kconfig.defconfig
```kconfig
# Lilygo ttgo LoRa32 board configuration

# Copyright (c) 2024 Lothar Felten <lothar.felten@gmail.com>
# SPDX-License-Identifier: Apache-2.0

if BOARD_TTGO_LORA32_ESP32_PROCPU

config ENTROPY_GENERATOR
	default y

endif # BOARD_TTGO_LORA32_ESP32_PROCPU
```

## boards/lilygo/ttgo_lora32/Kconfig.ttgo_lora32
```kconfig
# TTGO LoRa32 board configuration

# Copyright (c) 2024 Lothar Felten <lothar.felten@gmail.com>
# SPDX-License-Identifier: Apache-2.0

config BOARD_TTGO_LORA32
	select SOC_ESP32_PICO_D4
```

## boards/lilygo/ttgo_lora32/board.yml
```yaml
board:
  name: ttgo_lora32
  full_name: TTGO LoRa32
  vendor: lilygo
  socs:
  - name: esp32
```

## boards/lilygo/ttgo_lora32/ttgo_lora32_esp32_procpu_defconfig
```kconfig
# SPDX-License-Identifier: Apache-2.0

CONFIG_MAIN_STACK_SIZE=2048

CONFIG_CONSOLE=y
CONFIG_SERIAL=y
CONFIG_UART_CONSOLE=y

CONFIG_GPIO=y
CONFIG_I2C=y

# the following config is required to support chips of revision 1
CONFIG_ESP32_USE_UNSUPPORTED_REVISION=y
```

## boards/lilygo/ttgo_t3stm32/Kconfig.ttgo_t3stm32
```kconfig
# Copyright 2025 Lothar Felten <lothar.felten@gmail.com>
# SPDX-License-Identifier: Apache-2.0

config BOARD_TTGO_T3STM32
	select SOC_STM32WL55XX
```

## boards/lilygo/ttgo_t3stm32/board.yml
```yaml
board:
  name: ttgo_t3stm32
  full_name: TTGO T3-STM32
  vendor: lilygo
  socs:
    - name: stm32wl55xx
```

## boards/lilygo/ttgo_t7v1_5/Kconfig
```kconfig
# Copyright 2024 Tobias Kässer <t.kaesser@gmail.com>
# SPDX-License-Identifier: Apache-2.0

config HEAP_MEM_POOL_ADD_SIZE_BOARD
	int
	default 4096 if BOARD_TTGO_T7V1_5_ESP32_PROCPU
	default 256 if BOARD_TTGO_T7V1_5_ESP32_APPCPU
```

## boards/lilygo/ttgo_t7v1_5/Kconfig.ttgo_t7v1_5
```kconfig
# Copyright 2024 Tobias Kässer <t.kaesser@gmail.com>
# SPDX-License-Identifier: Apache-2.0

config BOARD_TTGO_T7V1_5
	select SOC_ESP32
	select SOC_ESP32_PROCPU if BOARD_TTGO_T7V1_5_ESP32_PROCPU
	select SOC_ESP32_APPCPU if BOARD_TTGO_T7V1_5_ESP32_APPCPU
```

## boards/lilygo/ttgo_t7v1_5/board.yml
```yaml
board:
  name: ttgo_t7v1_5
  full_name: TTGO T7 Mini32 V1.5
  vendor: lilygo
  socs:
  - name: esp32
```

## boards/lilygo/ttgo_t8c3/Kconfig.defconfig
```kconfig
# Copyright (c) 2024 Lothar Felten <lothar.felten@gmail.com>
# SPDX-License-Identifier: Apache-2.0

config HEAP_MEM_POOL_ADD_SIZE_BOARD
	int
	default 8192
```

## boards/lilygo/ttgo_t8c3/Kconfig.ttgo_t8c3
```kconfig
# Copyright 2024 Lothar Felten <lothar.felten@gmail.com>
# SPDX-License-Identifier: Apache-2.0

config BOARD_TTGO_T8C3
	select SOC_ESP32C3_FN4
```

## boards/lilygo/ttgo_t8c3/board.yml
```yaml
board:
  name: ttgo_t8c3
  full_name: TTGO T8-C3
  vendor: lilygo
  socs:
  - name: esp32c3
```
