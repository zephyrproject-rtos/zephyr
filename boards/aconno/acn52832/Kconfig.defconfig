## boards/aconno/acn52832/Kconfig.defconfig
```kconfig
# aconno acn52832 board configuration

# Copyright (c) 2023 Sven Herrmann <sven.herrmann@posteo.de>
# SPDX-License-Identifier: Apache-2.0

if BOARD_ACN52832

config BT_CTLR
	default BT

endif # BOARD_ACN52832
```

## boards/aconno/acn52832/board.yml
```yaml
board:
  name: acn52832
  full_name: acn52832
  vendor: aconno
  socs:
  - name: nrf52832
```

## boards/acrn/acrn/Kconfig
```kconfig
# Copyright (c) 2019-2025 Intel Corporation
#
# SPDX-License-Identifier: Apache-2.0

config ACRN_COMMON
	bool
	default y if BOARD_ACRN || BOARD_ACRN_EHL_CRB || BOARD_ACRN_ADL_CRB
	select CPU_HAS_FPU
	select X86_64
```

## boards/acrn/acrn/Kconfig.acrn
```kconfig
# Copyright (c) 2019-2024 Intel Corporation
#
# SPDX-License-Identifier: Apache-2.0

config BOARD_ACRN
	select SOC_ATOM
```

## boards/acrn/acrn/Kconfig.acrn_adl_crb
```kconfig
# Copyright (c) 2025 Intel Corporation
#
# SPDX-License-Identifier: Apache-2.0

config BOARD_ACRN_ADL_CRB
	select SOC_ATOM
```

## boards/acrn/acrn/Kconfig.acrn_ehl_crb
```kconfig
# Copyright (c) 2019-2024 Intel Corporation
#
# SPDX-License-Identifier: Apache-2.0

config BOARD_ACRN_EHL_CRB
	select SOC_ATOM
```

## boards/acrn/acrn/Kconfig.defconfig
```kconfig
# Copyright (c) 2021-2024 Intel Corporation
#
# SPDX-License-Identifier: Apache-2.0

config MP_MAX_NUM_CPUS
	default 2

configdefault HEAP_MEM_POOL_ADD_SIZE_ACPI
	default 32768

configdefault MAIN_STACK_SIZE
	default 32000 if ACPI

configdefault SHELL_STACK_SIZE
	default 32000 if SHELL && ACPI
```

## boards/acrn/acrn/acrn_adl_crb_defconfig
```kconfig
# Copyright (c) 2025 Intel Corporation
#
# SPDX-License-Identifier: Apache-2.0

CONFIG_PIC_DISABLE=y
CONFIG_LOAPIC=y
CONFIG_X2APIC=y
CONFIG_CONSOLE=y
CONFIG_SERIAL=y
CONFIG_UART_CONSOLE=y
CONFIG_SYS_CLOCK_HW_CYCLES_PER_SEC=1500000000
CONFIG_BUILD_OUTPUT_BIN=y
CONFIG_SHELL_BACKEND_SERIAL_INTERRUPT_DRIVEN=n
CONFIG_KERNEL_VM_SIZE=0x5000000
CONFIG_APIC_TSC_DEADLINE_TIMER=y
```

## boards/acrn/acrn/acrn_defconfig
```kconfig
# Copyright (c) 2019-2024 Intel Corporation
#
# SPDX-License-Identifier: Apache-2.0

CONFIG_PIC_DISABLE=y
CONFIG_LOAPIC=y
CONFIG_APIC_TSC_DEADLINE_TIMER=y
CONFIG_X2APIC=y
CONFIG_CONSOLE=y
CONFIG_SERIAL=y
CONFIG_UART_CONSOLE=y
CONFIG_SYS_CLOCK_HW_CYCLES_PER_SEC=25000000
CONFIG_BUILD_OUTPUT_BIN=y
CONFIG_SHELL_BACKEND_SERIAL_INTERRUPT_DRIVEN=n
CONFIG_KERNEL_VM_SIZE=0x1000000
```

## boards/acrn/acrn/board.yml
```yaml
boards:

  - name: acrn
    full_name: ACRN hypervisor
    vendor: acrn
    socs:
      - name: atom

  - name: acrn_ehl_crb
    full_name: ACRN on EHL hypervisor
    vendor: acrn
    socs:
      - name: atom

  - name: acrn_adl_crb
    full_name: ACRN Hypervisor on ADL
    vendor: acrn
    socs:
      - name: atom
```

## boards/acrn/board.yml
```yaml
boards:

  - name: acrn
    socs:
      - name: ia32

  - name: acrn_ehl_crb
    socs:
      - name: elkhart_lake
```

## boards/actinius/actinius_icarus/board.yml
```yaml
board:
  name: actinius_icarus
  vendor: Actinius
  variants:
  - name: 'ns'
  revision:
    format: major.minor.patch
    default: "2.0.0"
    revisions:
    - name: "1.4.0"
    - name: "2.0.0"
```

## boards/actinius/actinius_icarus_bee/board.yml
```yaml
board:
  name: actinius_icarus_bee
  vendor: actinius
  socs:
  - name: nrf9160
    variants:
    - name: 'ns'
```

## boards/actinius/actinius_icarus_som/board.yml
```yaml
board:
  name: actinius_icarus_som
  vendor: Actinius
  socs:
  - name: nrf9160
    variants:
    - name: 'ns'
```

## boards/actinius/actinius_icarus_som_dk/board.yml
```yaml
board:
  name: actinius_icarus_som_dk
  vendor: Actinius
  socs:
  - name: nrf9160
    variants:
    - name: 'ns'
```

## boards/actinius/common/Kconfig
```kconfig
# Copyright (c) 2022 Actinius
# SPDX-License-Identifier: Apache-2.0

module = ACTINIUS_BOARD_CONTROL
module-str = Board Control
source "subsys/logging/Kconfig.template.log_config"
```

## boards/actinius/icarus/Kconfig.actinius_icarus
```kconfig
# Actinius Icarus board configuration

# Copyright (c) 2019 Actinius
# SPDX-License-Identifier: Apache-2.0

config BOARD_ACTINIUS_ICARUS
	select SOC_NRF9160_SICA
```

## boards/actinius/icarus/actinius_icarus_nrf9160_ns_defconfig
```kconfig
# SPDX-License-Identifier: Apache-2.0

# This board implies building Non-Secure firmware
CONFIG_TRUSTED_EXECUTION_NONSECURE=y
```

## boards/actinius/icarus/board.yml
```yaml
board:
  name: actinius_icarus
  vendor: actinius
  socs:
  - name: nrf9160
    variants:
    - name: 'ns'
  revision:
    format: major.minor.patch
    default: "2.0.0"
    revisions:
    - name: "1.4.0"
    - name: "2.0.0"
```

## boards/actinius/icarus_bee/Kconfig
```kconfig
# Copyright The Zephyr Project Contributors
# SPDX-License-Identifier: Apache-2.0

config BOARD_ACTINIUS_ICARUS_BEE
	select BOARD_LATE_INIT_HOOK
```

## boards/actinius/icarus_bee/Kconfig.actinius_icarus_bee
```kconfig
# Actinius Icarus Bee board configuration

# Copyright (c) 2021 Actinius
# SPDX-License-Identifier: Apache-2.0

config BOARD_ACTINIUS_ICARUS_BEE
	select SOC_NRF9160_SICA
```

## boards/actinius/icarus_bee/board.yml
```yaml
board:
  name: actinius_icarus_bee
  full_name: Icarus Bee
  vendor: actinius
  socs:
  - name: nrf9160
    variants:
    - name: 'ns'
```

## boards/actinius/icarus_som/Kconfig
```kconfig
# Copyright The Zephyr Project Contributors
# SPDX-License-Identifier: Apache-2.0

config BOARD_ACTINIUS_ICARUS_SOM
	select BOARD_LATE_INIT_HOOK
```

## boards/actinius/icarus_som/Kconfig.actinius_icarus_som
```kconfig
# Actinius Icarus SoM board configuration

# Copyright (c) 2021 Actinius
# SPDX-License-Identifier: Apache-2.0

config BOARD_ACTINIUS_ICARUS_SOM
	select SOC_NRF9160_SICA
```

## boards/actinius/icarus_som/Kconfig.defconfig
```kconfig
# Actinius Icarus SoM board configuration

# Copyright (c) 2021 Actinius
# SPDX-License-Identifier: Apache-2.0

source "boards/actinius/common/Kconfig"

# For the secure version of the board the firmware is linked at the beginning
# of the flash, or into the code-partition defined in DT if it is intended to
# be loaded by MCUboot. If the secure firmware is to be combined with a non-
# secure image (TRUSTED_EXECUTION_SECURE=y), the secure FW image shall always
# be restricted to the size of its code partition.
# For the non-secure version of the board, the firmware
# must be linked into the code-partition (non-secure) defined in DT, regardless.
# Apply this configuration below by setting the Kconfig symbols used by
# the linker according to the information extracted from DT partitions.

config BOARD_ACTINIUS_ICARUS_SOM
	select USE_DT_CODE_PARTITION if BOARD_ACTINIUS_ICARUS_SOM_NRF9160_NS
```
