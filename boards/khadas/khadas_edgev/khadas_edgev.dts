/*
 * Copyright 2022 Huawei France Technologies SASU
 *
 * SPDX-License-Identifier: Apache-2.0
 */

/dts-v1/;

#include <rockchip/rk3399.dtsi>

/ {
	model = "Khadas Edge-V";
	compatible = "khadas,edgev";

	chosen {
		zephyr,sram = &sram0;
		zephyr,console = &uart2;
		zephyr,shell-uart = &uart2;
	};

	cpus {
		/delete-node/ cpu@1;
		/delete-node/ cpu@2;
		/delete-node/ cpu@3;
		/delete-node/ cpu@4;
		/delete-node/ cpu@5;
	};
};

&uart2 {
	status = "okay";
};
