## boards/arc/emsdp/Kconfig.emsdp_em7d_esp
```kconfig
# Copyright (c) 2022 Zephyr Project members and individual contributors
# SPDX-License-Identifier: Apache-2.0

config BOARD_EMSDP_EM7D_ESP
	bool
	default y
	select SOC_ARC_EMSDP
	select SOC_EMSDP_EM7D_ESP
```

## boards/arc/emsdp/emsdp_defconfig
```kconfig
# SPDX-License-Identifier: Apache-2.0

CONFIG_ARC=y
CONFIG_CPU_ARCEM=y
CONFIG_SOC_ARC_EMSDP=y
CONFIG_SOC_EMSDP_EM11D=y
CONFIG_BOARD_EMSDP=y
CONFIG_SYS_CLOCK_TICKS_PER_SEC=100
CONFIG_XIP=n
CONFIG_BUILD_OUTPUT_BIN=n
CONFIG_PRINTK=y
CONFIG_ARCV2_INTERRUPT_UNIT=y
CONFIG_ARCV2_TIMER=y
CONFIG_CONSOLE=y
CONFIG_UART_CONSOLE=y
CONFIG_SERIAL=y
CONFIG_UART_INTERRUPT_DRIVEN=y
CONFIG_ARC_MPU_ENABLE=y
CONFIG_GPIO=y
```

## boards/arc/emsdp/emsdp_em7d_esp_defconfig
```kconfig
# SPDX-License-Identifier: Apache-2.0

CONFIG_SOC_ARC_EMSDP=y
CONFIG_SOC_EMSDP_EM7D_ESP=y
CONFIG_BOARD_EMSDP=y
CONFIG_SYS_CLOCK_TICKS_PER_SEC=100
CONFIG_XIP=n
CONFIG_BUILD_NO_GAP_FILL=y
CONFIG_BUILD_OUTPUT_BIN=n
CONFIG_ARCV2_INTERRUPT_UNIT=y
CONFIG_ARCV2_TIMER=y
CONFIG_CONSOLE=y
CONFIG_UART_CONSOLE=y
CONFIG_SERIAL=y
CONFIG_UART_INTERRUPT_DRIVEN=y
CONFIG_ARC_MPU_ENABLE=y
CONFIG_GPIO=y
CONFIG_ARC_HAS_SECURE=y
CONFIG_TRUSTED_EXECUTION_SECURE=y
```

## boards/arc/hs4xd/Kconfig.board
```kconfig
# DesignWare ARC HS4XD Development Kit board configuration

# Copyright (c) 2022 Synopsys, Inc. All rights reserved.
# SPDX-License-Identifier: Apache-2.0

config BOARD_HS4XD
	bool "ARC HS4XD Development Kit"
	depends on SOC_ARC_HS4XD
	help
	  TODO
```

## boards/arc/hs4xd/Kconfig.defconfig
```kconfig
# SPDX-License-Identifier: Apache-2.0

if BOARD_HS4XD

config BOARD
	default "hs4xd"

# TODO

endif #BOARD_HS4XD
```

## boards/arc/hsdk/Kconfig.defconfig
```kconfig
# Copyright (c) 2019 Synopsys, Inc. All rights reserved.
# SPDX-License-Identifier: Apache-2.0

if BOARD_HSDK

config BOARD
	default "hsdk"

if GPIO

config GPIO_INIT_PRIORITY
	default 60

endif # GPIO

if SPI_DW

config SPI_DW_FIFO_DEPTH
	default 32

config SPI_DW_ARC_AUX_REGS
	default n

config SPI_DW_ACCESS_WORD_ONLY
	default y

endif # SPI_DW

if I2C_DW

config I2C_DW_CLOCK_SPEED
	default 200

endif #I2C_DW

endif # BOARD_HSDK
```

## boards/arc/hsdk/Kconfig.hsdk
```kconfig
# Copyright (c) 2022 Zephyr Project members and individual contributors
# SPDX-License-Identifier: Apache-2.0

config BOARD_HSDK
	bool
	default y
	select SOC_ARC_HSDK
```

## boards/arc/hsdk/Kconfig.hsdk_2cores
```kconfig
# Copyright (c) 2022 Zephyr Project members and individual contributors
# SPDX-License-Identifier: Apache-2.0

config BOARD_HSDK_2CORES
	bool
	default y
	select SOC_ARC_HSDK
```

## boards/arc/hsdk/hsdk_2cores_defconfig
```kconfig
# SPDX-License-Identifier: Apache-2.0

CONFIG_CPU_ARCHS=y
CONFIG_SOC_ARC_HSDK=y
CONFIG_BOARD_HSDK=y
CONFIG_SYS_CLOCK_TICKS_PER_SEC=100
CONFIG_XIP=y
CONFIG_BUILD_NO_GAP_FILL=y
CONFIG_BUILD_OUTPUT_BIN=n
CONFIG_PRINTK=y
CONFIG_ARCV2_INTERRUPT_UNIT=y
CONFIG_ARCV2_TIMER=y
CONFIG_CONSOLE=y
CONFIG_UART_CONSOLE=y
CONFIG_SERIAL=y
CONFIG_PINMUX=y
CONFIG_PINMUX_HSDK=y
CONFIG_GPIO=y
CONFIG_SPI=y
CONFIG_SMP=y
CONFIG_MP_NUM_CPUS=2
```

## boards/arc/hsdk4xd/Kconfig.board
```kconfig
# DesignWare ARC HSDK4XD Development Kit board configuration

# Copyright (c) 2023 Synopsys, Inc. All rights reserved.
# SPDX-License-Identifier: Apache-2.0

config BOARD_HSDK4XD
	bool "ARC HSDK4XD Development Kit"
	depends on SOC_ARC_HSDK4XD
	help
	  The ARC HS4x/4xD Development Kit is a ready-to-use software development
	  platform for the ARC HS4x/4xD family of processor IP. It includes
	  a multicore ARC HS4x/HS4xD-based chip and integrates a wide range
	  of interfaces.
```

## boards/arc/hsdk4xd/Kconfig.defconfig
```kconfig
# Copyright (c) 2023 Synopsys, Inc. All rights reserved.
# SPDX-License-Identifier: Apache-2.0

if BOARD_HSDK4XD

config BOARD
	default "hsdk4xd"

endif #BOARD_HSDK4XD
```

## boards/arc/iotdk/Kconfig.board
```kconfig
# DesignWare ARC IoT Development Kit board configuration

# Copyright (c) 2018 Synopsys, Inc. All rights reserved.
# SPDX-License-Identifier: Apache-2.0

config BOARD_IOTDK
	bool "ARC IoT Development Kit"
	depends on SOC_ARC_IOT
	help
	  The DesignWare ARC IoT Development Kit board is a versatile platform that includes the necessary hardware and software to accelerate software development and debugging of sensor fusion, voice recognition and face detection designs. It includes a silicon implementation of the ARC Data Fusion IP Subsystem running at 144 MHz on SMIC's 55-nm ultra-low power process, and a rich set of peripherals commonly used in IoT designs such as USB, UART, SPI, I2C, PWM, SDIO and ADCs.
```

## boards/arc/iotdk/Kconfig.defconfig
```kconfig
# SPDX-License-Identifier: Apache-2.0

config BOARD
	default "iotdk"
	depends on BOARD_IOTDK
```

## boards/arc/iotdk/Kconfig.iotdk
```kconfig
# SPDX-License-Identifier: Apache-2.0

config BOARD_IOTDK
	bool
	default y
	select SOC_ARC_IOT
```

## boards/arc/nsim/Kconfig.board
```kconfig
# DesignWare ARC nSIM simulated platform configuration

# Copyright (c) 2016, 2019 Synopsys, Inc. All rights reserved.
# SPDX-License-Identifier: Apache-2.0

config BOARD_NSIM
	bool "ARC nSIM simulator"
	depends on SOC_NSIM
	select HAS_COVERAGE_SUPPORT
	help
	  The DesignWare ARC nSIM board is a virtual board based on
	  the ARC nSIM simulator. It demonstrates the ARC core features
	  and a console based on the ns16550 UART model.
```

## boards/arc/nsim/Kconfig.defconfig
```kconfig
# SPDX-License-Identifier: Apache-2.0

if BOARD_NSIM

config BOARD
	default "nsim"

endif # BOARD_NSIM
```

## boards/arc/nsim/Kconfig.nsim_em
```kconfig
# SPDX-License-Identifier: Apache-2.0

config BOARD_NSIM_EM
	bool
	default y
	select SOC_NSIM
	select SOC_NSIM_EM
	select HAS_COVERAGE_SUPPORT
```

## boards/arc/nsim/Kconfig.nsim_em7d_v22
```kconfig
# SPDX-License-Identifier: Apache-2.0

config BOARD_NSIM_EM7D_V22
	bool
	default y
	select SOC_NSIM
	select SOC_NSIM_EM7D_V22
	select HAS_COVERAGE_SUPPORT
```

## boards/arc/nsim/Kconfig.nsim_hs
```kconfig
# Copyright (c) 2022 Zephyr Project members and individual contributors
# SPDX-License-Identifier: Apache-2.0

config BOARD_NSIM_HS
	bool
	default y
	select SOC_NSIM
	select SOC_NSIM_HS
	select HAS_COVERAGE_SUPPORT
```

## boards/arc/nsim/Kconfig.nsim_hs5x
```kconfig
# SPDX-License-Identifier: Apache-2.0

config BOARD_NSIM_HS5X
	bool
	default y
	select SOC_NSIM
	select SOC_NSIM_HS5X
	select HAS_COVERAGE_SUPPORT
```

## boards/arc/nsim/Kconfig.nsim_hs6x
```kconfig
# Copyright (c) 2022 Zephyr Project members and individual contributors
# SPDX-License-Identifier: Apache-2.0

config BOARD_NSIM_HS6X
	bool
	default y
	select SOC_NSIM
	select SOC_NSIM_HS6X
	select HAS_COVERAGE_SUPPORT
```

## boards/arc/nsim/Kconfig.nsim_hs6x_smp
```kconfig
# SPDX-License-Identifier: Apache-2.0

config BOARD_NSIM_HS6X_SMP
	bool
	default y
	select SOC_NSIM
	select SOC_NSIM_HS6X_SMP
	select HAS_COVERAGE_SUPPORT
```

## boards/arc/nsim/Kconfig.nsim_hs_mpuv6
```kconfig
# SPDX-License-Identifier: Apache-2.0

config BOARD_NSIM_HS_MPUV6
	bool
	default y
	select SOC_NSIM
	select SOC_NSIM_HS_MPUV6
	select HAS_COVERAGE_SUPPORT
```

## boards/arc/nsim/Kconfig.nsim_hs_smp
```kconfig
# SPDX-License-Identifier: Apache-2.0

config BOARD_NSIM_HS_SMP
	bool
	default y
	select SOC_NSIM
	select SOC_NSIM_HS_SMP
	select HAS_COVERAGE_SUPPORT
```

## boards/arc/nsim/Kconfig.nsim_sem
```kconfig
# Copyright (c) 2022 Zephyr Project members and individual contributors
# SPDX-License-Identifier: Apache-2.0

config BOARD_NSIM_SEM
	bool
	default y
	select SOC_NSIM
	select SOC_NSIM_SEM
	select HAS_COVERAGE_SUPPORT
```
