/*
 * Copyright (c) 2020 Nordic Semiconductor ASA
 *
 * SPDX-License-Identifier: Apache-2.0
 */

/ {
	zephyr,fixture {
		gpio-loopback {
			compatible = "zephyr,fixture,gpio-loopback";
			out-gpios = <&gpio0 18 0>; /* Pmod3 pin 9  */
			in-gpios = <&gpio0 19 0>;  /* Pmod3 pin 10 */
		};
	};
};
