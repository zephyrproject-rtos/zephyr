/dts-v1/;

#include <em9d.dtsi>

/ {
	model = "em_starterkit-em9d";
	compatible = "snps,em_starterkit-em9d", "snps,em_starterkit";

	aliases {
		uart-0 = &uart0;
		uart-1 = &uart1;
		uart-2 = &uart2;
	};

	chosen {
		zephyr,console = &uart1;
	};
};

&uart1 {
	status = "ok";
	current-speed = <115200>;
};
