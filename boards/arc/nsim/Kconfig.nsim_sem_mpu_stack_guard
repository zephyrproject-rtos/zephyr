## boards/arc/nsim/Kconfig.nsim_sem_mpu_stack_guard
```kconfig
# SPDX-License-Identifier: Apache-2.0

config BOARD_NSIM_SEM_MPU_STACK_GUARD
	bool
	default y
	select SOC_NSIM
	select SOC_NSIM_SEM
	select HAS_COVERAGE_SUPPORT
```

## boards/arc/nsim/nsim_em7d_v22_defconfig
```kconfig
# SPDX-License-Identifier: Apache-2.0

CONFIG_SOC_NSIM=y
CONFIG_SOC_NSIM_EM7D_V22=y
CONFIG_BOARD_NSIM=y
CONFIG_SYS_CLOCK_TICKS_PER_SEC=100
CONFIG_XIP=n
CONFIG_BUILD_OUTPUT_BIN=n
CONFIG_ARCV2_INTERRUPT_UNIT=y
CONFIG_ARCV2_TIMER=y
CONFIG_ARC_MPU_ENABLE=y
CONFIG_CONSOLE=y
CONFIG_UART_CONSOLE=y
CONFIG_SERIAL=y
CONFIG_ARC_EXCEPTION_DEBUG=y
CONFIG_ARC_USE_UNALIGNED_MEM_ACCESS=y
```

## boards/arc/nsim/nsim_hs6x_smp_defconfig
```kconfig
# SPDX-License-Identifier: Apache-2.0

CONFIG_ISA_ARCV3=y
CONFIG_SOC_NSIM=y
CONFIG_SOC_NSIM_HS6X_SMP=y
CONFIG_BOARD_NSIM=y
CONFIG_SYS_CLOCK_TICKS_PER_SEC=100
CONFIG_XIP=n
CONFIG_BUILD_OUTPUT_BIN=n
CONFIG_ARCV2_INTERRUPT_UNIT=y
CONFIG_ARCV2_TIMER=y
CONFIG_CONSOLE=y
CONFIG_UART_CONSOLE=y
CONFIG_SERIAL=y
CONFIG_ARC_EXCEPTION_DEBUG=y
CONFIG_SMP=y
CONFIG_MP_NUM_CPUS=2
```

## boards/arc/nsim/nsim_hs_flash_xip_defconfig
```kconfig
# SPDX-License-Identifier: Apache-2.0

CONFIG_SOC_NSIM=y
CONFIG_SOC_NSIM_HS=y
CONFIG_BOARD_NSIM=y
CONFIG_SYS_CLOCK_TICKS_PER_SEC=100
CONFIG_XIP=y
CONFIG_BUILD_OUTPUT_BIN=n
CONFIG_ARCV2_INTERRUPT_UNIT=y
CONFIG_ARCV2_TIMER=y
CONFIG_CONSOLE=y
CONFIG_UART_CONSOLE=y
CONFIG_SERIAL=y
CONFIG_ARC_EXCEPTION_DEBUG=y
CONFIG_HARVARD=n
CONFIG_ARC_MPU_ENABLE=y
```

## boards/arc/nsim_em/Kconfig.board
```kconfig
# Kconfig - DesignWare ARC EM Starter Kit board configuration
#
# Copyright (c) 2016 Synopsys, Inc. All rights reserved.
#
# SPDX-License-Identifier: Apache-2.0
#
config BOARD_NSIM_EM
	bool "ARC EM Nsim simulator"
	depends on SOC_NSIM
	select HAS_DTS
	help
	  The DesignWare ARC Nsim EM board is a virtual board based on
	  nsim simulator. It's used to show the ARC EM core features.
	  It just has a console based on hostlink feature of nsim simulator.
```

## boards/arc/nsim_em/Kconfig.defconfig
```kconfig
# SPDX-License-Identifier: Apache-2.0

if BOARD_NSIM_EM

config BOARD
	default "nsim_em"

config CPU_ARCEM4
	default y

if SERIAL

config UART_NSIM
	default y

endif # SERIAL


endif # BOARD_NSIM_EM
```

## boards/arc/panther_ss/Kconfig.board
```kconfig
config BOARD_PANTHER_SS
	bool "Panther - Sensor Sub System"
	depends on SOC_QUARK_SE_C1000_SS
```

## boards/arc/panther_ss/Kconfig.defconfig
```kconfig
if BOARD_PANTHER_SS

config BOARD
	default "panther_ss"

endif # BOARD_PANTHER_SS
```

## boards/arc/qemu_arc/Kconfig.board
```kconfig
# Copyright (c) 2020 Synopsys, Inc. All rights reserved.
#
# SPDX-License-Identifier: Apache-2.0

config BOARD_QEMU_ARC
	bool "ARC QEMU for EM & HS cores"
	depends on SOC_QEMU_ARC
	select QEMU_TARGET
	select HAS_COVERAGE_SUPPORT
```

## boards/arc/qemu_arc/Kconfig.defconfig
```kconfig
# Copyright (c) 2020,2021 Synopsys, Inc. All rights reserved.
# SPDX-License-Identifier: Apache-2.0

if NETWORKING

	config NET_L2_ETHERNET
	default y

	# Required to satisfy dependency of networking stack on RNG
	config TEST_RANDOM_GENERATOR
	default y

endif # NETWORKING
```

## boards/arc/qemu_arc/Kconfig.qemu_arc_em
```kconfig
# Copyright (c) 2022 Zephyr Project members and individual contributors
# SPDX-License-Identifier: Apache-2.0

config BOARD_QEMU_ARC_EM
	bool
	default y
	select SOC_QEMU_ARC
	select SOC_QEMU_ARC_EM
	select QEMU_TARGET
	select HAS_COVERAGE_SUPPORT
```

## boards/arc/qemu_arc/Kconfig.qemu_arc_hs
```kconfig
# Copyright (c) 2022 Zephyr Project members and individual contributors
# SPDX-License-Identifier: Apache-2.0

config BOARD_QEMU_ARC_HS
	bool
	default y
	select SOC_QEMU_ARC
	select SOC_QEMU_ARC_HS
	select QEMU_TARGET
	select HAS_COVERAGE_SUPPORT
```

## boards/arc/qemu_arc/Kconfig.qemu_arc_hs5x
```kconfig
# Copyright (c) 2022 Zephyr Project members and individual contributors
# SPDX-License-Identifier: Apache-2.0

config BOARD_QEMU_ARC_HS5X
	bool
	default y
	select SOC_QEMU_ARC
	select SOC_QEMU_ARC_HS5X
	select QEMU_TARGET
	select HAS_COVERAGE_SUPPORT
```

## boards/arc/qemu_arc/Kconfig.qemu_arc_hs6x
```kconfig
# SPDX-License-Identifier: Apache-2.0

config BOARD_QEMU_ARC_HS6X
	bool
	default y
	select SOC_QEMU_ARC
	select SOC_QEMU_ARC_HS6X
	select QEMU_TARGET
	select HAS_COVERAGE_SUPPORT
```

## boards/arc/qemu_arc/qemu_arc_em_defconfig
```kconfig
CONFIG_CPU_ARCEM=y
CONFIG_SOC_QEMU_ARC=y
CONFIG_SOC_QEMU_ARC_EM=y
CONFIG_XIP=y
CONFIG_BUILD_OUTPUT_BIN=n
CONFIG_PRINTK=y
CONFIG_ARCV2_INTERRUPT_UNIT=y
CONFIG_ARCV2_TIMER=y
CONFIG_ARC_HAS_STACK_CHECKING=n
CONFIG_CONSOLE=y
CONFIG_UART_CONSOLE=y
CONFIG_SERIAL=y
CONFIG_UART_NS16550=y
CONFIG_QEMU_ICOUNT_SHIFT=6
```

## boards/arc/qemu_arc/qemu_arc_hs5x_defconfig
```kconfig
CONFIG_ISA_ARCV3=y
CONFIG_SOC_QEMU_ARC=y
CONFIG_SOC_QEMU_ARC_HS5X=y
CONFIG_XIP=n
CONFIG_BUILD_OUTPUT_BIN=n
CONFIG_ARCV2_INTERRUPT_UNIT=y
CONFIG_ARCV2_TIMER=y
CONFIG_ARC_HAS_STACK_CHECKING=n
CONFIG_CONSOLE=y
CONFIG_UART_CONSOLE=y
CONFIG_SERIAL=y
CONFIG_QEMU_ICOUNT_SHIFT=6
```

## boards/arc/quark_se_c1000_ss_devboard/Kconfig.board
```kconfig
config BOARD_QUARK_SE_C1000_DEVBOARD_SS
	bool "Quark SE C1000 - Sensor Sub System"
	depends on SOC_QUARK_SE_C1000_SS
	select HAS_DTS_I2C
```

## boards/arc/quark_se_c1000_ss_devboard/quark_se_c1000_ss_devboard_defconfig
```kconfig
# SPDX-License-Identifier: Apache-2.0

CONFIG_ARC=y
CONFIG_SOC_QUARK_SE_C1000_SS=y
CONFIG_BOARD_QUARK_SE_C1000_DEVBOARD_SS=y
CONFIG_SYS_CLOCK_TICKS_PER_SEC=100
CONFIG_SYS_CLOCK_HW_CYCLES_PER_SEC=32000000
CONFIG_XIP=y
CONFIG_PRINTK=y
CONFIG_CPU_ARCEM4=y
CONFIG_CPU_ARCV2=y
CONFIG_ARCV2_INTERRUPT_UNIT=y
CONFIG_ARCV2_TIMER=y
CONFIG_CONSOLE=y
CONFIG_UART_CONSOLE=y
CONFIG_UART_QMSI=y
CONFIG_SERIAL=y
```

## boards/arduino/arduino_giga_r1/Kconfig.arduino_giga_r1
```kconfig
# Copyright 2023 Google LLC
# SPDX-License-Identifier: Apache-2.0

config BOARD_ARDUINO_GIGA_R1
	select SOC_STM32H747XX_M7 if BOARD_ARDUINO_GIGA_R1_STM32H747XX_M7
	select SOC_STM32H747XX_M4 if BOARD_ARDUINO_GIGA_R1_STM32H747XX_M4
```

## boards/arduino/arduino_giga_r1/arduino_giga_r1_stm32h747xx_m4_defconfig
```kconfig
# Copyright 2023 Google LLC
# SPDX-License-Identifier: Apache-2.0

# Enable GPIO
CONFIG_GPIO=y

# Clock configuration
CONFIG_CLOCK_CONTROL=y

# Enable MPU
CONFIG_ARM_MPU=y

# Enable HW stack protection
CONFIG_HW_STACK_PROTECTION=y

# Enable uart driver
CONFIG_SERIAL=y

# Console
CONFIG_CONSOLE=y
CONFIG_UART_CONSOLE=y

# Enable pin controller
CONFIG_PINCTRL=y
```

## boards/arduino/arduino_nano_33_ble/board.yml
```yaml
board:
  name: arduino_nano_33_ble
  vendor: Arduino
  socs:
  - name: nrf52840
    variants:
    - name: 'sense'
```

## boards/arduino/arduino_nano_33_iot/board.yml
```yaml
board:
  name: arduino_nano_33_iot
  vendor: arduino
  socs:
    - name: samd21g18a
```

## boards/arduino/arduino_nicla_sense_me/board.yml
```yaml
board:
  name: arduino_nicla_sense_me
  vendor: Arduino
  socs:
  - name: nrf52832
```

## boards/arduino/arduino_uno_r4_minima/arduino_uno_r4_minima_defconfig
```kconfig
# Copyright (c) 2023 TOKITA Hiroshi <tokita.hiroshi@fujitsu.com>
# SPDX-License-Identifier: Apache-2.0

CONFIG_SYS_CLOCK_HW_CYCLES_PER_SEC=48000000

CONFIG_USE_DT_CODE_PARTITION=y

# enable uart driver
CONFIG_SERIAL=y
CONFIG_UART_INTERRUPT_DRIVEN=y

# enable console
CONFIG_CONSOLE=y
CONFIG_UART_CONSOLE=y
```
