/*
 * Copyright (c) 2022 Nordic Semiconductor ASA
 * SPDX-License-Identifier: Apache-2.0
 */

#include "nsim.dtsi"

/ {
	ici: intercore-interrupt-unit {
		compatible = "snps,archs-ici";
		interrupts = <19 1>;
		interrupt-parent = <&intc>;
	};
};
