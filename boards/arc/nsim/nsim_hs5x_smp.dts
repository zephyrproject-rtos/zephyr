/*
 * Copyright (c) 2022, Synopsys, Inc.
 *
 * SPDX-License-Identifier: Apache-2.0
 */

/dts-v1/;

#include "nsim.dtsi"
#include "nsim-flat-mem.dtsi"

/ {
	model = "snps,nsim_hs";
	compatible = "snps,nsim_hs";

	cpus {
		#address-cells = <1>;
		#size-cells = <0>;

		cpu@0 {
			device_type = "cpu";
			compatible = "snps,arcv3-hs";
			reg = <0>;
		};

		cpu@1 {
			device_type = "cpu";
			compatible = "snps,arcv3-hs";
			reg = <1>;
		};
	};
};
