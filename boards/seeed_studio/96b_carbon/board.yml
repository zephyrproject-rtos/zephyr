## boards/seeed_studio/96b_carbon/board.yml
```yaml
board:
  name: 96b_carbon
  vendor: seeed studio
  socs:
    - name: stm32f401xe
```

## boards/seeed_studio/lora_e5_dev_board/board.yml
```yaml
board:
  name: lora_e5_dev_board
  vendor: seeed studio
  socs:
    - name: stm32wle5xx
```

## boards/seeed_studio/wio_terminal/wio_terminal_defconfig
```kconfig
# Copyright (c) 2023 Joel Guittet
# Copyright (c) 2024 Gerson Fernando Budke <nandojve@gmail.com>
# SPDX-License-Identifier: Apache-2.0

CONFIG_SOC_ATMEL_SAMD5X_XOSC32K=y
CONFIG_SOC_ATMEL_SAMD5X_XOSC32K_AS_MAIN=y

CONFIG_ARM_MPU=y
CONFIG_CORTEX_M_SYSTICK=y
CONFIG_HW_STACK_PROTECTION=y
CONFIG_REGULATOR=y

# BOSSA bootloader
CONFIG_BOOTLOADER_BOSSA=y
CONFIG_BOOTLOADER_BOSSA_ADAFRUIT_UF2=y
CONFIG_BUILD_OUTPUT_UF2=y

# Console over USB CDC-ACM
CONFIG_SERIAL=y
CONFIG_CONSOLE=y
CONFIG_UART_CONSOLE=y
CONFIG_UART_INTERRUPT_DRIVEN=y
CONFIG_USB_DEVICE_STACK=y
CONFIG_USB_DEVICE_INITIALIZE_AT_BOOT=y
CONFIG_USB_DEVICE_VID=0x2886
CONFIG_USB_DEVICE_PID=0x802D
CONFIG_USB_DEVICE_MANUFACTURER="Seeed Studio"
CONFIG_USB_DEVICE_PRODUCT="Wio Terminal"
CONFIG_USB_CDC_ACM_LOG_LEVEL_OFF=y
```

## boards/segger/ip_k66f/Kconfig.defconfig
```kconfig
# IP-K66F board

# Copyright (c) 2020 DENX Software Engineering GmbH
# SPDX-License-Identifier: Apache-2.0

if BOARD_IP_K66F

config OSC_XTAL0_FREQ
	default 12000000

config MCG_PRDIV0
	default 0x0

config MCG_VDIV0
	default 0xe

config MCG_FCRDIV
	default 1

configdefault NET_L2_ETHERNET
	default y

configdefault ETH_NXP_ENET_RMII_EXT_CLK
	default y

endif # BOARD_IP_K66F
```

## boards/segger/ip_k66f/Kconfig.ip_k66f
```kconfig
# Copyright 2024 NXP
# SPDX-License-Identifier: Apache-2.0

config BOARD_IP_K66F
	select SOC_MK66F18
	select SOC_PART_NUMBER_MK66FN2M0VMD18
```

## boards/segger/ip_k66f/board.yml
```yaml
board:
  name: ip_k66f
  full_name: IP Switch Board
  vendor: segger
  socs:
    - name: mk66f18
```

## boards/segger/ip_k66f/ip_k66f_defconfig
```kconfig
# SPDX-License-Identifier: Apache-2.0

CONFIG_GPIO=y
CONFIG_PINCTRL=y
CONFIG_SYS_CLOCK_HW_CYCLES_PER_SEC=180000000
CONFIG_OSC_LOW_POWER=y
CONFIG_USE_SEGGER_RTT=y

# Add RTT console support
CONFIG_CONSOLE=y
CONFIG_RTT_CONSOLE=y
CONFIG_SEGGER_RTT_BUFFER_SIZE_DOWN=64

# Enable MPU
CONFIG_ARM_MPU=y
CONFIG_HW_STACK_PROTECTION=y
```

## boards/segger/trb_stm32f407/Kconfig.segger_trb_stm32f407
```kconfig
# Copyright (c) 2020, Erwin Rol <erwin@erwinrol.com>
# SPDX-License-Identifier: Apache-2.0

config BOARD_SEGGER_TRB_STM32F407
	select SOC_STM32F407XE
```

## boards/segger/trb_stm32f407/board.yml
```yaml
board:
  name: segger_trb_stm32f407
  full_name: Cortex-M Trace Reference Board V1.2
  vendor: segger
  socs:
    - name: stm32f407xx
```

## boards/segger/trb_stm32f407/segger_trb_stm32f407_defconfig
```kconfig
# SPDX-License-Identifier: Apache-2.0

# Enable MPU
CONFIG_ARM_MPU=y

# Enable HW stack protection
CONFIG_HW_STACK_PROTECTION=y

# Enable RTT
CONFIG_USE_SEGGER_RTT=y

CONFIG_CONSOLE=y
CONFIG_RTT_CONSOLE=y

# no serial port
CONFIG_SERIAL=n

# enable GPIO
CONFIG_GPIO=y
```

## boards/sensoan/sgw2/Kconfig
```kconfig
# SGW-2 board configuration
#
# Copyright (c) 2019 Nordic Semiconductor ASA
# Copyright (c) 2024 Sensoan Oy
#
# SPDX-License-Identifier: Apache-2.0

config BOARD_SGW2
	# The GPIO driver is forced here to be enabled whenever nrf5340_reset.c
	# is included. This is the case for sgw2/nrf9160 and sgw2/nrf9160/ns builds
	# whenever BT_HCI is enabled.
	select GPIO if (BOARD_SGW2_NRF9160 || BOARD_SGW2_NRF9160_NS) && BT_HCI

if BOARD_SGW2_NRF5340_CPUAPP || BOARD_SGW2_NRF5340_CPUAPP_NS || BOARD_SGW2_NRF5340_CPUNET

if BOARD_SGW2_NRF5340_CPUAPP || BOARD_SGW2_NRF5340_CPUAPP_NS

config DOMAIN_CPUNET_BOARD
	string
	default "sgw2/nrf5340/cpunet"
	help
	  The board which will be used for CPUNET domain when creating a multi
	  image application where one or more images should be located on
	  another board. For example hci_rpmsg on the nRF5340_cpunet for
	  Bluetooth applications.

endif #  BOARD_SGW2_NRF5340_CPUAPP || BOARD_SGW2_NRF5340_CPUAPP_NS

config DOMAIN_CPUAPP_BOARD
	string
	default "sgw2/nrf5340/cpuapp"
	depends on BOARD_SGW2_NRF5340_CPUNET
	help
	  The board which will be used for CPUAPP domain when creating a multi
	  image application where one or more images should be located on
	  another board.

endif # BOARD_SGW2_NRF5340_CPUAPP || BOARD_SGW2_NRF5340_CPUAPP_NS || BOARD_SGW2_NRF5340_CPUNET

module=BOARD
module-dep=LOG
module-str=Log level for board
source "${ZEPHYR_BASE}/subsys/logging/Kconfig.template.log_config"
```

## boards/sensoan/sgw2/Kconfig.sgw2
```kconfig
# SGW-2 board configuration
#
# Copyright (c) 2019 Nordic Semiconductor ASA
# Copyright (c) 2024 Sensoan Oy
#
# SPDX-License-Identifier: Apache-2.0

config BOARD_SGW2
	select SOC_NRF9160_SICA if BOARD_SGW2_NRF9160 || BOARD_SGW2_NRF9160_NS
	select SOC_NRF5340_CPUAPP_QKAA if BOARD_SGW2_NRF5340_CPUAPP
	select SOC_NRF5340_CPUAPP_QKAA if BOARD_SGW2_NRF5340_CPUAPP_NS
	select SOC_NRF5340_CPUNET_QKAA if BOARD_SGW2_NRF5340_CPUNET
```

## boards/sensoan/sgw2/board.yml
```yaml
board:
  name: sgw2
  vendor: sensoan
  socs:
  - name: nrf9160
    variants:
    - name: 'ns'
  - name: nrf5340
    variants:
    - name: 'ns'
      cpucluster: 'cpuapp'
```

## boards/sensoan/sgw2/dts/bindings/sensoan,sgw2-nrf5340-reset.yaml
```yaml
# Copyright (c) 2019 Nordic Semiconductor ASA
# Copyright (c) 2024 Sensoan Oy
# SPDX-License-Identifier: Apache-2.0

description: GPIO used to reset nRF5340 on SGW-2

compatible: "sensoan,sgw2-nrf5340-reset"

include: base.yaml

properties:
  status:
    required: true

  gpios:
    type: phandle-array
    required: true
    description: |
      GPIO to use as nRF5340 reset line: output in nRF9160, input in nRF5340.
```

## boards/sensry/ganymed_bob/Kconfig.defconfig
```kconfig
# Copyright (c) 2025 sensry.io
# SPDX-License-Identifier: Apache-2.0

if NETWORKING

config NET_L2_ETHERNET
	default y

if DT_HAS_MICROCHIP_VSC8541_ENABLED

config GPIO
	default y

endif

endif # NETWORKING
```

## boards/sensry/ganymed_bob/Kconfig.ganymed_bob
```kconfig
# SPDX-License-Identifier: Apache-2.0
# Copyright (c) 2024 sensry.io

config BOARD_GANYMED_BOB
	select SOC_SY120_GBM if BOARD_GANYMED_BOB_SY120_GBM
	select SOC_SY120_GEN1 if BOARD_GANYMED_BOB_SY120_GEN1
```

## boards/sensry/ganymed_bob/board.yml
```yaml
# Copyright (c) 2024 sensry.io
# SPDX-License-Identifier: Apache-2.0

board:
  name: ganymed_bob
  vendor: sensry
  socs:
    - name: sy120_gbm
    - name: sy120_gen1
```

## boards/sensry/ganymed_sk/Kconfig.ganymed_sk
```kconfig
# Copyright (c) 2025 sensry.io
# SPDX-License-Identifier: Apache-2.0

config BOARD_GANYMED_SK
	select SOC_SY120_GBM if BOARD_GANYMED_SK_SY120_GBM
	select SOC_SY120_GEN1 if BOARD_GANYMED_SK_SY120_GEN1
```

## boards/sensry/ganymed_sk/board.yml
```yaml
# Copyright (c) 2025 sensry.io
# SPDX-License-Identifier: Apache-2.0

board:
  name: ganymed_sk
  full_name: Ganymed Starter Kit (SK)
  vendor: sensry
  socs:
    - name: sy120_gbm
    - name: sy120_gen1
```

## boards/sensry/ganymed_sk/ganymed_sk_sy120_gbm_defconfig
```kconfig
# Copyright (c) 2025 sensry.io
# SPDX-License-Identifier: Apache-2.0

CONFIG_SERIAL=y
CONFIG_CONSOLE=y
CONFIG_UART_CONSOLE=y
```

## boards/shakti/nexys_ganga/Kconfig.nexys_ganga
```kconfig
# Copyright (c) 2026 RISE Lab, IIT Madras
# SPDX-License-Identifier: Apache-2.0

config BOARD_NEXYS_GANGA
	select SOC_GANGA
```

## boards/shakti/nexys_ganga/board.yml
```yaml
# Copyright (c) 2026 RISE Lab, IIT Madras
# SPDX-License-Identifier: Apache-2.0

boards:
  - name: nexys_ganga
    full_name: Nexys Video (Ganga SoC)
    vendor: shakti
    socs:
      - name: ganga
```

## boards/shakti/nexys_ganga/nexys_ganga_defconfig
```kconfig
# Copyright (c) 2026 RISE Lab, IIT Madras
# SPDX-License-Identifier: Apache-2.0

CONFIG_CONSOLE=y
CONFIG_SERIAL=y
CONFIG_UART_CONSOLE=y
```
