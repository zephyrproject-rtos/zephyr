## boards/mikroe/clicker_ra4m1/Kconfig.mikroe_clicker_ra4m1
```kconfig
# Copyright (c) 2024 Ian Morris
# SPDX-License-Identifier: Apache-2.0

config BOARD_MIKROE_CLICKER_RA4M1
	select SOC_R7FA4M1AB3CFM
```

## boards/mikroe/clicker_ra4m1/board.yml
```yaml
# Copyright (c) 2024 Ian Morris
# SPDX-License-Identifier: Apache-2.0

board:
  name: mikroe_clicker_ra4m1
  vendor: mikroe
  socs:
    - name: r7fa4m1ab3cfm
```

## boards/mikroe/clicker_ra4m1/mikroe_clicker_ra4m1_defconfig
```kconfig
# Copyright (c) 2024 Ian Morris
# SPDX-License-Identifier: Apache-2.0

# Enable uart driver
CONFIG_SERIAL=y

# Enable console
CONFIG_CONSOLE=y
CONFIG_UART_CONSOLE=y

# Enable GPIO
CONFIG_GPIO=y
```

## boards/mikroe/hexiwear/Kconfig.hexiwear
```kconfig
# Copyright 2024 NXP
# SPDX-License-Identifier: Apache-2.0

config BOARD_HEXIWEAR
	select SOC_MK64F12 if BOARD_HEXIWEAR_MK64F12
	select SOC_PART_NUMBER_MK64FN1M0VDC12 if BOARD_HEXIWEAR_MK64F12
	select SOC_MKW40Z4 if BOARD_HEXIWEAR_MKW40Z4
	select SOC_PART_NUMBER_MKW40Z160VHT4 if BOARD_HEXIWEAR_MKW40Z4
```

## boards/mikroe/hexiwear/board.yml
```yaml
board:
  name: hexiwear
  full_name: Hexiwear
  vendor: mikroe
  socs:
    - name: mk64f12
    - name: mkw40z4
```

## boards/mikroe/mini_m4_for_stm32/Kconfig.defconfig
```kconfig
# Mikroe MINI-M4 for STM32 board configuration

# Copyright (c) 2019, Kwon Tae-young <tykwon@m2i.co.kr>
# SPDX-License-Identifier: Apache-2.0

if BOARD_MIKROE_MINI_M4_FOR_STM32

config SPI_STM32_INTERRUPT
	default y
	depends on SPI

endif # BOARD_MIKROE_MINI_M4_FOR_STM32
```

## boards/mikroe/mini_m4_for_stm32/Kconfig.mikroe_mini_m4_for_stm32
```kconfig
# Copyright (c) 2019, Kwon Tae-young <tykwon@m2i.co.kr>
# SPDX-License-Identifier: Apache-2.0

config BOARD_MIKROE_MINI_M4_FOR_STM32
	select SOC_STM32F415XX
```

## boards/mikroe/mini_m4_for_stm32/board.yml
```yaml
board:
  name: mikroe_mini_m4_for_stm32
  full_name: MINI-M4 for STM32
  vendor: mikroe
  socs:
    - name: stm32f415xx
```

## boards/mikroe/quail/Kconfig.mikroe_quail
```kconfig
# Copyright (c) 2025 ThoseBoards
# SPDX-License-Identifier: Apache-2.0

config BOARD_MIKROE_QUAIL
	select SOC_STM32F427XX
```

## boards/mikroe/quail/board.yml
```yaml
board:
  name: mikroe_quail
  full_name: MikroE Quail
  vendor: mikroe
  socs:
    - name: stm32f427xx
```

## boards/mikroe/quail/mikroe_quail_defconfig
```kconfig
# Enable MPU
CONFIG_ARM_MPU=y

CONFIG_SERIAL=y

# Console
CONFIG_CONSOLE=y
CONFIG_UART_CONSOLE=y

# Enable GPIO
CONFIG_GPIO=y
```

## boards/mikroe/stm32_m4_clicker/Kconfig.defconfig
```kconfig
# Copyright (c) 2024 Ian Morris
# SPDX-License-Identifier: Apache-2.0

if BOARD_MIKROE_STM32_M4_CLICKER

source "boards/common/usb/Kconfig.cdc_acm_serial.defconfig"

endif # BOARD_MIKROE_STM32_M4_CLICKER
```

## boards/mikroe/stm32_m4_clicker/Kconfig.mikroe_stm32_m4_clicker
```kconfig
# Copyright (c) 2024 Ian Morris
# SPDX-License-Identifier: Apache-2.0

config BOARD_MIKROE_STM32_M4_CLICKER
	select SOC_STM32F415XX
```

## boards/mikroe/stm32_m4_clicker/board.yml
```yaml
# Copyright (c) 2024 Ian Morris
# SPDX-License-Identifier: Apache-2.0

board:
  name: mikroe_stm32_m4_clicker
  full_name: STM32 M4 Clicker
  vendor: mikroe
  socs:
    - name: stm32f415xx
```

## boards/mikroe/stm32_m4_clicker/mikroe_stm32_m4_clicker_defconfig
```kconfig
# Copyright (c) 2024 Ian Morris
# SPDX-License-Identifier: Apache-2.0

# Enable MPU
CONFIG_ARM_MPU=y

# Enable HW stack protection
CONFIG_HW_STACK_PROTECTION=y

# Console
CONFIG_SERIAL=y
CONFIG_CONSOLE=y

# Enable GPIO
CONFIG_GPIO=y

# Enable Clocks
CONFIG_CLOCK_CONTROL=y

# Enable USB
CONFIG_USB_DEVICE_STACK=y
```

## boards/milkv/duo/Kconfig.milkv_duo
```kconfig
# Copyright (c) 2023-2024 Chen Xingyu <hi@xingrz.me>
# SPDX-License-Identifier: Apache-2.0

config BOARD_MILKV_DUO
	select SOC_CV1800B if BOARD_MILKV_DUO_CV1800B_C906_1
	select SOC_SG2002 if BOARD_MILKV_DUO_SG2002_C906_1
```

## boards/milkv/duo/board.yml
```yaml
board:
  name: milkv_duo
  full_name: Duo
  vendor: milkv
  socs:
  - name: cv1800b
  - name: sg2002
```

## boards/milkv/duo/milkv_duo_sg2002_c906_1_defconfig
```kconfig
# Copyright (c) 2024 Chen Xingyu <hi@xingrz.me>
# SPDX-License-Identifier: Apache-2.0

CONFIG_XIP=n

CONFIG_GPIO=y
CONFIG_SERIAL=y

CONFIG_CONSOLE=y
CONFIG_UART_CONSOLE=y
```

## boards/milkv/duo256m/Kconfig.milkv_duo256m
```kconfig
# Copyright (c) 2024 Chen Xingyu <hi@xingrz.me>
# SPDX-License-Identifier: Apache-2.0

config BOARD_MILKV_DUO256M
	select SOC_SG2002
```

## boards/milkv/duos/Kconfig.milkv_duos
```kconfig
# Copyright (c) 2024 Chen Xingyu <hi@xingrz.me>
# SPDX-License-Identifier: Apache-2.0

config BOARD_MILKV_DUOS
	select SOC_SG2000 if BOARD_MILKV_DUOS_SG2000_C906_1
```

## boards/milkv/duos/board.yml
```yaml
board:
  name: milkv_duos
  full_name: Duo S
  vendor: milkv
  socs:
  - name: sg2000
```

## boards/minnowboard/Kconfig.defconfig
```kconfig
if BOARD_MINNOWBOARD

config BOARD
	default minnowboard

endif # BOARD_MINNOWBOARD
```

## boards/mips/ci40/Kconfig.board
```kconfig
# Kconfig - CI40 board configuration
#
# SPDX-License-Identifier: Apache-2.0
#

config BOARD_CI40
	bool "CI40 Development Board"
	depends on SOC_DANUBE
	select HAS_DTS
```
