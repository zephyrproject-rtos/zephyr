## boards/alif/balletto_b1_sk/Kconfig.balletto_b1_sk
```kconfig
# SPDX-FileCopyrightText: Copyright Alif Semiconductor
# SPDX-License-Identifier: Apache-2.0

config BOARD_BALLETTO_B1_SK
	select SOC_AB1C1F4M51820PH0 if BOARD_BALLETTO_B1_SK_AB1C1F4M51820PH0
```

## boards/alif/balletto_b1_sk/board.yml
```yaml
# SPDX-FileCopyrightText: Copyright Alif Semiconductor
# SPDX-License-Identifier: Apache-2.0

board:
  name: balletto_b1_sk
  full_name: Alif Balletto B1 StartKit
  vendor: alif
  socs:
  - name: ab1c1f4m51820ph0
```

## boards/alif/ensemble_e1c_sk/Kconfig.ensemble_e1c_sk
```kconfig
# SPDX-FileCopyrightText: Copyright Alif Semiconductor
# SPDX-License-Identifier: Apache-2.0

config BOARD_ENSEMBLE_E1C_SK
	select SOC_AE1C1F4051920PH0_RTSS_HE if BOARD_ENSEMBLE_E1C_SK_AE1C1F4051920PH0_RTSS_HE
```

## boards/alif/ensemble_e1c_sk/board.yml
```yaml
# SPDX-FileCopyrightText: Copyright Alif Semiconductor
# SPDX-License-Identifier: Apache-2.0

board:
  name: ensemble_e1c_sk
  full_name: Alif Ensemble E1C StartKit
  vendor: alif
  socs:
  - name: ae1c1f4051920ph0
```

## boards/alif/ensemble_e8_ak/Kconfig.ensemble_e8_ak
```kconfig
# SPDX-FileCopyrightText: Copyright Alif Semiconductor
# SPDX-License-Identifier: Apache-2.0

config BOARD_ENSEMBLE_E8_AK
	select SOC_AE822FA0E5597BS0_APSS if BOARD_ENSEMBLE_E8_AK_AE822FA0E5597BS0_APSS
	select SOC_AE822FA0E5597BS0_RTSS_HE if BOARD_ENSEMBLE_E8_AK_AE822FA0E5597BS0_RTSS_HE
	select SOC_AE822FA0E5597BS0_RTSS_HP if BOARD_ENSEMBLE_E8_AK_AE822FA0E5597BS0_RTSS_HP
```

## boards/alif/ensemble_e8_ak/board.yml
```yaml
board:
  name: ensemble_e8_ak
  full_name: Alif Ensemble E8 AI/ML AppKit
  vendor: alif
  socs:
  - name: ae822fa0e5597bs0
    variants:
    - name: sram
      cpucluster: rtss_he
    - name: sram
      cpucluster: rtss_hp
```

## boards/amd/kv260_r5/Kconfig.defconfig
```kconfig
# Copyright (c) 2022 Linaro.
# SPDX-License-Identifier: Apache-2.0

if BOARD_KV260_R5

config BUILD_OUTPUT_BIN
	default y

if USERSPACE

config COMPILER_ISA_THUMB2
	default n

endif

configdefault ISR_STACK_SIZE
	default 512

endif # BOARD_KV260_R5
```

## boards/andestech/adp_xc7k/Kconfig.adp_xc7k
```kconfig
# Copyright (c) 2021 Andes Technology Corporation
# SPDX-License-Identifier: Apache-2.0

config BOARD_ADP_XC7K
	select SOC_AE350_N22 if BOARD_ADP_XC7K_AE350_N22 || BOARD_ADP_XC7K_AE350_N22_CLIC
	select SOC_AE350_D23 if BOARD_ADP_XC7K_AE350_D23 || BOARD_ADP_XC7K_AE350_D23_CLIC
	select SOC_AE350_A25 if BOARD_ADP_XC7K_AE350_A25
	select SOC_AE350_AX45 if BOARD_ADP_XC7K_AE350_AX45
```

## boards/andestech/adp_xc7k/adp_xc7k_ae350_d25f_defconfig
```kconfig
CONFIG_XIP=n
CONFIG_CONSOLE=y
CONFIG_UART_CONSOLE=y
CONFIG_SERIAL=y
CONFIG_GPIO=y
CONFIG_RISCV_CUSTOM_CSR_ANDES_EXECIT=y
CONFIG_RISCV_CUSTOM_CSR_ANDES_HSP=y
CONFIG_RISCV_CUSTOM_CSR_ANDES_HWDSP=y
CONFIG_RISCV_CUSTOM_CSR_ANDES_PFT=y
```

## boards/andestech/adp_xc7k/board.yml
```yaml
board:
  name: adp_xc7k
  full_name: ADP-XC7K
  vendor: andestech
  socs:
  - name: ae350_d23
    variants:
    - name: clic
  - name: ae350_a25
```

## boards/andestech/adp_xc7k_ae350/adp_xc7k_ae350_smp_defconfig
```kconfig
CONFIG_XIP=n
CONFIG_CONSOLE=y
CONFIG_UART_CONSOLE=y
CONFIG_SERIAL=y
CONFIG_GPIO=y
CONFIG_PMP_GRANULARITY=8

CONFIG_SMP=y
CONFIG_MP_MAX_NUM_CPUS=2
```

## boards/antmicro/myra_sip_baseboard/board.yml
```yaml
board:
  name: myra_sip_baseboard
  full_name: Myra SiP Baseboard
  vendor: antmicro
  socs:
    - name: stm32g491xx
```

## boards/antmicro/stm32h7_hdmi_board/Kconfig.defconfig
```kconfig
# Copyright (c) 2026 Antmicro <www.antmicro.com>
# SPDX-License-Identifier: Apache-2.0

if BOARD_STM32H7_HDMI_BOARD

configdefault NET_L2_ETHERNET
	default y

endif # BOARD_STM32H7_HDMI_BOARD
```

## boards/antmicro/stm32h7_hdmi_board/Kconfig.stm32h7_hdmi_board
```kconfig
# Copyright (c) 2026 Antmicro <www.antmicro.com>
# SPDX-License-Identifier: Apache-2.0

config BOARD_STM32H7_HDMI_BOARD
	select SOC_STM32H747XX_M7 if BOARD_STM32H7_HDMI_BOARD_STM32H747XX_M7
	select SOC_STM32H747XX_M4 if BOARD_STM32H7_HDMI_BOARD_STM32H747XX_M4
```

## boards/antmicro/stm32h7_hdmi_board/board.yml
```yaml
board:
  name: stm32h7_hdmi_board
  full_name: STM32H7 HDMI Board
  vendor: antmicro
  socs:
    - name: stm32h747xx
```

## boards/antmicro/stm32h7_hdmi_board/stm32h7_hdmi_board_stm32h747xx_m4_defconfig
```kconfig
# Copyright (c) 2026 Antmicro <www.antmicro.com>
# SPDX-License-Identifier: Apache-2.0

# Enable MPU
CONFIG_ARM_MPU=y

# Enable HW stack protection
CONFIG_HW_STACK_PROTECTION=y

# Enable uart driver
CONFIG_SERIAL=y

# By default CONSOLE assigned to m7
# CONFIG_CONSOLE=y
# CONFIG_UART_CONSOLE=y
```

## boards/arducam/pico4ml_pro/Kconfig
```kconfig
# SPDX-FileCopyrightText: Copyright The Zephyr Project Contributors
# SPDX-License-Identifier: Apache-2.0

config BOARD_PICO4ML_PRO
	select RP2_FLASH_W25Q080
```

## boards/arducam/pico4ml_pro/Kconfig.defconfig
```kconfig
# SPDX-FileCopyrightText: Copyright The Zephyr Project Contributors
# SPDX-License-Identifier: Apache-2.0

if BOARD_PICO4ML_PRO

if I2C_DW

config I2C_DW_CLOCK_SPEED
	default 125

endif # I2C_DW

config USB_SELF_POWERED
	default n

source "boards/common/usb/Kconfig.cdc_acm_serial.defconfig"

endif # BOARD_PICO4ML_PRO
```

## boards/arducam/pico4ml_pro/Kconfig.pico4ml_pro
```kconfig
# SPDX-FileCopyrightText: Copyright The Zephyr Project Contributors
# SPDX-License-Identifier: Apache-2.0

config BOARD_PICO4ML_PRO
	select SOC_RP2040
```
