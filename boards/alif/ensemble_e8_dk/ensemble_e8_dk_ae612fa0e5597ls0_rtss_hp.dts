/*
 * SPDX-FileCopyrightText: Copyright Alif Semiconductor
 * SPDX-License-Identifier: Apache-2.0
 */

/dts-v1/;

#include <alif/ensemble/ae612fa0e5597ls0.dtsi>
#include <alif/ensemble/ae612fa0e5597ls0_nvic_irq.dtsi>
#include <alif/ensemble/common/ensemble_rtss_hp.dtsi>
#include "ensemble_e8_dk-pinctrl.dtsi"

/ {
	compatible = "alif,ensemble-e8-dk-ae612fa0e5597ls0-rtss-hp";

	chosen {
		zephyr,flash = &mram;
		zephyr,sram = &dtcm;
		zephyr,console = &uart4;
		zephyr,shell-uart = &uart4;
	};
};

&uart4 {
	status = "okay";
	pinctrl-0 = <&pinctrl_uart4>;
	pinctrl-names = "default";
};
