/*
 * SPDX-FileCopyrightText: Copyright Alif Semiconductor
 * SPDX-License-Identifier: Apache-2.0
 */

/dts-v1/;

#include <alif/ensemble/ae402fa0e5597le0.dtsi>
#include <alif/ensemble/ae402fa0e5597le0_nvic_irq.dtsi>
#include <alif/ensemble/common/ensemble_rtss_he.dtsi>
#include "ensemble_e8_dk-pinctrl.dtsi"

/ {
	compatible = "alif,ensemble-e8-dk-ae402fa0e5597le0-rtss-he";

	chosen {
		zephyr,flash = &mram;
		zephyr,sram = &dtcm;
		zephyr,console = &uart2;
		zephyr,shell-uart = &uart2;
	};
};

&uart2 {
	status = "okay";
	pinctrl-0 = <&pinctrl_uart2>;
	pinctrl-names = "default";
};
