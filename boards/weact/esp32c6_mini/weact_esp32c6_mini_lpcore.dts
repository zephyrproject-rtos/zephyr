/*
 * Copyright (c) 2025 Siratul Islam
 *
 * SPDX-License-Identifier: Apache-2.0
 */
/dts-v1/;

#include <espressif/esp32c6/esp32c6_lpcore.dtsi>
#include <espressif/partitions_0x0_default.dtsi>

/ {
	model = "WeAct Studio ESP32-C6-Mini LP Core";
	compatible = "weact,esp32c6-mini";

	chosen {
		zephyr,flash = &flash0;
		zephyr,sram = &ulp_ram;
		zephyr,code-partition = &slot0_lpcore_partition;
		zephyr,console = &lp_uart;
		zephyr,shell-uart = &lp_uart;
	};
};

&flash0 {
	reg = <0x0 DT_SIZE_M(4)>;
	ranges = <0x0 0x0 DT_SIZE_M(4)>;
};

&lp_uart {
	status = "okay";
	current-speed = <115200>;
};
