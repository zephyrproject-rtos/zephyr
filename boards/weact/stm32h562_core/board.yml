## boards/weact/stm32h562_core/board.yml
```yaml
board:
  name: weact_stm32h562_core
  full_name: STM32H562 Core Board
  vendor: weact
  socs:
    - name: stm32h562xx
```

## boards/weact/stm32h5_core/Kconfig.weact_stm32h5_core
```kconfig
# Copyright (c) 2025 Kacper Brzostowski
# SPDX-License-Identifier: Apache-2.0

config BOARD_WEACT_STM32H5_CORE
	select SOC_STM32H562XX
```

## boards/weact/stm32h5_core/board.yml
```yaml
board:
  name: weact_stm32h5_core
  full_name: STM32H5 Core Board
  vendor: weact
  socs:
    - name: stm32h562xx
```

## boards/weact/stm32wb55_core/Kconfig.defconfig
```kconfig
# Copyright (c) 2025 Siratul Islam
# SPDX-License-Identifier: Apache-2.0

# STM32WB55 Core V1.0 board configuration

if BOARD_WEACT_STM32WB55_CORE

config BT_STM32_IPM
	default y
	depends on BT

endif
```

## boards/weact/stm32wb55_core/Kconfig.weact_stm32wb55_core
```kconfig
# Copyright (c) 2025 Siratul Islam
# SPDX-License-Identifier: Apache-2.0

config BOARD_WEACT_STM32WB55_CORE
	select SOC_STM32WB55XX
```

## boards/weact/stm32wb55_core/board.yml
```yaml
board:
  name: weact_stm32wb55_core
  full_name: STM32WB55 Core Board V1.0
  vendor: weact
  socs:
    - name: stm32wb55xx
```

## boards/weact/usb2canfdv1/Kconfig.usb2canfdv1
```kconfig
# Copyright (c) 2024 Henrik Brix Andersen <henrik@brixandersen.dk>
# SPDX-License-Identifier: Apache-2.0

config BOARD_USB2CANFDV1
	select SOC_STM32G0B1XX
```

## boards/weact/usb2canfdv1/board.yml
```yaml
board:
  name: usb2canfdv1
  full_name: USB2CANFDV1
  vendor: weact
  socs:
    - name: stm32g0b1xx
```

## boards/weact/usb2canfdv2/Kconfig.usb2canfdv2
```kconfig
# SPDX-FileCopyrightText: Copyright (c) 2026 Henrik Brix Andersen <henrik@brixandersen.dk>
# SPDX-License-Identifier: Apache-2.0

config BOARD_USB2CANFDV2
	select SOC_STM32G431XX
```

## boards/weact/usb2canfdv2/board.yml
```yaml
board:
  name: usb2canfdv2
  full_name: USB2CANFDV2
  vendor: weact
  socs:
    - name: stm32g431xx
```

## boards/weact/weact_esp32s3_b/Kconfig.sysbuild
```kconfig
# Copyright (c) 2024 Espressif Systems (Shanghai) Co., Ltd.
# Copyright (c) 2025 Siratul Islam <sirat4757@gmail.com>
# SPDX-License-Identifier: Apache-2.0

choice BOOTLOADER
	default BOOTLOADER_MCUBOOT
endchoice

choice BOOT_SIGNATURE_TYPE
	default BOOT_SIGNATURE_TYPE_NONE
endchoice
```

## boards/weact/weact_esp32s3_b/board.yml
```yaml
board:
  name: weact_esp32s3_b
  full_name: WeAct Studio ESP32-S3-B
  vendor: weact
  socs:
    - name: esp32s3
```

## boards/wemos/esp32s2_lolin_mini/Kconfig
```kconfig
# Copyright (c) 2023 Google, LLC
# SPDX-License-Identifier: Apache-2.0

config HEAP_MEM_POOL_ADD_SIZE_BOARD
	int
	default 4096
```

## boards/wemos/esp32s2_lolin_mini/Kconfig.defconfig
```kconfig
# ESP32S2 LOLIN S2 MINI board configuration

# Copyright (c) 2023 Google, LLC
# SPDX-License-Identifier: Apache-2.0

config ENTROPY_GENERATOR
	default y
```

## boards/wemos/esp32s2_lolin_mini/Kconfig.esp32s2_lolin_mini
```kconfig
# ESP32S2 LOLIN S2 MINI board configuration

# Copyright (c) 2023 Google, LLC
# SPDX-License-Identifier: Apache-2.0

config BOARD_ESP32S2_LOLIN_MINI
	select SOC_ESP32S2_FN4R2
```

## boards/wemos/esp32s2_lolin_mini/board.yml
```yaml
board:
  name: esp32s2_lolin_mini
  full_name: ESP32-S2 Lolin Mini
  vendor: wemos
  socs:
  - name: esp32s2
```

## boards/wemos/lolin32_lite/Kconfig
```kconfig
# Copyright (c) 2025 Siratul Islam <email@sirat.me>
# SPDX-License-Identifier: Apache-2.0

config HEAP_MEM_POOL_ADD_SIZE_BOARD
	int
	default 4096 if BOARD_LOLIN32_LITE_ESP32_PROCPU
	default 256 if BOARD_LOLIN32_LITE_ESP32_APPCPU
```

## boards/wemos/lolin32_lite/Kconfig.lolin32_lite
```kconfig
# Copyright (c) 2025 Siratul Islam <email@sirat.me>
# SPDX-License-Identifier: Apache-2.0

config BOARD_LOLIN32_LITE
	select SOC_ESP32_WROVER_E_N4R8
	select SOC_ESP32_PROCPU if BOARD_LOLIN32_LITE_ESP32_PROCPU
	select SOC_ESP32_APPCPU if BOARD_LOLIN32_LITE_ESP32_APPCPU
```

## boards/wemos/lolin32_lite/Kconfig.sysbuild
```kconfig
# Copyright (c) 2025 Siratul Islam <email@sirat.me>
# SPDX-License-Identifier: Apache-2.0

choice BOOTLOADER
	default BOOTLOADER_MCUBOOT
endchoice

choice BOOT_SIGNATURE_TYPE
	default BOOT_SIGNATURE_TYPE_NONE
endchoice
```

## boards/wemos/lolin32_lite/board.yml
```yaml
board:
  name: lolin32_lite
  full_name: Wemos Lolin32 Lite
  vendor: wemos
  socs:
    - name: esp32
```

## boards/wemos/lolin32_lite/lolin32_lite_appcpu_defconfig
```kconfig
# SPDX-License-Identifier: Apache-2.0

CONFIG_CLOCK_CONTROL=y

# For ESP32-D0WDQ6 variants
CONFIG_ESP32_USE_UNSUPPORTED_REVISION=y
```

## boards/wemos/lolin32_lite/lolin32_lite_procpu_defconfig
```kconfig
# Copyright (c) 2025 Siratul Islam <email@sirat.me>
# SPDX-License-Identifier: Apache-2.0

CONFIG_CONSOLE=y
CONFIG_SERIAL=y
CONFIG_UART_CONSOLE=y

CONFIG_GPIO=y

# For ESP32-D0WDQ6 variants
CONFIG_ESP32_USE_UNSUPPORTED_REVISION=y
```

## boards/witte/linum/Kconfig.linum
```kconfig
# Copyright (c) 2024 Felipe Neves
# SPDX-License-Identifier: Apache-2.0

config BOARD_LINUM
	select SOC_STM32H753XX
```

## boards/witte/linum/board.yml
```yaml
board:
  name: linum
  full_name: Linum Board
  vendor: witte
  socs:
    - name: stm32h753xx
```
