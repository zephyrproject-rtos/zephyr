## boards/weact/can485dbv1/can485dbv1_procpu_defconfig
```kconfig
# SPDX-FileCopyrightText: Copyright (c) 2026 Navimatix GmbH
# SPDX-FileCopyrightText: Copyright (c) 2026 TiaC Systems
# SPDX-License-Identifier: Apache-2.0

CONFIG_CONSOLE=y
CONFIG_SERIAL=y
CONFIG_UART_CONSOLE=y

CONFIG_GPIO=y
```

## boards/weact/ch32v00x_core/Kconfig.ch32v00x_core
```kconfig
# SPDX-FileCopyrightText: Copyright Michael Hope <michaelh@juju.nz>
# SPDX-License-Identifier: Apache-2.0

config BOARD_CH32V00X_CORE
	select SOC_CH32V006
```

## boards/weact/ch32v00x_core/board.yml
```yaml
board:
  name: ch32v00x_core
  full_name: WeActStudio CH32V00xCoreBoard
  vendor: weact
  socs:
    - name: ch32v006
```

## boards/weact/ch592f_minible/Kconfig.ch592f_minible
```kconfig
# Copyright (c) 2026 Mike Kasprzak (distraction.engineer)
# SPDX-License-Identifier: Apache-2.0

config BOARD_CH592F_MINIBLE
	select SOC_CH592F
```

## boards/weact/ch592f_minible/board.yml
```yaml
board:
  name: ch592f_minible
  full_name: WeActStudio CH592F Mini BLE Core Board
  vendor: weact
  socs:
    - name: ch592f
```

## boards/weact/esp32c3_mini/Kconfig
```kconfig
# Copyright (c) 2025 Siratul Islam
# SPDX-License-Identifier: Apache-2.0

config HEAP_MEM_POOL_ADD_SIZE_BOARD
	int
	default 4096
```

## boards/weact/esp32c3_mini/Kconfig.sysbuild
```kconfig
# Copyright (c) 2023 Espressif Systems (Shanghai) Co., Ltd.
# Copyright (c) 2025 Siratul Islam
# SPDX-License-Identifier: Apache-2.0

choice BOOTLOADER
	default BOOTLOADER_MCUBOOT
endchoice

choice BOOT_SIGNATURE_TYPE
	default BOOT_SIGNATURE_TYPE_NONE
endchoice
```

## boards/weact/esp32c3_mini/Kconfig.weact_esp32c3_mini
```kconfig
# ESP32-C6-Mini board configuration

# Copyright (c) 2025 Siratul Islam
# SPDX-License-Identifier: Apache-2.0

config BOARD_WEACT_ESP32C3_MINI
	select SOC_ESP32C3_FH4
```

## boards/weact/esp32c3_mini/board.yml
```yaml
board:
  name: weact_esp32c3_mini
  full_name: ESP32-C3-Mini
  vendor: weact
  socs:
    - name: esp32c3
```

## boards/weact/esp32c6_mini/Kconfig
```kconfig
# Copyright (c) 2025 Siratul Islam
# SPDX-License-Identifier: Apache-2.0

config HEAP_MEM_POOL_ADD_SIZE_BOARD
	int
	default 4096 if BOARD_WEACT_ESP32C6_MINI_ESP32C6_HPCORE
	default 256 if BOARD_WEACT_ESP32C6_MINI_ESP32C6_LPCORE
```

## boards/weact/esp32c6_mini/Kconfig.weact_esp32c6_mini
```kconfig
# ESP32-C6-Mini board configuration

# Copyright (c) 2025 Siratul Islam
# SPDX-License-Identifier: Apache-2.0

config BOARD_WEACT_ESP32C6_MINI
	select SOC_ESP32_C6_WROOM_1U_N4
	select SOC_ESP32C6_HPCORE if BOARD_WEACT_ESP32C6_MINI_ESP32C6_HPCORE
	select SOC_ESP32C6_LPCORE if BOARD_WEACT_ESP32C6_MINI_ESP32C6_LPCORE
```

## boards/weact/esp32c6_mini/board.yml
```yaml
board:
  name: weact_esp32c6_mini
  full_name: ESP32-C6-Mini
  vendor: weact
  socs:
    - name: esp32c6
```

## boards/weact/esp32c6_mini/weact_esp32c6_mini_lpcore_defconfig
```kconfig
# Copyright (c) 2025 Espressif Systems (Shanghai) Co., Ltd.
# Copyright (c) 2025 Siratul Islam
# SPDX-License-Identifier: Apache-2.0

# Memory protection
CONFIG_THREAD_STACK_INFO=n
CONFIG_THREAD_CUSTOM_DATA=n

# Boot
CONFIG_BOOT_BANNER=n

# Console
CONFIG_SERIAL=y
CONFIG_CONSOLE=y
CONFIG_UART_CONSOLE=y
CONFIG_PRINTK=n
CONFIG_CBPRINTF_NANO=y

# Build
CONFIG_SIZE_OPTIMIZATIONS=y
CONFIG_BUSYWAIT_CPU_LOOPS_PER_USEC=4
```

## boards/weact/esp32s3_b/Kconfig
```kconfig
# Copyright (c) 2024 Espressif Systems (Shanghai) Co., Ltd.
# Copyright (c) 2025 Siratul Islam <sirat4757@gmail.com>
# SPDX-License-Identifier: Apache-2.0

config HEAP_MEM_POOL_ADD_SIZE_BOARD
	int
	default 4096 if BOARD_WEACT_ESP32S3_B_ESP32S3_PROCPU
	default 256 if BOARD_WEACT_ESP32S3_B_ESP32S3_APPCPU
```

## boards/weact/esp32s3_b/Kconfig.weact_esp32s3_b
```kconfig
# Copyright (c) 2024 Espressif Systems (Shanghai) Co., Ltd.
# Copyright (c) 2025 Siratul Islam <sirat4757@gmail.com>
# SPDX-License-Identifier: Apache-2.0

config BOARD_WEACT_ESP32S3_B
	select SOC_ESP32S3_WROOM_N8
	select SOC_ESP32S3_PROCPU if BOARD_WEACT_ESP32S3_B_ESP32S3_PROCPU
	select SOC_ESP32S3_APPCPU if BOARD_WEACT_ESP32S3_B_ESP32S3_APPCPU
```

## boards/weact/esp32s3_b/board.yml
```yaml
board:
  name: weact_esp32s3_b
  full_name: ESP32-S3-B
  vendor: weact
  socs:
    - name: esp32s3
```

## boards/weact/esp32s3_mini/Kconfig
```kconfig
# Copyright (c) 2025 Siratul Islam <sirat4757@gmail.com>
# SPDX-License-Identifier: Apache-2.0

config HEAP_MEM_POOL_ADD_SIZE_BOARD
	int
	default 4096 if BOARD_WEACT_ESP32S3_MINI_ESP32S3_PROCPU
	default 256 if BOARD_WEACT_ESP32S3_MINI_ESP32S3_APPCPU
```

## boards/weact/esp32s3_mini/Kconfig.weact_esp32s3_mini
```kconfig
# Copyright (c) 2025 Siratul Islam <sirat4757@gmail.com>
# SPDX-License-Identifier: Apache-2.0

config BOARD_WEACT_ESP32S3_MINI
	select SOC_ESP32S3_MINI_N4R2
	select SOC_ESP32S3_PROCPU if BOARD_WEACT_ESP32S3_MINI_ESP32S3_PROCPU
	select SOC_ESP32S3_APPCPU if BOARD_WEACT_ESP32S3_MINI_ESP32S3_APPCPU
```

## boards/weact/esp32s3_mini/board.yml
```yaml
board:
  name: weact_esp32s3_mini
  full_name: ESP32-S3-Mini
  vendor: weact
  socs:
    - name: esp32s3
```

## boards/weact/mini_stm32h743/Kconfig.defconfig
```kconfig
# WeAct Studio MiniSTM32H7 board configuration

# Copyright (c) Charles Dias <charlesdias.cd@outlook.com>
# SPDX-License-Identifier: Apache-2.0

if BOARD_MINI_STM32H743

if DISPLAY

config INPUT
	default y

if LVGL

configdefault LV_COLOR_16_SWAP
	default y

config LV_Z_BITS_PER_PIXEL
	default 16

endif # LVGL

endif # DISPLAY

source "boards/common/usb/Kconfig.cdc_acm_serial.defconfig"

endif # BOARD_MINI_STM32H743
```

## boards/weact/mini_stm32h743/Kconfig.mini_stm32h743
```kconfig
# Copyright (c) 2024 Charles Dias <charlesdias.cd@outlook.com>
# SPDX-License-Identifier: Apache-2.0

config BOARD_MINI_STM32H743
	select SOC_STM32H743XX
```

## boards/weact/mini_stm32h743/board.yml
```yaml
board:
  name: mini_stm32h743
  full_name: MiniSTM32H743 Core Board
  vendor: weact
  socs:
    - name: stm32h743xx
```

## boards/weact/mini_stm32h743/mini_stm32h743_defconfig
```kconfig
# Copyright (c) Charles Dias <charlesdias.cd@outlook.com>
# SPDX-License-Identifier: Apache-2.0

# Enable MPU
CONFIG_ARM_MPU=y

# Enable HW stack protection
CONFIG_HW_STACK_PROTECTION=y

# Enable UART driver
CONFIG_SERIAL=y

# Enable console
CONFIG_CONSOLE=y

# Enable GPIO
CONFIG_GPIO=y
```

## boards/weact/mini_stm32h750/Kconfig.mini_stm32h750
```kconfig
# SPDX-FileCopyrightText: Copyright The Zephyr Project Contributors
# SPDX-License-Identifier: Apache-2.0

config BOARD_MINI_STM32H750
	select SOC_STM32H750XX
```

## boards/weact/mini_stm32h750/Kconfig.sysbuild
```kconfig
# SPDX-FileCopyrightText: Copyright The Zephyr Project Contributors
# SPDX-License-Identifier: Apache-2.0

if BOARD_MINI_STM32H750_STM32H750XX_EXT_FLASH_APP

choice BOOTLOADER
	default BOOTLOADER_MCUBOOT
endchoice

choice BOOT_SIGNATURE_TYPE
	default BOOT_SIGNATURE_TYPE_NONE
endchoice

endif # BOARD_MINI_STM32H750_STM32H750XX_EXT_FLASH_APP
```
