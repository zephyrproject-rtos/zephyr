## boards/weact/mini_stm32h750/board.yml
```yaml
board:
  name: mini_stm32h750
  full_name: MiniSTM32H750 Core Board
  vendor: weact
  socs:
    - name: stm32h750xx
      variants:
        - name: ext_flash_app
```

## boards/weact/mini_stm32h7b0/Kconfig.defconfig
```kconfig
# Copyright (c) 2024 Linaro Limited
# SPDX-License-Identifier: Apache-2.0

# WeAct Studio MiniSTM32H7B0 board configuration

if BOARD_MINI_STM32H7B0

if DISPLAY

config INPUT
	default y

if LVGL

configdefault LV_COLOR_16_SWAP
	default y

config LV_Z_BITS_PER_PIXEL
	default 16

endif # LVGL

endif # DISPLAY

source "boards/common/usb/Kconfig.cdc_acm_serial.defconfig"

endif # BOARD_MINI_STM32H7B0
```

## boards/weact/mini_stm32h7b0/Kconfig.mini_stm32h7b0
```kconfig
# Copyright (c) 2024 Linaro Limited
# SPDX-License-Identifier: Apache-2.0

config BOARD_MINI_STM32H7B0
	select SOC_STM32H7B0XX
```

## boards/weact/mini_stm32h7b0/board.yml
```yaml
board:
  name: mini_stm32h7b0
  full_name: MiniSTM32H7B0 Core Board
  vendor: weact
  socs:
    - name: stm32h7b0xx
```

## boards/weact/mini_stm32h7b0/mini_stm32h7b0_defconfig
```kconfig
# Copyright (c) 2024 Linaro Limited
# SPDX-License-Identifier: Apache-2.0

# Enable MPU
CONFIG_ARM_MPU=y

# Enable HW stack protection
CONFIG_HW_STACK_PROTECTION=y

# Enable GPIO
CONFIG_GPIO=y
```

## boards/weact/ra4m1_core/Kconfig.weact_ra4m1_core
```kconfig
# Copyright (c) 2024 Renesas Electronics Corporation'
# Copyright (c) 2026 Henry Xin
# SPDX-License-Identifier: Apache-2.0

config BOARD_WEACT_RA4M1_CORE
	select SOC_R7FA4M1AB3CFM
```

## boards/weact/ra4m1_core/board.yml
```yaml
board:
  name: weact_ra4m1_core
  full_name: WeAct RA4M1 Core Board
  vendor: weact
  socs:
    - name: r7fa4m1ab3cfm
```

## boards/weact/rp2350b_core/Kconfig.rp2350b_core
```kconfig
# Copyright (c) 2026 MASSDRIVER EI (massdriver.space)
# SPDX-License-Identifier: Apache-2.0

config BOARD_RP2350B_CORE
	select SOC_RP2350B_HAZARD3 if BOARD_RP2350B_CORE_RP2350B_HAZARD3
	select SOC_RP2350B_M33 if BOARD_RP2350B_CORE_RP2350B_M33
```

## boards/weact/rp2350b_core/board.yml
```yaml
board:
  name: rp2350b_core
  full_name: WeAct RP2350B Core
  vendor: weact
  socs:
    - name: rp2350b
```

## boards/weact/stm32f405_core/Kconfig.weact_stm32f405_core
```kconfig
# Copyright (c) 2024 Pavlo Yadvychuk
# SPDX-License-Identifier: Apache-2.0

config BOARD_WEACT_STM32F405_CORE
	select SOC_STM32F405XX
```

## boards/weact/stm32f405_core/board.yml
```yaml
board:
  name: weact_stm32f405_core
  full_name: STM32F405 Core Board V1.0
  vendor: weact
  socs:
    - name: stm32f405xx
```

## boards/weact/stm32f446_core/Kconfig.weact_stm32f446_core
```kconfig
# Copyright (c) 2025 Siratul Islam
# SPDX-License-Identifier: Apache-2.0

config BOARD_WEACT_STM32F446_CORE
	select SOC_STM32F446XX
```

## boards/weact/stm32f446_core/board.yml
```yaml
board:
  name: weact_stm32f446_core
  full_name: STM32F446 Core Board V1.1
  vendor: weact
  socs:
    - name: stm32f446xx
```

## boards/weact/stm32g030_core/Kconfig.defconfig
```kconfig
# STM32G030 Core V1.0 board configuration

# Copyright (c) 2025 Siratul Islam
# SPDX-License-Identifier: Apache-2.0

if BOARD_WEACT_STM32G030_CORE

config SPI_STM32_INTERRUPT
	default y
	depends on SPI

endif # BOARD_WEACT_STM32G030_CORE
```

## boards/weact/stm32g030_core/Kconfig.weact_stm32g030_core
```kconfig
# Copyright (c) 2025 Siratul Islam
# SPDX-License-Identifier: Apache-2.0

config BOARD_WEACT_STM32G030_CORE
	select SOC_STM32G030XX
```

## boards/weact/stm32g030_core/board.yml
```yaml
board:
  name: weact_stm32g030_core
  full_name: STM32G030 Core Board 1.0
  vendor: weact
  socs:
    - name: stm32g030xx
```

## boards/weact/stm32g0b1_core/Kconfig.weact_stm32g0b1_core
```kconfig
# Copyright (c) 2024 Henrik Brix Andersen <henrik@brixandersen.dk>
# Copyright (c) 2026 Paul Wedeck <paulwedeck@gmail.com>
# SPDX-License-Identifier: Apache-2.0

config BOARD_WEACT_STM32G0B1_CORE
	select SOC_STM32G0B1XX
```

## boards/weact/stm32g0b1_core/board.yml
```yaml
board:
  name: weact_stm32g0b1_core
  full_name: STM32G0B1 Core Board
  vendor: weact
  socs:
    - name: stm32g0b1xx
```

## boards/weact/stm32g0b1_core/weact_stm32g0b1_core_defconfig
```kconfig
CONFIG_ARM_MPU=y
CONFIG_GPIO=y
CONFIG_SERIAL=y
CONFIG_CONSOLE=y
CONFIG_UART_CONSOLE=y
CONFIG_UART_INTERRUPT_DRIVEN=y
```

## boards/weact/stm32g431_core/Kconfig.weact_stm32g431_core
```kconfig
# Copyright (c) 2023 Andreas Sandberg
# SPDX-License-Identifier: Apache-2.0

config BOARD_WEACT_STM32G431_CORE
	select SOC_STM32G431XX
```

## boards/weact/stm32g431_core/board.yml
```yaml
board:
  name: weact_stm32g431_core
  full_name: STM32G431 Core Board
  vendor: weact
  socs:
    - name: stm32g431xx
```

## boards/weact/stm32g431_core/weact_stm32g431_core_defconfig
```kconfig
#
# Copyright (c) 2023 Andreas Sandberg
#
# SPDX-License-Identifier: Apache-2.0
#

CONFIG_CLOCK_CONTROL=y
CONFIG_PINCTRL=y

CONFIG_ARM_MPU=y
CONFIG_HW_STACK_PROTECTION=y

CONFIG_GPIO=y

CONFIG_SERIAL=y
CONFIG_UART_INTERRUPT_DRIVEN=y
CONFIG_CONSOLE=y
CONFIG_UART_CONSOLE=y
```

## boards/weact/stm32g474_core/board.yml
```yaml
board:
  name: weact_stm32g474_core
  full_name: STM32G474 Core Board
  vendor: weact
  socs:
    - name: stm32g474xx
```

## boards/weact/stm32h562_core/Kconfig.defconfig
```kconfig
# Always set CONFIG_BOARD here. This isn't meant to be customized,
# but is set as a "default" due to Kconfig language restrictions.
config BOARD
    default "weact_stm32h562_core"
    depends on BOARD_WEACT_STM32H562_CORE
```
