## boards/renesas/rcar_h3ulcb/Kconfig.rcar_h3ulcb
```kconfig
# Copyright (c) 2023 EPAM Systems
# SPDX-License-Identifier: Apache-2.0

config BOARD_RCAR_H3ULCB
	select SOC_R8A77951_R7 if BOARD_RCAR_H3ULCB_R8A77951_R7
	select SOC_R8A77951_A57 if BOARD_RCAR_H3ULCB_R8A77951_A57
```

## boards/renesas/rcar_h3ulcb/board.yml
```yaml
board:
  name: rcar_h3ulcb
  full_name: R-Car H3ULCB
  vendor: renesas
  socs:
  - name: r8a77951
```

## boards/renesas/rcar_h3ulcb/rcar_h3ulcb_r8a77951_a57_defconfig
```kconfig
# Copyright (c) 2023 EPAM Systems
# SPDX-License-Identifier: Apache-2.0

# Cache management
CONFIG_CACHE_MANAGEMENT=y

# Enable UART driver
CONFIG_SERIAL=y
CONFIG_AARCH64_IMAGE_HEADER=y
CONFIG_SYS_CLOCK_HW_CYCLES_PER_SEC=8300000
CONFIG_XIP=n

CONFIG_MAX_XLAT_TABLES=24
CONFIG_ARMV8_A_NS=y

# Enable console
CONFIG_CONSOLE=y
CONFIG_UART_CONSOLE=y

# Enable clock control
CONFIG_CLOCK_CONTROL=y
```

## boards/renesas/rcar_ironhide_x5h/Kconfig.rcar_ironhide_x5h
```kconfig
# Copyright (c) 2026 BayLibre, SAS
# SPDX-License-Identifier: Apache-2.0

config BOARD_RCAR_IRONHIDE_X5H
	select SOC_R8A78000_R52 if BOARD_RCAR_IRONHIDE_X5H_R8A78000_R52
```

## boards/renesas/rcar_ironhide_x5h/board.yml
```yaml
board:
  name: rcar_ironhide_x5h
  full_name: R-Car Ironhide
  vendor: renesas
  socs:
  - name: r8a78000
```

## boards/renesas/rcar_ironhide_x5h/rcar_ironhide_x5h_r8a78000_a720_defconfig
```kconfig
# Copyright (c) 2026 Renesas Electronics Corporation
# SPDX-License-Identifier: Apache-2.0

CONFIG_CLOCK_CONTROL=y
CONFIG_ARM_MMU=y
CONFIG_ARMV8_A_NS=y
```

## boards/renesas/rcar_ironhide_x5h/rcar_ironhide_x5h_r8a78000_r52_defconfig
```kconfig
# SCMI-related configurations
CONFIG_MBOX=y
CONFIG_ARM_SCMI=y

# Clock-related configurations
CONFIG_CLOCK_CONTROL=y

# Serial interface-related configurations
CONFIG_SERIAL=y
CONFIG_UART_INTERRUPT_DRIVEN=y
CONFIG_CONSOLE=y
CONFIG_UART_CONSOLE=y

# GPIO-related configurations
CONFIG_GPIO=y
```

## boards/renesas/rcar_salvator_x/Kconfig.rcar_salvator_x
```kconfig
# Copyright (c) 2022 BayLibre, SAS
# SPDX-License-Identifier: Apache-2.0

config BOARD_RCAR_SALVATOR_X
	select SOC_R8A77951_R7
```

## boards/renesas/rcar_salvator_x/board.yml
```yaml
board:
  name: rcar_salvator_x
  full_name: R-Car Salvator-X
  vendor: renesas
  socs:
  - name: r8a77951
```

## boards/renesas/rcar_salvator_xs/Kconfig.defconfig
```kconfig
# Copyright (c) 2023 EPAM Systems
# SPDX-License-Identifier: Apache-2.0

if BOARD_RCAR_SALVATOR_XS

config BUILD_OUTPUT_BIN
	default y

endif # BOARD_RCAR_SALVATOR_XS
```

## boards/renesas/rcar_salvator_xs/Kconfig.rcar_salvator_xs
```kconfig
# Copyright (c) 2023 EPAM Systems
# SPDX-License-Identifier: Apache-2.0

config BOARD_RCAR_SALVATOR_XS
	select SOC_R8A77961
```

## boards/renesas/rcar_salvator_xs/board.yml
```yaml
board:
  name: rcar_salvator_xs
  full_name: R-Car Salvator-XS
  vendor: renesas
  socs:
  - name: r8a77961
```

## boards/renesas/rcar_spider_s4/Kconfig.defconfig
```kconfig
# Copyright (c) 2024 EPAM Systems
# SPDX-License-Identifier: Apache-2.0

config BUILD_OUTPUT_BIN
	default y if BOARD_RCAR_SPIDER_S4_R8A779F0_A55
```

## boards/renesas/rcar_spider_s4/Kconfig.rcar_spider_s4
```kconfig
# Copyright (c) 2023 IoT.bzh
# SPDX-License-Identifier: Apache-2.0

config BOARD_RCAR_SPIDER_S4
	select SOC_R8A779F0_R52 if BOARD_RCAR_SPIDER_S4_R8A779F0_R52
	select SOC_R8A779F0_A55 if BOARD_RCAR_SPIDER_S4_R8A779F0_A55
```

## boards/renesas/rcar_spider_s4/board.yml
```yaml
board:
  name: rcar_spider_s4
  full_name: R-Car Spider
  vendor: renesas
  socs:
  - name: r8a779f0
```

## boards/renesas/rcar_spider_s4/rcar_spider_s4_r8a779f0_a55_defconfig
```kconfig
# Cache management
CONFIG_CACHE_MANAGEMENT=y

# Enable UART driver
CONFIG_SERIAL=y

# Enable console
CONFIG_CONSOLE=y
CONFIG_UART_CONSOLE=y
CONFIG_UART_INTERRUPT_DRIVEN=y

# Enable clock control
CONFIG_CLOCK_CONTROL=y
CONFIG_SYS_CLOCK_HW_CYCLES_PER_SEC=16666666

CONFIG_AARCH64_IMAGE_HEADER=y
CONFIG_XIP=n
CONFIG_MAX_XLAT_TABLES=24
CONFIG_ARMV8_A_NS=y
```

## boards/renesas/rcar_spider_s4/rcar_spider_s4_r8a779f0_r52_defconfig
```kconfig
CONFIG_CLOCK_CONTROL=y
CONFIG_SYS_CLOCK_HW_CYCLES_PER_SEC=12500000
CONFIG_CONSOLE=y
CONFIG_RAM_CONSOLE=y
CONFIG_FLASH_SIZE=0
CONFIG_FLASH_BASE_ADDRESS=0
CONFIG_SERIAL=y
CONFIG_UART_CONSOLE=y
CONFIG_UART_INTERRUPT_DRIVEN=y
CONFIG_GPIO=y
```

## boards/renesas/rsk_rx130/Kconfig.rsk_rx130
```kconfig
# Copyright (c) 2024 Renesas Electronics Corporation
# SPDX-License-Identifier: Apache-2.0

config BOARD_RSK_RX130
	select SOC_R5F51308AXFP
```

## boards/renesas/rsk_rx130/board.yml
```yaml
board:
  name: rsk_rx130
  full_name: Renesas Starter Kit for RX130
  vendor: renesas
  revision:
    format: custom
    default: 512kb
    exact: true
    revisions:
      - name: 512kb
      - name: 128kb
  socs:
    - name: r5f51308axfp
```

## boards/renesas/rsk_rx140/Kconfig.rsk_rx140
```kconfig
# Copyright (c) 2025 Renesas Electronics Corporation
# SPDX-License-Identifier: Apache-2.0

config BOARD_RSK_RX140
	select SOC_R5F51406BDFN
```

## boards/renesas/rsk_rx140/board.yml
```yaml
board:
  name: rsk_rx140
  full_name: Renesas Starter Kit for RX140
  vendor: renesas
  socs:
    - name: r5f51406bdfn
```

## boards/renesas/rssk_ra2l1/Kconfig.rssk_ra2l1
```kconfig
# Copyright (c) 2025 Renesas Electronics Corporation
# SPDX-License-Identifier: Apache-2.0

config BOARD_RSSK_RA2L1
	select SOC_R7FA2L1ABXXFP
```

## boards/renesas/rssk_ra2l1/board.yml
```yaml
board:
  name: rssk_ra2l1
  full_name: Capacitive Touch Evaluation System for RA2L1
  vendor: renesas
  socs:
  - name: r7fa2l1abxxfp
```

## boards/renesas/rza2m_evk/Kconfig.rza2m_evk
```kconfig
# Copyright (c) 2025 Renesas Electronics Corporation
# SPDX-License-Identifier: Apache-2.0

config BOARD_RZA2M_EVK
	select SOC_R7S921053VCBG
```
