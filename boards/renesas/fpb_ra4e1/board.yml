## boards/renesas/fpb_ra4e1/board.yml
```yaml
board:
  name: fpb_ra4e1
  full_name: RA4E1 Fast Prototyping Board
  vendor: renesas
  socs:
  - name: r7fa4e10d2cfm
```

## boards/renesas/fpb_ra6e1/Kconfig.fpb_ra6e1
```kconfig
# Copyright (c) 2024 Renesas Electronics Corporation
# SPDX-License-Identifier: Apache-2.0

config BOARD_FPB_RA6E1
	select SOC_R7FA6E10F2CFP
```

## boards/renesas/fpb_ra6e1/board.yml
```yaml
board:
  name: fpb_ra6e1
  full_name: RA6E1 Fast Prototyping Board
  vendor: renesas
  socs:
  - name: r7fa6e10f2cfp
```

## boards/renesas/fpb_ra6e1/fpb_ra6e1_defconfig
```kconfig
# Copyright (c) 2024 Renesas Electronics Corporation
# SPDX-License-Identifier: Apache-2.0

CONFIG_SYS_CLOCK_HW_CYCLES_PER_SEC=200000000

# Enable GPIO
CONFIG_GPIO=y

CONFIG_BUILD_OUTPUT_HEX=y
CONFIG_BUILD_NO_GAP_FILL=y

# Enable Console
CONFIG_SERIAL=y
CONFIG_UART_INTERRUPT_DRIVEN=y
CONFIG_UART_CONSOLE=y
CONFIG_CONSOLE=y

CONFIG_CLOCK_CONTROL=y
```

## boards/renesas/fpb_ra6e2/Kconfig.fpb_ra6e2
```kconfig
# Copyright (c) 2024 Renesas Electronics Corporation
# SPDX-License-Identifier: Apache-2.0

config BOARD_FPB_RA6E2
	select SOC_R7FA6E2BB3CFM
```

## boards/renesas/fpb_ra6e2/board.yml
```yaml
board:
  name: fpb_ra6e2
  full_name: RA6E2 Fast Prototyping Board
  vendor: renesas
  socs:
  - name: r7fa6e2bb3cfm
```

## boards/renesas/fpb_ra8e1/Kconfig.fpb_ra8e1
```kconfig
# Copyright (c) 2026 Renesas Electronics Corporation
# SPDX-License-Identifier: Apache-2.0

config BOARD_FPB_RA8E1
	select SOC_R7FA8E1AFDCFB
```

## boards/renesas/fpb_ra8e1/board.yml
```yaml
board:
  name: fpb_ra8e1
  full_name: Fast Prototyping Board for RA8E1 MCU Group
  vendor: renesas
  socs:
  - name: r7fa8e1afdcfb
```

## boards/renesas/fpb_rx140/Kconfig.fpb_rx140
```kconfig
# Copyright (c) 2024 Renesas Electronics Corporation
# SPDX-License-Identifier: Apache-2.0

config BOARD_FPB_RX140
	select SOC_R5F51406BGFN
```

## boards/renesas/fpb_rx140/board.yml
```yaml
board:
  name: fpb_rx140
  full_name: Fast Prototyping Board for RX140
  vendor: renesas
  socs:
    - name: r5f51406bgfn
```

## boards/renesas/fpb_rx14t/Kconfig.fpb_rx14t
```kconfig
# Copyright (c) 2026 Renesas Electronics Corporation
# SPDX-License-Identifier: Apache-2.0

config BOARD_FPB_RX14T
	select SOC_R5F514T5AMFM
```

## boards/renesas/fpb_rx14t/board.yml
```yaml
board:
  name: fpb_rx14t
  full_name: RX14T Fast Prototyping Board
  vendor: renesas
  socs:
  - name: r5f514t5amfm
```

## boards/renesas/fpb_rx261/Kconfig.fpb_rx261
```kconfig
# Copyright (c) 2025 Renesas Electronics Corporation
# SPDX-License-Identifier: Apache-2.0

config BOARD_FPB_RX261
	select SOC_R5F52618BGFP
```

## boards/renesas/fpb_rx261/board.yml
```yaml
board:
  name: fpb_rx261
  full_name: RX261 Fast Prototyping Board
  vendor: renesas
  socs:
  - name: r5f52618bgfp
```

## boards/renesas/mcb_rx14t/board.yml
```yaml
board:
  name: mcb_rx14t
  full_name: RX14T Motor Control Board
  vendor: renesas
  socs:
  - name: r5f514t5amfm
```

## boards/renesas/mcb_rx26t/Kconfig.mcb_rx26t
```kconfig
# Copyright (c) 2025 Renesas Electronics Corporation
# SPDX-License-Identifier: Apache-2.0

config BOARD_MCB_RX26T
	select SOC_R5F526TFDDFP
```

## boards/renesas/mcb_rx26t/board.yml
```yaml
board:
  name: mcb_rx26t
  full_name: RX26T Motor Control Board
  vendor: renesas
  revision:
    format: custom
    default: typeb
    exact: true
    revisions:
      - name: typea
      - name: typeb
      - name: typec
  socs:
    - name: r5f526tfddfp
```

## boards/renesas/mcb_rx26t/mcb_rx26t_defconfig
```kconfig
# Copyright (c) 2025 Renesas Electronics Corporation
# SPDX-License-Identifier: Apache-2.0

# Enable GPIO
CONFIG_GPIO=y

# Enable UART driver
CONFIG_SERIAL=y
CONFIG_UART_INTERRUPT_DRIVEN=n

# Enable console
CONFIG_CONSOLE=y
CONFIG_UART_CONSOLE=y
```

## boards/renesas/mck_ra4t1/Kconfig.mck_ra4t1
```kconfig
# Copyright (c) 2025 Renesas Electronics Corporation
# SPDX-License-Identifier: Apache-2.0

config BOARD_MCK_RA4T1
	select SOC_R7FA4T1BB3CFM
```

## boards/renesas/mck_ra4t1/board.yml
```yaml
board:
  name: mck_ra4t1
  full_name: RA4T1 Motor Control Kit
  vendor: renesas
  socs:
  - name: r7fa4t1bb3cfm
```

## boards/renesas/mck_ra8t1/Kconfig.mck_ra8t1
```kconfig
# Copyright (c) 2024 Renesas Electronics Corporation
# SPDX-License-Identifier: Apache-2.0

config BOARD_MCK_RA8T1
	select SOC_R7FA8T1AHECBD
```

## boards/renesas/mck_ra8t1/board.yml
```yaml
board:
  name: mck_ra8t1
  full_name: RA8T1 Evaluation Kit
  vendor: renesas
  socs:
  - name: r7fa8t1ahecbd
```

## boards/renesas/mck_ra8t2/Kconfig.mck_ra8t2
```kconfig
# Copyright (c) 2025 Renesas Electronics Corporation
# SPDX-License-Identifier: Apache-2.0

config BOARD_MCK_RA8T2
	select SOC_R7KA8T2LFECAC_CM85 if BOARD_MCK_RA8T2_R7KA8T2LFECAC_CM85
	select SOC_R7KA8T2LFECAC_CM33 if BOARD_MCK_RA8T2_R7KA8T2LFECAC_CM33
```

## boards/renesas/mck_ra8t2/board.yml
```yaml
board:
  name: mck_ra8t2
  full_name: RA8T2 Motor Control Kit
  vendor: renesas
  socs:
  - name: r7ka8t2lfecac
```

## boards/renesas/pb_rh850u2b_468pin/board.yml
```yaml
board:
  name: pb_rh850u2b_468pin
  full_name: Piggy Board RH850 U2B 468pin
  vendor: renesas
  socs:
  - name: r7f70254xafabg-c
```
