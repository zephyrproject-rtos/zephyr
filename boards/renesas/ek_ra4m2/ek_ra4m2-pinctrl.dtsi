/*
 * Copyright (c) 2024 Renesas Electronics Corporation
 * SPDX-License-Identifier: Apache-2.0
 */

&pinctrl {
	sci0_default: sci0_default {
		group1 {
			/* tx rx */
			psels = <RA_PSEL(RA_PSEL_SCI_0, 4, 11)>,
			<RA_PSEL(RA_PSEL_SCI_0, 4, 10)>;
		};
	};
};
