/*
 * Copyright (c) 2025 Renesas Electronics Corporation
 *
 * SPDX-License-Identifier: Apache-2.0
 */

&pinctrl {
	sci9_default: sci9_default {
		group1 {
			/* TXD RXD */
			psels = <RA_PSEL(RA_PSEL_SCI_9, 2, 3)>,
				<RA_PSEL(RA_PSEL_SCI_9, 2, 2)>;
		};
	};
};
