/*
 * Copyright (c) 2023 Renesas Electronics Corporation
 *
 * SPDX-License-Identifier: Apache-2.0
 */

/ {
	dma_test_dma: dma-test-dma {
		compatible = "test-dma-memory-to-memory";
		dma = <&dma>;
		max-burst-length = <8>;
	};
};

&dma {
	status = "okay";
};
