/*
 * Copyright (c) 2025 Renesas Electronics Corporation
 *
 * SPDX-License-Identifier: Apache-2.0
 */

/ {
	dma_test_dma0: dma-test-dma0 {
		compatible = "test-dma-memory-to-memory";
		dma = <&dma0>;
		max-transfer-size = <1024>;
	};
};

&dma0 {
	status = "okay";
	interrupts = <31 1>, <30 1>, <29 1>;
	interrupt-names = "ch0", "ch1", "ch2";
};
