/*
 * Copyright (c) 2025 Renesas Electronics Corporation
 *
 * SPDX-License-Identifier: Apache-2.0
 */

/ {
	dma_test_dma0: dma-test-dma0 {
		compatible = "test-dma-memory-to-memory";
		dma = <&dma0>;
	};
};

&dma0 {
	status = "okay";
	interrupts = <63 1>, <62 1>, <61 1>;
	interrupt-names = "ch0", "ch1", "ch2";
};
