/*
 * SPDX-FileCopyrightText: 2026 Renesas Electronics Corporation
 * SPDX-License-Identifier: Apache-2.0
 */

/dts-v1/;

#include <renesas/ra/ra6/r7ka6b1bg4zak.dtsi>
#include "ek_ra6b1_common.dtsi"

&gpio1 {
	status = "okay";
};

&gpio2 {
	status = "okay";
};
