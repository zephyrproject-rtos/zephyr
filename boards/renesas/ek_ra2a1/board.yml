## boards/renesas/ek_ra2a1/board.yml
```yaml
board:
  name: ek_ra2a1
  full_name: RA2A1 Evaluation Kit
  vendor: renesas
  socs:
  - name: r7fa2a1ab3cfm
```

## boards/renesas/ek_ra2a1/ek_ra2a1_defconfig
```kconfig
# Copyright (c) 2024 TOKITA Hiroshi
# SPDX-License-Identifier: Apache-2.0

CONFIG_SYS_CLOCK_HW_CYCLES_PER_SEC=48000000

# Enable GPIO
CONFIG_GPIO=y

# Enable Console
CONFIG_SERIAL=y
CONFIG_UART_CONSOLE=y
CONFIG_UART_INTERRUPT_DRIVEN=y
CONFIG_CONSOLE=y

CONFIG_BUILD_OUTPUT_HEX=y
CONFIG_BUILD_NO_GAP_FILL=y
CONFIG_CLOCK_CONTROL=y
```

## boards/renesas/ek_ra2l1/Kconfig.ek_ra2l1
```kconfig
# Copyright (c) 2021-2024 MUNIC SA
# SPDX-License-Identifier: Apache-2.0

config BOARD_EK_RA2L1
	select SOC_R7FA2L1ABXXFP
```

## boards/renesas/ek_ra2l1/board.yml
```yaml
board:
  name: ek_ra2l1
  full_name: RA2L1 Evaluation Kit
  vendor: renesas
  socs:
  - name: r7fa2l1abxxfp
```

## boards/renesas/ek_ra2l1/ek_ra2l1_defconfig
```kconfig
# Copyright (c) 2021-2024 MUNIC SA
# Copyright (c) 2024-2025 Renesas Electronics Corporation
# SPDX-License-Identifier: Apache-2.0

# Enable GPIO
CONFIG_GPIO=y

# Enable Console
CONFIG_SERIAL=y
CONFIG_UART_INTERRUPT_DRIVEN=y
CONFIG_UART_CONSOLE=y
CONFIG_CONSOLE=y
```

## boards/renesas/ek_ra4c1/Kconfig.ek_ra4c1
```kconfig
# Copyright (c) 2025 Renesas Electronics Corporation
# SPDX-License-Identifier: Apache-2.0

config BOARD_EK_RA4C1
	select SOC_R7FA4C1BD3CFP
```

## boards/renesas/ek_ra4c1/board.yml
```yaml
board:
  name: ek_ra4c1
  full_name: RA4C1 Evaluation Kit
  vendor: renesas
  socs:
  - name: r7fa4c1bd3cfp
```

## boards/renesas/ek_ra4e2/Kconfig.ek_ra4e2
```kconfig
# Copyright (c) 2024 Renesas Electronics Corporation
# SPDX-License-Identifier: Apache-2.0

config BOARD_EK_RA4E2
	select SOC_R7FA4E2B93CFM
```

## boards/renesas/ek_ra4e2/board.yml
```yaml
board:
  name: ek_ra4e2
  full_name: RA4E2 Evaluation Kit
  vendor: renesas
  socs:
  - name: r7fa4e2b93cfm
```

## boards/renesas/ek_ra4l1/Kconfig.ek_ra4l1
```kconfig
# Copyright (c) 2025 Renesas Electronics Corporation
# SPDX-License-Identifier: Apache-2.0

config BOARD_EK_RA4L1
	select SOC_R7FA4L1BD4CFP
```

## boards/renesas/ek_ra4l1/board.yml
```yaml
board:
  name: ek_ra4l1
  full_name: RA4L1 Evaluation Kit
  vendor: renesas
  socs:
  - name: r7fa4l1bd4cfp
```

## boards/renesas/ek_ra4m1/Kconfig.ek_ra4m1
```kconfig
# Copyright (c) 2024 Renesas Electronics Corporation
# SPDX-License-Identifier: Apache-2.0

config BOARD_EK_RA4M1
	select SOC_R7FA4M1AB3CFP
```

## boards/renesas/ek_ra4m1/board.yml
```yaml
board:
  name: ek_ra4m1
  full_name: RA4M1 Evaluation Kit
  vendor: renesas
  socs:
  - name: r7fa4m1ab3cfp
```

## boards/renesas/ek_ra4m1/ek_ra4m1_defconfig
```kconfig
# Copyright (c) 2024 Ian Morris
# SPDX-License-Identifier: Apache-2.0

CONFIG_SYS_CLOCK_HW_CYCLES_PER_SEC=12000000

CONFIG_BUILD_OUTPUT_HEX=y

# enable uart driver
CONFIG_SERIAL=y

# enable console
CONFIG_CONSOLE=y
CONFIG_UART_CONSOLE=y

# enable GPIO
CONFIG_GPIO=y

# enable pin controller
CONFIG_PINCTRL=y

# enable Clocks
CONFIG_CLOCK_CONTROL=y
```

## boards/renesas/ek_ra4m2/Kconfig.ek_ra4m2
```kconfig
# Copyright (c) 2024 Renesas Electronics Corporation
# SPDX-License-Identifier: Apache-2.0

config BOARD_EK_RA4M2
	select SOC_R7FA4M2AD3CFP
```

## boards/renesas/ek_ra4m2/board.yml
```yaml
board:
  name: ek_ra4m2
  full_name: RA4M2 Evaluation Kit
  vendor: renesas
  socs:
  - name: r7fa4m2ad3cfp
```

## boards/renesas/ek_ra4m3/Kconfig.ek_ra4m3
```kconfig
# Copyright (c) 2024 Renesas Electronics Corporation
# SPDX-License-Identifier: Apache-2.0

config BOARD_EK_RA4M3
	select SOC_R7FA4M3AF3CFB
```

## boards/renesas/ek_ra4m3/board.yml
```yaml
board:
  name: ek_ra4m3
  full_name: RA4M3 Evaluation Kit
  vendor: renesas
  socs:
  - name: r7fa4m3af3cfb
```

## boards/renesas/ek_ra4w1/board.yml
```yaml
board:
  name: ek_ra4w1
  full_name: RA4W1 Evaluation Kit
  vendor: renesas
  socs:
  - name: r7fa4w1ad2cng
```

## boards/renesas/ek_ra6e2/Kconfig.ek_ra6e2
```kconfig
# Copyright (c) 2024 Renesas Electronics Corporation
# SPDX-License-Identifier: Apache-2.0

config BOARD_EK_RA6E2
	select SOC_R7FA6E2BB3CFM
```

## boards/renesas/ek_ra6e2/board.yml
```yaml
board:
  name: ek_ra6e2
  full_name: RA6E2 Evaluation Kit
  vendor: renesas
  socs:
  - name: r7fa6e2bb3cfm
```

## boards/renesas/ek_ra6m1/Kconfig.ek_ra6m1
```kconfig
# Copyright (c) 2024 Renesas Electronics Corporation
# SPDX-License-Identifier: Apache-2.0

config BOARD_EK_RA6M1
	select SOC_R7FA6M1AD3CFP
```

## boards/renesas/ek_ra6m1/board.yml
```yaml
board:
  name: ek_ra6m1
  full_name: RA6M1 Evaluation Kit
  vendor: renesas
  socs:
  - name: r7fa6m1ad3cfp
```

## boards/renesas/ek_ra6m2/Kconfig.ek_ra6m2
```kconfig
# Copyright (c) 2024 Renesas Electronics Corporation
# SPDX-License-Identifier: Apache-2.0

config BOARD_EK_RA6M2
	select SOC_R7FA6M2AF3CFB
```

## boards/renesas/ek_ra6m2/board.yml
```yaml
board:
  name: ek_ra6m2
  full_name: RA6M2 Evaluation Kit
  vendor: renesas
  socs:
  - name: r7fa6m2af3cfb
```
