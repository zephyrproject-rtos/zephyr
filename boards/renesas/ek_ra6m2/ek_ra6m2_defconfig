## boards/renesas/ek_ra6m2/ek_ra6m2_defconfig
```kconfig
# Copyright (c) 2024 Renesas Electronics Corporation
# SPDX-License-Identifier: Apache-2.0

# Enable GPIO
CONFIG_GPIO=y

# Enable Console
CONFIG_SERIAL=y
CONFIG_UART_CONSOLE=y
CONFIG_UART_INTERRUPT_DRIVEN=y
CONFIG_CONSOLE=y
```

## boards/renesas/ek_ra6m3/board.yml
```yaml
board:
  name: ek_ra6m3
  full_name: RA6M3 Evaluation Kit
  vendor: renesas
  socs:
  - name: r7fa6m3ah3cfc
```

## boards/renesas/ek_ra6m4/board.yml
```yaml
board:
  name: ek_ra6m4
  full_name: RA6M4 Evaluation Kit
  vendor: renesas
  socs:
  - name: r7fa6m4af3cfb
```

## boards/renesas/ek_ra6m5/Kconfig.defconfig
```kconfig
# Copyright (c) 2025 Renesas Electronics Corporation
# SPDX-License-Identifier: Apache-2.0

if BOARD_EK_RA6M5

configdefault NET_L2_ETHERNET
	default y

configdefault OUTPUT_RPD
	default y if NETWORKING

endif # BOARD_EK_RA6M5
```

## boards/renesas/ek_ra6m5/Kconfig.ek_ra6m5
```kconfig
# Copyright (c) 2024 Renesas Electronics Corporation
# SPDX-License-Identifier: Apache-2.0

config BOARD_EK_RA6M5
	select SOC_R7FA6M5BH3CFC
```

## boards/renesas/ek_ra6m5/board.yml
```yaml
board:
  name: ek_ra6m5
  full_name: RA6M5 Evaluation Kit
  vendor: renesas
  socs:
  - name: r7fa6m5bh3cfc
```

## boards/renesas/ek_ra6m5/ek_ra6m5_defconfig
```kconfig
# Copyright (c) 2024 Renesas Electronics Corporation
# SPDX-License-Identifier: Apache-2.0

CONFIG_SYS_CLOCK_HW_CYCLES_PER_SEC=200000000

# Enable GPIO
CONFIG_GPIO=y
CONFIG_PINCTRL=y

CONFIG_BUILD_OUTPUT_HEX=y
CONFIG_BUILD_NO_GAP_FILL=y
```

## boards/renesas/ek_ra8d1/Kconfig.ek_ra8d1
```kconfig
# Copyright (c) 2024 Renesas Electronics Corporation
# SPDX-License-Identifier: Apache-2.0

config BOARD_EK_RA8D1
	select SOC_R7FA8D1BHECBD
```

## boards/renesas/ek_ra8d1/board.yml
```yaml
board:
  name: ek_ra8d1
  full_name: RA8D1 Evaluation Kit
  vendor: renesas
  socs:
  - name: r7fa8d1bhecbd
```

## boards/renesas/ek_ra8d2/Kconfig.defconfig
```kconfig
# Copyright (c) 2025 Renesas Electronics Corporation
# SPDX-License-Identifier: Apache-2.0

if BOARD_EK_RA8D2

configdefault NET_L2_ETHERNET
	default y

# Enable fixed clock for ethernet phy
config CLOCK_CONTROL_FIXED_RATE_CLOCK
	default y if ETH_PHY_DRIVER

endif # BOARD_EK_RA8D2
```

## boards/renesas/ek_ra8d2/Kconfig.ek_ra8d2
```kconfig
# Copyright (c) 2025 Renesas Electronics Corporation
# SPDX-License-Identifier: Apache-2.0

config BOARD_EK_RA8D2
	select SOC_R7KA8D2KFLCAC_CM85 if BOARD_EK_RA8D2_R7KA8D2KFLCAC_CM85
	select SOC_R7KA8D2KFLCAC_CM33 if BOARD_EK_RA8D2_R7KA8D2KFLCAC_CM33
```

## boards/renesas/ek_ra8d2/board.yml
```yaml
board:
  name: ek_ra8d2
  full_name: RA8D2 Evaluation Kit
  vendor: renesas
  socs:
  - name: r7ka8d2kflcac
```

## boards/renesas/ek_ra8m1/Kconfig.ek_ra8m1
```kconfig
# Copyright (c) 2024 Renesas Electronics Corporation
# SPDX-License-Identifier: Apache-2.0

config BOARD_EK_RA8M1
	select SOC_R7FA8M1AHECBD
```

## boards/renesas/ek_ra8m1/board.yml
```yaml
board:
  name: ek_ra8m1
  full_name: RA8M1 Evaluation Kit
  vendor: renesas
  socs:
  - name: r7fa8m1ahecbd
```

## boards/renesas/ek_ra8m2/Kconfig.defconfig
```kconfig
# Copyright (c) 2025 Renesas Electronics Corporation
# SPDX-License-Identifier: Apache-2.0

if BOARD_EK_RA8M2

if NETWORKING

config NET_L2_ETHERNET
	default y

endif # NETWORKING

# Enable fixed clock for ethernet phy
config CLOCK_CONTROL_FIXED_RATE_CLOCK
	default y if ETH_PHY_DRIVER

if MDIO

config MDIO_RENESAS_RA_RMAC_MDIO_HOLD_NS
	default 4

config MDIO_RENESAS_RA_RMAC_MDIO_CAPTURE_NS
	default 4

endif #MDIO

endif # BOARD_EK_RA8M2
```

## boards/renesas/ek_ra8m2/Kconfig.ek_ra8m2
```kconfig
# Copyright (c) 2025 Renesas Electronics Corporation
# SPDX-License-Identifier: Apache-2.0

config BOARD_EK_RA8M2
	select SOC_R7KA8M2JFLCAC_CM85 if BOARD_EK_RA8M2_R7KA8M2JFLCAC_CM85
	select SOC_R7KA8M2JFLCAC_CM33 if BOARD_EK_RA8M2_R7KA8M2JFLCAC_CM33
```

## boards/renesas/ek_ra8m2/board.yml
```yaml
board:
  name: ek_ra8m2
  full_name: RA8M2 Evaluation Kit
  vendor: renesas
  socs:
  - name: r7ka8m2jflcac
```

## boards/renesas/ek_ra8p1/Kconfig.defconfig
```kconfig
# Copyright (c) 2025 Renesas Electronics Corporation
# SPDX-License-Identifier: Apache-2.0

if BOARD_EK_RA8P1

if DISK_DRIVER_SDMMC

config SD_CMD_TIMEOUT
	default 1000

endif # DISK_DRIVER_SDMMC

endif # BOARD_EK_RA8P1
```

## boards/renesas/ek_ra8p1/Kconfig.ek_ra8p1
```kconfig
# Copyright (c) 2025 Renesas Electronics Corporation
# SPDX-License-Identifier: Apache-2.0

config BOARD_EK_RA8P1
	select SOC_R7KA8P1KFLCAC_CM85 if BOARD_EK_RA8P1_R7KA8P1KFLCAC_CM85
	select SOC_R7KA8P1KFLCAC_CM33 if BOARD_EK_RA8P1_R7KA8P1KFLCAC_CM33
```

## boards/renesas/ek_ra8p1/board.yml
```yaml
board:
  name: ek_ra8p1
  full_name: RA8P1 Evaluation Kit
  vendor: renesas
  socs:
  - name: r7ka8p1kflcac
```

## boards/renesas/ek_ra8t2/board.yml
```yaml
board:
  name: ek_ra8t2
  full_name: RA8T2 Evaluation Kit
  vendor: renesas
  socs:
  - name: r7ka8t2lflcac
```

## boards/renesas/ek_rx261/board.yml
```yaml
board:
  name: ek_rx261
  full_name: RX261 Evaluation Kit
  vendor: renesas
  socs:
  - name: r5f52618bgfp
```

## boards/renesas/fpb_ra0e1/Kconfig.fpb_ra0e1
```kconfig
# Copyright (c) 2026 Renesas Electronics Corporation
# SPDX-License-Identifier: Apache-2.0

config BOARD_FPB_RA0E1
	select SOC_R7FA0E1073CFJ
```

## boards/renesas/fpb_ra0e1/board.yml
```yaml
board:
  name: fpb_ra0e1
  full_name: RA0E1 Fast Prototype Board
  vendor: renesas
  socs:
  - name: r7fa0e1073cfj
```

## boards/renesas/fpb_ra0e1/fpb_ra0e1_defconfig
```kconfig
# Copyright (c) 2026 Renesas Electronics Corporation
# SPDX-License-Identifier: Apache-2.0

# Enable GPIO
CONFIG_GPIO=y
```
