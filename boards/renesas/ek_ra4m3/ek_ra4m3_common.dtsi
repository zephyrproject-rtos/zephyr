/*
 * Copyright (c) 2024 Piotr Rak
 *
 * SPDX-License-Identifier: Apache-2.0
 */

/dts-v1/;
#include <renesas/ra/r7fa4m3af3cfb.dtsi>

/ {
	model = "Renesas EK-RA4M3 Board";
	compatible = "renesas,r7fa4m3af3cfb";
};
