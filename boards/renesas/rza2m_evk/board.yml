## boards/renesas/rza2m_evk/board.yml
```yaml
board:
  name: rza2m_evk
  full_name: RZ/A2M Evaluation Kit
  vendor: renesas
  socs:
  - name: r7s921053vcbg
```

## boards/renesas/rza2m_evk/rza2m_evk_defconfig
```kconfig
# Copyright (c) 2025 Renesas Electronics Corporation
# SPDX-License-Identifier: Apache-2.0

CONFIG_XIP=n

# Enable clock control
CONFIG_CLOCK_CONTROL=y

# Enable UART driver
CONFIG_SERIAL=y
CONFIG_UART_CONSOLE=y
CONFIG_UART_INTERRUPT_DRIVEN=y

# Enable console
CONFIG_CONSOLE=y
```

## boards/renesas/rza3m_ek/Kconfig.rza3m_ek
```kconfig
# Copyright (c) 2025 Renesas Electronics Corporation
# SPDX-License-Identifier: Apache-2.0

config BOARD_RZA3M_EK
	select SOC_R9A07G066M04GBG
```

## boards/renesas/rza3m_ek/board.yml
```yaml
board:
  name: rza3m_ek
  full_name: RZ/A3M Evaluation Kit
  vendor: renesas
  socs:
  - name: r9a07g066m04gbg
```

## boards/renesas/rza3m_ek/rza3m_ek_defconfig
```kconfig
# Copyright (c) 2025 Renesas Electronics Corporation
# SPDX-License-Identifier: Apache-2.0

CONFIG_XIP=n

# MMU Options
CONFIG_MAX_XLAT_TABLES=24

# Cache Options
CONFIG_CACHE_MANAGEMENT=y
CONFIG_DCACHE_LINE_SIZE_DETECT=y
CONFIG_ICACHE_LINE_SIZE_DETECT=y

# Enable UART driver
CONFIG_SERIAL=y

# Enable console
CONFIG_CONSOLE=y
CONFIG_UART_CONSOLE=y
```

## boards/renesas/rza3ul_smarc/Kconfig.defconfig
```kconfig
# Copyright (c) 2025 Renesas Electronics Corporation
# SPDX-License-Identifier: Apache-2.0

config FLASH_LOAD_OFFSET
	default $(dt_nodelabel_reg_addr_hex,header)
```

## boards/renesas/rza3ul_smarc/Kconfig.rza3ul_smarc
```kconfig
# Copyright (c) 2025 Renesas Electronics Corporation
# SPDX-License-Identifier: Apache-2.0

config BOARD_RZA3UL_SMARC
	select SOC_R9A07G063U02GBG
```

## boards/renesas/rza3ul_smarc/board.yml
```yaml
board:
  name: rza3ul_smarc
  full_name: RZ/A3UL SMARC Evaluation Board Kit
  vendor: renesas
  socs:
  - name: r9a07g063u02gbg
```

## boards/renesas/rza3ul_smarc/rza3ul_smarc_defconfig
```kconfig
# Copyright (c) 2025 Renesas Electronics Corporation
# SPDX-License-Identifier: Apache-2.0

CONFIG_XIP=n

# MMU Options
CONFIG_MAX_XLAT_TABLES=24

# Cache Options
CONFIG_CACHE_MANAGEMENT=y

# Enable UART driver
CONFIG_SERIAL=y

# Enable console
CONFIG_CONSOLE=y
CONFIG_UART_CONSOLE=y
```

## boards/renesas/rzg2l_smarc/Kconfig.rzg2l_smarc
```kconfig
# Copyright (c) 2025 Renesas Electronics Corporation
# SPDX-License-Identifier: Apache-2.0

config BOARD_RZG2L_SMARC
	select SOC_R9A07G044L23GBG
```

## boards/renesas/rzg2l_smarc/board.yml
```yaml
board:
  name: rzg2l_smarc
  full_name: RZ/G2L SMARC Evaluation Board Kit
  vendor: renesas
  socs:
  - name: r9a07g044l23gbg
```

## boards/renesas/rzg2l_smarc/rzg2l_smarc_r9a07g044l23gbg_cm33_defconfig
```kconfig
# Copyright (c) 2025 Renesas Electronics Corporation
# SPDX-License-Identifier: Apache-2.0

CONFIG_XIP=n

# Enable UART driver
CONFIG_SERIAL=y

# Enable console
CONFIG_CONSOLE=y
CONFIG_UART_CONSOLE=y
```

## boards/renesas/rzg2lc_smarc/Kconfig.rzg2lc_smarc
```kconfig
# Copyright (c) 2025 Renesas Electronics Corporation
# SPDX-License-Identifier: Apache-2.0

config BOARD_RZG2LC_SMARC
	select SOC_R9A07G044C22GBG
```

## boards/renesas/rzg2lc_smarc/board.yml
```yaml
board:
  name: rzg2lc_smarc
  full_name: RZ/G2LC SMARC Evaluation Board Kit
  vendor: renesas
  socs:
  - name: r9a07g044c22gbg
```

## boards/renesas/rzg2ul_smarc/Kconfig.rzg2ul_smarc
```kconfig
# Copyright (c) 2025 Renesas Electronics Corporation
# SPDX-License-Identifier: Apache-2.0

config BOARD_RZG2UL_SMARC
	select SOC_R9A07G043U11GBG
```

## boards/renesas/rzg2ul_smarc/board.yml
```yaml
board:
  name: rzg2ul_smarc
  full_name: RZ/G2UL SMARC Evaluation Board Kit
  vendor: renesas
  socs:
  - name: r9a07g043u11gbg
```

## boards/renesas/rzg2ul_smarc/rzg2ul_smarc_r9a07g043u11gbg_cm33_defconfig
```kconfig
# Copyright (c) 2025 Renesas Electronics Corporation
# SPDX-License-Identifier: Apache-2.0

CONFIG_XIP=n

# Enable console
CONFIG_CONSOLE=y

# Segger RTT
CONFIG_RTT_CONSOLE=y
CONFIG_USE_SEGGER_RTT=y
```

## boards/renesas/rzg3e_smarc/Kconfig.rzg3e_smarc
```kconfig
# Copyright (c) 2025 Renesas Electronics Corporation
# SPDX-License-Identifier: Apache-2.0

config BOARD_RZG3E_SMARC
	select SOC_R9A09G047A57GBG
```

## boards/renesas/rzg3e_smarc/board.yml
```yaml
board:
  name: rzg3e_smarc
  full_name: RZ/G3E Evaluation Board Kit
  vendor: renesas
  socs:
  - name: r9a09g047a57gbg
```

## boards/renesas/rzg3s_smarc/Kconfig.rzg3s_smarc
```kconfig
# Copyright (c) 2024 Renesas Electronics Corporation
# SPDX-License-Identifier: Apache-2.0

config BOARD_RZG3S_SMARC
	select SOC_R9A08G045S33GBG
```

## boards/renesas/rzg3s_smarc/board.yml
```yaml
board:
  name: rzg3s_smarc
  full_name: RZ/G3S SMARC Evaluation Board Kit
  vendor: renesas
  socs:
  - name: r9a08g045s33gbg
```

## boards/renesas/rzg3s_smarc/rzg3s_smarc_r9a08g045s33gbg_cm33_defconfig
```kconfig
# Copyright (c) 2024 EPAM Systems
# Copyright (c) 2024 Renesas Electronics Corporation
# SPDX-License-Identifier: Apache-2.0

CONFIG_XIP=n

# Enable UART driver
CONFIG_SERIAL=y

# Enable console
CONFIG_CONSOLE=y
CONFIG_UART_CONSOLE=y
```

## boards/renesas/rzn2h_evb/Kconfig.rzn2h_evb
```kconfig
# Copyright (c) 2026 Renesas Electronics Corporation
# SPDX-License-Identifier: Apache-2.0

config BOARD_RZN2H_EVB
	select SOC_R9A09G087M44GBG_CR52_0 if BOARD_RZN2H_EVB_R9A09G087M44GBG_CR52_0
```

## boards/renesas/rzn2h_evb/board.yml
```yaml
board:
  name: rzn2h_evb
  full_name: RZ/N2H Evaluation Board Kit
  vendor: renesas
  socs:
  - name: r9a09g087m44gbg
```

## boards/renesas/rzn2l_rsk/Kconfig.rzn2l_rsk
```kconfig
# Copyright (c) 2025 Renesas Electronics Corporation
# SPDX-License-Identifier: Apache-2.0

config BOARD_RZN2L_RSK
	select SOC_R9A07G084M04GBG
```
