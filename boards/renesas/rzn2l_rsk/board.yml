## boards/renesas/rzn2l_rsk/board.yml
```yaml
board:
  name: rzn2l_rsk
  full_name: Renesas Starter Kit+ for RZ/N2L
  vendor: renesas
  socs:
  - name: r9a07g084m04gbg
```

## boards/renesas/rzt2h_evb/Kconfig.rzt2h_evb
```kconfig
# Copyright (c) 2026 Renesas Electronics Corporation
# SPDX-License-Identifier: Apache-2.0

config BOARD_RZT2H_EVB
	select SOC_R9A09G077M44GBG
```

## boards/renesas/rzt2h_evb/board.yml
```yaml
board:
  name: rzt2h_evb
  full_name: RZ/T2H Evaluation Board Kit
  vendor: renesas
  socs:
  - name: r9a09g077m44gbg
```

## boards/renesas/rzt2l_rsk/Kconfig.rzt2l_rsk
```kconfig
# Copyright (c) 2025 Renesas Electronics Corporation
# SPDX-License-Identifier: Apache-2.0

config BOARD_RZT2L_RSK
	select SOC_R9A07G074M04GBG
```

## boards/renesas/rzt2l_rsk/board.yml
```yaml
board:
  name: rzt2l_rsk
  full_name: Renesas Starter Kit+ for RZ/T2L
  vendor: renesas
  socs:
  - name: r9a07g074m04gbg
```

## boards/renesas/rzt2m_rsk/Kconfig.rzt2m_rsk
```kconfig
# Copyright (c) 2023 Nordic Semiconductor ASA
# Copyright (c) 2025 Renesas Electronics Corporation
# SPDX-License-Identifier: Apache-2.0

config BOARD_RZT2M_RSK
	select SOC_R9A07G075M24GBG
```

## boards/renesas/rzt2m_rsk/board.yml
```yaml
board:
  name: rzt2m_rsk
  full_name: Renesas Starter Kit+ for RZ/T2M
  vendor: renesas
  socs:
  - name: r9a07g075m24gbg
```

## boards/renesas/rzt2m_rsk/rzt2m_rsk_r9a07g075m24gbg_cr520_defconfig
```kconfig
# Copyright (c) 2023 Antmicro <www.antmicro.com>
# Copyright (c) 2025 Renesas Electronics Corporation
# SPDX-License-Identifier: Apache-2.0

CONFIG_XIP=n

# Enable UART driver
CONFIG_SERIAL=y
CONFIG_UART_CONSOLE=y
CONFIG_UART_INTERRUPT_DRIVEN=y

# Enable console
CONFIG_CONSOLE=y
```

## boards/renesas/rzt2m_starterkit/Kconfig.rzt2m_starter_kit
```kconfig
# Copyright (c) 2023 Nordic Semiconductor ASA

# SPDX-License-Identifier: Apache-2.0

config BOARD_RZT2M_STARTER_KIT
	select SOC_RENESAS_RZT2M
```

## boards/renesas/rzt2m_starterkit/board.yml
```yaml
board:
  name: rzt2m_starter_kit
  vendor: renesas
  socs:
  - name: renesas_rzt2m
```

## boards/renesas/rzt2m_starterkit/rzt2m_starter_kit_renesas_rzt2m_defconfig
```kconfig
# Copyright (c) 2023 Antmicro <www.antmicro.com>
# SPDX-License-Identifier: Apache-2.0

CONFIG_SERIAL=y
CONFIG_CONSOLE=y
CONFIG_UART_CONSOLE=y
CONFIG_UART_INTERRUPT_DRIVEN=y
```

## boards/renesas/rzv2h_evk/Kconfig.rzv2h_evk
```kconfig
# Copyright (c) 2025 Renesas Electronics Corporation
# SPDX-License-Identifier: Apache-2.0

config BOARD_RZV2H_EVK
	select SOC_R9A09G057H44GBG_CM33 if BOARD_RZV2H_EVK_R9A09G057H44GBG_CM33
```

## boards/renesas/rzv2h_evk/board.yml
```yaml
board:
  name: rzv2h_evk
  full_name: RZ/V2H Evaluation Board Kit
  vendor: renesas
  socs:
  - name: r9a09g057h44gbg
```

## boards/renesas/rzv2h_evk/rzv2h_evk_r9a09g057h44gbg_cr8_0_defconfig
```kconfig
# Copyright (c) 2025 Renesas Electronics Corporation
# SPDX-License-Identifier: Apache-2.0

CONFIG_XIP=n

# MPU Config
CONFIG_ARM_MPU=y

# Enable UART driver
CONFIG_SERIAL=y

# Enable console
CONFIG_CONSOLE=y
CONFIG_UART_CONSOLE=y

# Cache Options
CONFIG_CACHE_MANAGEMENT=y
CONFIG_DCACHE_LINE_SIZE_DETECT=y
CONFIG_ICACHE_LINE_SIZE_DETECT=y
```

## boards/renesas/rzv2l_smarc/Kconfig.rzv2l_smarc
```kconfig
# Copyright (c) 2025 Renesas Electronics Corporation
# SPDX-License-Identifier: Apache-2.0

config BOARD_RZV2L_SMARC
	select SOC_R9A07G054L23GBG
```

## boards/renesas/rzv2l_smarc/board.yml
```yaml
board:
  name: rzv2l_smarc
  full_name: RZ/V2L SMARC Evaluation Board Kit
  vendor: renesas
  socs:
  - name: r9a07g054l23gbg
```

## boards/renesas/rzv2n_evk/Kconfig.rzv2n_evk
```kconfig
# Copyright (c) 2025 Renesas Electronics Corporation
# SPDX-License-Identifier: Apache-2.0

config BOARD_RZV2N_EVK
	select SOC_R9A09G056N48GBG_CM33
```

## boards/renesas/rzv2n_evk/board.yml
```yaml
board:
  name: rzv2n_evk
  full_name: RZ/V2N Evaluation Board Kit
  vendor: renesas
  socs:
  - name: r9a09g056n48gbg
```

## boards/renesas/voice_ra4e1/Kconfig.voice_ra4e1
```kconfig
# Copyright (c) 2025 Renesas Electronics Corporation
# SPDX-License-Identifier: Apache-2.0

config BOARD_VOICE_RA4E1
	select SOC_R7FA4E10D2CNE
```

## boards/renesas/voice_ra4e1/board.yml
```yaml
board:
  name: voice_ra4e1
  full_name: RA4E1 Voice User Reference Kit
  vendor: renesas
  socs:
  - name: r7fa4e10d2cne
```

## boards/renode/cortex_r8_virtual/Kconfig.cortex_r8_virtual
```kconfig
# Copyright (c) 2024 Antmicro <www.antmicro.com>
# SPDX-License-Identifier: Apache-2.0

config BOARD_CORTEX_R8_VIRTUAL
	select SOC_CORTEX_R8_VIRTUAL
```

## boards/renode/cortex_r8_virtual/board.yml
```yaml
board:
  name: cortex_r8_virtual
  full_name: Cortex-R8 Virtual
  vendor: renode
  socs:
  - name: cortex_r8_virtual
```

## boards/renode/cortex_r8_virtual/cortex_r8_virtual_defconfig
```kconfig
# Copyright (c) 2024 Antmicro <www.antmicro.com>
# SPDX-License-Identifier: Apache-2.0

CONFIG_XIP=n

CONFIG_ISR_STACK_SIZE=512
CONFIG_THREAD_STACK_INFO=y

CONFIG_MAX_DOMAIN_PARTITIONS=24

# Enable UART driver
CONFIG_SERIAL=y

# Enable console
CONFIG_CONSOLE=y
CONFIG_UART_CONSOLE=y

# Enable serial port
CONFIG_UART_XLNX_PS=y

CONFIG_SYS_CLOCK_TICKS_PER_SEC=1000
CONFIG_ARM_MPU=y
```

## boards/renode/riscv32_virtual/Kconfig.riscv32_virtual
```kconfig
# Copyright (c) 2023 Meta
# SPDX-License-Identifier: Apache-2.0

config BOARD_RISCV32_VIRTUAL
	select SOC_RISCV_VIRTUAL_RENODE
```

## boards/renode/riscv32_virtual/board.yml
```yaml
board:
  name: riscv32_virtual
  full_name: RISCV32 Virtual
  vendor: renode
  socs:
  - name: riscv_virtual_renode
```
