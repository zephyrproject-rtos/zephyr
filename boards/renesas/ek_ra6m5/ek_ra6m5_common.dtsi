/*
 * Copyright (c) 2024 Piotr Rak <piotr.rak@gmail.com>
 *
 * SPDX-License-Identifier: Apache-2.0
 */

/dts-v1/;
#include <renesas/ra/r7fa6m5bh3cfc.dtsi>

/ {
	model = "Renesas EK-RA6M5 Board";
	compatible = "renesas,r7fa6m5bh3cfc";
};
