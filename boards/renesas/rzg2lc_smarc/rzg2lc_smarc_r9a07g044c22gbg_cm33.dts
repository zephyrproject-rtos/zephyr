/*
 * Copyright (c) 2025 Renesas Electronics Corporation
 * SPDX-License-Identifier: Apache-2.0
 */

/dts-v1/;

#include <zephyr/dt-bindings/memory-attr/memory-attr-arm.h>
#include <zephyr/dt-bindings/input/input-event-codes.h>
#include <arm/renesas/rz/rzg/r9a07g044c.dtsi>
#include "rzg2lc_smarc-pinctrl.dtsi"

/ {
	model = "Renesas RZ/G2LC SMARC";
	compatible = "renesas,rzg2lc-smarc";

	chosen {
		zephyr,sram = &ddr;
		zephyr,console = &scif1;
		zephyr,shell-uart = &scif1;
	};

	ddr: memory@60010000 {
		compatible = "mmio-sram";
		reg = <0x60010000 DT_SIZE_M(46)>;
	};
};

&scif1 {
	current-speed = <115200>;
	pinctrl-0 = <&scif1_pins>;
	pinctrl-names = "default";
	status = "okay";
};
