/*
 * Copyright (c) 2025 Nordic Semiconductor ASA
 *
 * SPDX-License-Identifier: Apache-2.0
 */

/dts-v1/;

#define USE_NON_SECURE_ADDRESS_MAP 1

#include <nordic/nrf7120e_enga_cpuapp.dtsi>
#include "nrf7120_7120e_cpuapp_common.dtsi"

/ {
	compatible = "nordic,nrf7120dk_nrf7120e-cpuapp";
	model = "Nordic nRF7120 DK nRF7120E Application MCU";

	chosen {
		zephyr,code-partition = &slot0_ns_partition;
		zephyr,sram = &sram0_ns;
		zephyr,entropy = &psa_rng;
	};

	/delete-node/ rng;

	psa_rng: psa-rng {
		status = "okay";
	};
};

&uart21 {
	/* Disable so that TF-M can use this UART */
	status = "disabled";
};

#include <nordic/nrf7120e_cpuapp_ns_partition.dtsi>
