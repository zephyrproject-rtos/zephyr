/*
 * Copyright (c) 2018-2023 Nordic Semiconductor ASA
 * Copyright (c) 2017 Linaro Limited
 *
 * SPDX-License-Identifier: Apache-2.0
 */

/dts-v1/;
#include "nrf52840dongle_nrf52840_common.dtsi"

/* Include flash partition table that is not compatible with Nordic nRF5
 * bootloader. Use an external debugger to program the device.
 */
#include "fstab-debugger.dtsi"
