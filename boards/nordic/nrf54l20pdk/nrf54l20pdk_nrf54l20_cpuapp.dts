/*
 * Copyright (c) 2024 Nordic Semiconductor ASA
 *
 * SPDX-License-Identifier: Apache-2.0
 */

/dts-v1/;

#include "nrf54l20_cpuapp_common.dtsi"

/ {
	compatible = "nordic,nrf54l20pdk_nrf54l20-cpuapp";
	model = "Nordic nRF54L20 PDK nRF54L20 Application MCU";

	chosen {
		zephyr,code-partition = &slot0_partition;
		zephyr,sram = &cpuapp_sram;
	};
};
