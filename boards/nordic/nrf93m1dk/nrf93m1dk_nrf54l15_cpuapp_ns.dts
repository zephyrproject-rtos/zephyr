/*
 * Copyright (c) 2026 Nordic Semiconductor ASA
 *
 * SPDX-License-Identifier: Apache-2.0
 */

/dts-v1/;

#define USE_NON_SECURE_ADDRESS_MAP 1

#include <arm/nordic/nrf54l15_cpuapp_ns.dtsi>
#include "nrf93m1dk_nrf54l15_cpuapp_common.dtsi"

/ {
	compatible = "nordic,nrf93m1dk_nrf54l15-cpuapp";
	model = "Nordic nRF93M1 DK nRF54L15 Application MCU";

	chosen {
		zephyr,code-partition = &slot0_ns_partition;
		zephyr,sram = &sram0_ns;
		zephyr,entropy = &psa_rng;
	};

	/delete-node/ rng;

	psa_rng: psa-rng {
		status = "okay";
	};
};

/* Include default memory partition configuration file */
#include <vendor/nordic/nrf54l15_cpuapp_ns_partition.dtsi>
