/*
 * Copyright (c) 2020-2025 Nordic Semiconductor ASA
 *
 * SPDX-License-Identifier: Apache-2.0
 */

/dts-v1/;
#include <nordic/nrf5340_cpuapp_qkaa.dtsi>
#include "nrf5340_cpuapp_common.dtsi"

/ {
	compatible = "nordic,nrf5340-dk-nrf5340-cpuapp";
	model = "Nordic NRF5340 DK NRF5340 Application";

	chosen {
		zephyr,sram = &sram0_image;
		zephyr,flash = &flash0;
		zephyr,code-partition = &slot0_partition;
		zephyr,sram-secure-partition = &sram0_s;
		zephyr,sram-non-secure-partition = &sram0_ns;
		zephyr,boot-mode = &boot_mode0;
	};
};

&gpregret1 {
	status = "okay";

	boot_mode0: boot_mode@0 {
		compatible = "zephyr,retention";
		reg = <0x0 0x1>;
		status = "okay";
	};
};

/* Include default memory partition configuration file */
#include <nordic/nrf5340_cpuapp_partition.dtsi>
