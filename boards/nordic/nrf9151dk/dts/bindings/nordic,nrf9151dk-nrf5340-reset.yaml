## boards/nordic/nrf9151dk/dts/bindings/nordic,nrf9151dk-nrf5340-reset.yaml
```yaml
# Copyright (c) 2023 Nordic Semiconductor ASA
# SPDX-License-Identifier: Apache-2.0

description: GPIO used to reset nRF5340 on nRF9151 DK

compatible: "nordic,nrf9151dk-nrf5340-reset"

include: base.yaml

properties:
  status:
    required: true

  gpios:
    type: phandle-array
    required: true
    description: |
      GPIO to use as nRF5340 reset line: output in nRF9151, input in nRF5340.
```

## boards/nordic/nrf9160dk/Kconfig
```kconfig
# nRF9160 DK NRF52840 board configuration

# Copyright (c) 2018-2020 Nordic Semiconductor ASA
# SPDX-License-Identifier: Apache-2.0

config BOARD_NRF9160DK
	# The GPIO driver is required by this board's initialization code
	# (board.c), so it is forced here to be enabled always, not only
	# enabled by default (in defconfig).
	select GPIO if BOARD_NRF9160DK_NRF52840
	select BOARD_EARLY_INIT_HOOK if BOARD_NRF9160DK_NRF52840 && \
					$(dt_nodelabel_exists,external_flash_pins_routing)
	select BOARD_LATE_INIT_HOOK if BOARD_NRF9160DK_NRF52840

if BOARD_NRF9160DK_NRF52840

module = BOARD_NRF9160DK
module-str = Board Control
source "subsys/logging/Kconfig.template.log_config"

endif # BOARD_NRF9160DK_NRF52840
```

## boards/nordic/nrf9160dk/Kconfig.defconfig
```kconfig
# nRF9160 DK NRF9160 board configuration

# Copyright (c) 2018-2020 Nordic Semiconductor ASA
# SPDX-License-Identifier: Apache-2.0

if BOARD_NRF9160DK_NRF9160 || BOARD_NRF9160DK_NRF9160_NS

config BOARD_NRF9160DK
	select USE_DT_CODE_PARTITION if BOARD_NRF9160DK_NRF9160_NS

config BT_HCI_VS
	default y if BT

config BT_WAIT_NOP
	default BT && $(dt_nodelabel_enabled,nrf52840_reset)

config I2C
	default $(dt_compat_on_bus,$(DT_COMPAT_NXP_PCAL6408A),i2c)

endif # BOARD_NRF9160DK_NRF9160 || BOARD_NRF9160DK_NRF9160_NS

if BOARD_NRF9160DK_NRF52840

config BT_WAIT_NOP
	default BT && $(dt_nodelabel_enabled,reset_input)

endif # BOARD_NRF9160DK_NRF52840
```

## boards/nordic/nrf9160dk/Kconfig.nrf9160dk
```kconfig
# nRF9160 DK NRF9160 board configuration

# Copyright (c) 2018-2020 Nordic Semiconductor ASA
# SPDX-License-Identifier: Apache-2.0

config BOARD_NRF9160DK
	select SOC_NRF9160_SICA if BOARD_NRF9160DK_NRF9160 || BOARD_NRF9160DK_NRF9160_NS
	select SOC_NRF52840_QIAA if BOARD_NRF9160DK_NRF52840
```

## boards/nordic/nrf9160dk/board.yml
```yaml
board:
  name: nrf9160dk
  full_name: nRF9160 DK
  vendor: nordic
  socs:
  - name: nrf9160
    variants:
    - name: 'ns'
  - name: nrf52840
  revision:
    format: major.minor.patch
    default: "0.14.0"
    revisions:
    - name: "0.7.0"
    - name: "0.14.0"
```

## boards/nordic/nrf9160dk/dts/bindings/nordic,nrf9160dk-nrf52840-interface.yaml
```yaml
# Copyright (c) 2021 Nordic Semiconductor ASA
# SPDX-License-Identifier: Apache-2.0

# NOTE: This file is replicated in nrf9160dk_nrf9160 and nrf9160dk_nrf52840.
#       Any changes should be done in both instances.

description: |
    nRF9160 DK GPIO interface between nRF9160 and nRF52840

    This interface can be used for inter-SoC communication on the DK.
    The connections are as follows:

    | nRF9160 |                            |    nRF52840    |
    |   P0.17 | -- nRF interface line 0 -- | P0.17          |
    |   P0.18 | -- nRF interface line 1 -- | P0.20          |
    |   P0.19 | -- nRF interface line 2 -- | P0.15          |
    |   P0.21 | -- nRF interface line 3 -- | P0.22          |
    |   P0.22 | -- nRF interface line 4 -- | P1.04          |
    |   P0.23 | -- nRF interface line 5 -- | P1.02          |
    |   COEX0 | -- nRF interface line 6 -- | P1.13          |
    |   COEX1 | -- nRF interface line 7 -- | P1.11          |
    |   COEX2 | -- nRF interface line 8 -- | P1.15          |
    |   P0.24 | -- nRF interface line 9 -- | P0.18 (nRESET) | (in v0.14.0 or later)

    Before particular lines of this interface can be used, the corresponding
    analog switches that control the routing of involved nRF9160 pins must be
    configured to provide the optional routing (i.e. to nRF52840). To achieve
    this, set the status of respective devicetree nodes in the firmware for
    the nrf9160dk_nrf52840 board to "okay":
    - `nrf_interface_pins_0_2_routing` to enable lines 0-2
    - `nrf_interface_pins_3_5_routing` to enable lines 3-5
    - `nrf_interface_pins_6_8_routing` to enable lines 6-8
    - `nrf_interface_pin_9_routing` to enable line 9 (this line is only
      available in nRF9160 DK v0.14.0 or later)

    NOTE: In nRF9160 DK revisions earlier than v0.14.0, when the above signals
          from nRF9160 are routed to nRF52840, they are not available on the DK
          connectors.

compatible: "nordic,nrf9160dk-nrf52840-interface"

include: [gpio-nexus.yaml, base.yaml]
```

## boards/nordic/nrf9160dk/dts/bindings/nordic,nrf9160dk-nrf52840-reset.yaml
```yaml
# Copyright (c) 2021 Nordic Semiconductor ASA
# SPDX-License-Identifier: Apache-2.0

# NOTE: This file is replicated in nrf9160dk_nrf9160 and nrf9160dk_nrf52840.
#       Any changes should be done in both instances.

description: GPIO used to reset nRF52840 on nRF9160 DK

compatible: "nordic,nrf9160dk-nrf52840-reset"

include: base.yaml

properties:
  status:
    required: true

  gpios:
    type: phandle-array
    required: true
    description: |
      GPIO to use as nRF52840 reset line: output in nRF9160, input in nRF52840.
```

## boards/nordic/nrf9160dk/nrf9160dk_nrf52840_defconfig
```kconfig
# SPDX-License-Identifier: Apache-2.0

# Enable MPU
CONFIG_ARM_MPU=y

# Enable hardware stack protection
CONFIG_HW_STACK_PROTECTION=y

# Enable UART driver
CONFIG_SERIAL=y

# Enable console
CONFIG_CONSOLE=y
CONFIG_UART_CONSOLE=y
```

## boards/nordic/nrf9161dk/Kconfig.defconfig
```kconfig
# nRF9161 DK NRF9161 board configuration

# Copyright (c) 2023 Nordic Semiconductor ASA
# SPDX-License-Identifier: Apache-2.0

config HW_STACK_PROTECTION
	default ARCH_HAS_STACK_PROTECTION

if BOARD_NRF9161DK_NRF9161 || BOARD_NRF9161DK_NRF9161_NS

config BOARD_NRF9161DK
	select USE_DT_CODE_PARTITION if BOARD_NRF9161DK_NRF9161_NS

config BT_HCI_VS
	default y if BT

config BT_WAIT_NOP
	default BT && $(dt_nodelabel_enabled,nrf5340_reset)

config I2C
	default $(dt_compat_on_bus,$(DT_COMPAT_NXP_PCAL6408A),i2c)

endif # BOARD_NRF9161DK_NRF9161 || BOARD_NRF9161DK_NRF9161_NS
```

## boards/nordic/nrf9161dk/Kconfig.nrf9161dk
```kconfig
# nRF9161 DK NRF9161 board configuration

# Copyright (c) 2023 Nordic Semiconductor ASA
# SPDX-License-Identifier: Apache-2.0

config BOARD_NRF9161DK
	select SOC_NRF9161_LACA
```

## boards/nordic/nrf9161dk/board.yml
```yaml
board:
  name: nrf9161dk
  full_name: nRF9161 DK
  vendor: nordic
  socs:
  - name: nrf9161
    variants:
    - name: 'ns'
  revision:
    format: major.minor.patch
    default: "0.9.0"
    revisions:
    - name: "0.7.0"
    - name: "0.9.0"
```

## boards/nordic/nrf9280pdk/Kconfig.defconfig
```kconfig
# Copyright (c) 2024 Nordic Semiconductor ASA
# SPDX-License-Identifier: Apache-2.0

config HW_STACK_PROTECTION
	default ARCH_HAS_STACK_PROTECTION

if BOARD_NRF9280PDK_NRF9280_CPUPPR

# As PPR has limited memory most of tests does not fit with asserts enabled.
config ASSERT
	default n if ZTEST

endif # BOARD_NRF9280PDK_NRF9280_CPUPPR

if BOARD_NRF9280PDK_NRF9280_CPUAPP

config ROM_START_OFFSET
	default 0x800 if BOOTLOADER_MCUBOOT

config FLASH_LOAD_OFFSET
	default $(dt_nodelabel_reg_addr_hex,cpuapp_boot_partition) if !USE_DT_CODE_PARTITION

endif # BOARD_NRF9280PDK_NRF9280_CPUAPP
```

## boards/nordic/nrf9280pdk/Kconfig.nrf9280pdk
```kconfig
# Copyright (c) 2024 Nordic Semiconductor ASA
# SPDX-License-Identifier: Apache-2.0

config BOARD_NRF9280PDK
	select SOC_NRF9280_CPUAPP if BOARD_NRF9280PDK_NRF9280_CPUAPP
	select SOC_NRF9280_CPURAD if BOARD_NRF9280PDK_NRF9280_CPURAD
	select SOC_NRF9280_CPUPPR if (BOARD_NRF9280PDK_NRF9280_CPUPPR || \
				       BOARD_NRF9280PDK_NRF9280_CPUPPR_XIP)
```

## boards/nordic/nrf9280pdk/board.yml
```yaml
board:
  name: nrf9280pdk
  full_name: nRF9280 PDK
  vendor: nordic
  socs:
  - name: nrf9280
    variants:
    - name: xip
      cpucluster: cpuppr
  revision:
    format: major.minor.patch
    default: 0.2.0
    exact: false
    revisions:
    - name: 0.1.0
    - name: 0.2.0
```

## boards/nordic/nrf9280pdk/nrf9280pdk_nrf9280_cpuapp_defconfig
```kconfig
# Copyright (c) 2024 Nordic Semiconductor ASA
# SPDX-License-Identifier: Apache-2.0

# Enable UART driver
CONFIG_SERIAL=y

# Enable console
CONFIG_CONSOLE=y
CONFIG_UART_CONSOLE=y

# Enable MPU
CONFIG_ARM_MPU=y

# MPU-based null-pointer dereferencing detection cannot be applied
# as the (0x0 - 0x400) region is unmapped for this target.
CONFIG_NULL_POINTER_EXCEPTION_DETECTION_NONE=y

# Enable cache
CONFIG_CACHE_MANAGEMENT=y
CONFIG_EXTERNAL_CACHE=y

# Enable GPIO
CONFIG_GPIO=y
```

## boards/nordic/nrf9280pdk/nrf9280pdk_nrf9280_cpuppr_xip_defconfig
```kconfig
# Copyright (c) 2024 Nordic Semiconductor ASA
# SPDX-License-Identifier: Apache-2.0

# Enable UART driver
CONFIG_SERIAL=y

# Enable console
CONFIG_CONSOLE=y
CONFIG_UART_CONSOLE=y

CONFIG_USE_DT_CODE_PARTITION=y

CONFIG_XIP=y
```

## boards/nordic/nrf93m1dk/Kconfig.defconfig
```kconfig
# Copyright (c) 2026 Nordic Semiconductor ASA
# SPDX-License-Identifier: Apache-2.0

config HW_STACK_PROTECTION
	default ARCH_HAS_STACK_PROTECTION

if SPI_NOR

config SPI_NOR_FLASH_LAYOUT_PAGE_SIZE
	default 4096 if MCUBOOT || BOOTLOADER_MCUBOOT

endif # SPI_NOR

if BOARD_NRF93M1DK_NRF54L15_CPUAPP_NS

config BOARD_NRF93M1DK
	select USE_DT_CODE_PARTITION if BOARD_NRF93M1DK_NRF54L15_CPUAPP_NS

# By default, if we build for a Non-Secure version of the board,
# enable building with TF-M as the Secure Execution Environment.
config BUILD_WITH_TFM
	default y

# If building with TF-M, disable UART in TF-M to avoid conflicts with
# the UART used by the modem
if BUILD_WITH_TFM

config TFM_SECURE_UART
	default n

config TFM_LOG_LEVEL_SILENCE
	default y

endif # BUILD_WITH_TFM

endif # BOARD_NRF93M1DK_NRF54L15_CPUAPP_NS

if BOARD_NRF93M1DK_NRF54L15_CPUAPP_NS || BOARD_NRF93M1DK_NRF54L15_CPUAPP

# Configure default init priority:
# 1. I2C (CONFIG_I2C_INIT_PRIORITY, default 50)
# 2. NPM13xx MFD (CONFIG_MFD_INIT_PRIORITY, default 80)
# 3. NPM13xx charger (CONFIG_SENSOR_INIT_PRIORITY, default 90)
# 4. Power domain GPIO (CONFIG_POWER_DOMAIN_GPIO_INIT_PRIORITY, default was 75)
# 5. Cellular modem (CONFIG_MODEM_CELLULAR_INIT_PRIORITY, default was 79)
#
# The order of 3, 4 and 5 is critical to ensure that the Vbus current limit
# is set before the modem is initialized.

config POWER_DOMAIN_GPIO_INIT_PRIORITY
	default 92

config MODEM_CELLULAR_INIT_PRIORITY
	default 93

if !MCUBOOT

config REGULATOR
	default y

config SENSOR
	default y

config POWER_DOMAIN
	default y

endif # !MCUBOOT

endif # BOARD_NRF93M1DK_NRF54L15_CPUAPP_NS || BOARD_NRF93M1DK_NRF54L15_CPUAPP
```

## boards/nordic/nrf93m1dk/Kconfig.nrf93m1dk
```kconfig
# Copyright (c) 2026 Nordic Semiconductor ASA
# SPDX-License-Identifier: Apache-2.0

config BOARD_NRF93M1DK
	select SOC_NRF54L15_CPUAPP if BOARD_NRF93M1DK_NRF54L15_CPUAPP || BOARD_NRF93M1DK_NRF54L15_CPUAPP_NS
	select SOC_NRF54L15_CPUFLPR if BOARD_NRF93M1DK_NRF54L15_CPUFLPR || \
		BOARD_NRF93M1DK_NRF54L15_CPUFLPR_XIP

config BOARD_NRF93M1DK_INIT_PRIORITY
	int "Initialization priority"
	default 91
	help
	  Initialization priority of nrf93m1dk board.
```

## boards/nordic/nrf93m1dk/board.yml
```yaml
board:
  name: nrf93m1dk
  full_name: nRF93M1 DK
  vendor: nordic
  revision:
    format: major.minor.patch
    default: "0.3.0"
    revisions:
    - name: "0.1.0"
    - name: "0.2.0"
    - name: "0.3.0"
  socs:
  - name: nrf54l15
    variants:
    - name: xip
      cpucluster: cpuflpr
    - name: ns
      cpucluster: cpuapp
runners:
  run_once:
    '--recover':
    - runners:
      - nrfutil
      run: first
      groups:
      - boards:
        - nrf93m1dk/nrf54l15/cpuapp
        - nrf93m1dk/nrf54l15/cpuapp/ns
        - nrf93m1dk/nrf54l15/cpuflpr
        - nrf93m1dk/nrf54l15/cpuflpr/xip
    '--erase':
    - runners:
      - jlink
      - nrfutil
      run: first
      groups:
      - boards:
        - nrf93m1dk/nrf54l15/cpuapp
        - nrf93m1dk/nrf54l15/cpuapp/ns
        - nrf93m1dk/nrf54l15/cpuflpr
        - nrf93m1dk/nrf54l15/cpuflpr/xip
    '--reset':
    - runners:
      - jlink
      - nrfutil
      run: last
      groups:
      - boards:
        - nrf93m1dk/nrf54l15/cpuapp
        - nrf93m1dk/nrf54l15/cpuapp/ns
        - nrf93m1dk/nrf54l15/cpuflpr
        - nrf93m1dk/nrf54l15/cpuflpr/xip
```

## boards/nordic/nrf93m1dk/nrf93m1dk_nrf54l15_cpuapp_defconfig
```kconfig
# Copyright (c) 2026 Nordic Semiconductor ASA
# SPDX-License-Identifier: Apache-2.0

# DK does no have 32kHz crystal, use the internal RC oscillator
CONFIG_CLOCK_CONTROL_NRF_K32SRC_RC=y

# Enable UART driver
CONFIG_SERIAL=y

# Enable console
CONFIG_CONSOLE=y
CONFIG_UART_CONSOLE=y

# Enable GPIO
CONFIG_GPIO=y

# Enable MPU
CONFIG_ARM_MPU=y

CONFIG_I2C=y
CONFIG_REGULATOR=y
CONFIG_REGULATOR_NPM13XX=y
CONFIG_SENSOR=y
CONFIG_NPM13XX_CHARGER=y
CONFIG_POWER_DOMAIN=y
```

## boards/nordic/nrf93m1dk/nrf93m1dk_nrf54l15_cpuapp_ns_defconfig
```kconfig
# Copyright (c) 2026 Nordic Semiconductor ASA
# SPDX-License-Identifier: Apache-2.0

# DK does no have 32kHz crystal, use the internal RC oscillator
CONFIG_CLOCK_CONTROL_NRF_K32SRC_RC=y

CONFIG_ARM_MPU=y
CONFIG_NULL_POINTER_EXCEPTION_DETECTION_NONE=y
CONFIG_ARM_TRUSTZONE_M=y

# This Board implies building Non-Secure firmware
CONFIG_TRUSTED_EXECUTION_NONSECURE=y

# Don't enable the cache in the non-secure image as it is a
# secure-only peripheral on 54l
CONFIG_CACHE_MANAGEMENT=n
CONFIG_EXTERNAL_CACHE=n

CONFIG_UART_CONSOLE=y
CONFIG_CONSOLE=y
CONFIG_SERIAL=y
CONFIG_GPIO=y

# Start SYSCOUNTER on driver init
CONFIG_NRF_GRTC_START_SYSCOUNTER=y

# Disable TFM BL2 since it is not supported
CONFIG_TFM_BL2=n

# The oscillators are configured as secure and cannot be configured
# from the non secure application directly. This needs to be set
# otherwise nrfx will try to configure them, resulting in a bus
# fault.
CONFIG_NRF_SKIP_CLOCK_CONFIG=y

CONFIG_TFM_SECURE_UART=n
CONFIG_TFM_LOG_LEVEL_SILENCE=y
CONFIG_REGULATOR=y
CONFIG_REGULATOR_NPM13XX=y
CONFIG_SENSOR=y
CONFIG_NPM13XX_CHARGER=y
CONFIG_I2C=y
CONFIG_POWER_DOMAIN=y
```

## boards/nordic/thingy52/Kconfig
```kconfig
# Thingy52 NRF52832 board configuration

# Copyright (c) 2018 Aapo Vienamo
# SPDX-License-Identifier: Apache-2.0

if BOARD_THINGY52

config BOARD_CCS_VDD_PWR_CTRL_INIT_PRIORITY
	int "CCS_VDD power rail init priority"
	default 85
	depends on GPIO_SX1509B
	help
	  Initialization priority for the CCS_VDD power rail. This powers the
	  CCS811 gas sensor. The value has to be greater than
	  BOARD_VDD_PWR_CTRL_INIT_PRIORITY, but smaller than SENSOR_INIT_PRIORITY.

endif # BOARD_THINGY52
```

## boards/nordic/thingy52/Kconfig.defconfig
```kconfig
# Thingy52 NRF52832 board configuration

# Copyright (c) 2018 Aapo Vienamo
# SPDX-License-Identifier: Apache-2.0

if BOARD_THINGY52

config HW_STACK_PROTECTION
	default ARCH_HAS_STACK_PROTECTION

endif # BOARD_THINGY52
```

## boards/nordic/thingy52/Kconfig.thingy52
```kconfig
# Thingy52 NRF52832 board configuration

# Copyright (c) 2018 Aapo Vienamo
# SPDX-License-Identifier: Apache-2.0

config BOARD_THINGY52
	select SOC_NRF52832_QFAA
```

## boards/nordic/thingy52/board.yml
```yaml
board:
  name: thingy52
  full_name: "Thingy:52"
  vendor: nordic
  socs:
  - name: nrf52832
```
