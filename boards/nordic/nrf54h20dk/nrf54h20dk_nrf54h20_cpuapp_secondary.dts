/*
 * Copyright (c) 2024 Nordic Semiconductor ASA
 *
 * SPDX-License-Identifier: Apache-2.0
 */

#include "nrf54h20dk_nrf54h20_cpuapp.dts"

/ {
	chosen {
		zephyr,code-partition = &cpuapp_secondary_partition;
	};
};
