/*
 * Copyright (c) 2025 Nordic Semiconductor ASA
 *
 * SPDX-License-Identifier: Apache-2.0
 */

/dts-v1/;

#include "nrf54lv10a_cpuapp_common.dtsi"

/ {
	compatible = "nordic,nrf54lv10dk_nrf54lv10a-cpuapp";
	model = "Nordic nRF54LV10 DK nRF54LV10A Application MCU";

	chosen {
		zephyr,code-partition = &slot0_partition;
		zephyr,sram = &cpuapp_sram;
	};
};

&bt_hci_controller {
	status = "disabled";
};

/* Include default memory partition configuration file */
#include <vendor/nordic/nrf54lv10a_cpuapp_partition.dtsi>
