/*
 * Copyright (c) 2025 Nordic Semiconductor ASA
 *
 * SPDX-License-Identifier: Apache-2.0
 */

&hfpll {
	/* For now use 64 MHz clock for CPU and fast peripherals. */
	clock-frequency = <DT_FREQ_M(64)>;
};
