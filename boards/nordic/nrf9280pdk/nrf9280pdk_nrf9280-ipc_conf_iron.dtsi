/*
 * Copyright (c) 2025 Nordic Semiconductor ASA
 *
 * SPDX-License-Identifier: Apache-2.0
 */

/* This file is to be merged with the original ipc_conf.dtsi in the future. */

/ {
	ipc {
		/delete-node/ ipc-1-2;
		/delete-node/ ipc-1-3;

		cpusec_cpuapp_ipc: ipc-1-2 {
			compatible = "nordic,ironside-call";
			memory-region = <&cpusec_cpuapp_ipc_shm>;
			mboxes = <&cpusec_bellboard 12>,
				 <&cpuapp_bellboard 0>;
			status = "disabled";
		};

		cpusec_cpurad_ipc: ipc-1-3 {
			compatible = "nordic,ironside-call";
			memory-region = <&cpusec_cpurad_ipc_shm>;
			mboxes = <&cpusec_bellboard 18>,
				 <&cpurad_bellboard 0>;
			status = "disabled";
		};
	};
};
