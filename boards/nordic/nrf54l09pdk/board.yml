## boards/nordic/nrf54l09pdk/board.yml
```yaml
board:
  name: nrf54l09pdk
  full_name: nRF54L09 PDK
  vendor: nordic
  socs:
  - name: nrf54l09
```

## boards/nordic/nrf54l15dk/Kconfig
```kconfig
# Copyright (c) 2026 Nordic Semiconductor ASA
# SPDX-License-Identifier: Apache-2.0

config BOARD_NRF54L15DK
	select SOC_NRF54L10_DEVELOP_IN_NRF54L15 if SOC_NRF54L10
	select SOC_NRF54L05_DEVELOP_IN_NRF54L15 if SOC_NRF54L05
```

## boards/nordic/nrf54l15dk/Kconfig.defconfig
```kconfig
# Copyright (c) 2024 Nordic Semiconductor ASA
# SPDX-License-Identifier: Apache-2.0

config HW_STACK_PROTECTION
	default ARCH_HAS_STACK_PROTECTION

if BOARD_NRF54L15DK_NRF54L05_CPUAPP || BOARD_NRF54L15DK_NRF54L10_CPUAPP || \
	BOARD_NRF54L15DK_NRF54L15_CPUAPP

config ROM_START_OFFSET
	default 0x800 if BOOTLOADER_MCUBOOT

endif # BOARD_NRF54L15DK_NRF54L05_CPUAPP || BOARD_NRF54L15DK_NRF54L10_CPUAPP || \
	# BOARD_NRF54L15DK_NRF54L15_CPUAPP

if BOARD_NRF54L15DK_NRF54L15_CPUAPP_NS || BOARD_NRF54L15DK_NRF54L10_CPUAPP_NS

config BOARD_NRF54L15DK
	select USE_DT_CODE_PARTITION if BOARD_NRF54L15DK_NRF54L15_CPUAPP_NS || \
		BOARD_NRF54L15DK_NRF54L10_CPUAPP_NS

config HAS_BT_CTLR
	default BT

# By default, if we build for a Non-Secure version of the board,
# enable building with TF-M as the Secure Execution Environment.
config BUILD_WITH_TFM
	default y

endif # BOARD_NRF54L15DK_NRF54L15_CPUAPP_NS || BOARD_NRF54L15DK_NRF54L10_CPUAPP_NS
```

## boards/nordic/nrf54l15dk/Kconfig.nrf54l15dk
```kconfig
# Copyright (c) 2024 Nordic Semiconductor ASA
# SPDX-License-Identifier: Apache-2.0

config BOARD_NRF54L15DK
	select SOC_NRF54L05_CPUAPP if BOARD_NRF54L15DK_NRF54L05_CPUAPP
	select SOC_NRF54L10_CPUAPP if BOARD_NRF54L15DK_NRF54L10_CPUAPP
	select SOC_NRF54L15_CPUAPP if BOARD_NRF54L15DK_NRF54L15_CPUAPP || BOARD_NRF54L15DK_NRF54L15_CPUAPP_NS
	select SOC_NRF54L15_CPUFLPR if BOARD_NRF54L15DK_NRF54L15_CPUFLPR || \
					    BOARD_NRF54L15DK_NRF54L15_CPUFLPR_XIP
```

## boards/nordic/nrf54l15dk/board.yml
```yaml
board:
  name: nrf54l15dk
  full_name: nRF54L15 DK
  vendor: nordic
  socs:
    - name: nrf54l05
    - name: nrf54l10
      variants:
        - name: ns
          cpucluster: cpuapp
    - name: nrf54l15
      variants:
        - name: xip
          cpucluster: cpuflpr
        - name: ns
          cpucluster: cpuapp
runners:
  run_once:
    '--recover':
      - runners:
          - nrfjprog
          - nrfutil
        run: first
        groups:
          - boards:
              - nrf54l15dk/nrf54l15/cpuapp
              - nrf54l15dk/nrf54l15/cpuflpr
              - nrf54l15dk/nrf54l15/cpuflpr/xip
    '--erase':
      - runners:
          - nrfjprog
          - jlink
          - nrfutil
        run: first
        groups:
          - boards:
              - nrf54l15dk/nrf54l15/cpuapp
              - nrf54l15dk/nrf54l15/cpuflpr
              - nrf54l15dk/nrf54l15/cpuflpr/xip
    '--reset':
      - runners:
          - nrfjprog
          - jlink
          - nrfutil
        run: last
        groups:
          - boards:
              - nrf54l15dk/nrf54l15/cpuapp
              - nrf54l15dk/nrf54l15/cpuflpr
              - nrf54l15dk/nrf54l15/cpuflpr/xip
```

## boards/nordic/nrf54l15dk/nrf54l15dk_nrf54l15_cpuapp_ns_defconfig
```kconfig
# Copyright (c) 2025 Nordic Semiconductor ASA
# SPDX-License-Identifier: LicenseRef-Nordic-5-Clause

CONFIG_ARM_MPU=y
CONFIG_HW_STACK_PROTECTION=y
CONFIG_NULL_POINTER_EXCEPTION_DETECTION_NONE=y
CONFIG_ARM_TRUSTZONE_M=y

# This Board implies building Non-Secure firmware
CONFIG_TRUSTED_EXECUTION_NONSECURE=y

# Don't enable the cache in the non-secure image as it is a
# secure-only peripheral on 54l
CONFIG_CACHE_MANAGEMENT=n
CONFIG_EXTERNAL_CACHE=n

CONFIG_UART_CONSOLE=y
CONFIG_CONSOLE=y
CONFIG_SERIAL=y
CONFIG_GPIO=y

# Start SYSCOUNTER on driver init
CONFIG_NRF_GRTC_START_SYSCOUNTER=y

# Disable TFM BL2 since it is not supported
CONFIG_TFM_BL2=n

# Support for silence logging is not supported at the moment
# Tracked by: NCSDK-31930
CONFIG_TFM_LOG_LEVEL_SILENCE=n

# The oscillators are configured as secure and cannot be configured
# from the non secure application directly. This needs to be set
# otherwise nrfx will try to configure them, resulting in a bus
# fault.
CONFIG_SOC_NRF54LX_SKIP_CLOCK_CONFIG=y
```

## boards/nordic/nrf54l15dk/nrf54l15dk_nrf54l15_cpuflpr_xip_defconfig
```kconfig
# Copyright (c) 2024 Nordic Semiconductor ASA
# SPDX-License-Identifier: Apache-2.0

# Enable UART driver
CONFIG_SERIAL=y

# Enable console
CONFIG_CONSOLE=y
CONFIG_UART_CONSOLE=y

# Enable GPIO
CONFIG_GPIO=y

# Execute from RRAM
CONFIG_XIP=y
```

## boards/nordic/nrf54l15pdk/Kconfig
```kconfig
# nRF54L15 PDK board configuration

# Copyright (c) 2024 Nordic Semiconductor ASA
# SPDX-License-Identifier: Apache-2.0

if BOARD_NRF54L15PDK_NRF54L15_CPUAPP

config BOARD_ENABLE_DCDC
	bool "DCDC mode"
	select SOC_NRF54L_VREG_MAIN_DCDC
	default y

endif # BOARD_NRF54L15PDK_NRF54L15_CPUAPP

if BOARD_NRF54L15PDK_NRF54L15_CPUAPP_NS

# TODO: Remove the options bellow when (NCSDK-25023) is done
config NRF_SPU_FLASH_REGION_SIZE
	hex
	default 0x4000
	# This option does not apply to 54, but we pretend the HW has this limitation
	# for now for easier porting. NCSDK-25023
	help
	  FLASH region size for the NRF_SPU peripheral. For nrf54 the
	  region size is configurable per-region so this option does
	  not apply.

config NRF_SPU_FLASH_REGION_ALIGNMENT
	hex
	default 0x4000
	# This option does not apply to 54, but we pretend the HW has this limitation
	# for now for easier porting. NCSDK-25023
	help
	  FLASH region size for the NRF_SPU peripheral. For nrf54 the
	  region size is configurable per-region so this option does
	  not apply.

config NRF_SPU_RAM_REGION_SIZE
	hex
	default 0x2000
	# This HW limitation does not apply to 54, but we pretend
	# it does for now for easier porting. NCSDK-25023
	help
	  RAM region size for the NRF_SPU peripheral. For nrf54 the
	  region size is configurable per-region so this option does
	  not apply.


config NRF_SPU_RAM_REGION_ALIGNMENT
	hex
	default 0x1000
	help
	  RAM regions must be aligned to this value due to SPU HW
	  limitations.

endif #BOARD_NRF54L15PDK_NRF54L15_CPUAPP_NS
```

## boards/nordic/nrf54l15pdk/Kconfig.defconfig
```kconfig
# Copyright (c) 2024 Nordic Semiconductor ASA
# SPDX-License-Identifier: Apache-2.0

if BOARD_NRF54L15PDK_NRF54L15_CPUAPP

config BT_CTLR
	default BT

config ROM_START_OFFSET
	default 0 if PARTITION_MANAGER_ENABLED
	default 0x800 if BOOTLOADER_MCUBOOT

endif # BOARD_NRF54L15PDK_NRF54L15_CPUAPP

if BOARD_NRF54L15PDK_NRF54L15_CPUAPP_NS

config BT_CTLR
	default BT

# By default, if we build for a Non-Secure version of the board,
# enable building with TF-M as the Secure Execution Environment.
config BUILD_WITH_TFM
	default y if BOARD_NRF54L15PDK_NRF54L15_CPUAPP_NS

# By default, if we build with TF-M, instruct build system to
# flash the combined TF-M (Secure) & Zephyr (Non Secure) image
config TFM_FLASH_MERGED_BINARY
	default y
	depends on BUILD_WITH_TFM

endif #BOARD_NRF54L15PDK_NRF54L15_CPUAPP_NS

if BOARD_NRF54L15PDK_NRF54L15_CPUFLPR || BOARD_NRF54L15PDK_NRF54L15_CPUFLPR_XIP

# As FLPR has limited memory most of tests does not fit with asserts enabled.
config ASSERT
	default n if ZTEST

endif # BOARD_NRF54L15PDK_NRF54L15_CPUFLPR || BOARD_NRF54L15PDK_NRF54L15_CPUFLPR_XIP
```

## boards/nordic/nrf54l15pdk/Kconfig.nrf54l15pdk
```kconfig
# Copyright (c) 2024 Nordic Semiconductor ASA
# SPDX-License-Identifier: Apache-2.0

config BOARD_NRF54L15PDK
	select SOC_NRF54L15_ENGA_CPUAPP if BOARD_NRF54L15PDK_NRF54L15_CPUAPP || BOARD_NRF54L15PDK_NRF54L15_CPUAPP_NS
	select SOC_NRF54L15_ENGA_CPUFLPR if BOARD_NRF54L15PDK_NRF54L15_CPUFLPR || \
					    BOARD_NRF54L15PDK_NRF54L15_CPUFLPR_XIP
```

## boards/nordic/nrf54l15pdk/board.yml
```yaml
board:
  name: nrf54l15pdk
  full_name: nRF54L15 PDK
  vendor: nordic
  socs:
  - name: nrf54l15
    variants:
    - name: xip
      cpucluster: cpuflpr
  revision:
    format: major.minor.patch
    default: "0.3.0"
    revisions:
    - name: "0.2.1"
    - name: "0.3.0"
```

## boards/nordic/nrf54l15pdk/nrf54l15pdk_nrf54l15_cpuapp_defconfig
```kconfig
# Copyright (c) 2024 Nordic Semiconductor ASA
# SPDX-License-Identifier: Apache-2.0

# Enable UART driver
CONFIG_SERIAL=y

# Enable console
CONFIG_CONSOLE=y
CONFIG_UART_CONSOLE=y

# Enable MPU
CONFIG_ARM_MPU=y

# Enable hardware stack protection
CONFIG_HW_STACK_PROTECTION=y

# MPU-based null-pointer dereferencing detection cannot
# be applied as the (0x0 - 0x400) is unmapped for this target.
CONFIG_NULL_POINTER_EXCEPTION_DETECTION_NONE=y

# Enable Cache
CONFIG_CACHE_MANAGEMENT=y
CONFIG_EXTERNAL_CACHE=y

CONFIG_UART_CONSOLE=y
CONFIG_CONSOLE=y
CONFIG_SERIAL=y

# Enable GPIO
CONFIG_GPIO=y

CONFIG_SOC_NRF_FORCE_CONSTLAT=y

# Start SYSCOUNTER on driver init
CONFIG_NRF_GRTC_START_SYSCOUNTER=y
```

## boards/nordic/nrf54l15pdk/nrf54l15pdk_nrf54l15_cpuapp_ns_defconfig
```kconfig
# Copyright (c) 2024 Nordic Semiconductor ASA
# SPDX-License-Identifier: LicenseRef-Nordic-5-Clause

# Enable MPU
CONFIG_ARM_MPU=y

# Enable hardware stack protection
CONFIG_HW_STACK_PROTECTION=y

CONFIG_NULL_POINTER_EXCEPTION_DETECTION_NONE=y

# Enable TrustZone-M
CONFIG_ARM_TRUSTZONE_M=y

# This Board implies building Non-Secure firmware
CONFIG_TRUSTED_EXECUTION_NONSECURE=y

# Don't enable the cache in the non-secure image as it is a
# secure-only peripheral on 54l
CONFIG_CACHE_MANAGEMENT=n
CONFIG_EXTERNAL_CACHE=n

CONFIG_UART_CONSOLE=y
CONFIG_CONSOLE=y
CONFIG_SERIAL=y

# Enable GPIO
CONFIG_GPIO=y

# Start SYSCOUNTER on driver init
CONFIG_NRF_GRTC_START_SYSCOUNTER=y
```

## boards/nordic/nrf54l15tag/Kconfig.defconfig
```kconfig
# Copyright (c) 2025 Nordic Semiconductor ASA
# SPDX-License-Identifier: Apache-2.0

config HW_STACK_PROTECTION
	default ARCH_HAS_STACK_PROTECTION

if SPI_NOR

config SPI_NOR_FLASH_LAYOUT_PAGE_SIZE
	default 4096 if MCUBOOT || BOOTLOADER_MCUBOOT

endif # SPI_NOR

if BOARD_NRF54L15TAG_NRF54L15_CPUAPP_NS

config BOARD_NRF54L15TAG
	select USE_DT_CODE_PARTITION

config HAS_BT_CTLR
	default BT

# By default, if we build for a Non-Secure version of the board,
# enable building with TF-M as the Secure Execution Environment.
config BUILD_WITH_TFM
	default y

endif # BOARD_NRF54L15TAG_NRF54L15_CPUAPP_NS
```

## boards/nordic/nrf54l15tag/Kconfig.nrf54l15tag
```kconfig
# Copyright (c) 2025 Nordic Semiconductor ASA
# SPDX-License-Identifier: Apache-2.0

config BOARD_NRF54L15TAG
	select SOC_NRF54L15_CPUAPP if BOARD_NRF54L15TAG_NRF54L15_CPUAPP || \
				      BOARD_NRF54L15TAG_NRF54L15_CPUAPP_NS
	select SOC_NRF54L15_CPUFLPR if BOARD_NRF54L15TAG_NRF54L15_CPUFLPR || \
				       BOARD_NRF54L15TAG_NRF54L15_CPUFLPR_XIP
```

## boards/nordic/nrf54l15tag/board.yml
```yaml
board:
  name: nrf54l15tag
  full_name: nRF54L15 TAG
  vendor: nordic
  socs:
    - name: nrf54l15
      variants:
        - name: xip
          cpucluster: cpuflpr
        - name: ns
          cpucluster: cpuapp
runners:
  run_once:
    '--recover':
      - runners:
          - nrfjprog
          - nrfutil
        run: first
        groups:
          - boards:
              - nrf54l15tag/nrf54l15/cpuapp
              - nrf54l15tag/nrf54l15/cpuapp/ns
              - nrf54l15tag/nrf54l15/cpuflpr
              - nrf54l15tag/nrf54l15/cpuflpr/xip
    '--erase':
      - runners:
          - nrfjprog
          - jlink
          - nrfutil
        run: first
        groups:
          - boards:
              - nrf54l15tag/nrf54l15/cpuapp
              - nrf54l15tag/nrf54l15/cpuapp/ns
              - nrf54l15tag/nrf54l15/cpuflpr
              - nrf54l15tag/nrf54l15/cpuflpr/xip
    '--reset':
      - runners:
          - nrfjprog
          - jlink
          - nrfutil
        run: last
        groups:
          - boards:
              - nrf54l15tag/nrf54l15/cpuapp
              - nrf54l15tag/nrf54l15/cpuapp/ns
              - nrf54l15tag/nrf54l15/cpuflpr
              - nrf54l15tag/nrf54l15/cpuflpr/xip
```

## boards/nordic/nrf54l15tag/nrf54l15tag_nrf54l15_cpuapp_defconfig
```kconfig
# Copyright (c) 2025 Nordic Semiconductor ASA
# SPDX-License-Identifier: Apache-2.0

CONFIG_GPIO=y
CONFIG_ARM_MPU=y
```

## boards/nordic/nrf54l15tag/nrf54l15tag_nrf54l15_cpuflpr_defconfig
```kconfig
# Copyright (c) 2025 Nordic Semiconductor ASA
# SPDX-License-Identifier: Apache-2.0

CONFIG_GPIO=y
CONFIG_USE_DT_CODE_PARTITION=y

# Execute from SRAM
CONFIG_XIP=n
```

## boards/nordic/nrf54l15tag/nrf54l15tag_nrf54l15_cpuflpr_xip_defconfig
```kconfig
# Copyright (c) 2025 Nordic Semiconductor ASA
# SPDX-License-Identifier: Apache-2.0

CONFIG_GPIO=y

# Execute from RRAM
CONFIG_XIP=y
CONFIG_USE_DT_CODE_PARTITION=y
```

## boards/nordic/nrf54l20pdk/Kconfig
```kconfig
# nRF54L20 PDK board configuration

# Copyright (c) 2024 Nordic Semiconductor ASA
# SPDX-License-Identifier: Apache-2.0

if BOARD_NRF54L20PDK_NRF54L20_CPUAPP

config BOARD_ENABLE_DCDC
	bool "DCDC mode"
	select SOC_NRF54L_VREG_MAIN_DCDC
	default y

endif # BOARD_NRF54L20PDK_NRF54L20_CPUAPP
```

## boards/nordic/nrf54l20pdk/Kconfig.defconfig
```kconfig
# Copyright (c) 2024 Nordic Semiconductor ASA
# SPDX-License-Identifier: Apache-2.0

if BOARD_NRF54L20PDK_NRF54L20_CPUAPP

config HW_STACK_PROTECTION
	default ARCH_HAS_STACK_PROTECTION

config ROM_START_OFFSET
	default 0x800 if BOOTLOADER_MCUBOOT

config SOC_NRF54LX_SKIP_GLITCHDETECTOR_DISABLE
	default y

endif # BOARD_NRF54L20PDK_NRF54L20_CPUAPP
```

## boards/nordic/nrf54l20pdk/Kconfig.nrf54l20pdk
```kconfig
# Copyright (c) 2024 Nordic Semiconductor ASA
# SPDX-License-Identifier: Apache-2.0

config BOARD_NRF54L20PDK
	select SOC_NRF54L20_ENGA_CPUAPP if BOARD_NRF54L20PDK_NRF54L20_CPUAPP
```

## boards/nordic/nrf54l20pdk/board.yml
```yaml
board:
  name: nrf54l20pdk
  full_name: nRF54L20 PDK
  vendor: nordic
  socs:
  - name: nrf54l20
    variants:
    - name: xip
      cpucluster: cpuflpr
```

## boards/nordic/nrf54lm20dk/Kconfig
```kconfig
# Copyright (c) 2026 Nordic Semiconductor ASA
# SPDX-License-Identifier: Apache-2.0

config BOARD_NRF54LM20DK
	select SOC_NRF54LM20A_DEVELOP_IN_NRF54LM20B if SOC_NRF54LM20A_CPUAPP || SOC_NRF54LM20A_CPUFLPR
```

## boards/nordic/nrf54lm20dk/Kconfig.defconfig
```kconfig
# Copyright (c) 2025 Nordic Semiconductor ASA
# SPDX-License-Identifier: Apache-2.0

if BOARD_NRF54LM20DK_NRF54LM20A_CPUAPP

config HW_STACK_PROTECTION
	default ARCH_HAS_STACK_PROTECTION

endif # BOARD_NRF54LM20DK_NRF54LM20A_CPUAPP

if BOARD_NRF54LM20DK_NRF54LM20A_CPUAPP_NS

# By default, if we build for a Non-Secure version of the board,
# enable building with TF-M as the Secure Execution Environment.
config BUILD_WITH_TFM
	default y

endif # BOARD_NRF54LM20DK_NRF54LM20A_CPUAPP_NS
```
