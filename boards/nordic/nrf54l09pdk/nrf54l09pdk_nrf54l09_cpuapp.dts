/*
 * Copyright (c) 2024 Nordic Semiconductor ASA
 *
 * SPDX-License-Identifier: Apache-2.0
 */

/dts-v1/;

#include "nrf54l09_cpuapp_common.dtsi"

/ {
	compatible = "nordic,nrf54l09pdk_nrf54l09-cpuapp";
	model = "Nordic nRF54L09 PDK nRF54L09 Application MCU";

	chosen {
		zephyr,code-partition = &slot0_partition;
		zephyr,sram = &cpuapp_sram;
	};
};
