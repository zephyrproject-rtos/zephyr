/*
 * Copyright (c) 2025 Nordic Semiconductor ASA
 *
 * SPDX-License-Identifier: Apache-2.0
 */

#include <vendor/nordic/nrf54l15_cpuflpr.dtsi>

#include "nrf54l15tag_common.dtsi"

/ {
	chosen {
		zephyr,code-partition = &cpuflpr_code_partition;
		zephyr,flash = &cpuflpr_rram;
		zephyr,sram = &cpuflpr_sram;
	};
};

&grtc {
	owned-channels = <3 4>;
	status = "okay";
};
