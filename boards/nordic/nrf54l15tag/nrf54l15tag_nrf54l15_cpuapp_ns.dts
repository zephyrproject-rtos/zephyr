/*
 * Copyright (c) 2025 Nordic Semiconductor ASA
 *
 * SPDX-License-Identifier: Apache-2.0
 */

/dts-v1/;

#define USE_NON_SECURE_ADDRESS_MAP 1

#include <arm/nordic/nrf54l15_cpuapp_ns.dtsi>
#include <vendor/nordic/nrf54l15_cpuapp_ns_partition.dtsi>

#include "nrf54l15tag_cpuapp_common.dtsi"

/ {
	compatible = "nordic,nrf54l15tag_nrf54l15-cpuapp";
	model = "Nordic nRF54L15 TAG nRF54L15 Application MCU";

	/delete-node/ rng;

	psa_rng: psa-rng {
		status = "okay";
	};

	chosen {
		zephyr,sram = &sram0_ns;
		zephyr,code-partition = &slot0_ns_partition;
		zephyr,entropy = &psa_rng;
	};
};
