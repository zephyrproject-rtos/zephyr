/*
 * Copyright (c) 2025 Nordic Semiconductor ASA
 *
 * SPDX-License-Identifier: Apache-2.0
 */

/dts-v1/;

#include "nrf54l15tag_cpuflpr_common.dtsi"

/ {
	compatible = "nordic,nrf54l15tag_nrf54l15-cpuflpr";
	model = "Nordic nRF54L15 TAG nRF54L15 FLPR MCU";
};

&cpuflpr_rram {
	partitions {
		compatible = "fixed-partitions";
		ranges;
		#address-cells = <1>;
		#size-cells = <1>;

		cpuflpr_code_partition: partition@0 {
			reg = <0x0 DT_SIZE_K(96)>;
			label = "image-0";
		};
	};
};
