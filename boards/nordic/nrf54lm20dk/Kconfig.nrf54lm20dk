## boards/nordic/nrf54lm20dk/Kconfig.nrf54lm20dk
```kconfig
# Copyright (c) 2025 Nordic Semiconductor ASA
# SPDX-License-Identifier: Apache-2.0

config BOARD_NRF54LM20DK
	select SOC_NRF54LM20A_CPUAPP if BOARD_NRF54LM20DK_NRF54LM20A_CPUAPP || BOARD_NRF54LM20DK_NRF54LM20A_CPUAPP_NS
	select SOC_NRF54LM20A_CPUFLPR if BOARD_NRF54LM20DK_NRF54LM20A_CPUFLPR
	select SOC_NRF54LM20B_CPUAPP if BOARD_NRF54LM20DK_NRF54LM20B_CPUAPP || BOARD_NRF54LM20DK_NRF54LM20B_CPUAPP_NS
	select SOC_NRF54LM20B_CPUFLPR if BOARD_NRF54LM20DK_NRF54LM20B_CPUFLPR
```

## boards/nordic/nrf54lm20dk/board.yml
```yaml
board:
  name: nrf54lm20dk
  full_name: nRF54LM20 DK
  vendor: nordic
  socs:
  - name: nrf54lm20a
    variants:
    - name: ns
      cpucluster: cpuapp
  - name: nrf54lm20b
    variants:
    - name: ns
      cpucluster: cpuapp
runners:
  run_once:
    '--recover':
    - runners:
      - nrfjprog
      - nrfutil
      run: first
      groups:
      - boards:
        - nrf54lm20dk/nrf54lm20a/cpuapp
        - nrf54lm20dk/nrf54lm20a/cpuapp/ns
        - nrf54lm20dk/nrf54lm20a/cpuflpr
        - nrf54lm20dk/nrf54lm20b/cpuapp
        - nrf54lm20dk/nrf54lm20b/cpuapp/ns
        - nrf54lm20dk/nrf54lm20b/cpuflpr
    '--erase':
    - runners:
      - nrfjprog
      - jlink
      - nrfutil
      run: first
      groups:
      - boards:
        - nrf54lm20dk/nrf54lm20a/cpuapp
        - nrf54lm20dk/nrf54lm20a/cpuapp/ns
        - nrf54lm20dk/nrf54lm20a/cpuflpr
        - nrf54lm20dk/nrf54lm20b/cpuapp
        - nrf54lm20dk/nrf54lm20b/cpuapp/ns
        - nrf54lm20dk/nrf54lm20b/cpuflpr
    '--reset':
    - runners:
      - nrfjprog
      - jlink
      - nrfutil
      run: last
      groups:
      - boards:
        - nrf54lm20dk/nrf54lm20a/cpuapp
        - nrf54lm20dk/nrf54lm20a/cpuapp/ns
        - nrf54lm20dk/nrf54lm20a/cpuflpr
        - nrf54lm20dk/nrf54lm20b/cpuapp
        - nrf54lm20dk/nrf54lm20b/cpuapp/ns
        - nrf54lm20dk/nrf54lm20b/cpuflpr
```

## boards/nordic/nrf54lm20dk/nrf54lm20dk_nrf54lm20a_cpuapp_defconfig
```kconfig
# Copyright (c) 2025 Nordic Semiconductor ASA
# SPDX-License-Identifier: Apache-2.0

# Enable UART driver
CONFIG_SERIAL=y

# Enable console
CONFIG_CONSOLE=y
CONFIG_UART_CONSOLE=y

# Enable GPIO
CONFIG_GPIO=y

# Enable MPU
CONFIG_ARM_MPU=y

# MPU-based null-pointer dereferencing detection cannot
# be applied as the (0x0 - 0x400) is unmapped for this target.
CONFIG_NULL_POINTER_EXCEPTION_DETECTION_NONE=y

# Enable Cache
CONFIG_CACHE_MANAGEMENT=y
CONFIG_EXTERNAL_CACHE=y

# Start SYSCOUNTER on driver init
CONFIG_NRF_GRTC_START_SYSCOUNTER=y
```

## boards/nordic/nrf54lm20dk/nrf54lm20dk_nrf54lm20a_cpuapp_ns_defconfig
```kconfig
# Copyright (c) 2025 Nordic Semiconductor ASA
# SPDX-License-Identifier: Apache-2.0

# Enable MPU
CONFIG_ARM_MPU=y
CONFIG_HW_STACK_PROTECTION=y
CONFIG_NULL_POINTER_EXCEPTION_DETECTION_NONE=y

# Enable TrustZone-M
CONFIG_ARM_TRUSTZONE_M=y

# This Board implies building Non-Secure firmware
CONFIG_TRUSTED_EXECUTION_NONSECURE=y

# Enable UART driver
CONFIG_SERIAL=y

# Enable console
CONFIG_CONSOLE=y
CONFIG_UART_CONSOLE=y

# Enable GPIO
CONFIG_GPIO=y

# Don't enable the cache in the non-secure image as it is a
# secure-only peripheral on 54l
CONFIG_CACHE_MANAGEMENT=n
CONFIG_EXTERNAL_CACHE=n

# Start SYSCOUNTER on driver init
CONFIG_NRF_GRTC_START_SYSCOUNTER=y

# Disable TFM BL2 since it is not supported
CONFIG_TFM_BL2=n
# Support for silence logging is not supported at the moment
# Tracked by: NCSDK-31930
CONFIG_TFM_LOG_LEVEL_SILENCE=n

# The oscillators are configured as secure and cannot be configured
# from the non secure application directly. This needs to be set
# otherwise nrfx will try to configure them, resulting in a bus
# fault.
CONFIG_SOC_NRF54LX_SKIP_CLOCK_CONFIG=y

# Runtime NCS features - disabled for reduced footprint
CONFIG_NRF_RTC_TIMER_USER_CHAN_COUNT=0
```

## boards/nordic/nrf54lm20pdk/Kconfig.defconfig
```kconfig
# Copyright (c) 2025 Nordic Semiconductor ASA
# SPDX-License-Identifier: Apache-2.0

if BOARD_NRF54LM20PDK_NRF54LM20A_CPUAPP

config ROM_START_OFFSET
	default 0x800 if BOOTLOADER_MCUBOOT

config SOC_NRF54LX_SKIP_GLITCHDETECTOR_DISABLE
	default y

endif # BOARD_NRF54LM20PDK_NRF54LM20A_CPUAPP
```

## boards/nordic/nrf54lm20pdk/board.yml
```yaml
board:
  name: nrf54lm20pdk
  full_name: nRF54LM20 PDK
  vendor: nordic
  socs:
  - name: nrf54lm20a
    variants:
    - name: xip
      cpucluster: cpuflpr
  revision:
    format: custom
    default: "0.2.0.csp"
    revisions:
    - name: "0.0.0"
    - name: "0.2.0"
    - name: "0.2.0.csp"
runners:
  run_once:
    '--recover':
    - runners:
      - nrfjprog
      - nrfutil
      run: first
      groups:
      - boards:
        - nrf54lm20pdk/nrf54lm20a/cpuapp
        - nrf54lm20pdk@0.0.0/nrf54lm20a/cpuapp
        - nrf54lm20pdk@0.2.0/nrf54lm20a/cpuapp
        - nrf54lm20pdk@0.2.0.csp/nrf54lm20a/cpuapp
        - nrf54lm20pdk/nrf54lm20a/cpuflpr
        - nrf54lm20pdk@0.0.0/nrf54lm20a/cpuflpr
        - nrf54lm20pdk@0.2.0/nrf54lm20a/cpuflpr
        - nrf54lm20pdk@0.2.0.csp/nrf54lm20a/cpuflpr
        - nrf54lm20pdk/nrf54lm20a/cpuflpr/xip
    '--erase':
    - runners:
      - nrfjprog
      - jlink
      - nrfutil
      run: first
      groups:
      - boards:
        - nrf54lm20pdk/nrf54lm20a/cpuapp
        - nrf54lm20pdk@0.0.0/nrf54lm20a/cpuapp
        - nrf54lm20pdk@0.2.0/nrf54lm20a/cpuapp
        - nrf54lm20pdk@0.2.0.csp/nrf54lm20a/cpuapp
        - nrf54lm20pdk/nrf54lm20a/cpuflpr
        - nrf54lm20pdk@0.0.0/nrf54lm20a/cpuflpr
        - nrf54lm20pdk@0.2.0/nrf54lm20a/cpuflpr
        - nrf54lm20pdk@0.2.0.csp/nrf54lm20a/cpuflpr
        - nrf54lm20pdk/nrf54lm20a/cpuflpr/xip
    '--reset':
    - runners:
      - nrfjprog
      - jlink
      - nrfutil
      run: last
      groups:
      - boards:
        - nrf54lm20pdk/nrf54lm20a/cpuapp
        - nrf54lm20pdk@0.0.0/nrf54lm20a/cpuapp
        - nrf54lm20pdk@0.2.0/nrf54lm20a/cpuapp
        - nrf54lm20pdk@0.2.0.csp/nrf54lm20a/cpuapp
        - nrf54lm20pdk/nrf54lm20a/cpuflpr
        - nrf54lm20pdk@0.0.0/nrf54lm20a/cpuflpr
        - nrf54lm20pdk@0.2.0/nrf54lm20a/cpuflpr
        - nrf54lm20pdk@0.2.0.csp/nrf54lm20a/cpuflpr
        - nrf54lm20pdk/nrf54lm20a/cpuflpr/xip
```

## boards/nordic/nrf54lv10dk/Kconfig.defconfig
```kconfig
# Copyright (c) 2025 Nordic Semiconductor ASA
# SPDX-License-Identifier: Apache-2.0

config HAS_BT_CTLR
	default BT

config HW_STACK_PROTECTION
	default ARCH_HAS_STACK_PROTECTION

if BOARD_NRF54LV10DK_NRF54LV10A_CPUAPP_NS

config BOARD_NRF54LV10DK
	select USE_DT_CODE_PARTITION

# By default, if building for the /ns variant of the board,
# enable building with TF-M as the Secure Processing Environment.
config BUILD_WITH_TFM
	default y

endif # BOARD_NRF54LV10DK_NRF54LV10A_CPUAPP_NS
```

## boards/nordic/nrf54lv10dk/Kconfig.nrf54lv10dk
```kconfig
# Copyright (c) 2025 Nordic Semiconductor ASA
# SPDX-License-Identifier: Apache-2.0

config BOARD_NRF54LV10DK
	select SOC_NRF54LV10A_CPUAPP if BOARD_NRF54LV10DK_NRF54LV10A_CPUAPP || \
					BOARD_NRF54LV10DK_NRF54LV10A_CPUAPP_NS
	select SOC_NRF54LV10A_CPUFLPR if BOARD_NRF54LV10DK_NRF54LV10A_CPUFLPR
```

## boards/nordic/nrf54lv10dk/board.yml
```yaml
board:
  name: nrf54lv10dk
  full_name: nRF54LV10 DK
  vendor: nordic
  socs:
  - name: nrf54lv10a
    variants:
    - name: ns
      cpucluster: cpuapp
runners:
  run_once:
    '--recover':
    - runners:
      - nrfjprog
      - nrfutil
      run: first
      groups:
      - boards:
        - nrf54lv10dk/nrf54lv10a/cpuapp
        - nrf54lv10dk/nrf54lv10a/cpuapp/ns
        - nrf54lv10dk/nrf54lv10a/cpuflpr
    '--erase':
    - runners:
      - nrfjprog
      - jlink
      - nrfutil
      run: first
      groups:
      - boards:
        - nrf54lv10dk/nrf54lv10a/cpuapp
        - nrf54lv10dk/nrf54lv10a/cpuapp/ns
        - nrf54lv10dk/nrf54lv10a/cpuflpr
    '--reset':
    - runners:
      - nrfjprog
      - jlink
      - nrfutil
      run: last
      groups:
      - boards:
        - nrf54lv10dk/nrf54lv10a/cpuapp
        - nrf54lv10dk/nrf54lv10a/cpuapp/ns
        - nrf54lv10dk/nrf54lv10a/cpuflpr
```

## boards/nordic/nrf7002dk/Kconfig
```kconfig
# nRF5340 DK board configuration

# Copyright (c) 2024 Nordic Semiconductor ASA
# SPDX-License-Identifier: Apache-2.0

config IPM_NRFX
	default IPM

config MBOX_NRFX_IPC
	default MBOX

if BOARD_NRF7002DK_NRF5340_CPUAPP || \
	BOARD_NRF7002DK_NRF5340_CPUAPP_NS || \
	BOARD_NRF7002DK_NRF5340_CPUAPP_NRF7001 || \
	BOARD_NRF7002DK_NRF5340_CPUAPP_NRF7001_NS

config BT_HCI_IPC
	default y if BT

config HEAP_MEM_POOL_ADD_SIZE_BOARD
	int
	default 4096 if BT_HCI_IPC

endif

if BOARD_NRF7002DK_NRF5340_CPUNET

config BT_ECC
	default y if BT

endif
```

## boards/nordic/nrf7002dk/Kconfig.defconfig
```kconfig
# nRF5340 DK nRF5340 board configuration

# Copyright (c) 2024 Nordic Semiconductor ASA
# SPDX-License-Identifier: Apache-2.0

if BOARD_NRF7002DK_NRF5340_CPUAPP || \
	BOARD_NRF7002DK_NRF5340_CPUAPP_NS || \
	BOARD_NRF7002DK_NRF5340_CPUAPP_NRF7001 || \
	BOARD_NRF7002DK_NRF5340_CPUAPP_NRF7001_NS

# By default, if we build for a Non-Secure version of the board,
# force building with TF-M as the Secure Execution Environment.
config BUILD_WITH_TFM
	default y if BOARD_NRF7002DK_NRF5340_CPUAPP_NS || \
		     BOARD_NRF7002DK_NRF5340_CPUAPP_NRF7001_NS

if BUILD_WITH_TFM

# By default, if we build with TF-M, instruct build system to
# flash the combined TF-M (Secure) & Zephyr (Non Secure) image
config TFM_FLASH_MERGED_BINARY
	bool
	default y

endif # BUILD_WITH_TFM

# Code Partition:
#
# For the secure version of the board the firmware is linked at the beginning
# of the flash, or into the code-partition defined in DT if it is intended to
# be loaded by MCUboot. If the secure firmware is to be combined with a non-
# secure image (TRUSTED_EXECUTION_SECURE=y), the secure FW image shall always
# be restricted to the size of its code partition.
#
# For the non-secure version of the board, the firmware
# must be linked into the code-partition (non-secure) defined in DT, regardless.
# Apply this configuration below by setting the Kconfig symbols used by
# the linker according to the information extracted from DT partitions.

# SRAM Partition:
#
# If the secure firmware is to be combined with a non-secure image
# (TRUSTED_EXECUTION_SECURE=y), the secure FW image SRAM shall always
# be restricted to the secure image SRAM partition (sram-secure-partition).
# Otherwise (if TRUSTED_EXECUTION_SECURE is not set) the whole zephyr,sram
# may be used by the image.
#
# For the non-secure version of the board, the firmware image SRAM is
# always restricted to the allocated non-secure SRAM partition.
#
# Workaround for not being able to have commas in macro arguments
DT_CHOSEN_Z_CODE_PARTITION := zephyr,code-partition
DT_CHOSEN_Z_SRAM_PARTITION := zephyr,sram-secure-partition

if (BOARD_NRF7002DK_NRF5340_CPUAPP || BOARD_NRF7002DK_NRF5340_CPUAPP_NRF7001) && \
	TRUSTED_EXECUTION_SECURE

config FLASH_LOAD_SIZE
	default $(dt_chosen_reg_size_hex,$(DT_CHOSEN_Z_CODE_PARTITION))

config SRAM_SIZE
	default $(dt_chosen_reg_size_int,$(DT_CHOSEN_Z_SRAM_PARTITION),0,K)

endif

if BOARD_NRF7002DK_NRF5340_CPUAPP_NS || BOARD_NRF7002DK_NRF5340_CPUAPP_NRF7001_NS

config FLASH_LOAD_OFFSET
	default $(dt_chosen_reg_addr_hex,$(DT_CHOSEN_Z_CODE_PARTITION))

config FLASH_LOAD_SIZE
	default $(dt_chosen_reg_size_hex,$(DT_CHOSEN_Z_CODE_PARTITION))

endif

endif
```

## boards/nordic/nrf7002dk/Kconfig.nrf7002dk
```kconfig
# Copyright (c) 2024 Nordic Semiconductor
# SPDX-License-Identifier: Apache-2.0

config BOARD_NRF7002DK
	select SOC_NRF5340_CPUNET_QKAA if BOARD_NRF7002DK_NRF5340_CPUNET
	select SOC_NRF5340_CPUAPP_QKAA if BOARD_NRF7002DK_NRF5340_CPUAPP || \
					  BOARD_NRF7002DK_NRF5340_CPUAPP_NS || \
					  BOARD_NRF7002DK_NRF5340_CPUAPP_NRF7001 || \
					  BOARD_NRF7002DK_NRF5340_CPUAPP_NRF7001_NS
```

## boards/nordic/nrf7002dk/board.yml
```yaml
board:
  name: nrf7002dk
  full_name: nRF7002 DK
  vendor: nordic
  socs:
    - name: nrf5340
      variants:
        - name: nrf7001
          cpucluster: cpuapp
```

## boards/nordic/nrf7002dk/nrf7002dk_nrf5340_cpuapp_defconfig
```kconfig
# SPDX-License-Identifier: Apache-2.0

# Enable MPU
CONFIG_ARM_MPU=y

# Enable hardware stack protection
CONFIG_HW_STACK_PROTECTION=y

# Enable TrustZone-M
CONFIG_ARM_TRUSTZONE_M=y

# Enable GPIO
CONFIG_GPIO=y

# Enable PINCTRL
CONFIG_PINCTRL=y

# Enable uart driver
CONFIG_SERIAL=y

# enable console
CONFIG_CONSOLE=y
CONFIG_UART_CONSOLE=y
```

## boards/nordic/nrf7002dk/nrf7002dk_nrf5340_cpuapp_ns_defconfig
```kconfig
# SPDX-License-Identifier: Apache-2.0

# Enable MPU
CONFIG_ARM_MPU=y

# Enable hardware stack protection
CONFIG_HW_STACK_PROTECTION=y

# Enable TrustZone-M
CONFIG_ARM_TRUSTZONE_M=y

# This Board implies building Non-Secure firmware
CONFIG_TRUSTED_EXECUTION_NONSECURE=y

# enable GPIO
CONFIG_GPIO=y

# enable PINCTRL
CONFIG_PINCTRL=y

# Enable uart driver
CONFIG_SERIAL=y

# enable console
CONFIG_CONSOLE=y
CONFIG_UART_CONSOLE=y
```

## boards/nordic/nrf7120dk/Kconfig.defconfig
```kconfig
# Copyright (c) 2025 Nordic Semiconductor ASA
# SPDX-License-Identifier: Apache-2.0

config HW_STACK_PROTECTION
	default ARCH_HAS_STACK_PROTECTION

if BOARD_NRF7120DK_NRF7120_CPUAPP

config HAS_BT_CTLR
	default BT

endif # BOARD_NRF7120DK_NRF7120_CPUAPP

if BOARD_NRF7120DK_NRF7120_CPUAPP_NS

config BOARD_NRF7120DK
	select USE_DT_CODE_PARTITION

config HAS_BT_CTLR
	default BT

endif # BOARD_NRF7120DK_NRF7120_CPUAPP_NS
```

## boards/nordic/nrf7120dk/board.yml
```yaml
board:
  name: nrf7120dk
  full_name: nRF7120 DK
  vendor: nordic
  socs:
    - name: nrf7120
      variants:
        - name: xip
          cpucluster: cpuflpr
        - name: ns
          cpucluster: cpuapp

runners:
  run_once:
    '--recover':
      - runners:
          - nrfutil
        run: first
        groups:
          - boards:
              - nrf7120dk/nrf7120/cpuapp
              - nrf7120dk/nrf7120/cpuapp/ns
              - nrf7120dk/nrf7120/cpuflpr
              - nrf7120dk/nrf7120/cpuflpr/xip
    '--erase':
      - runners:
          - jlink
          - nrfutil
        run: first
        groups:
          - boards:
              - nrf7120dk/nrf7120/cpuapp
              - nrf7120dk/nrf7120/cpuapp/ns
              - nrf7120dk/nrf7120/cpuflpr
              - nrf7120dk/nrf7120/cpuflpr/xip
    '--reset':
      - runners:
          - jlink
          - nrfutil
        run: last
        groups:
          - boards:
              - nrf7120dk/nrf7120/cpuapp
              - nrf7120dk/nrf7120/cpuapp/ns
              - nrf7120dk/nrf7120/cpuflpr
              - nrf7120dk/nrf7120/cpuflpr/xip
```

## boards/nordic/nrf7120dk/nrf7120dk_nrf7120_cpuapp_ns_defconfig
```kconfig
# Copyright (c) 2025 Nordic Semiconductor ASA
# SPDX-License-Identifier: Apache-2.0

# Enable MPU
CONFIG_ARM_MPU=y

# Enable hardware stack protection
CONFIG_HW_STACK_PROTECTION=y

CONFIG_NULL_POINTER_EXCEPTION_DETECTION_NONE=y

# Enable TrustZone-M
CONFIG_ARM_TRUSTZONE_M=y

# This Board implies building Non-Secure firmware
CONFIG_TRUSTED_EXECUTION_NONSECURE=y

# Use devicetree code partition for TF-M
CONFIG_USE_DT_CODE_PARTITION=y

# Don't enable the cache in the non-secure image as it is a
# secure-only peripheral on 71x series
CONFIG_CACHE_MANAGEMENT=n
CONFIG_EXTERNAL_CACHE=n

CONFIG_UART_CONSOLE=y
CONFIG_CONSOLE=y
CONFIG_SERIAL=y

# Enable GPIO
CONFIG_GPIO=y

# Start SYSCOUNTER on driver init
CONFIG_NRF_GRTC_START_SYSCOUNTER=y

# Disable TFM BL2 since it is not supported
CONFIG_TFM_BL2=n
```

## boards/nordic/nrf7120dk/nrf7120dk_nrf7120_cpuflpr_xip_defconfig
```kconfig
# Copyright (c) 2025 Nordic Semiconductor ASA
# SPDX-License-Identifier: Apache-2.0

# Enable UART driver
CONFIG_SERIAL=y

# Enable console
CONFIG_CONSOLE=y
CONFIG_UART_CONSOLE=y

# Enable GPIO
CONFIG_GPIO=y

# Execute from MRAM
CONFIG_XIP=y
```
