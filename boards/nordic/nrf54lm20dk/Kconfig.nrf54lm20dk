## boards/nordic/nrf9131ek/Kconfig.defconfig
```kconfig
# nRF9131 EK NRF9131 board configuration

# Copyright (c) 2023 Nordic Semiconductor ASA
# SPDX-License-Identifier: Apache-2.0

config HW_STACK_PROTECTION
	default ARCH_HAS_STACK_PROTECTION

config BOARD_NRF9131EK
	select USE_DT_CODE_PARTITION if BOARD_NRF9131EK_NRF9131_NS
```

## boards/nordic/nrf9131ek/Kconfig.nrf9131ek
```kconfig
# nRF9131-EK board configuration

# Copyright (c) 2023 Nordic Semiconductor ASA
# SPDX-License-Identifier: Apache-2.0

config BOARD_NRF9131EK
	select SOC_NRF9131_LACA
```

## boards/nordic/nrf9131ek/board.yml
```yaml
board:
  name: nrf9131ek
  full_name: nRF9131 EK
  vendor: nordic
  socs:
  - name: nrf9131
    variants:
    - name: 'ns'
```

## boards/nordic/nrf9151dk/Kconfig.defconfig
```kconfig
# nRF9151 DK NRF9151 board configuration

# Copyright (c) 2023 Nordic Semiconductor ASA
# SPDX-License-Identifier: Apache-2.0
#
config HW_STACK_PROTECTION
	default ARCH_HAS_STACK_PROTECTION

if BOARD_NRF9151DK_NRF9151 || BOARD_NRF9151DK_NRF9151_NS

config BOARD_NRF9151DK
	select USE_DT_CODE_PARTITION if BOARD_NRF9151DK_NRF9151_NS

config BT_HCI_VS
	default y if BT

config BT_WAIT_NOP
	default BT && $(dt_nodelabel_enabled,nrf5340_reset)

config I2C
	default $(dt_compat_on_bus,$(DT_COMPAT_NXP_PCAL6408A),i2c)

# minimal TFM
config TFM_PARTITION_PROTECTED_STORAGE
	default n

config TFM_PARTITION_INTERNAL_TRUSTED_STORAGE
	default n

config TFM_PARTITION_CRYPTO
	default n

config TFM_PARTITION_PLATFORM
	default n


config TFM_CRYPTO_RNG_MODULE_ENABLED
	default n

config TFM_CRYPTO_KEY_MODULE_ENABLED
	default n

config TFM_CRYPTO_AEAD_MODULE_ENABLED
	default n

config TFM_CRYPTO_MAC_MODULE_ENABLED
	default n

config TFM_CRYPTO_HASH_MODULE_ENABLED
	default n

config TFM_CRYPTO_CIPHER_MODULE_ENABLED
	default n

config TFM_CRYPTO_ASYM_ENCRYPT_MODULE_ENABLED
	default n

config TFM_CRYPTO_ASYM_SIGN_MODULE_ENABLED
	default n

config TFM_CRYPTO_KEY_DERIVATION_MODULE_ENABLED
	default n


# config TFM_PLATFORM_NV_COUNTER_MODULE_DISABLED
# 	default n

# config TFM_CRYPTO_BUILTIN_KEYS
# 	default n

# config TFM_CRYPTO_ENGINE_BUF_SIZE
# 	default 1

# config TFM_CRYPTO_CONC_OPER_NUM
# 	default 1

# config TFM_CRYPTO_IOVEC_BUFFER_SIZE
# 	default 1024

# config TFM_CRYPTO_PARTITION_STACK_SIZE
# 	default 0x800


# config PSA_DEFAULT_OFF
# 	default y

# config PSA_WANT_GENERATE_RANDOM
# 	default y

# config PSA_WANT_ALG_HMAC_DRBG
# 	default y


# config TFM_EXPERIMENTAL
# 	default n
config MBEDTLS_PSA_CRYPTO_CLIENT
	default n

endif # BOARD_NRF9151DK_NRF9151 || BOARD_NRF9151DK_NRF9151_NS
```

## boards/nordic/nrf9151dk/Kconfig.nrf9151dk
```kconfig
# nRF9151 DK NRF9151 board configuration

# Copyright (c) 2023 Nordic Semiconductor ASA
# SPDX-License-Identifier: Apache-2.0

config BOARD_NRF9151DK
	select SOC_NRF9151_LACA
```

## boards/nordic/nrf9151dk/board.yml
```yaml
board:
  name: nrf9151dk
  full_name: nRF9151 DK
  vendor: nordic
  socs:
  - name: nrf9151
    variants:
    - name: 'ns'
```
