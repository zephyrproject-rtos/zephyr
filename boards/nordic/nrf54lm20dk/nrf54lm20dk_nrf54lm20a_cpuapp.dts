/*
 * Copyright (c) 2025 Nordic Semiconductor ASA
 *
 * SPDX-License-Identifier: Apache-2.0
 */

/dts-v1/;

#include <nordic/nrf54lm20a_cpuapp.dtsi>
#include "nrf54lm20_a_b_cpuapp_common.dtsi"
#include <vendor/nordic/nrf54lm20a_cpuapp_partition.dtsi>

/ {
	compatible = "nordic,nrf54lm20dk_nrf54lm20a-cpuapp";
	model = "Nordic nRF54LM20 DK nRF54LM20A Application MCU";

	chosen {
		zephyr,code-partition = &slot0_partition;
		zephyr,sram = &cpuapp_sram;
	};
};
