## boards/nordic/thingy52/thingy52_nrf52832_defconfig
```kconfig
# Copyright (c) 2018 Aapo Vienamo
# SPDX-License-Identifier: Apache-2.0

# Enable regulators
CONFIG_REGULATOR=y

# Enable MPU
CONFIG_ARM_MPU=y

# Enable hardware stack protection
CONFIG_HW_STACK_PROTECTION=y

# Enable RTT
CONFIG_USE_SEGGER_RTT=y

# Enable regulators (init priority adjusted so that they
# are turned before I2C GPIO expander)
CONFIG_REGULATOR=y
CONFIG_REGULATOR_FIXED_INIT_PRIORITY=45

# Enable GPIO
CONFIG_GPIO=y

# Enable UART driver
CONFIG_SERIAL=y

# Enable console
CONFIG_CONSOLE=y
CONFIG_UART_CONSOLE=y
```

## boards/nordic/thingy53/Kconfig.sysbuild
```kconfig
# Copyright (c) 2024 Nordic Semiconductor ASA
# SPDX-License-Identifier: Apache-2.0

if BOARD_THINGY53_NRF5340_CPUAPP || BOARD_THINGY53_NRF5340_CPUAPP_NS

choice BOOTLOADER
	default BOOTLOADER_MCUBOOT
endchoice

config SECURE_BOOT_NETCORE
	default y

config NETCORE_APP_UPDATE
	default y if SECURE_BOOT_NETCORE

config NRF_DEFAULT_EMPTY
	default y if SECURE_BOOT_NETCORE

endif # BOARD_THINGY53_NRF5340_CPUAPP || BOARD_THINGY53_NRF5340_CPUAPP_NS

config PM_EXTERNAL_FLASH_MCUBOOT_SECONDARY
	default y if BOOTLOADER_MCUBOOT
```

## boards/nordic/thingy53/Kconfig.thingy53
```kconfig
# Thingy53 NRF5340 board configuration

# Copyright (c) 2021 Nordic Semiconductor ASA
# SPDX-License-Identifier: Apache-2.0

config BOARD_THINGY53
	select SOC_NRF5340_CPUAPP_QKAA if BOARD_THINGY53_NRF5340_CPUAPP
	select SOC_NRF5340_CPUAPP_QKAA if BOARD_THINGY53_NRF5340_CPUAPP_NS
	select SOC_NRF5340_CPUNET_QKAA if BOARD_THINGY53_NRF5340_CPUNET
```

## boards/nordic/thingy53/board.yml
```yaml
board:
  name: thingy53
  full_name: "Thingy:53"
  vendor: nordic
  socs:
  - name: 'nrf5340'
    variants:
    - name: 'ns'
      cpucluster: 'cpuapp'
```

## boards/nordic/thingy53/thingy53_nrf5340_cpunet_defconfig
```kconfig
# SPDX-License-Identifier: Apache-2.0

# Enable MPU
CONFIG_ARM_MPU=y

# Enable GPIO
CONFIG_GPIO=y
```

## boards/nordic_nrf/nrf21540dk/board.yml
```yaml
board:
  name: nrf21540dk
  vendor: Nordic Semiconductor
  socs:
  - name: nrf52840
```

## boards/nordic_nrf/nrf51dongle/Kconfig.defconfig
```kconfig
# nRF51 Dongle NRF51822 board configuration

# Copyright (c) 2018-2020 Nordic Semiconductor ASA.
# SPDX-License-Identifier: Apache-2.0

if BOARD_NRF51DONGLE

config BT_CTLR
	default BT

endif # BOARD_NRF51DONGLE
```

## boards/nordic_nrf/nrf52833dk/board.yml
```yaml
board:
  name: nrf52833dk
  vendor: Nordic Semiconductor
  socs:
  - name: nrf52820
  - name: nrf52833
```

## boards/nordic_nrf/nrf52840dongle/board.yml
```yaml
board:
  name: nrf52840dongle
  vendor: Nordic Semiconductor
  socs:
  - name: nrf52840
```

## boards/nordic_nrf/nrf52dk/Kconfig
```kconfig
# nRF52 DK nRF52810 board configuration

# Copyright (c) 2018 Nordic Semiconductor ASA
# SPDX-License-Identifier: Apache-2.0

if BOARD_NRF52DK

config BOARD_ENABLE_DCDC
	bool "DCDC mode"
	select SOC_DCDC_NRF52X
	default y

# BT_CTLR depends on BT. When BT is enabled we should default to also
# enabling the controller.
config BT_CTLR
	default y if BT

endif # BOARD_NRF52DK
```

## boards/nordic_nrf/nrf52dk/board.yml
```yaml
board:
  name: nrf52dk
  vendor: nordic
  socs:
  - name: nrf52805
  - name: nrf52810
  - name: nrf52832
```

## boards/nordic_nrf/nrf5340_audio_dk/board.yml
```yaml
board:
  name: nrf5340_audio_dk
  vendor: Nordic Semiconductor
  socs:
  - name: 'nrf5340'
    variants:
    - name: 'ns'
      cpucluster: 'cpuapp'
```

## boards/nordic_nrf/nrf5340dk/Kconfig.defconfig
```kconfig
# nRF5340 DK nRF5340 board configuration

# Copyright (c) 2019-2020 Nordic Semiconductor ASA
# SPDX-License-Identifier: Apache-2.0

if  BOARD_NRF5340DK_NRF5340_CPUAPP || BOARD_NRF5340DK_NRF5340_CPUAPP_NS

# Code Partition:
#
# For the secure version of the board the firmware is linked at the beginning
# of the flash, or into the code-partition defined in DT if it is intended to
# be loaded by MCUboot. If the secure firmware is to be combined with a non-
# secure image (TRUSTED_EXECUTION_SECURE=y), the secure FW image shall always
# be restricted to the size of its code partition.
#
# For the non-secure version of the board, the firmware
# must be linked into the code-partition (non-secure) defined in DT, regardless.
# Apply this configuration below by setting the Kconfig symbols used by
# the linker according to the information extracted from DT partitions.

# SRAM Partition:
#
# If the secure firmware is to be combined with a non-secure image
# (TRUSTED_EXECUTION_SECURE=y), the secure FW image SRAM shall always
# be restricted to the secure image SRAM partition (sram-secure-partition).
# Otherwise (if TRUSTED_EXECUTION_SECURE is not set) the whole zephyr,sram
# may be used by the image.
#
# For the non-secure version of the board, the firmware image SRAM is
# always restricted to the allocated non-secure SRAM partition.
#
# Workaround for not being able to have commas in macro arguments
DT_CHOSEN_Z_CODE_PARTITION := zephyr,code-partition
DT_CHOSEN_Z_SRAM_PARTITION := zephyr,sram-secure-partition

if BOARD_NRF5340DK_NRF5340_CPUAPP && TRUSTED_EXECUTION_SECURE

config FLASH_LOAD_SIZE
	default $(dt_chosen_reg_size_hex,$(DT_CHOSEN_Z_CODE_PARTITION))

config SRAM_SIZE
	default $(dt_chosen_reg_size_int,$(DT_CHOSEN_Z_SRAM_PARTITION),0,K)

endif # BOARD_NRF5340DK_NRF5340_CPUAPP && TRUSTED_EXECUTION_SECURE

if BOARD_NRF5340DK_NRF5340_CPUAPP_NS

config FLASH_LOAD_OFFSET
	default $(dt_chosen_reg_addr_hex,$(DT_CHOSEN_Z_CODE_PARTITION))

config FLASH_LOAD_SIZE
	default $(dt_chosen_reg_size_hex,$(DT_CHOSEN_Z_CODE_PARTITION))

endif # BOARD_NRF5340DK_NRF5340_CPUAPP_NS

endif # BOARD_NRF5340DK_NRF5340_CPUAPP || BOARD_NRF5340DK_NRF5340_CPUAPP_NS

config MBOX_NRFX_IPC
	default MBOX

if BOARD_NRF5340DK_NRF5340_CPUAPP || BOARD_NRF5340DK_NRF5340_CPUAPP_NS

choice BT_HCI_BUS_TYPE
	default BT_HCI_IPC if BT
endchoice

config HEAP_MEM_POOL_ADD_SIZE_BOARD
	int
	default 4096 if BT_HCI_IPC

endif #  BOARD_NRF5340DK_NRF5340_CPUAPP || BOARD_NRF5340DK_NRF5340_CPUAPP_NS

if BOARD_NRF5340DK_NRF5340_CPUNET

config BT_CTLR
	default y if BT

endif # BOARD_NRF5340DK_NRF5340_CPUNET
```

## boards/nordic_nrf/nrf5340dk/board.yml
```yaml
board:
  name: nrf5340dk
  vendor: Nordic Semiconductor
  socs:
  - name: 'nrf5340'
    variants:
    - name: 'ns'
      cpucluster: 'cpuapp'
```

## boards/nordic_nrf/nrf54h20pdk/Kconfig.defconfig
```kconfig
# Copyright (c) 2024 Nordic Semiconductor ASA
# SPDX-License-Identifier: Apache-2.0

if BOARD_NRF54H20PDK

# Data cache is disabled due to a HW issue in the EngA SoC revision.
config DCACHE
	default n

endif # BOARD_NRF54H20PDK
```

## boards/nordic_nrf/nrf54h20pdk/board.yml
```yaml
board:
  name: nrf54h20pdk
  vendor: Nordic Semiconductor
  socs:
  - name: nrf54h20
```

## boards/nordic_nrf/nrf54l15pdk/Kconfig.defconfig
```kconfig
# Copyright (c) 2024 Nordic Semiconductor ASA
# SPDX-License-Identifier: Apache-2.0

if BOARD_NRF54L15PDK_NRF54L15_CPUAPP

config BT_CTLR
	default BT

endif # BOARD_NRF54L15PDK_NRF54L15_CPUAPP
```

## boards/nordic_nrf/nrf54l15pdk/board.yml
```yaml
board:
  name: nrf54l15pdk
  vendor: Nordic Semiconductor
  socs:
  - name: nrf54l15
```

## boards/nordic_nrf/nrf9131ek/board.yml
```yaml
board:
  name: nrf9131ek
  vendor: Nordic Semiconductor
  socs:
  - name: nrf9131
    variants:
    - name: 'ns'
```

## boards/nordic_nrf/nrf9151dk/board.yml
```yaml
board:
  name: nrf9151dk
  vendor: Nordic Semiconductor
  socs:
  - name: nrf9151
    variants:
    - name: 'ns'
```

## boards/nordic_nrf/nrf9161dk/nrf9161dk_nrf9161_defconfig
```kconfig
# SPDX-License-Identifier: Apache-2.0

# Enable MPU
CONFIG_ARM_MPU=y

# Enable hardware stack protection
CONFIG_HW_STACK_PROTECTION=y

# Enable TrustZone-M
CONFIG_ARM_TRUSTZONE_M=y

# Enable GPIO
CONFIG_GPIO=y

# Enable UART driver
CONFIG_SERIAL=y

# Enable console
CONFIG_CONSOLE=y
CONFIG_UART_CONSOLE=y
```

## boards/nordic_nrf/thingy52/board.yml
```yaml
board:
  name: thingy52
  vendor: Nordic Semiconductor
  socs:
  - name: nrf52832
```

## boards/nordic_nrf/thingy53/board.yml
```yaml
board:
  name: thingy53
  vendor: Nordic Semiconductor
  socs:
  - name: 'nrf5340'
    variants:
    - name: 'ns'
      cpucluster: 'cpuapp'
```
