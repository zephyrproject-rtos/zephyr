## boards/nordic/nrf52dk/Kconfig.nrf52dk
```kconfig
# nRF52 DK nRF52810 board configuration

# Copyright (c) 2018 Nordic Semiconductor ASA
# SPDX-License-Identifier: Apache-2.0

config BOARD_NRF52DK
	select SOC_NRF52805_CAAA if BOARD_NRF52DK_NRF52805
	select SOC_NRF52810_QFAA if BOARD_NRF52DK_NRF52810
	select SOC_NRF52832_QFAA if BOARD_NRF52DK_NRF52832
```

## boards/nordic/nrf52dk/board.yml
```yaml
board:
  name: nrf52dk
  full_name: nRF52 DK
  vendor: nordic
  socs:
  - name: nrf52805
  - name: nrf52810
  - name: nrf52832
```

## boards/nordic/nrf52dk/nrf52dk_nrf52810_defconfig
```kconfig
# SPDX-License-Identifier: Apache-2.0

# Enable MPU
CONFIG_ARM_MPU=y

# Enable hardware stack protection
CONFIG_HW_STACK_PROTECTION=y

# enable GPIO
CONFIG_GPIO=y

# Enable UARTE
CONFIG_SERIAL=y

# enable console
CONFIG_CONSOLE=y
CONFIG_UART_CONSOLE=y

# Bluetooth not enabled by default on nRF52810 due to RAM limitations when
# running the default set of kernel tests.
# Enable this on your prj.conf to include Bluetooth support
```

## boards/nordic/nrf5340_audio_dk/Kconfig
```kconfig
# nRF5340 Audio DK board configuration

# Copyright (c) 2019 Nordic Semiconductor ASA
# SPDX-License-Identifier: Apache-2.0

config BOARD_NRF5340_AUDIO_DK
	select BOARD_LATE_INIT_HOOK if BOARD_NRF5340_AUDIO_DK_NRF5340_CPUAPP || BOARD_NRF5340_AUDIO_DK_NRF5340_CPUAPP_NS
```

## boards/nordic/nrf5340_audio_dk/Kconfig.nrf5340_audio_dk
```kconfig
# nRF5340 Audio DK board configuration

# Copyright (c) 2019 Nordic Semiconductor ASA
# SPDX-License-Identifier: Apache-2.0

config BOARD_NRF5340_AUDIO_DK
	select SOC_NRF5340_CPUAPP_QKAA if BOARD_NRF5340_AUDIO_DK_NRF5340_CPUAPP
	select SOC_NRF5340_CPUAPP_QKAA if BOARD_NRF5340_AUDIO_DK_NRF5340_CPUAPP_NS
	select SOC_NRF5340_CPUNET_QKAA if BOARD_NRF5340_AUDIO_DK_NRF5340_CPUNET
```

## boards/nordic/nrf5340_audio_dk/board.yml
```yaml
board:
  name: nrf5340_audio_dk
  full_name: nRF5340 Audio DK
  vendor: nordic
  socs:
  - name: 'nrf5340'
    variants:
    - name: 'ns'
      cpucluster: 'cpuapp'
```

## boards/nordic/nrf5340_audio_dk/nrf5340_audio_dk_nrf5340_cpuapp_ns_defconfig
```kconfig
# Copyright (c) 2020 Nordic Semiconductor ASA
# SPDX-License-Identifier: Apache-2.0

CONFIG_ARM_MPU=y

CONFIG_ARM_TRUSTZONE_M=y
CONFIG_TRUSTED_EXECUTION_NONSECURE=y

CONFIG_GPIO=y

CONFIG_SERIAL=y

CONFIG_CONSOLE=y
CONFIG_UART_CONSOLE=y

CONFIG_REGULATOR=y
```

## boards/nordic/nrf5340dk/Kconfig.nrf5340dk
```kconfig
# Copyright (c) 2022 Zephyr Project members and individual contributors
# SPDX-License-Identifier: Apache-2.0

config BOARD_NRF5340DK
	select SOC_NRF5340_CPUAPP_QKAA if BOARD_NRF5340DK_NRF5340_CPUAPP
	select SOC_NRF5340_CPUAPP_QKAA if BOARD_NRF5340DK_NRF5340_CPUAPP_NS
	select SOC_NRF5340_CPUNET_QKAA if BOARD_NRF5340DK_NRF5340_CPUNET
```

## boards/nordic/nrf5340dk/board.yml
```yaml
board:
  name: nrf5340dk
  full_name: nRF5340 DK
  vendor: nordic
  socs:
  - name: 'nrf5340'
    variants:
    - name: 'ns'
      cpucluster: 'cpuapp'
      include-parent-kconfig: True
      include-parent-dts: True
      variants:
      - name: 'shop'
        include-parent-dts: True
```

## boards/nordic/nrf5340dk/nrf5340dk_nrf5340_cpuapp_defconfig
```kconfig
# SPDX-License-Identifier: Apache-2.0

# Enable MPU
CONFIG_ARM_MPU=y

# Enable TrustZone-M
CONFIG_ARM_TRUSTZONE_M=y

# enable GPIO
CONFIG_GPIO=y

# Enable uart driver
CONFIG_SERIAL=y

# enable console
CONFIG_CONSOLE=y
CONFIG_UART_CONSOLE=y
```

## boards/nordic/nrf5340dk/nrf5340dk_nrf5340_cpuapp_ns_defconfig
```kconfig
# SPDX-License-Identifier: Apache-2.0

# Enable MPU
CONFIG_ARM_MPU=y

# Enable TrustZone-M
CONFIG_ARM_TRUSTZONE_M=y

# This Board implies building Non-Secure firmware
CONFIG_TRUSTED_EXECUTION_NONSECURE=y

# enable GPIO
CONFIG_GPIO=y

# Enable uart driver
CONFIG_SERIAL=y

# enable console
CONFIG_CONSOLE=y
CONFIG_UART_CONSOLE=y
```

## boards/nordic/nrf5340dk/nrf5340dk_nrf5340_cpunet_defconfig
```kconfig
# SPDX-License-Identifier: Apache-2.0

# Enable MPU
CONFIG_ARM_MPU=y

# enable GPIO
CONFIG_GPIO=y

# Enable uart driver
CONFIG_SERIAL=y

# enable console
CONFIG_CONSOLE=y
CONFIG_UART_CONSOLE=y
```

## boards/nordic/nrf54h20dk/Kconfig.defconfig
```kconfig
# Copyright (c) 2024 Nordic Semiconductor ASA
# SPDX-License-Identifier: Apache-2.0

config HW_STACK_PROTECTION
	default ARCH_HAS_STACK_PROTECTION

if BOARD_NRF54H20DK_NRF54H20_CPUAPP

config BT_HCI_IPC
	default y if BT

config MAX_THREAD_BYTES
	default 3 if USERSPACE

config ROM_START_OFFSET
	default 0x800 if BOOTLOADER_MCUBOOT

if !USE_DT_CODE_PARTITION

# Application core firmware must start at this offset when not using MCUboot.
# However, the default 'zephyr,code-partition' in DT is set for MCUboot.
config FLASH_LOAD_OFFSET
	default $(dt_nodelabel_reg_addr_hex,cpuapp_boot_partition)

# This is meant to span 'cpuapp_boot_partition' and 'cpuapp_slot0_partition'
# in the default memory map.
config FLASH_LOAD_SIZE
	default $(add_hex, $(dt_nodelabel_reg_addr_hex,cpuapp_slot0_partition), \
			   $(dt_nodelabel_reg_size_hex,cpuapp_slot0_partition), \
			   -$(dt_nodelabel_reg_addr_hex,cpuapp_boot_partition))

endif # !USE_DT_CODE_PARTITION

endif # BOARD_NRF54H20DK_NRF54H20_CPUAPP

if BOARD_NRF54H20DK_NRF54H20_CPURAD

config MAX_THREAD_BYTES
	default 3 if USERSPACE

config ROM_START_OFFSET
	default 0x800 if BOOTLOADER_MCUBOOT

endif # BOARD_NRF54H20DK_NRF54H20_CPURAD
```

## boards/nordic/nrf54h20dk/Kconfig.nrf54h20dk
```kconfig
# Copyright (c) 2024 Nordic Semiconductor ASA
# SPDX-License-Identifier: Apache-2.0

config BOARD_NRF54H20DK
	select SOC_NRF54H20_ENGB_CPUAPP if BOARD_NRF54H20DK_NRF54H20_CPUAPP && BOARD_REVISION = "0.8.0"
	select SOC_NRF54H20_ENGB_CPURAD if BOARD_NRF54H20DK_NRF54H20_CPURAD && BOARD_REVISION = "0.8.0"
	select SOC_NRF54H20_ENGB_CPUPPR if (BOARD_NRF54H20DK_NRF54H20_CPUPPR || \
				       BOARD_NRF54H20DK_NRF54H20_CPUPPR_XIP) && BOARD_REVISION = "0.8.0"
	select SOC_NRF54H20_ENGB_CPUFLPR if (BOARD_NRF54H20DK_NRF54H20_CPUFLPR || \
				        BOARD_NRF54H20DK_NRF54H20_CPUFLPR_XIP) && BOARD_REVISION = "0.8.0"
```

## boards/nordic/nrf54h20dk/Kconfig.sysbuild
```kconfig
# Copyright (c) 2025 Nordic Semiconductor ASA
# SPDX-License-Identifier: Apache-2.0

if BOARD_NRF54H20DK_NRF54H20_CPURAD

config NRF_DEFAULT_EMPTY
	default y

endif # BOARD_NRF54H20DK_NRF54H20_CPURAD
```

## boards/nordic/nrf54h20dk/board.yml
```yaml
board:
  name: nrf54h20dk
  full_name: nRF54H20 DK
  vendor: nordic
  socs:
  - name: nrf54h20
    variants:
    - name: xip
      cpucluster: cpuppr
    - name: xip
      cpucluster: cpuflpr
  revision:
    format: major.minor.patch
    default: "0.9.0"
    revisions:
    - name: "0.9.0"
runners:
  run_once:
    '--recover':
    - runners:
      - nrfutil
      run: first
      groups:
      - boards:
        - nrf54h20dk@0.9.0/nrf54h20/cpuapp
        - nrf54h20dk@0.9.0/nrf54h20/cpurad
        - nrf54h20dk@0.9.0/nrf54h20/cpuppr
        - nrf54h20dk@0.9.0/nrf54h20/cpuppr/xip
        - nrf54h20dk@0.9.0/nrf54h20/cpuflpr
        - nrf54h20dk@0.9.0/nrf54h20/cpuflpr/xip
    '--erase':
    - runners:
      - jlink
      - nrfutil
      run: first
      groups:
      - boards:
        - nrf54h20dk@0.9.0/nrf54h20/cpuapp
        - nrf54h20dk@0.9.0/nrf54h20/cpurad
        - nrf54h20dk@0.9.0/nrf54h20/cpuppr
        - nrf54h20dk@0.9.0/nrf54h20/cpuppr/xip
        - nrf54h20dk@0.9.0/nrf54h20/cpuflpr
        - nrf54h20dk@0.9.0/nrf54h20/cpuflpr/xip
    '--reset':
    - runners:
      - jlink
      - nrfutil
      run: last
      groups:
      - boards:
        - nrf54h20dk@0.9.0/nrf54h20/cpuapp
        - nrf54h20dk@0.9.0/nrf54h20/cpurad
        - nrf54h20dk@0.9.0/nrf54h20/cpuppr
        - nrf54h20dk@0.9.0/nrf54h20/cpuppr/xip
        - nrf54h20dk@0.9.0/nrf54h20/cpuflpr
        - nrf54h20dk@0.9.0/nrf54h20/cpuflpr/xip
```

## boards/nordic/nrf54h20dk/nrf54h20dk_nrf54h20_cpuapp_secondary_defconfig
```kconfig
# Copyright (c) 2024 Nordic Semiconductor ASA
# SPDX-License-Identifier: Apache-2.0

# Use devicetree code partition instead of fallback boot partition
CONFIG_USE_DT_CODE_PARTITION=y
```

## boards/nordic/nrf54h20dk/nrf54h20dk_nrf54h20_cpuppr_defconfig
```kconfig
# Copyright (c) 2024 Nordic Semiconductor ASA
# SPDX-License-Identifier: Apache-2.0

# Enable UART driver
CONFIG_SERIAL=y

# Enable console
CONFIG_CONSOLE=y
CONFIG_UART_CONSOLE=y

CONFIG_USE_DT_CODE_PARTITION=y

# Execute from RAM
CONFIG_XIP=n
```

## boards/nordic/nrf54h20dk/nrf54h20dk_nrf54h20_cpuppr_xip_defconfig
```kconfig
# Copyright (c) 2024 Nordic Semiconductor ASA
# SPDX-License-Identifier: Apache-2.0

CONFIG_XIP=y
```

## boards/nordic/nrf54h20dk/nrf54h20dk_nrf54h20_cpurad_defconfig
```kconfig
# Copyright (c) 2024 Nordic Semiconductor ASA
# SPDX-License-Identifier: Apache-2.0

# Enable UART driver
CONFIG_SERIAL=y

# Enable console
CONFIG_CONSOLE=y
CONFIG_UART_CONSOLE=y

CONFIG_USE_DT_CODE_PARTITION=y

# Enable MPU
CONFIG_ARM_MPU=y

# Enable hardware stack protection
CONFIG_HW_STACK_PROTECTION=y

# MPU-based null-pointer dereferencing detection cannot be applied
# as the (0x0 - 0x400) region is unmapped for this target.
CONFIG_NULL_POINTER_EXCEPTION_DETECTION_NONE=y

# Enable cache
CONFIG_CACHE_MANAGEMENT=y
CONFIG_EXTERNAL_CACHE=y
```

## boards/nordic/nrf54h20pdk/Kconfig.nrf54h20pdk
```kconfig
# Copyright (c) 2024 Nordic Semiconductor ASA
# SPDX-License-Identifier: Apache-2.0

config BOARD_NRF54H20PDK
	select SOC_NRF54H20_ENGA_CPUAPP if BOARD_NRF54H20PDK_NRF54H20_CPUAPP
	select SOC_NRF54H20_ENGA_CPURAD if BOARD_NRF54H20PDK_NRF54H20_CPURAD
	select SOC_NRF54H20_ENGA_CPUPPR if BOARD_NRF54H20PDK_NRF54H20_CPUPPR || \
					   BOARD_NRF54H20PDK_NRF54H20_CPUPPR_RAM
```

## boards/nordic/nrf54h20pdk/board.yml
```yaml
board:
  name: nrf54h20pdk
  vendor: nordic
  socs:
  - name: nrf54h20
    variants:
    - name: ram
      cpucluster: cpuppr
```

## boards/nordic/nrf54h20pdk/nrf54h20pdk_defconfig
```kconfig
# Copyright (c) 2024 Nordic Semiconductor ASA
# SPDX-License-Identifier: Apache-2.0

# Enable UART driver
CONFIG_SERIAL=y

# Enable console
CONFIG_CONSOLE=y
CONFIG_UART_CONSOLE=y
```

## boards/nordic/nrf54l09pdk/Kconfig.defconfig
```kconfig
# Copyright (c) 2024 Nordic Semiconductor ASA
# SPDX-License-Identifier: Apache-2.0

if BOARD_NRF54L09PDK_NRF54L09_CPUAPP

config BT_CTLR
	default BT

config ROM_START_OFFSET
	default 0x800 if BOOTLOADER_MCUBOOT

config SOC_NRF54LX_SKIP_CLOCK_CONFIG
	default y

config SOC_NRF54LX_SKIP_GLITCHDETECTOR_DISABLE
	default y

endif # BOARD_NRF54L09PDK_NRF54L09_CPUAPP
```

## boards/nordic/nrf54l09pdk/Kconfig.nrf54l09pdk
```kconfig
# Copyright (c) 2024 Nordic Semiconductor ASA
# SPDX-License-Identifier: Apache-2.0

config BOARD_NRF54L09PDK
	select SOC_NRF54L09_ENGA_CPUAPP if BOARD_NRF54L09PDK_NRF54L09_CPUAPP
```
