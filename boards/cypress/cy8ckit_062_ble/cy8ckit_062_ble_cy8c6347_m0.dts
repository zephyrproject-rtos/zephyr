/*
 * Copyright (c) 2018, Cypress
 * Copyright (c) 2020-2021, ATL Electronics
 *
 * SPDX-License-Identifier: Apache-2.0
 */

/dts-v1/;

#include <infineon/cat1a/legacy/psoc6_cm0.dtsi>
#include "cy8ckit_062_ble_common.dtsi"

/ {
	compatible = "cypress,cy8c6xx7_cm0p", "cypress,psoc6";
	model = "Cypress PSOC 6 BLE Pioneer Kit";

	chosen {
		zephyr,sram = &sram0;
		zephyr,flash = &flash0;
	};
};

&gpio_prt0 {
	interrupt-parent = <&intmux_ch20>;
};

&spi6 {
	interrupt-parent = <&intmux_ch16>;
	status = "okay";
};

arduino_spi: &spi6 {};
