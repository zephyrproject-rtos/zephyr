/*
 * Copyright (c) 2018, Cypress
 *
 * SPDX-License-Identifier: Apache-2.0
 */

/dts-v1/;

#include <infineon/cat1a/legacy/psoc6_cm4.dtsi>
#include "cy8ckit_062_wifi_bt_cy8c6247-pinctrl.dtsi"

/ {
	model = "cy8ckit_062_wifi_bt_m4 with a Cypress PSOC 6 SoC";
	compatible = "cypress,cy8ckit_062_wifi_bt_m4", "cypress,PSOC6";

	aliases {
		uart-5 = &uart5;
	};

	chosen {
		zephyr,sram = &sram2;
		zephyr,flash = &flash1;
		zephyr,console = &uart5;
		zephyr,shell-uart = &uart5;
	};
};

&uart5 {
	status = "okay";
	current-speed = <115200>;

	pinctrl-0 = <&p5_0_scb5_uart_rx &p5_1_scb5_uart_tx>;
	pinctrl-names = "default";
};
