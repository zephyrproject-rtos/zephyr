## boards/technexion/pico_pi/Kconfig.defconfig
```kconfig
# Pico-Pi iMX7D M4 board

# Copyright (c) 2019, Joris Offouga
# SPDX-License-Identifier: Apache-2.0

if BOARD_PICO_PI

if !XIP
config FLASH_SIZE
	default 0
config FLASH_BASE_ADDRESS
	default 0
endif

endif # BOARD_PICO_PI
```

## boards/technexion/pico_pi/Kconfig.pico_pi
```kconfig
# Copyright (c) 2019, Joris Offouga
# Copyright 2024 NXP
# SPDX-License-Identifier: Apache-2.0

config BOARD_PICO_PI
	select SOC_PART_NUMBER_MCIMX7D7DVM10SC
	select SOC_MCIMX7D_M4 if BOARD_PICO_PI_MCIMX7D_M4
```

## boards/technexion/pico_pi/board.yml
```yaml
board:
  name: pico_pi
  full_name: Pico-Pi i.MX7D - Android Things IoT Development Platform
  vendor: technexion
  socs:
    - name: mcimx7d
```

## boards/technexion/pico_pi/pico_pi_mcimx7d_m4_defconfig
```kconfig
#
# Copyright (c) 2019, Joris Offouga
#
# SPDX-License-Identifier: Apache-2.0
#

CONFIG_UART_CONSOLE=y
CONFIG_SERIAL=y
CONFIG_UART_INTERRUPT_DRIVEN=y
CONFIG_CONSOLE=y
CONFIG_XIP=y
CONFIG_GPIO=n
```

## boards/telink/tl3218/board.yml
```yaml
boards:
- name: tl3218
  vendor: telink
  socs:
  - name: telink_tl321x

- name: tl3218_retention
  vendor: telink
  socs:
  - name: telink_tl321x
```

## boards/telink/tl321x/board.yml
```yaml
boards:
- name: tl3218x
  vendor: telink
  socs:
  - name: telink_tl321x

- name: tl3218x_retention
  vendor: telink
  socs:
  - name: telink_tl321x
```

## boards/telink/tl321x/tl3218x_retention_defconfig
```kconfig
# Copyright (c) 2024 Telink Semiconductor
# SPDX-License-Identifier: Apache-2.0

CONFIG_SOC_RISCV_TELINK_TL321X=y
CONFIG_SOC_SERIES_RISCV_TELINK_TLX_RETENTION=y

CONFIG_GPIO=y
CONFIG_SYS_CLOCK_TICKS_PER_SEC=1000
CONFIG_UART_INTERRUPT_DRIVEN=y
CONFIG_SERIAL=y
CONFIG_CONSOLE=y
CONFIG_UART_CONSOLE=y
CONFIG_ENTROPY_GENERATOR=y
```

## boards/telink/tl7218/board.yml
```yaml
boards:
- name: tl7218
  vendor: telink
  socs:
  - name: telink_tl721x

- name: tl7218_retention
  vendor: telink
  socs:
  - name: telink_tl721x
```

## boards/telink/tl721x/Kconfig.defconfig
```kconfig
# Copyright (c) 2024 Telink Semiconductor
# SPDX-License-Identifier: Apache-2.0

if BOARD_TL7218X || BOARD_TL7218X_RETENTION

config SOC_FLASH_TELINK_TLX
	bool
	default y if FLASH

if BT

config BT_HCI_ACL_FLOW_CONTROL
	bool
	default n

endif # BT

# Workaround for not being able to have commas in macro arguments
DT_CHOSEN_Z_CODE_PARTITION := zephyr,code-partition

config FLASH_LOAD_OFFSET
	hex
	default $(dt_chosen_reg_addr_hex,$(DT_CHOSEN_Z_CODE_PARTITION)) if USE_DT_CODE_PARTITION

if MCUBOOT

config IMG_ERASE_PROGRESSIVELY
	bool
	default y

config MCUBOOT_ACTION_HOOKS
	bool
	default y

config IMG_BLOCK_BUF_SIZE
	int
	default 4096

endif # MCUBOOT

if BOOTLOADER_MCUBOOT

config MCUBOOT_SIGNATURE_KEY_FILE
	string
	default "bootloader/mcuboot/root-rsa-2048.pem" if !MCUBOOT_GENERATE_UNSIGNED_IMAGE

config MCUBOOT_EXTRA_IMGTOOL_ARGS
	string
	default "--max-sectors 4096"

endif # BOOTLOADER_MCUBOOT

endif # BOARD_TL7218X || BOARD_TL7218X_RETENTION
```

## boards/telink/tl721x/Kconfig.tl7218x_retention
```kconfig
# Copyright (c) 2024 Telink Semiconductor
# SPDX-License-Identifier: Apache-2.0

config BOARD_TL7218X_RETENTION
```

## boards/telink/tl721x/board.yml
```yaml
boards:
- name: tl7218x
  vendor: telink
  socs:
  - name: telink_tl721x

- name: tl7218x_retention
  vendor: telink
  socs:
  - name: telink_tl721x
```

## boards/telink/tlsr9118bdk40d/Kconfig.defconfig
```kconfig
# Copyright (c) 2023-2024 Telink Semiconductor
# SPDX-License-Identifier: Apache-2.0

if BOARD_TLSR9118BDK40D || BOARD_TLSR9118BDK40D_V1

config SOC_FLASH_TELINK_W91
	bool
	default y if FLASH

if BT

config BT_HCI_ACL_FLOW_CONTROL
	bool
	default n

endif # BT

# Workaround for not being able to have commas in macro arguments
DT_CHOSEN_Z_CODE_PARTITION := zephyr,code-partition

config FLASH_LOAD_OFFSET
	hex
	default $(dt_chosen_reg_addr_hex,$(DT_CHOSEN_Z_CODE_PARTITION)) if USE_DT_CODE_PARTITION

if MCUBOOT

config MCUBOOT_ACTION_HOOKS
	bool
	default y

config IMG_BLOCK_BUF_SIZE
	int
	default 4096

endif # MCUBOOT

if BOOTLOADER_MCUBOOT

config MCUBOOT_SIGNATURE_KEY_FILE
	string
	default "bootloader/mcuboot/root-rsa-2048.pem" if !MCUBOOT_GENERATE_UNSIGNED_IMAGE

config MCUBOOT_EXTRA_IMGTOOL_ARGS
	string
	default "--max-sectors 4096"

endif # BOOTLOADER_MCUBOOT

if ZTEST

config ZTEST_THREAD_PRIORITY
	default 0

endif # ZTEST

endif # BOARD_TLSR9118BDK40D || BOARD_TLSR9118BDK40D_V1
```

## boards/telink/tlsr9118bdk40d/Kconfig.tlsr9118bdk40d
```kconfig
# Copyright (c) 2024 Telink Semiconductor
# SPDX-License-Identifier: Apache-2.0

config BOARD_TLSR9118BDK40D
```

## boards/telink/tlsr9118bdk40d/board.yml
```yaml
boards:
- name: tlsr9118bdk40d
  vendor: telink
  socs:
  - name: telink_w91

- name: tlsr9118bdk40d_v1
  vendor: telink
  socs:
  - name: telink_w91
```

## boards/telink/tlsr9118bdk40d/tlsr9118bdk40d_defconfig
```kconfig
# Copyright (c) 2023-2024 Telink Semiconductor
# SPDX-License-Identifier: Apache-2.0

CONFIG_SOC_RISCV_TELINK_W91=y

CONFIG_SYS_CLOCK_TICKS_PER_SEC=1000
CONFIG_GPIO=y
CONFIG_PWM=y
CONFIG_ENTROPY_GENERATOR=y
CONFIG_CONSOLE=y
```

## boards/telink/tlsr9258a/board.yml
```yaml
boards:
- name: tlsr9258a
  vendor: telink
  socs:
  - name: telink_b92

- name: tlsr9258a_retention
  vendor: telink
  socs:
  - name: telink_b92
```

## boards/telink/tlsr9518adk80d/Kconfig.defconfig
```kconfig
# Copyright (c) 2021 Telink Semiconductor
# SPDX-License-Identifier: Apache-2.0

if BOARD_TLSR9518ADK80D

config SOC_FLASH_TELINK_B91
	default y if FLASH

# Workaround for not being able to have commas in macro arguments
DT_CHOSEN_Z_CODE_PARTITION := zephyr,code-partition

config FLASH_LOAD_OFFSET
	default $(dt_chosen_reg_addr_hex,$(DT_CHOSEN_Z_CODE_PARTITION)) if USE_DT_CODE_PARTITION

# Buffer for image writter shall be less(multiple of access alignment) or
# equal to flash page. tlsr9518adk80d boards use external P25Q16 IC as
# flesh memory. Flash page size of the IC is 256 bytes. So that, it is
# maximum image writer buffer size for such kind of boards.
config IMG_BLOCK_BUF_SIZE
	default 256 if MCUBOOT_IMG_MANAGER

endif
```

## boards/telink/tlsr9518adk80d/Kconfig.tlsr9518adk80d
```kconfig
# Copyright (c) 2021 Telink Semiconductor
# SPDX-License-Identifier: Apache-2.0

config BOARD_TLSR9518ADK80D
	select SOC_TLSR9518
```

## boards/telink/tlsr9518adk80d/board.yml
```yaml
board:
  name: tlsr9518adk80d
  full_name: TLSR9518ADK80D
  vendor: telink
  socs:
  - name: tlsr9518
```

## boards/telink/tlsr9518adk80d/tlsr9518adk80d_defconfig
```kconfig
# Copyright (c) 2021 Telink Semiconductor
# SPDX-License-Identifier: Apache-2.0

CONFIG_GPIO=y
CONFIG_SYS_CLOCK_TICKS_PER_SEC=1000
CONFIG_HEAP_MEM_POOL_SIZE=4096
CONFIG_UART_INTERRUPT_DRIVEN=y
CONFIG_SERIAL=y
CONFIG_CONSOLE=y
CONFIG_UART_CONSOLE=y

# HW DSP options
CONFIG_TELINK_B91_HWDSP=n
```

## boards/telink/tlsr9528a/board.yml
```yaml
boards:
- name: tlsr9528a
  vendor: telink
  socs:
  - name: telink_b92

- name: tlsr9528a_retention
  vendor: telink
  socs:
  - name: telink_b92
```

## boards/thirdreality/3r_tnh_sensor_lite/Kconfig
```kconfig
# Copyright (c) 2026 MASSDRIVER EI (massdriver.space)
# SPDX-License-Identifier: Apache-2.0

config BOARD_3R_TNH_SENSOR_LITE
	select BOARD_EARLY_INIT_HOOK
```

## boards/thirdreality/3r_tnh_sensor_lite/Kconfig.3r_tnh_sensor_lite
```kconfig
# Copyright (c) 2026 MASSDRIVER EI (massdriver.space)
# SPDX-License-Identifier: Apache-2.0

config BOARD_3R_TNH_SENSOR_LITE
	select SOC_BL704L10Q2I
```

## boards/thirdreality/3r_tnh_sensor_lite/board.yml
```yaml
board:
  name: 3r_tnh_sensor_lite
  full_name: ThirdReality Temperature and Humidity Sensor Lite
  vendor: thirdreality
  socs:
    - name: bl704l10q2i
```

## boards/ti/am13e230x_lp/Kconfig.am13e230x_lp
```kconfig
# Copyright (c) 2026 Texas Instruments Incorporated
#
# SPDX-License-Identifier: Apache-2.0

config BOARD_AM13E230X_LP
	select SOC_AM13E230X
```
