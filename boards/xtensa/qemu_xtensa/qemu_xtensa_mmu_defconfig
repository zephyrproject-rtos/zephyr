## boards/xtensa/qemu_xtensa/qemu_xtensa_mmu_defconfig
```kconfig
# SPDX-License-Identifier: Apache-2.0

CONFIG_MAIN_STACK_SIZE=2048
CONFIG_BOARD_QEMU_XTENSA_MMU=y
CONFIG_CONSOLE=y
CONFIG_SOC_XTENSA_DC233C=y
CONFIG_SYS_CLOCK_HW_CYCLES_PER_SEC=10000000
CONFIG_STACK_SENTINEL=y
CONFIG_GEN_ISR_TABLES=y
CONFIG_GEN_IRQ_VECTOR_TABLE=n
CONFIG_SIMULATOR_XTENSA=y
CONFIG_QEMU_ICOUNT_SHIFT=6
```

## boards/xtensa/twatch/Kconfig.board
```kconfig
# TTGO TWACH series configuration

# Copyright (c) 2022 Qingsong Gou <gouqs@hotmail.com>
# SPDX-License-Identifier: Apache-2.0

config BOARD_TWATCH_V3
	bool "TTGO TWATCH V3 Development Board"
	depends on SOC_ESP32
```

## boards/xtensa/twatch/Kconfig.defconfig
```kconfig
# TTGO TWACTH series configuration

# Copyright (c) 2022 Qingsong Gou <gouqs@hotmail.com>
# SPDX-License-Identifier: Apache-2.0

if BOARD_TWATCH_V3

config BOARD
	default "twach_v3" if BOARD_TWATCH_V3

config ENTROPY_ESP32_RNG
	default y if ENTROPY_GENERATOR

config KSCAN_FT5336
	default y if KSCAN

config ST7789V
	default y if DISPLAY

config REGULATOR_PMIC
	default y if REGULATOR

config PWM_LED_ESP32
	default y if PWM

if BT

config HEAP_MEM_POOL_SIZE
	default 16384

config ENTROPY_GENERATOR
	default y

choice BT_HCI_BUS_TYPE
	default BT_ESP32
endchoice

endif # BT

endif # BOARD_TWATCH_V3
```

## boards/xtensa/up_squared_adsp/Kconfig.board
```kconfig
# Xtensa board configuration

# Copyright (c) 2019 Intel Corporation
# SPDX-License-Identifier: Apache-2.0

config  BOARD_UP_SQUARED_ADSP
	bool "Xtensa on Up Squared"
	depends on SOC_INTEL_APL_ADSP
```

## boards/xtensa/up_squared_adsp/Kconfig.defconfig
```kconfig
# Copyright (c) 2019 Intel Corporation
#
# SPDX-License-Identifier: Apache-2.0

if BOARD_UP_SQUARED_ADSP

config BOARD
	default "up_squared_adsp"

config CAVS_ICTL_0_OFFSET
	default 6
config CAVS_ICTL_1_OFFSET
	default 10
config CAVS_ICTL_2_OFFSET
	default 13
config CAVS_ICTL_3_OFFSET
	default 16

config 2ND_LVL_INTR_00_OFFSET
	default CAVS_ICTL_0_OFFSET
config 2ND_LVL_INTR_01_OFFSET
	default CAVS_ICTL_1_OFFSET
config 2ND_LVL_INTR_02_OFFSET
	default CAVS_ICTL_2_OFFSET
config 2ND_LVL_INTR_03_OFFSET
	default CAVS_ICTL_3_OFFSET

config MAX_IRQ_PER_AGGREGATOR
	default 32
config NUM_2ND_LEVEL_AGGREGATORS
	default 4
config 2ND_LVL_ISR_TBL_OFFSET
	default 21

config CAVS_ISR_TBL_OFFSET
	default 2ND_LVL_ISR_TBL_OFFSET

if DMA_DW

config HEAP_MEM_POOL_SIZE
	default 1024

endif # DMA_DW

if DMA

config DMA_DW
	default y

endif

if I2S
config I2S_CAVS
	default y
endif

endif # BOARD_UP_SQUARED_ADSP
```

## boards/xtensa/up_squared_adsp/up_squared_adsp_defconfig
```kconfig
# SPDX-License-Identifier: Apache-2.0

CONFIG_MAIN_STACK_SIZE=2048

CONFIG_SOC_INTEL_APL_ADSP=y
CONFIG_BOARD_UP_SQUARED_ADSP=y

CONFIG_GEN_ISR_TABLES=y
CONFIG_GEN_IRQ_VECTOR_TABLE=n

CONFIG_XTENSA_RESET_VECTOR=y

CONFIG_XTENSA_USE_CORE_CRT1=y

CONFIG_MULTI_LEVEL_INTERRUPTS=y
CONFIG_2ND_LEVEL_INTERRUPTS=y
CONFIG_CAVS_ICTL=y

CONFIG_BOOTLOADER_SRAM_SIZE=192
```

## boards/xtensa/xiao_esp32s3/Kconfig.board
```kconfig
# XIAO ESP32S3 board configuration

# Copyright (c) 2023 Seeed Studio inc.
# SPDX-License-Identifier: Apache-2.0

config BOARD_XIAO_ESP32S3
	bool "XIAO ESP32S3 Board"
	depends on SOC_ESP32S3
```

## boards/xtensa/xiao_esp32s3/Kconfig.defconfig
```kconfig
# Copyright (c) 2023 Seeed Studio inc.
# SPDX-License-Identifier: Apache-2.0

config BOARD
	default "xiao_esp32s3"
	depends on BOARD_XIAO_ESP32S3

config ENTROPY_GENERATOR
	default y

config HEAP_MEM_POOL_SIZE
	default 98304 if WIFI
	default 40960 if BT
	default 4096

choice BT_HCI_BUS_TYPE
	default BT_ESP32 if BT
endchoice
```

## boards/xtensa/xt-sim/Kconfig
```kconfig
# Kconfig - XTENSA board configuration
#
# Copyright (c) 2016 Cadence Design Systems, Inc.
# SPDX-License-Identifier: Apache-2.0

config XTENSA_XTSC_INC
	string "Xtensa XTSC extension include file"
	depends on SIMULATOR_XTENSA
	help
	  If you want to use xtsc-run with an extended core, then you can put here the
	  path to the include file of the extension model. This path can either be
	  absolute or relative to the execution directory.
```

## boards/xtensa/xt-sim/Kconfig.board
```kconfig
# Xtensa Development ISS

# Copyright (c) 2016 Cadence Design Systems, Inc.
# SPDX-License-Identifier: Apache-2.0

config BOARD_XT_SIM
	def_bool "$(BOARD)" = "xt-sim"
	depends on SIMULATOR_XTENSA
```

## boards/xtensa/xt-sim/Kconfig.defconfig
```kconfig
# Copyright (c) 2016 Cadence Design Systems, Inc.
# SPDX-License-Identifier: Apache-2.0

config IPM_CONSOLE_STACK_SIZE
	default 2048 if IPM_CONSOLE_RECEIVER
```

## boards/xtensa/xt-sim/Kconfig.xt_sim
```kconfig
# Copyright (c) 2022 Zephyr Project members and individual contributors
# SPDX-License-Identifier: Apache-2.0

config BOARD_XT_SIM
	bool
	default y
	select SOC_XTENSA_SAMPLE_CONTROLLER
	select SIMULATOR_XTENSA
```

## boards/xtensa/xt-sim/xt-sim_D_108mini_defconfig
```kconfig
CONFIG_MAIN_STACK_SIZE=2048
CONFIG_IPM_CONSOLE_STACK_SIZE=2048
CONFIG_XTENSA=y
CONFIG_SOC_D_108mini=y
CONFIG_BOARD_XT_SIM=y
CONFIG_CONSOLE=y
```

## boards/xtensa/xt-sim/xt-sim_D_233L_defconfig
```kconfig
CONFIG_MAIN_STACK_SIZE=2048
CONFIG_IPM_CONSOLE_STACK_SIZE=2048
CONFIG_XTENSA=y
CONFIG_SOC_D_233L=y
CONFIG_BOARD_XT_SIM=y
CONFIG_CONSOLE=y

CONFIG_SW_ISR_TABLE=y
CONFIG_GEN_ISR_TABLES=y
CONFIG_GEN_IRQ_VECTOR_TABLE=n
CONFIG_SIMULATOR_XTENSA=y
```

## boards/xtensa/xt-sim/xt-sim_XRC_FUSION_AON_ALL_LM_defconfig
```kconfig
CONFIG_MAIN_STACK_SIZE=2048
CONFIG_IPM_CONSOLE_STACK_SIZE=2048
CONFIG_XTENSA=y
CONFIG_SOC_XRC_FUSION_AON_ALL_LM=y
CONFIG_BOARD_XT_SIM=y
CONFIG_CONSOLE=y
```

## boards/xtensa/xt-sim/xt-sim_defconfig
```kconfig
# SPDX-License-Identifier: Apache-2.0

CONFIG_MAIN_STACK_SIZE=2048
CONFIG_SOC_XTENSA_SAMPLE_CONTROLLER=y
CONFIG_BOARD_XT_SIM=y
CONFIG_CONSOLE=y

CONFIG_GEN_ISR_TABLES=y
CONFIG_GEN_IRQ_VECTOR_TABLE=n
CONFIG_SIMULATOR_XTENSA=y
```

## boards/xtensa/xt-sim/xt-sim_intel_s1000_defconfig
```kconfig
# SPDX-License-Identifier: Apache-2.0

CONFIG_MAIN_STACK_SIZE=2048
CONFIG_SOC_INTEL_S1000=y
CONFIG_BOARD_XT_SIM_INTEL_S1000=y
CONFIG_CONSOLE=y
CONFIG_GEN_ISR_TABLES=y
CONFIG_GEN_IRQ_VECTOR_TABLE=n
```

## boards/xtensa/yd_esp32/Kconfig.board
```kconfig
# YD-ESP32 board configuration

# Copyright (c) 2023 Julio Cesar <hi@jcsx.dev>
# SPDX-License-Identifier: Apache-2.0

config BOARD_YD_ESP32
	bool "YD-ESP32 Development Board"
	depends on SOC_SERIES_ESP32

choice SOC_PART_NUMBER
	default SOC_ESP32_WROOM_32UE_N4
endchoice
```

## boards/xtensa/yd_esp32/Kconfig.defconfig
```kconfig
# YD-ESP32 board configuration

# Copyright (c) 2023 Julio Cesar <hi@jcsx.dev>
# SPDX-License-Identifier: Apache-2.0

config BOARD
	default "yd_esp32"
	depends on BOARD_YD_ESP32

config ENTROPY_GENERATOR
	default y

config HEAP_MEM_POOL_ADD_SIZE_BOARD
	int
	default 65535 if WIFI && BT
	default 51200 if WIFI
	default 40960 if BT
	default 4096

choice BT_HCI_BUS_TYPE
	default BT_ESP32 if BT
endchoice
```

## boards/xuantie/xiaohui_c908/Kconfig.defconfig
```kconfig
# Copyright (c) 2019 BayLibre SAS
# SPDX-License-Identifier: Apache-2.0

if BOARD_XIAOHUI_C908

config SYS_CLOCK_HW_CYCLES_PER_SEC
	default 50000000

endif # BOARD_XIAOHUI_C908
```

## boards/xuantie/xiaohui_c908/Kconfig.xiaohui_c908
```kconfig
# Copyright (c) 2019 BayLibre SAS
# SPDX-License-Identifier: Apache-2.0

config BOARD_XIAOHUI_C908
	select SOC_SERIES_XIAOHUI_C9XX
```

## boards/xuantie/xiaohui_c908/board.yml
```yaml
board:
  name: xiaohui_c908
  vendor: xuantie
  socs:
  - name: c908
    variants:
    - name: smp
```

## boards/xuantie/xiaohui_c908/xiaohui_c908_smp_defconfig
```kconfig
# SPDX-License-Identifier: Apache-2.0

CONFIG_CPU_XUANTIE_C908V=y
CONFIG_XUANTIE_CPU_NAME="c908v"
CONFIG_CONSOLE=y
CONFIG_SERIAL=y
CONFIG_UART_CONSOLE=y
CONFIG_STACK_SENTINEL=y
CONFIG_XIP=n
CONFIG_SMP=y
CONFIG_MP_MAX_NUM_CPUS=2
CONFIG_PM_CPU_OPS=y
CONFIG_RISCV_PMP=n
CONFIG_TICKLESS_KERNEL=n

CONFIG_SCHED_CPU_MASK=y
CONFIG_XUANTIE_RISCV_VLENB_LEN=256
CONFIG_IDLE_STACK_SIZE=8192
CONFIG_ISR_STACK_SIZE=8192
CONFIG_MAIN_STACK_SIZE=8192
CONFIG_SYSTEM_WORKQUEUE_STACK_SIZE=8192
CONFIG_COMMON_LIBC_MALLOC_ARENA_SIZE=524288
CONFIG_SPIN_VALIDATE=n
```

## boards/xunlong/opi_zero/Kconfig.opi_zero
```kconfig
# Copyright (c) 2025 Muhammad Waleed Badar
# SPDX-License-Identifier: Apache-2.0

config BOARD_OPI_ZERO
	select SOC_SUN8I_H3
```

## boards/xunlong/opi_zero/board.yml
```yaml
board:
  name: opi_zero
  full_name: Orange Pi Zero
  vendor: xunlong
  socs:
  - name: sun8i_h3
```
