## boards/xtensa/intel_adsp_cavs25/intel_adsp_cavs25_defconfig
```kconfig
# SPDX-License-Identifier: Apache-2.0

CONFIG_MAIN_STACK_SIZE=2048

CONFIG_SOC_SERIES_INTEL_ADSP_CAVS=y
CONFIG_SOC_INTEL_CAVS_V25=y
CONFIG_BOARD_INTEL_ADSP_CAVS25=y

CONFIG_GEN_ISR_TABLES=y
CONFIG_GEN_IRQ_VECTOR_TABLE=n

CONFIG_XTENSA_RESET_VECTOR=y

CONFIG_XTENSA_USE_CORE_CRT1=y

CONFIG_MULTI_LEVEL_INTERRUPTS=y
CONFIG_2ND_LEVEL_INTERRUPTS=y
CONFIG_CAVS_ICTL=y

CONFIG_BOOTLOADER_SRAM_SIZE=192
CONFIG_BUILD_OUTPUT_BIN=n
CONFIG_CLEANUP_INTERMEDIATE_FILES=y

CONFIG_MP_NUM_CPUS=4

CONFIG_DAI_SSP_HAS_POWER_CONTROL=y
```

## boards/xtensa/intel_adsp_cavs25/intel_adsp_cavs25_tgph_defconfig
```kconfig
# SPDX-License-Identifier: Apache-2.0

CONFIG_MAIN_STACK_SIZE=2048

CONFIG_SOC_INTEL_CAVS_V25=y
CONFIG_BOARD_INTEL_ADSP_CAVS25_TGPH=y
CONFIG_SOC_SERIES_INTEL_ADSP_CAVS=y


CONFIG_GEN_ISR_TABLES=y
CONFIG_GEN_IRQ_VECTOR_TABLE=n

CONFIG_XTENSA_RESET_VECTOR=y

CONFIG_XTENSA_USE_CORE_CRT1=y

CONFIG_MULTI_LEVEL_INTERRUPTS=y
CONFIG_2ND_LEVEL_INTERRUPTS=y

CONFIG_BUILD_OUTPUT_BIN=n
CONFIG_CLEANUP_INTERMEDIATE_FILES=y

CONFIG_DAI_SSP_HAS_POWER_CONTROL=y
```

## boards/xtensa/intel_adsp_cavs25_tgph/Kconfig.defconfig
```kconfig
# Copyright (c) 2022 Intel Corporation
#
# SPDX-License-Identifier: Apache-2.0

if BOARD_INTEL_ADSP_CAVS25_TGPH

config BOARD
	default "intel_adsp_cavs25_tgph"

config I2S_CAVS
	default y
	depends on I2S

endif # BOARD_INTEL_ADSP_CAVS25_TGPH
```

## boards/xtensa/intel_s1000_crb/Kconfig.board
```kconfig
# Xtensa on Intel_S1000

# Copyright (c) 2017 Intel Corporation
# SPDX-License-Identifier: Apache-2.0

config BOARD_INTEL_S1000_CRB
	def_bool "$(BOARD)" = "intel_s1000_crb"
	depends on SOC_INTEL_S1000
```

## boards/xtensa/intel_s1000_crb/Kconfig.defconfig
```kconfig
# Copyright (c) 2017 Intel Corporation
# SPDX-License-Identifier: Apache-2.0

if BOARD_INTEL_S1000_CRB

config BOARD
	default "intel_s1000_crb"

config CAVS_ICTL_0_OFFSET
	default 6
config CAVS_ICTL_1_OFFSET
	default 10
config CAVS_ICTL_2_OFFSET
	default 13
config CAVS_ICTL_3_OFFSET
	default 16

config DW_ICTL_OFFSET
	default 7

config 2ND_LVL_INTR_00_OFFSET
	default CAVS_ICTL_0_OFFSET
config 2ND_LVL_INTR_01_OFFSET
	default CAVS_ICTL_1_OFFSET
config 2ND_LVL_INTR_02_OFFSET
	default CAVS_ICTL_2_OFFSET
config 2ND_LVL_INTR_03_OFFSET
	default CAVS_ICTL_3_OFFSET
config 3RD_LVL_INTR_00_OFFSET
	default DW_ICTL_OFFSET

config MAX_IRQ_PER_AGGREGATOR
	default 32
config NUM_2ND_LEVEL_AGGREGATORS
	default 4
config NUM_3RD_LEVEL_AGGREGATORS
	default 1
config 2ND_LVL_ISR_TBL_OFFSET
	default 21
config 3RD_LVL_ISR_TBL_OFFSET
	default 149

config CAVS_ISR_TBL_OFFSET
	default 2ND_LVL_ISR_TBL_OFFSET
config DW_ISR_TBL_OFFSET
	default 3RD_LVL_ISR_TBL_OFFSET

config HEAP_MEM_POOL_SIZE
	default 1024
	depends on DMA_DW

config ROM_START_OFFSET
	default 0x100
	depends on BOOTLOADER_MCUBOOT

if USB
config USB_DW
	default y

config USB_DW_USB_2_0
	default y

config USB_REQUEST_BUFFER_SIZE
	default 128
	depends on USB_DEVICE_HID

config USB_REQUEST_BUFFER_SIZE
	default 4096
	depends on USB_DFU_CLASS

config USB_DEVICE_STACK
	default y

config USB_DEVICE_VID
	default "0x8087"

config USB_DEVICE_PID
	default "0x0B1A"

config USB_DEVICE_MANUFACTURER
	default "Intel(R) Corporation"

config USB_DEVICE_PRODUCT
	default "Sue Creek (S1000) ASIC"

endif # USB

if SERIAL

config UART_INTERRUPT_DRIVEN
	default y

endif # SERIAL

if I2C

config I2C_DW
	default y

endif

config DMA_DW
	default y
	depends on DMA

config I2S_CAVS
	default y
	depends on I2S

if AUDIO
config AUDIO_CODEC
	default y

config AUDIO_TLV320DAC
	default y

config AUDIO_DMIC
	default y

config AUDIO_INTEL_DMIC
	default y

endif

config INTEL_GNA
	default y
	depends on NEURAL_NET_ACCEL

if GPIO

config GPIO_DW
	default y

config GPIO_DW_0
	default y

endif

if FLASH

config SPI
	default y

config SPI_NOR
	default y

config FLASH_HAS_PAGE_LAYOUT
	default y

config FLASH_PAGE_LAYOUT
	default y

endif

if SPI

config SPI_DW
	default y

config SPI_0
	default y

endif

config PINMUX_INTEL_S1000
	default y
	depends on PINMUX

endif # BOARD_INTEL_S1000_CRB
```

## boards/xtensa/intel_s1000_crb/intel_s1000_crb_defconfig
```kconfig
# SPDX-License-Identifier: Apache-2.0

CONFIG_MAIN_STACK_SIZE=2048

CONFIG_SOC_INTEL_S1000=y
CONFIG_BOARD_INTEL_S1000_CRB=y

CONFIG_GEN_ISR_TABLES=y
CONFIG_GEN_IRQ_VECTOR_TABLE=n

CONFIG_XTENSA_RESET_VECTOR=y
CONFIG_XTENSA_USE_CORE_CRT1=y

CONFIG_MULTI_LEVEL_INTERRUPTS=y
CONFIG_2ND_LEVEL_INTERRUPTS=y
CONFIG_3RD_LEVEL_INTERRUPTS=y
CONFIG_CAVS_ICTL=y
CONFIG_DW_ICTL=y

CONFIG_BOOTLOADER_SRAM_SIZE=192


CONFIG_GPIO=y
CONFIG_CONSOLE=y
CONFIG_SERIAL=y
CONFIG_UART_CONSOLE=y
CONFIG_UART_NS16550=y

CONFIG_PINMUX=y
CONFIG_PINMUX_INTEL_S1000=y
```

## boards/xtensa/m5stack_atoms3/Kconfig.defconfig
```kconfig
# M5Stack AtomS3 board configuration
# Copyright (c) 2023 Benjamin Cabé <benjamin@zephyrproject.org>
# SPDX-License-Identifier: Apache-2.0

if BOARD_M5STACK_ATOMS3

config BOARD
	default "m5stack_atoms3"
	depends on BOARD_M5STACK_ATOMS3

config ENTROPY_GENERATOR
	default y

config HEAP_MEM_POOL_ADD_SIZE_BOARD
	int
	default 65535 if WIFI && BT
	default 51200 if WIFI
	default 65536 if BT
	default 4096

config KERNEL_MEM_POOL
	default y

choice BT_HCI_BUS_TYPE
	default BT_ESP32 if BT
endchoice

config LV_COLOR_16_SWAP
	default y if LVGL

endif # BOARD_M5STACK_ATOMS3
```

## boards/xtensa/m5stack_atoms3_lite/Kconfig.board
```kconfig
# M5Stack AtomS3 Lite board configuration
# Copyright (c) 2023 Martin Kiepfer <mrmarteng@teleschirm.org>
# SPDX-License-Identifier: Apache-2.0

# M5Stack AtomS3 Lite
config BOARD_M5STACK_ATOMS3_LITE
	bool "M5Stack AtomS3 Lite Development Board"
	depends on SOC_SERIES_ESP32S3

choice SOC_PART_NUMBER
	default SOC_ESP32S3_FN8
endchoice
```

## boards/xtensa/m5stack_atoms3_lite/Kconfig.defconfig
```kconfig
# M5Stack AtomS3 Lite board configuration
# Copyright (c) 2023 Martin Kiepfer <mrmarteng@teleschirm.org>
# SPDX-License-Identifier: Apache-2.0

if BOARD_M5STACK_ATOMS3_LITE

config BOARD
	default "m5stack_atoms3_lite"
	depends on BOARD_M5STACK_ATOMS3_LITE

config ENTROPY_GENERATOR
	default y

config HEAP_MEM_POOL_ADD_SIZE_BOARD
	int
	default 98304 if WIFI
	default 65536 if BT
	default 4096

config KERNEL_MEM_POOL
	default y

choice BT_HCI_BUS_TYPE
	default BT_ESP32 if BT
endchoice
endif # BOARD_M5STACK_ATOMS3_LITE
```

## boards/xtensa/m5stack_core2/Kconfig.defconfig
```kconfig
# M5Stack Core2 board configuration
# Copyright (c) 2022 AVSystem Sławomir Wolf Sp.j. (AVSystem)
# Copyright (c) 2023 Martin Kiepfer <m.kiepfer@teleschirm.org>
# SPDX-License-Identifier: Apache-2.0

if BOARD_M5STACK_CORE2

config BOARD
	default "m5stack_core2"
	depends on BOARD_M5STACK_CORE2

config ENTROPY_GENERATOR
	default y

config HEAP_MEM_POOL_ADD_SIZE_BOARD
	int
	default 65535 if WIFI && BT
	default 51200 if WIFI
	default 65536 if BT
	default 4096

config KERNEL_MEM_POOL
	default y

choice BT_HCI_BUS_TYPE
	default BT_ESP32 if BT
endchoice

config REGULATOR_AXP192_INIT_PRIORITY
	default 81

config GPIO_HOGS_INIT_PRIORITY
	default 82

config INPUT_FT5336_INTERRUPT
	default y if INPUT

config INPUT
	default y

config LV_COLOR_16_SWAP
	default y if LVGL

endif # BOARD_M5STACK_CORE2
```

## boards/xtensa/m5stack_m5dial/Kconfig.board
```kconfig
# M5Stack M5Dial board configuration

# Copyright (c) 2023 Martin Kiepfer <mrmarteng@teleschirm.org>
# SPDX-License-Identifier: Apache-2.0

config BOARD_M5STACK_M5DIAL
	bool "M5Stack M5Dial IoT Development Board"
	depends on SOC_SERIES_ESP32S3

choice SOC_PART_NUMBER
	default SOC_ESP32S3_FN8
endchoice
```

## boards/xtensa/m5stack_m5dial/Kconfig.defconfig
```kconfig
# M5Stack M5Dial board configuration
# Copyright (c) 2023 Martin Kiepfer <mrmarteng@teleschirm.org>
# SPDX-License-Identifier: Apache-2.0

if BOARD_M5STACK_M5DIAL

config BOARD
	default "m5stack_m5dial"
	depends on BOARD_M5STACK_M5DIAL

config ENTROPY_GENERATOR
	default y

config HEAP_MEM_POOL_SIZE
	default 98304 if WIFI
	default 65536 if BT
	default 4096

config KERNEL_MEM_POOL
	default y

choice BT_HCI_BUS_TYPE
	default BT_ESP32 if BT
endchoice

config INPUT_FT5336_INTERRUPT
	default y if INPUT

config INPUT
	default y

config LV_COLOR_16_SWAP
	default y if LVGL

endif # BOARD_M5STACK_M5DIAL
```

## boards/xtensa/m5stack_m5dial/m5stack_m5dial_defconfig
```kconfig
# SPDX-License-Identifier: Apache-2.0

CONFIG_BOARD_M5STACK_M5DIAL=y
CONFIG_SOC_SERIES_ESP32S3=y

CONFIG_MAIN_STACK_SIZE=2048

CONFIG_GPIO=y
CONFIG_REGULATOR=y # for LCD backlight

CONFIG_CONSOLE=y
CONFIG_PWM=y
CONFIG_SERIAL=y
CONFIG_UART_CONSOLE=y
```

## boards/xtensa/m5stack_stamps3/Kconfig.board
```kconfig
# M5Stack StampS3 board configuration

# Copyright (c) 2023 Martin Kiepfer <mrmarteng@teleschirm.org>
# SPDX-License-Identifier: Apache-2.0

config BOARD_M5STACK_STAMPS3
	bool "M5Stack StampS3 Development Board"
	depends on SOC_SERIES_ESP32S3

choice SOC_PART_NUMBER
	default SOC_ESP32S3_FN8
endchoice
```

## boards/xtensa/m5stack_stamps3/Kconfig.defconfig
```kconfig
# M5Stack StampS3 board configuration
# Copyright (c) 2023 Martin Kiepfer <mrmarteng@teleschirm.org>
# SPDX-License-Identifier: Apache-2.0

if BOARD_M5STACK_STAMPS3

config BOARD
	default "m5stack_stamps3"
	depends on BOARD_M5STACK_STAMPS3

config ENTROPY_GENERATOR
	default y

config HEAP_MEM_POOL_ADD_SIZE_BOARD
	int
	default 98304 if WIFI
	default 65536 if BT
	default 4096

config KERNEL_MEM_POOL
	default y

choice BT_HCI_BUS_TYPE
	default BT_ESP32 if BT
endchoice

endif # BOARD_M5STACK_STAMPS3
```

## boards/xtensa/m5stickc_plus/Kconfig.board
```kconfig
# M5StickC PLUS board configuration

# Copyright (c) 2022 AVSystem Sławomir Wolf Sp.j. (AVSystem)
# SPDX-License-Identifier: Apache-2.0

config BOARD_M5STICKC_PLUS
	bool "M5StickC PLUS Development Board"
	depends on SOC_SERIES_ESP32

choice SOC_PART_NUMBER
	default SOC_ESP32_PICO_D4
endchoice
```

## boards/xtensa/m5stickc_plus/Kconfig.defconfig
```kconfig
# M5StickC PLUS board configuration

# Copyright (c) 2022 AVSystem Sławomir Wolf Sp.j. (AVSystem)
# SPDX-License-Identifier: Apache-2.0

config BOARD
	default "m5stickc_plus"
	depends on BOARD_M5STICKC_PLUS

config ENTROPY_GENERATOR
	default y

config HEAP_MEM_POOL_SIZE
	default 98304 if WIFI
	default 40960 if BT
	default 4096

choice BT_HCI_BUS_TYPE
	default BT_ESP32 if BT
endchoice
```

## boards/xtensa/m5stickc_plus/m5stickc_plus_defconfig
```kconfig
# SPDX-License-Identifier: Apache-2.0

CONFIG_BOARD_M5STICKC_PLUS=y
CONFIG_SOC_SERIES_ESP32=y

CONFIG_MAIN_STACK_SIZE=2048

CONFIG_CONSOLE=y
CONFIG_SERIAL=y
CONFIG_UART_CONSOLE=y

CONFIG_GPIO=y
CONFIG_I2C=y
```

## boards/xtensa/mt8195_adsp/Kconfig.defconfig
```kconfig
# Copyright 2023 The ChromiumOS Authors
# SPDX-License-Identifier: Apache-2.0

if BOARD_MT8195_ADSP

config BOARD
	default "mt8195_adsp"

endif # BOARD_MT8195_ADSP
```

## boards/xtensa/nxp_adsp_imx8/Kconfig.board
```kconfig
# Xtensa board configuration

# Copyright (c) 2021 NXP
# SPDX-License-Identifier: Apache-2.0

config  BOARD_NXP_ADSP_IMX8
	bool "NXP ADSP i.MX8"
	depends on SOC_SERIES_NXP_IMX8
	select SOC_PART_NUMBER_MIMX8QM6AVUFF
```

## boards/xtensa/nxp_adsp_imx8/Kconfig.defconfig
```kconfig
# Copyright (c) 2021 NXP
#
# SPDX-License-Identifier: Apache-2.0

if BOARD_NXP_ADSP_IMX8

config BOARD
	default "nxp_adsp_imx8"

config DUMMY_DMA
	bool
	default y
	depends on DMA

config IMX_EDMA
	bool
	default y
	depends on DMA


endif # BOARD_NXP_ADSP_IMX8
```

## boards/xtensa/nxp_adsp_imx8/Kconfig.nxp_adsp_imx8
```kconfig
# SPDX-License-Identifier: Apache-2.0

config BOARD_NXP_ADSP_IMX8
	bool
	default y
	select SOC_SERIES_NXP_IMX8
```

## boards/xtensa/nxp_adsp_imx8m/Kconfig.board
```kconfig
# Xtensa board configuration

# Copyright (c) 2021 NXP
# SPDX-License-Identifier: Apache-2.0

config BOARD_NXP_ADSP_IMX8M
	bool "NXP i.MX8M Plus EVK Audio DSP"
	depends on SOC_SERIES_NXP_IMX8M
	select SOC_PART_NUMBER_MIMX8ML8DVNLZ
	select SOC_PART_NUMBER_MIMX8ML8CVNKZ
```

## boards/xtensa/nxp_adsp_imx8m/Kconfig.defconfig
```kconfig
# Copyright 2021, 2023 NXP
#
# SPDX-License-Identifier: Apache-2.0

if BOARD_NXP_ADSP_IMX8M

config BOARD
	default "nxp_adsp_imx8m"

endif # BOARD_NXP_ADSP_IMX8M
```

## boards/xtensa/nxp_adsp_imx8m/Kconfig.nxp_adsp_imx8m
```kconfig
# Copyright (c) 2022 Zephyr Project members and individual contributors
# SPDX-License-Identifier: Apache-2.0

config BOARD_NXP_ADSP_IMX8M
	bool
	default y
	select SOC_SERIES_NXP_IMX8M
```
