/*
 * Copyright (c) 2020 Intel Corporation
 *
 * SPDX-License-Identifier: Apache-2.0
 */

/dts-v1/;

#include <intel/intel_adsp_cavs25.dtsi>

/ {
	model = "intel_adsp_cavs25";
	compatible = "intel";

	aliases {
		dma0 = &lpgpdma0;
	};

	chosen {
		zephyr,sram = &sram0;
		zephyr,console = &mem_window3;
	};
};
