/*
 * Copyright (c) 2020 Intel Corporation
 *
 * SPDX-License-Identifier: Apache-2.0
 */

/dts-v1/;

#include <intel/intel_bdw_adsp.dtsi>

/ {
	model = "intel_adsp_broadwell";
	compatible = "intel";

	chosen {
		zephyr,sram = &sram0;
	};
};
