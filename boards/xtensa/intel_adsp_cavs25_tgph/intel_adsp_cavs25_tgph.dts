/*
 * Copyright (c) 2020,2022 Intel Corporation
 *
 * SPDX-License-Identifier: Apache-2.0
 */

/dts-v1/;

#include <intel/intel_cavs25_tgph.dtsi>

/ {
	model = "intel_adsp_cavs25_tgph";
	compatible = "intel";

	chosen {
		zephyr,sram = &sram0;
	};
};
