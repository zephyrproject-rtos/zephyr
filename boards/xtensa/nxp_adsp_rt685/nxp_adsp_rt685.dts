/*
 * Copyright (c) 2023 NXP
 * SPDX-License-Identifier: Apache-2.0
 */

/dts-v1/;

#include <nxp/nxp_rt685.dtsi>
#include <nxp/nxp_imx/rt/MIMXRT685SFVKB-pinctrl.h>
#include <zephyr/dt-bindings/gpio/gpio.h>

/ {
	model = "nxp_adsp_rt685";
	compatible = "nxp";
};