## boards/xtensa/nxp_adsp_imx8m/nxp_adsp_imx8m_defconfig
```kconfig
# SPDX-License-Identifier: Apache-2.0

CONFIG_MAIN_STACK_SIZE=3072

CONFIG_SOC_SERIES_NXP_IMX8M=y
CONFIG_SOC_MIMX8M_ADSP=y
CONFIG_BOARD_NXP_ADSP_IMX8M=y

CONFIG_GEN_ISR_TABLES=y
CONFIG_GEN_IRQ_VECTOR_TABLE=n

CONFIG_XTENSA_RESET_VECTOR=y

CONFIG_XTENSA_USE_CORE_CRT1=y

CONFIG_XTENSA_SMALL_VECTOR_TABLE_ENTRY=y

CONFIG_MULTI_LEVEL_INTERRUPTS=n
CONFIG_2ND_LEVEL_INTERRUPTS=n

CONFIG_BUILD_OUTPUT_BIN=n

CONFIG_DCACHE_LINE_SIZE=128

# enable uart driver
CONFIG_SERIAL=y

# clock configuration
CONFIG_CLOCK_CONTROL=y

# console (remote proc console by default)
CONFIG_CONSOLE=y

# uart console (overrides remote proc console)
CONFIG_UART_CONSOLE=y

# enable pin controller
CONFIG_PINCTRL=y
```

## boards/xtensa/nxp_adsp_imx8ulp/Kconfig.board
```kconfig
# Xtensa board configuration

# Copyright (c) 2023 NXP
# SPDX-License-Identifier: Apache-2.0

config  BOARD_NXP_ADSP_IMX8ULP
	bool "NXP ADSP i.MX8ULP"
```

## boards/xtensa/nxp_adsp_imx8x/Kconfig.board
```kconfig
# Xtensa board configuration

# Copyright (c) 2021 NXP
# SPDX-License-Identifier: Apache-2.0

config  BOARD_NXP_ADSP_IMX8X
	bool "NXP ADSP i.MX8X"
	depends on SOC_SERIES_NXP_IMX8
	select SOC_PART_NUMBER_MIMX8QX6AVLFZ
```

## boards/xtensa/nxp_adsp_imx8x/Kconfig.defconfig
```kconfig
# Copyright (c) 2021 NXP
#
# SPDX-License-Identifier: Apache-2.0

if BOARD_NXP_ADSP_IMX8X

config BOARD
	default "nxp_adsp_imx8x"

endif # BOARD_NXP_ADSP_IMX8X
```

## boards/xtensa/nxp_adsp_imx8x/Kconfig.nxp_adsp_imx8x
```kconfig
# SPDX-License-Identifier: Apache-2.0

config BOARD_NXP_ADSP_IMX8X
	bool
	default y
	select SOC_SERIES_NXP_IMX8
```

## boards/xtensa/nxp_adsp_imx8x/nxp_adsp_imx8x_defconfig
```kconfig
# SPDX-License-Identifier: Apache-2.0

CONFIG_MAIN_STACK_SIZE=3072

# board/soc-related configurations
CONFIG_SOC_SERIES_NXP_IMX8=y
CONFIG_SOC_MIMX8QXP_ADSP=y
CONFIG_BOARD_NXP_ADSP_IMX8X=y

CONFIG_LOG=y

# TODO: maybe move this to SOF?
CONFIG_DYNAMIC_INTERRUPTS=y
CONFIG_BUILD_OUTPUT_BIN=n
```

## boards/xtensa/nxp_adsp_rt595/Kconfig.defconfig
```kconfig
# Copyright (c) 2023 Google LLC.
# SPDX-License-Identifier: Apache-2.0

if BOARD_NXP_ADSP_RT595

config BOARD
	default "nxp_adsp_rt595"

endif # BOARD_NXP_ADSP_RT595
```

## boards/xtensa/nxp_adsp_rt595/nxp_adsp_rt595_defconfig
```kconfig
CONFIG_SOC_SERIES_NXP_RT5XX=y
CONFIG_SOC_NXP_RT595=y
CONFIG_BOARD_NXP_ADSP_RT595=y

CONFIG_GEN_ISR_TABLES=y
CONFIG_GEN_IRQ_VECTOR_TABLE=n
CONFIG_XTENSA_SMALL_VECTOR_TABLE_ENTRY=y
```

## boards/xtensa/nxp_adsp_rt685/Kconfig
```kconfig
# Copyright 2023 Google LLC.
# Copyright 2023 NXP
# SPDX-License-Identifier: Apache-2.0

DT_ADSP_RESET_MEM := $(dt_nodelabel_path,adsp_reset)
DT_ADSP_DATA_MEM := $(dt_nodelabel_path,adsp_data)
DT_ADSP_TEXT_MEM := $(dt_nodelabel_path,adsp_text)

if BOARD_NXP_ADSP_RT685

config RT685_ADSP_STACK_SIZE
	hex "Boot time stack size"
	default 0x1000
	help
	  Stack space is reserved at the end of the RT685_ADSP_DATA_MEM
	  region, starting at RT685_ADSP_DATA_MEM_ADDR - RT685_ADSP_STACK_SIZE

config RT685_ADSP_RESET_MEM_ADDR
	hex
	default $(dt_node_reg_addr_hex,$(DT_ADSP_RESET_MEM))

config RT685_ADSP_RESET_MEM_SIZE
	hex
	default $(dt_node_reg_size_hex,$(DT_ADSP_RESET_MEM))

config RT685_ADSP_DATA_MEM_ADDR
	hex
	default $(dt_node_reg_addr_hex,$(DT_ADSP_DATA_MEM))

config RT685_ADSP_DATA_MEM_SIZE
	hex
	default $(dt_node_reg_size_hex,$(DT_ADSP_DATA_MEM))

config RT685_ADSP_TEXT_MEM_ADDR
	hex
	default $(dt_node_reg_addr_hex,$(DT_ADSP_TEXT_MEM))

config RT685_ADSP_TEXT_MEM_SIZE
	hex
	default $(dt_node_reg_size_hex,$(DT_ADSP_TEXT_MEM))

endif # BOARD_NXP_ADSP_RT685
```

## boards/xtensa/nxp_adsp_rt685/Kconfig.board
```kconfig
# Copyright (c) 2023 Google LLC.
# Copyright (c) 2023 NXP
# SPDX-License-Identifier: Apache-2.0

config BOARD_NXP_ADSP_RT685
	bool "NXP ADSP RT685"
	depends on SOC_SERIES_NXP_RT6XX
```

## boards/xtensa/nxp_adsp_rt685/Kconfig.defconfig
```kconfig
# Copyright (c) 2023 Google LLC.
# Copyright (c) 2023 NXP
# SPDX-License-Identifier: Apache-2.0

if BOARD_NXP_ADSP_RT685

config BOARD
	default "nxp_adsp_RT685"

endif # BOARD_NXP_ADSP_RT685
```

## boards/xtensa/nxp_adsp_rt685/nxp_adsp_rt685_defconfig
```kconfig
CONFIG_SOC_NXP_RT685=y
CONFIG_SOC_SERIES_NXP_RT6XX=y
CONFIG_BOARD_NXP_ADSP_RT685=y

CONFIG_GEN_ISR_TABLES=y
CONFIG_GEN_IRQ_VECTOR_TABLE=n
CONFIG_XTENSA_SMALL_VECTOR_TABLE_ENTRY=y

CONFIG_CONSOLE=y
CONFIG_UART_CONSOLE=y
CONFIG_SERIAL=y
CONFIG_PINCTRL=y
CONFIG_GPIO=y
```

## boards/xtensa/odroid_go/Kconfig.board
```kconfig
# ODROID-GO Game Kit configuration

# Copyright (c) 2019 Yannis Damigos
# SPDX-License-Identifier: Apache-2.0

config BOARD_ODROID_GO
	bool "ODROID-GO Game Kit"
	depends on SOC_SERIES_ESP32

choice SOC_PART_NUMBER
	default SOC_ESP32_WROVER_E_N16R2
endchoice
```

## boards/xtensa/odroid_go/Kconfig.defconfig
```kconfig
# ODROID-GO Game Kit configuration

# Copyright (c) 2019 Yannis Damigos
# SPDX-License-Identifier: Apache-2.0

config BOARD
	default "odroid_go"
	depends on BOARD_ODROID_GO

config DISK_DRIVER_SDMMC
	default y if DISK_ACCESS

config SPI
	default y if DISK_DRIVER_SDMMC

config ENTROPY_GENERATOR
	default y

config HEAP_MEM_POOL_ADD_SIZE_BOARD
	int
	default 65535 if WIFI && BT
	default 51200 if WIFI
	default 40960 if BT
	default 4096

choice BT_HCI_BUS_TYPE
	default BT_ESP32 if BT
endchoice
```

## boards/xtensa/odroid_go/Kconfig.odroid_go
```kconfig
# SPDX-License-Identifier: Apache-2.0

config BOARD_ODROID_GO
	bool
	default y
	select SOC_ESP32
```

## boards/xtensa/odroid_go/odroid_go_defconfig
```kconfig
# SPDX-License-Identifier: Apache-2.0

CONFIG_XTENSA_RESET_VECTOR=n

CONFIG_BOARD_ODROID_GO=y
CONFIG_SOC_ESP32=y

CONFIG_MAIN_STACK_SIZE=2048

CONFIG_SYS_CLOCK_HW_CYCLES_PER_SEC=240000000

CONFIG_CONSOLE=y
CONFIG_SERIAL=y
CONFIG_UART_CONSOLE=y

CONFIG_XTENSA_USE_CORE_CRT1=n

CONFIG_GPIO=y

CONFIG_GEN_ISR_TABLES=y
CONFIG_GEN_IRQ_VECTOR_TABLE=n

CONFIG_CLOCK_CONTROL=y

# required to enable LCD backlight
CONFIG_REGULATOR=y
```

## boards/xtensa/olimex_esp32_evb/Kconfig.board
```kconfig
# Olimex ESP32-EVB board configuration

# Copyright (c) 2022 Henrik Brix Andersen <henrik@brixandersen.dk>
# SPDX-License-Identifier: Apache-2.0

config BOARD_OLIMEX_ESP32_EVB
	bool "Olimex ESP32-EVB"
	depends on SOC_ESP32
```

## boards/xtensa/olimex_esp32_evb/Kconfig.defconfig
```kconfig
# Olimex ESP32-EVB board configuration

# Copyright (c) 2022 Henrik Brix Andersen <henrik@brixandersen.dk>
# SPDX-License-Identifier: Apache-2.0

if BOARD_OLIMEX_ESP32_EVB

config BOARD
	default "olimex_esp32_evb"

config ENTROPY_GENERATOR
	default y

config HEAP_MEM_POOL_SIZE
	default 98304 if WIFI
	default 40960 if BT
	default 4096

choice BT_HCI_BUS_TYPE
	default BT_ESP32 if BT
endchoice

endif # BOARD_OLIMEX_ESP32_EVB
```

## boards/xtensa/particle_argon_esp32/Kconfig.board
```kconfig
# Kconfig - Particle Argon ESP32 board configuration
#
# Copyright (c) 2018 Matthias Boesl
# SPDX-License-Identifier: Apache-2.0

config BOARD_PARTICLE_ARGON_ESP32
	bool "Particle Argon board ESP32"
	depends on SOC_ESP32
```

## boards/xtensa/particle_argon_esp32/Kconfig.defconfig
```kconfig
# Kconfig - Particle Argon ESP32 board configuration
#
# Copyright (c) 2018 Matthias Boesl
# SPDX-License-Identifier: Apache-2.0

if BOARD_PARTICLE_ARGON_ESP32

config BOARD
	default "aprticle_argon_esp32"

endif # BOARD_PARTICLE_ARGON_ESP32
```

## boards/xtensa/qemu_xtensa/Kconfig.board
```kconfig
# XTENSA board configuration

# Copyright (c) 2017, 2023 Intel Corporation
# SPDX-License-Identifier: Apache-2.0

config BOARD_QEMU_XTENSA
	bool "Xtensa emulation using QEMU"
	depends on SOC_XTENSA_SAMPLE_CONTROLLER
	select QEMU_TARGET

config BOARD_QEMU_XTENSA_MMU
	bool "Xtensa emulation using QEMU with MMU"
	depends on SOC_XTENSA_DC233C
	select QEMU_TARGET
	select XTENSA_MMU
```

## boards/xtensa/qemu_xtensa/Kconfig.defconfig
```kconfig
# Copyright (c) 2017 Intel Corporation
# SPDX-License-Identifier: Apache-2.0

if BOARD_QEMU_XTENSA

config BUILD_OUTPUT_BIN
	default n

config BOARD
	default "qemu_xtensa"

config IPM_CONSOLE_STACK_SIZE
	default 2048 if IPM_CONSOLE_RECEIVER

endif # BOARD_QEMU_XTENSA
```

## boards/xtensa/qemu_xtensa/Kconfig.qemu_xtensa
```kconfig
# Copyright (c) 2022 Zephyr Project members and individual contributors
# SPDX-License-Identifier: Apache-2.0

config BOARD_QEMU_XTENSA
	bool
	default y
	select SOC_XTENSA_SAMPLE_CONTROLLER
	select QEMU_TARGET
```

## boards/xtensa/qemu_xtensa/qemu_xtensa_defconfig
```kconfig
CONFIG_MAIN_STACK_SIZE=2048
CONFIG_IPM_CONSOLE_STACK_SIZE=2048
CONFIG_XTENSA=y
CONFIG_BOARD_QEMU_XTENSA=y
CONFIG_CONSOLE=y
CONFIG_SOC_XTENSA_SAMPLE_CONTROLLER=y
CONFIG_SYS_CLOCK_HW_CYCLES_PER_SEC=10000000
CONFIG_TOOLCHAIN_VARIANT=""
CONFIG_STACK_SENTINEL=y
CONFIG_SW_ISR_TABLE=y
CONFIG_GEN_ISR_TABLES=y
CONFIG_GEN_IRQ_VECTOR_TABLE=n
CONFIG_SIMULATOR_XTENSA=y
```
