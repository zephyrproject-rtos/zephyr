/*
 * Copyright (c) 2020 Intel Corporation
 *
 * SPDX-License-Identifier: Apache-2.0
 */

/dts-v1/;

#include <intel/intel_byt_adsp.dtsi>

/ {
	model = "intel_adsp_baytrail";
	compatible = "intel";

	chosen {
		zephyr,sram = &sram0;
	};
};
