/*
 * Copyright (c) 2022 Qinsong Gou <gouqs@hotmail.com>
 *
 * SPDX-License-Identifier: Apache-2.0
 */
/dts-v1/;

#include "twatch-common.dtsi"

/ {
	model = "twatch_v3";
	compatible = "ttgo,twatch_v3";

	aliases {
		uart-0 = &uart0;
		i2c-0 = &i2c0;
		kscan0 = &ft5336;
	};

	chosen {
		zephyr,sram = &sram0;
		zephyr,console = &uart0;
		zephyr,shell-uart = &uart0;
		zephyr,flash = &flash0;
		zephyr,display = &st7789v;
	};
};
