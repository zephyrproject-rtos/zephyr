/*
 * Copyright (c) 2019 Intel Corporation.
 *
 * SPDX-License-Identifier: Apache-2.0
 */
/dts-v1/;

#include "sample_controller.dtsi"

/ {
	model = "xt-sim";
	compatible = "xtensa,sample_controller";

	chosen {
		zephyr,sram = &sram0;
	};
};

&cpu0 {
	clock-frequency = <10000000>;
};
