/*
 * Copyright (c) 2019 Intel Corporation
 *
 * SPDX-License-Identifier: Apache-2.0
 */

/dts-v1/;

#include <intel/intel_apl_adsp.dtsi>

/ {
	model = "up_squared_adsp";
	compatible = "intel";

	chosen {
		zephyr,sram = &sram0;
		zephyr,console = &ipm_console;
	};
};
