/*
 * Copyright (c) 2020 Intel Corporation
 *
 * SPDX-License-Identifier: Apache-2.0
 */

/dts-v1/;

#include <intel/intel_adsp_cavs20.dtsi>

/ {
	model = "intel_adsp_cavs20";
	compatible = "intel";

	chosen {
		zephyr,sram = &sram0;
		zephyr,console = &mem_window3;
	};
};
