/*
 * Copyright (c) 2020 Intel Corporation
 *
 * SPDX-License-Identifier: Apache-2.0
 */

/dts-v1/;

#include <intel/intel_adsp_cavs20_jsl.dtsi>

/ {
	model = "intel_adsp_cavs20_jsl";
	compatible = "intel";

	chosen {
		zephyr,sram = &sram0;
	};
};
