/*
 * Copyright (c) 2019 Intel Corporation
 *
 * SPDX-License-Identifier: Apache-2.0
 */

/dts-v1/;

#include <intel/intel_cavs15.dtsi>

/ {
	model = "intel_adsp_cavs15";
	compatible = "intel";

	chosen {
		zephyr,sram = &sram0;
		zephyr,console = &ipm_console;
	};
};
