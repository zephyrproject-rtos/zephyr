## boards/xtensa/adafruit_feather_esp32_v2/Kconfig.board
```kconfig
# Adafruit Feather ESP32 V2 board configuration

# Copyright (c) 2023 MIT Media Lab
# SPDX-License-Identifier: Apache-2.0

config BOARD_ADAFRUIT_FEATHER_ESP32_V2
	bool "Adafruit Feather ESP32 V2"
	depends on SOC_SERIES_ESP32

choice SOC_PART_NUMBER
	default SOC_ESP32_PICO_V3_02
endchoice
```

## boards/xtensa/adafruit_feather_esp32_v2/Kconfig.defconfig
```kconfig
# Adafruit Feather ESP32 V2 board configuration

# Copyright (c) 2023 MIT Media Lab
# SPDX-License-Identifier: Apache-2.0

config BOARD
	default "adafruit_feather_esp32_v2"
	depends on BOARD_ADAFRUIT_FEATHER_ESP32_V2

config ENTROPY_GENERATOR
	default y

config HEAP_MEM_POOL_SIZE
	default 98304 if WIFI
	default 40960 if BT
	default 4096

choice BT_HCI_BUS_TYPE
	default BT_ESP32 if BT
endchoice
```

## boards/xtensa/adafruit_feather_esp32_v2/adafruit_feather_esp32_v2_defconfig
```kconfig
# SPDX-License-Identifier: Apache-2.0

CONFIG_BOARD_ADAFRUIT_FEATHER_ESP32_V2=y
CONFIG_SOC_SERIES_ESP32=y

CONFIG_MAIN_STACK_SIZE=2048

CONFIG_CONSOLE=y
CONFIG_SERIAL=y
CONFIG_UART_CONSOLE=y
CONFIG_UART_INTERRUPT_DRIVEN=y

CONFIG_GPIO=y
CONFIG_I2C=y
```

## boards/xtensa/adafruit_feather_esp32s3_n4r2/Kconfig.board
```kconfig
# Copyright (c) 2023 Helmut Lord
# SPDX-License-Identifier: Apache-2.0

# Adafruit Feather ESP32-S3 N4R2 board configuration
config BOARD_ADAFRUIT_FEATHER_ESP32S3_N4R2
	bool "Adafruit Feather ESP32S3 N4R2 Board"
	depends on SOC_SERIES_ESP32S3

choice SOC_PART_NUMBER
	default SOC_ESP32S3_MINI_N4R2
endchoice
```

## boards/xtensa/adafruit_feather_esp32s3_n4r2/Kconfig.defconfig
```kconfig
# Adafruit Feather ESP32-S3 N4R2 board configuration

# Copyright (c) 2023 Helmut Lord
# SPDX-License-Identifier: Apache-2.0

config BOARD
	default "adafruit_feather_esp32s3_n4r2"
	depends on BOARD_ADAFRUIT_FEATHER_ESP32S3_N4R2

config ENTROPY_GENERATOR
	default y

config HEAP_MEM_POOL_SIZE
	default 98304 if WIFI
	default 40960 if BT
	default 4096

choice BT_HCI_BUS_TYPE
	default BT_ESP32 if BT
endchoice
```

## boards/xtensa/adafruit_feather_esp32s3_n4r2/adafruit_feather_esp32s3_n4r2_defconfig
```kconfig
# SPDX-License-Identifier: Apache-2.0

CONFIG_BOARD_ADAFRUIT_FEATHER_ESP32S3_N4R2=y
CONFIG_SOC_SERIES_ESP32S3=y

CONFIG_MAIN_STACK_SIZE=2048

CONFIG_CONSOLE=y
CONFIG_SERIAL=y
CONFIG_UART_CONSOLE=y
CONFIG_GPIO=y
CONFIG_CLOCK_CONTROL=y

CONFIG_LED_STRIP=y
CONFIG_WS2812_STRIP=y
CONFIG_WS2812_STRIP_SPI=y

CONFIG_I2C=y
CONFIG_MAX17048=y
CONFIG_FUEL_GAUGE=y
```

## boards/xtensa/esp32/Kconfig
```kconfig
config ESP32_FLASH_CACHE
	   bool
	   prompt "ESP32 flash cache"
	   default n
	   depends on BOOTLOADER_ESP_IDF
	   help
		This option enables flash cache.
```

## boards/xtensa/esp32/Kconfig.board
```kconfig
# ESP32 board configuration

# Copyright (c) 2017 Intel Corporation
# SPDX-License-Identifier: Apache-2.0

config BOARD_ESP32
	bool "ESP32 Development Board"
	depends on SOC_ESP32
```

## boards/xtensa/esp32/Kconfig.defconfig
```kconfig
# ESP32 board configuration

# Copyright (c) 2017 Intel Corporation
# SPDX-License-Identifier: Apache-2.0

config BOARD
	default "esp32"
	depends on BOARD_ESP32

config ENTROPY_GENERATOR
	default y

config HEAP_MEM_POOL_SIZE
	default 98304 if WIFI
	default 40960 if BT
	default 4096

choice BT_HCI_BUS_TYPE
	default BT_ESP32 if BT
endchoice
```

## boards/xtensa/esp32/Kconfig.esp32
```kconfig
# Copyright (c) 2022 Zephyr Project members and individual contributors
# SPDX-License-Identifier: Apache-2.0

config BOARD_ESP32
	bool
	default y
	select SOC_ESP32
```

## boards/xtensa/esp32/esp32_defconfig
```kconfig
# SPDX-License-Identifier: Apache-2.0

CONFIG_XTENSA_RESET_VECTOR=n

CONFIG_BOARD_ESP32=y
CONFIG_SOC_ESP32=y

CONFIG_MAIN_STACK_SIZE=2048

CONFIG_SYS_CLOCK_HW_CYCLES_PER_SEC=240000000

CONFIG_CONSOLE=y
CONFIG_SERIAL=y
CONFIG_UART_CONSOLE=y
CONFIG_UART_ESP32=y

CONFIG_XTENSA_USE_CORE_CRT1=n

CONFIG_PINMUX=y
CONFIG_PINMUX_ESP32=y

CONFIG_GPIO=y
CONFIG_GPIO_ESP32=y

CONFIG_GEN_ISR_TABLES=y
CONFIG_GEN_IRQ_VECTOR_TABLE=n

CONFIG_I2C=y
CONFIG_I2C_ESP32=y
CONFIG_I2C_0=y
CONFIG_I2C_1=y
CONFIG_I2C_2=n
CONFIG_I2C_3=n
CONFIG_CLOCK_CONTROL=y
```

## boards/xtensa/esp32_devkitc_wroom/Kconfig.board
```kconfig
# Copyright (c) 2023 Espressif Systems (Shanghai) Co., Ltd.
# SPDX-License-Identifier: Apache-2.0

config BOARD_ESP32_DEVKITC_WROOM
	bool "ESP32-DEVKITC-WROOM Development Board"
	depends on SOC_SERIES_ESP32

choice SOC_PART_NUMBER
	default SOC_ESP32_WROOM_32UE_N4
endchoice
```

## boards/xtensa/esp32_devkitc_wroom/Kconfig.defconfig
```kconfig
# ESP32 board configuration

# Copyright (c) 2017 Intel Corporation
# SPDX-License-Identifier: Apache-2.0

if BOARD_ESP32_DEVKITC_WROOM

config BOARD
	default "esp32_devkitc_wroom"

config HEAP_MEM_POOL_ADD_SIZE_BOARD
	int
	default 65535 if WIFI && BT
	default 51200 if WIFI
	default 40960 if BT
	default 4096

choice BT_HCI_BUS_TYPE
	default BT_ESP32 if BT
endchoice

endif # BOARD_ESP32_DEVKITC_WROOM

if BOARD_ESP32_DEVKITC_WROOM_APPCPU

config BOARD
	default "esp32_devkitc_wroom_appcpu"

config HEAP_MEM_POOL_ADD_SIZE_BOARD
	default 4096

config KERNEL_BIN_NAME
	default "esp32_appcpu_firmware"

endif # BOARD_ESP32_DEVKITC_WROOM_APPCPU

config ENTROPY_GENERATOR
	default y
```

## boards/xtensa/esp32_devkitc_wrover/Kconfig.board
```kconfig
# Copyright (c) 2023 Espressif Systems (Shanghai) Co., Ltd.
# SPDX-License-Identifier: Apache-2.0

config BOARD_ESP32_DEVKITC_WROVER
	bool "ESP32-DEVKITC-WROVER-E Development board"
	depends on SOC_SERIES_ESP32

choice SOC_PART_NUMBER
	default SOC_ESP32_WROVER_E_N4R8
endchoice
```

## boards/xtensa/esp32_devkitc_wrover/Kconfig.defconfig
```kconfig
# Copyright (c) 2023 Espressif Systems (Shanghai) Co., Ltd.
# SPDX-License-Identifier: Apache-2.0

config BOARD
	default "esp32_devkitc_wrover"
	depends on BOARD_ESP32_DEVKITC_WROVER

config ENTROPY_GENERATOR
	default y

config HEAP_MEM_POOL_SIZE
	default 98304 if WIFI
	default 40960 if BT
	default 4096

choice BT_HCI_BUS_TYPE
	default BT_ESP32 if BT
endchoice
```

## boards/xtensa/esp32_devkitc_wrover/esp32_devkitc_wrover_appcpu_defconfig
```kconfig
# SPDX-License-Identifier: Apache-2.0

CONFIG_SOC_SERIES_ESP32=y
CONFIG_SOC_ESP32_APPCPU=y
CONFIG_BOARD_ESP32_DEVKITC_WROVER_APPCPU=y

CONFIG_MAIN_STACK_SIZE=2048
CONFIG_CLOCK_CONTROL=y
CONFIG_MINIMAL_LIBC=y
```

## boards/xtensa/esp32_ethernet_kit/Kconfig.board
```kconfig
# ESP32-ETHERNET-KIT board configuration

# Copyright (c) 2022 Grant Ramsay <grant.ramsay@hotmail.com>
# SPDX-License-Identifier: Apache-2.0

config BOARD_ESP32_ETHERNET_KIT
	bool "ESP32-ETHERNET-KIT Development Board"
	depends on SOC_ESP32
```

## boards/xtensa/esp32_ethernet_kit/Kconfig.defconfig
```kconfig
# ESP32-ETHERNET-KIT board configuration

# Copyright (c) 2022 Grant Ramsay <grant.ramsay@hotmail.com>
# SPDX-License-Identifier: Apache-2.0

config BOARD
	default "esp32_ethernet_kit"
	depends on BOARD_ESP32_ETHERNET_KIT

config ESP_SPIRAM
	default y

choice SPIRAM_TYPE
	default SPIRAM_TYPE_ESPPSRAM64
endchoice

config ENTROPY_GENERATOR
	default y

config HEAP_MEM_POOL_SIZE
	default 98304 if WIFI
	default 40960 if BT
	default 4096

choice BT_HCI_BUS_TYPE
	default BT_ESP32 if BT
endchoice
```

## boards/xtensa/esp32_net/Kconfig.board
```kconfig
# ESP32 board configuration

# Copyright (c) 2022 Espressif Systems (Shanghai) Co., Ltd.
# SPDX-License-Identifier: Apache-2.0

config BOARD_ESP32_NET
	bool "ESP32 Board configuration for APP_CPU"
	depends on SOC_SERIES_ESP32_NET

choice SOC_PART_NUMBER
	default SOC_ESP32_NET
endchoice
```

## boards/xtensa/esp32_net/Kconfig.defconfig
```kconfig
# ESP32_NET board configuration

# Copyright (c) 2022 Espressif Systems (Shanghai) Co., Ltd.
# SPDX-License-Identifier: Apache-2.0

config BOARD
	default "esp32_net"
	depends on BOARD_ESP32_NET

config ENTROPY_GENERATOR
	default y

config HEAP_MEM_POOL_SIZE
	default 98304 if WIFI
	default 40960 if BT
	default 4096

choice BT_HCI_BUS_TYPE
	default BT_ESP32 if BT
endchoice
```

## boards/xtensa/esp32_net/Kconfig.esp32_net
```kconfig
# Copyright (c) 2022 Zephyr Project members and individual contributors
# SPDX-License-Identifier: Apache-2.0

config BOARD_ESP32_NET
	bool
	default y
	select SOC_ESP32_NET
```

## boards/xtensa/esp32_net/esp32_net_defconfig
```kconfig
# SPDX-License-Identifier: Apache-2.0

CONFIG_BOARD_ESP32_NET=y
CONFIG_SOC_SERIES_ESP32_NET=y

CONFIG_MAIN_STACK_SIZE=2048

CONFIG_CONSOLE=n
CONFIG_SERIAL=n
CONFIG_UART_CONSOLE=n

CONFIG_GPIO=n
CONFIG_GPIO_ESP32=n

CONFIG_I2C=n
```

## boards/xtensa/esp32s2/Kconfig.board
```kconfig
# ESP32 board configuration

# Copyright (c) 2020 Intel Corporation
# SPDX-License-Identifier: Apache-2.0

config BOARD_ESP32S2
	bool "ESP32S2 Development Board"
	depends on SOC_ESP32S2
```

## boards/xtensa/esp32s2/Kconfig.defconfig
```kconfig
# ESP32 board configuration

# Copyright (c) 2020 Intel Corporation
# SPDX-License-Identifier: Apache-2.0

config BOARD
	default "esp32s2"
	depends on BOARD_ESP32S2

config ENTROPY_ESP32_RNG
	default y if ENTROPY_GENERATOR
```

## boards/xtensa/esp32s2_devkitc/Kconfig.board
```kconfig
# Copyright (c) 2023 Espressif Systems (Shanghai) Co., Ltd.
# SPDX-License-Identifier: Apache-2.0

config BOARD_ESP32S2_DEVKITC
	bool "ESP32S2 DevKitC Board"
	depends on SOC_SERIES_ESP32S2

choice SOC_PART_NUMBER
	default SOC_ESP32S2_SOLO_N4R2
endchoice
```
