## boards/xtensa/intel_adsp_ace15_mtpm/Kconfig.board
```kconfig
# Xtensa board configuration

# Copyright (c) 2022 Intel Corporation
# SPDX-License-Identifier: Apache-2.0

config  BOARD_INTEL_ADSP_ACE15_MTPM
	bool "Intel ADSP ACE 1.5 Meteor PCH M"
	depends on SOC_SERIES_INTEL_ACE1X
```

## boards/xtensa/intel_adsp_ace15_mtpm/Kconfig.defconfig
```kconfig
# Copyright (c) 2022 Intel Corporation
#
# SPDX-License-Identifier: Apache-2.0

if BOARD_INTEL_ADSP_ACE15_MTPM

config BOARD
	default "intel_adsp_ace15_mtpm"

if DAI_INTEL_SSP

config DAI_SSP_HAS_POWER_CONTROL
	def_bool y

endif

endif # BOARD_INTEL_ADSP_ACE15_MTPM
```

## boards/xtensa/intel_adsp_ace15_mtpm/Kconfig.intel_adsp_ace15_mtpm
```kconfig
# Copyright (c) 2022 Zephyr Project members and individual contributors
# SPDX-License-Identifier: Apache-2.0

config BOARD_INTEL_ADSP_ACE15_MTPM
	bool
	default y
	select SOC_SERIES_INTEL_ACE
	select SOC_INTEL_ACE15_MTPM
```

## boards/xtensa/intel_adsp_ace15_mtpm/intel_adsp_ace15_mtpm_defconfig
```kconfig
# SPDX-License-Identifier: Apache-2.0

CONFIG_MAIN_STACK_SIZE=2048

CONFIG_SOC_SERIES_INTEL_ACE=y
CONFIG_SOC_INTEL_ACE15_MTPM=y
CONFIG_BOARD_INTEL_ADSP_ACE15_MTPM=y

CONFIG_GEN_ISR_TABLES=y
CONFIG_GEN_IRQ_VECTOR_TABLE=n

CONFIG_BUILD_OUTPUT_BIN=n
CONFIG_MM_DRV=y
```

## boards/xtensa/intel_adsp_ace20_lnl/Kconfig.board
```kconfig
# Xtensa board configuration

# Copyright (c) 2022 Intel Corporation
# SPDX-License-Identifier: Apache-2.0

config  BOARD_INTEL_ADSP_ACE20_LNL
	bool "Intel ADSP ACE 2.0 Lunar Lake PCH"
	depends on SOC_SERIES_INTEL_ACE
```

## boards/xtensa/intel_adsp_ace20_lnl/Kconfig.defconfig
```kconfig
# Copyright (c) 2022 Intel Corporation
#
# SPDX-License-Identifier: Apache-2.0

if BOARD_INTEL_ADSP_ACE20_LNL

config BOARD
	default "intel_adsp_ace20_lnl"

endif # BOARD_INTEL_ADSP_ACE20_LNL
```

## boards/xtensa/intel_adsp_ace20_lnl/intel_adsp_ace20_lnl_defconfig
```kconfig
# SPDX-License-Identifier: Apache-2.0


CONFIG_SOC_SERIES_INTEL_ACE=y
CONFIG_SOC_INTEL_ACE20_LNL=y
CONFIG_BOARD_INTEL_ADSP_ACE20_LNL=y

CONFIG_GEN_ISR_TABLES=y
CONFIG_GEN_IRQ_VECTOR_TABLE=n

CONFIG_BUILD_OUTPUT_BIN=n
CONFIG_MM_DRV=y
CONFIG_MM_DRV_INTEL_ADSP_MTL_TLB=y

CONFIG_DCACHE_LINE_SIZE=64
```

## boards/xtensa/intel_adsp_baytrail/Kconfig.board
```kconfig
# Xtensa board configuration

# Copyright (c) 2020 Intel Corporation
# SPDX-License-Identifier: Apache-2.0

config  BOARD_INTEL_ADSP_BAYTRAIL
	bool "Intel ADSP BAYTRAIL"
	depends on SOC_SERIES_INTEL_ADSP_BAYTRAIL
```

## boards/xtensa/intel_adsp_baytrail/Kconfig.defconfig
```kconfig
# Copyright (c) 2020 Intel Corporation
#
# SPDX-License-Identifier: Apache-2.0

if BOARD_INTEL_ADSP_BAYTRAIL

config BOARD
	default "intel_adsp_baytrail"

config CAVS_ICTL_0_OFFSET
	default 6
config CAVS_ICTL_1_OFFSET
	default 10
config CAVS_ICTL_2_OFFSET
	default 13
config CAVS_ICTL_3_OFFSET
	default 16

config MAX_IRQ_PER_AGGREGATOR
	default 32

config DMA_DW
	default y
	depends on DMA

config I2S_CAVS
	default y
	depends on I2S

endif # BOARD_INTEL_ADSP_BAYTRAIL
```

## boards/xtensa/intel_adsp_broadwell/Kconfig.board
```kconfig
# Xtensa board configuration

# Copyright (c) 2020 Intel Corporation
# SPDX-License-Identifier: Apache-2.0

config  BOARD_INTEL_ADSP_BROADWELL
	bool "Intel ADSP BROADWELL"
	depends on SOC_SERIES_INTEL_ADSP_BROADWELL
```

## boards/xtensa/intel_adsp_broadwell/Kconfig.defconfig
```kconfig
# Copyright (c) 2020 Intel Corporation
#
# SPDX-License-Identifier: Apache-2.0

if BOARD_INTEL_ADSP_BROADWELL

config BOARD
	default "intel_adsp_broadwell"

config CAVS_ICTL_0_OFFSET
	default 6
config CAVS_ICTL_1_OFFSET
	default 10
config CAVS_ICTL_2_OFFSET
	default 13
config CAVS_ICTL_3_OFFSET
	default 16

config MAX_IRQ_PER_AGGREGATOR
	default 32

config DMA_DW
	default y
	depends on DMA

config I2S_CAVS
	default y
	depends on I2S

endif # BOARD_INTEL_ADSP_BROADWELL
```

## boards/xtensa/intel_adsp_broadwell/intel_adsp_broadwell_defconfig
```kconfig
# SPDX-License-Identifier: Apache-2.0

CONFIG_MAIN_STACK_SIZE=2048

CONFIG_SOC_SERIES_INTEL_ADSP_BROADWELL=y
CONFIG_BOARD_INTEL_ADSP_BROADWELL=y

CONFIG_GEN_ISR_TABLES=y
CONFIG_GEN_IRQ_VECTOR_TABLE=n

CONFIG_XTENSA_RESET_VECTOR=y

CONFIG_XTENSA_USE_CORE_CRT1=y

CONFIG_SOF=y
```

## boards/xtensa/intel_adsp_cavs15/Kconfig.board
```kconfig
# Xtensa board configuration

# Copyright (c) 2019 Intel Corporation
# SPDX-License-Identifier: Apache-2.0

config  BOARD_INTEL_ADSP_CAVS15
	bool "Intel ADSP CAVS 1.5"
	depends on SOC_SERIES_INTEL_ADSP_CAVS
```

## boards/xtensa/intel_adsp_cavs15/Kconfig.defconfig
```kconfig
# Copyright (c) 2019 Intel Corporation
#
# SPDX-License-Identifier: Apache-2.0

if BOARD_INTEL_ADSP_CAVS15

config BOARD
	default "intel_adsp_cavs15"

config CAVS_ICTL_0_OFFSET
	default 6
config CAVS_ICTL_1_OFFSET
	default 10
config CAVS_ICTL_2_OFFSET
	default 13
config CAVS_ICTL_3_OFFSET
	default 16

config 2ND_LVL_INTR_00_OFFSET
	default CAVS_ICTL_0_OFFSET
config 2ND_LVL_INTR_01_OFFSET
	default CAVS_ICTL_1_OFFSET
config 2ND_LVL_INTR_02_OFFSET
	default CAVS_ICTL_2_OFFSET
config 2ND_LVL_INTR_03_OFFSET
	default CAVS_ICTL_3_OFFSET

config MAX_IRQ_PER_AGGREGATOR
	default 32
config NUM_2ND_LEVEL_AGGREGATORS
	default 4
config 2ND_LVL_ISR_TBL_OFFSET
	default 21

config CAVS_ISR_TBL_OFFSET
	default 2ND_LVL_ISR_TBL_OFFSET

config DMA_DW
	default y
	depends on DMA

config I2S_CAVS
	default y
	depends on I2S

endif # BOARD_INTEL_ADSP_CAVS15
```

## boards/xtensa/intel_adsp_cavs15/Kconfig.intel_adsp_cavs15
```kconfig
# Copyright (c) 2022 Zephyr Project members and individual contributors
# SPDX-License-Identifier: Apache-2.0

config BOARD_INTEL_ADSP_CAVS15
	bool
	default y
	select SOC_INTEL_CAVS_V15
	select SOC_SERIES_INTEL_ADSP_CAVS
```

## boards/xtensa/intel_adsp_cavs15/intel_adsp_cavs15_defconfig
```kconfig
# SPDX-License-Identifier: Apache-2.0

CONFIG_MAIN_STACK_SIZE=2048

CONFIG_SOC_SERIES_INTEL_CAVS_V15=y
CONFIG_BOARD_INTEL_ADSP_CAVS15=y

CONFIG_GEN_ISR_TABLES=y
CONFIG_GEN_IRQ_VECTOR_TABLE=n

CONFIG_XTENSA_RESET_VECTOR=y

CONFIG_XTENSA_USE_CORE_CRT1=y

CONFIG_MULTI_LEVEL_INTERRUPTS=y
CONFIG_2ND_LEVEL_INTERRUPTS=y
CONFIG_CAVS_ICTL=y

CONFIG_BOOTLOADER_SRAM_SIZE=192
CONFIG_BUILD_OUTPUT_BIN=n
CONFIG_CLEANUP_INTERMEDIATE_FILES=y
```

## boards/xtensa/intel_adsp_cavs18/Kconfig.board
```kconfig
# Xtensa board configuration

# Copyright (c) 2020 Intel Corporation
# SPDX-License-Identifier: Apache-2.0

config  BOARD_INTEL_ADSP_CAVS18
	bool "Intel ADSP CAVS 1.8"
	depends on SOC_SERIES_INTEL_CAVS_V18
```

## boards/xtensa/intel_adsp_cavs18/Kconfig.defconfig
```kconfig
# Copyright (c) 2020 Intel Corporation
#
# SPDX-License-Identifier: Apache-2.0

if BOARD_INTEL_ADSP_CAVS18

config BOARD
	default "intel_adsp_cavs18"

config CAVS_ICTL_0_OFFSET
	default 6
config CAVS_ICTL_1_OFFSET
	default 10
config CAVS_ICTL_2_OFFSET
	default 13
config CAVS_ICTL_3_OFFSET
	default 16

config 2ND_LVL_INTR_00_OFFSET
	default CAVS_ICTL_0_OFFSET
config 2ND_LVL_INTR_01_OFFSET
	default CAVS_ICTL_1_OFFSET
config 2ND_LVL_INTR_02_OFFSET
	default CAVS_ICTL_2_OFFSET
config 2ND_LVL_INTR_03_OFFSET
	default CAVS_ICTL_3_OFFSET

config MAX_IRQ_PER_AGGREGATOR
	default 32
config NUM_2ND_LEVEL_AGGREGATORS
	default 4
config 2ND_LVL_ISR_TBL_OFFSET
	default 21

config CAVS_ISR_TBL_OFFSET
	default 2ND_LVL_ISR_TBL_OFFSET

endif # BOARD_INTEL_ADSP_CAVS18
```

## boards/xtensa/intel_adsp_cavs20/Kconfig.board
```kconfig
# Xtensa board configuration

# Copyright (c) 2020,2022 Intel Corporation
# SPDX-License-Identifier: Apache-2.0

config  BOARD_INTEL_ADSP_CAVS20
	bool "Intel ADSP CAVS 2.0 for Ice Lake"
	depends on SOC_SERIES_INTEL_CAVS_V20

config  BOARD_INTEL_ADSP_CAVS20_JSL
	bool "Intel ADSP CAVS 2.0 for Jasper Lake"
	depends on SOC_SERIES_INTEL_CAVS_V20
```

## boards/xtensa/intel_adsp_cavs20/Kconfig.intel_adsp_cavs20
```kconfig
# SPDX-License-Identifier: Apache-2.0

config BOARD_INTEL_ADSP_CAVS20
	bool
	default y
	select SOC_INTEL_CAVS_V20
	select SOC_SERIES_INTEL_ADSP_CAVS
```

## boards/xtensa/intel_adsp_cavs20/Kconfig.intel_adsp_cavs20_jsl
```kconfig
# Copyright (c) 2022 Zephyr Project members and individual contributors
# SPDX-License-Identifier: Apache-2.0

config BOARD_INTEL_ADSP_CAVS20_JSL
	bool
	default y
	select SOC_INTEL_CAVS_V20
	select SOC_SERIES_INTEL_ADSP_CAVS
```

## boards/xtensa/intel_adsp_cavs25/Kconfig.board
```kconfig
# Xtensa board configuration

# Copyright (c) 2020 Intel Corporation
# SPDX-License-Identifier: Apache-2.0

config  BOARD_INTEL_ADSP_CAVS25
	bool "Intel ADSP CAVS 2.5"
	depends on SOC_SERIES_INTEL_CAVS_V25

config  BOARD_INTEL_ADSP_CAVS25_TGPH
	bool "Intel ADSP CAVS 2.5 for Tiger Lake H PCH"
	depends on SOC_SERIES_INTEL_CAVS_V25
```

## boards/xtensa/intel_adsp_cavs25/Kconfig.defconfig
```kconfig
# Copyright (c) 2020 Intel Corporation
#
# SPDX-License-Identifier: Apache-2.0

if BOARD_INTEL_ADSP_CAVS25

config BOARD
	default "intel_adsp_cavs25"

endif # BOARD_INTEL_ADSP_CAVS25
```

## boards/xtensa/intel_adsp_cavs25/Kconfig.intel_adsp_cavs25
```kconfig
# Copyright (c) 2022 Zephyr Project members and individual contributors
# SPDX-License-Identifier: Apache-2.0

config BOARD_INTEL_ADSP_CAVS25
	bool
	default y
	select SOC_SERIES_INTEL_ADSP_CAVS
	select SOC_INTEL_CAVS_V25
```

## boards/xtensa/intel_adsp_cavs25/Kconfig.intel_adsp_cavs25_tgph
```kconfig
# Copyright (c) 2022 Zephyr Project members and individual contributors
# SPDX-License-Identifier: Apache-2.0

config BOARD_INTEL_ADSP_CAVS25_TGPH
	bool
	default y
	select SOC_INTEL_CAVS_V25
	select SOC_SERIES_INTEL_ADSP_CAVS
```
