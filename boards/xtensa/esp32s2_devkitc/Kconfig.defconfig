## boards/xtensa/esp32s2_devkitc/Kconfig.defconfig
```kconfig
# ESP32S2 DevKitC board configuration

# Copyright (c) 2023 Espressif Systems (Shanghai) Co., Ltd.
# SPDX-License-Identifier: Apache-2.0

config BOARD
	default "esp32s2_devkitc"
	depends on BOARD_ESP32S2_DEVKITC

config ENTROPY_GENERATOR
	default y

config HEAP_MEM_POOL_SIZE
	default 32768 if WIFI
	default 4096
```

## boards/xtensa/esp32s2_franzininho/Kconfig.board
```kconfig
# ESP32S2 Franzininho board configuration

# Copyright (c) 2022 Felipe Neves
# SPDX-License-Identifier: Apache-2.0

config BOARD_ESP32S2_FRANZININHO
	bool "ESP32S2 Franzininho Board"
	depends on SOC_ESP32S2
```

## boards/xtensa/esp32s2_franzininho/Kconfig.defconfig
```kconfig
# ESP32S2 Franzininho board configuration

# Copyright (c) 2022 Felipe Neves
# SPDX-License-Identifier: Apache-2.0

config BOARD
	default "esp32s2_franzininho"
	depends on BOARD_ESP32S2_FRANZININHO

config ENTROPY_GENERATOR
	default y

config HEAP_MEM_POOL_SIZE
	default 98304 if WIFI
	default 4096
```

## boards/xtensa/esp32s2_lolin_mini/Kconfig.defconfig
```kconfig
# ESP32S2 LOLIN S2 MINI board configuration

# Copyright (c) 2023 Google, LLC
# SPDX-License-Identifier: Apache-2.0

config BOARD
	default "esp32s2_lolin_mini"
	depends on BOARD_ESP32S2_LOLIN_MINI

config ENTROPY_GENERATOR
	default y

config HEAP_MEM_POOL_SIZE
	default 32768 if WIFI
	default 4096
```

## boards/xtensa/esp32s2_saola/Kconfig.board
```kconfig
# ESP32S2 saola board configuration

# Copyright (c) 2021 Espressif Systems (Shanghai) Co., Ltd.
# SPDX-License-Identifier: Apache-2.0

config BOARD_ESP32S2_SAOLA
	bool "ESP32S2 Saola Board"
	depends on SOC_ESP32S2
```

## boards/xtensa/esp32s2_saola/Kconfig.defconfig
```kconfig
# ESP32S2 Saola board configuration

# Copyright (c) 2021 Espressif Systems (Shanghai) Co., Ltd.
# SPDX-License-Identifier: Apache-2.0

config BOARD
	default "esp32s2_saola"
	depends on BOARD_ESP32S2_SAOLA

config ENTROPY_GENERATOR
	default y

config HEAP_MEM_POOL_SIZE
	default 98304 if WIFI
	default 16384 if BT
	default 4096

choice BT_HCI_BUS_TYPE
	default BT_ESP32 if BT
endchoice
```

## boards/xtensa/esp32s2_saola/Kconfig.esp32s2_saola
```kconfig
# SPDX-License-Identifier: Apache-2.0

config BOARD_ESP32S2_SAOLA
	bool
	default y
	select SOC_ESP32S2
```

## boards/xtensa/esp32s2_saola/esp32s2_saola_defconfig
```kconfig
# SPDX-License-Identifier: Apache-2.0

CONFIG_XTENSA_RESET_VECTOR=n

CONFIG_BOARD_ESP32S2_SAOLA=y
CONFIG_SOC_ESP32S2=y
CONFIG_MAIN_STACK_SIZE=2048

CONFIG_CONSOLE=y
CONFIG_SERIAL=y
CONFIG_UART_CONSOLE=y

CONFIG_XTENSA_USE_CORE_CRT1=n

CONFIG_GPIO=y

CONFIG_GEN_ISR_TABLES=y
CONFIG_GEN_IRQ_VECTOR_TABLE=n

CONFIG_CLOCK_CONTROL=y

CONFIG_BOOTLOADER_ESP_IDF=y
```

## boards/xtensa/esp32s3_devkitc/Kconfig.board
```kconfig
# Copyright (c) 2023 Espressif Systems (Shanghai) Co., Ltd.
# SPDX-License-Identifier: Apache-2.0

# ESP32S3 DevKitC board configuration
config BOARD_ESP32S3_DEVKITC
	bool "ESP32S3 DevKitC Board"
	depends on SOC_SERIES_ESP32S3

config BOARD_ESP32S3_DEVKITM_APPCPU
	bool "ESP32S3 Board configuration for APPCPU (core 1)."
	depends on SOC_SERIES_ESP32S3 && SOC_ESP32S3_APPCPU

choice SOC_PART_NUMBER
	default SOC_ESP32S3_WROOM_N8R8
endchoice
```

## boards/xtensa/esp32s3_devkitc/Kconfig.defconfig
```kconfig
# ESP32S3 DevKitC board configuration

# Copyright (c) 2023 Espressif Systems (Shanghai) Co., Ltd.
# SPDX-License-Identifier: Apache-2.0

config BOARD
	default "esp32s3_devkitc"
	depends on BOARD_ESP32S3_DEVKITC

config ENTROPY_GENERATOR
	default y

config HEAP_MEM_POOL_SIZE
	default 98304 if WIFI
	default 40960 if BT
	default 4096

choice BT_HCI_BUS_TYPE
	default BT_ESP32 if BT
endchoice
```

## boards/xtensa/esp32s3_devkitm/Kconfig.board
```kconfig
# Copyright (c) 2022 Espressif Systems (Shanghai) Co., Ltd.
# SPDX-License-Identifier: Apache-2.0

# ESP32S3 DevKitM board configuration
config BOARD_ESP32S3_DEVKITM
	bool "ESP32S3 DevKitM Board"
	depends on SOC_SERIES_ESP32S3

config BOARD_ESP32S3_DEVKITM_APPCPU
	bool "ESP32S3 Board configuration for APPCPU (core 1)."
	depends on SOC_SERIES_ESP32S3 && SOC_ESP32S3_APPCPU

choice SOC_PART_NUMBER
	default SOC_ESP32S3_MINI_N8
endchoice
```

## boards/xtensa/esp32s3_devkitm/Kconfig.defconfig
```kconfig
# ESP32S3 DevKitM board configuration

# Copyright (c) 2022 Espressif Systems (Shanghai) Co., Ltd.
# SPDX-License-Identifier: Apache-2.0

if BOARD_ESP32S3_DEVKITM

config BOARD
	default "esp32s3_devkitm"

config HEAP_MEM_POOL_SIZE
	default 98304 if WIFI
	default 40960 if BT
	default 4096

choice BT_HCI_BUS_TYPE
	default BT_ESP32 if BT
endchoice

endif

if BOARD_ESP32S3_DEVKITM_APPCPU

config BOARD
	default "esp32s3_devkitm_appcpu"

config HEAP_MEM_POOL_SIZE
	default 4096

config KERNEL_BIN_NAME
	default "esp32_net_firmware"
endif

config ENTROPY_GENERATOR
	default y
```

## boards/xtensa/esp32s3_devkitm/esp32s3_devkitm_appcpu_defconfig
```kconfig
# SPDX-License-Identifier: Apache-2.0

CONFIG_SOC_SERIES_ESP32S3=y
CONFIG_SOC_ESP32S3_APPCPU=y
CONFIG_BOARD_ESP32S3_DEVKITM_APPCPU=y

CONFIG_MAIN_STACK_SIZE=2048
CONFIG_CLOCK_CONTROL=y
CONFIG_MINIMAL_LIBC=y
```

## boards/xtensa/esp32s3_devkitm/esp32s3_devkitm_defconfig
```kconfig
# SPDX-License-Identifier: Apache-2.0

CONFIG_XTENSA_RESET_VECTOR=n
CONFIG_BOARD_ESP32S3_DEVKITM=y
CONFIG_SOC_ESP32S3=y
CONFIG_MAIN_STACK_SIZE=2048
CONFIG_CONSOLE=y
CONFIG_SERIAL=y
CONFIG_UART_CONSOLE=y
CONFIG_XTENSA_USE_CORE_CRT1=n
CONFIG_GPIO=y
CONFIG_GEN_ISR_TABLES=y
CONFIG_GEN_IRQ_VECTOR_TABLE=n
CONFIG_CLOCK_CONTROL=y
```

## boards/xtensa/esp32s3_luatos_core/Kconfig.board
```kconfig
# Copyright (c) 2023 YuLong Yao <feilongphone@gmail.com>
# SPDX-License-Identifier: Apache-2.0

# ESP32S3 Core board configuration
config BOARD_ESP32S3_LUATOS_CORE
	bool "ESP32S3 LuatOS Core Board with ch343 enabled"
	depends on SOC_SERIES_ESP32S3

config BOARD_ESP32S3_LUATOS_CORE_USB
	bool "ESP32S3 LuatOS Core Board with ch343 disabled"
	depends on SOC_SERIES_ESP32S3

choice SOC_PART_NUMBER
	default SOC_ESP32S3_MINI_N8
endchoice
```

## boards/xtensa/esp32s_nodemcu/Kconfig.board
```kconfig
# ESP32S NodeMCU board configuration

# Copyright (c) 2022 Niklas Salminen <xcb3djok@gmail.com>
# SPDX-License-Identifier: Apache-2.0

config BOARD_ESP32S_NODEMCU
	bool "ESP32S NodeMCU Development Board"
	depends on SOC_ESP32
```

## boards/xtensa/esp32s_nodemcu/Kconfig.defconfig
```kconfig
# ESP32S NodeMCU board configuration

# Copyright (c) 2022 Niklas Salminen <xcb3djok@gmail.com>
# SPDX-License-Identifier: Apache-2.0

config BOARD
	default "esp32s_nodemcu"
	depends on BOARD_ESP32S_NODEMCU

config ENTROPY_ESP32_RNG
	default y if ENTROPY_GENERATOR

if BT

config HEAP_MEM_POOL_SIZE
	default 16384

config ENTROPY_GENERATOR
	default y

choice BT_HCI_BUS_TYPE
	default BT_ESP32
endchoice

endif # BT
```

## boards/xtensa/esp_wrover_kit/Kconfig.board
```kconfig
# ESP-WROVER-KIT board configuration

# Copyright (c) 2021 Espressif Systems (Shanghai) Co., Ltd.
# SPDX-License-Identifier: Apache-2.0

config BOARD_ESP_WROVER_KIT
	bool "ESP-WROVER-KIT Development Board"
	depends on SOC_ESP32
```

## boards/xtensa/esp_wrover_kit/Kconfig.defconfig
```kconfig
# ESP-WROVER-KIT board configuration

# Copyright (c) 2021 Espressif Systems (Shanghai) Co., Ltd.
# SPDX-License-Identifier: Apache-2.0

config BOARD
	default "esp_wrover_kit"
	depends on BOARD_ESP_WROVER_KIT

if BT

config HEAP_MEM_POOL_SIZE
	default 16384

config ENTROPY_GENERATOR
	default y

choice BT_HCI_BUS_TYPE
	default BT_ESP32
endchoice

endif # BT

config DISK_DRIVER_SDMMC
	default y
```

## boards/xtensa/esp_wrover_kit/Kconfig.esp_wrover_kit
```kconfig
# SPDX-License-Identifier: Apache-2.0

config BOARD_ESP_WROVER_KIT
	bool
	default y
	select SOC_ESP32
```

## boards/xtensa/esp_wrover_kit/esp_wrover_kit_defconfig
```kconfig
# SPDX-License-Identifier: Apache-2.0

CONFIG_XTENSA_RESET_VECTOR=n

CONFIG_BOARD_ESP_WROVER_KIT=y
CONFIG_SOC_ESP32=y

CONFIG_MAIN_STACK_SIZE=2048

CONFIG_SYS_CLOCK_HW_CYCLES_PER_SEC=240000000

CONFIG_CONSOLE=y
CONFIG_SERIAL=y
CONFIG_UART_CONSOLE=y

CONFIG_XTENSA_USE_CORE_CRT1=n

CONFIG_GPIO=y

CONFIG_GEN_ISR_TABLES=y
CONFIG_GEN_IRQ_VECTOR_TABLE=n

CONFIG_CLOCK_CONTROL=y
```

## boards/xtensa/heltec_wifi_lora32_v2/Kconfig.board
```kconfig
# HELTEC ESP32 board configuration

# Copyright (c) 2021 Instituto de Pesquisas Eldorado (eldorado.org.br)
# SPDX-License-Identifier: Apache-2.0

config BOARD_HELTEC_WIFI_LORA32
	bool "HELTEC WiFi LoRa 32 (V2) Board"
	depends on SOC_SERIES_ESP32

choice SOC_PART_NUMBER
	default SOC_ESP32_D0WD_V3
endchoice
```

## boards/xtensa/heltec_wifi_lora32_v2/Kconfig.defconfig
```kconfig
# HELTEC board configuration

# Copyright (c) 2021 Instituto de Pesquisas Eldorado (eldorado.org.br)
# SPDX-License-Identifier: Apache-2.0

config BOARD
	default "heltec_wifi_lora32"
	depends on BOARD_HELTEC_WIFI_LORA32

config ENTROPY_GENERATOR
	default y

config HEAP_MEM_POOL_SIZE
	default 98304 if WIFI
	default 40960 if BT
	default 4096

choice BT_HCI_BUS_TYPE
	default BT_ESP32 if BT
endchoice
```

## boards/xtensa/heltec_wifi_lora32_v2/Kconfig.heltec_wifi_lora32_v2
```kconfig
# Copyright (c) 2022 Zephyr Project members and individual contributors
# SPDX-License-Identifier: Apache-2.0

config BOARD_HELTEC_WIFI_LORA32_V2
	bool
	default y
	select SOC_ESP32
```

## boards/xtensa/heltec_wireless_stick_lite_v3/heltec_wireless_stick_lite_v3_defconfig
```kconfig
# SPDX-License-Identifier: Apache-2.0

CONFIG_BOARD_HELTEC_WIRELESS_STICK_LITE=y
CONFIG_SOC_SERIES_ESP32S3=y

CONFIG_MAIN_STACK_SIZE=2048

CONFIG_CLOCK_CONTROL=y
CONFIG_CONSOLE=y
CONFIG_GPIO=y
CONFIG_PWM=y
CONFIG_SERIAL=y
CONFIG_SPI=y
CONFIG_UART_CONSOLE=y
```
