/*
 * Copyright (c) 2021 NXP
 *
 * SPDX-License-Identifier: Apache-2.0
 */

/dts-v1/;

#include <nxp/nxp_imx8.dtsi>
#include "nxp_adsp_imx8x-pinctrl.dtsi"

/ {
	model = "nxp_adsp_imx8x";
	compatible = "nxp";

	chosen {
		zephyr,sram = &sram0;
		zephyr,console = &lpuart2;
		zephyr,shell-uart = &lpuart2;
	};
};

&lpuart2 {
	status = "okay";
	current-speed = <115200>;
	pinctrl-0 = <&lpuart2_default>;
	pinctrl-names = "default";
};
