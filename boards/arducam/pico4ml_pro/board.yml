## boards/arducam/pico4ml_pro/board.yml
```yaml
board:
  name: pico4ml_pro
  full_name: Pico4ML-Pro
  vendor: arducam
  socs:
  - name: rp2040
```

## boards/arducam/pico4ml_pro/pico4ml_pro_defconfig
```kconfig
# SPDX-FileCopyrightText: Copyright The Zephyr Project Contributors
# SPDX-License-Identifier: Apache-2.0

CONFIG_BUILD_OUTPUT_UF2=y
CONFIG_CLOCK_CONTROL=y
CONFIG_GPIO=y
CONFIG_RESET=y
CONFIG_USE_DT_CODE_PARTITION=y
```

## boards/arduino/nano_connect/Kconfig.defconfig
```kconfig
# Copyright (c) Arduino s.r.l. and/or its affiliated companies
# SPDX-License-Identifier: Apache-2.0

if BOARD_ARDUINO_NANO_CONNECT

if I2C_DW

configdefault I2C_DW_CLOCK_SPEED
	default 125

endif # I2C_DW

configdefault USB_SELF_POWERED
	default n

endif # BOARD_ARDUINO_NANO_CONNECT
```

## boards/arduino/nano_r4/Kconfig.arduino_nano_r4
```kconfig
# Copyright (c) 2026 Sahaj Sarup
# SPDX-License-Identifier: Apache-2.0

config BOARD_ARDUINO_NANO_R4
	select SOC_R7FA4M1AB3CFM
```

## boards/arduino/nano_r4/arduino_nano_r4_defconfig
```kconfig
# Copyright (c) 2026 Sahaj Sarup
# SPDX-License-Identifier: Apache-2.0

# Enable UART driver
CONFIG_SERIAL=y
CONFIG_UART_INTERRUPT_DRIVEN=y

# Enable console
CONFIG_CONSOLE=y
CONFIG_UART_CONSOLE=y

# Enable GPIO
CONFIG_GPIO=y

CONFIG_USE_DT_CODE_PARTITION=y
```

## boards/arduino/nano_r4/board.yml
```yaml
board:
  name: arduino_nano_r4
  full_name: Arduino Nano R4
  vendor: arduino
  socs:
    - name: r7fa4m1ab3cfm
```

## boards/arduino/nesso_n1/Kconfig.sysbuild
```kconfig
# Copyright (c) 2026 Carlo Caione <ccaione@baylibre.com>
# SPDX-License-Identifier: Apache-2.0

choice BOOTLOADER
	default BOOTLOADER_MCUBOOT
endchoice
```

## boards/arduino/nicla_vision/Kconfig
```kconfig
# Copyright The Zephyr Project Contributors
# SPDX-License-Identifier: Apache-2.0

if WIFI_AIROC

config HEAP_MEM_POOL_ADD_SIZE_BOARD
	int
	default 20480

endif # WIFI_AIROC
```

## boards/arduino/opta/Kconfig
```kconfig
# Copyright The Zephyr Project Contributors
# SPDX-License-Identifier: Apache-2.0

config BOARD_ARDUINO_OPTA
	select BOARD_EARLY_INIT_HOOK
	select BOARD_LATE_INIT_HOOK if FLASH_STM32_QSPI_GENERIC_READ

config HEAP_MEM_POOL_ADD_SIZE_BOARD
	int
	default 20480 if WIFI_AIROC
```

## boards/arduino/portenta_c33/Kconfig.defconfig
```kconfig
# Copyright 2025 Arduino SA
# SPDX-License-Identifier: Apache-2.0

if BOARD_ARDUINO_PORTENTA_C33

configdefault USE_DT_CODE_PARTITION
	default y

configdefault ETH_DRIVER
	default y

endif # BOARD_ARDUINO_PORTENTA_C33
```

## boards/arduino/portenta_h7/Kconfig
```kconfig
# Copyright The Zephyr Project Contributors
# SPDX-License-Identifier: Apache-2.0

config BOARD_ARDUINO_PORTENTA_H7
	select BOARD_LATE_INIT_HOOK if BOARD_ARDUINO_PORTENTA_H7_STM32H747XX_M7

if WIFI_AIROC

config HEAP_MEM_POOL_ADD_SIZE_BOARD
	int
	default 20480

endif # WIFI_AIROC
```

## boards/arm/fvp_baser_aemv8r/Kconfig.defconfig
```kconfig
# Copyright (c) 2021 Arm Limited (or its affiliates). All rights reserved.
# SPDX-License-Identifier: Apache-2.0

if BOARD_FVP_BASER_AEMV8R

config BUILD_OUTPUT_BIN
	default y

configdefault ISR_STACK_SIZE
	default 1024 if BOARD_FVP_BASER_AEMV8R_FVP_AEMV8R_AARCH32 || \
		BOARD_FVP_BASER_AEMV8R_FVP_AEMV8R_AARCH32_SMP

endif # BOARD_FVP_BASER_AEMV8R
```

## boards/arm/mps4/Kconfig.defconfig
```kconfig
# Copyright 2025 Arm Limited and/or its affiliates <open-source-office@arm.com>
# SPDX-License-Identifier: Apache-2.0

if BOARD_MPS4_CORSTONE315_FVP || BOARD_MPS4_CORSTONE320_FVP

if SERIAL

config UART_INTERRUPT_DRIVEN
	default y

endif # SERIAL

endif
```

## boards/aspeed/ast1030_evb/Kconfig.defconfig
```kconfig
#
# Copyright The Zephyr Project Contributors
#
# SPDX-License-Identifier: Apache-2.0
#

configdefault MAIN_STACK_SIZE
	default 4096
```

## boards/aspeed/ast1030_evb/ast1030_evb_defconfig
```kconfig
# SPDX-License-Identifier: Apache-2.0
#
# Copyright (c) 2021 Aspeed Technology Inc.
#

CONFIG_XIP=n
CONFIG_CONSOLE=y
CONFIG_UART_CONSOLE=y
CONFIG_SERIAL=y
CONFIG_HEAP_MEM_POOL_SIZE=50000
CONFIG_CLOCK_CONTROL=y
CONFIG_RESET=y
```

## boards/aspeed/ast2700_evb/Kconfig.ast2700_evb
```kconfig
# Copyright (c) 2026 ASPEED Technology Inc.
# SPDX-License-Identifier: Apache-2.0

config BOARD_AST2700_EVB
	select SOC_AST2700_BOOTMCU if BOARD_AST2700_EVB_AST2700_BOOTMCU
```

## boards/aspeed/ast2700_evb/ast2700_evb_ast2700_bootmcu_defconfig
```kconfig
# Copyright (c) 2026 ASPEED Technology Inc.
# SPDX-License-Identifier: Apache-2.0

CONFIG_SERIAL=y
CONFIG_CONSOLE=y
CONFIG_UART_CONSOLE=y
```

## boards/aspeed/ast2700_evb/board.yml
```yaml
# Copyright (c) 2026 ASPEED Technology Inc.
# SPDX-License-Identifier: Apache-2.0

board:
  name: ast2700_evb
  full_name: AST2700 Evaluation Board
  vendor: aspeed
  socs:
    - name: ast2700
```

## boards/beagle/beaglebone_ai64/Kconfig.beaglebone_ai64
```kconfig
# Copyright (C) 2023 BeagleBoard.org Foundation
# Copyright (C) 2023 S Prashanth
#
# SPDX-License-Identifier: Apache-2.0

config BOARD_BEAGLEBONE_AI64
	select SOC_J721E_MAIN_R5F0_0 if BOARD_BEAGLEBONE_AI64_J721E_MAIN_R5F0_0
	select SOC_J721E_MAIN_R5F0_1 if BOARD_BEAGLEBONE_AI64_J721E_MAIN_R5F0_1
	select SOC_J721E_MAIN_R5F1_0 if BOARD_BEAGLEBONE_AI64_J721E_MAIN_R5F1_0
	select SOC_J721E_MAIN_R5F1_1 if BOARD_BEAGLEBONE_AI64_J721E_MAIN_R5F1_1
	select SOC_J721E_MCU_R5F0_0 if BOARD_BEAGLEBONE_AI64_J721E_MCU_R5F0_0
	select SOC_J721E_MCU_R5F0_1 if BOARD_BEAGLEBONE_AI64_J721E_MCU_R5F0_1
```
