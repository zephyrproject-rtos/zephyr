## boards/arm64/nxp_ls1046ardb/nxp_ls1046ardb_defconfig
```kconfig
# SPDX-License-Identifier: Apache-2.0

# Platform Configuration
CONFIG_SOC_SERIES_LS1046A=y
CONFIG_SOC_LS1046A=y
CONFIG_BOARD_NXP_LS1046ARDB=y
CONFIG_ARM64_VA_BITS_40=y
CONFIG_ARM64_PA_BITS_40=y
# 25 MHz system clock
CONFIG_SYS_CLOCK_HW_CYCLES_PER_SEC=25000000

# Zephyr Kernel Configuration
CONFIG_XIP=n
CONFIG_AARCH64_IMAGE_HEADER=y

# Serial Drivers
CONFIG_SERIAL=y
CONFIG_UART_INTERRUPT_DRIVEN=y

# Enable Console
CONFIG_CONSOLE=y
CONFIG_UART_CONSOLE=y
```

## boards/arm64/nxp_ls1046ardb/nxp_ls1046ardb_smp_4cores_defconfig
```kconfig
# SPDX-License-Identifier: Apache-2.0

# Platform Configuration
CONFIG_SOC_SERIES_LS1046A=y
CONFIG_SOC_LS1046A=y
CONFIG_BOARD_NXP_LS1046ARDB=y
CONFIG_ARM64_VA_BITS_40=y
CONFIG_ARM64_PA_BITS_40=y
# 25 MHz system clock
CONFIG_SYS_CLOCK_HW_CYCLES_PER_SEC=25000000

# Zephyr Kernel Configuration
CONFIG_XIP=n
CONFIG_AARCH64_IMAGE_HEADER=y
CONFIG_MAX_THREAD_BYTES=5
CONFIG_MAX_XLAT_TABLES=10

# SMP support
CONFIG_SMP=y
CONFIG_MP_NUM_CPUS=4
CONFIG_CACHE_MANAGEMENT=y
CONFIG_ARMV8_A_NS=y

# PSCI is supported
CONFIG_PM_CPU_OPS=y
CONFIG_PM_CPU_OPS_PSCI=y

# Serial Drivers
CONFIG_SERIAL=y
CONFIG_UART_INTERRUPT_DRIVEN=y

# Enable Console
CONFIG_CONSOLE=y
CONFIG_UART_CONSOLE=y
```

## boards/arm64/phycore_am62x_a53/Kconfig.board
```kconfig
# Copyright (c) 2023 Enphase Energy
# SPDX-License-Identifier: Apache-2.0

config BOARD_PHYCORE_AM62X_A53
	bool "PHYTEC phyCORE-AM62x A53"
	depends on SOC_SERIES_AM6X_A53
```

## boards/arm64/phycore_am62x_a53/Kconfig.defconfig
```kconfig
# Copyright (c) 2023 Enphase Energy
# SPDX-License-Identifier: Apache-2.0

if BOARD_PHYCORE_AM62X_A53

config BOARD
	default "phycore_am62x_a53"

endif # BOARD_PHYCORE_AM62X_A53
```

## boards/arm64/qemu_cortex_a53/Kconfig
```kconfig
# Copyright (c) 2021 BayLibre SAS
# SPDX-License-Identifier: Apache-2.0

# The GICv3 & ITS drivers allocation needs are:
# - LPI prop table: global 1x64K aligned on 64K
# - LPI pend table: for each redistributor/cpu 1x64K aligned on 64K
# - Devices table: 8x64K aligned on 64K
# - Interrupt Collections table: 1x64K aligned on 64K
#
# This makes 11x64K allocations aligned on 64K, but due to alignment constraints,
# HEAP needs to be 14x64K to permit all allocations to success.
#
# Note, will need 64K HEAP_MEM per CPUs added.
#
# This doesn't necessarily include the Interrupt Translation Table, which are
# 256bytes aligned tables, for reference a 32 ITEs table needs 512bytes.
# With 14x64K HEAP, up to 254 ITT tables of 32 ITEs can be allocated.
config HEAP_MEM_POOL_SIZE
	default 917504 if GIC_V3_ITS
```

## boards/arm64/qemu_cortex_a53/Kconfig.board
```kconfig
# Copyright (c) 2019 Carlo Caione <ccaione@baylibre.com>
# SPDX-License-Identifier: Apache-2.0

config BOARD_QEMU_CORTEX_A53
	bool "Cortex-A53 Emulation (QEMU)"
	depends on SOC_QEMU_CORTEX_A53
	select ARM64
	select QEMU_TARGET

config QEMU_CORTEX_A53_ETH_E1000
	bool "Use Intel e1000 Ethernet driver for networking"
	default y if !NET_TEST
	depends on BOARD_QEMU_CORTEX_A53 && NETWORKING && DT_HAS_INTEL_E1000_ENABLED
	select ETH_E1000
	select NET_L2_ETHERNET
	select PCIE
	select PCIE_CONTROLLER
	select PCIE_ECAM
```

## boards/arm64/qemu_cortex_a53/Kconfig.defconfig
```kconfig
# Copyright (c) 2019 Carlo Caione <ccaione@baylibre.com>
# SPDX-License-Identifier: Apache-2.0

if BOARD_QEMU_CORTEX_A53

config BUILD_OUTPUT_BIN
	default y

config BOARD
	default "qemu_cortex_a53"

config MAX_THREAD_BYTES
	default 3

if NETWORKING

choice NET_QEMU_NETWORKING
	default NET_QEMU_ETHERNET if QEMU_CORTEX_A53_ETH_E1000
endchoice

config NET_DRIVERS
	default n if QEMU_CORTEX_A53_ETH_E1000

endif # NETWORKING

# QEMU PCI requires at least 256M of virtual space
config KERNEL_VM_SIZE
	default 0x80000000 if PCIE

# QEMU PCI requires physical addresses with more than 32 bits
choice ARM64_VA_BITS
	default ARM64_VA_BITS_40 if PCIE
endchoice

choice ARM64_PA_BITS
	default ARM64_PA_BITS_40 if PCIE
endchoice

endif # BOARD_QEMU_CORTEX_A53
```

## boards/arm64/qemu_cortex_a53/Kconfig.qemu_cortex_a53_smp
```kconfig
# Copyright (c) 2022 Zephyr Project members and individual contributors
# SPDX-License-Identifier: Apache-2.0

config BOARD_QEMU_CORTEX_A53_SMP
	bool
	default y
	select SOC_QEMU_CORTEX_A53
	select ARM64
	select QEMU_TARGET
```

## boards/arm64/qemu_cortex_a53/qemu_cortex_a53_defconfig
```kconfig
CONFIG_SOC_QEMU_CORTEX_A53=y
CONFIG_BOARD_QEMU_CORTEX_A53=y
CONFIG_ARM_ARCH_TIMER=y
CONFIG_QEMU_ICOUNT=n

# Cache management
CONFIG_CACHE_MANAGEMENT=y

# Enable UART driver
CONFIG_SERIAL=y

# Enable console
CONFIG_CONSOLE=y
CONFIG_UART_CONSOLE=y

# Enable serial port
CONFIG_UART_PL011=y
CONFIG_UART_INTERRUPT_DRIVEN=y
```

## boards/arm64/qemu_cortex_a53/qemu_cortex_a53_smp_defconfig
```kconfig
CONFIG_SOC_QEMU_CORTEX_A53=y
CONFIG_BOARD_QEMU_CORTEX_A53=y
CONFIG_ARM_ARCH_TIMER=y
CONFIG_QEMU_ICOUNT=n

# Enable UART driver
CONFIG_SERIAL=y

# Enable console
CONFIG_CONSOLE=y
CONFIG_UART_CONSOLE=y

# PSCI is supported
CONFIG_PM_CPU_OPS=y

# Enable serial port
CONFIG_UART_INTERRUPT_DRIVEN=y

CONFIG_SMP=y
CONFIG_MP_NUM_CPUS=2
CONFIG_CACHE_MANAGEMENT=y
CONFIG_TIMEOUT_64BIT=y
CONFIG_ARMV8_A_NS=y
CONFIG_MAX_THREAD_BYTES=3
```

## boards/arm64/qemu_cortex_a53/qemu_cortex_a53_xip_defconfig
```kconfig
CONFIG_SOC_QEMU_CORTEX_A53=y
CONFIG_BOARD_QEMU_CORTEX_A53=y
CONFIG_ARM_ARCH_TIMER=y

# Cache management
CONFIG_CACHE_MANAGEMENT=y

# Enable UART driver
CONFIG_SERIAL=y

# Enable console
CONFIG_CONSOLE=y
CONFIG_UART_CONSOLE=y

# Enable serial port
CONFIG_UART_INTERRUPT_DRIVEN=y

# Avoid timing skew in tests
CONFIG_QEMU_ICOUNT=y
CONFIG_QEMU_ICOUNT_SHIFT=4
CONFIG_QEMU_ICOUNT_SLEEP=y

# Enable XIP
CONFIG_XIP=y
```

## boards/arm64/qemu_cortex_a55/Kconfig.board
```kconfig
# Copyright 2022 NXP
# SPDX-License-Identifier: Apache-2.0

config BOARD_QEMU_CORTEX_A55
	bool "Cortex-A55 Emulation (QEMU)"
	depends on SOC_QEMU_CORTEX_A55
	select ARM64
	select QEMU_TARGET
```

## boards/arm64/qemu_cortex_a55/Kconfig.defconfig
```kconfig
# Copyright 2022 NXP
# SPDX-License-Identifier: Apache-2.0

if BOARD_QEMU_CORTEX_A55

config BUILD_OUTPUT_BIN
	default y

config BOARD
	default "qemu_cortex_a55"

endif # BOARD_QEMU_CORTEX_A55
```

## boards/arm64/qemu_kvm_arm64/Kconfig.board
```kconfig
# Copyright (c) 2022 Huawei France Technologies SASU
# SPDX-License-Identifier: Apache-2.0

config BOARD_QEMU_KVM_ARM64
	bool "Cortex AArch64 KVM Virt Emulation (QEMU)"
	depends on SOC_QEMU_VIRT_ARM64
	select ARM64
	select QEMU_TARGET
```

## boards/arm64/qemu_kvm_arm64/Kconfig.defconfig
```kconfig
# Copyright (c) 2022 Huawei France Technologies SASU
# SPDX-License-Identifier: Apache-2.0

if BOARD_QEMU_KVM_ARM64

config BUILD_OUTPUT_BIN
	default y

config BOARD
	default "qemu_kvm_arm64"

endif # BOARD_QEMU_KVM_ARM64
```

## boards/arm64/qemu_kvm_arm64/qemu_kvm_arm64_defconfig
```kconfig
CONFIG_SOC_QEMU_VIRT_ARM64=y
CONFIG_BOARD_QEMU_KVM_ARM64=y
CONFIG_ARM_ARCH_TIMER=y
CONFIG_TIMER_READS_ITS_FREQUENCY_AT_RUNTIME=y
CONFIG_QEMU_ICOUNT=n
CONFIG_ARMV8_A_NS=y

# Cache management
CONFIG_CACHE_MANAGEMENT=y

# Enable UART driver
CONFIG_SERIAL=y

# Enable console
CONFIG_CONSOLE=y
CONFIG_UART_CONSOLE=y

# Enable serial port
CONFIG_UART_INTERRUPT_DRIVEN=y
```

## boards/arm64/rcar_h3ulcb_ca57/Kconfig.defconfig
```kconfig
# Copyright (c) 2023 EPAM Systems
# SPDX-License-Identifier: Apache-2.0

if BOARD_RCAR_H3ULCB_CA57

config BOARD
	default "rcar_h3ulcb_ca57"

config BUILD_OUTPUT_BIN
	default y

endif # BOARD_RCAR_H3ULCB_CA57
```

## boards/arm64/rcar_h3ulcb_ca57/rcar_h3ulcb_ca57_defconfig
```kconfig
CONFIG_SOC_ARM64_R8A77951=y
CONFIG_SOC_SERIES_RCAR_GEN3=y
CONFIG_BOARD_RCAR_H3ULCB_CA57=y

# Cache management
CONFIG_CACHE_MANAGEMENT=y

# Enable UART driver
CONFIG_SERIAL=y
CONFIG_AARCH64_IMAGE_HEADER=y
CONFIG_SYS_CLOCK_HW_CYCLES_PER_SEC=8300000
CONFIG_XIP=n

CONFIG_MAX_XLAT_TABLES=24
CONFIG_ARMV8_A_NS=y

# Enable console
CONFIG_CONSOLE=y
CONFIG_UART_CONSOLE=y

# Enable clock control
CONFIG_CLOCK_CONTROL=y
```

## boards/arm64/rcar_salvator_xs_m3/Kconfig.board
```kconfig
# Copyright (c) 2023 EPAM Systems
# SPDX-License-Identifier: Apache-2.0

config BOARD_RCAR_SALVATOR_XS_M3
	bool "Renesas Salvator XS M3"
	depends on SOC_R8A77961
```

## boards/arm64/rcar_salvator_xs_m3/rcar_salvator_xs_m3_defconfig
```kconfig
CONFIG_SOC_R8A77961=y
CONFIG_SOC_SERIES_RCAR_GEN3=y
CONFIG_BOARD_RCAR_SALVATOR_XS_M3=y

# Cache management
CONFIG_CACHE_MANAGEMENT=y

# Enable UART driver
CONFIG_SERIAL=y
CONFIG_AARCH64_IMAGE_HEADER=y
CONFIG_SYS_CLOCK_HW_CYCLES_PER_SEC=8300000
CONFIG_XIP=n

CONFIG_MAX_XLAT_TABLES=24
CONFIG_ARMV8_A_NS=y

# Enable console
CONFIG_CONSOLE=y
CONFIG_UART_CONSOLE=y

# Enable clock control
CONFIG_CLOCK_CONTROL=y
```

## boards/arm64/rcar_spider/Kconfig.board
```kconfig
# Copyright (c) 2023 EPAM Systems
# SPDX-License-Identifier: Apache-2.0

config BOARD_RCAR_SPIDER
	bool "Renesas Spider"
	depends on SOC_R8A779F
```

## boards/arm64/rcar_spider/Kconfig.defconfig
```kconfig
# Copyright (c) 2023 EPAM Systems
# SPDX-License-Identifier: Apache-2.0

if BOARD_RCAR_SPIDER

config BOARD
	default "rcar_spider"

config BUILD_OUTPUT_BIN
	default y

endif # BOARD_RCAR_SPIDER
```

## boards/arm64/rcar_spider_ca55/Kconfig.board
```kconfig
# Copyright (c) 2023 EPAM Systems
# SPDX-License-Identifier: Apache-2.0

config BOARD_RCAR_SPIDER_CA55
	bool "Renesas Spider"
	depends on SOC_R8A779F0
```

## boards/arm64/rcar_spider_ca55/Kconfig.defconfig
```kconfig
# Copyright (c) 2023 EPAM Systems
# SPDX-License-Identifier: Apache-2.0

if BOARD_RCAR_SPIDER_CA55

config BOARD
	default "rcar_spider_ca55"

config BUILD_OUTPUT_BIN
	default y

endif # BOARD_RCAR_SPIDER_CA55
```

## boards/arm64/roc_rk3568_pc/Kconfig.board
```kconfig
# Copyright 2022 HNU-ESNL
# Copyright 2022 openEuler SIG-Zephyr
# SPDX-License-Identifier: Apache-2.0

config BOARD_ROC_RK3568_PC
	bool "Rockchip ROC-RK3568-PC"
	depends on SOC_SERIES_RK3568
	select ARM64
```
