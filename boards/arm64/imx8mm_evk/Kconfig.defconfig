## boards/arm64/imx8mm_evk/Kconfig.defconfig
```kconfig
# Copyright 2020-2022 NXP
# SPDX-License-Identifier: Apache-2.0

if BOARD_IMX8MM_EVK_A53

config BOARD
	default "imx8mm_evk_a53"

endif # BOARD_IMX8MM_EVK_A53
```

## boards/arm64/imx8mm_evk/imx8mm_evk_defconfig
```kconfig
# SPDX-License-Identifier: Apache-2.0

# Platform Configuration
CONFIG_SOC_SERIES_IMX8M_A53=y
CONFIG_SOC_IMX8MM_A53=y
CONFIG_BOARD_IMX8MM_EVK_A53=y
CONFIG_ARM_ARCH_TIMER=y

# Zephyr Kernel Configuration
CONFIG_XIP=n
CONFIG_ARM64_VA_BITS_48=y
CONFIG_ARM64_PA_BITS_48=y

# Serial Drivers
CONFIG_SERIAL=n
CONFIG_UART_INTERRUPT_DRIVEN=n

# Enable Console
CONFIG_CONSOLE=y
CONFIG_UART_CONSOLE=n

CONFIG_RAM_CONSOLE=y
CONFIG_RAM_CONSOLE_BUFFER_SIZE=2048

CONFIG_ARMV8_A_NS=y
CONFIG_DYNAMIC_INTERRUPTS=y
CONFIG_TIMEOUT_64BIT=y

CONFIG_CLOCK_CONTROL=n

# SMP support
CONFIG_SMP=y
CONFIG_MP_NUM_CPUS=2
CONFIG_CACHE_MANAGEMENT=y
CONFIG_ARMV8_A_NS=y

# PSCI is supported
CONFIG_PM_CPU_OPS=y
CONFIG_PM_CPU_OPS_PSCI=y
```

## boards/arm64/imx8mp_evk/Kconfig.board
```kconfig
# Copyright 2021 NXP
# SPDX-License-Identifier: Apache-2.0

config BOARD_IMX8MP_EVK_A53
	bool "NXP i.MX8M Plus EVK A53"
	depends on SOC_SERIES_IMX8M_A53
	select ARM64
```

## boards/arm64/imx8mp_evk/Kconfig.defconfig
```kconfig
# Copyright 2021-2022 NXP
# SPDX-License-Identifier: Apache-2.0

if BOARD_IMX8MP_EVK_A53

config BOARD
	default "imx8mp_evk_a53"

endif # BOARD_IMX8MP_EVK_A53
```

## boards/arm64/intel_socfpga_agilex5_socdk/Kconfig.board
```kconfig
# Copyright (c) 2022 Intel Corporation
# SPDX-License-Identifier: Apache-2.0

config BOARD_INTEL_SOCFPGA_AGILEX5_SOCDK
	bool "Intel SoC FPGA Development Kit (Agilex5)"
	select HAS_COVERAGE_SUPPORT
	depends on SOC_AGILEX5
```

## boards/arm64/intel_socfpga_agilex5_socdk/Kconfig.defconfig
```kconfig
# Copyright (c) 2022 Intel Corporation
# SPDX-License-Identifier: Apache-2.0

config BOARD
	default "intel_socfpga_agilex5_socdk"
	depends on BOARD_INTEL_SOCFPGA_AGILEX5_SOCDK

if NETWORKING

config NET_L2_ETHERNET
	default y

config ETH_DWC_XGMAC
	default y if NET_L2_ETHERNET

config PHY_GENERIC_MII
	default y if ETH_DWC_XGMAC

config MDIO
	default y if ETH_DWC_XGMAC

config MDIO_DWCXGMAC
	default y if ETH_DWC_XGMAC

endif # NETWORKING
```

## boards/arm64/intel_socfpga_agilex5_socdk/intel_socfpga_agilex5_socdk_defconfig
```kconfig
# Copyright (c) 2022 Intel Corporation
# SPDX-License-Identifier: Apache-2.0

# The Zephyr build from this defconfig is execpted to boot from
# Intel Arm Trusted Firmware (ATF)
# Boot Flow: BL21 -> BL31 -> Zephyr

CONFIG_SOC_SERIES_AGILEX5=y
CONFIG_SOC_AGILEX5=y
CONFIG_BOARD_INTEL_SOCFPGA_AGILEX5_SOCDK=y

# Arm Features
CONFIG_ARM_ARCH_TIMER=y
CONFIG_CACHE_MANAGEMENT=y
CONFIG_ARMV8_A_NS=y

# Serial Drivers
CONFIG_SERIAL=y
CONFIG_UART_NS16550=y
CONFIG_UART_INTERRUPT_DRIVEN=y
CONFIG_UART_NS16550_ACCESS_WORD_ONLY=y

# Enable Console
CONFIG_CONSOLE=y
CONFIG_UART_CONSOLE=y

# Enable Clock Manager
CONFIG_CLOCK_CONTROL=y

# For Misc Register Map
CONFIG_SYSCON=y
```

## boards/arm64/intel_socfpga_agilex_socdk/Kconfig.intel_socfpga_agilex_socdk
```kconfig
# Copyright (c) 2022 Zephyr Project members and individual contributors
# SPDX-License-Identifier: Apache-2.0

config BOARD_INTEL_SOCFPGA_AGILEX_SOCDK
	bool
	default y
	select SOC_SERIES_AGILEX
	select SOC_AGILEX
```

## boards/arm64/intel_socfpga_agilex_socdk/intel_socfpga_agilex_socdk_defconfig
```kconfig
# Copyright (c) 2021-2023 Intel Corporation
# SPDX-License-Identifier: Apache-2.0

# The Zephyr build from this defconfig is expected to boot from
# Intel Arm Trusted Firmware (ATF)
# Boot Flow: BL21 -> BL31 -> Zephyr

CONFIG_SOC_SERIES_AGILEX=y
CONFIG_SOC_AGILEX=y
CONFIG_BOARD_INTEL_SOCFPGA_AGILEX_SOCDK=y

# Arm Features
CONFIG_ARM_ARCH_TIMER=y
CONFIG_CACHE_MANAGEMENT=y

# Serial Drivers
CONFIG_SERIAL=y
CONFIG_UART_INTERRUPT_DRIVEN=y
CONFIG_UART_NS16550_ACCESS_WORD_ONLY=y

# Enable Console
CONFIG_CONSOLE=y
CONFIG_UART_CONSOLE=y

# Enable Clock Manager
CONFIG_CLOCK_CONTROL=y

# For Misc Register Map
CONFIG_SYSCON=y

# Reset Manager
CONFIG_RESET=y

# Setting higher priority for Intel SOCFPGA reset controller to initialize it before
# other dependent drivers running at CONFIG_KERNEL_INIT_PRIORITY_DEFAULT which is 40
CONFIG_RESET_INIT_PRIORITY=35

# SOC
CONFIG_SYS_CLOCK_HW_CYCLES_PER_SEC=400000000
```

## boards/arm64/khadas_edgev/Kconfig.board
```kconfig
#
# Copyright 2022 Huawei France Technologies SASU
# SPDX-License-Identifier: Apache-2.0
#

config BOARD_KHADAS_EDGEV
	bool "Khadas Edge-V"
	depends on SOC_SERIES_RK3399
```

## boards/arm64/khadas_edgev/Kconfig.defconfig
```kconfig
#
# Copyright 2022 Huawei France Technologies SASU
# SPDX-License-Identifier: Apache-2.0
#

config BOARD
	default "khadas_edgev"
	depends on BOARD_KHADAS_EDGEV
```

## boards/arm64/khadas_edgev/khadas_edgev_defconfig
```kconfig
# SPDX-License-Identifier: Apache-2.0

# Platform Configuration
CONFIG_SOC_SERIES_RK3399=y
CONFIG_SOC_RK3399=y
CONFIG_BOARD_KHADAS_EDGEV=y
CONFIG_ARM64_VA_BITS_40=y
CONFIG_ARM64_PA_BITS_40=y
CONFIG_SYS_CLOCK_HW_CYCLES_PER_SEC=24000000
CONFIG_CACHE_MANAGEMENT=y
CONFIG_ARMV8_A_NS=y

# Serial Drivers
CONFIG_SERIAL=y
CONFIG_UART_INTERRUPT_DRIVEN=y

# Enable Console
CONFIG_CONSOLE=y
CONFIG_UART_CONSOLE=y
```

## boards/arm64/mimx8mm_evk/Kconfig.mimx8mm_evk_a53
```kconfig
# Copyright (c) 2022 Zephyr Project members and individual contributors
# SPDX-License-Identifier: Apache-2.0

config BOARD_MIMX8MM_EVK_A53
	bool
	default y
	select SOC_SERIES_MIMX8M_A53
	select SOC_MIMX8MM_A53
	select SOC_PART_NUMBER_MIMX8MM6DVTLZ
```

## boards/arm64/mimx8mm_evk_a53/mimx8mm_evk_a53_defconfig
```kconfig
# SPDX-License-Identifier: Apache-2.0

# Platform Configuration
CONFIG_SOC_SERIES_IMX8MM_A53=y
CONFIG_SOC_MIMX8MM_A53=y
CONFIG_BOARD_MIMX8MM_EVK_A53=y
CONFIG_ARM_ARCH_TIMER=y

# Zephyr Kernel Configuration
CONFIG_XIP=n
CONFIG_ARM64_VA_BITS_48=y
CONFIG_ARM64_PA_BITS_48=y

# Serial Drivers
CONFIG_SERIAL=y
CONFIG_UART_INTERRUPT_DRIVEN=y

# Enable Console
CONFIG_CONSOLE=y
CONFIG_UART_CONSOLE=y
CONFIG_UART_IMX8M=y
CONFIG_ARMV8_A_NS=y
CONFIG_DYNAMIC_INTERRUPTS=y
CONFIG_TIMEOUT_64BIT=y

CONFIG_CLOCK_CONTROL=y

# SMP support
CONFIG_SMP=y
CONFIG_MP_NUM_CPUS=2
CONFIG_CACHE_MANAGEMENT=y
CONFIG_ARMV8_A_NS=y

# PSCI is supported
CONFIG_PM_CPU_OPS=y
CONFIG_PM_CPU_OPS_PSCI=y
```

## boards/arm64/mimx8mn_evk/Kconfig.defconfig
```kconfig
# Copyright 2022 NXP
# SPDX-License-Identifier: Apache-2.0

if BOARD_MIMX8MN_EVK_A53

config BOARD
	default "mimx8mn_evk_a53"

endif # BOARD_MIMX8MN_EVK_A53
```

## boards/arm64/mimx8mp_evk/Kconfig.board
```kconfig
# Copyright 2021-2022 NXP
# SPDX-License-Identifier: Apache-2.0

config BOARD_MIMX8MP_EVK_A53
	bool "NXP i.MX8M Plus EVK A53"
	depends on SOC_SERIES_MIMX8M_A53
	select SOC_PART_NUMBER_MIMX8ML8DVNLZ
```

## boards/arm64/mimx8mp_evk/Kconfig.defconfig
```kconfig
# Copyright 2021-2022 NXP
# SPDX-License-Identifier: Apache-2.0

if BOARD_MIMX8MP_EVK_A53

config BOARD
	default "mimx8mp_evk_a53"

endif # BOARD_MIMX8MP_EVK_A53
```

## boards/arm64/mimx8qm_mek/Kconfig.board
```kconfig
# Copyright 2023 NXP
# SPDX-License-Identifier: Apache-2.0

config BOARD_MIMX8QM_MEK_A53
	bool "NXP i.MX8QM MEK A53"
	depends on SOC_SERIES_MIMX8QM_A53
	select SOC_PART_NUMBER_MIMX8QM6AVUFF
```

## boards/arm64/mimx8qm_mek/Kconfig.defconfig
```kconfig
# Copyright 2023 NXP
# SPDX-License-Identifier: Apache-2.0

if BOARD_MIMX8QM_MEK_A53

config BOARD
	default "mimx8qm_mek_a53"

endif # BOARD_MIMX8QM_MEK_A53
```

## boards/arm64/mimx8qm_mek/mimx8qm_mek_a53_defconfig
```kconfig
# Copyright 2023 NXP
# SPDX-License-Identifier: Apache-2.0

# ARM options
CONFIG_AARCH64_IMAGE_HEADER=y
CONFIG_ARMV8_A_NS=y
CONFIG_ARM64_VA_BITS_36=y
CONFIG_ARM64_PA_BITS_36=y

# cache options
CONFIG_CACHE_MANAGEMENT=y
CONFIG_DCACHE_LINE_SIZE_DETECT=y
CONFIG_ICACHE_LINE_SIZE_DETECT=y

# platform configuration
CONFIG_SOC_SERIES_MIMX8QM_A53=y
CONFIG_SOC_MIMX8QM_A53=y
CONFIG_BOARD_MIMX8QM_MEK_A53=y

# driver configuration
CONFIG_FIRMWARE=y
CONFIG_CLOCK_CONTROL=y
```

## boards/arm64/mimx93_evk/Kconfig.board
```kconfig
# Copyright 2022 NXP
# SPDX-License-Identifier: Apache-2.0

config BOARD_MIMX93_EVK_A55
	bool "NXP i.MX93 EVK A55"
	depends on SOC_SERIES_MIMX9_A55
	select SOC_PART_NUMBER_MIMX9352CVUXK
```

## boards/arm64/mimx93_evk/mimx93_evk_a55_defconfig
```kconfig
#
# Copyright 2022 NXP
#
# SPDX-License-Identifier: Apache-2.0

# ARM Options
CONFIG_AARCH64_IMAGE_HEADER=y
CONFIG_ARMV8_A_NS=y

# Cache Options
CONFIG_CACHE_MANAGEMENT=y
CONFIG_DCACHE_LINE_SIZE_DETECT=y
CONFIG_ICACHE_LINE_SIZE_DETECT=y

# Platform Configuration
CONFIG_SOC_SERIES_MIMX9_A55=y
CONFIG_SOC_MIMX93_A55=y
CONFIG_BOARD_MIMX93_EVK_A55=y

# Zephyr Kernel Configuration
CONFIG_XIP=n

# Serial Drivers
CONFIG_SERIAL=y
CONFIG_UART_INTERRUPT_DRIVEN=y

# Enable Console
CONFIG_CONSOLE=y
CONFIG_UART_CONSOLE=y

CONFIG_CLOCK_CONTROL=y
CONFIG_PINCTRL=y
```

## boards/arm64/mimx93_evk/mimx93_evk_a55_sof_defconfig
```kconfig
#
# Copyright 2023 NXP
#
# SPDX-License-Identifier: Apache-2.0

# ARM Options
CONFIG_AARCH64_IMAGE_HEADER=y
CONFIG_ARMV8_A_NS=y

# The number of bits used for PAs and VAs
# from Zephyr needs to match the number of
# bits used for said address used by Jailhouse.
CONFIG_ARM64_VA_BITS_40=y
CONFIG_ARM64_PA_BITS_40=y

# Cache Options
CONFIG_CACHE_MANAGEMENT=y
CONFIG_ICACHE_LINE_SIZE_DETECT=y
# SOF doesn't currently support the usage of
# run-time data cache line size detection.
# Because of this, CONFIG_DCACHE_LINE_SIZE_DETECT
# (which defaults to n) can't be set to 'y'.
# The size of data cache line will have to be
# set manually to 64 (value taken from A55 TRM).
CONFIG_DCACHE_LINE_SIZE=64

# Platform Configuration
CONFIG_SOC_SERIES_MIMX9_A55=y
CONFIG_SOC_MIMX93_A55=y
CONFIG_BOARD_MIMX93_EVK_A55=y

# Serial Drivers
CONFIG_SERIAL=y
CONFIG_UART_INTERRUPT_DRIVEN=y

# Enable Console
CONFIG_CONSOLE=y
CONFIG_UART_CONSOLE=y

CONFIG_CLOCK_CONTROL=y
CONFIG_PINCTRL=y

# Enable dynamic interrupts
CONFIG_DYNAMIC_INTERRUPTS=y
```

## boards/arm64/nxp_ls1046ardb/Kconfig.nxp_ls1046ardb
```kconfig
# Copyright (c) 2022 Zephyr Project members and individual contributors
# SPDX-License-Identifier: Apache-2.0

config BOARD_NXP_LS1046ARDB
	bool
	default y
	select SOC_SERIES_LS1046A
	select SOC_LS1046A
```

## boards/arm64/nxp_ls1046ardb/Kconfig.nxp_ls1046ardb_smp_2cores
```kconfig
# Copyright (c) 2022 Zephyr Project members and individual contributors
# SPDX-License-Identifier: Apache-2.0

config BOARD_NXP_LS1046ARDB_SMP_2CORES
	bool
	default y
	select SOC_SERIES_LS1046A
	select SOC_LS1046A
```
