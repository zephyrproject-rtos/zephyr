## boards/arm64/roc_rk3568_pc/Kconfig.defconfig
```kconfig
# Copyright 2022 HNU-ESNL
# Copyright 2022 openEuler SIG-Zephyr
# SPDX-License-Identifier: Apache-2.0

if BOARD_ROC_RK3568_PC

config BOARD
	default "roc_rk3568_pc"

endif # BOARD_ROC_RK3568_PC
```

## boards/arm64/rpi_4b/Kconfig.board
```kconfig
# Copyright 2023 honglin leng <a909204013@gmail.com>
# SPDX-License-Identifier: Apache-2.0

config BOARD_RPI_4B
	bool "Broadcom BCM2711"
	depends on SOC_BCM2711
```

## boards/arm64/rpi_4b/Kconfig.defconfig
```kconfig
# Copyright 2023 honglin leng <a909204013@gmail.com>
# SPDX-License-Identifier: Apache-2.0

config BOARD
	default "Raspberry Pi 4 Model B"
	depends on BOARD_RPI_4B
```

## boards/arm64/xenvm/Kconfig
```kconfig
# Copyright (c) 2022 Arm Limited (or its affiliates). All rights reserved.
# SPDX-License-Identifier: Apache-2.0

config XENVM_USE_GIC_V3
	bool "Xen VM using GICv3"
	depends on BOARD_XENVM
	help
	  Configure Xen VM to use GICv3 instead of default GICv2.
```

## boards/arm64/xenvm/Kconfig.board
```kconfig
# Copyright (c) 2020 EPAM Systems
# SPDX-License-Identifier: Apache-2.0

config BOARD_XENVM
	bool "Xen Virtual Machine"
	depends on SOC_XENVM
	select ARM64
```

## boards/arm64/xenvm/Kconfig.defconfig
```kconfig
# Copyright (c) 2020 EPAM Systems
# SPDX-License-Identifier: Apache-2.0

config BUILD_OUTPUT_BIN
	default y
```

## boards/arm64/xenvm/Kconfig.xenvm
```kconfig
# Copyright (c) 2022 Zephyr Project members and individual contributors
# SPDX-License-Identifier: Apache-2.0

config BOARD_XENVM
	bool
	default y
	select SOC_XENVM
```

## boards/arm64/xenvm/xenvm_defconfig
```kconfig
CONFIG_SOC_XENVM=y
CONFIG_BOARD_XENVM=y

# Enable UART driver
CONFIG_SERIAL=y

CONFIG_MAX_XLAT_TABLES=10
CONFIG_HEAP_MEM_POOL_SIZE=16384

# Enable console
CONFIG_CONSOLE=y
CONFIG_UART_CONSOLE=y

# Enable logging subsys
CONFIG_LOG=y
CONFIG_LOG_MODE_MINIMAL=n

CONFIG_USERSPACE=n
```

## boards/arm64/xenvm/xenvm_gicv3_defconfig
```kconfig
CONFIG_SOC_XENVM=y
CONFIG_BOARD_XENVM=y

# Enable UART driver
CONFIG_SERIAL=y

CONFIG_MAX_XLAT_TABLES=24

# Enable console
CONFIG_CONSOLE=y
CONFIG_UART_CONSOLE=y

# Enable logging subsys
CONFIG_LOG=y
CONFIG_LOG_MODE_MINIMAL=n

CONFIG_USERSPACE=n
```

## boards/armfly/stm32f429bit6/Kconfig.armfly_stm32f429bit6
```kconfig
# Copyright (c) 2026 Manyi Yu
# SPDX-License-Identifier: Apache-2.0

config BOARD_ARMFLY_STM32F429BIT6
	select SOC_STM32F429XX
```

## boards/armfly/stm32f429bit6/board.yml
```yaml
board:
  name: armfly_stm32f429bit6
  full_name: Armfly STM32F429BIT6
  vendor: armfly
  socs:
    - name: stm32f429xx
```

## boards/armfly/stm32h743xih6/Kconfig.armfly_stm32h743xih6
```kconfig
# Copyright (c) 2026 Zhaoming Li
# SPDX-License-Identifier: Apache-2.0

config BOARD_ARMFLY_STM32H743XIH6
	select SOC_STM32H743XX
```

## boards/armfly/stm32h743xih6/Kconfig.defconfig
```kconfig
# Armfly STM32H743XIH6 board configuration

# Copyright (c) 2026 Zhaoming Li
# SPDX-License-Identifier: Apache-2.0

if BOARD_ARMFLY_STM32H743XIH6

configdefault SPI_STM32_INTERRUPT
	default y if SPI

endif # BOARD_ARMFLY_STM32H743XIH6
```

## boards/armfly/stm32h743xih6/armfly_stm32h743xih6_defconfig
```kconfig
# SPDX-License-Identifier: Apache-2.0
# File armfly_stm32h743xih6_defconfig

# Enable MPU
CONFIG_ARM_MPU=y

# Enable HW stack protection
CONFIG_HW_STACK_PROTECTION=y

CONFIG_SERIAL=y

# Console
CONFIG_CONSOLE=y
CONFIG_UART_CONSOLE=y

# Enable GPIO
CONFIG_GPIO=y
```

## boards/armfly/stm32h743xih6/board.yml
```yaml
# Copyright (c) 2026 Zhaoming Li
# SPDX-License-Identifier: Apache-2.0

board:
  name: armfly_stm32h743xih6
  full_name: Armfly STM32H743XIH6
  vendor: armfly
  socs:
    - name: stm32h743xx
```

## boards/artery/at_start_f405/at_start_f405_defconfig
```kconfig
# Copyright (c) 2025, Jun Tan <juntan@arterytek.com>
# SPDX-License-Identifier: Apache-2.0

# Enable MPU
CONFIG_ARM_MPU=y

# Enable HW stack protection
CONFIG_HW_STACK_PROTECTION=y

# Enable GPIO
CONFIG_GPIO=y

# Enable Console
CONFIG_SERIAL=y
CONFIG_CONSOLE=y
CONFIG_UART_CONSOLE=y

# Enable reset
CONFIG_RESET=y
```

## boards/artery/at_start_f405/board.yml
```yaml
board:
  name: at_start_f405
  full_name: Artery AT-START-F405
  vendor: artery
  socs:
    - name: at32f405
```

## boards/arturo182/serpente/Kconfig.serpente
```kconfig
# Copyright (c) 2020 Alexander Falb <fal3xx@gmail.com>
# Copyright (c) 2024 Gerson Fernando Budke <nandojve@gmail.com>
# SPDX-License-Identifier: Apache-2.0

config BOARD_SERPENTE
	select SOC_SAMD21E18A
```

## boards/aspeed/ast1030_evb/Kconfig.ast1030_evb
```kconfig
# SPDX-License-Identifier: Apache-2.0
#
# Aspeed AST1030 evaluation board configuration
#
# Copyright (c) 2021 Aspeed Technology Inc.

config BOARD_AST1030_EVB
	select SOC_AST1030
```

## boards/aspeed/ast1030_evb/board.yml
```yaml
board:
  name: ast1030_evb
  full_name: AST1030_EVB
  vendor: aspeed
  socs:
  - name: ast1030
```

## boards/at/at_start_f405/Kconfig.at_start_f405
```kconfig
# Copyright (c) 2018 Philémon Jaermann
# SPDX-License-Identifier: Apache-2.0

config BOARD_AT_START_F405
	select SOC_AT32F405
```

## boards/at/at_start_f405/at_start_f405_defconfig
```kconfig
# SPDX-License-Identifier: Apache-2.0

# Enable MPU
CONFIG_ARM_MPU=n

# Enable HW stack protection
CONFIG_HW_STACK_PROTECTION=n

# Enable GPIO
CONFIG_GPIO=y
```
