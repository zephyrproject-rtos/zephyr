## boards/viewe/uedx24240013_md50e/Kconfig.uedx24240013_md50e
```kconfig
# Copyright (c) 2024 Espressif Systems (Shanghai) Co., Ltd.
# Copyright (c) 2026 VIEWE Display Co., Ltd.
# SPDX-License-Identifier: Apache-2.0

config BOARD_UEDX24240013_MD50E
	select SOC_ESP32C3_WROOM_02_N4
```

## boards/viewe/uedx24240013_md50e/board.yml
```yaml
board:
  name: uedx24240013_md50e
  full_name: VIEWE UEDX24240013-MD50E
  vendor: viewe
  socs:
  - name: esp32c3
```

## boards/viewe/uedx24320028e_wb_a/Kconfig
```kconfig
# SPDX-FileCopyrightText: Copyright The Zephyr Project Contributors
# SPDX-License-Identifier: Apache-2.0

config HEAP_MEM_POOL_ADD_SIZE_BOARD
	int
	default 4096 if BOARD_UEDX24320028E_WB_A_ESP32S3_PROCPU
	default 256 if BOARD_UEDX24320028E_WB_A_ESP32S3_APPCPU
```

## boards/viewe/uedx24320028e_wb_a/Kconfig.uedx24320028e_wb_a
```kconfig
# SPDX-FileCopyrightText: Copyright The Zephyr Project Contributors
# SPDX-License-Identifier: Apache-2.0

config BOARD_UEDX24320028E_WB_A
	select SOC_ESP32S3_WROOM_N16R8
	select SOC_ESP32S3_PROCPU if BOARD_UEDX24320028E_WB_A_ESP32S3_PROCPU
	select SOC_ESP32S3_APPCPU if BOARD_UEDX24320028E_WB_A_ESP32S3_APPCPU
```

## boards/viewe/uedx24320028e_wb_a/board.yml
```yaml
board:
  name: uedx24320028e_wb_a
  full_name: VIEWE UEDX24320028E-WB-A
  vendor: viewe
  socs:
  - name: esp32s3
```

## boards/viewe/uedx32480035e_wb_a/Kconfig
```kconfig
# Copyright (c) 2024 Espressif Systems (Shanghai) Co., Ltd.
# Copyright (c) 2026 VIEWE Display Co., Ltd.
# SPDX-License-Identifier: Apache-2.0

config HEAP_MEM_POOL_ADD_SIZE_BOARD
	int
	default 4096 if BOARD_UEDX32480035E_WB_A_ESP32S3_PROCPU
	default 256 if BOARD_UEDX32480035E_WB_A_ESP32S3_APPCPU
```

## boards/viewe/uedx32480035e_wb_a/board.yml
```yaml
board:
  name: uedx32480035e_wb_a
  full_name: VIEWE UEDX32480035E-WB-A
  vendor: viewe
  socs:
  - name: esp32s3
```

## boards/viewe/uedx80480070e_wb_a/board.yml
```yaml
board:
  name: uedx80480070e_wb_a
  full_name: VIEWE UEDX80480070E-WB-A
  vendor: viewe
  socs:
  - name: esp32s3
```

## boards/virtual_board/generated/boards/nxp/nxp_virtual/board.yml
```yaml
board:
  name: nxp_virtual
  full_name: NXP Virtual Board (SoC template)
  vendor: nxp
  socs:
  - name: mcimx6x
  - name: mcimx7d
  - name: mcxa153
  - name: mcxa156
  - name: mcxa266
  - name: mcxa344
  - name: mcxa346
  - name: mcxa366
  - name: mcxa577
  - name: mcxc141
  - name: mcxc142
  - name: mcxc242
  - name: mcxc444
  - name: mcxe245
  - name: mcxe246
  - name: mcxe247
  - name: mcxe315
  - name: mcxe316
  - name: mcxe317
  - name: mcxe31b
  - name: mcxn236
  - name: mcxn547
  - name: mcxn947
  - name: mcxw235
  - name: mcxw236
  - name: mcxw716c
  - name: mcxw727c
  - name: mimx8ml8
  - name: mimx8mm6
  - name: mimx8mn6
  - name: mimx8mq6
  - name: mimx8qm6
  - name: mimx8qx6
  - name: mimx8ud7
  - name: mimx9111
  - name: mimx9131
  - name: mimx9352
  - name: mimx94398
  - name: mimx9596
  - name: mimxrt1011
  - name: mimxrt1015
  - name: mimxrt1021
  - name: mimxrt1024
  - name: mimxrt1042
  - name: mimxrt1052
  - name: mimxrt1062
  - name: mimxrt1064
  - name: mimxrt1166
  - name: mimxrt1176
  - name: mimxrt1189
  - name: mimxrt595s
  - name: mimxrt685s
  - name: mimxrt798s
  - name: rw610
  - name: rw612
```

## boards/vng/nrf51_vbluno51/board.yml
```yaml
board:
  name: nrf51_vbluno51
  vendor: VNG Corporation
  socs:
  - name: nrf51822
```

## boards/vngiotlab/nrf51_vbluno51/Kconfig.nrf51_vbluno51
```kconfig
# nRF51-VBLUNO51 board configuration

# Copyright (c) 2017 VNG IoT Lab Limited.
# SPDX-License-Identifier: Apache-2.0

config BOARD_NRF51_VBLUNO51
	select SOC_NRF51822_QFAC
```

## boards/vngiotlab/nrf51_vbluno51/board.yml
```yaml
board:
  name: nrf51_vbluno51
  full_name: nRF51-VBLUno51
  vendor: vngiotlab
  socs:
  - name: nrf51822
```

## boards/vngiotlab/nrf52_vbluno52/Kconfig.defconfig
```kconfig
# nRF52 VBLUno52 board configuration

# Copyright (c) 2017 VNG IoT Lab
# SPDX-License-Identifier: Apache-2.0

if BOARD_NRF52_VBLUNO52

config BT_CTLR
	default BT

endif # BOARD_NRF52_VBLUNO52
```

## boards/vngiotlab/nrf52_vbluno52/Kconfig.nrf52_vbluno52
```kconfig
# nRF52 VBLUno52 board configuration
# Copyright (c) 2017 VNG IoT Lab

# SPDX-License-Identifier: Apache-2.0

config BOARD_NRF52_VBLUNO52
	select SOC_NRF52832_QFAA
```

## boards/vngiotlab/nrf52_vbluno52/board.yml
```yaml
board:
  name: nrf52_vbluno52
  full_name: nRF52-VBLUno52
  vendor: vngiotlab
  socs:
  - name: nrf52832
```

## boards/waveshare/esp32c5_zero/Kconfig.esp32c5_zero
```kconfig
# ESP32-C5-Zero board configuration

# Copyright (c) 2026 Espressif Systems (Shanghai) Co., Ltd.
# SPDX-License-Identifier: Apache-2.0

config BOARD_ESP32C5_ZERO
	select SOC_ESP32C5
	select SOC_ESP32C5_HPCORE if BOARD_ESP32C5_ZERO_ESP32C5_HPCORE
	select SOC_ESP32C5_LPCORE if BOARD_ESP32C5_ZERO_ESP32C5_LPCORE
```

## boards/waveshare/esp32c5_zero/board.yml
```yaml
board:
  name: esp32c5_zero
  full_name: ESP32-C5-Zero
  vendor: waveshare
  socs:
  - name: esp32c5
```

## boards/waveshare/esp32c6_lcd_1_47/Kconfig
```kconfig
# Copyright (c) 2026 Shankar Sridhar
# SPDX-License-Identifier: Apache-2.0

config HEAP_MEM_POOL_ADD_SIZE_BOARD
	int
	default 4096 if BOARD_ESP32C6_LCD_1_47_ESP32C6_HPCORE
```
