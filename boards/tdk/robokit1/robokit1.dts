/*
 * Copyright (c) 2022 Intel Corporation
 * Copyright (c) 2024 Gerson Fernando Budke
 *
 * SPDX-License-Identifier: Apache-2.0
 */

/dts-v1/;

#include <atmel/same70q21b.dtsi>

#include "robokit1-common.dtsi"

/ {
	model = "TDK RoboKit1";
	compatible = "tdk,robokit1", "atmel,same70q21b", "atmel,same70";
};
