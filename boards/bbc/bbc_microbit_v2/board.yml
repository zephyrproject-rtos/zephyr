## boards/bbc/microbit/Kconfig.bbc_microbit
```kconfig
# nRF51 BBC_MICROBIT board configuration

# Copyright (c) 2016 Nordic Semiconductor ASA.
# SPDX-License-Identifier: Apache-2.0

config BOARD_BBC_MICROBIT
	select SOC_NRF51822_QFAA
```

## boards/bbc/microbit/bbc_microbit_defconfig
```kconfig
# SPDX-License-Identifier: Apache-2.0

# Enable GPIO
CONFIG_GPIO=y

# Enable uart driver
CONFIG_SERIAL=y

# Enable console
CONFIG_CONSOLE=y
CONFIG_UART_CONSOLE=y
```

## boards/bbc/microbit/bbc_microbit_nrf51822_defconfig
```kconfig
# SPDX-License-Identifier: Apache-2.0

# Enable GPIO
CONFIG_GPIO=y

# Clock control
CONFIG_CLOCK_CONTROL_NRF_K32SRC_RC=y
CONFIG_CLOCK_CONTROL_NRF_K32SRC_250PPM=y

# Enable uart driver
CONFIG_SERIAL=y

# Enable console
CONFIG_CONSOLE=y
CONFIG_UART_CONSOLE=y
```

## boards/bbc/microbit/board.yml
```yaml
board:
  name: bbc_microbit
  full_name: "micro:bit"
  vendor: bbc
  socs:
  - name: nrf51822
```

## boards/bbc/microbit_v2/Kconfig.bbc_microbit_v2
```kconfig
# nRF52 BBC_MICROBIT_V2 board configuration

# Copyright (c) 2020 Lingao Meng
# SPDX-License-Identifier: Apache-2.0

config BOARD_BBC_MICROBIT_V2
	select SOC_NRF52833_QIAA
```

## boards/bbc/microbit_v2/Kconfig.defconfig
```kconfig
# nRF52 BBC_MICROBIT_V2 board configuration

# Copyright (c) 2020 Lingao Meng
# SPDX-License-Identifier: Apache-2.0

if BOARD_BBC_MICROBIT_V2

config BT_CTLR
	default BT

endif # BOARD_BBC_MICROBIT_V2
```

## boards/bbc/microbit_v2/bbc_microbit_v2_defconfig
```kconfig
# SPDX-License-Identifier: Apache-2.0

# enable GPIO
CONFIG_GPIO=y

# clock control
CONFIG_CLOCK_CONTROL_NRF_K32SRC_RC=y
CONFIG_CLOCK_CONTROL_NRF_K32SRC_250PPM=y

# enable uart driver
CONFIG_SERIAL=y

# enable console
CONFIG_CONSOLE=y
CONFIG_UART_CONSOLE=y
```

## boards/bbc/microbit_v2/board.yml
```yaml
board:
  name: bbc_microbit_v2
  full_name: "micro:bit V2"
  vendor: bbc
  socs:
  - name: nrf52833
```

## boards/bcdevices/plt_demo_v2/Kconfig.blueclover_plt_demo_v2
```kconfig
# Blue Clover PLT Demo V2 Configuration

# Copyright (c) 2021 Blue Clover
# SPDX-License-Identifier: Apache-2.0

config BOARD_BLUECLOVER_PLT_DEMO_V2
	select SOC_NRF52832_QFAA
```

## boards/bcdevices/plt_demo_v2/Kconfig.defconfig
```kconfig
# Blue Clover PLT Demo V2 Configuration

# Copyright (c) 2021 Blue Clover
# SPDX-License-Identifier: Apache-2.0

if BOARD_BLUECLOVER_PLT_DEMO_V2_NRF52832

config BT_CTLR
	default BT

config I2C
	default SENSOR

endif # BOARD_BLUECLOVER_PLT_DEMO_V2_NRF52832
```

## boards/bcdevices/plt_demo_v2/blueclover_plt_demo_v2_nrf52832_defconfig
```kconfig
# Kconfig - Blue Clover PLT Demo V2 Configuration
#
# Copyright (c) 2021 Blue Clover
#
# SPDX-License-Identifier: Apache-2.0

# Enable MPU
CONFIG_ARM_MPU=y

# Enable RTT
CONFIG_USE_SEGGER_RTT=y

# enable GPIO
CONFIG_GPIO=y

# enable uart driver
CONFIG_SERIAL=y

# enable console
CONFIG_CONSOLE=y
CONFIG_UART_CONSOLE=y
```

## boards/bcdevices/plt_demo_v2/board.yml
```yaml
board:
  name: blueclover_plt_demo_v2
  full_name: Blue Clover PLT Demo V2 nRF52832
  vendor: bcdevices
  socs:
  - name: nrf52832
```

## boards/beagle/beaglebadge/Kconfig.beaglebadge
```kconfig
# BeagleBoard.org BeagleBadge
#
# Copyright (c) 2025 Texas Instruments Incorporated
#
# SPDX-License-Identifier: Apache-2.0

config BOARD_BEAGLEBADGE
	select SOC_AM62L3_A53
```

## boards/beagle/beaglebadge/beaglebadge_am62l3_a53_defconfig
```kconfig
# BeagleBoard.org BeagleBadge
#
# Copyright (c) 2025 Texas Instruments Incorporated
#
# SPDX-License-Identifier: Apache-2.0

CONFIG_XIP=n

# GPIO Driver
CONFIG_GPIO=y

# Serial Driver
CONFIG_SERIAL=y

# Enable Console
CONFIG_CONSOLE=y
CONFIG_UART_CONSOLE=y
CONFIG_UART_INTERRUPT_DRIVEN=y

# ARM Options
CONFIG_AARCH64_IMAGE_HEADER=y
CONFIG_ARMV8_A_NS=y
CONFIG_ARM64_VA_BITS_36=y
CONFIG_ARM64_PA_BITS_36=y

# Cache Options
CONFIG_CACHE_MANAGEMENT=y
CONFIG_DCACHE_LINE_SIZE_DETECT=y
CONFIG_ICACHE_LINE_SIZE_DETECT=y

# Multicore Support
CONFIG_SMP=y
CONFIG_PM_CPU_OPS=y
CONFIG_MP_MAX_NUM_CPUS=2

CONFIG_PM_CPU_OPS=y
CONFIG_PM_CPU_OPS_PSCI=y
CONFIG_POWEROFF=y
```

## boards/beagle/beaglebadge/board.yml
```yaml
board:
  name: beaglebadge
  full_name: BeagleBadge
  vendor: beagle
  socs:
  - name: am62l3
```

## boards/beagle/beaglebone_ai64/board.yml
```yaml
board:
  name: beaglebone_ai64
  full_name: BeagleBone AI-64
  vendor: beagle
  socs:
  - name: j721e
```

## boards/beagle/beagleconnect_freedom/Kconfig.beagleconnect_freedom
```kconfig
# BeagleConnect Freedom board configuration

# Copyright (c) 2020 Erik Larson
# Copyright (c) 2021 Jason Kridner, BeagleBoard.org Foundation
# SPDX-License-Identifier: Apache-2.0

config BOARD_BEAGLECONNECT_FREEDOM
	select SOC_CC1352P7 if BOARD_BEAGLECONNECT_FREEDOM_CC1352P7
	select SOC_CC1352P if BOARD_BEAGLECONNECT_FREEDOM_CC1352P
```

## boards/beagle/beagleconnect_freedom/Kconfig.sysbuild
```kconfig
# Copyright (c) 2025 Ayush Singh, BeagleBoard.org Foundation
# SPDX-License-Identifier: Apache-2.0

if BOOTLOADER_MCUBOOT

choice MCUBOOT_MODE
	prompt "Mode of operation"
	default MCUBOOT_MODE_SWAP_SCRATCH

endchoice

endif # BOOTLOADER_MCUBOOT
```

## boards/beagle/beagleconnect_freedom/beagleconnect_freedom_defconfig
```kconfig
#
# Copyright (c) 2020 Erik Larson
# Copyright (c) 2020 Jason Kridner, BeagleBoard.org Foundation
#
# SPDX-License-Identifier: Apache-2.0
#

CONFIG_GPIO=y
CONFIG_PINCTRL=y

CONFIG_BUILD_OUTPUT_HEX=y
# custom callback for the antenna switch
CONFIG_CC13X2_CC26X2_HAS_CUSTOM_RF_HWATTRS=y
CONFIG_CC13X2_CC26X2_BOOTLOADER_ENABLE=y
CONFIG_CC13X2_CC26X2_BOOTLOADER_BACKDOOR_ENABLE=y
CONFIG_CC13X2_CC26X2_BOOTLOADER_BACKDOOR_PIN=15
# Enable MPU and hardware stack protection
CONFIG_ARM_MPU=y
CONFIG_HW_STACK_PROTECTION=y

# Enable default uart console
CONFIG_SERIAL=y
CONFIG_CONSOLE=y
CONFIG_UART_CONSOLE=y

# Adjust for oscillator capacitors
CONFIG_CC13X2_CC26X2_XOSC_CAPARRAY_DELTA=0x02
```

## boards/beagle/beagleconnect_freedom/board.yml
```yaml
board:
  name: beagleconnect_freedom
  full_name: BeagleConnect Freedom
  vendor: beagle
  socs:
    - name: cc1352p
    - name: cc1352p7
  revision:
    format: custom
    exact: true
    revisions:
      - name: "C5"
      - name: "C7"
```

## boards/beagle/beagleconnect_zepto/Kconfig.beagleconnect_zepto
```kconfig
# SPDX-FileCopyrightText: Copyright 2026 BeagleBoard.org Foundation
# SPDX-License-Identifier: Apache-2.0

config BOARD_BEAGLECONNECT_ZEPTO
	select SOC_MSPM0L1117
```

## boards/beagle/beagleconnect_zepto/beagleconnect_zepto_defconfig
```kconfig
# BeagleBoard.org BeagleConnect Zepto
#
# SPDX-FileCopyrightText: Copyright 2026 BeagleBoard.org Foundation
#
# SPDX-License-Identifier: Apache-2.0

CONFIG_CLOCK_CONTROL=y

# Enable Console
CONFIG_SERIAL=y
CONFIG_UART_CONSOLE=y
CONFIG_CONSOLE=y
```

## boards/beagle/beagleconnect_zepto/board.yml
```yaml
# SPDX-FileCopyrightText: Copyright 2026 BeagleBoard.org Foundation
#
# SPDX-License-Identifier: Apache-2.0

board:
  name: beagleconnect_zepto
  full_name: BeagleConnect Zepto
  vendor: beagle
  socs:
    - name: mspm0l1117
```

## boards/beagle/beagleplay/Kconfig.beagleplay
```kconfig
# BeaglePlay board configuration

# Copyright (c) 2020 Erik Larson
# Copyright (c) 2021-2022 Jason Kridner, BeagleBoard.org Foundation
# Copyright (c) 2024 Ayush Singh, BeagleBoard.org Foundation
# SPDX-License-Identifier: Apache-2.0

config BOARD_BEAGLEPLAY
	select SOC_CC1352P7 if BOARD_BEAGLEPLAY_CC1352P7
	help
	  BeagleBoard.org BeaglePlay CC1352P7
```
