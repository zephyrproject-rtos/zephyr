## boards/aifoundry/erbium/Kconfig.erbium
```kconfig
# Copyright (c) 2026 AIFoundry
# SPDX-License-Identifier: Apache-2.0

config BOARD_ERBIUM
	select SOC_ERBIUM
```

## boards/aifoundry/erbium/board.yml
```yaml
board:
  name: erbium
  full_name: Erbium
  vendor: aifoundry
  socs:
  - name: erbium
```

## boards/aifoundry/erbium/erbium_defconfig
```kconfig
# Copyright (c) 2026 AIFoundry
# SPDX-License-Identifier: Apache-2.0

CONFIG_FPU=y
CONFIG_FPU_SHARING=y

CONFIG_SYS_CLOCK_TICKS_PER_SEC=1000
CONFIG_XIP=n

CONFIG_RISCV_MACHINE_TIMER=y
CONFIG_PLIC=y
CONFIG_RISCV_TRAP_HANDLER_ALIGNMENT=4096
```

## boards/aithinker/ai_m62_12f/Kconfig.ai_m62_12f
```kconfig
# Copyright (c) 2024-2025 MASSDRIVER EI (massdriver.space)
#
# SPDX-License-Identifier: Apache-2.0

config BOARD_AI_M62_12F
	select SOC_BL616C50Q2I
```

## boards/aithinker/ai_m62_12f/board.yml
```yaml
board:
  name: ai_m62_12f
  full_name: Ai-Thinker M62-12F development board
  vendor: aithinker
  socs:
    - name: bl616c50q2i
```

## boards/aithinker/ai_m64p_32s_kit/Kconfig.ai_m64p_32s_kit
```kconfig
# Copyright (c) 2026 MASSDRIVER EI (massdriver.space)
#
# SPDX-License-Identifier: Apache-2.0

config BOARD_AI_M64P_32S_KIT
	select SOC_BL616CL4855
```

## boards/aithinker/ai_m64p_32s_kit/board.yml
```yaml
board:
  name: ai_m64p_32s_kit
  full_name: Ai-Thinker M64P-32S Development Board
  vendor: aithinker
  socs:
    - name: bl616cl4855
```

## boards/aithinker/ai_wb2_12f/Kconfig.ai_wb2_12f
```kconfig
# Copyright (c) 2024-2025 MASSDRIVER EI (massdriver.space)
#
# SPDX-License-Identifier: Apache-2.0

config BOARD_AI_WB2_12F
	select SOC_BL602C00Q2I
```

## boards/aithinker/ai_wb2_12f/board.yml
```yaml
board:
  name: ai_wb2_12f
  full_name: Ai-Thinker WB2-12F development board
  vendor: aithinker
  socs:
    - name: bl602c00q2i
```

## boards/aithinker/ai_wb2_12f_kit/ai_wb2_12f_kit_defconfig
```kconfig
# Copyright (c) 2024-2025 MASSDRIVER EI (massdriver.space)
#
# SPDX-License-Identifier: Apache-2.0

CONFIG_CONSOLE=y
CONFIG_SERIAL=y

CONFIG_UART_CONSOLE=y
```

## boards/aithinker/aipi_eyes_s2/Kconfig.aipi_eyes_s2
```kconfig
# Copyright (c) 2024-2026 MASSDRIVER EI (massdriver.space)
#
# SPDX-License-Identifier: Apache-2.0

config BOARD_AIPI_EYES_S2
	select SOC_BL618M05Q2I
```

## boards/aithinker/aipi_eyes_s2/Kconfig.defconfig
```kconfig
# Copyright (c) 2024-2026 MASSDRIVER EI (massdriver.space)
#
# SPDX-License-Identifier: Apache-2.0

if BOARD_AIPI_EYES_S2

configdefault CONSOLE
	default y

configdefault SERIAL
	default y

configdefault UART_CONSOLE
	default y

configdefault MEMC
	default y

endif
```

## boards/aithinker/aipi_eyes_s2/board.yml
```yaml
board:
  name: aipi_eyes_s2
  full_name: AiPi-Eyes-S2 Multi-Functional Development Board
  vendor: aithinker
  socs:
    - name: bl618m05q2i
      variants:
        - name: "safe_overclock"
        - name: "unsafe_overclock"
```

## boards/aithinker/esp32_cam/Kconfig
```kconfig
# Copyright (c) 2025 Muhammad Waleed Badar
# SPDX-License-Identifier: Apache-2.0

config HEAP_MEM_POOL_ADD_SIZE_BOARD
	int
	default 4096 if BOARD_ESP32_CAM_ESP32_PROCPU
	default 256 if BOARD_ESP32_CAM_ESP32_APPCPU
```

## boards/aithinker/esp32_cam/Kconfig.esp32_cam
```kconfig
# Copyright (c) 2025 Muhammad Waleed Badar
# SPDX-License-Identifier: Apache-2.0

config BOARD_ESP32_CAM
	select SOC_ESP32_WROVER_E_N4R8
	select SOC_ESP32_PROCPU if BOARD_ESP32_CAM_ESP32_PROCPU
	select SOC_ESP32_APPCPU if BOARD_ESP32_CAM_ESP32_APPCPU
```

## boards/aithinker/esp32_cam/board.yml
```yaml
board:
  name: esp32_cam
  full_name: Ai-Thinker ESP32-CAM
  vendor: aithinker
  socs:
  - name: esp32
```

## boards/aithinker/esp32_cam/esp32_cam_procpu_defconfig
```kconfig
# Copyright (c) 2025 Muhammad Waleed Badar
# SPDX-License-Identifier: Apache-2.0

CONFIG_CONSOLE=y
CONFIG_SERIAL=y
CONFIG_UART_CONSOLE=y

CONFIG_GPIO=y
```

## boards/alientek/dnesp32s3b/Kconfig.dnesp32s3b
```kconfig
# Copyright (c) 2024 Joel Guittet
# Copyright (c) 2025 Chen Xingyu <hi@xingrz.me>
# SPDX-License-Identifier: Apache-2.0

config BOARD_DNESP32S3B
	select SOC_ESP32S3_WROOM_N16R8
	select SOC_ESP32S3_PROCPU if BOARD_DNESP32S3B_ESP32S3_PROCPU
	select SOC_ESP32S3_APPCPU if BOARD_DNESP32S3B_ESP32S3_APPCPU
```

## boards/alientek/dnesp32s3b/board.yml
```yaml
board:
  name: dnesp32s3b
  full_name: DNESP32S3B
  vendor: alientek
  socs:
    - name: esp32s3
```

## boards/alientek/dnn647/Kconfig.defconfig
```kconfig
# SPDX-FileCopyrightText: Copyright The Zephyr Project Contributors
# SPDX-License-Identifier: Apache-2.0

if BOARD_DNN647

# Enable MEMC subsystem when the HyperRAM DT node is active so that
# CONFIG_MEMC_STM32_XSPI_HYPERRAM defaults to y automatically.
config MEMC
	default y if DT_HAS_ST_STM32_XSPI_HYPERRAM_ENABLED

endif # BOARD_DNN647
```

## boards/alientek/dnn647/Kconfig.dnn647
```kconfig
# Copyright (c) 2026 The Zephyr Project Contributors
# SPDX-License-Identifier: Apache-2.0

config BOARD_DNN647
	select SOC_STM32N647XX
```

## boards/alientek/dnn647/Kconfig.sysbuild
```kconfig
# SPDX-FileCopyrightText: Copyright The Zephyr Project Contributors
# SPDX-License-Identifier: Apache-2.0

if BOARD_DNN647_STM32N647XX

choice BOOTLOADER
	default BOOTLOADER_MCUBOOT
endchoice

endif
```

## boards/alientek/dnn647/board.yml
```yaml
board:
  name: dnn647
  full_name: STM32N647 DNN647
  vendor: alientek
  socs:
    - name: stm32n647xx
      variants:
        - name: sb
```

## boards/alientek/dnn647/dnn647_defconfig
```kconfig
# SPDX-License-Identifier: Apache-2.0

CONFIG_SERIAL=y
CONFIG_GPIO=y
CONFIG_CONSOLE=y
CONFIG_UART_CONSOLE=y
CONFIG_ARM_MPU=y
CONFIG_HW_STACK_PROTECTION=y
CONFIG_TRUSTED_EXECUTION_SECURE=y
CONFIG_XIP=n

# Display/LTDC configuration for RGB LCD
CONFIG_DISPLAY=y
CONFIG_STM32_LTDC=y
CONFIG_STM32_LTDC_RGB888=y
CONFIG_STM32_LTDC_FB_NUM=1

# DMA
CONFIG_DMA=y
```

## boards/alientek/dnn647/dnn647_stm32n647xx_sb_defconfig
```kconfig
# SPDX-License-Identifier: Apache-2.0

CONFIG_SERIAL=y
CONFIG_GPIO=y
CONFIG_CONSOLE=y
CONFIG_UART_CONSOLE=y
CONFIG_ARM_MPU=y
CONFIG_HW_STACK_PROTECTION=y
CONFIG_TRUSTED_EXECUTION_SECURE=y
CONFIG_STM32N6_BOOT_SERIAL=y
CONFIG_XIP=n
```
