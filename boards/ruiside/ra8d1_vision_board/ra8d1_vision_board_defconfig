## boards/ruiside/ra8d1_vision_board/ra8d1_vision_board_defconfig
```kconfig
# Copyright (c) 2025 Shan Pen <bricle031@gmail.com>
# SPDX-License-Identifier: Apache-2.0

# Enable GPIO
CONFIG_GPIO=y

# Enable Console
CONFIG_SERIAL=y
CONFIG_UART_CONSOLE=y
CONFIG_UART_INTERRUPT_DRIVEN=y
CONFIG_CONSOLE=y
```

## boards/ruiside/ra8p1_titan/board.yml
```yaml
board:
  name: ra8p1_titan
  full_name: RA8P1 Titan
  vendor: ruiside
  socs:
  - name: r7ka8p1kflcac
```

## boards/ruiside/ra8p1_titan_mini/Kconfig.ra8p1_titan_mini
```kconfig
# Copyright The Zephyr Project Contributors
# SPDX-License-Identifier: Apache-2.0

config BOARD_RA8P1_TITAN_MINI
	select SOC_R7KA8P1KFLCAC_CM85 if BOARD_RA8P1_TITAN_MINI_R7KA8P1KFLCAC_CM85
	select SOC_R7KA8P1KFLCAC_CM33 if BOARD_RA8P1_TITAN_MINI_R7KA8P1KFLCAC_CM33
```

## boards/ruiside/ra8p1_titan_mini/board.yml
```yaml
board:
  name: ra8p1_titan_mini
  full_name: RA8P1 Titan Mini
  vendor: ruiside
  socs:
  - name: r7ka8p1kflcac
```

## boards/ruuvi/ruuvi_ruuvitag/ruuvi_ruuvitag_defconfig
```kconfig
# Copyright (c) 2020 Ruuvi Innovations Ltd (Oy)
# SPDX-License-Identifier: Apache-2.0

# Enable MPU
CONFIG_ARM_MPU=y

# Enable console
CONFIG_CONSOLE=y
CONFIG_UART_CONSOLE=y
CONFIG_SERIAL=y

# Enable RTT
CONFIG_USE_SEGGER_RTT=y

# Enable GPIO
CONFIG_GPIO=y

CONFIG_PINCTRL=y
```

## boards/ruuvi/ruuvitag/Kconfig.defconfig
```kconfig
# Ruuvi RuuviTag configuration

# Copyright (c) 2020 Ruuvi Innovations Ltd (Oy)
# SPDX-License-Identifier: Apache-2.0

if BOARD_RUUVI_RUUVITAG

config SPI
	default y

endif # BOARD_RUUVI_RUUVITAG
```

## boards/ruuvi/ruuvitag/Kconfig.ruuvi_ruuvitag
```kconfig
# Copyright (c) 2020 Ruuvi Innovations Ltd (Oy)
# SPDX-License-Identifier: Apache-2.0

config BOARD_RUUVI_RUUVITAG
	select SOC_NRF52832_QFAA
```

## boards/ruuvi/ruuvitag/board.yml
```yaml
board:
  name: ruuvi_ruuvitag
  full_name: RuuviTag
  vendor: ruuvi
  socs:
  - name: nrf52832
```

## boards/sc/scobc_a1/Kconfig.defconfig
```kconfig
# SC-OBC Module A1

# Copyright (c) 2021 Space Cubics <yashi@spacecubics.com>
# SPDX-License-Identifier: Apache-2.0

if BOARD_SCOBC_A1

config CPU_CORTEX_M_HAS_SYSTICK
	default y

config CPU_HAS_ARM_MPU
	default y

config NUM_IRQS
	default 32

endif # BOARD_SCOBC_A1
```

## boards/sc/scobc_a1/Kconfig.scobc_a1
```kconfig
# SC-OBC Module A1 configuration

# Copyright (c) 2021 Space Cubics, LLC. <yashi@spacecubics.com>
# SPDX-License-Identifier: Apache-2.0

config BOARD_SCOBC_A1
	select SOC_DESIGNSTART_FPGA_CORTEX_M3
```

## boards/sc/scobc_a1/board.yml
```yaml
board:
  name: scobc_a1
  full_name: SC-OBC Module A1
  vendor: sc
  revision:
    format: major.minor.patch
    default: 2.0.0
    revisions:
      - name: 1.0.0
      - name: 2.0.0
  socs:
    - name: designstart_fpga_cortex_m3
```

## boards/sc/scobc_a1/dts/bindings/sc,sysmon.yaml
```yaml
# Copyright (c) 2025 Space Cubics Inc.
# SPDX-License-Identifier: Apache-2.0

description: SC-OBC Module A1 System Monitor

compatible: "sc,sysmon"

include: base.yaml

properties:
  reg:
    required: true
```

## boards/sc/scobc_a1/dts/bindings/sc,sysreg.yaml
```yaml
# Copyright (c) 2025 Space Cubics Inc.
# SPDX-License-Identifier: Apache-2.0

description: SC-OBC Module A1 System Register

compatible: "sc,sysreg"

include: base.yaml

properties:
  reg:
    required: true
```

## boards/sc/scobc_module1/Kconfig.defconfig
```kconfig
# Space Cubics OBC module 1

# Copyright (c) 2021 Space Cubics <yashi@spacecubics.com>
# SPDX-License-Identifier: Apache-2.0

if BOARD_SCOBC_MODULE1

config CPU_CORTEX_M_HAS_SYSTICK
	default y

config CPU_HAS_ARM_MPU
	default y

config NUM_IRQS
	default 7

endif # BOARD_SCOBC_MODULE1
```

## boards/sc/scobc_module1/Kconfig.scobc_module1
```kconfig
# Space Cubics OBC module 1 configuration

# Copyright (c) 2021 Space Cubics, LLC. <yashi@spacecubics.com>
# SPDX-License-Identifier: Apache-2.0

config BOARD_SCOBC_MODULE1
	select SOC_DESIGNSTART_FPGA_CORTEX_M3
```

## boards/sc/scobc_module1/board.yml
```yaml
board:
  name: scobc_module1
  full_name: OBC module 1
  vendor: spacecubics
  socs:
  - name: designstart_fpga_cortex_m3
```

## boards/sc/scobc_module1/scobc_module1_defconfig
```kconfig
# SPDX-License-Identifier: Apache-2.0

CONFIG_SYS_CLOCK_HW_CYCLES_PER_SEC=48000000
CONFIG_ARM_MPU=n

CONFIG_SERIAL=y
CONFIG_UART_INTERRUPT_DRIVEN=y
CONFIG_CONSOLE=y
CONFIG_UART_CONSOLE=y

CONFIG_XIP=n
CONFIG_FLASH_SIZE=0
CONFIG_FLASH_BASE_ADDRESS=0x0
```

## boards/sc/scobc_v1/Kconfig.scobc_v1
```kconfig
#
# Copyright (c) 2025 Space Cubics Inc.
#
# SPDX-License-Identifier: Apache-2.0
#

config BOARD_SCOBC_V1
	select SOC_VERSAL_RPU if BOARD_SCOBC_V1_VERSAL_RPU
	select SOC_MIV if BOARD_SCOBC_V1_MIV
```

## boards/sc/scobc_v1/board.yml
```yaml
board:
  name: scobc_v1
  full_name: SC-OBC Module V1
  vendor: sc
  socs:
  - name: versal_rpu
```

## boards/sc/scobc_v1/scobc_v1_miv_defconfig
```kconfig
CONFIG_SERIAL=y
CONFIG_CONSOLE=y
CONFIG_UART_CONSOLE=y
CONFIG_PRINTK=y
CONFIG_XIP=n
```

## boards/sc/scobc_v1/scobc_v1_versal_rpu_defconfig
```kconfig
# Enable UART driver
CONFIG_SERIAL=y

# Enable console
CONFIG_CONSOLE=y
CONFIG_UART_CONSOLE=y

# Run XIP from TCM ROM
CONFIG_XIP=y
```

## boards/scdz/ch32v307evt/Kconfig.ch32v307evt
```kconfig
# Copyright (c) 2025 Thomas Boje
# SPDX-License-Identifier: Apache-2.0

config BOARD_CH32V307EVT
	select SOC_CH32V307
```

## boards/scdz/ch32v307evt/board.yml
```yaml
board:
  name: ch32v307evt
  full_name: SCDZ_CH32V307EVT
  vendor: scdz
  socs:
    - name: ch32v307
```

## boards/seagate/faze/Kconfig.faze
```kconfig
# Copyright (c) 2020, Seagate Technology LLC
# SPDX-License-Identifier: Apache-2.0

config BOARD_FAZE
	select SOC_LPC11U67
```
