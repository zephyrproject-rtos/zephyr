## boards/nuvoton/npck6m9k_evb/Kconfig.npck6m9k_evb
```kconfig
# Copyright (c) 2026 Nuvoton Technology Corporation.
# SPDX-License-Identifier: Apache-2.0

config BOARD_NPCK6M9K_EVB
	select SOC_NPCK6M9K
```

## boards/nuvoton/npck6m9k_evb/board.yml
```yaml
board:
  name: npck6m9k_evb
  full_name: NPCK6M9K_EVB
  vendor: nuvoton
  socs:
  - name: npck6m9k
```

## boards/nuvoton/npcm400_evb/npcm400_evb_defconfig
```kconfig
# Copyright (c) 2024 Nuvoton Technology Corporation.
#
# SPDX-License-Identifier: Apache-2.0

CONFIG_SRAM_VECTOR_TABLE=y

# General Kernel Options
CONFIG_XIP=y

# Clock Driver
CONFIG_CLOCK_CONTROL=y
CONFIG_CLOCK_CONTROL_NPCM=y

# Pinctrl Driver
CONFIG_PINCTRL_NPCM=y

# UART Driver
CONFIG_SERIAL=y

# Console Driver
CONFIG_CONSOLE=y
CONFIG_UART_CONSOLE=y
```

## boards/nuvoton/numaker_m483kg/Kconfig.numaker_m483kg
```kconfig
# Copyright The Zephyr Project Contributors
# SPDX-License-Identifier: Apache-2.0

config BOARD_NUMAKER_M483KG
	select SOC_M483
```

## boards/nuvoton/numaker_m483kg/board.yml
```yaml
board:
  name: numaker_m483kg
  full_name: NuMaker-M483KG
  vendor: nuvoton
  socs:
  - name: m483
```

## boards/nuvoton/numaker_m5531/Kconfig.defconfig
```kconfig
# SPDX-License-Identifier: Apache-2.0
#
# Nuvoton NuMaker M5531 board configuration
#
# Copyright (c) 2025 Nuvoton Technology Corporation.

if BOARD_NUMAKER_M5531

configdefault ETH_DRIVER
	default y if !MODEM

endif # BOARD_NUMAKER_M5531
```

## boards/nuvoton/numaker_m55m1/Kconfig.defconfig
```kconfig
# SPDX-License-Identifier: Apache-2.0
#
# Nuvoton NuMaker M55M1 board configuration
#
# Copyright (c) 2025 Nuvoton Technology Corporation.

if BOARD_NUMAKER_M55M1

configdefault ETH_DRIVER
	default y if !MODEM

endif # BOARD_NUMAKER_M55M1
```

## boards/nuvoton/numaker_pfm_m467/Kconfig.defconfig
```kconfig
# SPDX-License-Identifier: Apache-2.0
#
# Nuvoton PFM M467 board configuration
#
# Copyright (c) 2023 Nuvoton Technology Corporation.

if BOARD_NUMAKER_PFM_M467

configdefault ETH_DRIVER
	default y if !MODEM

endif # BOARD_NUMAKER_PFM_M467
```

## boards/nuvoton/numaker_pfm_m487/numaker_pfm_m487_defconfig
```kconfig
# SPDX-License-Identifier: Apache-2.0

# Enable MPU
CONFIG_ARM_MPU=y

# Enable GPIO driver
CONFIG_GPIO=y

# Enable UART driver
CONFIG_SERIAL=y

# Console
CONFIG_CONSOLE=y
CONFIG_UART_CONSOLE=y

# Enable system clock controller driver
CONFIG_CLOCK_CONTROL=y
CONFIG_CLOCK_CONTROL_NUMICRO_M4_SCC=y

# Enable hex output for openocd
CONFIG_BUILD_OUTPUT_HEX=y
```

## boards/nxp/common/mpu/Kconfig
```kconfig
#
# SPDX-FileCopyrightText: Copyright 2026 NXP
#
# SPDX-License-Identifier: Apache-2.0
#

config BOARD_NXP_SPECIFIC_MPU_SETTINGS
	bool "Board-provided static Arm MPU region table"
	default y if CPU_CORTEX_M7
	help
	  Use the board's static Arm MPU region table instead of the generic
	  SoC fallback. With the Cortex-M7 unmapped-region catch-all enabled,
	  on-chip banks not in the table are unreachable unless an application
	  claims them via a zephyr,memory-attr node. The table only describes
	  the Cortex-M7 memory map, so a board sourcing this file gets it on
	  its Cortex-M7 target only; the choice stays overridable.
```

## boards/nxp/frdm_a_s32k344/Kconfig.defconfig
```kconfig
# Copyright 2023-2024 NXP
# SPDX-License-Identifier: Apache-2.0

if BOARD_FRDM_A_S32K344

if SERIAL

config UART_CONSOLE
	default y

endif # SERIAL

if SPI

config GPIO_INIT_PRIORITY
	default 10

config SPI_INIT_PRIORITY
	default 10

if WDT_NXP_FS26

config WDT_NXP_FS26_INIT_PRIORITY
	default 10

endif # WDT_NXP_FS26

endif # SPI

config NET_L2_ETHERNET
	default y if !NET_LOOPBACK && !NET_TEST

endif # BOARD_FRDM_A_S32K344
```

## boards/nxp/frdm_a_s32k344/board.yml
```yaml
board:
  name: frdm_a_s32k344
  full_name: FRDM-A-S32K344
  vendor: nxp
  socs:
    - name: s32k344
      variants:
        - name: mcuboot
```

## boards/nxp/frdm_imx8mp/Kconfig.frdm_imx8mp
```kconfig
# SPDX-License-Identifier: Apache-2.0
# SPDX-FileCopyrightText: Copyright (c) 2026 Filip Stojanovic <filipembedded@gmail.com>

config BOARD_FRDM_IMX8MP
	select SOC_MIMX8ML8_M7 if BOARD_FRDM_IMX8MP_MIMX8ML8_M7 || BOARD_FRDM_IMX8MP_MIMX8ML8_M7_DDR
	select SOC_PART_NUMBER_MIMX8ML8DVNLZ
```

## boards/nxp/frdm_imx8mp/board.yml
```yaml
# SPDX-License-Identifier: Apache-2.0
# SPDX-FileCopyrightText: Copyright (c) 2026 Filip Stojanovic <filipembedded@gmail.com>

board:
  name: frdm_imx8mp
  full_name: FRDM-IMX8MPLUS
  vendor: nxp
  socs:
  - name: mimx8ml8
    variants:
    - name: ddr
      cpucluster: m7
```

## boards/nxp/frdm_imx8mp/frdm_imx8mp_mimx8ml8_m7_defconfig
```kconfig
# SPDX-License-Identifier: Apache-2.0
# SPDX-FileCopyrightText: Copyright (c) 2026 Filip Stojanovic <filipembedded@gmail.com>

CONFIG_CLOCK_CONTROL=y
CONFIG_SERIAL=y
CONFIG_CONSOLE=y
CONFIG_UART_CONSOLE=y
CONFIG_UART_INTERRUPT_DRIVEN=y
CONFIG_XIP=y
CONFIG_CODE_ITCM=y
```

## boards/nxp/frdm_imx93/board.yml
```yaml
board:
  name: frdm_imx93
  full_name: FRDM-IMX93
  vendor: nxp
  socs:
  - name: mimx9352
    variants:
    - name: smp
      cpucluster: a55
    - name: ddr
      cpucluster: m33
```

## boards/nxp/frdm_imxrt1152/Kconfig.frdm_imxrt1152
```kconfig
# SPDX-FileCopyrightText: Copyright 2026 NXP
# SPDX-License-Identifier: Apache-2.0

config BOARD_FRDM_IMXRT1152
	select SOC_PART_NUMBER_MIMXRT1152XHM8B
```

## boards/nxp/frdm_imxrt1152/board.yml
```yaml
board:
  name: frdm_imxrt1152
  full_name: FRDM-IMXRT1152
  vendor: nxp
  socs:
    - name: mimxrt1152
```

## boards/nxp/frdm_imxrt1186/Kconfig
```kconfig
# Copyright 2026 NXP
# SPDX-License-Identifier: Apache-2.0

config BOARD_FRDM_IMXRT1186
	select BOARD_EARLY_INIT_HOOK

# CM7 execution mode
config CM7_BOOT_FROM_FLASH
	bool "Run CM7 core from Flash (XIP)"
	depends on SECOND_CORE_MCUX && (SOC_MIMXRT1186_CM7 || SOC_MIMXRT1186_CM33)
	default n
	help
	  If enabled, the CM7 core will run directly from flash (XIP).
	  If disabled, the CM7 core will run from ITCM memory.

config BOARD_NXP_SPECIFIC_MPU_SETTINGS
	bool "Use default MPU settings for NXP boards"
	default y if CPU_HAS_CUSTOM_FIXED_SOC_MPU_REGIONS
	help
	  Enable this option to use the default MPU settings for NXP boards.
	  This will configure the MPU regions according to the board's memory
	  map and peripherals.
```

## boards/nxp/frdm_k22f/frdm_k22f_defconfig
```kconfig
#
# Copyright (c) 2018 Prevas A/S
# Copyright (c) 2019 Thomas Burdick <thomas.burdick@gmail.com>

#
# SPDX-License-Identifier: Apache-2.0
#

CONFIG_CONSOLE=y
CONFIG_UART_CONSOLE=y
CONFIG_SERIAL=y
CONFIG_GPIO=y
CONFIG_OSC_LOW_POWER=y
```

## boards/nxp/frdm_k82f/frdm_k82f_defconfig
```kconfig
# SPDX-License-Identifier: Apache-2.0

CONFIG_SERIAL=y
CONFIG_CONSOLE=y
CONFIG_UART_CONSOLE=y
CONFIG_UART_INTERRUPT_DRIVEN=y
CONFIG_GPIO=y
CONFIG_OSC_LOW_POWER=y

# Enable MPU
CONFIG_ARM_MPU=y
CONFIG_HW_STACK_PROTECTION=y
```

## boards/nxp/frdm_mcxa287/Kconfig
```kconfig
# SPDX-FileCopyrightText: Copyright 2026 NXP
# SPDX-License-Identifier: Apache-2.0

config BOARD_FRDM_MCXA287
	select BOARD_EARLY_INIT_HOOK
```

## boards/nxp/frdm_mcxa287/Kconfig.frdm_mcxa287
```kconfig
# SPDX-FileCopyrightText: Copyright 2026 NXP
# SPDX-License-Identifier: Apache-2.0

config BOARD_FRDM_MCXA287
	select SOC_MCXA287
	select SOC_PART_NUMBER_MCXA287VPN
```
