## boards/nuvoton/numaker_m5531/board.yml
```yaml
board:
  name: numaker_m5531
  full_name: NUMAKER M5531
  vendor: nuvoton
  socs:
  - name: m55m1xxx
```

## boards/nuvoton/numaker_m5531/numaker_m5531_defconfig
```kconfig
# SPDX-License-Identifier: Apache-2.0

CONFIG_GPIO=y

# Enable system clock controller driver
CONFIG_CLOCK_CONTROL=y
CONFIG_CLOCK_CONTROL_NUMAKER_SCC=y

# Enable UART driver
CONFIG_SERIAL=y
CONFIG_UART_INTERRUPT_DRIVEN=y

# Console
CONFIG_CONSOLE=y
CONFIG_UART_CONSOLE=y
```

## boards/nuvoton/numaker_m55m1/Kconfig
```kconfig
# SPDX-License-Identifier: Apache-2.0
#
# Nuvoton NuMaker M55M1 board configuration
#
# Copyright (c) 2025 Nuvoton Technology Corporation.

config BOARD_NUMAKER_M55M1
	select SOC_FLASH_NUMAKER
```

## boards/nuvoton/numaker_m55m1/board.yml
```yaml
board:
  name: numaker_m55m1
  full_name: NUMAKER M55M1
  vendor: nuvoton
  socs:
  - name: m55m1xxx
```

## boards/nuvoton/numaker_pfm/Kconfig
```kconfig
# SPDX-License-Identifier: Apache-2.0
#
# Nuvoton PFM M467 board configuration
#
# Copyright (c) 2023 Nuvoton Technology Corporation.

config BOARD_NUMAKER_PFM
	select SOC_FLASH_NUMAKER if BOARD_NUMAKER_PFM_M467
```

## boards/nuvoton/numaker_pfm/Kconfig.numaker_pfm
```kconfig
# SPDX-License-Identifier: Apache-2.0
#
# Nuvoton PFM M467 board configuration
#
# Copyright (c) 2023 Nuvoton Technology Corporation.

config BOARD_NUMAKER_PFM_M467
	bool
	select SOC_M467

config BOARD_NUMAKER_PFM_M487
	bool
	select SOC_M487
```

## boards/nuvoton/numaker_pfm/board.yml
```yaml
board:
  name: numaker_pfm
  vendor: Nuvoton
  socs:
  - name: m467
  - name: m487
```

## boards/nuvoton/numaker_pfm_m467/Kconfig
```kconfig
# SPDX-License-Identifier: Apache-2.0
#
# Nuvoton PFM M467 board configuration
#
# Copyright (c) 2023 Nuvoton Technology Corporation.

config BOARD_NUMAKER_PFM_M467
	select SOC_FLASH_NUMAKER
```

## boards/nuvoton/numaker_pfm_m467/board.yml
```yaml
board:
  name: numaker_pfm_m467
  full_name: NUMAKER PFM M467
  vendor: nuvoton
  socs:
  - name: m467
```

## boards/nuvoton/numaker_pfm_m467/numaker_pfm_m467_defconfig
```kconfig
# SPDX-License-Identifier: Apache-2.0

CONFIG_GPIO=y

# Enable system clock controller driver
CONFIG_CLOCK_CONTROL=y
CONFIG_CLOCK_CONTROL_NUMAKER_SCC=y

# Enable MPU
CONFIG_ARM_MPU=y
CONFIG_SYS_CLOCK_HW_CYCLES_PER_SEC=200000000

# Enable UART driver
CONFIG_SERIAL=y
CONFIG_UART_INTERRUPT_DRIVEN=y

# Console
CONFIG_CONSOLE=y
CONFIG_UART_CONSOLE=y

# Enable FMC
CONFIG_FLASH=y
```

## boards/nuvoton/numaker_pfm_m487/Kconfig.numaker_pfm_m487
```kconfig
# SPDX-License-Identifier: Apache-2.0
#
# Nuvoton PFM M467 board configuration
#
# Copyright (c) 2023 Nuvoton Technology Corporation.

config BOARD_NUMAKER_PFM_M487
	select SOC_M487
```

## boards/nuvoton/numaker_pfm_m487/board.yml
```yaml
board:
  name: numaker_pfm_m487
  full_name: NUMAKER PFM M487
  vendor: nuvoton
  socs:
  - name: m487
```

## boards/nxp/common/Kconfig
```kconfig
# Copyright 2025 NXP
# SPDX-License-Identifier: Apache-2.0

config BOARD_NXP_SPSDK_IMAGE
	bool "Generate bootable firmware image with SPSDK"
	help
	  Generate bootable firmware image with NXP Secure
	  Provisioning SDK (SPSDK).

config BOARD_NXP_LPDDR4
	bool "On-board memory is LPDDR4x memory"
	help
	  The on-board memory is LPDDR4x memory and will use
	  LPDDR4x boot firmware.

config BOARD_NXP_LPDDR5
	bool "On-board memory is LPDDR5 memory"
	help
	  The on-board memory is LPDDR5 memory and will use
	  LPDDR5 boot firmware.
```

## boards/nxp/dk6_qn9090/Kconfig.dk6_qn9090
```kconfig
#
# Copyright (c) 2023 Sendrato
#
# SPDX-License-Identifier: Apache-2.0
#

config BOARD_DK6_QN9090
	bool
	default y
	select SOC_QN9090
	select SOC_PART_NUMBER_QN9090HN
```

## boards/nxp/dk6_qn9090/dk6_qn9090_defconfig
```kconfig
#
# Copyright (c) 2023 Sendrato
#
# SPDX-License-Identifier: Apache-2.0
#

CONFIG_CONSOLE=y
CONFIG_UART_CONSOLE=y
CONFIG_SERIAL=y
CONFIG_UART_INTERRUPT_DRIVEN=y
CONFIG_CORTEX_M_SYSTICK=y
CONFIG_GPIO=y
CONFIG_PINCTRL=y
CONFIG_I2C=y
CONFIG_SYS_CLOCK_HW_CYCLES_PER_SEC=48000000
CONFIG_ARM_MPU=y
CONFIG_HW_STACK_PROTECTION=y
```

## boards/nxp/frdm_imx91/Kconfig.defconfig
```kconfig
# Copyright 2025 NXP
# SPDX-License-Identifier: Apache-2.0

if BOARD_FRDM_IMX91

config GPIO
	default y if IMX_USDHC

if CAN

# CAN Phy must be initialized after board mux
configdefault GPIO_PCA_SERIES_INIT_PRIORITY
	default 60

configdefault CAN_TRANSCEIVER_INIT_PRIORITY
	default 65

endif # CAN

endif # BOARD_FRDM_IMX93
```

## boards/nxp/frdm_imx91/Kconfig.frdm_imx91
```kconfig
# Copyright 2025 NXP
# SPDX-License-Identifier: Apache-2.0

config BOARD_FRDM_IMX91
	select SOC_MIMX9131
	select SOC_PART_NUMBER_MIMX9131CVVXJ
```

## boards/nxp/frdm_imx91/board.yml
```yaml
board:
  name: frdm_imx91
  full_name: FRDM-IMX91
  vendor: nxp
  socs:
  - name: mimx9131
```

## boards/nxp/frdm_imx93/Kconfig
```kconfig
# i.MX 93 FRDM board configuration

# Copyright 2026 NXP
# SPDX-License-Identifier: Apache-2.0

source "boards/nxp/common/Kconfig"
```

## boards/nxp/frdm_imx93/Kconfig.defconfig
```kconfig
# Copyright 2025 NXP
# SPDX-License-Identifier: Apache-2.0

if BOARD_FRDM_IMX93

if BOARD_FRDM_IMX93_MIMX9352_A55

if GPIO

# I2C must be initialized for onboard expanders
config I2C
	default y

endif # GPIO

if CAN

# CAN Phy must be initialized after board mux
config GPIO_PCA_SERIES_INIT_PRIORITY
	default 60

config CAN_TRANSCEIVER_INIT_PRIORITY
	default 65

endif # CAN

configdefault NET_L2_ETHERNET
	default y

configdefault NET_TX_STACK_SIZE
	default 8192

configdefault NET_RX_STACK_SIZE
	default 8192

configdefault NET_TCP_WORKQ_STACK_SIZE
	default 8192

configdefault NET_MGMT_EVENT_STACK_SIZE
	default 8192

configdefault NET_SOCKETS_SERVICE_STACK_SIZE
	default 8192

endif # BOARD_FRDM_IMX93_MIMX9352_A55

if IMX_USDHC

config GPIO
	default y

endif # IMX_USDHC

endif # BOARD_FRDM_IMX93
```

## boards/nxp/frdm_imx93/Kconfig.frdm_imx93
```kconfig
# Copyright 2025 NXP
# SPDX-License-Identifier: Apache-2.0

config BOARD_FRDM_IMX93
	select SOC_MIMX9352_A55 if BOARD_FRDM_IMX93_MIMX9352_A55
	select SOC_PART_NUMBER_MIMX9352DVVXM
```

## boards/nxp/frdm_imxrt1186/Kconfig.defconfig
```kconfig
# FRDM-IMXRT1186 board

# Copyright 2026 NXP
# SPDX-License-Identifier: Apache-2.0

if BOARD_FRDM_IMXRT1186

# Use External Memory Configuration Data (XMCD) by default when booting primary core (M33)
config EXTERNAL_MEM_CONFIG_DATA
	default y if CPU_CORTEX_M33

config NXP_IMX_EXTERNAL_HYPERRAM
	default y if CPU_CORTEX_M33

if DMA

config NOCACHE_MEMORY
	default y

endif # DMA

endif # BOARD_FRDM_IMXRT1186
```

## boards/nxp/frdm_imxrt1186/Kconfig.frdm_imxrt1186
```kconfig
#
# Copyright 2026 NXP
#
# SPDX-License-Identifier: Apache-2.0
#

config BOARD_FRDM_IMXRT1186
	select SOC_PART_NUMBER_MIMXRT1186CVJ8C
	select SOC_MIMXRT1186_CM33 if BOARD_FRDM_IMXRT1186_MIMXRT1186_CM33
	select SOC_MIMXRT1186_CM7 if BOARD_FRDM_IMXRT1186_MIMXRT1186_CM7
```
