## boards/nuvoton/npck3m8k_evb/board.yml
```yaml
board:
  name: npck3m8k_evb
  full_name: NPCK3M8K_EVB
  vendor: nuvoton
  socs:
  - name: npck3m8k
```

## boards/nuvoton/npcm400_evb/Kconfig.defconfig
```kconfig
# Copyright (c) 2024 Nuvoton Technology Corporation.
#
# SPDX-License-Identifier: Apache-2.0

config SYS_CLOCK_TICKS_PER_SEC
	default 1000
```

## boards/nuvoton/npcm400_evb/Kconfig.npcm400_evb
```kconfig
# Copyright (c) 2024 Nuvoton Technology Corporation.
# SPDX-License-Identifier: Apache-2.0

config BOARD_NPCM400_EVB
	select SOC_NPCM400
```

## boards/nuvoton/npcm400_evb/board.yml
```yaml
board:
  name: npcm400_evb
  full_name: NPCM400_EVB
  vendor: nuvoton
  socs:
  - name: npcm400
```

## boards/nuvoton/npcm400f_evb/Kconfig.npcm400f_evb
```kconfig
# Copyright (c) 2024 Nuvoton Technology Corporation.
# SPDX-License-Identifier: Apache-2.0

config BOARD_NPCM400F_EVB
	bool "Nuvoton NPCM400F EVB Development board"
	select SOC_NPCM400F
```

## boards/nuvoton/npcm400f_evb/npcm400f_evb_defconfig
```kconfig
#
# Copyright (c) 2024 Nuvoton Technology Corporation.
#
# SPDX-License-Identifier: Apache-2.0
#

CONFIG_SRAM_VECTOR_TABLE=y
CONFIG_BOOTLOADER_SRAM_SIZE=0
# General Kernel Options
CONFIG_SYS_CLOCK_HW_CYCLES_PER_SEC=96000000
# CONFIG_FLASH_LOAD_OFFSET=0x600
CONFIG_XIP=n

# CONFIG_ARM_MPU=y

# Clock Driver
CONFIG_CLOCK_CONTROL=y
CONFIG_CLOCK_CONTROL_NPCM=y

# Pinctrl Driver
CONFIG_PINCTRL=y
CONFIG_PINCTRL_NPCM=y

# UART Driver
CONFIG_SERIAL=y
CONFIG_UART_INTERRUPT_DRIVEN=y
CONFIG_UART_NPCM=y

# Console Driver
CONFIG_CONSOLE=y
CONFIG_UART_CONSOLE=y

# GPIO Driver
CONFIG_GPIO=y
CONFIG_GPIO_NPCM=y
```

## boards/nuvoton/npcx4m8f_evb/Kconfig.npcx4m8f_evb
```kconfig
# Copyright (c) 2023 Nuvoton Technology Corporation.
# SPDX-License-Identifier: Apache-2.0

config BOARD_NPCX4M8F_EVB
	select SOC_NPCX4M8F
```

## boards/nuvoton/npcx4m8f_evb/board.yml
```yaml
board:
  name: npcx4m8f_evb
  full_name: NPCX4M8F_EVB
  vendor: nuvoton
  socs:
  - name: npcx4m8f
```

## boards/nuvoton/npcx7m6fb_evb/Kconfig.defconfig
```kconfig
# Copyright (c) 2020 Nuvoton Technology Corporation.
# SPDX-License-Identifier: Apache-2.0

config SYS_CLOCK_TICKS_PER_SEC
	default 1000

config INPUT
	default y if KSCAN
```

## boards/nuvoton/npcx7m6fb_evb/Kconfig.npcx7m6fb_evb
```kconfig
# Copyright (c) 2020 Nuvoton Technology Corporation.
# SPDX-License-Identifier: Apache-2.0

config BOARD_NPCX7M6FB_EVB
	select SOC_NPCX7M6FB
```

## boards/nuvoton/npcx7m6fb_evb/board.yml
```yaml
board:
  name: npcx7m6fb_evb
  full_name: NPCX7M6FB_EVB
  vendor: nuvoton
  socs:
  - name: npcx7m6fb
```

## boards/nuvoton/npcx7m6fb_evb/npcx7m6fb_evb_defconfig
```kconfig
#
# Copyright (c) 2020 Nuvoton Technology Corporation.
#
# SPDX-License-Identifier: Apache-2.0
#

# Enable NPCX firmware header
CONFIG_NPCX_HEADER=y
CONFIG_NPCX_IMAGE_OUTPUT_HEX=y
CONFIG_NPCX_HEADER_SPI_MAX_CLOCK_50=y
CONFIG_NPCX_HEADER_SPI_READ_MODE_DUAL=y

# Enable MPU
CONFIG_ARM_MPU=y

# General Kernel Options
CONFIG_SYS_CLOCK_HW_CYCLES_PER_SEC=15000000

# Clock configuration
CONFIG_CLOCK_CONTROL=y

# UART Driver
CONFIG_SERIAL=y
CONFIG_UART_INTERRUPT_DRIVEN=y

# GPIO Driver
CONFIG_GPIO=y

# Console Driver
CONFIG_CONSOLE=y
CONFIG_UART_CONSOLE=y
```

## boards/nuvoton/npcx9m6f_evb/Kconfig.npcx9m6f_evb
```kconfig
# Copyright (c) 2021 Nuvoton Technology Corporation.
# SPDX-License-Identifier: Apache-2.0

config BOARD_NPCX9M6F_EVB
	select SOC_NPCX9M6F
```

## boards/nuvoton/npcx9m6f_evb/board.yml
```yaml
board:
  name: npcx9m6f_evb
  full_name: NPCX9M6F_EVB
  vendor: nuvoton
  socs:
  - name: npcx9m6f
```

## boards/nuvoton/numaker_gai_m55m1/Kconfig.numaker_gai_m55m1
```kconfig
# SPDX-License-Identifier: Apache-2.0
#
# Nuvoton NuMaker NUGESTUREAI M55M1 board configuration
#
# Copyright (c) 2026 Nuvoton Technology Corporation.

config BOARD_NUMAKER_GAI_M55M1
	select SOC_M55M1XXX
```

## boards/nuvoton/numaker_m031ki/Kconfig.numaker_m031ki
```kconfig
# SPDX-License-Identifier: Apache-2.0
#
# Nuvoton NuMaker M031KI board configuration
#
# Copyright (c) 2026 Nuvoton Technology Corporation.

config BOARD_NUMAKER_M031KI
	select SOC_M031XXX
```

## boards/nuvoton/numaker_m031ki/board.yml
```yaml
board:
  name: numaker_m031ki
  full_name: NUMAKER M031KI
  vendor: nuvoton
  socs:
  - name: m031xxx
```

## boards/nuvoton/numaker_m2l31ki/Kconfig.numaker_m2l31ki
```kconfig
# SPDX-License-Identifier: Apache-2.0
#
# Nuvoton NuMaker M2L31KI board configuration
#
# Copyright (c) 2024 Nuvoton Technology Corporation.

config BOARD_NUMAKER_M2L31KI
	select SOC_M2L31XXX
```

## boards/nuvoton/numaker_m2l31ki/board.yml
```yaml
board:
  name: numaker_m2l31ki
  full_name: NUMAKER M2L31KI
  vendor: nuvoton
  socs:
  - name: m2l31xxx
```

## boards/nuvoton/numaker_m3334ki/Kconfig.numaker_m3334ki
```kconfig
# SPDX-License-Identifier: Apache-2.0
#
# Nuvoton NuMaker M3334KI board configuration
#
# Copyright (c) 2025 Nuvoton Technology Corporation.

config BOARD_NUMAKER_M3334KI
	select SOC_M333XXX
```

## boards/nuvoton/numaker_m3334ki/board.yml
```yaml
board:
  name: numaker_m3334ki
  full_name: NUMAKER M3334KI
  vendor: nuvoton
  socs:
  - name: m333xxx
```

## boards/nuvoton/numaker_m3351ki/Kconfig.numaker_m3351ki
```kconfig
# SPDX-License-Identifier: Apache-2.0
#
# Nuvoton NuMaker M3351KI board configuration
#
# Copyright (c) 2026 Nuvoton Technology Corporation.

config BOARD_NUMAKER_M3351KI
	select SOC_M335XXX
```

## boards/nuvoton/numaker_m3351ki/board.yml
```yaml
board:
  name: numaker_m3351ki
  full_name: NUMAKER M3351KI
  vendor: nuvoton
  socs:
  - name: m335xxx
```

## boards/nuvoton/numaker_m5531/Kconfig.numaker_m5531
```kconfig
# SPDX-License-Identifier: Apache-2.0
#
# Nuvoton NuMaker M5531 board configuration
#
# Copyright (c) 2025 Nuvoton Technology Corporation.

config BOARD_NUMAKER_M5531
	select SOC_M55M1XXX
```
