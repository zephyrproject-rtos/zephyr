## boards/boards_legacy/xtensa/esp_wrover_kit/Kconfig.defconfig
```kconfig
# ESP-WROVER-KIT board configuration

# Copyright (c) 2021 Espressif Systems (Shanghai) Co., Ltd.
# SPDX-License-Identifier: Apache-2.0

config BOARD
	default "esp_wrover_kit"
	depends on BOARD_ESP_WROVER_KIT

config HEAP_MEM_POOL_ADD_SIZE_BOARD
	int
	default 65535 if WIFI && BT
	default 51200 if WIFI
	default 40960 if BT
	default 4096

choice BT_HCI_BUS_TYPE
	default BT_ESP32 if BT
endchoice

config DISK_DRIVER_SDMMC
	default y
```

## boards/boards_legacy/xtensa/heltec_wireless_stick_lite_v3/Kconfig.defconfig
```kconfig
# Heltec Wireless Stick Lite (V3) board configuration

# Copyright (c) 2021 Instituto de Pesquisas Eldorado (eldorado.org.br)
# Copyright (c) 2023 The Zephyr Project Contributors
# SPDX-License-Identifier: Apache-2.0

config BOARD
	default "heltec_wireless_stick_lite_v3"
	depends on BOARD_HELTEC_WIRELESS_STICK_LITE

config ENTROPY_GENERATOR
	default y

config HEAP_MEM_POOL_ADD_SIZE_BOARD
	int
	default 65535 if WIFI && BT
	default 51200 if WIFI
	default 40960 if BT
	default 4096

choice BT_HCI_BUS_TYPE
	default BT_ESP32 if BT
endchoice
```

## boards/boards_legacy/xtensa/intel_adsp_cavs25/Kconfig.defconfig
```kconfig
# Copyright (c) 2020 Intel Corporation
#
# SPDX-License-Identifier: Apache-2.0

if BOARD_INTEL_ADSP_CAVS25 || BOARD_INTEL_ADSP_CAVS25_TGPH

config BOARD
	default "intel_adsp_cavs25" if BOARD_INTEL_ADSP_CAVS25
	default "intel_adsp_cavs25_tgph" if BOARD_INTEL_ADSP_CAVS25_TGPH



if DAI_INTEL_SSP

config DAI_SSP_HAS_POWER_CONTROL
	def_bool y

endif

endif # BOARD_INTEL_ADSP_CAVS25 || BOARD_INTEL_ADSP_CAVS25_TGPH
```

## boards/boards_legacy/xtensa/kincony_kc868_a32/Kconfig.board
```kconfig
# Copyright (c) 2023 Bartosz Bilas
# SPDX-License-Identifier: Apache-2.0

config BOARD_KINCONY_KC868_A32
	bool "KINCONY KC868-A32 Board"
	depends on SOC_SERIES_ESP32

choice SOC_PART_NUMBER
	default SOC_ESP32_WROOM_32UE_N4
endchoice
```

## boards/boards_legacy/xtensa/kincony_kc868_a32/Kconfig.defconfig
```kconfig
# Copyright (c) 2023 Bartosz Bilas
# SPDX-License-Identifier: Apache-2.0

config BOARD
	default "kincony_kc868_a32"
	depends on BOARD_KINCONY_KC868_A32

config ENTROPY_GENERATOR
	default y

config HEAP_MEM_POOL_SIZE
	default 65535 if WIFI && BT
	default 51200 if WIFI
	default 40960 if BT
	default 4096
```

## boards/boards_legacy/xtensa/m5stack_atoms3/Kconfig.board
```kconfig
# M5Stack AtomS3 board configuration

# Copyright (c) 2023 Benjamin Cabé <benjamin@zephyrproject.org>
# SPDX-License-Identifier: Apache-2.0

config BOARD_M5STACK_ATOMS3
	bool "M5Stack AtomS3 Development Board"
	depends on SOC_SERIES_ESP32S3

choice SOC_PART_NUMBER
	default SOC_ESP32S3_FN8
endchoice
```

## boards/boards_legacy/xtensa/m5stack_core2/Kconfig.board
```kconfig
# M5Stack Core2 board configuration

# Copyright (c) 2023 Martin Kiepfer <m.kiepfer@teleschirm.org>
# SPDX-License-Identifier: Apache-2.0

config BOARD_M5STACK_CORE2
	bool "M5Stack Core2 Development Board"
	depends on SOC_SERIES_ESP32

choice SOC_PART_NUMBER
	default SOC_ESP32_D0WD_V3
endchoice
```

## boards/boards_legacy/xtensa/nxp_adsp_imx8ulp/Kconfig.defconfig
```kconfig
# Copyright (c) 2023 NXP
#
# SPDX-License-Identifier: Apache-2.0

if BOARD_NXP_ADSP_IMX8ULP

config BOARD
	default "nxp_adsp_imx8ulp"

endif # BOARD_NXP_ADSP_IMX8ULP
```

## boards/boards_legacy/xtensa/nxp_adsp_imx8ulp/nxp_adsp_imx8ulp_defconfig
```kconfig
# SPDX-License-Identifier: Apache-2.0

CONFIG_SOC_SERIES_NXP_IMX8ULP=y
CONFIG_SOC_NXP_IMX8ULP=y
CONFIG_BOARD_NXP_ADSP_IMX8ULP=y

CONFIG_BUILD_OUTPUT_BIN=n

CONFIG_DYNAMIC_INTERRUPTS=y

CONFIG_LOG=y
```

## boards/boards_legacy/xtensa/nxp_adsp_rt595/Kconfig
```kconfig
# Copyright (c) 2023 Google LLC.
# SPDX-License-Identifier: Apache-2.0

DT_ADSP_RESET_MEM := $(dt_nodelabel_path,adsp_reset)
DT_ADSP_DATA_MEM := $(dt_nodelabel_path,adsp_data)
DT_ADSP_TEXT_MEM := $(dt_nodelabel_path,adsp_text)

if BOARD_NXP_ADSP_RT595

config RT595_ADSP_STACK_SIZE
	hex "Boot time stack size"
	default 0x1000
	help
	  Stack space is reserved at the end of the RT595_ADSP_DATA_MEM
	  region, starting at RT595_ADSP_DATA_MEM_ADDR - RT595_ADSP_STACK_SIZE

config RT595_ADSP_RESET_MEM_ADDR
	hex
	default $(dt_node_reg_addr_hex,$(DT_ADSP_RESET_MEM))

config RT595_ADSP_RESET_MEM_SIZE
	hex
	default $(dt_node_reg_size_hex,$(DT_ADSP_RESET_MEM))

config RT595_ADSP_DATA_MEM_ADDR
	hex
	default $(dt_node_reg_addr_hex,$(DT_ADSP_DATA_MEM))

config RT595_ADSP_DATA_MEM_SIZE
	hex
	default $(dt_node_reg_size_hex,$(DT_ADSP_DATA_MEM))

config RT595_ADSP_TEXT_MEM_ADDR
	hex
	default $(dt_node_reg_addr_hex,$(DT_ADSP_TEXT_MEM))

config RT595_ADSP_TEXT_MEM_SIZE
	hex
	default $(dt_node_reg_size_hex,$(DT_ADSP_TEXT_MEM))

endif # BOARD_NXP_ADSP_RT595
```

## boards/boards_legacy/xtensa/nxp_adsp_rt595/Kconfig.board
```kconfig
# Copyright (c) 2023 Google LLC.
# SPDX-License-Identifier: Apache-2.0

config BOARD_NXP_ADSP_RT595
	bool "NXP ADSP RT595"
	depends on SOC_SERIES_NXP_RT5XX
```

## boards/boards_legacy/xtensa/odroid_go/odroid_go_defconfig
```kconfig
# SPDX-License-Identifier: Apache-2.0

CONFIG_BOARD_ODROID_GO=y
CONFIG_SOC_SERIES_ESP32=y

CONFIG_MAIN_STACK_SIZE=2048

CONFIG_CONSOLE=y
CONFIG_SERIAL=y
CONFIG_UART_CONSOLE=y

CONFIG_GPIO=y

# required to enable LCD backlight
CONFIG_REGULATOR=y
```

## boards/boards_legacy/xtensa/olimex_esp32_evb/Kconfig.board
```kconfig
# Olimex ESP32-EVB board configuration

# Copyright (c) 2022 Henrik Brix Andersen <henrik@brixandersen.dk>
# SPDX-License-Identifier: Apache-2.0

config BOARD_OLIMEX_ESP32_EVB
	bool "Olimex ESP32-EVB"
	depends on SOC_SERIES_ESP32

choice SOC_PART_NUMBER
	default SOC_ESP32_WROVER_E_N8R2
endchoice
```

## boards/boards_legacy/xtensa/xiao_esp32s3/Kconfig.board
```kconfig
# XIAO ESP32S3 board configuration

# Copyright (c) 2023 Seeed Studio inc.
# SPDX-License-Identifier: Apache-2.0

config BOARD_XIAO_ESP32S3
	bool "XIAO ESP32S3 Board"
	depends on SOC_SERIES_ESP32S3

choice SOC_PART_NUMBER
	default SOC_ESP32S3_WROOM_N8R8
endchoice
```

## boards/boards_legacy/xtensa/yd_esp32/yd_esp32_defconfig
```kconfig
# Copyright (c) 2023 Julio Cesar <hi@jcsx.dev>
# SPDX-License-Identifier: Apache-2.0

CONFIG_BOARD_YD_ESP32=y
CONFIG_SOC_SERIES_ESP32=y

CONFIG_MAIN_STACK_SIZE=2048

CONFIG_CONSOLE=y
CONFIG_SERIAL=y
CONFIG_UART_CONSOLE=y

CONFIG_GPIO=y
```

## boards/bouffalolab/bl6/bl604e_iot_dvk/bl604e_iot_dvk_defconfig
```kconfig
# Copyright (c) 2022-2024 ATL Electronics
#
# SPDX-License-Identifier: Apache-2.0

CONFIG_CONSOLE=y
CONFIG_SERIAL=y

CONFIG_UART_CONSOLE=y
CONFIG_UART_BFLB=y
CONFIG_UART_INTERRUPT_DRIVEN=y
```

## boards/brcm/bcm958401m2/Kconfig.bcm958401m2
```kconfig
# SPDX-License-Identifier: Apache-2.0
#
# Copyright 2020 Broadcom.
#

config BOARD_BCM958401M2
	select SOC_BCM58400
```

## boards/brcm/bcm958401m2/bcm958401m2_bcm58400_defconfig
```kconfig
# SPDX-License-Identifier: Apache-2.0

CONFIG_XIP=n
CONFIG_SERIAL=y
CONFIG_UART_INTERRUPT_DRIVEN=y
CONFIG_CONSOLE=y
CONFIG_UART_CONSOLE=y
CONFIG_FLASH_SIZE=0
CONFIG_FLASH_BASE_ADDRESS=0x0
```

## boards/brcm/bcm958401m2/board.yml
```yaml
board:
  name: bcm958401m2
  full_name: BCM958401M2
  vendor: brcm
  socs:
  - name: bcm58400
```

## boards/brcm/bcm958402m2/Kconfig.bcm958402m2
```kconfig
# Copyright 2020 Broadcom
# SPDX-License-Identifier: Apache-2.0

config BOARD_BCM958402M2
	select SOC_BCM58402_M7 if BOARD_BCM958402M2_BCM58402_M7
	select SOC_BCM58402_A72 if BOARD_BCM958402M2_BCM58402_A72
```

## boards/brcm/bcm958402m2/bcm958402m2_bcm58402_a72_defconfig
```kconfig
# SPDX-License-Identifier: Apache-2.0

# Platform Configuration
CONFIG_ARM64_VA_BITS_36=y
CONFIG_ARM64_PA_BITS_36=y

# Zephyr Kernel Configuration
CONFIG_XIP=n
CONFIG_FLASH_SIZE=0
CONFIG_FLASH_BASE_ADDRESS=0x0

# Serial Drivers
CONFIG_SERIAL=y
CONFIG_UART_INTERRUPT_DRIVEN=y

# Enable Console
CONFIG_CONSOLE=y
CONFIG_UART_CONSOLE=y

# Enable PCIe EP
CONFIG_PCIE_ENDPOINT=y
CONFIG_PCIE_EP_IPROC=y
CONFIG_PCIE_EP_IPROC_V2=y

# Enable DMA
CONFIG_DMA=y
CONFIG_DMA_64BIT=y
```

## boards/brcm/bcm958402m2/bcm958402m2_bcm58402_m7_defconfig
```kconfig
# SPDX-License-Identifier: Apache-2.0

# Zephyr Kernel Configuration
CONFIG_XIP=n
CONFIG_FLASH_SIZE=0
CONFIG_FLASH_BASE_ADDRESS=0x0

# Serial Drivers
CONFIG_SERIAL=y
CONFIG_UART_INTERRUPT_DRIVEN=y

# Enable Console
CONFIG_CONSOLE=y
CONFIG_UART_CONSOLE=y

# Enable PCIe EP
CONFIG_PCIE_ENDPOINT=y
CONFIG_PCIE_EP_IPROC=y
CONFIG_PCIE_EP_IPROC_V2=y

# Enable DMA
CONFIG_DMA=y
CONFIG_DMA_64BIT=y
```

## boards/brcm/bcm958402m2/board.yml
```yaml
board:
  name: bcm958402m2
  full_name: BCM958402M2 (Cortex-M7)
  vendor: brcm
  socs:
  - name: bcm58402
```

## boards/broadcom/bcm958402m2/Kconfig.bcm958402m2
```kconfig
# Copyright 2020 Broadcom
# SPDX-License-Identifier: Apache-2.0

config BOARD_BCM958402M2_BCM58402_M7
	bool
	select SOC_BCM58402_M7

config BOARD_BCM958402M2_BCM58402_A72
	bool
	select SOC_BCM58402_A72
```
