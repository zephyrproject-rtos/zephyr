/*
 * Copyright (c) 2023 NXP
 *
 * SPDX-License-Identifier: Apache-2.0
 */

/dts-v1/;

#include <nxp/nxp_imx8ulp.dtsi>

/ {
	model = "nxp_adsp_imx8ulp";
	compatible = "nxp";

	chosen {
		zephyr,sram = &sram0;
	};
};
