## boards/boards_legacy/arc/hsdk/Kconfig.defconfig
```kconfig
# Copyright (c) 2019 Synopsys, Inc. All rights reserved.
# SPDX-License-Identifier: Apache-2.0

if BOARD_HSDK

config BOARD
	default "hsdk"

if SPI_DW

config SPI_DW_ACCESS_WORD_ONLY
	default y

endif # SPI_DW

if I2C_DW

config I2C_DW_CLOCK_SPEED
	default 200

endif #I2C_DW

endif # BOARD_HSDK
```

## boards/boards_legacy/arc/qemu_arc/Kconfig.defconfig
```kconfig
# Copyright (c) 2020,2021 Synopsys, Inc. All rights reserved.
# SPDX-License-Identifier: Apache-2.0

if BOARD_QEMU_ARC

config BOARD
	default "qemu_arc"

if NETWORKING

	config NET_L2_ETHERNET
	default y

	# Required to satisfy dependency of networking stack on RNG
	config TEST_RANDOM_GENERATOR
	default y

endif # NETWORKING

endif
```

## boards/boards_legacy/arm/96b_aerocore2/Kconfig.defconfig
```kconfig
#  Copyright (c) 2020 Linaro Limited
#  SPDX-License-Identifier: Apache-2.0

if BOARD_96B_AEROCORE2

config BOARD
	default "96b_aerocore2"

endif # BOARD_96B_AEROCORE2
```

## boards/boards_legacy/arm/96b_argonkey/Kconfig.board
```kconfig
# 96Boards Argonkey Board Configuration

# Copyright (c) 2018 STMicroelectronics
# SPDX-License-Identifier: Apache-2.0

config BOARD_96B_ARGONKEY
	bool "96Boards Argonkey"
	depends on SOC_STM32F412CX
```

## boards/boards_legacy/arm/96b_nitrogen/Kconfig.defconfig
```kconfig
# 96Boards NITROGEN board configuration

# Copyright (c) 2016 Nordic Semiconductor ASA
# SPDX-License-Identifier: Apache-2.0

if BOARD_96B_NITROGEN

config BOARD
	default "96b_nitrogen"

config BT_CTLR
	default BT

endif # BOARD_96B_NITROGEN
```

## boards/boards_legacy/arm/adafruit_feather_m0_lora/Kconfig.defconfig
```kconfig
# Adafruit Feather M0 LoRa board configuration

# Copyright (c) 2022 Miguel Dardenne <miguel.dardenne@gmail.com>
# SPDX-License-Identifier: Apache-2.0

config BOARD
	default "adafruit_feather_m0_lora"
	depends on BOARD_ADAFRUIT_FEATHER_M0_LORA
```

## boards/boards_legacy/arm/adafruit_feather_nrf52840/Kconfig.board
```kconfig
# Adafruit Feather nRF52840 Express board configuration

# Copyright (c) 2020 Tobias Svehagen
# SPDX-License-Identifier: Apache-2.0

config BOARD_ADAFRUIT_FEATHER_NRF52840
	bool "Adafruit Feather nRF52840 Express"
	depends on SOC_NRF52840_QIAA
```

## boards/boards_legacy/arm/adafruit_feather_stm32f405/Kconfig.board
```kconfig
# Adafruit Feather STM32F405 Express board configuration

# Copyright (c) 2020 Lucian Copeland for Adafruit Industries
# SPDX-License-Identifier: Apache-2.0

config BOARD_ADAFRUIT_FEATHER_STM32F405
	bool "Feather STM32F405 Express Board"
	depends on SOC_STM32F405XG
```

## boards/boards_legacy/arm/adafruit_feather_stm32f405/Kconfig.defconfig
```kconfig
# Adafruit Feather STM32F405 Express board configuration

# Copyright (c) 2020 Lucian Copeland for Adafruit Industries.
# SPDX-License-Identifier: Apache-2.0

if BOARD_ADAFRUIT_FEATHER_STM32F405

config BOARD
	default "adafruit_feather_stm32f405"

endif # BOARD_ADAFRUIT_FEATHER_STM32F405
```

## boards/boards_legacy/arm/adafruit_grand_central_m4_express/Kconfig.defconfig
```kconfig
# Adafruit Grand Central M4 Express board configuration

# Copyright (c) 2023 Lukas Jung <lukas.jung@mailbox.org>
# SPDX-License-Identifier: Apache-2.0

config BOARD
	default "adafruit_grand_central_m4_express"
	depends on BOARD_ADAFRUIT_GRAND_CENTRAL_M4_EXPRESS
```

## boards/boards_legacy/arm/adafruit_itsybitsy_m4_express/Kconfig.board
```kconfig
# Adafruit ItsyBitsy M4 Express board configuration

# Copyright (c) 2020 Google LLC.
# SPDX-License-Identifier: Apache-2.0

config BOARD_ADAFRUIT_ITSYBITSY_M4_EXPRESS
	bool "Adafruit ItsyBitsy M4 Express"
	depends on SOC_PART_NUMBER_SAMD51G19A
```

## boards/boards_legacy/arm/adafruit_itsybitsy_nrf52840/adafruit_itsybitsy_nrf52840_defconfig
```kconfig
# SPDX-License-Identifier: Apache-2.0

CONFIG_SOC_SERIES_NRF52X=y
CONFIG_SOC_NRF52840_QIAA=y
CONFIG_BOARD_ADAFRUIT_ITSYBITSY_NRF52840=y

# Enable MPU
CONFIG_ARM_MPU=y

# enable GPIO
CONFIG_GPIO=y

# enable uart driver
CONFIG_SERIAL=y

# enable console
CONFIG_CONSOLE=y
CONFIG_UART_CONSOLE=y

# Flashing
CONFIG_USE_DT_CODE_PARTITION=y
CONFIG_BUILD_OUTPUT_UF2=y
```

## boards/boards_legacy/arm/adafruit_trinket_m0/Kconfig.board
```kconfig
# Adafruit Trinket M0 board configuration

# Copyright (c) 2018 Google LLC.
# SPDX-License-Identifier: Apache-2.0

config BOARD_ADAFRUIT_TRINKET_M0
	bool "Adafruit Trinket M0"
	depends on SOC_PART_NUMBER_SAMD21E18A
```

## boards/boards_legacy/arm/apollo4p_blue_kxr_evb/apollo4p_blue_kxr_evb_defconfig
```kconfig
# SPDX-License-Identifier: Apache-2.0
#
# Copyright (c) 2023 Ambiq Micro Inc. <www.ambiq.com>

CONFIG_SOC_SERIES_APOLLO4X=y
CONFIG_SOC_APOLLO4P_BLUE=y
CONFIG_CONSOLE=y
CONFIG_UART_CONSOLE=y
CONFIG_SERIAL=y
CONFIG_UART_INTERRUPT_DRIVEN=y
```

## boards/boards_legacy/arm/apollo4p_evb/Kconfig.board
```kconfig
# SPDX-License-Identifier: Apache-2.0
#
# Copyright (c) 2023 Antmicro <www.antmicro.com>

config BOARD_APOLLO4P_EVB
	bool "Ambiq Apollo4 Plus Evaluation Board"
	depends on SOC_APOLLO4P
```

## boards/boards_legacy/arm/apollo4p_evb/Kconfig.defconfig
```kconfig
# SPDX-License-Identifier: Apache-2.0
#
# Copyright (c) 2023 Antmicro <www.antmicro.com>

config BOARD
	default "apollo4p_evb"
	depends on BOARD_APOLLO4P_EVB
```

## boards/boards_legacy/arm/apollo4p_evb/apollo4p_evb_defconfig
```kconfig
# SPDX-License-Identifier: Apache-2.0
#
# Copyright (c) 2023 Antmicro <www.antmicro.com>

CONFIG_SOC_SERIES_APOLLO4X=y
CONFIG_CONSOLE=y
CONFIG_UART_CONSOLE=y
CONFIG_SERIAL=y
CONFIG_UART_INTERRUPT_DRIVEN=y
```

## boards/boards_legacy/arm/arduino_due/Kconfig.board
```kconfig
# Arduino Due Board configuration

# Copyright (c) 2017 Justin Watson
# SPDX-License-Identifier: Apache-2.0

config BOARD_ARDUINO_DUE
	bool "Arduino Due Board"
	depends on SOC_PART_NUMBER_SAM3X8E
```

## boards/boards_legacy/arm/arduino_giga_r1/arduino_giga_r1_m7_defconfig
```kconfig
# Copyright 2023 Google LLC
# SPDX-License-Identifier: Apache-2.0

CONFIG_SOC_SERIES_STM32H7X=y
CONFIG_SOC_STM32H747XX=y

# Board config should be specified since there are 2 possible targets
CONFIG_BOARD_ARDUINO_GIGA_R1_M7=y

# Disable the internal SMPS regulator
CONFIG_POWER_SUPPLY_DIRECT_SMPS=n

# Enable GPIO
CONFIG_GPIO=y

# Enable clocks
CONFIG_CLOCK_CONTROL=y

# Enable MPU
CONFIG_ARM_MPU=y

# Enable HW stack protection
CONFIG_HW_STACK_PROTECTION=y

# Enable uart driver
CONFIG_SERIAL=y

# Console
CONFIG_CONSOLE=y
CONFIG_UART_CONSOLE=y

# Enable pin controller
CONFIG_PINCTRL=y

# Use zephyr,code-partition as flash offset
CONFIG_USE_DT_CODE_PARTITION=y
```

## boards/boards_legacy/arm/arduino_nano_33_ble/arduino_nano_33_ble_defconfig
```kconfig
# SPDX-License-Identifier: Apache-2.0

CONFIG_SOC_SERIES_NRF52X=y
CONFIG_SOC_NRF52840_QIAA=y
CONFIG_BOARD_ARDUINO_NANO_33_BLE=y

# Enable MPU
CONFIG_ARM_MPU=y
CONFIG_HW_STACK_PROTECTION=y

# enable peripherals
CONFIG_GPIO=y
CONFIG_SERIAL=y

# enable console
CONFIG_CONSOLE=y
CONFIG_UART_CONSOLE=y

# enable sam-ba bootloader on legacy mode
CONFIG_BOOTLOADER_BOSSA=y
CONFIG_BOOTLOADER_BOSSA_LEGACY=y
```

## boards/boards_legacy/arm/arduino_nano_33_iot/Kconfig.board
```kconfig
# Arduino Nano 33 IOT board configuration

# Copyright (c) 2020 Google LLC.
# SPDX-License-Identifier: Apache-2.0

config BOARD_ARDUINO_NANO_33_IOT
	bool "Arduino Nano 33 IOT"
	depends on SOC_PART_NUMBER_SAMD21G18A
```

## boards/boards_legacy/arm/arduino_nano_33_iot/Kconfig.defconfig
```kconfig
# Arduino Nano 33 IOT board configuration

# Copyright (c) 2020 Google LLC.
# SPDX-License-Identifier: Apache-2.0

config BOARD
	default "arduino_nano_33_iot"
	depends on BOARD_ARDUINO_NANO_33_IOT
```

## boards/boards_legacy/arm/arduino_opta_m4/Kconfig.board
```kconfig
# Copyright (c) 2023 Felipe Neves
# SPDX-License-Identifier: Apache-2.0

config BOARD_ARDUINO_OPTA_M4
	bool "Arduino OPTA Programmable Logic Controller M4 Core"
	depends on SOC_STM32H747XX
	select CPU_CORTEX_M4
```

## boards/boards_legacy/arm/arduino_opta_m4/arduino_opta_m4_defconfig
```kconfig
# Copyright (c) 2023 Felipe Neves
# SPDX-License-Identifier: Apache-2.0

CONFIG_SOC_SERIES_STM32H7X=y
CONFIG_SOC_STM32H747XX=y

CONFIG_BOARD_ARDUINO_OPTA_M4=y

# enable GPIO
CONFIG_GPIO=y

# clock configuration
CONFIG_CLOCK_CONTROL=y

# Enable MPU
CONFIG_ARM_MPU=y

# Enable HW stack protection
CONFIG_HW_STACK_PROTECTION=y

# enable pin controller
CONFIG_PINCTRL=y

# Use zephyr,code-partition as flash offset
CONFIG_USE_DT_CODE_PARTITION=y
```

## boards/boards_legacy/arm/arduino_uno_r4/Kconfig.board
```kconfig
# Copyright (c) 2023 TOKITA Hiroshi <tokita.hiroshi@fujitsu.com>
# SPDX-License-Identifier: Apache-2.0

config BOARD_ARDUINO_UNO_R4_MINIMA
	bool "Arduino Uno R4 Minima board"
	depends on SOC_R7FA4M1AB3CFM
```
