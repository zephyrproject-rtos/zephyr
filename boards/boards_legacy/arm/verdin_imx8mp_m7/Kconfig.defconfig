## boards/boards_legacy/arm/verdin_imx8mp_m7/Kconfig.defconfig
```kconfig
# VERDIN_IMX8MP_M7 board defconfig

# Copyright (c) 2023 Toradex
# SPDX-License-Identifier: Apache-2.0

if BOARD_VERDIN_IMX8MP_M7

config BOARD
	default "verdin_imx8mp_m7"

if !XIP
config FLASH_SIZE
	default 0
config FLASH_BASE_ADDRESS
	default 0
endif

endif # BOARD_VERDIN_IMX8MP_M7
```

## boards/boards_legacy/arm/verdin_imx8mp_m7/verdin_imx8mp_m7_itcm_defconfig
```kconfig
#
# Copyright (c) 2023 Toradex
#
# SPDX-License-Identifier: Apache-2.0
#

CONFIG_SOC_SERIES_IMX8ML_M7=y
CONFIG_SOC_MIMX8ML8=y
CONFIG_BOARD_VERDIN_IMX8MP_M7=y
CONFIG_CLOCK_CONTROL=y
CONFIG_UART_CONSOLE=y
CONFIG_SERIAL=y
CONFIG_CONSOLE=y
CONFIG_XIP=y
CONFIG_CODE_ITCM=y
CONFIG_PINCTRL=y
```

## boards/boards_legacy/arm/warp7_m4/Kconfig.board
```kconfig
# WaRP7 iMX7S M4 board

# Copyright (c) 2018, Diego Sueiro
# SPDX-License-Identifier: Apache-2.0

config BOARD_WARP7_M4
	bool "WaRP7 iMX7 Solo"
	depends on SOC_SERIES_IMX7_M4
	select SOC_PART_NUMBER_MCIMX7S3DVK08SA
```

## boards/boards_legacy/arm/we_ophelia1ev_nrf52805/we_ophelia1ev_nrf52805_defconfig
```kconfig
# Copyright (c) 2022 Nordic Semiconductor ASA
# SPDX-License-Identifier: Apache-2.0

CONFIG_SOC_SERIES_NRF52X=y
CONFIG_SOC_NRF52805_CAAA=y
CONFIG_BOARD_WE_OPHELIA1EV_NRF52805=y

# Enable MPU
CONFIG_ARM_MPU=y

# Enable hardware stack protection
CONFIG_HW_STACK_PROTECTION=y

# Enable GPIO
CONFIG_GPIO=y

# Enable UART driver
CONFIG_SERIAL=y

# Enable console
CONFIG_CONSOLE=y
CONFIG_UART_CONSOLE=y

# Use internal oscillator
CONFIG_CLOCK_CONTROL_NRF_K32SRC_RC=y
```

## boards/boards_legacy/arm/xiao_ble/Kconfig
```kconfig
# XIAO BLE board configuration

# Copyright (c) 2022 Marcin Niestroj
# SPDX-License-Identifier: Apache-2.0

if BOARD_XIAO_BLE

config BOARD_ENABLE_DCDC
	bool "DCDC mode"
	select SOC_DCDC_NRF52X
	default y

config BOARD_ENABLE_DCDC_HV
	bool "High Voltage DCDC converter"
	select SOC_DCDC_NRF52X_HV
	default y

endif # BOARD_XIAO_BLE
```

## boards/boards_legacy/arm/xiao_ble/xiao_ble_defconfig
```kconfig
# SPDX-License-Identifier: Apache-2.0

CONFIG_SOC_SERIES_NRF52X=y
CONFIG_SOC_NRF52840_QIAA=y
CONFIG_BOARD_XIAO_BLE=y

# Enable MPU
CONFIG_ARM_MPU=y

# Enable hardware stack protection
CONFIG_HW_STACK_PROTECTION=y

# enable GPIO
CONFIG_GPIO=y

# enable uart driver
CONFIG_SERIAL=y

# enable console
CONFIG_CONSOLE=y

# Logger cannot use itself to log
CONFIG_USB_CDC_ACM_LOG_LEVEL_OFF=y

# enable USB
CONFIG_USB_DEVICE_STACK=y

# Build UF2 by default, supported by the Adafruit nRF52 Bootloader
CONFIG_BUILD_OUTPUT_UF2=y
CONFIG_USE_DT_CODE_PARTITION=y
```

## boards/boards_legacy/arm/xmc47_relax_kit/Kconfig.board
```kconfig
# SPDX-License-Identifier: Apache-2.0
#
# Copyright (c) 2023 Schlumberger

config BOARD_XMC47_RELAX_KIT
	bool "Infineon XMC4700 Relax Kit"
	depends on SOC_SERIES_XMC_4XXX
	select SOC_PART_NUMBER_F144X2048
```

## boards/boards_legacy/arm/xmc47_relax_kit/Kconfig.defconfig
```kconfig
# SPDX-License-Identifier: Apache-2.0
#
# Copyright (c) 2023 Schlumberger

if BOARD_XMC47_RELAX_KIT

config BOARD
	default "xmc47_relax_kit"

if NETWORKING

config NET_L2_ETHERNET
	default y
config MDIO
	default y
config TEST_RANDOM_GENERATOR
	default y

endif # NETWORKING

endif
```

## boards/boards_legacy/arm64/intel_socfpga_agilex5_socdk/Kconfig.defconfig
```kconfig
# Copyright (c) 2022 Intel Corporation
# SPDX-License-Identifier: Apache-2.0

config BOARD
	default "intel_socfpga_agilex5_socdk"
	depends on BOARD_INTEL_SOCFPGA_AGILEX5_SOCDK

config MAX_THREAD_BYTES
	default 5
```

## boards/boards_legacy/arm64/intel_socfpga_agilex5_socdk/intel_socfpga_agilex5_socdk_defconfig
```kconfig
# Copyright (c) 2023 Intel Corporation
# SPDX-License-Identifier: Apache-2.0

# The Zephyr build from this defconfig is expected to boot from
# Intel Arm Trusted Firmware (ATF).
# Boot Flow is: ATF BL21 -> ATF BL31 -> Zephyr

CONFIG_SOC_SERIES_AGILEX5=y
CONFIG_SOC_AGILEX5=y
CONFIG_BOARD_INTEL_SOCFPGA_AGILEX5_SOCDK=y

# Compiler Options
CONFIG_FORTIFY_SOURCE_RUN_TIME=y

# Arm Features
CONFIG_ARM_ARCH_TIMER=y
CONFIG_CACHE_MANAGEMENT=y
CONFIG_ARMV8_A_NS=y

# Serial Drivers
CONFIG_SERIAL=y
CONFIG_UART_INTERRUPT_DRIVEN=y
CONFIG_UART_NS16550_ACCESS_WORD_ONLY=y

# Enable Console
CONFIG_CONSOLE=y
CONFIG_UART_CONSOLE=y

# Enable Clock Manager
CONFIG_CLOCK_CONTROL=y

# For Misc Register Map
CONFIG_SYSCON=y

# Reset Manager
CONFIG_RESET=y

# PSCI support Enable
CONFIG_PM_CPU_OPS=y
CONFIG_PM_CPU_OPS_PSCI=y

# Enable SMP support
CONFIG_SMP=y
CONFIG_MP_MAX_NUM_CPUS=4
```

## boards/boards_legacy/arm64/intel_socfpga_agilex_socdk/Kconfig.board
```kconfig
# Copyright (c) 2021 Intel Corporation
# SPDX-License-Identifier: Apache-2.0

config BOARD_INTEL_SOCFPGA_AGILEX_SOCDK
	bool "Intel SoC FPGA Development Kit (Agilex)"
	depends on SOC_AGILEX
```

## boards/boards_legacy/arm64/intel_socfpga_agilex_socdk/Kconfig.defconfig
```kconfig
# Copyright (c) 2021 Intel Corporation
# SPDX-License-Identifier: Apache-2.0

config BOARD
	default "intel_socfpga_agilex_socdk"
	depends on BOARD_INTEL_SOCFPGA_AGILEX_SOCDK
```

## boards/boards_legacy/arm64/mimx8mm_evk/Kconfig.defconfig
```kconfig
# Copyright 2020-2022 NXP
# SPDX-License-Identifier: Apache-2.0

if BOARD_MIMX8MM_EVK_A53

config BOARD
	default "mimx8mm_evk_a53"

endif # BOARD_MIMX8MM_EVK_A53
```

## boards/boards_legacy/arm64/mimx8mn_evk/Kconfig.board
```kconfig
# Copyright 2022 NXP
# SPDX-License-Identifier: Apache-2.0

config BOARD_MIMX8MN_EVK_A53
	bool "NXP i.MX8M Nano EVK A53"
	depends on SOC_SERIES_MIMX8M_A53
	select SOC_PART_NUMBER_MIMX8MN6DVTJZ
```

## boards/boards_legacy/arm64/mimx93_evk/Kconfig.defconfig
```kconfig
# Copyright 2022 NXP
# SPDX-License-Identifier: Apache-2.0

if BOARD_MIMX93_EVK_A55

config BOARD
	default "mimx93_evk_a55"

endif # BOARD_MIMX8MP_EVK_A55
```

## boards/boards_legacy/arm64/nxp_ls1046ardb/Kconfig.board
```kconfig
#
# Copyright 2021 NXP
# SPDX-License-Identifier: Apache-2.0
#

config BOARD_NXP_LS1046ARDB
	bool "NXP Layerscape ls1046ardb"
	depends on SOC_SERIES_LS1046A
```

## boards/boards_legacy/arm64/nxp_ls1046ardb/Kconfig.defconfig
```kconfig
#
# Copyright 2021 NXP
# SPDX-License-Identifier: Apache-2.0
#

config BOARD
	default "nxp_ls1046ardb"
	depends on BOARD_NXP_LS1046ARDB
```

## boards/boards_legacy/arm64/rcar_h3ulcb_ca57/Kconfig.board
```kconfig
# Copyright (c) 2023 EPAM Systems
# SPDX-License-Identifier: Apache-2.0

config BOARD_RCAR_H3ULCB_CA57
	bool "Renesas H3ULCB"
	depends on SOC_ARM64_R8A77951
```

## boards/boards_legacy/arm64/rcar_salvator_xs_m3/Kconfig.defconfig
```kconfig
# Copyright (c) 2023 EPAM Systems
# SPDX-License-Identifier: Apache-2.0

if BOARD_RCAR_SALVATOR_XS_M3

config BOARD
	default "rcar_salvator_xs_m3"

config BUILD_OUTPUT_BIN
	default y

endif # BOARD_RCAR_SALVATOR_XS_M3
```

## boards/boards_legacy/posix/native_sim/Kconfig.board
```kconfig
# Copyright (c) 2023 Nordic Semiconductor ASA
# SPDX-License-Identifier: Apache-2.0

config BOARD_NATIVE_SIM_32BIT
	bool "Native simulation, 32-bit mode"
	select BOARD_NATIVE_SIM
	help
	  Will produce a console Linux process which can be executed natively
	  as a 32-bit executable.

config BOARD_NATIVE_SIM_64BIT
	bool "Native simulation, 64-bit mode"
	select BOARD_NATIVE_SIM
	select 64BIT
	help
	  Will produce a console Linux process which can be executed natively
	  as a 64-bit executable.
```

## boards/boards_legacy/posix/nrf_bsim/nrf5340bsim_nrf5340_cpunet_defconfig
```kconfig
# SPDX-License-Identifier: Apache-2.0

CONFIG_SOC_POSIX=y
CONFIG_BOARD_NRF5340BSIM_NRF5340_CPUNET=y
CONFIG_CONSOLE=y
CONFIG_NO_OPTIMIZATIONS=y
```

## boards/boards_legacy/riscv/esp32c3_devkitm/Kconfig.board
```kconfig
# ESP32C3 devkitm board configuration

# Copyright (c) 2021 Espressif Systems (Shanghai) Co., Ltd.
# SPDX-License-Identifier: Apache-2.0

config BOARD_ESP32C3_DEVKITM
	bool "ESP32C3 Devkit-M Board"
	depends on SOC_SERIES_ESP32C3

choice SOC_PART_NUMBER
	default SOC_ESP32C3_MINI_N4
endchoice
```

## boards/boards_legacy/riscv/esp32c3_luatos_core/Kconfig.board
```kconfig
# Copyright (c) 2023 YuLong Yao<feilongphone@gmail.com>
# SPDX-License-Identifier: Apache-2.0

config BOARD_ESP32C3_LUATOS_CORE
	bool "luatos ESP32C3-CORE Board"
	depends on SOC_SERIES_ESP32C3

config BOARD_ESP32C3_LUATOS_CORE_USB
	bool "luatos ESP32C3-CORE Board without UART chip"
	depends on SOC_SERIES_ESP32C3

choice SOC_PART_NUMBER
	default SOC_ESP32C3_MINI_N4
endchoice
```

## boards/boards_legacy/riscv/gd32vf103v_eval/Kconfig.board
```kconfig
# Copyright (c) 2021, Teslabs Engineering S.L.
# SPDX-License-Identifier: Apache-2.0

config BOARD_GD32VF103V_EVAL
	bool "GigaDevice GD32VF103V-EVAL"
	depends on SOC_GD32VF103
```

## boards/boards_legacy/riscv/hifive1_revb/hifive1_revb_defconfig
```kconfig
CONFIG_SOC_SERIES_SIFIVE_FREEDOM_E300=y
CONFIG_SOC_SIFIVE_FREEDOM_E340=y
CONFIG_BOARD_HIFIVE1_REVB=y
CONFIG_GPIO=y
CONFIG_PINCTRL=y
CONFIG_CONSOLE=y
CONFIG_SERIAL=y
CONFIG_UART_SIFIVE_PORT_0=y
CONFIG_UART_CONSOLE=y
CONFIG_RISCV_CORE_E31=y
```
