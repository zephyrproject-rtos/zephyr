## boards/boards_legacy/arm/hexiwear_kw40z/Kconfig.defconfig
```kconfig
# Hexiwear KW40Z board

# Copyright (c) 2017, NXP
# SPDX-License-Identifier: Apache-2.0

if BOARD_HEXIWEAR_KW40Z

config BOARD
	default "hexiwear_kw40z"

config OSC_XTAL0_FREQ
	default 32000000

config MCG_FRDIV
	default 5

config MCG_FCRDIV
	default 0

endif # BOARD_HEXIWEAR_KW40Z
```

## boards/boards_legacy/arm/holyiot_yj16019/Kconfig.board
```kconfig
# Holyiot YJ-16019 board configuration

# Copyright (c) 2019 Henrik Brix Andersen <henrik@brixandersen.dk>
# SPDX-License-Identifier: Apache-2.0

config BOARD_HOLYIOT_YJ16019
	bool "Holyiot YJ-16019"
	depends on SOC_NRF52832_QFAA
```

## boards/boards_legacy/arm/lora_e5_dev_board/Kconfig.defconfig
```kconfig
# LoRa-E5 Dev board configuration

# Copyright (c) 2021 Thomas Stranger
# SPDX-License-Identifier: Apache-2.0

if BOARD_LORA_E5_DEV_BOARD

config BOARD
	default "lora_e5_dev_board"

endif # BOARD_LORA_E5_DEV_BOARD
```

## boards/boards_legacy/arm/lora_e5_mini/Kconfig.defconfig
```kconfig
# LoRa-E5 mini configuration

# Copyright (c) 2023 Marcin Niestroj
# SPDX-License-Identifier: Apache-2.0

if BOARD_LORA_E5_MINI

config BOARD
	default "lora_e5_mini"

endif # BOARD_LORA_E5_MINI
```

## boards/boards_legacy/arm/lpcxpresso54114/lpcxpresso54114_m0_defconfig
```kconfig
#
# Copyright (c) 2017, NXP
#
# SPDX-License-Identifier: Apache-2.0
#

CONFIG_SOC_LPC54114_M0=y
CONFIG_SOC_SERIES_LPC54XXX=y
CONFIG_BOARD_LPCXPRESSO54114_M0=y
CONFIG_USE_SEGGER_RTT=y
CONFIG_SERIAL=n
CONFIG_GPIO=n
CONFIG_SYS_CLOCK_HW_CYCLES_PER_SEC=48000000
CONFIG_PINCTRL=y
```

## boards/boards_legacy/arm/lpcxpresso55s16/Kconfig.board
```kconfig
# LPCXpresso55S16 board

# Copyright (c) 2020 Henrik Brix Andersen <henrik@brixandersen.dk>
# SPDX-License-Identifier: Apache-2.0

config BOARD_LPCXPRESSO55S16
	bool "NXP LPCXPRESSO-55S16"
	depends on SOC_SERIES_LPC55XXX
	select SOC_PART_NUMBER_LPC55S16JBD100
```

## boards/boards_legacy/arm/lpcxpresso55s28/lpcxpresso55s28_defconfig
```kconfig
#
# Copyright (c) 2020 Lemonbeat GmbH
#
# SPDX-License-Identifier: Apache-2.0
#

CONFIG_SOC_SERIES_LPC55XXX=y
CONFIG_SOC_LPC55S28=y
CONFIG_BOARD_LPCXPRESSO55S28=y
CONFIG_CONSOLE=y
CONFIG_UART_CONSOLE=y
CONFIG_SERIAL=y
CONFIG_UART_INTERRUPT_DRIVEN=y
CONFIG_GPIO=y
CONFIG_PINCTRL=y
CONFIG_ARM_MPU=y
CONFIG_HW_STACK_PROTECTION=y

CONFIG_RUNTIME_NMI=y

CONFIG_BUILD_OUTPUT_HEX=y
```

## boards/boards_legacy/arm/lpcxpresso55s69/lpcxpresso55s69_cpu1_defconfig
```kconfig
#
# Copyright (c) 2019, NXP
#
# SPDX-License-Identifier: Apache-2.0
#

CONFIG_SOC_SERIES_LPC55XXX=y
CONFIG_SOC_LPC55S69_CPU1=y
CONFIG_BOARD_LPCXPRESSO55S69_CPU1=y
CONFIG_GPIO=y
CONFIG_PINCTRL=y

CONFIG_RUNTIME_NMI=y
```

## boards/boards_legacy/arm/mec1501modular_assy6885/Kconfig.board
```kconfig
# Copyright (c) 2019, Intel Corporation
# SPDX-License-Identifier: Apache-2.0

config BOARD_MEC1501MODULAR_ASSY6885
	bool "Microchip MEC1501 Modular ASSY 6885 Development board"
	depends on SOC_MEC1501_HSZ
```

## boards/boards_legacy/arm/mercury_xu/mercury_xu_defconfig
```kconfig
# Copyright (c) 2020, Antmicro
CONFIG_SOC_XILINX_ZYNQMP_RPU=y
CONFIG_BOARD_MERCURY_XU=y

# enable uart driver
CONFIG_SERIAL=y

# enable console
CONFIG_CONSOLE=y
CONFIG_UART_CONSOLE=y

# enable timer
CONFIG_SYS_CLOCK_TICKS_PER_SEC=100

CONFIG_PINCTRL=y
```

## boards/boards_legacy/arm/mikroe_mini_m4_for_stm32/Kconfig.board
```kconfig
# Mikroe MINI-M4 for STM32 board configuration

# Copyright (c) 2019, Kwon Tae-young <tykwon@m2i.co.kr>
# SPDX-License-Identifier: Apache-2.0

config BOARD_MIKROE_MINI_M4_FOR_STM32
	bool "Mikroe MINI-M4 for STM32 Board"
	depends on SOC_STM32F415XX
```

## boards/boards_legacy/arm/mimx8mm_evk/Kconfig.board
```kconfig
# MIMX8MM EVK board

# Copyright (c) 2020, Manivannan Sadhasivam <mani@kernel.org>
# SPDX-License-Identifier: Apache-2.0

config BOARD_MIMX8MM_EVK
	bool "NXP i.MX8M Mini EVK"
	depends on SOC_SERIES_IMX8MM_M4
	select SOC_PART_NUMBER_MIMX8MM6DVTLZ
```

## boards/boards_legacy/arm/mimx8mm_phyboard_polis/Kconfig.board
```kconfig
# MIMX8MM_PHYBOARD_POLIS board configuration

# Copyright (c) 2022 PHYTEC Messtechnik GmbH
# SPDX-License-Identifier: Apache-2.0

config BOARD_MIMX8MM_PHYBOARD_POLIS
	bool "Phytec Phyboard Polis i.MX8M Mini"
	depends on SOC_SERIES_IMX8MM_M4
	select SOC_PART_NUMBER_MIMX8MM6DVTLZ
```

## boards/boards_legacy/arm/mimxrt1010_evk/Kconfig.board
```kconfig
#
# Copyright (c) 2019, NXP
#
# SPDX-License-Identifier: Apache-2.0
#

config BOARD_MIMXRT1010_EVK
	bool "NXP MIMXRT1010-EVK"
	depends on SOC_SERIES_IMX_RT
	select SOC_PART_NUMBER_MIMXRT1011DAE5A
```

## boards/boards_legacy/arm/mimxrt1040_evk/Kconfig.board
```kconfig
# Copyright 2023, NXP
# SPDX-License-Identifier: Apache-2.0

config BOARD_MIMXRT1040_EVK
	bool "NXP MIMXRT1040-EVK"
	depends on SOC_SERIES_IMX_RT
	select SOC_PART_NUMBER_MIMXRT1042XJM5B
```

## boards/boards_legacy/arm/mimxrt1040_evk/Kconfig.defconfig
```kconfig
# Copyright 2023, NXP
# SPDX-License-Identifier: Apache-2.0

if BOARD_MIMXRT1040_EVK

config BOARD
	default "mimxrt1040_evk" if BOARD_MIMXRT1040_EVK

choice CODE_LOCATION
	default CODE_FLEXSPI
endchoice

config DEVICE_CONFIGURATION_DATA
	default y

config NXP_IMX_EXTERNAL_SDRAM
	default y

endif # BOARD_MIMXRT1040_EVK
```

## boards/boards_legacy/arm/mimxrt1062_fmurt6/mimxrt1062_fmurt6_defconfig
```kconfig
#
# SPDX-License-Identifier: Apache-2.0
#
# Copyright 2023 NXP
#

CONFIG_SOC_MIMXRT1062=y
CONFIG_SOC_SERIES_IMX_RT=y
CONFIG_BOARD_MIMXRT1062_FMURT6=y
CONFIG_CONSOLE=y
CONFIG_UART_CONSOLE=y
CONFIG_SERIAL=y
CONFIG_GPIO=y
CONFIG_ARM_MPU=y
CONFIG_HW_STACK_PROTECTION=y
CONFIG_PINCTRL=y

# Enable Regulators
CONFIG_REGULATOR=y
CONFIG_REGULATOR_FIXED_INIT_PRIORITY=75
```

## boards/boards_legacy/arm/mimxrt1064_evk/Kconfig.board
```kconfig
# Copyright (c) 2018, NXP
# SPDX-License-Identifier: Apache-2.0

config BOARD_MIMXRT1064_EVK
	bool "NXP MIMXRT1064-EVK"
	depends on SOC_SERIES_IMX_RT
	select SOC_PART_NUMBER_MIMXRT1064DVL6A
```

## boards/boards_legacy/arm/mimxrt1170_evk/Kconfig.board
```kconfig
# Copyright 2021,2023 NXP
# SPDX-License-Identifier: Apache-2.0

config BOARD_MIMXRT1170_EVK_CM7
	bool "NXP MIMXRT1170-EVK CM7"
	depends on SOC_MIMXRT1176_CM7
	select SOC_PART_NUMBER_MIMXRT1176DVMAA

config BOARD_MIMXRT1170_EVK_CM4
	bool "NXP MIMXRT1170-EVK CM4"
	depends on SOC_MIMXRT1176_CM4
	select SOC_PART_NUMBER_MIMXRT1176DVMAA

config BOARD_MIMXRT1170_EVKB_CM7
	bool "NXP MIMXRT1170-EVKB CM7"
	depends on SOC_MIMXRT1176_CM7
	select SOC_PART_NUMBER_MIMXRT1176DVMAA

config BOARD_MIMXRT1170_EVKB_CM4
	bool "NXP MIMXRT1170-EVKB CM4"
	depends on SOC_MIMXRT1176_CM4
	select SOC_PART_NUMBER_MIMXRT1176DVMAA
```

## boards/boards_legacy/arm/mimxrt595_evk/Kconfig.board
```kconfig
# Copyright (c) 2022, NXP
# SPDX-License-Identifier: Apache-2.0

config BOARD_MIMXRT595_EVK
	bool "NXP MIMXRT595-EVK"
	depends on SOC_SERIES_IMX_RT5XX
	select CODE_DATA_RELOCATION_SRAM
	select SOC_PART_NUMBER_MIMXRT595SFFOC
	select NXP_IMX_RT5XX_BOOT_HEADER if !BOOTLOADER_MCUBOOT
```

## boards/boards_legacy/arm/mimxrt685_evk/Kconfig.board
```kconfig
# Copyright (c) 2020, NXP
# SPDX-License-Identifier: Apache-2.0

config BOARD_MIMXRT685_EVK
	bool "NXP MIMXRT685-EVK"
	depends on SOC_SERIES_IMX_RT6XX
	select SOC_PART_NUMBER_MIMXRT685SFVKB
	select NXP_IMX_RT6XX_BOOT_HEADER if !BOOTLOADER_MCUBOOT
```

## boards/boards_legacy/arm/mps2_an385/Kconfig.board
```kconfig
# Copyright (c) 2017 Linaro Limited
# SPDX-License-Identifier: Apache-2.0

config BOARD_MPS2_AN385
	bool "ARM Cortex-M3 SMM on V2M-MPS2 (Application Note AN385)"
	depends on SOC_MPS2_AN385
	select QEMU_TARGET
	select HAS_COVERAGE_SUPPORT
```

## boards/boards_legacy/arm/mps2_an521/Kconfig.board
```kconfig
# Copyright (c) 2018-2019 Linaro Limited
# SPDX-License-Identifier: Apache-2.0

config BOARD_MPS2_AN521_CPU0
	bool "ARM Cortex-M33 SMM on V2M-MPS2 (AN521) (CPU0)"
	depends on SOC_MPS2_AN521_CPU0
	select QEMU_TARGET
	select HAS_COVERAGE_SUPPORT

config BOARD_MPS2_AN521_CPU0_NS
	bool "ARM Cortex-M33 SMM on V2M-MPS2 (AN521) (CPU0 Non-Secure)"
	depends on SOC_MPS2_AN521_CPU0
	select QEMU_TARGET
	select HAS_COVERAGE_SUPPORT

config BOARD_MPS2_AN521_CPU1
	bool "ARM Cortex-M33 SMM on V2M-MPS2 (AN521) CPU1"
	depends on SOC_MPS2_AN521_CPU1
	select QEMU_TARGET
	select HAS_COVERAGE_SUPPORT
```

## boards/boards_legacy/arm/mps2_an521/mps2_an521_defconfig
```kconfig
#
# Copyright (c) 2018-2019 Linaro Limited
#
# SPDX-License-Identifier: Apache-2.0
#

CONFIG_SOC_SERIES_MPS2=y
CONFIG_SOC_MPS2_AN521_CPU0=y
CONFIG_BOARD_MPS2_AN521_CPU0=y
CONFIG_RUNTIME_NMI=y
CONFIG_ARM_TRUSTZONE_M=y
CONFIG_ARM_MPU=y
CONFIG_QEMU_ICOUNT_SHIFT=7

# GPIOs
CONFIG_GPIO=y

# Serial
CONFIG_CONSOLE=y
CONFIG_UART_CONSOLE=y
CONFIG_SERIAL=y

# Build a Secure firmware image
CONFIG_TRUSTED_EXECUTION_SECURE=y
```

## boards/boards_legacy/arm/msp_exp432p401r_launchxl/Kconfig.defconfig
```kconfig
# TI MSP-EXP432P401R LaunchXL development board configuration

# SPDX-License-Identifier: Apache-2.0

config BOARD
	default "msp_exp432p401r_launchxl"
	depends on BOARD_MSP_EXP432P401R_LAUNCHXL
```
