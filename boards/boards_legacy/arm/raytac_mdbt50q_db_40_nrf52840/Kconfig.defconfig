## boards/boards_legacy/arm/raytac_mdbt50q_db_40_nrf52840/Kconfig.defconfig
```kconfig
# Raytac MDBT50Q-DB-40 NRF52840 board configuration

# Copyright (c) 2022 Raytac Corporation
# SPDX-License-Identifier: Apache-2.0

if BOARD_RAYTAC_MDBT50Q_DB_40_NRF52840

config BOARD
	default "raytac_mdbt50q_db_40_nrf52840"

config BT_CTLR
	default BT

endif
```

## boards/boards_legacy/arm/rcar_h3ulcb/Kconfig.defconfig
```kconfig
# Copyright (c) 2021 IoT.bzh
# SPDX-License-Identifier: Apache-2.0

if BOARD_RCAR_H3ULCB_CR7
config BOARD
	default "rcar_h3ulcb_cr7"
endif # BOARD_RCAR_H3ULCB_CR7
```

## boards/boards_legacy/arm/reel_board/reel_board_v2_defconfig
```kconfig
# SPDX-License-Identifier: Apache-2.0

CONFIG_SOC_SERIES_NRF52X=y
CONFIG_SOC_NRF52840_QIAA=y
CONFIG_BOARD_REEL_BOARD_V2=y

# Enable MPU
CONFIG_ARM_MPU=y

# enable GPIO
CONFIG_GPIO=y

# enable uart driver
CONFIG_SERIAL=y

# enable console
CONFIG_CONSOLE=y
CONFIG_UART_CONSOLE=y
```

## boards/boards_legacy/arm/s32z270dc2_r52/Kconfig.board
```kconfig
# Copyright 2022 NXP
# SPDX-License-Identifier: Apache-2.0

config BOARD_S32Z270DC2_RTU0_R52
	bool "NXP X-S32Z270-DC (DC2) on RTU0 Cortex-R52 cores"
	depends on SOC_SERIES_S32ZE_R52
	select SOC_PART_NUMBER_S32Z27

config BOARD_S32Z270DC2_RTU1_R52
	bool "NXP X-S32Z270-DC (DC2) on RTU1 Cortex-R52 cores"
	depends on SOC_SERIES_S32ZE_R52
	select SOC_PART_NUMBER_S32Z27
```

## boards/boards_legacy/arm/s32z270dc2_r52/s32z270dc2_rtu0_r52_defconfig
```kconfig
# Copyright 2022 NXP
# SPDX-License-Identifier: Apache-2.0

CONFIG_BOARD_S32Z270DC2_RTU0_R52=y
CONFIG_SOC_SERIES_S32ZE_R52=y
CONFIG_SOC_S32Z27_R52=y
CONFIG_XIP=n
CONFIG_ISR_STACK_SIZE=512
CONFIG_SYS_CLOCK_TICKS_PER_SEC=1000
CONFIG_SYS_CLOCK_HW_CYCLES_PER_SEC=8000000
CONFIG_ARM_MPU=y
CONFIG_PINCTRL=y
CONFIG_SERIAL=y
CONFIG_CONSOLE=y
```

## boards/boards_legacy/arm/sam4e_xpro/sam4e_xpro_defconfig
```kconfig
# SPDX-License-Identifier: Apache-2.0

CONFIG_SOC_SERIES_SAM4E=y
CONFIG_SOC_PART_NUMBER_SAM4E16E=y
CONFIG_SOC_ATMEL_SAM4E_EXT_MAINCK=y
CONFIG_BOARD_SAM4E_XPRO=y
CONFIG_BUILD_OUTPUT_HEX=y

CONFIG_ARM_MPU=y
CONFIG_HW_STACK_PROTECTION=y
CONFIG_WDT_DISABLE_AT_BOOT=y

CONFIG_CONSOLE=y
CONFIG_GPIO=y
CONFIG_SERIAL=y
CONFIG_UART_CONSOLE=y
```

## boards/boards_legacy/arm/sam4l_ek/sam4l_ek_defconfig
```kconfig
# SPDX-License-Identifier: Apache-2.0

CONFIG_SOC_SERIES_SAM4L=y
CONFIG_SOC_PART_NUMBER_SAM4LC4C=y
CONFIG_BOARD_SAM4L_EK=y

CONFIG_ARM_MPU=y
CONFIG_HW_STACK_PROTECTION=y

CONFIG_CONSOLE=y
CONFIG_GPIO=y
CONFIG_SERIAL=y
CONFIG_UART_CONSOLE=y
```

## boards/boards_legacy/arm/sam_e70_xplained/sam_e70_xplained_defconfig
```kconfig
# SPDX-License-Identifier: Apache-2.0

CONFIG_SOC_SERIES_SAME70=y
CONFIG_SOC_PART_NUMBER_SAME70Q21=y
CONFIG_SOC_ATMEL_SAME70_EXT_MAINCK=y
CONFIG_SOC_ATMEL_SAME70_PLLA_MULA=24
CONFIG_SOC_ATMEL_SAME70_PLLA_DIVA=1
CONFIG_BOARD_SAM_E70_XPLAINED=y
CONFIG_BUILD_OUTPUT_HEX=y

CONFIG_ARM_MPU=y
CONFIG_CACHE_MANAGEMENT=y
CONFIG_HW_STACK_PROTECTION=y
CONFIG_WDT_DISABLE_AT_BOOT=y

CONFIG_CONSOLE=y
CONFIG_GPIO=y
CONFIG_SERIAL=y
CONFIG_UART_CONSOLE=y
CONFIG_USART_SAM=y
```

## boards/boards_legacy/arm/sam_v71_xult/Kconfig.board
```kconfig
# Atmel SMART SAM V71 Xplained Board selection

# Copyright (c) 2019 Gerson Fernando Budke
# Copyright (c) 2016 Piotr Mienkowski
# SPDX-License-Identifier: Apache-2.0

config BOARD_SAM_V71_XULT
	bool "Atmel SMART SAM V71 Xplained Ultra Board"
	depends on SOC_PART_NUMBER_SAMV71Q21 || SOC_PART_NUMBER_SAMV71Q21B
```

## boards/boards_legacy/arm/sam_v71_xult/sam_v71_xult_defconfig
```kconfig
# SPDX-License-Identifier: Apache-2.0

CONFIG_SOC_SERIES_SAMV71=y
CONFIG_SOC_PART_NUMBER_SAMV71Q21=y
CONFIG_SOC_ATMEL_SAMV71_EXT_MAINCK=y
CONFIG_SOC_ATMEL_SAMV71_PLLA_MULA=24
CONFIG_SOC_ATMEL_SAMV71_PLLA_DIVA=1
CONFIG_BOARD_SAM_V71_XULT=y
CONFIG_BUILD_OUTPUT_HEX=y

CONFIG_ARM_MPU=y
CONFIG_CACHE_MANAGEMENT=y
CONFIG_HW_STACK_PROTECTION=y
CONFIG_WDT_DISABLE_AT_BOOT=y

CONFIG_CONSOLE=y
CONFIG_GPIO=y
CONFIG_SERIAL=y
CONFIG_UART_CONSOLE=y
CONFIG_USART_SAM=y
```

## boards/boards_legacy/arm/scobc_module1/Kconfig.board
```kconfig
# Space Cubics OBC module 1 configuration

# Copyright (c) 2021 Space Cubics, LLC. <yashi@spacecubics.com>
# SPDX-License-Identifier: Apache-2.0

config BOARD_SCOBC_MODULE1
	bool "Space Cubics OBC Module 1"
	depends on SOC_SERIES_ARM_DESIGNSTART
```

## boards/boards_legacy/arm/seeeduino_xiao/Kconfig.board
```kconfig
# Seeeduino XIAO board configuration

# Copyright (c) 2020 Google LLC.
# SPDX-License-Identifier: Apache-2.0

config BOARD_SEEEDUINO_XIAO
	bool "Seeeduino XIAO"
	depends on SOC_PART_NUMBER_SAMD21G18A
```

## boards/boards_legacy/arm/seeeduino_xiao/Kconfig.defconfig
```kconfig
# Seeedunio XIAO board configuration

# Copyright (c) 2020 Google LLC.
# SPDX-License-Identifier: Apache-2.0

config BOARD
	default "seeeduino_xiao"
	depends on BOARD_SEEEDUINO_XIAO
```

## boards/boards_legacy/arm/segger_trb_stm32f407/Kconfig.defconfig
```kconfig
# SEGGER-TRB-STM32F407 board configuration

# Copyright (c) 2020, Erwin Rol <erwin@erwinrol.com>
# SPDX-License-Identifier: Apache-2.0

if BOARD_SEGGER_TRB_STM32F407

config BOARD
	default "segger_trb_stm32f407"

endif # BOARD_SEGGER_TRB_STM32F407
```

## boards/boards_legacy/arm/sensortile_box/Kconfig.board
```kconfig
# SensorTile.box board configuration

# Copyright (c) 2019 STMicroelectronics
# SPDX-License-Identifier: Apache-2.0

config BOARD_SENSORTILE_BOX
	bool "SensorTile.box Development Board"
	depends on SOC_STM32L4R9XX
```

## boards/boards_legacy/arm/serpente/Kconfig.defconfig
```kconfig
# Serpente board configuration
# Copyright (c) 2020 Alexander Falb <fal3xx@gmail.com>
# SPDX-License-Identifier: Apache-2.0

config BOARD
	default "serpente"
	depends on BOARD_SERPENTE
```

## boards/boards_legacy/arm/stm32f411e_disco/Kconfig.board
```kconfig
# STM32F411E-DISCO board configuration

# Copyright (c) 2017 Fenix Engineering Solutions
# SPDX-License-Identifier: Apache-2.0

config BOARD_STM32F411E_DISCO
	bool "STM32F411E-DISCO Development Board"
	depends on SOC_STM32F411XE
```

## boards/boards_legacy/arm/stm32f4_disco/Kconfig.defconfig
```kconfig
# STM32F4DISCOVERY board configuration

# Copyright (c) 2016 Linaro Limited.
# SPDX-License-Identifier: Apache-2.0

if BOARD_STM32F4_DISCO

config BOARD
	default "stm32f4_disco"

endif # BOARD_STM32F4_DISCO
```

## boards/boards_legacy/arm/stm32f723e_disco/Kconfig.defconfig
```kconfig
# STM32F723E DISCOVERY board configuration

# Copyright (c) 2018 Aurelien Jarno
# SPDX-License-Identifier: Apache-2.0

if BOARD_STM32F723E_DISCO

config BOARD
	default "stm32f723e_disco"

config SPI_STM32_INTERRUPT
	default y
	depends on SPI


endif # BOARD_STM32F723E_DISCO
```

## boards/boards_legacy/arm/stm32f746g_disco/Kconfig.defconfig
```kconfig
# STM32F746G DISCOVERY board configuration

# Copyright (c) 2018 Yurii Hamann
# SPDX-License-Identifier: Apache-2.0

if BOARD_STM32F746G_DISCO

config BOARD
	default "stm32f746g_disco"

if NETWORKING

config NET_L2_ETHERNET
	default y

endif # NETWORKING

config INPUT
	default y if LVGL

if DISPLAY

# MEMC needs to be enabled in order to store
# display buffer to external SDRAM connected to FMC
config MEMC
	default y

endif # DISPLAY

if INPUT

config INPUT_FT5336_INTERRUPT
	default y

endif # INPUT

config DISK_DRIVER_SDMMC
	default y if DISK_DRIVERS

endif # BOARD_STM32F746G_DISCO
```

## boards/boards_legacy/arm/stm32f7508_dk/Kconfig.board
```kconfig
# STM32F7508-DK Discovery board configuration

# Copyright (c) 2022, Rtone.
# SPDX-License-Identifier: Apache-2.0

config BOARD_STM32F7508_DK
	bool "STM32F7508-DK Discovery Kit"
	depends on SOC_STM32F750XX
```

## boards/boards_legacy/arm/stm32f769i_disco/Kconfig.board
```kconfig
# STM32F769I Discovery board configuration

# Copyright (c) 2018 Yong Jin
# SPDX-License-Identifier: Apache-2.0

config BOARD_STM32F769I_DISCO
	bool "STM32F769I Discovery Development Board"
	depends on SOC_STM32F769XX
```

## boards/boards_legacy/arm/stm32g0316_disco/Kconfig.defconfig
```kconfig
# STM32G0316 Discovery board configuration

# Copyright (c) 2019 SEAL AG
# SPDX-License-Identifier: Apache-2.0

if BOARD_STM32G0316_DISCO

config BOARD
	default "stm32g0316_disco"

endif # BOARD_STM32G0316_DISCO
```

## boards/boards_legacy/arm/stm32g071b_disco/Kconfig.defconfig
```kconfig
# STM32G071B Discovery board configuration

# Copyright 2021 The Chromium OS Authors
# SPDX-License-Identifier: Apache-2.0

if BOARD_STM32G071B_DISCO

config BOARD
	default "stm32g071b_disco"

endif # BOARD_STM32G071B_DISCO
```

## boards/boards_legacy/arm/stm32g081b_eval/Kconfig.board
```kconfig
# STM32G081B Evaluation board configuration

# Copyright 2021 The Chromium OS Authors
# SPDX-License-Identifier: Apache-2.0

config BOARD_STM32G081B_EVAL
	bool "STM32G081B Evaluation Board"
	depends on SOC_STM32G081XX
```
