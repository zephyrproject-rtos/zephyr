## boards/boards_legacy/arm/stm32g081b_eval/Kconfig.defconfig
```kconfig
# STM32G081B evaluation board configuration

# Copyright 2021 The Chromium OS Authors
# SPDX-License-Identifier: Apache-2.0

if BOARD_STM32G081B_EVAL

config BOARD
	default "stm32g081b_eval"

endif # BOARD_STM32G081B_EVAL
```

## boards/boards_legacy/arm/stm32h747i_disco/stm32h747i_disco_m4_defconfig
```kconfig
# SPDX-License-Identifier: Apache-2.0

CONFIG_SOC_SERIES_STM32H7X=y
CONFIG_SOC_STM32H747XX=y

# Board config should be specified since there are 2 possible targets
CONFIG_BOARD_STM32H747I_DISCO_M4=y

# enable GPIO
CONFIG_GPIO=y

# clock configuration
CONFIG_CLOCK_CONTROL=y

# Enable MPU
CONFIG_ARM_MPU=y

# Enable HW stack protection
CONFIG_HW_STACK_PROTECTION=y

# enable uart driver
CONFIG_SERIAL=y

# By default CONSOLE is assigned to m7
#CONFIG_CONSOLE=y
#CONFIG_UART_CONSOLE=y

# enable pin controller
CONFIG_PINCTRL=y
```

## boards/boards_legacy/arm/stm32h747i_disco/stm32h747i_disco_m7_defconfig
```kconfig
# SPDX-License-Identifier: Apache-2.0

CONFIG_SOC_SERIES_STM32H7X=y
CONFIG_SOC_STM32H747XX=y

# Board config should be specified since there are 2 possible targets
CONFIG_BOARD_STM32H747I_DISCO_M7=y

# Enable the internal SMPS regulator
CONFIG_POWER_SUPPLY_DIRECT_SMPS=y

# enable GPIO
CONFIG_GPIO=y

# Enable clocks
CONFIG_CLOCK_CONTROL=y

# Enable MPU
CONFIG_ARM_MPU=y

# Enable HW stack protection
CONFIG_HW_STACK_PROTECTION=y

# Disable following to assign serial ports to m4 core

# enable uart driver
CONFIG_SERIAL=y
# console
CONFIG_CONSOLE=y
CONFIG_UART_CONSOLE=y

# enable pin controller
CONFIG_PINCTRL=y
```

## boards/boards_legacy/arm/stm32l4r9i_disco/Kconfig.board
```kconfig
# STM32L4R9I Discovery board configuration

# Copyright (c) 2023 STMicroelectronics
# SPDX-License-Identifier: Apache-2.0

config BOARD_STM32L4R9I_DISCO
	bool "STM32L4R9I Discovery Development Board"
	depends on SOC_STM32L4R9XX
```

## boards/boards_legacy/arm/stm32l4r9i_disco/Kconfig.defconfig
```kconfig
# STM32L4R9I Discovery board configuration

# Copyright (c) 2023 STMicroelectronics
# SPDX-License-Identifier: Apache-2.0

if BOARD_STM32L4R9I_DISCO

config BOARD
	default "stm32l4r9i_disco"

endif # BOARD_STM32L4R9I_DISCO
```

## boards/boards_legacy/arm/stm32u5a9j_dk/Kconfig.board
```kconfig
# STM32U5A9J Discovery Kit board configuration

# Copyright (c) 2023 STMicroelectronics
# SPDX-License-Identifier: Apache-2.0

config BOARD_STM32U5A9J_DK
	bool "STM32U5A9J Discovery Kit Development Board"
	depends on SOC_STM32U5A9XX
```

## boards/boards_legacy/arm/stm32u5a9j_dk/stm32u5a9j_dk_defconfig
```kconfig
# Copyright (c) 2023 STMicroelectronics
# SPDX-License-Identifier: Apache-2.0

# Set SoC present on the board
CONFIG_SOC_SERIES_STM32U5X=y
CONFIG_SOC_STM32U5A9XX=y

# Enable MPU
CONFIG_ARM_MPU=y

# Enable HW stack protection
CONFIG_HW_STACK_PROTECTION=y

# Enable serial
CONFIG_SERIAL=y

# Enable console
CONFIG_CONSOLE=y
CONFIG_UART_CONSOLE=y

# Enable GPIO
CONFIG_GPIO=y

# Enable clocks
CONFIG_CLOCK_CONTROL=y

# Enable pinctrl
CONFIG_PINCTRL=y
```

## boards/boards_legacy/arm/stm32wb5mm_dk/Kconfig.board
```kconfig
# STM32WB5MM-DK Discovery Development board configuration

# Copyright (c) 2024 Javad Rahimipetroudi <javad.rahimipetroudi@mind.be>
# SPDX-License-Identifier: Apache-2.0

config BOARD_STM32WB5MM_DK
	bool "stm32wb5mm-dk Discovery Development Board"
	depends on SOC_STM32WB55XX
```

## boards/boards_legacy/arm/tdk_robokit1/Kconfig.board
```kconfig
# TDK RoboKit 1 Board Options

# Copyright (c) 2022 Intel Corporation
# SPDX-License-Identifier: Apache-2.0

config BOARD_TDK_ROBOKIT1
	bool "TDK RoboKit1 Board"
	depends on SOC_PART_NUMBER_SAME70Q21 || SOC_PART_NUMBER_SAME70Q21B
```

## boards/boards_legacy/arm/tdk_robokit1/Kconfig.defconfig
```kconfig
# TDK RoboKit1 Configuration

# Copyright (c) 2022 Intel Corporation
# SPDX-License-Identifier: Apache-2.0

if BOARD_TDK_ROBOKIT1

config BOARD
	default "tdk_robotkit1"

endif # BOARD_TDK_ROBOKIT1
```

## boards/boards_legacy/arm/thingy52_nrf52832/Kconfig.board
```kconfig
# Thingy52 NRF52832 board configuration

# Copyright (c) 2018 Aapo Vienamo
# SPDX-License-Identifier: Apache-2.0

config BOARD_THINGY52_NRF52832
	bool "Thingy52 NRF52832"
	depends on SOC_NRF52832_QFAA
```

## boards/boards_legacy/arm/thingy52_nrf52832/thingy52_nrf52832_defconfig
```kconfig
# SPDX-License-Identifier: Apache-2.0

CONFIG_SOC_SERIES_NRF52X=y
CONFIG_SOC_NRF52832_QFAA=y
CONFIG_BOARD_THINGY52_NRF52832=y

# Enable regulators
CONFIG_REGULATOR=y

# Enable MPU
CONFIG_ARM_MPU=y

# Enable hardware stack protection
CONFIG_HW_STACK_PROTECTION=y

# Enable RTT
CONFIG_USE_SEGGER_RTT=y

# enable regulators (init priority adjusted so that they
# are turned before I2C GPIO expander)
CONFIG_REGULATOR=y
CONFIG_REGULATOR_FIXED_INIT_PRIORITY=45

# enable GPIO
CONFIG_GPIO=y

# enable uart driver
CONFIG_SERIAL=y

# enable console
CONFIG_CONSOLE=y
CONFIG_UART_CONSOLE=y
```

## boards/boards_legacy/arm/twr_ke18f/Kconfig.defconfig
```kconfig
# TWR-KE18F board

# Copyright (c) 2019 Vestas Wind Systems A/S
# SPDX-License-Identifier: Apache-2.0

if BOARD_TWR_KE18F

config BOARD
	default "twr_ke18f"

config I2C_MCUX_LPI2C_BUS_RECOVERY
	default y
	depends on I2C_MCUX_LPI2C && PINCTRL

# The KE1xF has 8 MPU regions, which is not enough for both HW stack protection
# and userspace. Only enable HW stack protection if userspace is not enabled.
config HW_STACK_PROTECTION
	default y if !USERSPACE

endif # BOARD_TWR_KE18F
```

## boards/boards_legacy/arm/ubx_bmd300eval_nrf52832/Kconfig.defconfig
```kconfig
# BMD-300-EVAL, BMD-301-EVAL, and BMD-350-EVAL board configuration

# Copyright (c) 2021 u-blox AG
# SPDX-License-Identifier: Apache-2.0

if BOARD_UBX_BMD300EVAL_NRF52832

config BOARD
	default "ubx_bmd300eval_nrf52832"

config BT_CTLR
	default BT

endif # BOARD_UBX_BMD300EVAL_NRF52832
```

## boards/boards_legacy/arm/ubx_bmd340eval_nrf52840/Kconfig.board
```kconfig
# BMD-340-EVAL board configuration

# Copyright (c) 2021 u-blox AG
# SPDX-License-Identifier: Apache-2.0

config BOARD_UBX_BMD340EVAL_NRF52840
	bool "u-blox BMD-340-EVAL"
	depends on SOC_NRF52840_QIAA
```

## boards/boards_legacy/arm/ubx_bmd345eval_nrf52840/Kconfig.board
```kconfig
# BMD-340-EVAL board configuration

# Copyright (c) 2021 u-blox AG
# Copyright (c) 2021 Linumiz
# SPDX-License-Identifier: Apache-2.0

config BOARD_UBX_BMD345EVAL_NRF52840
	bool "u-blox BMD-345-EVAL"
	depends on SOC_NRF52840_QIAA
```

## boards/boards_legacy/arm/ubx_evkannab1_nrf52832/Kconfig.defconfig
```kconfig
# u-blox EVK-ANNA-B1 board configuration
#
# Copyright (c) 2021 u-blox AG
# SPDX-License-Identifier: Apache-2.0

if BOARD_UBX_EVKANNAB1_NRF52832

config BOARD
	default "ubx_evkannab1_nrf52832"

config BT_CTLR
	default BT

endif # BOARD_UBX_EVKANNAB1_NRF52832
```

## boards/boards_legacy/arm/ubx_evkninab1_nrf52832/Kconfig.defconfig
```kconfig
# u-blox EVK-NINA-B1 board configuration

# Copyright (c) 2021 u-blox AG
# SPDX-License-Identifier: Apache-2.0

if BOARD_UBX_EVKNINAB1_NRF52832

config BOARD
	default "ubx_evkninab1_nrf52832"

config BT_CTLR
	default BT

endif # BOARD_UBX_EVKNINAB1_NRF52832
```

## boards/boards_legacy/arm/ubx_evkninab3_nrf52840/Kconfig.board
```kconfig
# EVK-NINA-B3 board configuration

# Copyright (c) 2021 u-blox AG
# SPDX-License-Identifier: Apache-2.0

config BOARD_UBX_EVKNINAB3_NRF52840
	bool "u-blox EVK-NINA-B3"
	depends on SOC_NRF52840_QIAA
```

## boards/boards_legacy/arm/ucans32k1sic/Kconfig.board
```kconfig
# Copyright 2023 NXP
# SPDX-License-Identifier: Apache-2.0

config BOARD_UCANS32K1SIC
	bool "ucans32k1sic"
	depends on SOC_SERIES_S32K1XX
	select SOC_PART_NUMBER_FS32K146UAT0VLHT
```

## boards/boards_legacy/arm/ucans32k1sic/Kconfig.defconfig
```kconfig
# Copyright 2023 NXP
# SPDX-License-Identifier: Apache-2.0

if BOARD_UCANS32K1SIC

config BOARD
	default "ucans32k1sic"

if SERIAL

config UART_CONSOLE
	default y

endif # SERIAL

if CAN

config GPIO
	default y

endif # CAN

endif # BOARD_UCANS32K1SIC
```

## boards/boards_legacy/arm/usb_kw24d512/Kconfig.board
```kconfig
# USB-KW24D512 board

# Copyright (c) 2017, Phytec Messtechnik GmbH
# SPDX-License-Identifier: Apache-2.0

config BOARD_USB_KW24D512
	bool "NXP USB-KW24D512"
	depends on SOC_SERIES_KINETIS_KWX
	select SOC_PART_NUMBER_MKW24D512VHA5
```

## boards/boards_legacy/arm/v2m_beetle/Kconfig.defconfig
```kconfig
# ARM V2M Beetle Board configuration options

# Copyright (c) 2016 Linaro Limited
# SPDX-License-Identifier: Apache-2.0

if BOARD_V2M_BEETLE

config BOARD
	default "v2m_beetle"

if SERIAL

config UART_INTERRUPT_DRIVEN
	default y

endif # SERIAL

endif # BOARD_V2M_BEETLE
```

## boards/boards_legacy/arm/verdin_imx8mp_m7/Kconfig.board
```kconfig
# VERDIN_IMX8MP_M7 board

# Copyright (c) 2023 Toradex
# SPDX-License-Identifier: Apache-2.0

config BOARD_VERDIN_IMX8MP_M7
	bool "Toradex iMX8M Plus M7"
	depends on SOC_SERIES_IMX8ML_M7
	select SOC_PART_NUMBER_MIMX8ML8DVNLZ
```
