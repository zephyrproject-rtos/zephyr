## boards/boards_legacy/arm/arduino_uno_r4/Kconfig.defconfig
```kconfig
# Copyright (c) 2023 TOKITA Hiroshi <tokita.hiroshi@fujitsu.com>
# SPDX-License-Identifier: Apache-2.0

if BOARD_ARDUINO_UNO_R4_MINIMA

config BOARD
	default "arduino_uno_r4_minima" if BOARD_ARDUINO_UNO_R4_MINIMA

endif # BOARD_ARDUINO_UNO_R4_MINIMA
```

## boards/boards_legacy/arm/arduino_zero/Kconfig.board
```kconfig
# Arduino Zero Board configuration

# Copyright (c) 2017 Google LLC.
# SPDX-License-Identifier: Apache-2.0

config BOARD_ARDUINO_ZERO
	bool "Arduino Zero"
	depends on SOC_PART_NUMBER_SAMD21G18A
```

## boards/boards_legacy/arm/arduino_zero/Kconfig.defconfig
```kconfig
# Arduino Zero board configuration

# Copyright (c) 2017 Google LLC.
# SPDX-License-Identifier: Apache-2.0

config BOARD
	default "arduino_zero"
	depends on BOARD_ARDUINO_ZERO
```

## boards/boards_legacy/arm/ast1030_evb/Kconfig.board
```kconfig
# SPDX-License-Identifier: Apache-2.0
#
# Aspeed AST1030 evaluation board configuration
#
# Copyright (c) 2021 Aspeed Technology Inc.

config BOARD_AST1030_EVB
	bool "ASPEED AST1030 Evaluation Board"
	depends on SOC_AST1030
```

## boards/boards_legacy/arm/atsamd20_xpro/Kconfig.board
```kconfig
# SAM D20 Xplained Pro Board configuration

# Copyright (c) 2018 Sean Nyekjaer
# SPDX-License-Identifier: Apache-2.0

config BOARD_ATSAMD20_XPRO
	bool "SAM D20 Xplained Pro"
	depends on SOC_PART_NUMBER_SAMD20J18
```

## boards/boards_legacy/arm/atsamd21_xpro/atsamd21_xpro_defconfig
```kconfig
# Copyright (c) 2018 Bryan O'Donoghue
# SPDX-License-Identifier: Apache-2.0

CONFIG_SOC_SERIES_SAMD21=y
CONFIG_SOC_PART_NUMBER_SAMD21J18A=y
CONFIG_SOC_ATMEL_SAMD_XOSC32K=y
CONFIG_SOC_ATMEL_SAMD_XOSC32K_AS_MAIN=y
CONFIG_BOARD_ATSAMD21_XPRO=y
CONFIG_BUILD_OUTPUT_HEX=y

CONFIG_CONSOLE=y
CONFIG_GPIO=y
CONFIG_SERIAL=y
CONFIG_UART_CONSOLE=y
CONFIG_UART_INTERRUPT_DRIVEN=y
```

## boards/boards_legacy/arm/atsamr21_xpro/Kconfig.board
```kconfig
# SAM R21 Xplained Pro Board configuration

# Copyright (c) 2019 Benjamin Valentin
# SPDX-License-Identifier: Apache-2.0

config BOARD_ATSAMR21_XPRO
	bool "SAM R21 Xplained Pro"
	depends on SOC_PART_NUMBER_SAMR21G18A
```

## boards/boards_legacy/arm/b_u585i_iot02a/Kconfig.defconfig
```kconfig
# B_U585I_IOT02A discovery kit board configuration

# Copyright (c) 2021 STMicroelectronics
# SPDX-License-Identifier: Apache-2.0

if BOARD_B_U585I_IOT02A

config BOARD
	default "b_u585i_iot02a"

config SPI_STM32_INTERRUPT
	default y
	depends on SPI

# Get flash configuration for NS image from dts flash partition
config USE_DT_CODE_PARTITION
	default y if TRUSTED_EXECUTION_NONSECURE

if BUILD_WITH_TFM

# Initial Attestation key provisioned by the BL1 bootloader
config TFM_INITIAL_ATTESTATION_KEY
	default y

config TFM_DUMMY_PROVISIONING
	default n

endif # BUILD_WITH_TFM

# Disable Flow control
if BT

config BT_HCI_ACL_FLOW_CONTROL
	default n

endif # BT

endif # BOARD_B_U585I_IOT02A
```

## boards/boards_legacy/arm/bl5340_dvk/Kconfig.board
```kconfig
# BL5340-DVK board configuration

# Copyright (c) 2021 Laird Connectivity
# SPDX-License-Identifier: Apache-2.0

if SOC_NRF5340_CPUAPP_QKAA

config BOARD_BL5340_DVK_CPUAPP
	bool "BL5340-DVK (nRF5340) Application MCU"

config BOARD_BL5340_DVK_CPUAPP_NS
	bool "BL5340-DVK (nRF5340) Application MCU non-secure"

endif # SOC_NRF5340_CPUAPP_QKAA

config BOARD_BL5340_DVK_CPUNET
	bool "BL5340-DVK (nRF5340) Network MCU"
	depends on SOC_NRF5340_CPUNET_QKAA
```

## boards/boards_legacy/arm/bl653_dvk/Kconfig.board
```kconfig
# BL653 DVK board configuration

# Copyright (c) 2020 Laird Connectivity
# SPDX-License-Identifier: Apache-2.0

config BOARD_BL653_DVK
	bool "BL653 DVK"
	depends on SOC_NRF52833_QIAA
```

## boards/boards_legacy/arm/bl654_sensor_board/Kconfig.defconfig
```kconfig
# BL654 Sensor Board configuration

# Copyright (c) 2021 Laird Connectivity
# SPDX-License-Identifier: Apache-2.0

if BOARD_BL654_SENSOR_BOARD

config BOARD
	default "bl654_sensor_board"

config BT_CTLR
	default BT

endif # BOARD_BL654_SENSOR_BOARD
```

## boards/boards_legacy/arm/black_f407zg_pro/Kconfig.defconfig
```kconfig
# black_f407zg board configuration

# Copyright (c) 2020 Intel Corporation
# SPDX-License-Identifier: Apache-2.0

if BOARD_BLACK_F407ZG_PRO

config BOARD
	default "black_f407zg_pro"

config SPI_STM32_INTERRUPT
	default y
	depends on SPI

endif # BOARD_BLACK_F407ZG_PRO
```

## boards/boards_legacy/arm/bt510/Kconfig.board
```kconfig
# BT510 DVK board configuration

# Copyright (c) 2020 Laird Connectivity
# SPDX-License-Identifier: Apache-2.0

config BOARD_BT510
	bool "BT510"
	depends on SOC_NRF52840_QIAA
```

## boards/boards_legacy/arm/bt610/Kconfig.board
```kconfig
# BT610 board configuration

# Copyright (c) 2021 Laird Connectivity
# SPDX-License-Identifier: Apache-2.0

config BOARD_BT610
	bool "BT610"
	depends on SOC_NRF52840_QIAA
```

## boards/boards_legacy/arm/cc1352r1_launchxl/Kconfig.defconfig
```kconfig
# TI CC1352R LaunchXL board

# Copyright (c) 2019 Brett Witherspoon
# SPDX-License-Identifier: Apache-2.0

if BOARD_CC1352R1_LAUNCHXL

config BOARD
	default "cc1352r1_launchxl"

endif # BOARD_CC1352R1_LAUNCHXL
```

## boards/boards_legacy/arm/cc1352r_sensortag/Kconfig.defconfig
```kconfig
# TI CC1352R SensorTag board

# Copyright (c) 2019 Brett Witherspoon
# Copyright (c) 2020 Friedt Professional Engineering Services, Inc
# SPDX-License-Identifier: Apache-2.0

if BOARD_CC1352R_SENSORTAG

config BOARD
	default "cc1352r_sensortag"

config SPI
	default SENSOR

endif # BOARD_CC1352R_SENSORTAG
```

## boards/boards_legacy/arm/cc3235sf_launchxl/Kconfig.defconfig
```kconfig
# TI CC3235SF LaunchXL board configuration

# Copyright (c) 2019, Texas Instruments Incorporated
# SPDX-License-Identifier: Apache-2.0

if BOARD_CC3235SF_LAUNCHXL

config BOARD
	default "cc3235sf_launchxl"

endif # BOARD_CC3235SF_LAUNCHXL
```

## boards/boards_legacy/arm/colibri_imx7d_m4/colibri_imx7d_m4_defconfig
```kconfig
#
# Copyright (c) 2017, NXP
#
# SPDX-License-Identifier: Apache-2.0
#

CONFIG_SOC_SERIES_IMX7_M4=y
CONFIG_SOC_MCIMX7_M4=y
CONFIG_BOARD_COLIBRI_IMX7D_M4=y
CONFIG_UART_CONSOLE=y
CONFIG_SERIAL=y
CONFIG_UART_INTERRUPT_DRIVEN=y
CONFIG_CONSOLE=y
CONFIG_XIP=y
CONFIG_PINCTRL=y
```

## boards/boards_legacy/arm/contextualelectronics_abc/Kconfig.defconfig
```kconfig
# nRF52840 BLE Cell board configuration

# Copyright (c) 2020 Bilal Wasim
# SPDX-License-Identifier: Apache-2.0

if BOARD_CONTEXTELEC_ABC

config BOARD
	default "nrf52840_ble_cell"

config BT_CTLR
	default BT

endif # BOARD_CONTEXTELEC_ABC
```

## boards/boards_legacy/arm/cy8ckit_062_wifi_bt/Kconfig.defconfig
```kconfig
# PSoC6 WiFi-BT Pioneer Kit configuration

# Copyright (c) 2020 ATL Electronics
# SPDX-License-Identifier: Apache-2.0

if BOARD_CY8CKIT_062_WIFI_BT_M0 || \
	BOARD_CY8CKIT_062_WIFI_BT_M4

config BOARD
	default "cy8ckit_062_wifi_bt_m0" if BOARD_CY8CKIT_062_WIFI_BT_M0
	default "cy8ckit_062_wifi_bt_m4" if BOARD_CY8CKIT_062_WIFI_BT_M4

endif   # BOARD_CY8CKIT_062_WIFI_BT_M0 || \
	# BOARD_CY8CKIT_062_WIFI_BT_M4
```

## boards/boards_legacy/arm/cy8ckit_062s4/Kconfig.board
```kconfig
# Copyright (c) 2023 David Ullmann
# SPDX-License-Identifier: Apache-2.0

config BOARD_CY8CKIT_062S4_M4
	bool "PSoC 62S4 pioneer kit"
	depends on SOC_CY8C6244LQI_S4D92
```

## boards/boards_legacy/arm/cy8ckit_062s4/Kconfig.defconfig
```kconfig
# Copyright (c) 2023 David Ullmann
# SPDX-License-Identifier: Apache-2.0

if BOARD_CY8CKIT_062S4_M4

config BOARD
	default "cy8ckit_062s4_m4" if BOARD_CY8CKIT_062S4_M4


endif #BOARD_CY8CKIT_062S4_M4
```

## boards/boards_legacy/arm/cy8cproto_063_ble/Kconfig.board
```kconfig
# CY8CPROTO-063-BLE PSoC™ 6 BLE Prototyping Kit
#
# Copyright (c) 2023 Cypress Semiconductor Corporation (an Infineon company) or
# an affiliate of Cypress Semiconductor Corporation
# SPDX-License-Identifier: Apache-2.0

config BOARD_CY8CPROTO_063_BLE
	bool "CY8CPROTO-063-BLE PSoC™ 6 BLE Prototyping Kit with single CPU"
```

## boards/boards_legacy/arm/cy8cproto_063_ble/Kconfig.defconfig
```kconfig
# CY8CPROTO-063-BLE PSoC™ 6 BLE Prototyping Kit

# Copyright (c) 2023 Cypress Semiconductor Corporation (an Infineon company) or
# an affiliate of Cypress Semiconductor Corporation
# SPDX-License-Identifier: Apache-2.0

if BOARD_CY8CPROTO_063_BLE

config BOARD
	default "cy8cproto_063_ble"

choice BT_HCI_BUS_TYPE
	default BT_PSOC6_BLESS if BT
endchoice

endif # BOARD_CY8CPROTO_063_BLE
```
