## boards/boards_legacy/arm/nucleo_f302r8/Kconfig.board
```kconfig
# NUCLEO-64 F302R8 board configuration

# Copyright (c) 2018 Seitz & Associates
# SPDX-License-Identifier: Apache-2.0

config BOARD_NUCLEO_F302R8
	bool "NUCLEO-64 F302R8 Development Board"
	depends on SOC_STM32F302X8
```

## boards/boards_legacy/arm/nucleo_f303k8/Kconfig.defconfig
```kconfig
# NUCLEO-32 F303k8 board configuration

# Copyright (c) 2020 Sebastian Schwabe <sebastian.schwabe@mailbox.tu-dresden.de>
#                    	Fabian Paschke <fabian.paschke@eas.iis.fraunhofer.de>
# SPDX-License-Identifier: Apache-2.0

if BOARD_NUCLEO_F303K8

config BOARD
	default "nucleo_f303k8"

endif # BOARD_NUCLEO_F303K8
```

## boards/boards_legacy/arm/nucleo_f334r8/Kconfig.board
```kconfig
# STM32 Nucleo-64 development board with STM32F334R8 MCU configuration

# Copyright (c) 2016 RnDity Sp. z o.o.
# SPDX-License-Identifier: Apache-2.0

config BOARD_NUCLEO_F334R8
	bool "NUCLEO-64 F334R8 Development Board"
	depends on SOC_STM32F334X8
```

## boards/boards_legacy/arm/nucleo_f401re/Kconfig.board
```kconfig
# NUCLEO-64 F401RE board configuration

# Copyright (c) 2016 Linaro Limited.
# SPDX-License-Identifier: Apache-2.0

config BOARD_NUCLEO_F401RE
	bool "NUCLEO-64 F401RE Development Board"
	depends on SOC_STM32F401XE
```

## boards/boards_legacy/arm/nucleo_f411re/Kconfig.defconfig
```kconfig
# NUCLEO-64 F411RE board configuration

# Copyright (c) 2016 Matthias Boesl
# SPDX-License-Identifier: Apache-2.0

if BOARD_NUCLEO_F411RE

config BOARD
	default "nucleo_f411re"

config SPI_STM32_INTERRUPT
	default y
	depends on SPI

endif # BOARD_NUCLEO_F411RE
```

## boards/boards_legacy/arm/nucleo_f446re/Kconfig.board
```kconfig
# STM32F446RE Nucleo board configuration

# Copyright (c) 2018 Philémon Jaermann
# SPDX-License-Identifier: Apache-2.0

config BOARD_NUCLEO_F446RE
	bool "Nucleo F446RE Development Board"
	depends on SOC_STM32F446XX
```

## boards/boards_legacy/arm/nucleo_f446ze/Kconfig.board
```kconfig
# STM32F446ZE Nucleo board configuration

# Copyright (c) 2021 Tom Owen
# SPDX-License-Identifier: Apache-2.0

config BOARD_NUCLEO_F446ZE
	bool "Nucleo F446ZE Development Board"
	depends on SOC_STM32F446XX
```

## boards/boards_legacy/arm/nucleo_f746zg/Kconfig.board
```kconfig
# STM32F746ZG Nucleo board configuration

# Copyright (c) 2018 AJ Palmer
# SPDX-License-Identifier: Apache-2.0

config BOARD_NUCLEO_F746ZG
	bool "Nucleo F746ZG Development Board"
	depends on SOC_STM32F746XX
```

## boards/boards_legacy/arm/nucleo_f746zg/Kconfig.defconfig
```kconfig
# STM32F746ZG Nucleo board configuration

# Copyright (c) 2018 AJ Palmer
# SPDX-License-Identifier: Apache-2.0

if BOARD_NUCLEO_F746ZG

config BOARD
	default "nucleo_f746zg"

if NETWORKING

config NET_L2_ETHERNET
	default y

endif # NETWORKING

endif # BOARD_NUCLEO_F746ZG
```

## boards/boards_legacy/arm/nucleo_f756zg/Kconfig.defconfig
```kconfig
# STM32F756ZG Nucleo board configuration

# Copyright (c) 2018 AJ Palmer
# SPDX-License-Identifier: Apache-2.0

if BOARD_NUCLEO_F756ZG

config BOARD
	default "nucleo_f756zg"

if NETWORKING

config NET_L2_ETHERNET
	default y

endif # NETWORKING

endif # BOARD_NUCLEO_F756ZG
```

## boards/boards_legacy/arm/nucleo_g031k8/Kconfig.board
```kconfig
# STM32 Nucleo-32 development board with STM32G031K8 MCU configuration

# Copyright (c) 2022 Joylab AG <team@joylab.ch>
# SPDX-License-Identifier: Apache-2.0

config BOARD_NUCLEO_G031K8
	bool "NUCLEO-32 G031K8 Development Board"
	depends on SOC_STM32G031XX
```

## boards/boards_legacy/arm/nucleo_g070rb/Kconfig.board
```kconfig
# STM32 Nucleo-64 development board with STM32G070RB MCU configuration

# Copyright (c) 2023 Marin Jurjević <marin.jurjevic@hotmail.com>
# SPDX-License-Identifier: Apache-2.0

config BOARD_NUCLEO_G070RB
	bool "NUCLEO-64 G070RB Development Board"
	depends on SOC_STM32G070XX
```

## boards/boards_legacy/arm/nucleo_g070rb/Kconfig.defconfig
```kconfig
# STM32 Nucleo-64 development board with STM32G070RB MCU

# Copyright (c) 2023 Marin Jurjević <marin.jurjevic@hotmail.com>
# SPDX-License-Identifier: Apache-2.0

if BOARD_NUCLEO_G070RB

config BOARD
	default "nucleo_g070rb"

endif # BOARD_NUCLEO_G070RB
```

## boards/boards_legacy/arm/nucleo_g0b1re/Kconfig.board
```kconfig
# STM32 Nucleo-64 development board with STM32G0B1RE MCU configuration

# Copyright (c) 2019 Thomas Stranger
# SPDX-License-Identifier: Apache-2.0

config BOARD_NUCLEO_G0B1RE
	bool "NUCLEO-64 G0B1RE Development Board"
	depends on SOC_STM32G0B1XX
```

## boards/boards_legacy/arm/nucleo_g431rb/Kconfig.board
```kconfig
# STM32G431RB Nucleo board configuration

# Copyright (c) 2019 Richard Osterloh <richard.osterloh@gmail.com>
# SPDX-License-Identifier: Apache-2.0

config BOARD_NUCLEO_G431RB
	bool "Nucleo G431RB Development Board"
	depends on SOC_STM32G431XX
```

## boards/boards_legacy/arm/nucleo_g474re/Kconfig.defconfig
```kconfig
# STM32G474RE Nucleo board configuration

# Copyright (c) 2019 STMicroelectronics.
# SPDX-License-Identifier: Apache-2.0

if BOARD_NUCLEO_G474RE

config BOARD
	default "nucleo_g474re"

config SPI_STM32_INTERRUPT
	default y
	depends on SPI

endif # BOARD_NUCLEO_G431RB
```

## boards/boards_legacy/arm/nucleo_h743zi/Kconfig.board
```kconfig
# STM32H743ZI Nucleo board configuration

# Copyright (c) 2020 Teslabs Engineering S.L.
# SPDX-License-Identifier: Apache-2.0

config BOARD_NUCLEO_H743ZI
	bool "Nucleo H743ZI Development Board"
	depends on SOC_STM32H743XX
```

## boards/boards_legacy/arm/nucleo_h745zi_q/nucleo_h745zi_q_m7_defconfig
```kconfig
# SPDX-License-Identifier: Apache-2.0

CONFIG_SOC_SERIES_STM32H7X=y
CONFIG_SOC_STM32H745XX=y

# Board config should be specified since there are 2 possible targets
CONFIG_BOARD_NUCLEO_H745ZI_Q_M7=y

# Enable the internal SMPS regulator
CONFIG_POWER_SUPPLY_DIRECT_SMPS=y

# Enable MPU
CONFIG_ARM_MPU=y

# Enable HW stack protection
CONFIG_HW_STACK_PROTECTION=y

# Enable UART ( disable to assign to M4 core)
CONFIG_SERIAL=y

# Console ( disable to assign to M4 core)
CONFIG_CONSOLE=y
CONFIG_UART_CONSOLE=y

# Enable GPIO
CONFIG_GPIO=y

# Enable Clock
CONFIG_CLOCK_CONTROL=y

# enable pin controller
CONFIG_PINCTRL=y
```

## boards/boards_legacy/arm/nucleo_h753zi/Kconfig.board
```kconfig
# STM32H753ZI Nucleo board configuration

# Copyright (c) 2021 Blue Clover Devices
# SPDX-License-Identifier: Apache-2.0

config BOARD_NUCLEO_H753ZI
	bool "Nucleo H753ZI Development Board"
	depends on SOC_STM32H753XX
```

## boards/boards_legacy/arm/nucleo_l011k4/Kconfig.board
```kconfig
# STM32 Nucleo-32 development board with STM32L011K4 MCU configuration

# Copyright (c) 2020 Steven Daglish <s.c.daglish@gmail.com>
# SPDX-License-Identifier: Apache-2.0

config BOARD_NUCLEO_L011K4
	bool "NUCLEO-32 L011K4 Development Board"
	depends on SOC_STM32L011XX
```

## boards/boards_legacy/arm/nucleo_l053r8/Kconfig.defconfig
```kconfig
# STM32 Nucleo-64 development board with STM32L053R8 MCU

# Copyright (c) 2018 Anthony Kreft <anthony.kreft@gmail.com>
# SPDX-License-Identifier: Apache-2.0

if BOARD_NUCLEO_L053R8

config BOARD
	default "nucleo_l053r8"

config SPI_STM32_INTERRUPT
	default y
	depends on SPI

endif # BOARD_NUCLEO_L053R8
```

## boards/boards_legacy/arm/nucleo_l053r8/nucleo_l053r8_defconfig
```kconfig
# SPDX-License-Identifier: Apache-2.0

# Zephyr Kernel Configuration
CONFIG_SOC_SERIES_STM32L0X=y

# Platform Configuration
CONFIG_SOC_STM32L053XX=y

# Enable MPU
CONFIG_ARM_MPU=y

# Kernel Options due to Low Memory (8k)
CONFIG_MAIN_STACK_SIZE=640
CONFIG_IDLE_STACK_SIZE=200
CONFIG_ISR_STACK_SIZE=512

# Serial Drivers
CONFIG_SERIAL=y
CONFIG_UART_INTERRUPT_DRIVEN=y
# enable console
CONFIG_CONSOLE=y
CONFIG_UART_CONSOLE=y

# GPIO Controller
CONFIG_GPIO=y

# Clock controller
CONFIG_CLOCK_CONTROL=y

# enable pin controller
CONFIG_PINCTRL=y
```

## boards/boards_legacy/arm/nucleo_l412rb_p/Kconfig.defconfig
```kconfig
# STM32L412RB Nucleo board configuration

# Copyright (c) 2021 Guðni Már Gilbert
# SPDX-License-Identifier: Apache-2.0

if BOARD_NUCLEO_L412RB_P

config BOARD
	default "nucleo_l412rb_p"

config SPI_STM32_INTERRUPT
	default y
	depends on SPI

endif # BOARD_NUCLEO_L412RB_P
```

## boards/boards_legacy/arm/nucleo_l432kc/Kconfig.defconfig
```kconfig
# STM32L432KC Nucleo board configuration

# Copyright (c) 2016 Open-RnD Sp. z o.o.
# Copyright (c) 2016 BayLibre, SAS
# SPDX-License-Identifier: Apache-2.0

if BOARD_NUCLEO_L432KC

config BOARD
	default "nucleo_l432kc"

config SPI_STM32_INTERRUPT
	default y
	depends on SPI

endif # BOARD_NUCLEO_L432KC
```

## boards/boards_legacy/arm/nucleo_l452re/Kconfig.board
```kconfig
# STM32L452RE Nucleo board configuration
#
# Copyright (c) 2019 Libre Solar Technologies GmbH
#
# SPDX-License-Identifier: Apache-2.0

config BOARD_NUCLEO_L452RE
	bool "Nucleo L452RE Development Board"
	depends on SOC_STM32L452XX

config BOARD_NUCLEO_L452RE_P
	bool "Nucleo L452RE-P Development Board"
	depends on SOC_STM32L452XX
```
