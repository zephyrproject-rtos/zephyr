## boards/boards_legacy/arm/npcx4m8f_evb/Kconfig.board
```kconfig
# Copyright (c) 2023 Nuvoton Technology Corporation.
# SPDX-License-Identifier: Apache-2.0

config BOARD_NPCX4M8F_EVB
	bool "Nuvoton NPCX4M8F EVB Development board"
	depends on SOC_NPCX4M8F
```

## boards/boards_legacy/arm/npcx4m8f_evb/Kconfig.defconfig
```kconfig
# Copyright (c) 2023 Nuvoton Technology Corporation.
# SPDX-License-Identifier: Apache-2.0

if BOARD_NPCX4M8F_EVB

config BOARD
	default "npcx4m8f_evb"

endif # BOARD_NPCX4M8F_EVB

config SYS_CLOCK_TICKS_PER_SEC
	default 1000

config INPUT
	default y if KSCAN
```

## boards/boards_legacy/arm/npcx4m8f_evb/npcx4m8f_evb_defconfig
```kconfig
#
# Copyright (c) 2023 Nuvoton Technology Corporation.
#
# SPDX-License-Identifier: Apache-2.0
#

CONFIG_SOC_NPCX4M8F=y
CONFIG_SOC_SERIES_NPCX4=y
CONFIG_BOARD_NPCX4M8F_EVB=y

# Enable NPCX firmware header
CONFIG_NPCX_HEADER=y
CONFIG_NPCX_IMAGE_OUTPUT_HEX=y
CONFIG_NPCX_HEADER_SPI_MAX_CLOCK_50=y
CONFIG_NPCX_HEADER_SPI_READ_MODE_DUAL=y

# Enable MPU
CONFIG_ARM_MPU=y

# Clock configuration
CONFIG_CLOCK_CONTROL=y

# General Kernel Options
CONFIG_SYS_CLOCK_HW_CYCLES_PER_SEC=15000000

# UART Driver
CONFIG_SERIAL=y
CONFIG_UART_INTERRUPT_DRIVEN=y

# GPIO Driver
CONFIG_GPIO=y

# Pin Controller Driver
CONFIG_PINCTRL=y

# Console Driver
CONFIG_CONSOLE=y
CONFIG_UART_CONSOLE=y
```

## boards/boards_legacy/arm/npcx7m6fb_evb/Kconfig.board
```kconfig
# Copyright (c) 2020 Nuvoton Technology Corporation.
# SPDX-License-Identifier: Apache-2.0

config BOARD_NPCX7M6FB_EVB
	bool "Nuvoton NPCX7M6FB EVB Development board"
	depends on SOC_NPCX7M6FB
```

## boards/boards_legacy/arm/nrf51dk_nrf51422/Kconfig.board
```kconfig
# nRF51 DK NRF51422 board configuration

# Copyright (c) 2016 Linaro Limited.
# SPDX-License-Identifier: Apache-2.0

config BOARD_NRF51DK_NRF51422
	bool "nRF51 DK NRF51422"
	depends on SOC_NRF51822_QFAC
```

## boards/boards_legacy/arm/nrf51dk_nrf51422/Kconfig.defconfig
```kconfig
# nRF51 DK NRF51422 board configuration

# Copyright (c) 2016 Linaro Limited.
# SPDX-License-Identifier: Apache-2.0

if BOARD_NRF51DK_NRF51422

config BOARD
	default "nrf51dk_nrf51422"

config BT_CTLR
	default BT

endif # BOARD_NRF51DK_NRF51422
```

## boards/boards_legacy/arm/nrf51dongle_nrf51422/Kconfig.defconfig
```kconfig
# nRF51 Dongle NRF51422 board configuration

# Copyright (c) 2018-2020 Nordic Semiconductor ASA.
# SPDX-License-Identifier: Apache-2.0

if BOARD_NRF51DONGLE_NRF51422

config BOARD
	default "nrf51dongle_nrf51422"

config BT_CTLR
	default BT

endif # BOARD_NRF51DONGLE_NRF51422
```

## boards/boards_legacy/arm/nrf52832_mdk/Kconfig.defconfig
```kconfig
# nRF52832-MDK board configuration

# Copyright (c) 2018 makerdiary.com.
# SPDX-License-Identifier: Apache-2.0

if BOARD_NRF52832_MDK

config BOARD
	default "nrf52832_mdk"

config BT_CTLR
	default BT

endif # BOARD_NRF52832_MDK
```

## boards/boards_legacy/arm/nrf52833dk_nrf52820/Kconfig.board
```kconfig
# nRF52833DK nRF52820 board configuration

# Copyright (c) 2020 Nordic Semiconductor ASA
# SPDX-License-Identifier: Apache-2.0

config BOARD_NRF52833DK_NRF52820
	bool "nRF52833 DK NRF52820"
	depends on SOC_NRF52820_QDAA
```

## boards/boards_legacy/arm/nrf52833dk_nrf52833/Kconfig.defconfig
```kconfig
# nRF52833 DK NRF52833 board configuration

# Copyright (c) 2019 Nordic Semiconductor ASA
# SPDX-License-Identifier: Apache-2.0

if BOARD_NRF52833DK_NRF52833

config BOARD
	default "nrf52833dk_nrf52833"

config BT_CTLR
	default BT

endif # BOARD_NRF52833DK_NRF52833
```

## boards/boards_legacy/arm/nrf52840_mdk/Kconfig
```kconfig
# nRF52840-MDK board configuration

# Copyright (c) 2018 makerdiary.com
# SPDX-License-Identifier: Apache-2.0

config BOARD_ENABLE_DCDC
	bool "DCDC mode"
	select SOC_DCDC_NRF52X
	default y
	depends on BOARD_NRF52840_MDK
```

## boards/boards_legacy/arm/nrf52840_mdk_usb_dongle/Kconfig.defconfig
```kconfig
# nRF52840 MDK USB Dongle board configuration
#
# Copyright (c) 2018 Nordic Semiconductor ASA
#
# Copyright (c) 2022 Nikola Trifunovic
#
# SPDX-License-Identifier: Apache-2.0

if BOARD_NRF52840_MDK_USB_DONGLE

config BOARD
	default "nrf52840_mdk_usb_dongle"

# To let the nRF5 bootloader load an application, the application
# must be linked after Nordic MBR, that is factory-programmed on the board.

# Nordic nRF5 bootloader exists outside of the partitions specified in the
# DTS file, so we manually override FLASH_LOAD_OFFSET to link the application
# correctly, after Nordic MBR.

# When building MCUBoot, MCUBoot itself will select USE_DT_CODE_PARTITION
# which will make it link into the correct partition specified in DTS file,
# so no override is necessary.

config FLASH_LOAD_OFFSET
	default 0x1000
	depends on BOARD_HAS_NRF5_BOOTLOADER && !USE_DT_CODE_PARTITION

if USB_DEVICE_STACK

# Enable UART driver, needed for CDC ACM
config SERIAL
	default y

endif # USB_DEVICE_STACK

config BT_CTLR
	default BT

endif # BOARD_NRF52840_MDK_USB_DONGLE
```

## boards/boards_legacy/arm/nrf52840_papyr/Kconfig.defconfig
```kconfig
# Electronut Labs Papyr board configuration

# Copyright (c) 2018 Electronut Labs
# SPDX-License-Identifier: Apache-2.0

if BOARD_NRF52840_PAPYR

config BOARD
	default "nrf52840_papyr"

config BT_CTLR
	default BT

endif # BOARD_NRF52840_PAPYR
```

## boards/boards_legacy/arm/nrf52840dk_nrf52811/Kconfig.defconfig
```kconfig
# nRF52840 DK NRF52811 board configuration

# Copyright (c) 2019 Nordic Semiconductor ASA
# SPDX-License-Identifier: Apache-2.0

if BOARD_NRF52840DK_NRF52811

config BOARD
	default "nrf52840dk_nrf52811"

config BT_CTLR
	default BT

endif # BOARD_NRF52840DK_NRF52811
```

## boards/boards_legacy/arm/nrf52840dongle_nrf52840/Kconfig.board
```kconfig
# nRF52840 Dongle NRF52840 board configuration

# Copyright (c) 2018 Nordic Semiconductor ASA
# SPDX-License-Identifier: Apache-2.0

config BOARD_NRF52840DONGLE_NRF52840
	bool "nRF52840 DONGLE NRF52840"
	depends on SOC_NRF52840_QIAA
```

## boards/boards_legacy/arm/nrf52dk_nrf52805/Kconfig.board
```kconfig
# nRF52 DK nRF52805 board configuration

# Copyright (c) 2020 Nordic Semiconductor ASA
# SPDX-License-Identifier: Apache-2.0

config BOARD_NRF52DK_NRF52805
	bool "nRF52 DK NRF52805"
	depends on SOC_NRF52805_CAAA
```

## boards/boards_legacy/arm/nrf52dk_nrf52832/Kconfig
```kconfig
# nRF52 DK board configuration

# Copyright (c) 2016 Nordic Semiconductor ASA
# SPDX-License-Identifier: Apache-2.0

config BOARD_ENABLE_DCDC
	bool "DCDC mode"
	select SOC_DCDC_NRF52X
	default y
	depends on BOARD_NRF52DK_NRF52832
```

## boards/boards_legacy/arm/nrf52dk_nrf52832/Kconfig.board
```kconfig
# nRF52 DK NRF52832 board configuration

# Copyright (c) 2016 Nordic Semiconductor ASA
# SPDX-License-Identifier: Apache-2.0

config BOARD_NRF52DK_NRF52832
	bool "nRF52 DK NRF52832"
	depends on SOC_NRF52832_QFAA
```

## boards/boards_legacy/arm/nrf5340_audio_dk_nrf5340/nrf5340_audio_dk_nrf5340_cpuapp_defconfig
```kconfig
# Copyright (c) 2020 Nordic Semiconductor ASA
# SPDX-License-Identifier: Apache-2.0

CONFIG_SOC_SERIES_NRF53X=y
CONFIG_SOC_NRF5340_CPUAPP_QKAA=y
CONFIG_BOARD_NRF5340_AUDIO_DK_NRF5340_CPUAPP=y

CONFIG_ARM_MPU=y

CONFIG_HW_STACK_PROTECTION=y

CONFIG_ARM_TRUSTZONE_M=y

CONFIG_GPIO=y

CONFIG_SERIAL=y

CONFIG_CONSOLE=y
CONFIG_UART_CONSOLE=y

CONFIG_REGULATOR=y
```

## boards/boards_legacy/arm/nrf54l15pdk_nrf54l15/Kconfig.defconfig
```kconfig
# Copyright (c) 2024 Nordic Semiconductor ASA
# SPDX-License-Identifier: Apache-2.0

if BOARD_NRF54L15PDK_NRF54L15_CPUAPP

config BOARD
	default "nrf54l15pdk_nrf54l15_cpuapp"

config BT_CTLR
	default BT

endif # BOARD_NRF54L15PDK_NRF54L15_CPUAPP
```

## boards/boards_legacy/arm/nrf54l15pdk_nrf54l15/nrf54l15pdk_nrf54l15_cpuapp_defconfig
```kconfig
# Copyright (c) 2024 Nordic Semiconductor ASA
# SPDX-License-Identifier: Apache-2.0

CONFIG_SOC_SERIES_NRF54LX=y
CONFIG_SOC_NRF54L15_ENGA_CPUAPP=y
CONFIG_BOARD_NRF54L15PDK_NRF54L15_CPUAPP=y

# Enable MPU
CONFIG_ARM_MPU=y

# Enable hardware stack protection
CONFIG_HW_STACK_PROTECTION=y

# MPU-based null-pointer dereferencing detection cannot
# be applied as the (0x0 - 0x400) is unmapped for this target.
CONFIG_NULL_POINTER_EXCEPTION_DETECTION_NONE=y

# Enable Cache
CONFIG_CACHE_MANAGEMENT=y
CONFIG_EXTERNAL_CACHE=y

CONFIG_UART_CONSOLE=y
CONFIG_CONSOLE=y
CONFIG_SERIAL=y

# Enable GPIO
CONFIG_GPIO=y

CONFIG_SOC_NRF_FORCE_CONSTLAT=y

# Start SYSCOUNTER on driver init
CONFIG_NRF_GRTC_START_SYSCOUNTER=y
```

## boards/boards_legacy/arm/nrf9160dk_nrf9160/nrf9160dk_nrf9160_ns_defconfig
```kconfig
# SPDX-License-Identifier: Apache-2.0

CONFIG_SOC_SERIES_NRF91X=y
CONFIG_SOC_NRF9160_SICA=y
CONFIG_BOARD_NRF9160DK_NRF9160_NS=y

# Enable MPU
CONFIG_ARM_MPU=y

# Enable hardware stack protection
CONFIG_HW_STACK_PROTECTION=y

# Enable TrustZone-M
CONFIG_ARM_TRUSTZONE_M=y

# This Board implies building Non-Secure firmware
CONFIG_TRUSTED_EXECUTION_NONSECURE=y

# enable GPIO
CONFIG_GPIO=y

# Enable uart driver
CONFIG_SERIAL=y

# enable console
CONFIG_CONSOLE=y
CONFIG_UART_CONSOLE=y
```

## boards/boards_legacy/arm/nucleo_c031c6/Kconfig.board
```kconfig
# STM32 Nucleo-64 development board with STM32C031C6 MCU configuration

# Copyright (c) 2023 Benjamin Björnsson <benjamin.bjornsson@gmail.com>
# SPDX-License-Identifier: Apache-2.0

config BOARD_NUCLEO_C031C6
	bool "NUCLEO-64 C031C6 Development Board"
	depends on SOC_STM32C031XX
```

## boards/boards_legacy/arm/nucleo_c031c6/Kconfig.defconfig
```kconfig
# STM32 Nucleo-64 development board with STM32C031C6 MCU

# Copyright (c) 2023 Benjamin Björnsson <benjamin.bjornsson@gmail.com>
# SPDX-License-Identifier: Apache-2.0

if BOARD_NUCLEO_C031C6

config BOARD
	default "nucleo_c031c6"

endif # BOARD_NUCLEO_C031C6
```

## boards/boards_legacy/arm/nucleo_f207zg/Kconfig.board
```kconfig
# NUCLEO-144 F207ZG board configuration

# Copyright (c) 2018 qianfan Zhao
# SPDX-License-Identifier: Apache-2.0

config BOARD_NUCLEO_F207ZG
	bool "NUCLEO-144 F207ZG Development Board"
	depends on SOC_STM32F207XX
```
