## boards/boards_legacy/arm/da1469x_dk_pro/Kconfig.board
```kconfig
# DA1469x series Development Kit Pro board configuration

# Copyright (c) 2022 Renesas Electronics Corporation
# SPDX-License-Identifier: Apache-2.0

config BOARD_DA1469X_DK_PRO
	bool "DA1469x series Development Kit Pro board"
	depends on SOC_SERIES_DA1469X
```

## boards/boards_legacy/arm/da1469x_dk_pro/Kconfig.defconfig
```kconfig
# DA1469x series Development Kit Pro board configuration

# Copyright (c) 2022 Renesas Electronics Corporation
# SPDX-License-Identifier: Apache-2.0

if BOARD_DA1469X_DK_PRO

config BOARD
	default "da1469x_dk_pro"

endif # BOARD_DA1469X_DK_PRO
```

## boards/boards_legacy/arm/da1469x_dk_pro/da1469x_dk_pro_defconfig
```kconfig
# SPDX-License-Identifier: Apache-2.0

CONFIG_SOC_SERIES_DA1469X=y
CONFIG_SOC_DA14699=y
CONFIG_BOARD_DA1469X_DK_PRO=y

CONFIG_HW_STACK_PROTECTION=y

CONFIG_GPIO=y

CONFIG_CONSOLE=y
CONFIG_UART_CONSOLE=y
CONFIG_SERIAL=y

CONFIG_BUILD_OUTPUT_HEX=n

CONFIG_I2C=y
CONFIG_I2C_CALLBACK=y
```

## boards/boards_legacy/arm/decawave_dwm1001_dev/decawave_dwm1001_dev_defconfig
```kconfig
# SPDX-License-Identifier: Apache-2.0

CONFIG_SOC_SERIES_NRF52X=y
CONFIG_SOC_NRF52832_QFAA=y
CONFIG_BOARD_DECAWAVE_DWM1001_DEV=y

# Enable MPU
CONFIG_ARM_MPU=y

# Enable RTT
CONFIG_USE_SEGGER_RTT=y

# enable GPIO
CONFIG_GPIO=y

# enable uart driver
CONFIG_SERIAL=y

# enable console
CONFIG_CONSOLE=y
CONFIG_UART_CONSOLE=y
CONFIG_RTT_CONSOLE=y
```

## boards/boards_legacy/arm/degu_evk/Kconfig.defconfig
```kconfig
# Degu Evaluation Kit configuration

# Copyright (c) 2019 Atmark Techno, Inc.
# SPDX-License-Identifier: Apache-2.0

if BOARD_DEGU_EVK

config BOARD
	default "degu_evk"

if USB_DEVICE_STACK

config USB_DEVICE_PRODUCT
	default "Degu Evaluation Kit"

config UART_INTERRUPT_DRIVEN
	default y

config UART_LINE_CTRL
	default y

endif # USB_DEVICE_STACK

if LOG

# Logger cannot use itself to log
config USB_CDC_ACM_LOG_LEVEL
	default 0

# Set USB log level to error only
config USB_DEVICE_LOG_LEVEL
	default 1

endif # LOG

endif # BOARD_DEGU_EVK
```

## boards/boards_legacy/arm/dragino_nbsn95/Kconfig.defconfig
```kconfig
# Dragino NBSN95 NB-IoT Sensor Node board configuration

# Copyright (c) 2021 Next Big Thing AG
# SPDX-License-Identifier: Apache-2.0

if BOARD_DRAGINO_NBSN95

config BOARD
	default "dragino_nbsn95"

endif # BOARD_DRAGINO_NBSN95
```

## boards/boards_legacy/arm/ebyte_e73_tbb_nrf52832/Kconfig.defconfig
```kconfig
# EBYTE E73-TBB NRF52832 board configuration

# Copyright (c) 2016 Nordic Semiconductor ASA
# Copyright (c) 2021 Michal Morsisko
# SPDX-License-Identifier: Apache-2.0

if BOARD_EBYTE_E73_TBB_NRF52832

config BOARD
	default "ebyte_e73_tbb_nrf52832"

config BT_CTLR
	default BT

endif # BOARD_EBYTE_E73_TBB_NRF52832
```

## boards/boards_legacy/arm/efm32gg_sltb009a/Kconfig.board
```kconfig
# EFM32GG SLTB009A board configuration
# Copyright (c) 2023 Antmicro <www.antmicro.com>
# SPDX-License-Identifier: Apache-2.0

config BOARD_EFM32GG_SLTB009A
	bool "SiLabs EFM32GG-SLTB009A (Giant Gecko 12)"
	depends on SOC_SERIES_EFM32GG12B
	select SOC_PART_NUMBER_EFM32GG12B810F1024GM64
```

## boards/boards_legacy/arm/efm32gg_sltb009a/efm32gg_sltb009a_defconfig
```kconfig
# Copyright (c) 2023 Antmicro <www.antmicro.com>
# SPDX-License-Identifier: Apache-2.0

CONFIG_SOC_SERIES_EFM32GG12B=y
CONFIG_BOARD_EFM32GG_SLTB009A=y
CONFIG_ARM_MPU=y
CONFIG_CONSOLE=y
CONFIG_UART_CONSOLE=y
CONFIG_SERIAL=y
CONFIG_GPIO=y
CONFIG_SYS_CLOCK_HW_CYCLES_PER_SEC=72000000
CONFIG_CMU_HFCLK_HFRCO=y
```

## boards/boards_legacy/arm/efm32gg_stk3701a/Kconfig.board
```kconfig
# EFM32GG STK3701A board configuration
# Copyright (c) 2019 Interay Solutions B.V.
# Copyright (c) 2019 Oane Kingma
# SPDX-License-Identifier: Apache-2.0

config BOARD_EFM32GG_STK3701A
	bool "SiLabs EFM32GG-STK3701A (Giant Gecko 11)"
	depends on SOC_SERIES_EFM32GG11B
	select SOC_PART_NUMBER_EFM32GG11B820F2048GL192
```

## boards/boards_legacy/arm/efm32pg_stk3401a/Kconfig.defconfig
```kconfig
# EFM32PG STK3401A board

# Copyright (c) 2020, Rafael Dias Menezes <rdmeneze@gmail.com>
# SPDX-License-Identifier: Apache-2.0

if BOARD_EFM32PG_STK3401A

config BOARD
	default "efm32pg_stk3401a" if BOARD_EFM32PG_STK3401A

config CMU_HFXO_FREQ
	default 40000000

config CMU_LFXO_FREQ
	default 32768

endif # BOARD_EFM32PG_STK3401A
```

## boards/boards_legacy/arm/efm32pg_stk3402a/Kconfig.defconfig
```kconfig
# EFM32PG STK3402A board

# Copyright (c) 2018, Christian Taedcke
# Copyright (c) 2019  Lemonbeat GmbH
# SPDX-License-Identifier: Apache-2.0

if BOARD_EFM32PG_STK3402A || BOARD_EFM32PG_STK3402A_JG

config BOARD
	default "efm32pg_stk3402a" if BOARD_EFM32PG_STK3402A
	default "efm32pg_stk3402a_jg" if BOARD_EFM32PG_STK3402A_JG

config CMU_HFXO_FREQ
	default 40000000

config CMU_LFXO_FREQ
	default 32768

endif # BOARD_EFM32PG_STK3402A || BOARD_EFM32PG_STK3402A_JG
```

## boards/boards_legacy/arm/efm32wg_stk3800/Kconfig.board
```kconfig
# EFM32WG STK3800 board

# Copyright (c) 2017, Christian Taedcke
# SPDX-License-Identifier: Apache-2.0

config BOARD_EFM32WG_STK3800
	bool "SiLabs EFM32WG-STK3800 (Wonder Gecko)"
	depends on SOC_SERIES_EFM32WG
	select SOC_PART_NUMBER_EFM32WG990F256
```

## boards/boards_legacy/arm/efr32_thunderboard/Kconfig.defconfig
```kconfig
# Thunderboard-style boards

# Copyright (c) 2023 Antmicro <www.antmicro.com>
# SPDX-License-Identifier: Apache-2.0

if BOARD_EFR32BG22_BRD4184A

config BOARD
	default "efr32bg22_brd4184a"

endif # BOARD_EFR32BG22_BRD4184A

if BOARD_EFR32BG22_BRD4184B

config BOARD
	default "efr32bg22_brd4184b"

endif # BOARD_EFR32BG22_BRD4184B

if BOARD_EFR32BG27_BRD2602A

config BOARD
	default "efr32bg27_brd2602a"

endif # BOARD_EFR32BG27_BRD2602A

config CMU_HFXO_FREQ
	default 38400000

config CMU_LFXO_FREQ
	default 32768

if SOC_GECKO_USE_RAIL

config FPU
	default y

endif # SOC_GECKO_USE_RAIL

if BT

config FPU
	default y

config COMMON_LIBC_MALLOC_ARENA_SIZE
	default 8192

config MAIN_STACK_SIZE
	default 3072 if PM
	default 2304

choice BT_HCI_BUS_TYPE
	default BT_SILABS_HCI
endchoice

endif # BT

config REGULATOR
	default y if SI7210
```

## boards/boards_legacy/arm/efr32_thunderboard/efr32bg22_brd4184b_defconfig
```kconfig
# SPDX-License-Identifier: Apache-2.0

CONFIG_ARM_MPU=y
CONFIG_SOC_SERIES_EFR32BG22=y
CONFIG_BOARD_EFR32BG22_BRD4184B=y
CONFIG_CONSOLE=y
CONFIG_UART_CONSOLE=y
CONFIG_SERIAL=y
CONFIG_GPIO=y
CONFIG_SOC_GECKO_EMU_DCDC=y
CONFIG_SOC_GECKO_EMU_DCDC_MODE_ON=y
CONFIG_HW_STACK_PROTECTION=y
CONFIG_PINCTRL=y

# Used if SysTick is enabled, ignored for BURTC
# (BURTC uses TIMER_READS_ITS_FREQUENCY_AT_RUNTIME)
CONFIG_SYS_CLOCK_HW_CYCLES_PER_SEC=76800000

# Use BURTC as system clock source
CONFIG_GECKO_BURTC_TIMER=y
CONFIG_CMU_BURTCCLK_LFXO=y
CONFIG_SYS_CLOCK_TICKS_PER_SEC=1024
```

## boards/boards_legacy/arm/efr32mg_sltb004a/Kconfig.defconfig
```kconfig
# EFR32MG SLTB004A board

# Copyright (c) 2018, Diego Sueiro
# SPDX-License-Identifier: Apache-2.0

if BOARD_EFR32MG_SLTB004A

config BOARD
	default "efr32mg_sltb004a"

config CMU_HFXO_FREQ
	default 40000000

config CMU_LFXO_FREQ
	default 32768

endif # BOARD_EFR32MG_SLTB004A
```

## boards/boards_legacy/arm/ev11l78a/Kconfig.board
```kconfig
# Microchip EV11L78A Board configuration

# Copyright (c) 2023 Meta Platforms, Inc. and its affiliates.
# SPDX-License-Identifier: Apache-2.0

config BOARD_EV11L78A
	bool "Microchip EV11L78A"
	depends on SOC_PART_NUMBER_SAMD20E16
```

## boards/boards_legacy/arm/faze/Kconfig.board
```kconfig
# Seagate FireCuda Gaming SSD (FaZe) board

# Copyright (c) 2020, Seagate Technology LLC
# SPDX-License-Identifier: Apache-2.0

config BOARD_FAZE
	bool "Seagate FireCuda Gaming SSD (FaZe)"
	depends on SOC_SERIES_LPC11U6X
	select SOC_PART_NUMBER_LPC11U67JBD48
```

## boards/boards_legacy/arm/fk7b0m1_vbt6/fk7b0m1_vbt6_defconfig
```kconfig
# Copyright (c) Charles Dias <charlesdias.cd@outlook.com>
# SPDX-License-Identifier: Apache-2.0

CONFIG_SOC_SERIES_STM32H7X=y
CONFIG_SOC_STM32H7B0XX=y

# Enable MPU
CONFIG_ARM_MPU=y

# Enable HW stack protection
CONFIG_HW_STACK_PROTECTION=y

# Enable UART
CONFIG_SERIAL=y

# Console
CONFIG_CONSOLE=y
CONFIG_UART_CONSOLE=y

# Enable Pinctrl
CONFIG_PINCTRL=y

# Enable GPIO
CONFIG_GPIO=y

# Enable clocks
CONFIG_CLOCK_CONTROL=y
```

## boards/boards_legacy/arm/fvp_baser_aemv8r_aarch32/Kconfig.board
```kconfig
# Copyright (c) 2021 Arm Limited (or its affiliates). All rights reserved.
# Copyright (c) 2022 IoT.bzh
# SPDX-License-Identifier: Apache-2.0

config BOARD_FVP_BASER_AEMV8R_AARCH32
	bool "FVP BaseR AEMv8R AArch32 simulation board"
	depends on SOC_FVP_AEMV8R_AARCH32
```

## boards/boards_legacy/arm/fvp_baser_aemv8r_aarch32/fvp_baser_aemv8r_aarch32_smp_defconfig
```kconfig
# Copyright (c) 2023 Arm Limited (or its affiliates). All rights reserved.
# SPDX-License-Identifier: Apache-2.0

CONFIG_SOC_SERIES_FVP_AEMV8R_AARCH32=y
CONFIG_SOC_FVP_AEMV8R_AARCH32=y
CONFIG_BOARD_FVP_BASER_AEMV8R_AARCH32=y
CONFIG_ARM_MPU=y

CONFIG_ISR_STACK_SIZE=1024
CONFIG_THREAD_STACK_INFO=y

# Enable Timer and Sys clock
CONFIG_SYS_CLOCK_TICKS_PER_SEC=100
CONFIG_ARM_ARCH_TIMER=y

# Enable UART driver
CONFIG_SERIAL=y

# Enable serial port
CONFIG_UART_INTERRUPT_DRIVEN=y

# Enable console
CONFIG_CONSOLE=y
CONFIG_UART_CONSOLE=y

CONFIG_CACHE_MANAGEMENT=y

CONFIG_USE_SWITCH=y
CONFIG_SMP=y
CONFIG_MP_MAX_NUM_CPUS=4

CONFIG_DCACHE=n
```

## boards/boards_legacy/arm/google_dragonclaw/Kconfig.board
```kconfig
# Copyright (c) 2022 Google LLC
# SPDX-License-Identifier: Apache-2.0

config BOARD_GOOGLE_DRAGONCLAW
	bool "Google Dragonclaw Development Board"
	depends on SOC_STM32F412CX
```

## boards/boards_legacy/arm/google_dragonclaw/Kconfig.defconfig
```kconfig
# Copyright (c) 2022 Google LLC
# SPDX-License-Identifier: Apache-2.0

if BOARD_GOOGLE_DRAGONCLAW

config BOARD
	default "google_dragonclaw"

endif # BOARD_GOOGLE_DRAGONCLAW
```

## boards/boards_legacy/arm/google_twinkie_v2/Kconfig.defconfig
```kconfig
# Copyright 2023 The ChromiumOS Authors
# SPDX-License-Identifier: Apache-2.0

if BOARD_GOOGLE_TWINKIE_V2

config BOARD
	default "google_twinkie_v2"

endif # BOARD_GOOGLE_TWINKIE_V2
```

## boards/boards_legacy/arm/google_twinkie_v2/google_twinkie_v2_defconfig
```kconfig
# Copyright 2023 The ChromiumOS Authors
#
# SPDX-License-Identifier: Apache-2.0

CONFIG_SOC_SERIES_STM32G0X=y
CONFIG_SOC_STM32G0B1XX=y

# GPIO Controller
CONFIG_GPIO=y

# Enable Clocks
CONFIG_CLOCK_CONTROL=y

# enable pin controller
CONFIG_PINCTRL=y

# Enable MPU
CONFIG_ARM_MPU=y
```
