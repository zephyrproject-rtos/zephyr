## boards/boards_legacy/arm/nucleo_u575zi_q/Kconfig.board
```kconfig
# STM32U575ZI Q Nucleo board configuration

# Copyright (c) 2021 Linaro Limited
# SPDX-License-Identifier: Apache-2.0

config BOARD_NUCLEO_U575ZI_Q
	bool "Nucleo U575ZI Q Development Board"
	depends on SOC_STM32U575XX
```

## boards/boards_legacy/arm/nucleo_u575zi_q/Kconfig.defconfig
```kconfig
# STM32U575ZI Q Nucleo board configuration

# Copyright (c) 2021 Linaro Limited
# SPDX-License-Identifier: Apache-2.0

if BOARD_NUCLEO_U575ZI_Q

config BOARD
	default "nucleo_u575zi_q"

endif # BOARD_NUCLEO_U575ZI_Q
```

## boards/boards_legacy/arm/nucleo_u575zi_q/nucleo_u575zi_q_defconfig
```kconfig
# SPDX-License-Identifier: Apache-2.0

CONFIG_SOC_SERIES_STM32U5X=y
CONFIG_SOC_STM32U575XX=y

# enable uart driver
CONFIG_SERIAL=y

# enable GPIO
CONFIG_GPIO=y

# Enable clock
CONFIG_CLOCK_CONTROL=y

# console
CONFIG_CONSOLE=y
CONFIG_UART_CONSOLE=y

# Enable MPU
CONFIG_ARM_MPU=y

# Enable HW stack protection
CONFIG_HW_STACK_PROTECTION=y

# enable pin controller
CONFIG_PINCTRL=y
```

## boards/boards_legacy/arm/nucleo_u5a5zj_q/Kconfig.board
```kconfig
# STM32U5A5ZJ Q Nucleo board configuration

# Copyright (c) 2023 STMicroelectronics
# SPDX-License-Identifier: Apache-2.0

config BOARD_NUCLEO_U5A5ZJ_Q
	bool "Nucleo U5A5ZJ Q Development Board"
	depends on SOC_STM32U5A5XX
```

## boards/boards_legacy/arm/numaker_pfm_m467/Kconfig.board
```kconfig
# SPDX-License-Identifier: Apache-2.0
#
# Nuvoton PFM M467 board configuration
#
# Copyright (c) 2023 Nuvoton Technology Corporation.

config BOARD_NUMAKER_PFM_M467
	bool "NUVOTON PFM M467 Development Board"
	depends on SOC_M467
```

## boards/boards_legacy/arm/numaker_pfm_m467/numaker_pfm_m467_defconfig
```kconfig
# SPDX-License-Identifier: Apache-2.0

CONFIG_SOC_SERIES_M46X=y
CONFIG_SOC_M467=y
CONFIG_PINCTRL=y
CONFIG_GPIO=y

# Enable system clock controller driver
CONFIG_CLOCK_CONTROL=y
CONFIG_CLOCK_CONTROL_NUMAKER_SCC=y

# Enable MPU
CONFIG_ARM_MPU=y
CONFIG_SYS_CLOCK_HW_CYCLES_PER_SEC=200000000

# enable uart driver
CONFIG_SERIAL=y
CONFIG_UART_INTERRUPT_DRIVEN=y

# console
CONFIG_CONSOLE=y
CONFIG_UART_CONSOLE=y

# Enable FMC
CONFIG_FLASH=y
CONFIG_SOC_FLASH_NUMAKER=y
```

## boards/boards_legacy/arm/nuvoton_pfm_m487/Kconfig.board
```kconfig
# SPDX-License-Identifier: Apache-2.0
#
# Nuvoton PFM M487 board configuration
#
# Copyright (c) 2020 Linumiz
# Author: Saravanan Sekar <saravanan@linumiz.com>

config BOARD_NUVOTON_PFM_M487
	bool "NUVOTON PFM MP487 Development Board"
	depends on SOC_M487
```

## boards/boards_legacy/arm/nuvoton_pfm_m487/nuvoton_pfm_m487_defconfig
```kconfig
# SPDX-License-Identifier: Apache-2.0

CONFIG_SOC_SERIES_M48X=y
CONFIG_SOC_M487=y
CONFIG_BOARD_NUVOTON_PFM_M487=y

# Enable MPU
CONFIG_ARM_MPU=y
CONFIG_SYS_CLOCK_HW_CYCLES_PER_SEC=192000000

# Enable GPIO and pinctrl drivers
CONFIG_GPIO=y
CONFIG_PINCTRL=y

# enable uart driver
CONFIG_SERIAL=y

# console
CONFIG_CONSOLE=y
CONFIG_UART_CONSOLE=y
```

## boards/boards_legacy/arm/olimex_stm32_h405/Kconfig.board
```kconfig
# OLIMEX-STM32-H405 board configuration

# Copyright (c) 2020, 2021 Antony Pavlov <antonynpavlov@gmail.com>
# SPDX-License-Identifier: Apache-2.0

config BOARD_OLIMEX_STM32_H405
	bool "OLIMEX STM32-H405 Development Board"
	depends on SOC_STM32F405XG
```

## boards/boards_legacy/arm/olimex_stm32_h407/Kconfig.defconfig
```kconfig
# OLIMEX-STM32-H407 board configuration

# Copyright (c) 2018, Reto Schneider <code@reto-schneider.ch>
# SPDX-License-Identifier: Apache-2.0

if BOARD_OLIMEX_STM32_H407

config BOARD
	default "olimex_stm32_h407"

endif # BOARD_OLIMEX_STM32_H407
```

## boards/boards_legacy/arm/olimex_stm32_p405/Kconfig.defconfig
```kconfig
# OLIMEX-STM32-P405 board configuration

# Copyright (c) 2017, Erwin Rol <erwin@erwinrol.com>
# SPDX-License-Identifier: Apache-2.0

if BOARD_OLIMEX_STM32_P405

config BOARD
	default "olimex_stm32_p405"

endif # BOARD_OLIMEX_STM32_P405
```

## boards/boards_legacy/arm/pan1770_evb/Kconfig.board
```kconfig
# PAN1770 EVB configuration

# Copyright (c) 2022 Panasonic Industrial Devices Europe GmbH
# SPDX-License-Identifier: Apache-2.0

config BOARD_PAN1770_EVB
	bool "pan1770-evb"
	depends on SOC_NRF52840_QIAA
```

## boards/boards_legacy/arm/pan1783/Kconfig
```kconfig
# PAN1783 EVB board configuration

# Copyright (c) 2023 Panasonic Industrial Devices Europe GmbH
# SPDX-License-Identifier: Apache-2.0

if BOARD_PAN1783_EVB_CPUAPP || BOARD_PAN1783A_EVB_CPUAPP || BOARD_PAN1783A_PA_EVB_CPUAPP

config BOARD_ENABLE_DCDC_APP
	bool "Application MCU DCDC converter"
	select SOC_DCDC_NRF53X_APP
	default y

config BOARD_ENABLE_DCDC_NET
	bool "Network MCU DCDC converter"
	select SOC_DCDC_NRF53X_NET
	default y

config BOARD_ENABLE_DCDC_HV
	bool "High Voltage DCDC converter"
	select SOC_DCDC_NRF53X_HV
	default y

config BOARD_ENABLE_CPUNET
	bool "NRF53 Network MCU"
	select SOC_NRF_GPIO_FORWARDER_FOR_NRF5340 if \
		$(dt_compat_enabled,$(DT_COMPAT_NORDIC_NRF_GPIO_FORWARDER))
	help
	  This option enables releasing the Network 'force off' signal, which
	  as a consequence will power up the Network MCU during system boot.
	  Additionally, the option allocates GPIO pins that will be used by UARTE
	  of the Network MCU.
	default y if (BT || NRF_802154_SER_HOST)

config DOMAIN_CPUNET_BOARD
	string
	default "pan1783_evb_cpunet" if BOARD_PAN1783_EVB_CPUAPP
	default "pan1783a_evb_cpunet" if BOARD_PAN1783A_EVB_CPUAPP
	default "pan1783a_pa_evb_cpunet" if BOARD_PAN1783A_PA_EVB_CPUAPP
	depends on BOARD_ENABLE_CPUNET
	help
	  The board which will be used for CPUNET domain when creating a multi
	  image application where one or more images should be located on
	  another board. For example hci_ipc on the nRF5340_cpunet for
	  Bluetooth applications.

endif #  BOARD_PAN1783_EVB_CPUAPP || BOARD_PAN1783A_EVB_CPUAPP || BOARD_PAN1783A_PA_EVB_CPUAPP

config DOMAIN_CPUAPP_BOARD
	string
	default "pan1783_evb_cpuapp" if BOARD_PAN1783_EVB_CPUNET
	default "pan1783a_evb_cpuapp" if BOARD_PAN1783A_EVB_CPUNET
	default "pan1783a_pa_evb_cpuapp" if BOARD_PAN1783A_PA_EVB_CPUNET
	help
	  The board which will be used for CPUAPP domain when creating a multi
	  image application where one or more images should be located on
	  another board.
```

## boards/boards_legacy/arm/pan1783/Kconfig.defconfig
```kconfig
# PAN1783 EVB board configuration

# Copyright (c) 2023 Panasonic Industrial Devices Europe GmbH
# SPDX-License-Identifier: Apache-2.0

config BOARD
	default "pan1783_evb_cpuapp" if  BOARD_PAN1783_EVB_CPUAPP
	default "pan1783a_evb_cpuapp" if  BOARD_PAN1783A_EVB_CPUAPP
	default "pan1783a_pa_evb_cpuapp" if  BOARD_PAN1783A_PA_EVB_CPUAPP
	default "pan1783_evb_cpunet" if BOARD_PAN1783_EVB_CPUNET
	default "pan1783a_evb_cpunet" if BOARD_PAN1783A_EVB_CPUNET
	default "pan1783a_pa_evb_cpunet" if BOARD_PAN1783A_PA_EVB_CPUNET

config MBOX_NRFX_IPC
	default MBOX

if BOARD_PAN1783_EVB_CPUAPP || BOARD_PAN1783A_EVB_CPUAPP || BOARD_PAN1783A_PA_EVB_CPUAPP

choice BT_HCI_BUS_TYPE
	default BT_HCI_IPC if BT
endchoice

config HEAP_MEM_POOL_ADD_SIZE_BOARD
	int
	default 4096 if BT_HCI_IPC

endif #  BOARD_PAN1783_EVB_CPUAPP || BOARD_PAN1783A_EVB_CPUAPP || BOARD_PAN1783A_PA_EVB_CPUAPP

if BOARD_PAN1783_EVB_CPUNET || BOARD_PAN1783A_EVB_CPUNET || BOARD_PAN1783A_PA_EVB_CPUNET

config BT_CTLR
	default y if BT

endif # BOARD_PAN1783_EVB_CPUNET || BOARD_PAN1783A_EVB_CPUNET || BOARD_PAN1783A_PA_EVB_CPUNET
```

## boards/boards_legacy/arm/pan1783/pan1783a_pa_evb_cpuapp_defconfig
```kconfig
# SPDX-License-Identifier: Apache-2.0

CONFIG_SOC_SERIES_NRF53X=y
CONFIG_SOC_NRF5340_CPUAPP_QKAA=y
CONFIG_BOARD_PAN1783A_PA_EVB_CPUAPP=y

# Enable MPU
CONFIG_ARM_MPU=y

# Enable hardware stack protection
CONFIG_HW_STACK_PROTECTION=y

# enable GPIO
CONFIG_GPIO=y

# Enable uart driver
CONFIG_SERIAL=y

# enable console
CONFIG_CONSOLE=y
CONFIG_UART_CONSOLE=y

# clock config
CONFIG_CLOCK_CONTROL_NRF_K32SRC_RC=y
CONFIG_CLOCK_CONTROL_NRF_K32SRC_XTAL=n
```

## boards/boards_legacy/arm/pandora_stm32l475/Kconfig.board
```kconfig
# STM32L475 Pandora board configuration

# Copyright (c) 2023 Tisilicon
# SPDX-License-Identifier: Apache-2.0

config BOARD_PANDORA_STM32L475
	bool "STM32L475 Pandora Development Board"
	depends on SOC_STM32L475XX
```

## boards/boards_legacy/arm/pandora_stm32l475/Kconfig.defconfig
```kconfig
# STM32L475 Pandora board configuration

# Copyright (c) 2023 Tisilicon
# SPDX-License-Identifier: Apache-2.0

if BOARD_PANDORA_STM32L475

config BOARD
	default "pandora_stm32l475"

endif # BOARD_PANDORA_STM32L475
```

## boards/boards_legacy/arm/particle_argon/Kconfig.defconfig
```kconfig
# Particle Argon board configuration

# Copyright (c) 2018 Matthias Boesl
# SPDX-License-Identifier: Apache-2.0

if BOARD_PARTICLE_ARGON

config BOARD
	default "particle_argon"

config BT_CTLR
	default BT

endif # BOARD_PARTICLE_ARGON
```

## boards/boards_legacy/arm/particle_boron/particle_boron_defconfig
```kconfig
#
# Copyright (c) 2018 Peter Bigot Consulting, LLC
#
# SPDX-License-Identifier: Apache-2.0

CONFIG_SOC_SERIES_NRF52X=y
CONFIG_SOC_NRF52840_QIAA=y
CONFIG_BOARD_PARTICLE_BORON=y

# Enable MPU
CONFIG_ARM_MPU=y

# enable GPIO
CONFIG_GPIO=y

# enable uart driver
CONFIG_SERIAL=y

# enable console
CONFIG_CONSOLE=y
CONFIG_UART_CONSOLE=y

# Fix the priority to enable the modem line's serial buffer
# before the modem driver starts (gsm_ppp or ublox-sara-r4).
CONFIG_REGULATOR=y
CONFIG_REGULATOR_FIXED_INIT_PRIORITY=41
```

## boards/boards_legacy/arm/pico_pi_m4/Kconfig.board
```kconfig
# Pico-Pi iMX7D M4 board

# Copyright (c) 2019, Joris Offouga
# SPDX-License-Identifier: Apache-2.0

config BOARD_PICO_PI_M4
	bool "Pico-PI iMX7D Dual"
	depends on SOC_SERIES_IMX7_M4
```

## boards/boards_legacy/arm/pinetime_devkit0/pinetime_devkit0_defconfig
```kconfig
# SPDX-License-Identifier: Apache-2.0

CONFIG_SOC_SERIES_NRF52X=y
CONFIG_SOC_NRF52832_QFAA=y
CONFIG_BOARD_PINETIME_DEVKIT0=y

CONFIG_ARM_MPU=y

CONFIG_GPIO=y

CONFIG_SERIAL=y

CONFIG_CONSOLE=y
CONFIG_UART_CONSOLE=y
```

## boards/boards_legacy/arm/qemu_cortex_a9/Kconfig.defconfig
```kconfig
#
# Kconfig - Cortex-A9 (Zynq-7000) QEMU Emulation
#
# Copyright (c) 2021, Weidmueller Interface GmbH & Co. KG
# SPDX-License-Identifier: Apache-2.0
#

if BOARD_QEMU_CORTEX_A9

config BUILD_OUTPUT_BIN
	default n

config BOARD
	default "qemu_cortex_a9"

config SYS_CLOCK_HW_CYCLES_PER_SEC
	int
	default 111111111

config SYS_CLOCK_TICKS_PER_SEC
	default 1000

if LOG

	if LOG_PROCESS_THREAD

		config LOG_PROCESS_THREAD_STACK_SIZE
		default 8192

	endif # LOG_PROCESS_THREAD

endif # LOG

if NETWORKING

	config NET_L2_ETHERNET
	default y

	config NET_TX_STACK_SIZE
	default 8192

	config NET_RX_STACK_SIZE
	default 8192

	if NET_TCP

		config NET_TCP_WORKQ_STACK_SIZE
		default 8192

	endif # NET_TCP

	if NET_MGMT_EVENT

		config NET_MGMT_EVENT_STACK_SIZE
		default 8192

	endif # NET_MGMT_EVENT

	config TEST_RANDOM_GENERATOR
	default y

endif # NETWORKING

if QEMU_ICOUNT

	config QEMU_ICOUNT_SHIFT
	default 3
	config QEMU_ICOUNT_SLEEP
	default y

endif # QEMU_ICOUNT

if SHELL

	config SHELL_STACK_SIZE
	default 8192

endif # SHELL

endif # BOARD_QEMU_CORTEX_A9
```

## boards/boards_legacy/arm/qemu_cortex_a9/qemu_cortex_a9_defconfig
```kconfig
#
# Copyright (c) 2021, Weidmueller Interface GmbH & Co. KG
#
# SPDX-License-Identifier: Apache-2.0
#

CONFIG_BOARD_QEMU_CORTEX_A9=y

CONFIG_SOC_SERIES_XILINX_XC7ZXXXS=y
CONFIG_SOC_XILINX_XC7Z007S=y

CONFIG_ARM_ARCH_TIMER=y

CONFIG_SERIAL=y
CONFIG_CONSOLE=y
CONFIG_UART_CONSOLE=y

CONFIG_ARMV7_EXCEPTION_STACK_SIZE=8192
CONFIG_ARMV7_FIQ_STACK_SIZE=8192
CONFIG_ARMV7_SVC_STACK_SIZE=8192
CONFIG_ARMV7_SYS_STACK_SIZE=8192
CONFIG_IDLE_STACK_SIZE=8192
CONFIG_ISR_STACK_SIZE=8192
CONFIG_MAIN_STACK_SIZE=8192
CONFIG_SYSTEM_WORKQUEUE_STACK_SIZE=8192
```

## boards/boards_legacy/arm/qemu_cortex_m3/Kconfig.defconfig
```kconfig
# SPDX-License-Identifier: Apache-2.0

if BOARD_QEMU_CORTEX_M3

config BUILD_OUTPUT_BIN
	default n

config BOARD
	default "qemu_cortex_m3"

# DWT is not properly emulated in QEMU
choice NULL_POINTER_EXCEPTION_DETECTION
	bool
	default NULL_POINTER_EXCEPTION_DETECTION_NONE
endchoice

endif # BOARD_QEMU_CORTEX_M3
```

## boards/boards_legacy/arm/rak5010_nrf52840/Kconfig.defconfig
```kconfig
# RAKWIRELESS RAK5010 Board configuration

# Copyright (c) 2020 Guillaume Paquet <guillaume.paquet@smile.fr>
# SPDX-License-Identifier: Apache-2.0

if BOARD_RAK5010_NRF52840

config BOARD
	default "rak5010_nrf52840"

config MODEM_QUECTEL_BG9X
	default y

config BT_CTLR
	default BT

endif # BOARD_RAK5010_NRF52840
```
