## boards/boards_legacy/riscv/hifive_unleashed/Kconfig.board
```kconfig
# Copyright (c) 2021 Katsuhiro Suzuki
# SPDX-License-Identifier: Apache-2.0

config BOARD_HIFIVE_UNLEASHED
	bool "HiFive Unleashed target"
	depends on SOC_SIFIVE_FREEDOM_U540
```

## boards/boards_legacy/riscv/hifive_unmatched/Kconfig.board
```kconfig
# Copyright (c) 2021 Katsuhiro Suzuki
# SPDX-License-Identifier: Apache-2.0

config BOARD_HIFIVE_UNMATCHED
	bool "HiFive Unmatched target"
	depends on SOC_SIFIVE_FREEDOM_U740
```

## boards/boards_legacy/riscv/hifive_unmatched/Kconfig.defconfig
```kconfig
# Copyright (c) 2021 Katsuhiro Suzuki
# SPDX-License-Identifier: Apache-2.0

if BOARD_HIFIVE_UNMATCHED

config BOARD
	default "hifive_unmatched"

config SYS_CLOCK_TICKS_PER_SEC
	default 1000

config SYS_CLOCK_HW_CYCLES_PER_SEC
	default 1000000

endif
```

## boards/boards_legacy/riscv/hifive_unmatched/hifive_unmatched_defconfig
```kconfig
CONFIG_SOC_SERIES_SIFIVE_FREEDOM_U700=y
CONFIG_SOC_SIFIVE_FREEDOM_U740=y
CONFIG_BOARD_HIFIVE_UNMATCHED=y
CONFIG_CONSOLE=y
CONFIG_SERIAL=y
CONFIG_UART_SIFIVE_PORT_0=y
CONFIG_UART_CONSOLE=y
CONFIG_XIP=n
```

## boards/boards_legacy/riscv/icev_wireless/Kconfig.board
```kconfig
# Copyright (c) 2022 Friedt Professional Engineering Services, Inc
# SPDX-License-Identifier: Apache-2.0

config BOARD_ICEV_WIRELESS
	bool "ICE-V Wireless Board"
	depends on SOC_ESP32C3
```

## boards/boards_legacy/riscv/it82xx2_evb/Kconfig.board
```kconfig
# Copyright (c) 2023 ITE Corporation. All Rights Reserved.
# SPDX-License-Identifier: Apache-2.0

config BOARD_IT82XX2_EVB
	bool "IT82XX2 EV-board"
	depends on SOC_IT8XXX2
```

## boards/boards_legacy/riscv/it8xxx2_evb/Kconfig.defconfig
```kconfig
# Copyright (c) 2020 ITE Corporation. All Rights Reserved.
# SPDX-License-Identifier: Apache-2.0

if BOARD_IT8XXX2_EVB

config BOARD
	default "it8xxx2_evb"

if PM
config PM_DEVICE
	default y

choice PM_POLICY
	default PM_POLICY_CUSTOM
endchoice
endif # PM

config INPUT
	default y if KSCAN

endif # BOARD_IT8XXX2_EVB
```

## boards/boards_legacy/riscv/longan_nano/Kconfig.board
```kconfig
# Copyright (c) 2021 Tokita, Hiroshi <tokita.hiroshi@gmail.com>
# SPDX-License-Identifier: Apache-2.0

config BOARD_LONGAN_NANO
	bool "Sipeed Longan Nano target"
	depends on SOC_GD32VF103

config BOARD_LONGAN_NANO_LITE
	bool "Sipeed Longan Nano Lite target"
	depends on SOC_GD32VF103
```

## boards/boards_legacy/riscv/longan_nano/Kconfig.defconfig
```kconfig
# Sipeed longan nano Development Board Configuration

# Copyright (c) 2021 Tokita, Hiroshi <tokita.hiroshi@gmail.com>

if BOARD_LONGAN_NANO || BOARD_LONGAN_NANO_LITE

config BOARD
	default "longan_nano" if BOARD_LONGAN_NANO
	default "longan_nano_lite" if BOARD_LONGAN_NANO_LITE

config DISK_DRIVER_SDMMC
	default y if DISK_DRIVERS

endif # BOARD_LONGAN_NANO || BOARD_LONGAN_NANO_LITE
```

## boards/boards_legacy/riscv/niosv_g/Kconfig.board
```kconfig
# Copyright (C) 2023, Intel Corporation
# SPDX-License-Identifier: Apache-2.0

config BOARD_NIOSV_G
	bool "Intel FPGA Nios V/g General Purpose Processor"
	depends on SOC_NIOSV_G
```

## boards/boards_legacy/riscv/niosv_g/Kconfig.defconfig
```kconfig
# Copyright (C) 2023, Intel Corporation
# SPDX-License-Identifier: Apache-2.0

if BOARD_NIOSV_G

config BOARD
	default "niosv_g"

endif # BOARD_NIOSV_G
```

## boards/boards_legacy/riscv/niosv_m/niosv_m_defconfig
```kconfig
# Copyright (C) 2023, Intel Corporation
# SPDX-License-Identifier: Apache-2.0

CONFIG_SOC_SERIES_NIOSV=y
CONFIG_SOC_NIOSV_M=y
CONFIG_BOARD_NIOSV_M=y
CONFIG_CONSOLE=y
CONFIG_PRINTK=y
CONFIG_SERIAL=y
CONFIG_UART_CONSOLE=y
CONFIG_UART_ALTERA_JTAG=y
CONFIG_XIP=n
```

## boards/boards_legacy/riscv/nrf54h20pdk_nrf54h20/Kconfig.board
```kconfig
# Copyright (c) 2024 Nordic Semiconductor ASA
# SPDX-License-Identifier: Apache-2.0

config BOARD_NRF54H20PDK_NRF54H20_CPUPPR
	bool "nRF54H20 PDK nRF54H20 PPR MCU"
	depends on SOC_NRF54H20_ENGA_CPUPPR
```

## boards/boards_legacy/riscv/riscv32_virtual/Kconfig.defconfig
```kconfig
# Copyright (c) 2023 Meta
# SPDX-License-Identifier: Apache-2.0

config BOARD
	default "riscv32_virtual"
	depends on BOARD_RISCV32_VIRTUAL
```

## boards/boards_legacy/riscv/rv32m1_vega/Kconfig.board
```kconfig
# SPDX-License-Identifier: Apache-2.0

config BOARD_RV32M1_VEGA
	bool "RV32M1 RISC-V cores"
	depends on SOC_OPENISA_RV32M1_RISCV32
```

## boards/boards_legacy/riscv/stamp_c3/Kconfig.board
```kconfig
# M5Stack STAMP-C3 board configuration

# Copyright 2022 TOKITA Hiroshi <tokita.hiroshi@fujitsu.com>
# SPDX-License-Identifier: Apache-2.0

config BOARD_STAMP_C3
	bool "M5Stack STAMP-C3 Board"
	depends on SOC_SERIES_ESP32C3

choice SOC_PART_NUMBER
	default SOC_ESP32C3_FX4
endchoice
```

## boards/boards_legacy/x86/acrn/Kconfig.defconfig
```kconfig
# Copyright (c) 2021 Intel Corporation
# SPDX-License-Identifier: Apache-2.0

if BOARD_ACRN

config BOARD
	default "acrn"
	depends on BOARD_ACRN

config MP_MAX_NUM_CPUS
	default 2

config HEAP_MEM_POOL_ADD_SIZE_ACPI
	default 32768
	depends on ACPI

endif
```

## boards/boards_legacy/x86/intel_ish/intel_ish_5_4_1_defconfig
```kconfig
#
# Copyright (c) 2023 Intel Corporation
#
# SPDX-License-Identifier: Apache-2.0
#

CONFIG_SOC_FAMILY_INTEL_ISH=y
CONFIG_SOC_SERIES_INTEL_ISH5=y
CONFIG_SOC_INTEL_ISH_5_4_1=y
CONFIG_BOARD_INTEL_ISH_5_4_1=y

# uart & console
CONFIG_CONSOLE=y
CONFIG_UART_CONSOLE=y
CONFIG_SERIAL=y
```

## boards/boards_legacy/xtensa/esp32_devkitc_wroom/esp32_devkitc_wroom_defconfig
```kconfig
# Copyright (c) 2023 Espressif Systems (Shanghai) Co., Ltd.
# SPDX-License-Identifier: Apache-2.0

CONFIG_BOARD_ESP32_DEVKITC_WROOM=y
CONFIG_SOC_SERIES_ESP32=y

CONFIG_MAIN_STACK_SIZE=2048

CONFIG_CONSOLE=y
CONFIG_SERIAL=y
CONFIG_UART_CONSOLE=y

CONFIG_GPIO=y
```

## boards/boards_legacy/xtensa/esp32_devkitc_wrover/Kconfig.board
```kconfig
# Copyright (c) 2023 Espressif Systems (Shanghai) Co., Ltd.
# SPDX-License-Identifier: Apache-2.0

config BOARD_ESP32_DEVKITC_WROVER
	bool "ESP32-DEVKITC-WROVER-E Development board"
	depends on SOC_SERIES_ESP32

config BOARD_ESP32_DEVKITC_WROVER_APPCPU
	bool "ESP32 Board configuration for APPCPU (core 1)."
	depends on SOC_SERIES_ESP32 && SOC_ESP32_APPCPU

choice SOC_PART_NUMBER
	default SOC_ESP32_WROVER_E_N4R8
endchoice
```

## boards/boards_legacy/xtensa/esp32_ethernet_kit/esp32_ethernet_kit_defconfig
```kconfig
# SPDX-License-Identifier: Apache-2.0

CONFIG_BOARD_ESP32_ETHERNET_KIT=y
CONFIG_SOC_SERIES_ESP32=y

CONFIG_MAIN_STACK_SIZE=2048

CONFIG_CONSOLE=y
CONFIG_SERIAL=y
CONFIG_UART_CONSOLE=y

CONFIG_GPIO=y
```

## boards/boards_legacy/xtensa/esp32s2_franzininho/Kconfig.board
```kconfig
# ESP32S2 Franzininho board configuration

# Copyright (c) 2022 Felipe Neves
# SPDX-License-Identifier: Apache-2.0

config BOARD_ESP32S2_FRANZININHO
	bool "ESP32S2 Franzininho Board"
	depends on SOC_SERIES_ESP32S2

choice SOC_PART_NUMBER
	default SOC_ESP32S2_WROOM
endchoice
```

## boards/boards_legacy/xtensa/esp32s2_lolin_mini/Kconfig.board
```kconfig
# ESP32S2 LOLIN S2 MINI board configuration

# Copyright (c) 2023 Google, LLC
# SPDX-License-Identifier: Apache-2.0

config BOARD_ESP32S2_LOLIN_MINI
	bool "ESP32S2 Lolin Mini Board"
	depends on SOC_SERIES_ESP32S2

choice SOC_PART_NUMBER
	default SOC_ESP32S2_FN4R2
endchoice
```

## boards/boards_legacy/xtensa/esp32s2_saola/Kconfig.board
```kconfig
# Copyright (c) 2023 Espressif Systems (Shanghai) Co., Ltd.
# SPDX-License-Identifier: Apache-2.0

config BOARD_ESP32S2_SAOLA
	bool "ESP32S2 Saola Board"
	depends on SOC_SERIES_ESP32S2

choice SOC_PART_NUMBER
	default SOC_ESP32S2_WROVER_N4R2
endchoice
```

## boards/boards_legacy/xtensa/esp_wrover_kit/Kconfig.board
```kconfig
# ESP-WROVER-KIT board configuration

# Copyright (c) 2021 Espressif Systems (Shanghai) Co., Ltd.
# SPDX-License-Identifier: Apache-2.0

config BOARD_ESP_WROVER_KIT
	bool "ESP-WROVER-KIT Development Board"
	depends on SOC_SERIES_ESP32

choice SOC_PART_NUMBER
	default SOC_ESP32_WROVER_E_N4R8
endchoice
```
