/*
 * Copyright (c) 2026 Chrispine Tinega <chrispinetinega@gmail.com>
 *
 * SPDX-License-Identifier: Apache-2.0
 */

#include <zephyr/dt-bindings/pinctrl/ti-k3-pinctrl.h>

&pinctrl {
	mcu_uart0_rx_default: mcu-uart0-rx-default {
		pinmux = <K3_PINMUX(0x0014, PIN_INPUT, MUX_MODE_0)>;
	};

	mcu_uart0_tx_default: mcu-uart0-tx-default {
		pinmux = <K3_PINMUX(0x0018, PIN_OUTPUT, MUX_MODE_0)>;
	};
};
