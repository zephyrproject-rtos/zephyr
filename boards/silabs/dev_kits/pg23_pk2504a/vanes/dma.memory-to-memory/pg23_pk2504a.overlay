/*
 * Copyright (c) 2024 Silicon Laboratories, Inc.
 *
 * SPDX-License-Identifier: Apache-2.0
 */

/ {
	dma_test_dma0: dma-test-dma0 {
		compatible = "test-dma-memory-to-memory";
		dma = <&dma0>;
	};
};

&dma0 {
	status = "okay";
};
