/*
 * Copyright (c) 2024 GARDENA GmbH
 *
 * SPDX-License-Identifier: Apache-2.0
 */

#include <zephyr/dt-bindings/pinctrl/si32-pinctrl.h>

&pinctrl {
	usart0_default: usart0_default {
		group1 {
			pinmux = <SI32_MUX(USART0_TX, 1, 12)>,
				<SI32_MUX(USART0_RTS, 1, 14)>;
			output-enable;
		};
		group2 {
			pinmux = <SI32_MUX(USART0_RX, 1, 13)>,
				<SI32_MUX(USART0_CTS, 1, 15)>;
			input-enable;
		};
	};
};
