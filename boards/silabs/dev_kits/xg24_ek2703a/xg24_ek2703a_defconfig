## boards/silabs/dev_kits/xg24_ek2703a/xg24_ek2703a_defconfig
```kconfig
# Copyright (c) 2022 Silicon Labs
# SPDX-License-Identifier: Apache-2.0

CONFIG_ARM_MPU=y
CONFIG_CONSOLE=y
CONFIG_UART_CONSOLE=y
CONFIG_SERIAL=y
CONFIG_GPIO=y
CONFIG_HW_STACK_PROTECTION=y
CONFIG_REGULATOR=y
CONFIG_SOC_GECKO_EMU_DCDC=y
CONFIG_SOC_GECKO_EMU_DCDC_MODE_ON=y
```

## boards/silabs/dev_kits/xg26_dk2608a/Kconfig.xg26_dk2608a
```kconfig
# Copyright (c) 2026 Hong Nguyen
# SPDX-License-Identifier: Apache-2.0

config BOARD_XG26_DK2608A
	select SOC_EFR32MG26B510F3200IM68
```

## boards/silabs/dev_kits/xg26_dk2608a/board.yml
```yaml
board:
  name: xg26_dk2608a
  full_name: EFR32xG26 Dev Kit (xG26-DK2608A)
  vendor: silabs
  socs:
  - name: efr32mg26b510f3200im68
```

## boards/silabs/dev_kits/xg27_dk2602a/Kconfig
```kconfig
# EFR32 Thunderboard-style boards

# Copyright (c) 2022, Silicon Labs
# SPDX-License-Identifier: Apache-2.0

module = BOARD_XG27_DK2602A
module-str = Board Control
source "subsys/logging/Kconfig.template.log_config"
```

## boards/silabs/dev_kits/xg27_dk2602a/Kconfig.defconfig
```kconfig
# Copyright (c) 2023 Antmicro <www.antmicro.com>
# SPDX-License-Identifier: Apache-2.0

if BOARD_XG27_DK2602A

configdefault LOG_BACKEND_SWO_FREQ_HZ
	default 875000

if SOC_GECKO_USE_RAIL

config FPU
	default y

endif # SOC_GECKO_USE_RAIL

if BT

config FPU
	default y

config MAIN_STACK_SIZE
	default 3072 if PM
	default 2304

endif # BT

config REGULATOR
	default y if SI7210

endif
```

## boards/silabs/dev_kits/xg27_dk2602a/Kconfig.xg27_dk2602a
```kconfig
# EFR32BG SLTB010A board

# Copyright (c) 2021, Sateesh Kotapati
# SPDX-License-Identifier: Apache-2.0

config BOARD_XG27_DK2602A
	select SOC_PART_NUMBER_EFR32BG27C140F768IM40
```

## boards/silabs/dev_kits/xg27_dk2602a/board.yml
```yaml
boards:
  - name: xg27_dk2602a
    full_name: EFR32xG27 Dev Kit (xG27-DK2602A)
    vendor: silabs
    socs:
      - name: efr32bg27c140f768im40
```

## boards/silabs/dev_kits/xg28_pk2506a/Kconfig.xg28_pk2506a
```kconfig
# Copyright (c) 2025 Christoph Jans
# SPDX-License-Identifier: Apache-2.0

config BOARD_XG28_PK2506A
	select SOC_PART_NUMBER_EFM32PG28B310F1024IM68
```

## boards/silabs/dev_kits/xg28_pk2506a/board.yml
```yaml
board:
  name: xg28_pk2506a
  full_name: PG28 Pro Kit PK2506A Rev. A03
  vendor: silabs
  socs:
    - name: efm32pg28b310f1024im68
```

## boards/silabs/efm32gg_sltb009a/board.yml
```yaml
board:
  name: efm32gg_sltb009a
  vendor: silabs
  socs:
  - name: efm32gg12b810f1024gm64
```

## boards/silabs/efm32gg_slwstk6121a/Kconfig.efm32gg_slwstk6121a
```kconfig
# EFM32GG SLWSTK6121A board configuration
# Copyright (c) 2019 Interay Solutions B.V.
# Copyright (c) 2019 Oane Kingma
# Copyright (c) 2020 Thorvald Natvig
# SPDX-License-Identifier: Apache-2.0

config BOARD_EFM32GG_SLWSTK6121A
	select SOC_PART_NUMBER_EFM32GG11B820F2048GM64
```

## boards/silabs/efm32gg_slwstk6121a/board.yml
```yaml
board:
  name: efm32gg_slwstk6121a
  vendor: silabs
  socs:
  - name: efm32gg11b820f2048gm64
```

## boards/silabs/efm32gg_stk3701a/board.yml
```yaml
board:
  name: efm32gg_stk3701a
  vendor: silabs
  socs:
  - name: efm32gg11b820f2048gl192
```

## boards/silabs/efm32hg_slstk3400a/Kconfig.efm32hg_slstk3400a
```kconfig
# EFM32HG SLSTK3400A board

# Copyright (c) 2018, Marcio Montenegro
# SPDX-License-Identifier: Apache-2.0

config BOARD_EFM32HG_SLSTK3400A
	select SOC_PART_NUMBER_EFM32HG322F64
```

## boards/silabs/efm32hg_slstk3400a/board.yml
```yaml
board:
  name: efm32hg_slstk3400a
  vendor: silabs
  socs:
  - name: efm32hg322f64
```

## boards/silabs/efm32pg_stk3401a/Kconfig.efm32pg_stk3401a
```kconfig
# EFM32PG STK3401A board

# Copyright (c) 2020, Rafael Dias Menezes <rdmeneze@gmail.com>
# SPDX-License-Identifier: Apache-2.0

config BOARD_EFM32PG_STK3401A
	select SOC_PART_NUMBER_EFM32PG1B200F256GM48
```

## boards/silabs/efm32pg_stk3402a/Kconfig.efm32pg_stk3402a
```kconfig
# EFM32PG STK3402A board

# Copyright (c) 2018, Christian Taedcke
# Copyright (c) 2019  Lemonbeat GmbH
# SPDX-License-Identifier: Apache-2.0

config BOARD_EFM32PG_STK3402A
	select SOC_PART_NUMBER_EFM32PG12B500F1024GL125 if BOARD_EFM32PG_STK3402A_EFM32PG12B500F1024GL125
	select SOC_PART_NUMBER_EFM32JG12B500F1024GL125 if BOARD_EFM32PG_STK3402A_EFM32JG12B500F1024GL125
```

## boards/silabs/efm32pg_stk3402a/board.yml
```yaml
board:
  name: efm32pg_stk3402a
  vendor: silabs
  socs:
  - name: efm32pg12b500f1024gl125
  - name: efm32jg12b500f1024gl125
```

## boards/silabs/efm32wg_stk3800/board.yml
```yaml
board:
  name: efm32wg_stk3800
  vendor: silabs
  socs:
  - name: efm32wg990f256
```

## boards/silabs/efr32_radio/Kconfig.defconfig
```kconfig
# EFR32 radio board

# Copyright (c) 2020 Piotr Mienkowski
# Copyright (c) 2020 TriaGnoSys GmbH
# SPDX-License-Identifier: Apache-2.0

if BOARD_EFR32_RADIO

config CMU_HFXO_FREQ
	default 39000000 if BOARD_EFR32_RADIO_EFR32MG24B220F1536IM48
	default 38400000

config CMU_LFXO_FREQ
	default 32768

config FLASH_BASE_ADDRESS
	hex
	default 0x08000000 if BOARD_EFR32_RADIO_EFR32MG24B220F1536IM48
	default 0x0

config LOG_BACKEND_SWO_FREQ_HZ
	default 875000
	depends on LOG_BACKEND_SWO

if SOC_GECKO_USE_RAIL

config FPU
	default n if SOC_FAMILY_SILABS_S1
	default y

endif # SOC_GECKO_USE_RAIL

if BT

config FPU
	default y

config MINIMAL_LIBC_MALLOC_ARENA_SIZE
	default 8192

config MAIN_STACK_SIZE
	default 3072 if PM
	default 2304

choice BT_HCI_BUS_TYPE
	default BT_SILABS_HCI
endchoice

endif # BT

endif # BOARD_EFR32_RADIO
```

## boards/silabs/efr32_radio/Kconfig.efr32_radio
```kconfig
# EFR32BG13 BRD4104A / EFR32MG21 BRD4180A /
# EFR32FG1P BRD4250B / EFR32FG13P BRD4255A board

# Copyright (c) 2020 Piotr Mienkowski
# Copyright (c) 2020 TriaGnoSys GmbH
# SPDX-License-Identifier: Apache-2.0

config BOARD_EFR32_RADIO
	select SOC_PART_NUMBER_EFR32BG13P632F512GM48 if BOARD_EFR32_RADIO_EFR32BG13P632F512GM48
	select SOC_PART_NUMBER_EFR32MG12P433F1024GM68 if BOARD_EFR32_RADIO_EFR32MG12P433F1024GM68
	select SOC_PART_NUMBER_EFR32MG12P432F1024GL125 if BOARD_EFR32_RADIO_EFR32MG12P432F1024GL125
	select SOC_PART_NUMBER_EFR32FG1P133F256GM48 if BOARD_EFR32_RADIO_EFR32FG1P133F256GM48
	select SOC_PART_NUMBER_EFR32MG21A020F1024IM32 if BOARD_EFR32_RADIO_EFR32MG21A020F1024IM32
	select SOC_PART_NUMBER_EFR32MG24B220F1536IM48 if BOARD_EFR32_RADIO_EFR32MG24B220F1536IM48
	select SOC_PART_NUMBER_EFR32FG13P233F512GM48 if BOARD_EFR32_RADIO_EFR32FG13P233F512GM48
```

## boards/silabs/efr32_radio/board.yml
```yaml
boards:
  - name: efr32_radio
    socs:
      - name: efr32bg13p632f512gm48
      - name: efr32mg12p433f1024gm68
      - name: efr32mg12p432f1024gl125
      - name: efr32fg1p133f256gm48
      - name: efr32mg21a020f1024im32
      - name: efr32mg24b220f1536im48
      - name: efr32fg13p233f512gm48
```

## boards/silabs/efr32_thunderboard/Kconfig
```kconfig
# EFR32 Thunderboard-style boards

# Copyright (c) 2022, Silicon Labs
# SPDX-License-Identifier: Apache-2.0

module = BOARD_THUNDERBOARD
module-str = Board Control
source "subsys/logging/Kconfig.template.log_config"
```

## boards/silabs/efr32_thunderboard/board.yml
```yaml
boards:
  - name: efr32bg22_brd4184
    vendor: silabs
    socs:
      - name: efr32bg22c224f512im40
    revision:
      format: letter
      exact: true
      revisions:
        - name: A
        - name: B
      default: B
  - name: efr32bg27_brd2602a
    vendor: silabs
    socs:
      - name: efr32bg27c140f768im40
```

## boards/silabs/efr32mg_sltb004a/Kconfig.efr32mg_sltb004a
```kconfig
# EFR32MG SLTB004A board

# Copyright (c) 2018, Diego Sueiro
# SPDX-License-Identifier: Apache-2.0

config BOARD_EFR32MG_SLTB004A
	select SOC_PART_NUMBER_EFR32MG12P332F1024GL125
```
