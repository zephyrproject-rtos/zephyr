## boards/silabs/dev_kits/siwx917_dk2605a/siwx917_dk2605a_defconfig
```kconfig
# Copyright (c) 2025 Silicon Laboratories Inc.
# SPDX-License-Identifier: Apache-2.0

CONFIG_USE_DT_CODE_PARTITION=y
CONFIG_CONSOLE=y
CONFIG_UART_CONSOLE=y
CONFIG_SERIAL=y
CONFIG_MEMC=y

CONFIG_CLOCK_CONTROL_INIT_PRIORITY=28
CONFIG_MEMC_INIT_PRIORITY=29
```

## boards/silabs/dev_kits/sltb004a/Kconfig.sltb004a
```kconfig
# Copyright (c) 2018, Diego Sueiro
# SPDX-License-Identifier: Apache-2.0

config BOARD_SLTB004A
	select SOC_PART_NUMBER_EFR32MG12P332F1024GL125
```

## boards/silabs/dev_kits/sltb004a/board.yml
```yaml
board:
  name: sltb004a
  vendor: silabs
  socs:
  - name: efr32mg12p332f1024gl125
```

## boards/silabs/dev_kits/sltb009a/Kconfig.defconfig
```kconfig
# Copyright (c) 2023 Antmicro <www.antmicro.com>
# SPDX-License-Identifier: Apache-2.0

if BOARD_SLTB009A

config LOG_BACKEND_SWO_FREQ_HZ
	default 875000
	depends on LOG_BACKEND_SWO

endif # BOARD_SLTB009A
```

## boards/silabs/dev_kits/sltb009a/Kconfig.sltb009a
```kconfig
# Copyright (c) 2023 Antmicro <www.antmicro.com>
# SPDX-License-Identifier: Apache-2.0

config BOARD_SLTB009A
	select SOC_EFM32GG12B810F1024GM64
```

## boards/silabs/dev_kits/sltb009a/board.yml
```yaml
board:
  name: sltb009a
  full_name: EFM32GG12 Thunderboard (SLTB009A)
  vendor: silabs
  socs:
  - name: efm32gg12b810f1024gm64
```

## boards/silabs/dev_kits/sltb010a/Kconfig.defconfig
```kconfig
# Copyright (c) 2023 Antmicro <www.antmicro.com>
# SPDX-License-Identifier: Apache-2.0

config CMU_HFXO_FREQ
	default 38400000

config CMU_LFXO_FREQ
	default 32768

if SOC_GECKO_USE_RAIL

config FPU
	default y

endif # SOC_GECKO_USE_RAIL

if BT

config FPU
	default y

config COMMON_LIBC_MALLOC_ARENA_SIZE
	default 8192

config MAIN_STACK_SIZE
	default 3072 if PM
	default 2304

config BT_SEND_ECC_EMULATION
	default y

endif # BT

config REGULATOR
	default y if SI7210
```

## boards/silabs/dev_kits/sltb010a/Kconfig.sltb010a
```kconfig
# Copyright (c) 2021, Sateesh Kotapati
# SPDX-License-Identifier: Apache-2.0

config BOARD_SLTB010A
	select SOC_EFR32BG22C224F512IM40
```

## boards/silabs/dev_kits/sltb010a/board.yml
```yaml
boards:
  - name: sltb010a
    full_name: EFR32BG22 Thunderboard (SLTB010A)
    vendor: silabs
    socs:
      - name: efr32bg22c224f512im40
    revision:
      format: number
      default: "2"
      revisions:
        - name: "0"
        - name: "2"
```

## boards/silabs/dev_kits/xg22_ek2710a/Kconfig.defconfig
```kconfig
# Copyright The Zephyr Project Contributors
# SPDX-License-Identifier: Apache-2.0

if BOARD_XG22_EK2710A

config LOG_BACKEND_SWO_FREQ_HZ
	default 875000
	depends on LOG_BACKEND_SWO

if SOC_GECKO_USE_RAIL

config FPU
	default y

endif # SOC_GECKO_USE_RAIL

if BT

config FPU
	default y

config MAIN_STACK_SIZE
	default 3072 if PM
	default 2304

endif # BT

endif # BOARD_XG22_EK2710A
```

## boards/silabs/dev_kits/xg22_ek2710a/Kconfig.xg22_ek2710a
```kconfig
# Copyright The Zephyr Project Contributors
# SPDX-License-Identifier: Apache-2.0

config BOARD_XG22_EK2710A
	select SOC_EFR32MG22E224F512IM40
```

## boards/silabs/dev_kits/xg22_ek2710a/board.yml
```yaml
board:
  name: xg22_ek2710a
  full_name: EFR32xG22 Explorer Kit (xG22-EK2710A)
  vendor: silabs
  socs:
    - name: efr32mg22e224f512im40
```

## boards/silabs/dev_kits/xg23_pk2504a/Kconfig.defconfig
```kconfig
# Copyright (c) 2025 Christoph Jans
# SPDX-License-Identifier: Apache-2.0

if BOARD_XG23_PK2504A

config LOG_BACKEND_SWO_FREQ_HZ
	default 875000
	depends on LOG_BACKEND_SWO

if SOC_GECKO_USE_RAIL

config FPU
	default y

endif # SOC_GECKO_USE_RAIL

endif # BOARD_XG23_PK2504A
```

## boards/silabs/dev_kits/xg23_pk2504a/Kconfig.xg23_pk2504a
```kconfig
# Copyright (c) 2025 Christoph Jans
# SPDX-License-Identifier: Apache-2.0

config BOARD_XG23_PK2504A
	select SOC_PART_NUMBER_EFM32PG23B310F512IM48
```

## boards/silabs/dev_kits/xg23_pk2504a/board.yml
```yaml
board:
  name: xg23_pk2504a
  full_name: PG28 Pro Kit PK2504A Rev. A03
  vendor: silabs
  socs:
    - name: efm32pg23b310f512im48
```

## boards/silabs/dev_kits/xg24_dk2601b/Kconfig
```kconfig
# EFR32XG24 DK2601B board

# Copyright (c) 2022, Silicon Labs
# SPDX-License-Identifier: Apache-2.0

if BOARD_XG24_DK2601B

module = BOARD_EFR32MG24
module-str = Board Control
source "subsys/logging/Kconfig.template.log_config"

endif # BOARD_XG24_DK2601B
```

## boards/silabs/dev_kits/xg24_dk2601b/Kconfig.defconfig
```kconfig
# Copyright (c) 2021, Sateesh Kotapati
# SPDX-License-Identifier: Apache-2.0

if BOARD_XG24_DK2601B

configdefault LOG_BACKEND_SWO_FREQ_HZ
	default 875000

if SOC_GECKO_USE_RAIL

config FPU
	default y

endif # SOC_GECKO_USE_RAIL

if BT

config FPU
	default y

config MAIN_STACK_SIZE
	default 2304

if SHELL

config SHELL_STACK_SIZE
	default 4096

endif # SHELL

endif # BT

endif # BOARD_XG24_DK2601B
```

## boards/silabs/dev_kits/xg24_dk2601b/Kconfig.xg24_dk2601b
```kconfig
# Copyright (c) 2021, Sateesh Kotapati
# SPDX-License-Identifier: Apache-2.0

config BOARD_XG24_DK2601B
	select SOC_PART_NUMBER_EFR32MG24B310F1536IM48
```

## boards/silabs/dev_kits/xg24_dk2601b/board.yml
```yaml
board:
  name: xg24_dk2601b
  full_name: EFR32xG24 Dev Kit (xG24-DK2601B)
  vendor: silabs
  socs:
  - name: efr32mg24b310f1536im48
```

## boards/silabs/dev_kits/xg24_dk2601b/xg24_dk2601b_defconfig
```kconfig
# Copyright (c) 2022 Silicon Labs
# SPDX-License-Identifier: Apache-2.0

CONFIG_ARM_MPU=y
CONFIG_CONSOLE=y
CONFIG_UART_CONSOLE=y
CONFIG_SERIAL=y
CONFIG_CORTEX_M_SYSTICK=y
CONFIG_GPIO=y
CONFIG_SYS_CLOCK_HW_CYCLES_PER_SEC=76800000
CONFIG_CMU_HFCLK_HFXO=y
CONFIG_CMU_HFCLK_LFXO=y
CONFIG_HW_STACK_PROTECTION=y
CONFIG_PINCTRL=y
CONFIG_REGULATOR=y
CONFIG_SOC_GECKO_EMU_DCDC=y
CONFIG_SOC_GECKO_EMU_DCDC_MODE_ON=y
```

## boards/silabs/dev_kits/xg24_ek2703a/Kconfig
```kconfig
# EFR32XG24 EK2703A board

# Copyright (c) 2022, Silicon Labs
# SPDX-License-Identifier: Apache-2.0

if BOARD_XG24_EK2703A

config BOARD_XG24_EK2703A
	select GPIO
	select BOARD_LATE_INIT_HOOK

module = BOARD_EFR32MG24
module-str = Board Control
source "subsys/logging/Kconfig.template.log_config"

endif # BOARD_XG24_EK2703A
```

## boards/silabs/dev_kits/xg24_ek2703a/Kconfig.defconfig
```kconfig
# Copyright (c) 2021, Sateesh Kotapati
# SPDX-License-Identifier: Apache-2.0

if BOARD_XG24_EK2703A

configdefault LOG_BACKEND_SWO_FREQ_HZ
	default 875000

if SOC_GECKO_USE_RAIL

config FPU
	default y

endif # SOC_GECKO_USE_RAIL

endif # BOARD_XG24_EK2703A
```

## boards/silabs/dev_kits/xg24_ek2703a/Kconfig.xg24_ek2703a
```kconfig
# Copyright (c) 2021, Sateesh Kotapati
# SPDX-License-Identifier: Apache-2.0

config BOARD_XG24_EK2703A
	select SOC_PART_NUMBER_EFR32MG24B210F1536IM48
```

## boards/silabs/dev_kits/xg24_ek2703a/board.yml
```yaml
board:
  name: xg24_ek2703a
  full_name: EFR32xG24 Explorer Kit (xG24-EK2703A)
  vendor: silabs
  socs:
  - name: efr32mg24b210f1536im48
```
