## boards/silabs/starter_kits/slstk3701a/board.yml
```yaml
board:
  name: slstk3701a
  full_name: EFM32 Giant Gecko 11 (SLSTK3701A)
  vendor: silabs
  socs:
  - name: efm32gg11b820f2048gl192
```

## boards/sipeed/longan_nano/Kconfig.defconfig
```kconfig
# Sipeed longan nano Development Board Configuration

# Copyright (c) 2021 Tokita, Hiroshi <tokita.hiroshi@gmail.com>

if BOARD_LONGAN_NANO

config DISK_DRIVER_SDMMC
	default y if DISK_DRIVERS

endif # BOARD_LONGAN_NANO
```

## boards/sipeed/longan_nano/board.yml
```yaml
board:
  name: longan_nano
  full_name: Longan Nano
  vendor: sipeed
  socs:
    - name: gd32vf103
      variants:
        - name: lite
```

## boards/sipeed/longan_nano/longan_nano_defconfig
```kconfig
# Sipeed longan nano Development Board Configuration
#
# Copyright (c) 2021 Tokita, Hiroshi <tokita.hiroshi@gmail.com>
#
# SPDX-License-Identifier: Apache-2.0

CONFIG_GD32_HXTAL_8MHZ=y

CONFIG_SERIAL=y
CONFIG_UART_INTERRUPT_DRIVEN=y

CONFIG_CONSOLE=y
CONFIG_UART_CONSOLE=y

CONFIG_GPIO=y
```

## boards/sipeed/m0sense/Kconfig
```kconfig
# Copyright The Zephyr Project Contributors
# SPDX-License-Identifier: Apache-2.0

config BOARD_M0SENSE
	select BUILD_OUTPUT_UF2_USE_FLASH_OFFSET
```

## boards/sipeed/m0sense/Kconfig.defconfig
```kconfig
# Copyright The Zephyr Project Contributors
# SPDX-License-Identifier: Apache-2.0

if BOARD_M0SENSE

source "boards/common/usb/Kconfig.cdc_acm_serial.defconfig"

endif # BOARD_M0SENSE
```

## boards/sipeed/m0sense/Kconfig.m0sense
```kconfig
# SPDX-FileCopyrightText: Copyright The Zephyr Project Contributors
# SPDX-License-Identifier: Apache-2.0

config BOARD_M0SENSE
	select SOC_BL702SA0Q2I
```

## boards/sipeed/m0sense/board.yml
```yaml
board:
  name: m0sense
  full_name: Sipeed M0Sense
  vendor: sipeed
  socs:
    - name: bl702sa0q2i
```

## boards/sipeed/m0sense/m0sense_defconfig
```kconfig
# SPDX-FileCopyrightText: Copyright The Zephyr Project Contributors
# SPDX-License-Identifier: Apache-2.0

CONFIG_GPIO=y
CONFIG_CONSOLE=y
CONFIG_SERIAL=y

CONFIG_UART_CONSOLE=y
CONFIG_UART_INTERRUPT_DRIVEN=y

CONFIG_BUILD_OUTPUT_UF2=y

CONFIG_USB_DEVICE_STACK_NEXT=y
CONFIG_USBD_CDC_ACM_CLASS=y
CONFIG_CDC_ACM_SERIAL_INITIALIZE_AT_BOOT=y
```

## boards/sipeed/m1s_dock/board.yml
```yaml
board:
  name: m1s_dock
  full_name: Sipeed M1S Dock
  vendor: sipeed
  socs:
    - name: bl808c09q2i
```

## boards/sipeed/maix_m0s_dock/Kconfig.maix_m0s_dock
```kconfig
# Copyright (c) 2025 MASSDRIVER EI (massdriver.space)
#
# SPDX-License-Identifier: Apache-2.0

config BOARD_MAIX_M0S_DOCK
	select SOC_BL616C50Q2I
```

## boards/sipeed/maix_m0s_dock/board.yml
```yaml
board:
  name: maix_m0s_dock
  full_name: Sipeed M0S Dock
  vendor: sipeed
  socs:
    - name: bl616c50q2i
```

## boards/snps/em_starterkit/Kconfig.defconfig
```kconfig
# SPDX-License-Identifier: Apache-2.0
# Copyright (c) 2017 Synopsys

if BOARD_EM_STARTERKIT

if I2C_DW

config I2C_DW_CLOCK_SPEED
	default 100

endif # I2C_DW

endif # BOARD_EM_STARTERKIT
```

## boards/snps/em_starterkit/Kconfig.em_starterkit
```kconfig
# DesignWare ARC EM Starter Kit board configuration

# Copyright (c) 2016 Synopsys, Inc. All rights reserved.
# SPDX-License-Identifier: Apache-2.0

config BOARD_EM_STARTERKIT
	select SOC_EMSK
	select SOC_EMSK_EM7D if BOARD_EM_STARTERKIT_EMSK_EM7D
	select SOC_EMSK_EM9D if BOARD_EM_STARTERKIT_EMSK_EM9D
	select SOC_EMSK_EM11D if BOARD_EM_STARTERKIT_EMSK_EM11D
```

## boards/snps/em_starterkit/board.yml
```yaml
board:
  name: em_starterkit
  full_name: ARC EM Starter Kit
  vendor: snps
  socs:
  - name: emsk_em7d
  - name: emsk_em9d
  - name: emsk_em11d
  revision:
    format: major.minor.patch
    default: "2.3"
    revisions:
    - name: "2.2"
    - name: "2.3"
```

## boards/snps/em_starterkit/em_starterkit_emsk_em7d_2_3_defconfig
```kconfig
# SPDX-License-Identifier: Apache-2.0
# Copyright (c) 2017 Synopsys

CONFIG_SYS_CLOCK_TICKS_PER_SEC=100
CONFIG_XIP=n
CONFIG_BUILD_NO_GAP_FILL=y
CONFIG_BUILD_OUTPUT_BIN=n
CONFIG_ARCV2_INTERRUPT_UNIT=y
CONFIG_ARCV2_TIMER=y
CONFIG_CONSOLE=y
CONFIG_UART_CONSOLE=y
CONFIG_SERIAL=y
CONFIG_UART_INTERRUPT_DRIVEN=y
CONFIG_GPIO=y
CONFIG_ARC_HAS_SECURE=y
CONFIG_TRUSTED_EXECUTION_SECURE=y
CONFIG_INIT_ARCH_HW_AT_BOOT=y
```

## boards/snps/emsdp/Kconfig.defconfig
```kconfig
# DesignWare ARC EM Software Development Platform board configuration

# Copyright (c) 2019 Synopsys, Inc. All rights reserved.
# SPDX-License-Identifier: Apache-2.0

if BOARD_EMSDP

if SPI

config SPI_DW
	default y

endif # SPI

endif # BOARD_EMSDP
```

## boards/snps/emsdp/Kconfig.emsdp
```kconfig
# DesignWare ARC EM Software Development Platform board configuration

# Copyright (c) 2019 Synopsys, Inc. All rights reserved.
# SPDX-License-Identifier: Apache-2.0

config BOARD_EMSDP
	select SOC_ARC_EMSDP
	select SOC_EMSDP_EM4 if BOARD_EMSDP_EMSDP_EM4
	select SOC_EMSDP_EM5D if BOARD_EMSDP_EMSDP_EM5D
	select SOC_EMSDP_EM6 if BOARD_EMSDP_EMSDP_EM6
	select SOC_EMSDP_EM7D if BOARD_EMSDP_EMSDP_EM7D
	select SOC_EMSDP_EM7D_ESP if BOARD_EMSDP_EMSDP_EM7D_ESP
	select SOC_EMSDP_EM9D if BOARD_EMSDP_EMSDP_EM9D
	select SOC_EMSDP_EM11D if BOARD_EMSDP_EMSDP_EM11D
```

## boards/snps/emsdp/board.yml
```yaml
board:
  name: emsdp
  full_name: ARC EM Software Development Platform
  vendor: snps
  socs:
  - name: emsdp_em4
  - name: emsdp_em5d
  - name: emsdp_em6
  - name: emsdp_em7d
  - name: emsdp_em7d_esp
  - name: emsdp_em9d
  - name: emsdp_em11d
```

## boards/snps/emsdp/emsdp_emsdp_em7d_esp_defconfig
```kconfig
# SPDX-License-Identifier: Apache-2.0

CONFIG_ARC_HAS_SECURE=y
CONFIG_TRUSTED_EXECUTION_SECURE=y
CONFIG_SPI=y
```

## boards/snps/hsdk/Kconfig.hsdk
```kconfig
# DesignWare ARC HS Development Kit board configuration

# Copyright (c) 2019 Synopsys, Inc. All rights reserved.
# SPDX-License-Identifier: Apache-2.0

config BOARD_HSDK
	select SOC_ARC_HSDK
```

## boards/snps/hsdk/board.yml
```yaml
board:
  name: hsdk
  full_name: ARC HS Development Kit
  vendor: snps
  socs:
  - name: arc_hsdk
    variants:
    - name: 2cores
```

## boards/snps/hsdk4xd/Kconfig.hsdk4xd
```kconfig
# DesignWare ARC HSDK4XD Development Kit board configuration

# Copyright (c) 2023 Synopsys, Inc. All rights reserved.
# SPDX-License-Identifier: Apache-2.0

config BOARD_HSDK4XD
	select SOC_ARC_HSDK4XD
```

## boards/snps/hsdk4xd/board.yml
```yaml
board:
  name: hsdk4xd
  full_name: ARC HS4x/HS4xD Development Kit
  vendor: snps
  socs:
  - name: arc_hsdk4xd
```

## boards/snps/iotdk/Kconfig.iotdk
```kconfig
# DesignWare ARC IoT Development Kit board configuration

# Copyright (c) 2018 Synopsys, Inc. All rights reserved.
# SPDX-License-Identifier: Apache-2.0

config BOARD_IOTDK
	select SOC_ARC_IOT
```
