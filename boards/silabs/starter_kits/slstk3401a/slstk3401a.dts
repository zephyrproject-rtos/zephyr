/*
 * Copyright (c) 2020 Rafael Dias Menezes <rdmeneze@gmail.com>
 *
 * SPDX-License-Identifier: Apache-2.0
 */

/dts-v1/;
#include <silabs/efm32pg1b200f256gm48.dtsi>
#include "slstk3401a-common.dtsi"

/ {
	model = "Silicon Labs EFM32PG SLSTK3401A board";
	compatible = "silabs,slstk3401a", "silabs,efm32pg1b";
};
