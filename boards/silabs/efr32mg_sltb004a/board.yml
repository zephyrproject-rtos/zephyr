## boards/silabs/efr32mg_sltb004a/board.yml
```yaml
board:
  name: efr32mg_sltb004a
  vendor: silabs
  socs:
  - name: efr32mg12p332f1024gl125
```

## boards/silabs/efr32xg24_dk2601b/Kconfig.defconfig
```kconfig
# EFR32XG24 DK2601B board

# Copyright (c) 2021, Sateesh Kotapati
# SPDX-License-Identifier: Apache-2.0

if BOARD_EFR32XG24_DK2601B

config CMU_HFXO_FREQ
	default 40000000

config CMU_LFXO_FREQ
	default 32768

config FLASH_BASE_ADDRESS
	hex
	default 0x08000000

if SOC_GECKO_USE_RAIL

config FPU
	default y

endif # SOC_GECKO_USE_RAIL

if BT

config FPU
	default y

config MINIMAL_LIBC_MALLOC_ARENA_SIZE
	default 8192

config MAIN_STACK_SIZE
	default 2304

choice BT_HCI_BUS_TYPE
	default BT_SILABS_HCI
endchoice

if SHELL

config SHELL_STACK_SIZE
	default 4096

endif # SHELL

endif # BT

endif # BOARD_EFR32XG24_DK2601B
```

## boards/silabs/efr32xg24_dk2601b/Kconfig.efr32xg24_dk2601b
```kconfig
# EFR32XG24 DK2601B board

# Copyright (c) 2021, Sateesh Kotapati
# SPDX-License-Identifier: Apache-2.0

config BOARD_EFR32XG24_DK2601B
	select SOC_PART_NUMBER_EFR32MG24B310F1536IM48
```

## boards/silabs/explorer_kits/xg22/Kconfig.bg22_ek4108a
```kconfig
# Copyright The Zephyr Project Contributors
# SPDX-License-Identifier: Apache-2.0

config BOARD_BG22_EK4108A
	select SOC_EFR32BG22C224F512IM40
```

## boards/silabs/explorer_kits/xg22/bgm220_ek4314a_defconfig
```kconfig
# Copyright The Zephyr Project Contributors
# SPDX-License-Identifier: Apache-2.0

CONFIG_ARM_MPU=y
CONFIG_CONSOLE=y
CONFIG_UART_CONSOLE=y
CONFIG_SERIAL=y
CONFIG_GPIO=y
CONFIG_HW_STACK_PROTECTION=y
```

## boards/silabs/explorer_kits/xg22/board.yml
```yaml
boards:
  - name: bgm220_ek4314a
    full_name: BGM220 Explorer Kit (BGM220-EK4314A)
    vendor: silabs
    socs:
      - name: bgm220pc22hna
  - name: bg22_ek4108a
    full_name: EFR32BG22 Explorer Kit (BG22-EK4108A)
    vendor: silabs
    socs:
      - name: efr32bg22c224f512im40
  - name: xg22_ek2710a
    full_name: EFR32xG22E Explorer Kit (xG22-EK2710A)
    vendor: silabs
    socs:
      - name: efr32mg22e224f512im40
```

## boards/silabs/explorer_kits/xg26/Kconfig.mgm260p_ek2713a
```kconfig
# Copyright The Zephyr Project Contributors
# SPDX-License-Identifier: Apache-2.0

config BOARD_MGM260P_EK2713A
	select SOC_MGM260PD32VNA
```

## boards/silabs/explorer_kits/xg26/Kconfig.pg26_ek2711a
```kconfig
# Copyright The Zephyr Project Contributors
# SPDX-License-Identifier: Apache-2.0

config BOARD_PG26_EK2711A
	select SOC_EFM32PG26B500F3200IM68
```

## boards/silabs/explorer_kits/xg26/Kconfig.xg26_ek2709a
```kconfig
# Copyright The Zephyr Project Contributors
# SPDX-License-Identifier: Apache-2.0

config BOARD_XG26_EK2709A
	select SOC_EFR32MG26B510F3200IM48
```

## boards/silabs/explorer_kits/xg26/board.yml
```yaml
boards:
  - name: mgm260p_ek2713a
    full_name: xGM260P Explorer Kit (MGM260P-EK2713A)
    vendor: silabs
    socs:
      - name: mgm260pd32vna
  - name: pg26_ek2711a
    full_name: EFM32PG26 Explorer Kit (PG26-EK2711A)
    vendor: silabs
    socs:
      - name: efm32pg26b500f3200im68
  - name: xg26_ek2709a
    full_name: EFR32xG26 Explorer Kit (xG26-EK2709A)
    vendor: silabs
    socs:
      - name: efr32mg26b510f3200im48
```

## boards/silabs/explorer_kits/xg28/Kconfig.xg28_ek2705a
```kconfig
# Copyright The Zephyr Project Contributors
# SPDX-License-Identifier: Apache-2.0

config BOARD_XG28_EK2705A
	select SOC_EFR32ZG28B312F1024IM48
```

## boards/silabs/explorer_kits/xg28/board.yml
```yaml
boards:
  - name: xg28_ek2705a
    full_name: EFR32xG28 Explorer Kit (xG28-EK2705A)
    vendor: silabs
    socs:
      - name: efr32zg28b312f1024im48
```

## boards/silabs/radio_boards/bg29_rb4420a/Kconfig.defconfig
```kconfig
# Copyright (c) 2025 Silicon Laboratories Inc.
# SPDX-License-Identifier: Apache-2.0

if BOARD_BG29_RB4420A

config LOG_BACKEND_SWO_FREQ_HZ
	default 875000
	depends on LOG_BACKEND_SWO

if SOC_GECKO_USE_RAIL

config FPU
	default y

endif # SOC_GECKO_USE_RAIL

if BT

config FPU
	default y

config MAIN_STACK_SIZE
	default 3072 if PM
	default 2304

endif # BT

endif # BOARD_BG29_RB4420A
```

## boards/silabs/radio_boards/bg29_rb4420a/board.yml
```yaml
board:
  name: bg29_rb4420a
  full_name: EFR32BG29 Bluetooth LE 4 dBm DCDC Boost WLCSP (BG29-RB4420A)
  vendor: silabs
  socs:
    - name: efr32bg29b220f1024cj45
```

## boards/silabs/radio_boards/efr32_radio/efr32_radio_efr32mg24b220f1536im48_defconfig
```kconfig
# SPDX-License-Identifier: Apache-2.0

CONFIG_ARM_MPU=y
CONFIG_CONSOLE=y
CONFIG_UART_CONSOLE=y
CONFIG_SERIAL=y
CONFIG_GPIO=y
CONFIG_SYS_CLOCK_HW_CYCLES_PER_SEC=78000000
CONFIG_SOC_GECKO_EMU_DCDC=y
CONFIG_SOC_GECKO_EMU_DCDC_MODE_ON=y
CONFIG_PINCTRL=y

# Use BURTC as system clock source
CONFIG_GECKO_BURTC_TIMER=y
CONFIG_CMU_BURTCCLK_LFXO=y
CONFIG_SYS_CLOCK_TICKS_PER_SEC=1024
```

## boards/silabs/radio_boards/kg100s_rb4332a/Kconfig.defconfig
```kconfig
# Copyright (c) 2026 Martin Moya <martin.moya@focus.uy>
# SPDX-License-Identifier: Apache-2.0

if BOARD_KG100S_RB4332A

config LOG_BACKEND_SWO_FREQ_HZ
	default 875000
	depends on LOG_BACKEND_SWO

if SOC_GECKO_USE_RAIL

config FPU
	default y

endif # SOC_GECKO_USE_RAIL

endif # BOARD_KG100S_RB4332A
```

## boards/silabs/radio_boards/kg100s_rb4332a/Kconfig.kg100s_rb4332a
```kconfig
# Copyright (c) 2026 Martin Moya <martin.moya@focus.uy>
# SPDX-License-Identifier: Apache-2.0

config BOARD_KG100S_RB4332A
	select SOC_EFR32BG21B010F1024IM32
```

## boards/silabs/radio_boards/kg100s_rb4332a/board.yml
```yaml
board:
  name: kg100s_rb4332a
  full_name: KG100S Radio board (KG100S-RB4332A)
  vendor: silabs
  socs:
    - name: efr32bg21b010f1024im32
```

## boards/silabs/radio_boards/siwx917/board.yml
```yaml
boards:
  - name: siwx917_rb4338a
    full_name: >-
      SiWx917 Wi-Fi 6 and Bluetooth LE SoC 8 MB Flash Radio Board
      (SiWx91x-RB4338A)
    vendor: silabs
    socs:
      - name: siwg917m111mgtba
  - name: siwx917_rb4342a
    full_name: >-
      SiWx917 Wi-Fi 6 and Bluetooth LE 8 MB Flash + 8 MB ext PSRAM Radio Board
      (SiWx91x-RB4342A)
    vendor: silabs
    socs:
      - name: siwg917m111mgtba
```

## boards/silabs/radio_boards/siwx917/siwx917_rb4338a_defconfig
```kconfig
# Copyright (c) 2024 Silicon Laboratories Inc.
# SPDX-License-Identifier: Apache-2.0

CONFIG_USE_DT_CODE_PARTITION=y
CONFIG_CONSOLE=y
CONFIG_UART_CONSOLE=y
CONFIG_SERIAL=y
```

## boards/silabs/radio_boards/siwx917_rb4338a/Kconfig.siwx917_rb4338a
```kconfig
# Copyright (c) 2023 Antmicro
# SPDX-License-Identifier: Apache-2.0

config BOARD_SIWX917_RB4338A
	select SOC_PART_NUMBER_SIWG917M111MGTBA
	
# Kconfig.board for SiWx917 RB4338A

config SIGNING_ENABLED
  bool "Sign binary with Silicon Labs Commander"
  default n
  help
    Enable signing the Zephyr binary with Silicon Labs Commander during build.

config M4_OTA_KEY
  string "M4 OTA Key for Commander"
  default "OTA_KEY_IN_HEX"
  depends on SIGNING_ENABLED
  help
    The OTA key (hex string) used for signing and encryption with Silicon Labs Commander.

config M4_PRIVATE_KEY
  string "M4 Private Key Path for Commander"
  default "m4_private_key_path"
  depends on SIGNING_ENABLED
  help
    Path to the private key file used for signing with Silicon Labs Commander, relative to the board directory.
```

## boards/silabs/radio_boards/siwx917_rb4338a/board.yml
```yaml
board:
  name: siwx917_rb4338a
  full_name: SiWx917 Wi-Fi 6 and Bluetooth LE SoC 8 MB Flash Radio Board (SLWRB4338A)
  vendor: silabs
  socs:
    - name: siwg917m111mgtba
```

## boards/silabs/radio_boards/siwx917_rb4342a/Kconfig.siwx917_rb4342a
```kconfig
# Copyright (c) 2025 Silicon Laboratories Inc.
# SPDX-License-Identifier: Apache-2.0

config BOARD_SIWX917_RB4342A
	select SOC_SIWG917M111MGTBA
```

## boards/silabs/radio_boards/siwx917_rb4342a/board.yml
```yaml
board:
  name: siwx917_rb4342a
  full_name: SiWx917 Wi-Fi 6 and Bluetooth LE 8 MB Flash + 8 MB ext PSRAM Radio Board (SLWRB4342A)
  vendor: silabs
  socs:
    - name: siwg917m111mgtba
```

## boards/silabs/radio_boards/siwx917_rb4342a/siwx917_rb4342a_defconfig
```kconfig
# Copyright (c) 2025 Silicon Laboratories Inc.
# SPDX-License-Identifier: Apache-2.0

CONFIG_SYS_CLOCK_HW_CYCLES_PER_SEC=180000000
CONFIG_USE_DT_CODE_PARTITION=y
CONFIG_CONSOLE=y
CONFIG_UART_CONSOLE=y
CONFIG_SERIAL=y
CONFIG_MEMC=y

CONFIG_CLOCK_CONTROL_INIT_PRIORITY=28
CONFIG_MEMC_INIT_PRIORITY=29
```
