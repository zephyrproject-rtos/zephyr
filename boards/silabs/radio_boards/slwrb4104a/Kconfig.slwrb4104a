## boards/silabs/radio_boards/slwrb4104a/Kconfig.slwrb4104a
```kconfig
# Copyright (c) 2020 Piotr Mienkowski
# Copyright (c) 2020 TriaGnoSys GmbH
# SPDX-License-Identifier: Apache-2.0

config BOARD_SLWRB4104A
	select SOC_EFR32BG13P632F512GM48
```

## boards/silabs/radio_boards/slwrb4104a/board.yml
```yaml
board:
  name: slwrb4104a
  full_name: EFR32BG13 2.4 GHz 10 dBm (SLWRB4104A)
  vendor: silabs
  socs:
    - name: efr32bg13p632f512gm48
```

## boards/silabs/radio_boards/slwrb4161a/Kconfig.slwrb4161a
```kconfig
# EFR32MG12 BRD4161A

# Copyright (c) 2020 Piotr Mienkowski
# Copyright (c) 2020 TriaGnoSys GmbH
# SPDX-License-Identifier: Apache-2.0

config BOARD_SLWRB4161A
	select SOC_PART_NUMBER_EFR32MG12P432F1024GL125
```

## boards/silabs/radio_boards/slwrb4161a/board.yml
```yaml
board:
  name: slwrb4161a
  full_name: EFR32MG12 2.4 GHz 19 dBm (SLWRB4161A)
  vendor: silabs
  socs:
    - name: efr32mg12p432f1024gl125
```

## boards/silabs/radio_boards/slwrb4170a/Kconfig.slwrb4170a
```kconfig
# Copyright (c) 2020 Piotr Mienkowski
# Copyright (c) 2020 TriaGnoSys GmbH
# SPDX-License-Identifier: Apache-2.0

config BOARD_SLWRB4170A
	select SOC_PART_NUMBER_EFR32MG12P433F1024GM68
```

## boards/silabs/radio_boards/slwrb4170a/board.yml
```yaml
board:
  name: slwrb4170a
  full_name: EFR32MG12 2400/868-915 MHz 19 dBm Dual Band (SLWRB4170A)
  vendor: silabs
  socs:
    - name: efr32mg12p433f1024gm68
```

## boards/silabs/radio_boards/slwrb4170a/slwrb4170a_defconfig
```kconfig
# SPDX-License-Identifier: Apache-2.0

CONFIG_ARM_MPU=y
CONFIG_CONSOLE=y
CONFIG_UART_CONSOLE=y
CONFIG_SERIAL=y
CONFIG_GPIO=y
CONFIG_SYS_CLOCK_HW_CYCLES_PER_SEC=38400000
CONFIG_CMU_HFCLK_HFXO=y
CONFIG_SOC_GECKO_EMU_DCDC=y
CONFIG_SOC_GECKO_EMU_DCDC_MODE_ON=y
```

## boards/silabs/radio_boards/slwrb4180a/Kconfig.defconfig
```kconfig
# Copyright (c) 2020 Piotr Mienkowski
# Copyright (c) 2020 TriaGnoSys GmbH
# SPDX-License-Identifier: Apache-2.0

if BOARD_SLWRB4180A

config LOG_BACKEND_SWO_FREQ_HZ
	default 875000
	depends on LOG_BACKEND_SWO

if SOC_GECKO_USE_RAIL

config FPU
	default y

endif # SOC_GECKO_USE_RAIL

if BT

config FPU
	default y

config COMMON_LIBC_MALLOC_ARENA_SIZE
	default 8192

config MAIN_STACK_SIZE
	default 3072 if PM
	default 2304

endif # BT

endif # BOARD_SLWRB4180A
```

## boards/silabs/radio_boards/slwrb4180a/Kconfig.slwrb4180a
```kconfig
# Copyright (c) 2020 Piotr Mienkowski
# Copyright (c) 2020 TriaGnoSys GmbH
# SPDX-License-Identifier: Apache-2.0

config BOARD_SLWRB4180A
	select SOC_EFR32MG21A020F1024IM32
```

## boards/silabs/radio_boards/slwrb4180a/board.yml
```yaml
board:
  name: slwrb4180a
  full_name: EFR32xG21 2.4 GHz 20 dBm (SLWRB4180A)
  vendor: silabs
  socs:
    - name: efr32mg21a020f1024im32
```

## boards/silabs/radio_boards/slwrb4180b/Kconfig.defconfig
```kconfig
# Copyright (c) 2020 Piotr Mienkowski
# Copyright (c) 2020 TriaGnoSys GmbH
# SPDX-License-Identifier: Apache-2.0

if BOARD_SLWRB4180B

config LOG_BACKEND_SWO_FREQ_HZ
	default 875000
	depends on LOG_BACKEND_SWO

if SOC_GECKO_USE_RAIL

config FPU
	default y

endif # SOC_GECKO_USE_RAIL

endif # BOARD_SLWRB4180B
```

## boards/silabs/radio_boards/slwrb4180b/Kconfig.slwrb4180b
```kconfig
# Copyright (c) 2024 Capgemini
# SPDX-License-Identifier: Apache-2.0

config BOARD_SLWRB4180B
	select SOC_PART_NUMBER_EFR32MG21A020F1024IM32
```

## boards/silabs/radio_boards/slwrb4180b/board.yml
```yaml
board:
  name: slwrb4180b
  full_name: EFR32xG21 2.4 GHz 20 dBm (SLWRB4180B)
  vendor: silabs
  socs:
    - name: efr32mg21a020f1024im32
```

## boards/silabs/radio_boards/slwrb4250b/Kconfig.slwrb4250b
```kconfig
# Copyright (c) 2020 Piotr Mienkowski
# Copyright (c) 2020 TriaGnoSys GmbH
# SPDX-License-Identifier: Apache-2.0

config BOARD_SLWRB4250B
	select SOC_EFR32FG1P133F256GM48
```

## boards/silabs/radio_boards/slwrb4250b/board.yml
```yaml
board:
  name: slwrb4250b
  full_name: EFR32FG1 2400/868 MHz 13 dBm Dual Band (SLWRB4250B)
  vendor: silabs
  socs:
    - name: efr32fg1p133f256gm48
```

## boards/silabs/radio_boards/slwrb4255a/Kconfig.defconfig
```kconfig
# EFR32 radio board

# Copyright (c) 2020 Piotr Mienkowski
# Copyright (c) 2020 TriaGnoSys GmbH
# SPDX-License-Identifier: Apache-2.0

if BOARD_SLWRB4255A

config CMU_HFXO_FREQ
	default 38400000

config CMU_LFXO_FREQ
	default 32768

config FLASH_BASE_ADDRESS
	hex
	default 0x0

config LOG_BACKEND_SWO_FREQ_HZ
	default 875000
	depends on LOG_BACKEND_SWO

if SOC_GECKO_USE_RAIL

config FPU
	default n

endif # SOC_GECKO_USE_RAIL

if BT

config FPU
	default y

config COMMON_LIBC_MALLOC_ARENA_SIZE
	default 8192

config MAIN_STACK_SIZE
	default 3072 if PM
	default 2304

endif # BT

endif # BOARD_SLWRB4255A
```

## boards/silabs/radio_boards/slwrb4255a/Kconfig.slwrb4255a
```kconfig
# Copyright (c) 2020 Piotr Mienkowski
# Copyright (c) 2020 TriaGnoSys GmbH
# SPDX-License-Identifier: Apache-2.0

config BOARD_SLWRB4255A
	select SOC_PART_NUMBER_EFR32FG13P233F512GM48
```

## boards/silabs/radio_boards/slwrb4255a/board.yml
```yaml
boards:
  - name: slwrb4255a
    full_name: EFR32FG13 2400/915 MHz 19 dBm Dual Band (SLWRB4255A)
    socs:
      - name: efr32fg13p233f512gm48
```

## boards/silabs/radio_boards/slwrb4321a/Kconfig.defconfig
```kconfig
# Copyright (c) 2019 Interay Solutions B.V.
# Copyright (c) 2019 Oane Kingma
# Copyright (c) 2020 Thorvald Natvig
# SPDX-License-Identifier: Apache-2.0

if BOARD_SLWRB4321A

config LOG_BACKEND_SWO_FREQ_HZ
	default 875000
	depends on LOG_BACKEND_SWO

configdefault NET_L2_ETHERNET
	default y

endif # BOARD_SLWRB4321A
```

## boards/silabs/radio_boards/slwrb4321a/Kconfig.slwrb4321a
```kconfig
# Copyright (c) 2019 Interay Solutions B.V.
# Copyright (c) 2019 Oane Kingma
# Copyright (c) 2020 Thorvald Natvig
# SPDX-License-Identifier: Apache-2.0

config BOARD_SLWRB4321A
	select SOC_PART_NUMBER_EFM32GG11B820F2048GM64
```

## boards/silabs/radio_boards/slwrb4321a/board.yml
```yaml
board:
  name: slwrb4321a
  full_name: WGM160P Wi-Fi Module (SLWRB4321A)
  vendor: silabs
  socs:
  - name: efm32gg11b820f2048gm64
```

## boards/silabs/radio_boards/slwrb4321a/slwrb4321a_defconfig
```kconfig
# Copyright (c) 2019 Interay Solutions B.V.
# Copyright (c) 2019 Oane Kingma
# Copyright (c) 2020 Thorvald Natvig
# SPDX-License-Identifier: Apache-2.0

CONFIG_ARM_MPU=y
CONFIG_CONSOLE=y
CONFIG_UART_CONSOLE=y
CONFIG_SERIAL=y
CONFIG_GPIO=y
CONFIG_SYS_CLOCK_HW_CYCLES_PER_SEC=72000000
CONFIG_CMU_HFCLK_HFRCO=y
CONFIG_SOC_GECKO_EMU_DCDC=y
CONFIG_SOC_GECKO_EMU_DCDC_MODE_ON=y
```

## boards/silabs/radio_boards/xg22/Kconfig.slwrb4182a
```kconfig
# Copyright (c) 2025 Silicon Laboratories Inc.
# SPDX-License-Identifier: Apache-2.0

config BOARD_SLWRB4182A
	select SOC_EFR32MG22C224F512IM40
```

## boards/silabs/radio_boards/xg22/Kconfig.slwrb4311a
```kconfig
# Copyright (c) 2025 Silicon Laboratories Inc.
# SPDX-License-Identifier: Apache-2.0

config BOARD_SLWRB4311A
	select SOC_BGM220PC22HNA
```

## boards/silabs/radio_boards/xg23_rb4210a/Kconfig.defconfig
```kconfig
# Copyright (c) 2024 Yishai Jaffe
# SPDX-License-Identifier: Apache-2.0

if BOARD_XG23_RB4210A

config CMU_HFXO_FREQ
	default 39000000

config CMU_LFXO_FREQ
	default 32768

config LOG_BACKEND_SWO_FREQ_HZ
	default 875000
	depends on LOG_BACKEND_SWO

if SOC_GECKO_USE_RAIL

config FPU
	default y

endif # SOC_GECKO_USE_RAIL

endif # BOARD_XG23_RB4210A
```
