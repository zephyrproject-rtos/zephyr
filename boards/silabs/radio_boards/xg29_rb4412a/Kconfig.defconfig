## boards/silabs/radio_boards/xg29_rb4412a/Kconfig.defconfig
```kconfig
# Copyright (c) 2025 Silicon Laboratories Inc.
# SPDX-License-Identifier: Apache-2.0

if BOARD_XG29_RB4412A

config LOG_BACKEND_SWO_FREQ_HZ
	default 875000
	depends on LOG_BACKEND_SWO

if SOC_GECKO_USE_RAIL

config FPU
	default y

endif # SOC_GECKO_USE_RAIL

if BT

config FPU
	default y

config COMMON_LIBC_MALLOC_ARENA_SIZE
	default 8192

config MAIN_STACK_SIZE
	default 3072 if PM
	default 2304

endif # BT

endif # BOARD_XG29_RB4412A
```

## boards/silabs/radio_boards/xg29_rb4412a/Kconfig.xg29_rb4412a
```kconfig
# Copyright (c) 2025 Silicon Laboratories Inc.
# SPDX-License-Identifier: Apache-2.0

config BOARD_XG29_RB4412A
	select SOC_PART_NUMBER_EFR32MG29B140F1024IM40
```

## boards/silabs/radio_boards/xg29_rb4412a/board.yml
```yaml
board:
  name: xg29_rb4412a
  full_name: EFR32xG29 2.4 GHz 8 dBm Buck (xG29-RB4412A)
  vendor: silabs
  socs:
    - name: efr32mg29b140f1024im40
```

## boards/silabs/radio_boards/xg29_rb4412a/xg29_rb4412a_defconfig
```kconfig
# SPDX-License-Identifier: Apache-2.0

CONFIG_ARM_MPU=y
CONFIG_CONSOLE=y
CONFIG_UART_CONSOLE=y
CONFIG_SERIAL=y
CONFIG_GPIO=y
```

## boards/silabs/starter_kits/efm32pg_stk3401a/board.yml
```yaml
board:
  name: efm32pg_stk3401a
  vendor: silabs
  socs:
  - name: efm32pg1b200f256gm48
```

## boards/silabs/starter_kits/efm32tg_stk3300/Kconfig.efm32tg_stk3300
```kconfig
# Copyright (c) 2025, Lukas Woodtli
# SPDX-License-Identifier: Apache-2.0

config BOARD_EFM32TG_STK3300
	select SOC_EFM32TG840F32
```

## boards/silabs/starter_kits/efm32tg_stk3300/board.yml
```yaml
board:
  name: efm32tg_stk3300
  full_name: EFM32 Tiny Gecko (EFM32TG-STK3300)
  vendor: silabs
  socs:
  - name: efm32tg840f32
```

## boards/silabs/starter_kits/efm32tg_stk3300/efm32tg_stk3300_defconfig
```kconfig
# Copyright (c) 2025, Lukas Woodtli
# SPDX-License-Identifier: Apache-2.0

CONFIG_ARM_MPU=n
CONFIG_CONSOLE=y
CONFIG_UART_CONSOLE=y
CONFIG_SERIAL=y
CONFIG_GPIO=y
CONFIG_CMU_HFCLK_HFXO=y
```

## boards/silabs/starter_kits/efm32wg_stk3800/Kconfig.efm32wg_stk3800
```kconfig
# Copyright (c) 2017, Christian Taedcke
# SPDX-License-Identifier: Apache-2.0

config BOARD_EFM32WG_STK3800
	select SOC_EFM32WG990F256
```

## boards/silabs/starter_kits/efm32wg_stk3800/board.yml
```yaml
board:
  name: efm32wg_stk3800
  full_name: EFM32 Wonder Gecko (EFM32WG-STK3800)
  vendor: silabs
  socs:
  - name: efm32wg990f256
```

## boards/silabs/starter_kits/slstk3400a/Kconfig.defconfig
```kconfig
# Copyright (c) 2018, Marcio Montenegro
# SPDX-License-Identifier: Apache-2.0

if BOARD_SLSTK3400A

config CMU_HFXO_FREQ
	default 24000000

config CMU_LFXO_FREQ
	default 32768

# Kernel Options due to Low Memory (8k)

configdefault MAIN_STACK_SIZE
	default 640

configdefault IDLE_STACK_SIZE
	default 200

configdefault ISR_STACK_SIZE
	default 512

endif # BOARD_SLSTK3400A
```

## boards/silabs/starter_kits/slstk3400a/Kconfig.slstk3400a
```kconfig
# Copyright (c) 2018, Marcio Montenegro
# SPDX-License-Identifier: Apache-2.0

config BOARD_SLSTK3400A
	select SOC_EFM32HG322F64
```

## boards/silabs/starter_kits/slstk3400a/board.yml
```yaml
board:
  name: slstk3400a
  full_name: EFM32 Happy Gecko (SLSTK3400A)
  vendor: silabs
  socs:
  - name: efm32hg322f64
```

## boards/silabs/starter_kits/slstk3400a/slstk3400a_defconfig
```kconfig
# SPDX-License-Identifier: Apache-2.0

CONFIG_CONSOLE=y
CONFIG_UART_CONSOLE=y
CONFIG_SERIAL=y
CONFIG_GPIO=y
CONFIG_SYS_CLOCK_HW_CYCLES_PER_SEC=24000000
CONFIG_CMU_HFCLK_HFXO=y

# Kernel Options due to Low Memory (8k)
CONFIG_MAIN_STACK_SIZE=640
CONFIG_IDLE_STACK_SIZE=200
CONFIG_ISR_STACK_SIZE=512
```

## boards/silabs/starter_kits/slstk3401a/Kconfig.slstk3401a
```kconfig
# EFM32PG SLSTK3401A board

# Copyright (c) 2020, Rafael Dias Menezes <rdmeneze@gmail.com>
# SPDX-License-Identifier: Apache-2.0

config BOARD_SLSTK3401A
	select SOC_PART_NUMBER_EFM32PG1B200F256GM48
```

## boards/silabs/starter_kits/slstk3401a/board.yml
```yaml
board:
  name: slstk3401a
  full_name: EFM32 Pearl Gecko (SLSTK3401A)
  vendor: silabs
  socs:
  - name: efm32pg1b200f256gm48
```

## boards/silabs/starter_kits/slstk3402a/Kconfig.slstk3402a
```kconfig
# Copyright (c) 2018, Christian Taedcke
# Copyright (c) 2019  Lemonbeat GmbH
# SPDX-License-Identifier: Apache-2.0

config BOARD_SLSTK3402A
	select SOC_PART_NUMBER_EFM32PG12B500F1024GL125 if BOARD_SLSTK3402A_EFM32PG12B500F1024GL125
	select SOC_PART_NUMBER_EFM32JG12B500F1024GL125 if BOARD_SLSTK3402A_EFM32JG12B500F1024GL125
```

## boards/silabs/starter_kits/slstk3402a/board.yml
```yaml
board:
  name: slstk3402a
  full_name: EFM32 Pearl Gecko 12 (SLSTK3402A)
  vendor: silabs
  socs:
  - name: efm32pg12b500f1024gl125
  - name: efm32jg12b500f1024gl125
```

## boards/silabs/starter_kits/slstk3402a/slstk3402a_efm32pg12b500f1024gl125_defconfig
```kconfig
# SPDX-License-Identifier: Apache-2.0

CONFIG_ARM_MPU=y
CONFIG_CONSOLE=y
CONFIG_UART_CONSOLE=y
CONFIG_SERIAL=y
CONFIG_GPIO=y
CONFIG_SYS_CLOCK_HW_CYCLES_PER_SEC=40000000
CONFIG_CMU_HFCLK_HFXO=y
```

## boards/silabs/starter_kits/slstk3701a/Kconfig.defconfig
```kconfig
# Copyright (c) 2019 Interay Solutions B.V.
# Copyright (c) 2019 Oane Kingma
# SPDX-License-Identifier: Apache-2.0

if BOARD_SLSTK3701A

config LOG_BACKEND_SWO_FREQ_HZ
	default 875000
	depends on LOG_BACKEND_SWO

configdefault NET_L2_ETHERNET
	default y

endif # BOARD_SLSTK3701A
```

## boards/silabs/starter_kits/slstk3701a/Kconfig.slstk3701a
```kconfig
# Copyright (c) 2019 Interay Solutions B.V.
# Copyright (c) 2019 Oane Kingma
# SPDX-License-Identifier: Apache-2.0

config BOARD_SLSTK3701A
	select SOC_PART_NUMBER_EFM32GG11B820F2048GL192
```
