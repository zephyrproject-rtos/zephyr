## boards/silabs/radio_boards/xg23_rb4210a/Kconfig.xg23_rb4210a
```kconfig
# Copyright (c) 2024 Yishai Jaffe
# SPDX-License-Identifier: Apache-2.0

config BOARD_XG23_RB4210A
	select SOC_EFR32ZG23B020F512IM48
```

## boards/silabs/radio_boards/xg23_rb4210a/board.yml
```yaml
board:
  name: xg23_rb4210a
  full_name: EFR32xG23 868-915 MHz 20 dBm (xG23-RB4210A)
  vendor: silabs
  socs:
    - name: efr32zg23b020f512im48
```

## boards/silabs/radio_boards/xg24/Kconfig.defconfig
```kconfig
# Copyright (c) 2020 Piotr Mienkowski
# Copyright (c) 2020 TriaGnoSys GmbH
# Copyright (c) 2025 Silicon Laboratories Inc.
# SPDX-License-Identifier: Apache-2.0

if BOARD_XG24_RB4186C || BOARD_XG24_RB4187C || BOARD_XGM240_RB4316A || BOARD_XGM240_RB4317A

config LOG_BACKEND_SWO_FREQ_HZ
	default 875000
	depends on LOG_BACKEND_SWO

config FPU
	default y if SOC_GECKO_USE_RAIL || BT

if BT

config MAIN_STACK_SIZE
	default 3072 if PM
	default 2304

endif # BT

endif
```

## boards/silabs/radio_boards/xg24/Kconfig.xg24_rb4186c
```kconfig
# Copyright (c) 2025 Silicon Laboratories Inc.
# SPDX-License-Identifier: Apache-2.0

config BOARD_XG24_RB4186C
	select SOC_EFR32MG24B210F1536IM48
```

## boards/silabs/radio_boards/xg24/Kconfig.xg24_rb4187c
```kconfig
# Copyright (c) 2020 Piotr Mienkowski
# Copyright (c) 2020 TriaGnoSys GmbH
# SPDX-License-Identifier: Apache-2.0

config BOARD_XG24_RB4187C
	select SOC_EFR32MG24B220F1536IM48
```

## boards/silabs/radio_boards/xg24/Kconfig.xgm240_rb4317a
```kconfig
# Copyright (c) 2025 Silicon Laboratories Inc.
# SPDX-License-Identifier: Apache-2.0

config BOARD_XGM240_RB4317A
	select SOC_MGM240PB32VNA
```

## boards/silabs/radio_boards/xg24_rb4187c/Kconfig.defconfig
```kconfig
# EFR32 radio board

# Copyright (c) 2020 Piotr Mienkowski
# Copyright (c) 2020 TriaGnoSys GmbH
# SPDX-License-Identifier: Apache-2.0

if BOARD_XG24_RB4187C

config CMU_HFXO_FREQ
	default 39000000

config CMU_LFXO_FREQ
	default 32768

config FLASH_BASE_ADDRESS
	hex
	default 0x08000000

config LOG_BACKEND_SWO_FREQ_HZ
	default 875000
	depends on LOG_BACKEND_SWO

if SOC_GECKO_USE_RAIL

config FPU
	default y

endif # SOC_GECKO_USE_RAIL

if BT

config FPU
	default y

config COMMON_LIBC_MALLOC_ARENA_SIZE
	default 8192

config MAIN_STACK_SIZE
	default 3072 if PM
	default 2304

endif # BT

endif # BOARD_XG24_RB4187C
```

## boards/silabs/radio_boards/xg24_rb4187c/board.yml
```yaml
boards:
  - name: xg24_rb4187c
    full_name: EFR32xG24 2.4 GHz 20 dBm (xG24-RB4187C)
    socs:
      - name: efr32mg24b220f1536im48
```

## boards/silabs/radio_boards/xg24_rb4187c/xg24_rb4187c_defconfig
```kconfig
# SPDX-License-Identifier: Apache-2.0

CONFIG_ARM_MPU=y
CONFIG_CONSOLE=y
CONFIG_UART_CONSOLE=y
CONFIG_SERIAL=y
CONFIG_GPIO=y
CONFIG_SOC_GECKO_EMU_DCDC=y
CONFIG_SOC_GECKO_EMU_DCDC_MODE_ON=y
CONFIG_PINCTRL=y
```

## boards/silabs/radio_boards/xg26/Kconfig.defconfig
```kconfig
# Copyright The Zephyr Project Contributors
# SPDX-License-Identifier: Apache-2.0

if BOARD_XG26_RB4118A || BOARD_XG26_RB4120A || BOARD_MGM260P_RB4350A

config LOG_BACKEND_SWO_FREQ_HZ
	default 875000
	depends on LOG_BACKEND_SWO

config FPU
	default y if SOC_GECKO_USE_RAIL || BT

if BT

config MAIN_STACK_SIZE
	default 3072 if PM
	default 2304

endif # BT

endif
```

## boards/silabs/radio_boards/xg26/Kconfig.mgm260p_rb4350a
```kconfig
# Copyright The Zephyr Project Contributors
# SPDX-License-Identifier: Apache-2.0

config BOARD_MGM260P_RB4350A
	select SOC_MGM260PD22VNA
```

## boards/silabs/radio_boards/xg26/Kconfig.xg26_rb4118a
```kconfig
# Copyright The Zephyr Project Contributors
# SPDX-License-Identifier: Apache-2.0

config BOARD_XG26_RB4118A
	select SOC_EFR32MG26B510F3200IL136
```

## boards/silabs/radio_boards/xg26/Kconfig.xg26_rb4120a
```kconfig
# Copyright The Zephyr Project Contributors
# SPDX-License-Identifier: Apache-2.0

config BOARD_XG26_RB4120A
	select SOC_EFR32MG26B510F3200IM68
```

## boards/silabs/radio_boards/xg26/Kconfig.xg26_rb4121a
```kconfig
# Copyright (c) 2026 Hong Nguyen
# SPDX-License-Identifier: Apache-2.0

config BOARD_XG26_RB4121A
	select SOC_EFR32MG26B420F3200IM68
```

## boards/silabs/radio_boards/xg26/board.yml
```yaml
boards:
  - name: mgm260p_rb4350a
    full_name: MGM260P 2.4 GHz +10 dBm Radio Board
    vendor: silabs
    socs:
      - name: mgm260pd22vna
  - name: xg26_rb4118a
    full_name: EFR32xG26 2.4 GHz +10 dBm BGA136 Radio Board
    vendor: silabs
    socs:
      - name: efr32mg26b510f3200il136
  - name: xg26_rb4120a
    full_name: EFR32xG26 2.4 GHz +10 dBm Radio Board
    vendor: silabs
    socs:
      - name: efr32mg26b510f3200im68
  - name: xg26_rb4121a
    full_name: EFR32xG26 2.4 GHz +20 dBm Radio Board
    vendor: silabs
    socs:
      - name: efr32mg26b420f3200im68
```

## boards/silabs/radio_boards/xg27/Kconfig.bg27_rb4111b
```kconfig
# Copyright (c) 2025 Silicon Laboratories Inc.
# SPDX-License-Identifier: Apache-2.0

config BOARD_BG27_RB4111B
	select SOC_EFR32BG27C320F768GJ39
```

## boards/silabs/radio_boards/xg27/Kconfig.defconfig
```kconfig
# Copyright (c) 2025 Silicon Laboratories Inc.
# SPDX-License-Identifier: Apache-2.0

if BOARD_XG27_RB4194A || BOARD_BG27_RB4110B || BOARD_BG27_RB4111B

config LOG_BACKEND_SWO_FREQ_HZ
	default 875000
	depends on LOG_BACKEND_SWO

config FPU
	default y if SOC_GECKO_USE_RAIL || BT

if BT

config MAIN_STACK_SIZE
	default 3072 if PM
	default 2304

endif # BT

endif
```

## boards/silabs/radio_boards/xg27/Kconfig.xg27_rb4194a
```kconfig
# Copyright (c) 2025 Silicon Laboratories Inc.
# SPDX-License-Identifier: Apache-2.0

config BOARD_XG27_RB4194A
	select SOC_EFR32MG27C140F768IM40
```

## boards/silabs/radio_boards/xg27/board.yml
```yaml
boards:
  - name: bg27_rb4110b
    full_name: EFR32BG27 2.4 GHz 4 dBm DCDC Buck CSP (BG27-RB4110B)
    vendor: silabs
    socs:
      - name: efr32bg27c320f768gj39
  - name: bg27_rb4111b
    full_name: EFR32BG27 2.4 GHz 4 dBm DCDC Boost CSP (BG27-RB4111B)
    vendor: silabs
    socs:
      - name: efr32bg27c320f768gj39
  - name: xg27_rb4194a
    full_name: EFR32xG27 2.4 GHz 8 dBm (xG27-RB4194A)
    vendor: silabs
    socs:
      - name: efr32mg27c140f768im40
```

## boards/silabs/radio_boards/xg27_rb4194a/Kconfig.xg27_rb4194a
```kconfig
# EFR32MG27 BRD4194A

# Copyright (c) 2024 EMEA Central FAEs
# SPDX-License-Identifier: Apache-2.0

config BOARD_XG27_RB4194A
	select SOC_PART_NUMBER_EFR32BG27C140F768IM40
```

## boards/silabs/radio_boards/xg28_rb4401c/Kconfig.defconfig
```kconfig
# Copyright (c) 2025 Shontal Biton
# SPDX-License-Identifier: Apache-2.0

if BOARD_XG28_RB4401C

config LOG_BACKEND_SWO_FREQ_HZ
	default 875000
	depends on LOG_BACKEND_SWO

if SOC_GECKO_USE_RAIL

config FPU
	default y

endif # SOC_GECKO_USE_RAIL

endif # BOARD_XG28_RB4401C
```

## boards/silabs/radio_boards/xg28_rb4401c/Kconfig.xg28_rb4401c
```kconfig
# Copyright (c) 2025 Shontal Biton
# SPDX-License-Identifier: Apache-2.0

config BOARD_XG28_RB4401C
	select SOC_EFR32ZG28B322F1024IM68
```

## boards/silabs/radio_boards/xg28_rb4401c/board.yml
```yaml
board:
  name: xg28_rb4401c
  full_name: EFR32xG28 868-915 MHz 20 dBm (xG28-RB4401C)
  vendor: silabs
  socs:
    - name: efr32zg28b322f1024im68
```

## boards/silabs/radio_boards/xg29/Kconfig.bg29_rb4420a
```kconfig
# Copyright (c) 2025 Silicon Laboratories Inc.
# SPDX-License-Identifier: Apache-2.0

config BOARD_BG29_RB4420A
	select SOC_EFR32BG29B220F1024CJ45
```
