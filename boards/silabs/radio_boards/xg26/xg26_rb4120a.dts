/*
 * Copyright (c) 2025 Silicon Laboratories Inc.
 *
 * SPDX-License-Identifier: Apache-2.0
 */

/dts-v1/;
#include <silabs/xg26/efr32mg26b510f3200im68.dtsi>
#include "xg26_rb41xxa.dtsi"

/ {
	model = "Silicon Labs EFR32xG26 2.4 GHz +10 dBm Radio Board (xG26-RB4120A, BRD4120A)";
	compatible = "silabs,xg26_rb4120a", "silabs,efr32mg26";
};
