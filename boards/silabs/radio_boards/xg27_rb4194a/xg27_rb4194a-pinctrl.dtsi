/*
 * Copyright (c) 2024 EMEA Central FAEs
 *
 * SPDX-License-Identifier: Apache-2.0
 */

#include <arm/silabs/gpio_gecko.h>
#include <dt-bindings/pinctrl/gecko-pinctrl.h>

&pinctrl {
	usart1_default: usart1_default {
		group1 {
			psels = <GECKO_PSEL(UART_TX, A, 5)>,
				<GECKO_PSEL(UART_RX, A, 6)>,
				<GECKO_LOC(UART, 0)>;
		};
	};
};
