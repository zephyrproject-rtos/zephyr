## boards/silabs/radio_boards/xg29/Kconfig.xg29_rb4413a
```kconfig
# Copyright (c) 2025 Silicon Laboratories Inc.
# SPDX-License-Identifier: Apache-2.0

config BOARD_XG29_RB4413A
	select SOC_EFR32MG29B230F1024CM40
```

## boards/silabs/radio_boards/xg29/board.yml
```yaml
# Copyright The Zephyr Project Contributors
# SPDX-License-Identifier: Apache-2.0

boards:
  - name: bg29_rb4420a
    full_name: EFR32BG29 Bluetooth LE 4 dBm DCDC Boost WLCSP (BG29-RB4420A)
    vendor: silabs
    socs:
      - name: efr32bg29b220f1024cj45
  - name: xg29_rb4412a
    full_name: EFR32xG29 2.4 GHz 8 dBm Buck (xG29-RB4412A)
    vendor: silabs
    socs:
      - name: efr32mg29b140f1024im40
  - name: xg29_rb4413a
    full_name: EFR32xG29 2.4 GHz 6 dBm Boost QFN40 (xG29-RB4413A)
    vendor: silabs
    socs:
      - name: efr32mg29b230f1024cm40
```

## boards/silabs/radio_boards/xg29_rb4413a/board.yml
```yaml
board:
  name: xg29_rb4413a
  full_name: EFR32xG29 2.4 GHz 6 dBm Boost QFN40 (xG29-RB4413A)
  vendor: silabs
  socs:
    - name: efr32mg29b230f1024cm40
```

## boards/silabs/simg301_ek2719a/Kconfig.simg301_ek2719a
```kconfig
# Copyright (c) 2026 Silicon Laboratories Inc.
# SPDX-License-Identifier: Apache-2.0

config BOARD_SIMG301_EK2719A
	select SOC_SIMG301M104LIL
```

## boards/silabs/simg301_ek2719a/board.yml
```yaml
boards:
  - name: simg301_ek2719a
    full_name: SixG301 Explorer Kit (BRD2719A)
    vendor: silabs
    socs:
      - name: simg301m104lil
```

## boards/sipeed/m1s_dock/Kconfig.m1s_dock
```kconfig
# Copyright The Zephyr Project Contributors
#
# SPDX-License-Identifier: Apache-2.0

config BOARD_M1S_DOCK
	select SOC_BL808C09Q2I
	select SOC_BL808C09Q2I_M0 if BOARD_M1S_DOCK_BL808C09Q2I_M0
	select SOC_BL808C09Q2I_D0 if BOARD_M1S_DOCK_BL808C09Q2I_D0
	select SOC_BL808C09Q2I_LP if BOARD_M1S_DOCK_BL808C09Q2I_LP
```

## boards/sipeed/tang_mega_138k_pro/Kconfig.defconfig
```kconfig
# SPDX-FileCopyrightText: Copyright (c) 2026 TOKITA Hiroshi
# SPDX-License-Identifier: Apache-2.0

DT_AE350_MTIMER_PATH := $(dt_nodelabel_path,mtimer)

config XIP
	default y
```

## boards/sipeed/tang_mega_138k_pro/Kconfig.tang_mega_138k_pro
```kconfig
# SPDX-FileCopyrightText: Copyright (c) 2026 TOKITA Hiroshi
# SPDX-License-Identifier: Apache-2.0

config BOARD_TANG_MEGA_138K_PRO
	select SOC_AE350
```

## boards/sipeed/tang_mega_138k_pro/board.yml
```yaml
board:
  name: tang_mega_138k_pro
  full_name: Tang Mega 138K Pro Dock
  vendor: sipeed
  socs:
    - name: ae350
      variants:
        - name: demo
```

## boards/sipeed/tang_mega_138k_pro/tang_mega_138k_pro_ae350_demo_defconfig
```kconfig
CONFIG_BUILD_OUTPUT_BIN=y
CONFIG_USE_DT_CODE_PARTITION=y
CONFIG_PMP_SLOTS=16
CONFIG_PMP_NO_LOCK_GLOBAL=y

CONFIG_CONSOLE=y
CONFIG_UART_CONSOLE=y
CONFIG_SERIAL=y
CONFIG_GPIO=y
```

## boards/sipeed/tang_mega_138k_pro_dock/Kconfig.defconfig
```kconfig
# SPDX-FileCopyrightText: Copyright (c) 2026 TOKITA Hiroshi
# SPDX-License-Identifier: Apache-2.0

config XIP
	default y
```

## boards/sipeed/tang_mega_138k_pro_dock/board.yml
```yaml
board:
  name: tang_mega_138k_pro_dock
  full_name: Tang Mega 138K Pro Dock
  vendor: sipeed
  socs:
    - name: ae350_a25
      variants:
        - name: demo
```

## boards/sipeed/tang_mega_138k_pro_dock/tang_mega_138k_pro_dock_ae350_25_defconfig
```kconfig
CONFIG_BUILD_OUTPUT_BIN=y
CONFIG_USE_DT_CODE_PARTITION=y
CONFIG_PMP_SLOTS=16
CONFIG_PMP_NO_LOCK_GLOBAL=y
```

## boards/sparkfun/redboard_artemis/Kconfig.defconfig
```kconfig
# SPDX-FileCopyrightText: Copyright The Zephyr Project Contributors
# SPDX-License-Identifier: Apache-2.0

if BOARD_SPARKFUN_REDBOARD_ARTEMIS

config USE_DT_CODE_PARTITION
	default y

endif # BOARD_SPARKFUN_REDBOARD_ARTEMIS
```

## boards/sparkfun/redboard_artemis/Kconfig.sparkfun_redboard_artemis
```kconfig
# SPDX-FileCopyrightText: Copyright The Zephyr Project Contributors
# SPDX-License-Identifier: Apache-2.0

config BOARD_SPARKFUN_REDBOARD_ARTEMIS
	select SOC_APOLLO3_BLUE
```

## boards/sparkfun/redboard_artemis/board.yml
```yaml
# SPDX-FileCopyrightText: Copyright The Zephyr Project Contributors
# SPDX-License-Identifier: Apache-2.0

board:
  name: sparkfun_redboard_artemis
  full_name: RedBoard Artemis
  vendor: sparkfun
  socs:
  - name: apollo3_blue
```

## boards/sparkfun/rp2040_mikrobus/Kconfig.defconfig
```kconfig
# SPDX-FileCopyrightText: Copyright (c) 2026 Navimatix GmbH
# SPDX-FileCopyrightText: Copyright (c) 2026 TiaC Systems
# SPDX-License-Identifier: Apache-2.0

if BOARD_SPARKFUN_RP2040_MIKROBUS

if I2C_DW

config I2C_DW_CLOCK_SPEED
	default 125

endif # I2C_DW

endif # BOARD_SPARKFUN_RP2040_MIKROBUS
```

## boards/st/b_u585i_iot02a/b_u585i_iot02a_stm32u585xx_ext_flash_app_defconfig
```kconfig
# SPDX-License-Identifier: Apache-2.0

# enable uart driver
CONFIG_SERIAL=y

# console
CONFIG_CONSOLE=y
CONFIG_UART_CONSOLE=y

# Enable the MemoryMapped mode
CONFIG_MSPI_MEMMAP=y
```

## boards/st/nucleo_f429zi/Kconfig.defconfig
```kconfig
# NUCLEO-144 F429ZI board configuration

# Copyright (c) 2017 Linaro Limited
# SPDX-License-Identifier: Apache-2.0

if BOARD_NUCLEO_F429ZI

configdefault ETH_DRIVER
	default y

endif # BOARD_NUCLEO_F429ZI
```

## boards/st/nucleo_f746zg/Kconfig.defconfig
```kconfig
# STM32F746ZG Nucleo board configuration

# Copyright (c) 2018 AJ Palmer
# SPDX-License-Identifier: Apache-2.0

if BOARD_NUCLEO_F746ZG

configdefault ETH_DRIVER
	default y

endif # BOARD_NUCLEO_F746ZG
```

## boards/st/nucleo_f756zg/Kconfig.defconfig
```kconfig
# STM32F756ZG Nucleo board configuration

# Copyright (c) 2018 AJ Palmer
# SPDX-License-Identifier: Apache-2.0

if BOARD_NUCLEO_F756ZG

configdefault ETH_DRIVER
	default y

endif # BOARD_NUCLEO_F756ZG
```

## boards/st/nucleo_f767zi/Kconfig.defconfig
```kconfig
# STM32F767ZI Nucleo board configuration

# Copyright (c) 2019 Roland Ma
# SPDX-License-Identifier: Apache-2.0

if BOARD_NUCLEO_F767ZI

configdefault ETH_DRIVER
	default y

endif # BOARD_NUCLEO_F767ZI
```

## boards/st/nucleo_g564re/Kconfig.nucleo_g564re
```kconfig
# Copyright (c) 2026 STMicroelectronics
# SPDX-License-Identifier: Apache-2.0

config BOARD_NUCLEO_G564RE
	select SOC_STM32G564XX
```

## boards/st/nucleo_g564re/board.yml
```yaml
board:
  name: nucleo_g564re
  full_name: Nucleo G564RE
  vendor: st
  socs:
    - name: stm32g564xx
```

## boards/st/nucleo_h5e5zj/Kconfig.nucleo_h5e5zj
```kconfig
# SPDX-FileCopyrightText: Copyright The Zephyr Project Contributors
# SPDX-License-Identifier: Apache-2.0

config BOARD_NUCLEO_H5E5ZJ
	select SOC_STM32H5E5XX
```
