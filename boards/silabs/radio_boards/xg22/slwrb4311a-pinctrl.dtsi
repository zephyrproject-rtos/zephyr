/*
 * Copyright (c) 2025 Silicon Laboratories Inc.
 *
 * SPDX-License-Identifier: Apache-2.0
 */

#include <zephyr/dt-bindings/pinctrl/silabs/xg22-pinctrl.h>

&pinctrl {
	timer0_default: timer0_default {
		group0 {
			pins = <TIMER0_CC0_PB0>, <TIMER0_CC1_PB1>;
			drive-push-pull;
			output-high;
		};
	};
};
