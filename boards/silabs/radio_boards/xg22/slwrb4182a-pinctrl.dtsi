/*
 * Copyright (c) 2025 Silicon Laboratories Inc.
 *
 * SPDX-License-Identifier: Apache-2.0
 */

#include <zephyr/dt-bindings/pinctrl/silabs/xg22-pinctrl.h>

&pinctrl {
	timer0_default: timer0_default {
		group0 {
			pins = <TIMER0_CC0_PD2>, <TIMER0_CC1_PD3>;
			drive-push-pull;
			output-low;
		};
	};
};
