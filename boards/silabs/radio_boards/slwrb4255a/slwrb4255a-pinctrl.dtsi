/*
 * Copyright (c) 2022 Silicon Labs
 *
 * SPDX-License-Identifier: Apache-2.0
 */

#include <zephyr/dt-bindings/pinctrl/gecko-pinctrl-s1.h>

&pinctrl {
	/* configuration for uart0 device, default state */
	usart0_default: usart0_default {
		group1 {
			/* configure PA.1 as UART_RX */
			psels = <GECKO_PSEL(UART_RX, A, 1)>,
				<GECKO_LOC(UART_RX, 0)>;
		};

		group2 {
			/* configure PA.0 as UART_TX */
			psels = <GECKO_PSEL(UART_TX, A, 0)>,
				<GECKO_LOC(UART_TX, 0)>;
		};
	};
};
