## boards/we/proteus3ev/Kconfig.we_proteus3ev
```kconfig
# Copyright (c) 2022 Nordic Semiconductor ASA
# SPDX-License-Identifier: Apache-2.0

config BOARD_WE_PROTEUS3EV
	select SOC_NRF52840_QIAA
```

## boards/we/proteus3ev/board.yml
```yaml
board:
  name: we_proteus3ev
  full_name: Proteus-III-EV
  vendor: we
  socs:
  - name: nrf52840
```

## boards/weact/blackpill_f401cc/Kconfig.blackpill_f401cc
```kconfig
# Copyright (c) 2022 Linaro Limited
# SPDX-License-Identifier: Apache-2.0

config BOARD_BLACKPILL_F401CC
	select SOC_STM32F401XC
```

## boards/weact/blackpill_f401cc/Kconfig.defconfig
```kconfig
# Copyright (c) 2022 Linaro Limited
# SPDX-License-Identifier: Apache-2.0

# F401CE based Black Pill V3.0+ board board configuration

if BOARD_BLACKPILL_F401CC

config SPI_STM32_INTERRUPT
	default y
	depends on SPI

endif # BOARD_BLACKPILL_F401CC
```

## boards/weact/blackpill_f401cc/board.yml
```yaml
board:
  name: blackpill_f401cc
  full_name: Black Pill V1.2
  vendor: weact
  socs:
    - name: stm32f401xc
```

## boards/weact/blackpill_f401ce/Kconfig.blackpill_f401ce
```kconfig
# Copyright (c) 2020 Kalyan Sriram
# SPDX-License-Identifier: Apache-2.0

config BOARD_BLACKPILL_F401CE
	select SOC_STM32F401XE
```

## boards/weact/blackpill_f401ce/board.yml
```yaml
board:
  name: blackpill_f401ce
  full_name: Black Pill V3.0
  vendor: weact
  socs:
    - name: stm32f401xe
```

## boards/weact/blackpill_f411ce/Kconfig.blackpill_f411ce
```kconfig
# Copyright (c) 2020 Brian Bradley
# SPDX-License-Identifier: Apache-2.0

config BOARD_BLACKPILL_F411CE
	select SOC_STM32F411XE
```

## boards/weact/blackpill_f411ce/Kconfig.defconfig
```kconfig
# Copyright (c) 2020 Brian Bradley
# SPDX-License-Identifier: Apache-2.0

# F411CE based Black Pill V2.0+ board board configuration

if BOARD_BLACKPILL_F411CE

config SPI_STM32_INTERRUPT
	default y
	depends on SPI

endif # BOARD_BLACKPILL_F411CE
```

## boards/weact/blackpill_h523ce/Kconfig.blackpill_h523ce
```kconfig
# Copyright(c) 2025 Filip Stojanovic
# SPDX-License-Identifier: Apache-2.0

config BOARD_BLACKPILL_H523CE
	select SOC_STM32H523XX
```

## boards/weact/blackpill_h523ce/blackpill_h523ce_defconfig
```kconfig
# Copyright(c) 2025 Filip Stojanovic <filipembedded@gmail.com>
# SPDX-License-Identifier: Apache-2.0

# Enable MPU
CONFIG_ARM_MPU=y

# Enable HW stack protection
CONFIG_HW_STACK_PROTECTION=y

# Serial drivers
CONFIG_SERIAL=y
CONFIG_CONSOLE=y
CONFIG_UART_CONSOLE=y

# Enable GPIO
CONFIG_GPIO=y
```

## boards/weact/blackpill_h523ce/board.yml
```yaml
board:
  name: blackpill_h523ce
  full_name: Black Pill STM32H523
  vendor: weact
  socs:
    - name: stm32h523xx
```

## boards/weact/blackpill_u585ci/Kconfig.blackpill_u585ci
```kconfig
# Copyright (c) 2025 Michal Piekos
# SPDX-License-Identifier: Apache-2.0

config BOARD_BLACKPILL_U585CI
	select SOC_STM32U585XX
```

## boards/weact/blackpill_u585ci/board.yml
```yaml
board:
  name: blackpill_u585ci
  full_name: Black Pill STM32U585
  vendor: weact
  socs:
    - name: stm32u585xx
```

## boards/weact/bluepill_stm32f103c8t6/Kconfig.bluepill_stm32f103c8t6
```kconfig
# Copyright (c) 2024 Javad Rahimipetroudi <javad.rahimipetroudi@mind.be>
# SPDX-License-Identifier: Apache-2.0

config BOARD_BLUEPILL_STM32F103C8T6
	select SOC_STM32F103X8
```

## boards/weact/bluepill_stm32f103c8t6/board.yml
```yaml
board:
  name: bluepill_stm32f103c8t6
  vendor: st
  socs:
    - name: stm32f103xb
```

## boards/weact/bluepillplus_ch32v203/Kconfig.bluepillplus_ch32v203
```kconfig
# Copyright (c) 2025 MASSDRIVER EI (massdriver.space)
# SPDX-License-Identifier: Apache-2.0

config BOARD_BLUEPILLPLUS_CH32V203
	select SOC_CH32V203
```

## boards/weact/bluepillplus_ch32v203/board.yml
```yaml
board:
  name: bluepillplus_ch32v203
  full_name: BluePill Plus CH32V203
  vendor: weact
  socs:
    - name: ch32v203
```

## boards/weact/can485dbv1/Kconfig
```kconfig
# WeActStudio CAN485 DevBoard V1 ESP32 configuration

# SPDX-FileCopyrightText: Copyright (c) 2024 Espressif Systems (Shanghai) Co., Ltd.
# SPDX-FileCopyrightText: Copyright (c) 2026 Navimatix GmbH
# SPDX-FileCopyrightText: Copyright (c) 2026 TiaC Systems
# SPDX-License-Identifier: Apache-2.0

config HEAP_MEM_POOL_ADD_SIZE_BOARD
	int
	default 4096 if BOARD_CAN485DBV1_ESP32_PROCPU
	default 256 if BOARD_CAN485DBV1_ESP32_APPCPU
```

## boards/weact/can485dbv1/Kconfig.can485dbv1
```kconfig
# WeActStudio CAN485 DevBoard V1 ESP32 configuration

# SPDX-FileCopyrightText: Copyright (c) 2026 Navimatix GmbH
# SPDX-FileCopyrightText: Copyright (c) 2026 TiaC Systems
# SPDX-License-Identifier: Apache-2.0

config BOARD_CAN485DBV1
	select SOC_ESP32_D0WD_V3
	select SOC_ESP32_PROCPU if BOARD_CAN485DBV1_ESP32_PROCPU
	select SOC_ESP32_APPCPU if BOARD_CAN485DBV1_ESP32_APPCPU
```

## boards/weact/can485dbv1/Kconfig.sysbuild
```kconfig
# WeActStudio CAN485 DevBoard V1 ESP32 system build configuration

# SPDX-FileCopyrightText: Copyright (c) 2024 Espressif Systems (Shanghai) Co., Ltd.
# SPDX-FileCopyrightText: Copyright (c) 2026 Navimatix GmbH
# SPDX-FileCopyrightText: Copyright (c) 2026 TiaC Systems
# SPDX-License-Identifier: Apache-2.0

choice BOOTLOADER
	default BOOTLOADER_MCUBOOT
endchoice

choice BOOT_SIGNATURE_TYPE
	default BOOT_SIGNATURE_TYPE_NONE
endchoice
```

## boards/weact/can485dbv1/board.yml
```yaml
# SPDX-FileCopyrightText: Copyright (c) 2026 Navimatix GmbH
# SPDX-FileCopyrightText: Copyright (c) 2026 TiaC Systems
# SPDX-License-Identifier: Apache-2.0

board:
  name: can485dbv1
  full_name: CAN485 DevBoard V1
  vendor: weact
  socs:
  - name: esp32
```

## boards/weact/can485dbv1/can485dbv1_appcpu_defconfig
```kconfig
# SPDX-FileCopyrightText: Copyright (c) 2026 Navimatix GmbH
# SPDX-FileCopyrightText: Copyright (c) 2026 TiaC Systems
# SPDX-License-Identifier: Apache-2.0

CONFIG_CLOCK_CONTROL=y
```
