## boards/we/ophelia5dk/board.yml
```yaml
board:
  name: ophelia5dk
  full_name: Ophelia-V DK
  vendor: we
  socs:
  - name: nrf54lm20a
    variants:
    - name: ns
      cpucluster: cpuapp
runners:
  run_once:
    '--recover':
    - runners:
      - nrfjprog
      - nrfutil
      run: first
      groups:
      - boards:
        - ophelia5dk/nrf54lm20a/cpuapp
        - ophelia5dk/nrf54lm20a/cpuapp/ns
        - ophelia5dk/nrf54lm20a/cpuflpr
    '--erase':
    - runners:
      - nrfjprog
      - jlink
      - nrfutil
      run: first
      groups:
      - boards:
        - ophelia5dk/nrf54lm20a/cpuapp
        - ophelia5dk/nrf54lm20a/cpuapp/ns
        - ophelia5dk/nrf54lm20a/cpuflpr
    '--reset':
    - runners:
      - nrfjprog
      - jlink
      - nrfutil
      run: last
      groups:
      - boards:
        - ophelia5dk/nrf54lm20a/cpuapp
        - ophelia5dk/nrf54lm20a/cpuapp/ns
        - ophelia5dk/nrf54lm20a/cpuflpr
```

## boards/we/orthosie1ev/Kconfig.sysbuild
```kconfig
# Copyright (c) 2024 Würth Elektronik GmbH & Co. KG
# SPDX-License-Identifier: Apache-2.0

choice BOOTLOADER
	default BOOTLOADER_MCUBOOT
endchoice
```

## boards/weact/mspm0g3507_core/Kconfig.weact_mspm0g3507_core
```kconfig
# Copyright (c) 2025 Texas Instruments
# SPDX-License-Identifier: Apache-2.0

config BOARD_WEACT_MSPM0G3507_CORE
	select SOC_MSPM0G3507
```

## boards/weact/mspm0g3507_core/board.yml
```yaml
board:
  name: weact_mspm0g3507_core
  full_name: MSPM0G3507 Core Board
  vendor: weact
  socs:
    - name: mspm0g3507
```

## boards/weact/rp2350b_core/Kconfig.defconfig
```kconfig
# Copyright (c) 2026 MASSDRIVER EI (massdriver.space
# SPDX-License-Identifier: Apache-2.0

if BOARD_RP2350B_CORE

source "boards/common/usb/Kconfig.cdc_acm_serial.defconfig"

endif # BOARD_RP2350B_CORE
```

## boards/weact/stm32g474_core/Kconfig.weact_stm32g474_core
```kconfig
# Copyright (c) 2026 Pedro Reis
# SPDX-License-Identifier: Apache-2.0

config BOARD_WEACT_STM32G474_CORE
	select SOC_STM32G474XX
```

## boards/weact/stm32g474_core/weact_stm32g474_core_defconfig
```kconfig
CONFIG_GPIO=y
CONFIG_SERIAL=y
CONFIG_CONSOLE=y
CONFIG_UART_CONSOLE=y
CONFIG_CLOCK_CONTROL=y
CONFIG_PINCTRL=y

CONFIG_ARM_MPU=y
CONFIG_HW_STACK_PROTECTION=y
```

## boards/witte/linum/Kconfig.defconfig
```kconfig
# STM32H753ZI Linum board configuration

# Copyright (c) 2024 Felipe Neves
# SPDX-License-Identifier: Apache-2.0

if BOARD_LINUM

configdefault ETH_DRIVER
	default y

endif # BOARD_LINUM
```

## boards/wiznet/w5500_evb_pico2/Kconfig.defconfig
```kconfig
# Copyright (c) 2025 TOKITA Hiroshi
# SPDX-License-Identifier: Apache-2.0

if BOARD_W5500_EVB_PICO2

configdefault ETH_DRIVER
	default y

config USB_SELF_POWERED
	default n

endif # BOARD_W5500_EVB_PICO2
```

## boards/wiznet/w55rp20_evb_pico/Kconfig.defconfig
```kconfig
# Copyright (c) 2026 Mason Lee
# SPDX-License-Identifier: Apache-2.0

if BOARD_W55RP20_EVB_PICO

configdefault ETH_DRIVER
	default y

if I2C_DW

config I2C_DW_CLOCK_SPEED
	default 125

endif # I2C_DW

config USB_SELF_POWERED
	default n

endif # BOARD_W55RP20_EVB_PICO
```

## boards/wiznet/w6100_evb_pico2/Kconfig.defconfig
```kconfig
# SPDX-FileCopyrightText: Copyright 2025 TOKITA Hiroshi
# SPDX-License-Identifier: Apache-2.0

if BOARD_W6100_EVB_PICO2

configdefault ETH_DRIVER
	default y

config USB_SELF_POWERED
	default n

endif # BOARD_W6100_EVB_PICO2
```

## boards/xen/xenvm/board.yml
```yaml
board:
  name: xenvm
  full_name: ARMv8 Xen Virtual Machine Example
  vendor: xen
  socs:
  - name: xenvm
    variants:
    - name: gicv3
    - name: gicv3_smp
```

## boards/xen/xenvm/xenvm_xenvm_gicv3_smp_defconfig
```kconfig
# Enable UART driver
CONFIG_SERIAL=y

CONFIG_MAX_XLAT_TABLES=24

# Enable console
CONFIG_CONSOLE=y
CONFIG_UART_CONSOLE=y

# Enable logging subsys
CONFIG_LOG=y
CONFIG_LOG_MODE_MINIMAL=n
CONFIG_TIMER_READS_ITS_FREQUENCY_AT_RUNTIME=y

# Enable SMP
CONFIG_SMP=y
CONFIG_MP_MAX_NUM_CPUS=2
CONFIG_PM_CPU_OPS=y
CONFIG_PM_CPU_OPS_PSCI=y
```

## boards/xunlong/opi_zero3/Kconfig.opi_zero3
```kconfig
# Copyright (c) 2026 Khai Do
# Copyright (c) 2026 Eugene Cheng
# SPDX-License-Identifier: Apache-2.0

config BOARD_OPI_ZERO3
	select SOC_SUN50I_H618
```

## boards/xunlong/opi_zero3/board.yml
```yaml
# Copyright (c) 2026 Khai Do
# Copyright (c) 2026 Eugene Cheng
# SPDX-License-Identifier: Apache-2.0

board:
  name: opi_zero3
  full_name: Orange Pi Zero 3
  vendor: xunlong
  socs:
  - name: sun50i_h618
```

## boards/yuzuki/v851s_e907/Kconfig.v851s_e907
```kconfig
# SPDX-FileCopyrightText: Copyright The Zephyr Project Contributors
# SPDX-License-Identifier: Apache-2.0

config BOARD_V851S_E907
	select SOC_V851S_E907
```

## boards/yuzuki/v851s_e907/board.yml
```yaml
board:
  name: v851s_e907
  full_name: YuzukiPI-Lizard V851S E907 co-processor
  vendor: yuzuki
  socs:
    - name: v851s_e907
```

## cmake/toolchain/andes-clang/Kconfig
```kconfig
# Copyright (c) 2025 Andes Technology Corporation
# SPDX-License-Identifier: Apache-2.0

choice ANDES_CLANG_LINKER
	prompt "Andes Clang linker"
	default ANDES_CLANG_USE_LLD

config ANDES_CLANG_USE_LD
	bool "GNU ld"
	help
	  Use binutils ld linker with Andes Clang.

config ANDES_CLANG_USE_LLD
	bool "LLVM lld"
	help
	  Use LLVM lld linker with Andes Clang.

endchoice

rsource "../andes/Kconfig"
```

## cmake/toolchain/andes-clang/Kconfig.defconfig
```kconfig
# Copyright (c) 2025 Andes Technology Corporation
# SPDX-License-Identifier: Apache-2.0

rsource "../andes/Kconfig.defconfig"

config COMPILER_FREESTANDING
	default y if PICOLIBC_USE_MODULE
```

## cmake/toolchain/andes/Kconfig.defconfig
```kconfig
# Copyright (c) 2025 Andes Technology Corporation
# SPDX-License-Identifier: Apache-2.0

config COMPILER_FREESTANDING
	default y if "$(TOOLCHAIN_HAS_NEWLIB)" != "y"

config RISCV_USE_MSAVE_RESTORE
	default y if SIZE_OPTIMIZATIONS

config NEWLIB_LIBC_USE_POSIX_LIMITS_H
	default n if "$(TOOLCHAIN_HAS_NEWLIB)" = "y"
```

## cmake/toolchain/arcmwdt/Kconfig.defconfig
```kconfig
# Copyright (c) 2024 Synopsys
# SPDX-License-Identifier: Apache-2.0

config ISR_TABLES_LOCAL_DECLARATION
	default n

config PICOLIBC_SUPPORTED
	default n
```

## cmake/toolchain/tricore/Kconfig
```kconfig
# SPDX-FileCopyrightText: Copyright The Zephyr Project Contributors
# SPDX-License-Identifier: Apache-2.0

rsource "../cross-compile/Kconfig"

config TOOLCHAIN_SUPPORTS_ISR_TABLES_LOCAL_DECLARATION
	default y
```
