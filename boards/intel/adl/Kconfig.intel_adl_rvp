## boards/intel/adl/Kconfig.intel_adl_rvp
```kconfig
# Copyright (c) 2023-2024 Intel Corporation
# SPDX-License-Identifier: Apache-2.0

config BOARD_INTEL_ADL_RVP
	select SOC_ALDER_LAKE
```

## boards/intel/adl/board.yml
```yaml
boards:
  - name: intel_adl_crb
    full_name: Alder Lake CRB
    vendor: intel
    socs:
      - name: alder_lake
  - name: intel_adl_rvp
    full_name: Alder Lake RVP
    vendor: intel
    socs:
      - name: alder_lake
```

## boards/intel/adsp/Kconfig
```kconfig
# Copyright (c) 2025 Intel Corporation
#
# SPDX-License-Identifier: Apache-2.0

config RIMAGE_TARGET
	string
	default "tgl" if BOARD_INTEL_ADSP_CAVS25
	default "tgl-h" if BOARD_INTEL_ADSP_CAVS25_TGPH
	default "mtl" if BOARD_INTEL_ADSP_ACE15_MTPM || BOARD_INTEL_ADSP_ACE15_MTPM_SIM
	default "lnl"  if BOARD_INTEL_ADSP_ACE20_LNL || BOARD_INTEL_ADSP_ACE20_LNL_SIM
	default "ptl"  if BOARD_INTEL_ADSP_ACE30_PTL || BOARD_INTEL_ADSP_ACE30_PTL_SIM
	default "wcl"  if BOARD_INTEL_ADSP_ACE30_WCL || BOARD_INTEL_ADSP_ACE30_WCL_SIM
	default "nvl" if BOARD_INTEL_ADSP_ACE40_NVL || BOARD_INTEL_ADSP_ACE40_NVL_SIM || BOARD_INTEL_ADSP_ACE40_NVLS
```

## boards/intel/adsp/Kconfig.defconfig
```kconfig
# Copyright (c) 2020-2024 Intel Corporation
#
# SPDX-License-Identifier: Apache-2.0

if DAI_INTEL_SSP

config DAI_SSP_HAS_POWER_CONTROL
	def_bool y

endif

if BOARD_INTEL_ADSP

config MAIN_STACK_SIZE
	default 2048 if BOARD_INTEL_ADSP_CAVS25
	default 2048 if BOARD_INTEL_ADSP_CAVS25_TGPH
	default 2048 if BOARD_INTEL_ADSP_ACE15_MTPM
	default 2048 if BOARD_INTEL_ADSP_ACE15_MTPM_SIM
	default 2048 if BOARD_INTEL_ADSP_ACE20_LNL
	default 2048 if BOARD_INTEL_ADSP_ACE20_LNL_SIM
	default 4096 if BOARD_INTEL_ADSP_ACE30
	default 4096 if BOARD_INTEL_ADSP_ACE30_PTL
	default 4096 if BOARD_INTEL_ADSP_ACE30_PTL_SIM
	default 4096 if BOARD_INTEL_ADSP_ACE30_WCL
	default 4096 if BOARD_INTEL_ADSP_ACE30_WCL_SIM

endif # BOARD_INTEL_ADSP
```

## boards/intel/adsp/Kconfig.intel_adsp
```kconfig
# Copyright (c) 2024 Intel Corporation
# SPDX-License-Identifier: Apache-2.0

config BOARD_INTEL_ADSP
	select SOC_INTEL_CAVS_V25 if BOARD_INTEL_ADSP_CAVS25
	select SOC_INTEL_CAVS_V25 if BOARD_INTEL_ADSP_CAVS25_TGPH
	select SOC_INTEL_ACE15_MTPM if BOARD_INTEL_ADSP_ACE15_MTPM
	select SOC_INTEL_ACE15_MTPM if BOARD_INTEL_ADSP_ACE15_MTPM_SIM
	select SOC_INTEL_ACE20_LNL if BOARD_INTEL_ADSP_ACE20_LNL
	select SOC_INTEL_ACE20_LNL if BOARD_INTEL_ADSP_ACE20_LNL_SIM
	select SOC_INTEL_ACE30 if BOARD_INTEL_ADSP_ACE30_PTL
	select SOC_INTEL_ACE30 if BOARD_INTEL_ADSP_ACE30_PTL_SIM
	select SOC_INTEL_ACE30 if BOARD_INTEL_ADSP_ACE30_WCL
	select SOC_INTEL_ACE30 if BOARD_INTEL_ADSP_ACE30_WCL_SIM
	select SOC_INTEL_ACE40 if BOARD_INTEL_ADSP_ACE40_NVL
	select SOC_INTEL_ACE40 if BOARD_INTEL_ADSP_ACE40_NVL_SIM
	select SOC_INTEL_ACE40 if BOARD_INTEL_ADSP_ACE40_NVLS
```

## boards/intel/adsp/board.yml
```yaml
boards:
  - name: intel_adsp
    full_name: Intel ADSP
    vendor: intel
    socs:
      - name: cavs25
        variants:
          - name: 'tgph'
      - name: ace15_mtpm
        variants:
          - name: 'sim'
      - name: ace20_lnl
        variants:
          - name: 'sim'
      - name: ace30
        variants:
          - name: 'ptl'
            variants:
              - name: 'sim'
```

## boards/intel/adsp/intel_adsp_ace20_lnl_defconfig
```kconfig
# SPDX-License-Identifier: Apache-2.0

CONFIG_GEN_ISR_TABLES=y
CONFIG_GEN_IRQ_VECTOR_TABLE=n

CONFIG_BUILD_OUTPUT_BIN=n
CONFIG_MM_DRV=y
CONFIG_MM_DRV_INTEL_ADSP_MTL_TLB=y

CONFIG_DCACHE_LINE_SIZE=64
```

## boards/intel/adsp/intel_adsp_ace30_ptl_sim_defconfig
```kconfig
# SPDX-License-Identifier: Apache-2.0

CONFIG_INTEL_ADSP_SIM=y
CONFIG_INTEL_ADSP_SIM_NO_SECONDARY_CORE_FLOW=y

CONFIG_GEN_ISR_TABLES=y
CONFIG_GEN_IRQ_VECTOR_TABLE=n

CONFIG_BUILD_OUTPUT_BIN=n

CONFIG_DAI_SSP_HAS_POWER_CONTROL=y

CONFIG_DCACHE_LINE_SIZE=64
```

## boards/intel/adsp/intel_adsp_ace40_nvl_sim_defconfig
```kconfig
# SPDX-License-Identifier: Apache-2.0

CONFIG_MAIN_STACK_SIZE=2048

CONFIG_INTEL_ADSP_SIM=y

CONFIG_GEN_ISR_TABLES=y
CONFIG_GEN_IRQ_VECTOR_TABLE=n

CONFIG_BUILD_OUTPUT_BIN=n

CONFIG_DAI_SSP_HAS_POWER_CONTROL=y

CONFIG_DCACHE_LINE_SIZE=64
```

## boards/intel/adsp/intel_adsp_cavs25_tgph_defconfig
```kconfig
# Copyright (c) 2020-2024 Intel Corporation
#
# SPDX-License-Identifier: Apache-2.0

CONFIG_DAI_SSP_HAS_POWER_CONTROL=y

CONFIG_MP_MAX_NUM_CPUS=2
CONFIG_CORE_COUNT=2
```

## boards/intel/btl/Kconfig.intel_btl_s_crb
```kconfig
# Copyright (c) 2025 Intel Corporation
# SPDX-License-Identifier: Apache-2.0

config BOARD_INTEL_BTL_S_CRB
	select SOC_RAPTOR_LAKE
```

## boards/intel/btl/board.yml
```yaml
boards:
  - name: intel_btl_s_crb
    full_name: Bartlett Lake P CRB
    vendor: intel
    revision:
      format: letter
      default: "H"
      exact: true
      revisions:
        - name: "H"
        - name: "P"
    socs:
      - name: raptor_lake
```

## boards/intel/ehl/Kconfig.intel_ehl_crb
```kconfig
# Copyright (c) 2020-2024 Intel Corporation
# SPDX-License-Identifier: Apache-2.0

config BOARD_INTEL_EHL_CRB
	select SOC_ELKHART_LAKE
```

## boards/intel/ehl/board.yml
```yaml
board:
  name: intel_ehl_crb
  full_name: Elkhart Lake CRB
  vendor: intel
  socs:
    - name: elkhart_lake
      variants:
        - name: 'sbl'
```

## boards/intel/ehl/intel_ehl_crb_elkhart_lake_defconfig
```kconfig
# SPDX-License-Identifier: Apache-2.0

CONFIG_PIC_DISABLE=y
CONFIG_LOAPIC=y
CONFIG_CONSOLE=y
CONFIG_SERIAL=y
CONFIG_UART_CONSOLE=y
CONFIG_X2APIC=y
CONFIG_SMP=y
CONFIG_BUILD_OUTPUT_EFI=y
CONFIG_BUILD_NO_GAP_FILL=y
CONFIG_PCIE_PRT=n
```

## boards/intel/intel_adsp/Kconfig.defconfig
```kconfig
# Copyright (c) 2020-2024 Intel Corporation
#
# SPDX-License-Identifier: Apache-2.0

if DAI_INTEL_SSP

config DAI_SSP_HAS_POWER_CONTROL
	def_bool y

endif
```

## boards/intel/intel_adsp/Kconfig.intel_adsp
```kconfig
# Copyright (c) 2024 Intel Corporation
# SPDX-License-Identifier: Apache-2.0

config BOARD_INTEL_ADSP
	select SOC_INTEL_CAVS_V25
```

## boards/intel/intel_adsp/board.yml
```yaml
board:
  name: intel_adsp
  vendor: intel
  socs:
    - name: cavs25
      variants:
        - name: 'tgph'
```

## boards/intel/intel_adsp_ace15_mtpm/Kconfig.intel_adsp_ace15_mtpm
```kconfig
# Copyright (c) 2022-2024 Intel Corporation
#
# SPDX-License-Identifier: Apache-2.0

config BOARD_INTEL_ADSP_ACE15_MTPM
	bool
	select SOC_INTEL_ACE15_MTPM
```

## boards/intel/intel_adsp_ace15_mtpm/board.yml
```yaml
board:
  name: intel_adsp_ace15_mtpm
  vendor: intel
  socs:
    - name: intel_ace15_mtpm
```

## boards/intel/intel_adsp_ace20_lnl/Kconfig.intel_adsp_ace20_lnl
```kconfig
# Copyright (c) 2022-2024 Intel Corporation
# SPDX-License-Identifier: Apache-2.0

config BOARD_INTEL_ADSP_ACE20_LNL
	select SOC_INTEL_ACE20_LNL
```

## boards/intel/intel_adsp_ace20_lnl/board.yml
```yaml
board:
  name: intel_adsp_ace20_lnl
  vendor: intel
  socs:
    - name: ace20_lnl
```

## boards/intel/intel_adsp_cavs25/Kconfig.intel_adsp_cavs25
```kconfig
# Copyright (c) 2024 Intel Corporation
# SPDX-License-Identifier: Apache-2.0

config BOARD_INTEL_ADSP_CAVS25
	select SOC_INTEL_CAVS_V25
```

## boards/intel/intel_adsp_cavs25/board.yml
```yaml
board:
  name: intel_adsp_cavs25
  vendor: intel
  socs:
    - name: intel_tgl_adsp
      variants:
        - name: 'tgph'
```
