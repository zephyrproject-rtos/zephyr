/*
 * Copyright (c) 2023 Intel Corporation
 *
 * SPDX-License-Identifier: Apache-2.0
 */

#include "intel_adl.dts"

/ {
	model = "Intel Alder Lake CRB";
	compatible = "intel,alder-lake-crb";

	chosen {
		zephyr,console = &uart0;
		zephyr,shell-uart = &uart0;
	};

	aliases {
		rtc = &rtc;
		pwm-test = &pwm0;
	};
};

&uart0 {
	status = "okay";
};
