/*
 * Copyright (c) 2023 Intel Corporation
 *
 * SPDX-License-Identifier: Apache-2.0
 */

#include "intel_adl.dts"

/ {
	compatible = "intel,alder-lake-rvp";
	model = "Intel Alder Lake RVP";

	chosen {
		zephyr,console = &uart0_legacy;
		zephyr,shell-uart = &uart0_legacy;
	};
};
