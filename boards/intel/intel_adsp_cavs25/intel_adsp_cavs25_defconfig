## boards/intel/intel_adsp_cavs25/intel_adsp_cavs25_defconfig
```kconfig
# Copyright (c) 2020-2024 Intel Corporation
#
# SPDX-License-Identifier: Apache-2.0

CONFIG_MAIN_STACK_SIZE=2048

CONFIG_GEN_ISR_TABLES=y
CONFIG_GEN_IRQ_VECTOR_TABLE=n

CONFIG_XTENSA_RESET_VECTOR=y

CONFIG_XTENSA_USE_CORE_CRT1=y

CONFIG_MULTI_LEVEL_INTERRUPTS=y
CONFIG_2ND_LEVEL_INTERRUPTS=y

CONFIG_BUILD_OUTPUT_BIN=n

CONFIG_MP_MAX_NUM_CPUS=4

CONFIG_DCACHE_LINE_SIZE=64
```

## boards/intel/intel_ehl/Kconfig.defconfig
```kconfig
# Copyright (c) 2020-2024 Intel Corporation
# SPDX-License-Identifier: Apache-2.0


config BUILD_OUTPUT_STRIPPED
	default y

config MP_MAX_NUM_CPUS
	default 2

if BOARD_INTEL_EHL_CRB_ELKHART_LAKE_SBL
config SHELL_BACKEND_SERIAL_INTERRUPT_DRIVEN
	depends on SHELL_BACKEND_SERIAL
	default n
endif

config HEAP_MEM_POOL_ADD_SIZE_ACPI
	default 2097152
	depends on ACPI

# TSC on this board is 1.9 GHz, HPET and APIC are 19.2 MHz
config SYS_CLOCK_HW_CYCLES_PER_SEC
	default 1900000000 if APIC_TSC_DEADLINE_TIMER
	default 1900000000 if APIC_TIMER_TSC
	default 19200000

if APIC_TIMER
config APIC_TIMER_IRQ
	default 24
config APIC_TIMER_TSC_M
	default 3
config APIC_TIMER_TSC_N
	default 249
endif

if BOARD_INTEL_EHL_CRB_ELKHART_LAKE
	config HAS_COVERAGE_SUPPORT
		default y
endif
```

## boards/intel/intel_socfpga/agilex5_socdk/board.yml
```yaml
board:
  name: intel_socfpga_agilex5_socdk
  socs:
    - name: intel_socfpga_agilex5
```

## boards/intel/intel_socfpga/agilex_socdk/board.yml
```yaml
board:
  name: intel_socfpga_agilex_socdk
  socs:
    - name: intel_socfpga_agilex
```

## boards/intel/intel_socfpga_std/cyclonev_socdk/Kconfig.cyclonev_socdk
```kconfig
# Copyright (c) 2022-2024 Intel Corporation
# SPDX-License-Identifier: Apache-2.0

config BOARD_CYCLONEV_SOCDK
	select SOC_CYCLONE5
	help
	  Intel Cyclone V Development Kit
```

## boards/intel/intel_socfpga_std/cyclonev_socdk/Kconfig.defconfig
```kconfig
# Copyright (c) 2022-2024 Intel Corporation
# SPDX-License-Identifier: Apache-2.0

if I2C_DW
config I2C_DW_CLOCK_SPEED
	default 200
endif # I2C_DW

if USB_DEVICE_STACK
config USB_DW_USB_2_0
	default y
config USB_DEVICE_DRIVER
	default y
endif # USB_DEVICE_STACK

if NETWORKING

config NET_L2_ETHERNET
	default y
config TEST_RANDOM_GENERATOR
	default y

endif # NETWORKING
```

## boards/intel/ish/Kconfig.defconfig
```kconfig
# Copyright (c) 2023 Intel Corporation
#
# SPDX-License-Identifier: Apache-2.0
#

if TEST
config TEST_EXTRA_STACK_SIZE
	default 1024
endif # TEST

config SYS_CLOCK_TICKS_PER_SEC
	default 2048 if HPET_TIMER # HPET timer's frequency is 32768 HZ
	default 2000 if APIC_TIMER_TSC # APIC timer's frequency is 19.2 MHZ or 100 MHZ
```

## boards/intel/ish/Kconfig.intel_ish_5_4_1
```kconfig
# Copyright (c) 2024 Intel Corporation
#
# SPDX-License-Identifier: Apache-2.0

config BOARD_INTEL_ISH_5_4_1
	select SOC_INTEL_ISH_5_4_1
```

## boards/intel/ish/Kconfig.intel_ish_5_6_0
```kconfig
# Copyright (c) 2024 Intel Corporation
#
# SPDX-License-Identifier: Apache-2.0

config BOARD_INTEL_ISH_5_6_0
	select SOC_INTEL_ISH_5_6_0
```

## boards/intel/ish/board.yml
```yaml
boards:

  - name: intel_ish_5_4_1
    full_name: Integrated Sensor Hub (ISH) 5.4.1
    vendor: intel
    socs:
      - name: intel_ish_5_4_1

  - name: intel_ish_5_6_0
    full_name: Integrated Sensor Hub (ISH) 5.6.0
    vendor: intel
    socs:
      - name: intel_ish_5_6_0

  - name: intel_ish_5_8_0
    full_name: Integrated Sensor Hub (ISH) 5.8.0
    vendor: intel
    socs:
      - name: intel_ish_5_8_0
```

## boards/intel/ish/intel_ish_5_8_0_defconfig
```kconfig
#
# Copyright (c) 2023-2024 Intel Corporation
#
# SPDX-License-Identifier: Apache-2.0
#

# uart & console
CONFIG_CONSOLE=y
CONFIG_UART_CONSOLE=y
CONFIG_SERIAL=y
```

## boards/intel/niosv_g/Kconfig.niosv_g
```kconfig
# Copyright (C) 2023-2024, Intel Corporation
#
# SPDX-License-Identifier: Apache-2.0

config BOARD_NIOSV_G
	select SOC_NIOSV_G
	help
	  Intel FPGA Nios V/g General Purpose Processor
```

## boards/intel/niosv_g/board.yml
```yaml
board:
  name: niosv_g
  full_name: INTEL FPGA niosv_g
  vendor: intel
  socs:
    - name: niosv_g
```

## boards/intel/niosv_m/Kconfig.niosv_m
```kconfig
# Copyright (C) 2023-2024, Intel Corporation
#
# SPDX-License-Identifier: Apache-2.0

config BOARD_NIOSV_M
	select SOC_NIOSV_M
	help
	  Intel FPGA NIOSV Microcontroller Core Processor
```

## boards/intel/niosv_m/board.yml
```yaml
board:
  name: niosv_m
  full_name: INTEL FPGA niosv_m
  vendor: intel
  socs:
    - name: niosv_m
```

## boards/intel/nvl/Kconfig.intel_nvl_s_rvp
```kconfig
# Copyright (c) 2026 Intel Corporation
# SPDX-License-Identifier: Apache-2.0

config BOARD_INTEL_NVL_S_RVP
	select SOC_NOVA_LAKE
```

## boards/intel/nvl/board.yml
```yaml
boards:
  - name: intel_nvl_s_rvp
    full_name: Nova Lake RVP
    vendor: intel
    socs:
      - name: nova_lake
```

## boards/intel/ptl/Kconfig.intel_ptl_h_crb
```kconfig
# Copyright (c) 2025 Intel Corporation
# SPDX-License-Identifier: Apache-2.0

config BOARD_INTEL_PTL_H_CRB
	select SOC_PANTHER_LAKE
```

## boards/intel/ptl/board.yml
```yaml
boards:
  - name: intel_ptl_h_crb
    full_name: Panther Lake H CRB
    vendor: intel
    socs:
      - name: panther_lake
```

## boards/intel/rpl/Kconfig.defconfig
```kconfig
# Copyright (c) 2022-2024 Intel Corporation
# SPDX-License-Identifier: Apache-2.0


config BUILD_OUTPUT_STRIPPED
	default y

config MP_MAX_NUM_CPUS
	default 2

# TSC on this board is 1.9 GHz, HPET and APIC are 19.2 MHz
config SYS_CLOCK_HW_CYCLES_PER_SEC
	default 1900000000 if APIC_TSC_DEADLINE_TIMER
	default 1900000000 if APIC_TIMER_TSC
	default 19200000

if APIC_TIMER
config APIC_TIMER_IRQ
	default 24
config APIC_TIMER_TSC_M
	default 3
config APIC_TIMER_TSC_N
	default 249
endif

config ACPI
	default y

if ACPI
config HEAP_MEM_POOL_ADD_SIZE_ACPI
	default 64000000
config MAIN_STACK_SIZE
	default 320000

if SHELL
config SHELL_STACK_SIZE
	default 320000
endif # SHELL
endif # ACPI

if DMA
config DMA_64BIT
	default y
config DMA_DW_HW_LLI
	default n
config DMA_DW_CHANNEL_COUNT
	default 2
endif

config UART_NS16550_INTEL_LPSS_DMA
	default y if BOARD_INTEL_RPL_S_CRB

if SHELL
config SHELL_STACK_SIZE
	default 320000
endif

config HAS_COVERAGE_SUPPORT
	default y
```

## boards/intel/rpl/Kconfig.intel_rpl_s_crb
```kconfig
# Copyright (c) 2022-2024 Intel Corporation
# SPDX-License-Identifier: Apache-2.0

config BOARD_INTEL_RPL_S_CRB
	select SOC_RAPTOR_LAKE
```

## boards/intel/rpl/board.yml
```yaml
boards:
  - name: intel_rpl_p_crb
    full_name: Raptor Lake P CRB
    vendor: intel
    socs:
      - name: raptor_lake
  - name: intel_rpl_s_crb
    full_name: Raptor Lake S CRB
    vendor: intel
    revision:
      format: number
      default: "600"
      revisions:
        - name: "600"
        - name: "700"
    socs:
      - name: raptor_lake
```

## boards/intel/rpl/intel_rpl_p_crb_defconfig
```kconfig
# SPDX-License-Identifier: Apache-2.0

CONFIG_PIC_DISABLE=y
CONFIG_LOAPIC=y
CONFIG_CONSOLE=y
CONFIG_SERIAL=y
CONFIG_UART_NS16550=y
CONFIG_UART_NS16550_VARIANT_NS16750=y
CONFIG_UART_CONSOLE=y
CONFIG_X2APIC=y
CONFIG_SMP=y
CONFIG_BUILD_OUTPUT_EFI=y
CONFIG_BUILD_NO_GAP_FILL=y
CONFIG_TIMER_READS_ITS_FREQUENCY_AT_RUNTIME=y
```

## boards/intel/socfpga/agilex5_socdk/Kconfig.defconfig
```kconfig
# Copyright (c) 2022-2024 Intel Corporation
# SPDX-License-Identifier: Apache-2.0

config HAS_COVERAGE_SUPPORT
	default y

config MAX_THREAD_BYTES
	default 5
```

## boards/intel/socfpga/agilex5_socdk/Kconfig.intel_socfpga_agilex5_socdk
```kconfig
# Copyright (c) 2022-2024 Intel Corporation
# SPDX-License-Identifier: Apache-2.0

config BOARD_INTEL_SOCFPGA_AGILEX5_SOCDK
	select SOC_AGILEX5
```
