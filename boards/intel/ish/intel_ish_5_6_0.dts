/*
 * Copyright (c) 2023 Intel Corporation
 *
 * SPDX-License-Identifier: Apache-2.0
 */

/dts-v1/;

#include "intel/intel_ish5.dtsi"

/ {
	model = "intel_ish_5_6_0";
	compatible = "intel,ish_5_6_0";

	chosen {
		zephyr,sram = &sram;
		zephyr,console = &uart0;
		zephyr,shell-uart = &uart0;
	};
};
