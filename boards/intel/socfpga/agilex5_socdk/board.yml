## boards/intel/socfpga/agilex5_socdk/board.yml
```yaml
board:
  name: intel_socfpga_agilex5_socdk
  full_name: Agilex™ 5 SoC FPGA Development Kit
  vendor: intel
  socs:
    - name: agilex5
```

## boards/intel/socfpga/agilex_socdk/Kconfig.intel_socfpga_agilex_socdk
```kconfig
# Copyright (c) 2021-2024 Intel Corporation
# SPDX-License-Identifier: Apache-2.0

config BOARD_INTEL_SOCFPGA_AGILEX_SOCDK
	select SOC_AGILEX
```

## boards/intel/socfpga/agilex_socdk/board.yml
```yaml
board:
  name: intel_socfpga_agilex_socdk
  full_name: Agilex SoC Development Kit
  vendor: intel
  socs:
    - name: agilex
```

## boards/intel/socfpga/agilex_socdk/intel_socfpga_agilex_socdk_defconfig
```kconfig
# Copyright (c) 2021-2024 Intel Corporation
# SPDX-License-Identifier: Apache-2.0

# The Zephyr build from this defconfig is expected to boot from
# Intel Arm Trusted Firmware (ATF)
# Boot Flow: BL21 -> BL31 -> Zephyr

CONFIG_ARM_ARCH_TIMER=y

# Serial Drivers
CONFIG_SERIAL=y
CONFIG_UART_INTERRUPT_DRIVEN=y
CONFIG_UART_NS16550_ACCESS_WORD_ONLY=y

# Enable Console
CONFIG_CONSOLE=y
CONFIG_UART_CONSOLE=y

# Enable Clock Manager
CONFIG_CLOCK_CONTROL=y

# For Misc Register Map
CONFIG_SYSCON=y
```

## boards/intel/socfpga_std/cyclonev_socdk/Kconfig.cyclonev_socdk
```kconfig
# Copyright (c) 2022-2024 Intel Corporation
# SPDX-License-Identifier: Apache-2.0

config BOARD_CYCLONEV_SOCDK
	select SOC_CYCLONEV
```

## boards/intel/socfpga_std/cyclonev_socdk/board.yml
```yaml
board:
  name: cyclonev_socdk
  full_name: Cyclone® V SoC Development Kit
  vendor: intel
  socs:
    - name: cyclonev
```

## boards/intel/socfpga_std/cyclonev_socdk/cyclonev_socdk_defconfig
```kconfig
# Copyright (c) 2022-2024 Intel Corporation
# SPDX-License-Identifier: Apache-2.0

CONFIG_ARM_ARCH_TIMER=y

CONFIG_SYSCON=y

# Serial Drivers
CONFIG_SERIAL=y
CONFIG_UART_NS16550_VARIANT_NS16950=y

#Config Console
CONFIG_CONSOLE=y
CONFIG_UART_CONSOLE=y

#Flash not used.
CONFIG_FLASH_SIZE=0
CONFIG_FLASH_BASE_ADDRESS=0x0

# GPIOs
CONFIG_GPIO=y
```

## boards/intel/wcl/Kconfig.defconfig
```kconfig
# Copyright (c) 2025 Intel Corporation
# SPDX-License-Identifier: Apache-2.0

config BUILD_OUTPUT_STRIPPED
	default y

config MP_MAX_NUM_CPUS
	default 2

# The APIC TSC deadline and one-shot timers on this board run at 2 GHz; the HPET runs at 19.2 MHz.
config SYS_CLOCK_HW_CYCLES_PER_SEC
	default $(dt_node_int_prop_int,/cpus/cpu@0,clock-frequency) if APIC_TSC_DEADLINE_TIMER
	default $(dt_node_int_prop_int,/cpus/cpu@0,clock-frequency) if APIC_TIMER_TSC
	default $(dt_node_int_prop_int,/soc/hpet@fed00000,clock-frequency)

if APIC_TIMER

config APIC_TIMER_IRQ
	default 24

endif

if APIC_TIMER_TSC

config APIC_TIMER_TSC_M
	default 2

config APIC_TIMER_TSC_N
	default 68

endif

config ACPI
	default y

if ACPI

config HEAP_MEM_POOL_ADD_SIZE_ACPI
	default 64000000

config MAIN_STACK_SIZE
	default 320000

if SHELL

config SHELL_STACK_SIZE
	default 320000

endif # SHELL

endif # ACPI

if DMA

config DMA_64BIT
	default y

config DMA_DW_HW_LLI
	default n

config DMA_DW_CHANNEL_COUNT
	default 2

endif

config UART_NS16550_INTEL_LPSS_DMA
	default y if $(dt_nodelabel_enabled,uart0_dma) || $(dt_nodelabel_enabled,uart1_dma)

config HAS_COVERAGE_SUPPORT
	default y
```

## boards/intel/wcl/Kconfig.intel_wcl_crb
```kconfig
# Copyright (c) 2025 Intel Corporation
# SPDX-License-Identifier: Apache-2.0

config BOARD_INTEL_WCL_CRB
	select SOC_WILDCAT_LAKE
```

## boards/intel/wcl/board.yml
```yaml
boards:
  - name: intel_wcl_crb
    full_name: Wildcat Lake CRB
    vendor: intel
    socs:
      - name: wildcat_lake
```

## boards/ite/it515xx_evb/Kconfig.defconfig
```kconfig
# Copyright (c) 2025 ITE Corporation. All Rights Reserved.
# SPDX-License-Identifier: Apache-2.0

if BOARD_IT515XX_EVB

if PM

config PM_DEVICE
	default y

choice PM_POLICY
	default PM_POLICY_CUSTOM
endchoice

endif # PM

if VCMP_IT51XXX

choice VCMP_IT51XXX_SCAN_PERIOD
	default VCMP_IT51XXX_SCAN_PERIOD_1MS
endchoice

endif # VCMP_IT51XXX

endif # BOARD_IT515XX_EVB
```

## boards/ite/it515xx_evb/Kconfig.it515xx_evb
```kconfig
# Copyright (c) 2025 ITE Corporation. All Rights Reserved.
# SPDX-License-Identifier: Apache-2.0

config BOARD_IT515XX_EVB
	select SOC_IT51526AW
```

## boards/ite/it515xx_evb/board.yml
```yaml
board:
  name: it515xx_evb
  full_name: IT51XXX series
  vendor: ite
  socs:
    - name: it51526aw
```

## boards/ite/it515xx_evb/it515xx_evb_defconfig
```kconfig
# Copyright (c) 2025 ITE Corporation. All Rights Reserved.
# SPDX-License-Identifier: Apache-2.0

CONFIG_GEN_IRQ_VECTOR_TABLE=n

# General Kernel Options
CONFIG_SYS_CLOCK_HW_CYCLES_PER_SEC=32768
CONFIG_XIP=y
CONFIG_INIT_STACKS=y

# UART Driver
CONFIG_SERIAL=y
CONFIG_UART_INTERRUPT_DRIVEN=y

# Console Driver
CONFIG_CONSOLE=y
CONFIG_UART_CONSOLE=y

# GPIO Driver
CONFIG_GPIO=y

# Clock Driver
CONFIG_CLOCK_CONTROL=y

# ADC Driver
CONFIG_ADC=y

# Kscan Driver
CONFIG_INPUT=y
CONFIG_INPUT_ITE_IT51XXX_KBD=y

# PWM Driver
CONFIG_PWM=y
CONFIG_PWM_ITE_IT51XXX=y

# Tach Driver
CONFIG_SENSOR=y
CONFIG_TACH_IT51XXX=y

# WDT Driver
CONFIG_WATCHDOG=y
CONFIG_WDT_ITE_IT51XXX=y
```

## boards/ite/it51xxx_evb/Kconfig.defconfig
```kconfig
# Copyright (c) 2025 ITE Corporation. All Rights Reserved.
# SPDX-License-Identifier: Apache-2.0

if BOARD_IT51XXX_EVB

if PM

config PM_DEVICE
	default y

choice PM_POLICY
	default PM_POLICY_CUSTOM
endchoice

endif # PM

endif # BOARD_IT51XXX_EVB
```

## boards/ite/it51xxx_evb/Kconfig.it51xxx_evb
```kconfig
# Copyright (c) 2025 ITE Corporation. All Rights Reserved.
# SPDX-License-Identifier: Apache-2.0

config BOARD_IT51XXX_EVB
	select SOC_IT51526AW if BOARD_IT51XXX_EVB_IT51526AW
```

## boards/ite/it51xxx_evb/board.yml
```yaml
board:
  name: it51xxx_evb
  full_name: IT51XXX series
  vendor: ite
  socs:
    - name: it51526aw
```

## boards/ite/it51xxx_evb/it51xxx_evb_it51526aw_defconfig
```kconfig
# Copyright (c) 2025 ITE Corporation. All Rights Reserved.
# SPDX-License-Identifier: Apache-2.0

# General Kernel Options
CONFIG_XIP=y

# UART Driver
CONFIG_SERIAL=y
CONFIG_UART_INTERRUPT_DRIVEN=y

# Console Driver
CONFIG_CONSOLE=y
CONFIG_UART_CONSOLE=y

# GPIO Driver
CONFIG_GPIO=y

# Clock Driver
CONFIG_CLOCK_CONTROL=y
```

## boards/ite/it82xx2_evb/Kconfig.defconfig
```kconfig
# Copyright (c) 2023 ITE Corporation. All Rights Reserved.
# SPDX-License-Identifier: Apache-2.0

if BOARD_IT82XX2_EVB

config INPUT
	default y if KSCAN

config PM
	default n if SOC_IT8XXX2_JTAG_DEBUG_INTERFACE
	default y

config PM_DEVICE
	default n if SOC_IT8XXX2_JTAG_DEBUG_INTERFACE
	default y

endif
```

## boards/ite/it82xx2_evb/Kconfig.it82xx2_evb
```kconfig
# Copyright (c) 2023 ITE Corporation. All Rights Reserved.
# SPDX-License-Identifier: Apache-2.0

config BOARD_IT82XX2_EVB
	select SOC_IT82202AX
```

## boards/ite/it82xx2_evb/it82xx2_evb_defconfig
```kconfig
# Copyright (c) 2023 ITE Corporation. All Rights Reserved.
# SPDX-License-Identifier: Apache-2.0

CONFIG_GEN_IRQ_VECTOR_TABLE=n

# General Kernel Options
CONFIG_SYS_CLOCK_HW_CYCLES_PER_SEC=32768
CONFIG_XIP=y
CONFIG_INIT_STACKS=y

# UART Driver
CONFIG_SERIAL=y
CONFIG_UART_INTERRUPT_DRIVEN=y

# Console Driver
CONFIG_CONSOLE=y
CONFIG_UART_CONSOLE=y

# GPIO Driver
CONFIG_GPIO=y

# Power Management
CONFIG_PM=y
CONFIG_PM_DEVICE=y
CONFIG_PM_POLICY_CUSTOM=y
```

## boards/ite/it8xxx2_evb/Kconfig.defconfig
```kconfig
# Copyright (c) 2020 ITE Corporation. All Rights Reserved.
# SPDX-License-Identifier: Apache-2.0

if BOARD_IT8XXX2_EVB

if PM

config PM_DEVICE
	default y

choice PM_POLICY
	default PM_POLICY_CUSTOM
endchoice

endif # PM

config INPUT
	default y if KSCAN

endif # BOARD_IT8XXX2_EVB
```

## boards/ite/it8xxx2_evb/Kconfig.it8xxx2_evb
```kconfig
# Copyright (c) 2020 ITE Corporation. All Rights Reserved.
# SPDX-License-Identifier: Apache-2.0

config BOARD_IT8XXX2_EVB
	select SOC_IT82202_AX
```

## boards/ite/it8xxx2_evb/board.yml
```yaml
board:
  name: it8xxx2_evb
  full_name: IT8XXX2 series
  vendor: ite
  socs:
    - name: it81302bx
```
