/*
 * Copyright (c) 2025 Intel Corporation
 *
 * SPDX-License-Identifier: Apache-2.0
 */

/dts-v1/;

#include <intel/intel_adsp_ace40_nvl.dtsi>

/ {
	compatible = "intel";
	model = "intel_adsp_ace40_nvl";

	chosen {
		zephyr,sram = &sram0;
		zephyr,console = &mem_window3;
	};
};
