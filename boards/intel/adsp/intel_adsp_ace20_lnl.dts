/*
 * Copyright (c) 2022 Intel Corporation
 *
 * SPDX-License-Identifier: Apache-2.0
 */

/dts-v1/;

#include <intel/intel_adsp_ace20_lnl.dtsi>

/ {
	compatible = "intel,intel_adsp_ace20_lnl";
	model = "intel_adsp_ace20_lnl";

	chosen {
		zephyr,sram = &sram0;
		zephyr,console = &mem_window3;
	};
};
