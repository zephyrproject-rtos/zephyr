/*
 * Copyright (c) 2025 Intel Corporation
 *
 * SPDX-License-Identifier: Apache-2.0
 */

/dts-v1/;

#include <intel/intel_adsp_ace30_wcl.dtsi>

/ {
	model = "intel_adsp_ace30_wcl";
	compatible = "intel";

	chosen {
		zephyr,sram = &sram0;
		zephyr,console = &mem_window3;
	};
};
