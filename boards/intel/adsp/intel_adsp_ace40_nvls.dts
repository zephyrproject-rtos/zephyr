/*
 * Copyright (c) 2025 Intel Corporation
 *
 * SPDX-License-Identifier: Apache-2.0
 */

/dts-v1/;

#include <intel/intel_adsp_ace40_nvls.dtsi>

/ {
	model = "intel_adsp_ace40_nvls";
	compatible = "intel";

	chosen {
		zephyr,sram = &sram0;
		zephyr,console = &mem_window3;
	};
};
