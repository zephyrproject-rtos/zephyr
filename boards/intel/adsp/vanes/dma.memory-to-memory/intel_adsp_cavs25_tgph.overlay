/*
 * Copyright (c) 2022 Kumar Gala <galak@kernel.org>
 *
 * SPDX-License-Identifier: Apache-2.0
 */

/ {
	dma_test_lpgpdma0: dma-test-lpgpdma0 {
		compatible = "test-dma-memory-to-memory";
		dma = <&lpgpdma0>;
	};
};

&lpgpdma0 {
	status = "okay";
};
