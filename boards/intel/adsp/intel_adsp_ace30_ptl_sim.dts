/*
 * Copyright (c) 2022 Intel Corporation
 *
 * SPDX-License-Identifier: Apache-2.0
 */

/dts-v1/;

#include <intel/intel_adsp_ace30_ptl.dtsi>

/ {
	compatible = "intel";
	model = "intel_adsp_ace30_ptl_sim";

	chosen {
		zephyr,sram = &sram0;
		zephyr,console = &mem_window3;
	};
};
