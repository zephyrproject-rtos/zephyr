/*
 * Copyright (c) 2025 Junhui Liu <junhui.liu@pigmoral.tech>
 * SPDX-License-Identifier: Apache-2.0
 */

/dts-v1/;

#include <spacemit/k1_n308.dtsi>

/ {
	model = "Banana Pi BPI-F3";
	compatible = "bananapi,bpi-f3";

	chosen {
		zephyr,sram = &sram;
		zephyr,console = &uart0;
		zephyr,shell-uart = &uart0;
	};
};

&uart0 {
	status = "okay";
	current-speed = <115200>;
};
