## boards/rakwireless/rak3312/board.yml
```yaml
# SPDX-FileCopyrightText: Copyright (c) 2026 RAKwireless Technology Limited
# SPDX-License-Identifier: Apache-2.0

board:
  name: rak3312
  full_name: RAK3312 WisBlock Core Module
  vendor: rakwireless
  socs:
  - name: esp32s3
```

## boards/rakwireless/rak3312/rak3312_appcpu_defconfig
```kconfig
# SPDX-FileCopyrightText: Copyright (c) 2026 RAKwireless Technology Limited
# SPDX-License-Identifier: Apache-2.0

CONFIG_CLOCK_CONTROL=y
```

## boards/rakwireless/rak3372/Kconfig
```kconfig
# SPDX-FileCopyrightText: Copyright (c) 2026 RAKwireless Technology Limited
# SPDX-License-Identifier: Apache-2.0

config BOARD_RAK3372
	select BOARD_EARLY_INIT_HOOK if ADC || PWM
	select PINCTRL_DYNAMIC if ADC || PWM
```

## boards/rakwireless/rak3372/Kconfig.rak3372
```kconfig
# SPDX-FileCopyrightText: Copyright (c) 2026 RAKwireless Technology Limited
# SPDX-License-Identifier: Apache-2.0

config BOARD_RAK3372
	select SOC_STM32WLE5XX
```

## boards/rakwireless/rak3372/Kconfig.sysbuild
```kconfig
# SPDX-FileCopyrightText: Copyright (c) 2026 RAKwireless Technology Limited
# SPDX-License-Identifier: Apache-2.0

choice MCUBOOT_MODE
	default MCUBOOT_MODE_OVERWRITE_ONLY
endchoice
```

## boards/rakwireless/rak3372/board.yml
```yaml
# SPDX-FileCopyrightText: Copyright (c) 2026 RAKwireless Technology Limited
# SPDX-License-Identifier: Apache-2.0

board:
  name: rak3372
  full_name: RAK3372 WisBlock Core Module
  vendor: rakwireless
  socs:
  - name: stm32wle5xx
```

## boards/rakwireless/rak3401/Kconfig
```kconfig
# SPDX-FileCopyrightText: Copyright (c) 2026 RAKwireless Technology Limited
# SPDX-License-Identifier: Apache-2.0

config BOARD_RAK3401
	select BOARD_EARLY_INIT_HOOK
	select PINCTRL_DYNAMIC if PWM
```

## boards/rakwireless/rak3401/Kconfig.defconfig
```kconfig
# SPDX-FileCopyrightText: Copyright (c) 2021 Guillaume Paquet <guillaume.paquet@smile.fr>
# SPDX-License-Identifier: Apache-2.0

# RAKWIRELESS RAK3401 Board configuration

if BOARD_RAK3401

source "boards/common/usb/Kconfig.cdc_acm_serial.defconfig"

endif # BOARD_RAK3401
```

## boards/rakwireless/rak3401/Kconfig.rak3401
```kconfig
# SPDX-FileCopyrightText: Copyright (c) 2021 Guillaume Paquet <guillaume.paquet@smile.fr>
# SPDX-License-Identifier: Apache-2.0

# RAKWIRELESS RAK3401 selection

config BOARD_RAK3401
	select SOC_NRF52840_QIAA
```

## boards/rakwireless/rak3401/board.yml
```yaml
board:
  name: rak3401
  full_name: RAK3401 WisBlock Core Module
  vendor: rakwireless
  socs:
  - name: nrf52840
```

## boards/rakwireless/rak4631/Kconfig
```kconfig
# SPDX-License-Identifier: Apache-2.0
# Copyright (c) 2026 RAKwireless Technology Limited

config BOARD_RAK4631
	select BOARD_EARLY_INIT_HOOK
	select PINCTRL_DYNAMIC if PWM
```

## boards/rakwireless/rak4631/Kconfig.rak4631
```kconfig
# Copyright (c) 2021 Guillaume Paquet <guillaume.paquet@smile.fr>
# Copyright (c) 2026 RAKwireless Technology Limited
# SPDX-License-Identifier: Apache-2.0

config BOARD_RAK4631
	select SOC_NRF52840_QIAA
```

## boards/raspberrypi/rpi_5/Kconfig.defconfig
```kconfig
# SPDX-FileCopyrightText: Copyright The Zephyr Project Contributors
# SPDX-License-Identifier: Apache-2.0

if BOARD_RPI_5

config PM_DEVICE
	default y if UDC_DWC2

if PM_DEVICE

config POWER_DOMAIN
	default y

config PM_DEVICE_RUNTIME
	default y if UDC_DWC2

endif # PM_DEVICE

endif # BOARD_RPI_5
```

## boards/raspberrypi/rpi_debug_probe/Kconfig.defconfig
```kconfig
# Copyright (c) 2022 Peter Johanson
# SPDX-License-Identifier: Apache-2.0

if BOARD_RPI_DEBUG_PROBE

if I2C_DW

config I2C_DW_CLOCK_SPEED
	default 125

endif # I2C_DW

endif # BOARD_RPI_DEBUG_PROBE
```

## boards/raspberrypi/rpi_pico/Kconfig
```kconfig
# Copyright (c) 2021 Yonatan Schachter
# SPDX-License-Identifier: Apache-2.0

config BOARD_RPI_PICO
	select RP2_FLASH_W25Q080

if (BOARD_RPI_PICO_RP2040_W || BOARD_RPI_PICO_RP2040_W_MCUBOOT) && WIFI_AIROC

config HEAP_MEM_POOL_ADD_SIZE_BOARD
	int
	default 16384

endif # (BOARD_RPI_PICO_RP2040_W || BOARD_RPI_PICO_RP2040_W_MCUBOOT) && WIFI_AIROC
```

## boards/raspberrypi/rpi_pico2/board.yml
```yaml
board:
  name: rpi_pico2
  full_name: Raspberry Pi Pico 2
  vendor: raspberrypi
  socs:
    - name: rp2350a
      variants:
        - name: w
          cpucluster: m33_0
          variants:
            - name: mcuboot
              cpucluster: m33_0
        - name: mcuboot
          cpucluster: m33_0
```

## boards/raspberrypi/rpi_zero_2w/Kconfig.defconfig
```kconfig
# Copyright (c) 2026 Muhammad Waleed Badar
# SPDX-License-Identifier: Apache-2.0

if BOARD_RPI_ZERO_2W

config PM_DEVICE
	default y if PM

if PM_DEVICE

config POWER_DOMAIN
	default y

config PM_DEVICE_POWER_DOMAIN
	default y

endif # PM_DEVICE

endif # BOARD_RPI_ZERO_2W
```

## boards/raspberrypi/rpi_zero_2w/board.yml
```yaml
board:
  name: rpi_zero_2w
  full_name: Raspberry Pi Zero 2 W
  vendor: raspberrypi
  socs:
  - name: bcm2710
```

## boards/raytac/mdbt53_db_40/Kconfig
```kconfig
# Copyright (c) 2019-2020 Nordic Semiconductor ASA
# SPDX-License-Identifier: Apache-2.0

if BOARD_RAYTAC_MDBT53_DB_40_NRF5340_CPUAPP || BOARD_RAYTAC_MDBT53_DB_40_NRF5340_CPUAPP_NS

config BOARD_RAYTAC_MDBT53_DB_40
	select USE_DT_CODE_PARTITION if BOARD_RAYTAC_MDBT53_DB_40_NRF5340_CPUAPP_NS

config HEAP_MEM_POOL_ADD_SIZE_BOARD
	int
	default 4096 if BT_HCI_IPC

endif # BOARD_RAYTAC_MDBT53_DB_40_NRF5340_CPUAPP || BOARD_RAYTAC_MDBT53_DB_40_NRF5340_CPUAPP_NS
```

## boards/realtek/rtl8730e_evb/Kconfig.sysbuild
```kconfig
# Copyright (c) 2026 Realtek Semiconductor Corp.
# SPDX-License-Identifier: Apache-2.0

config RTL8730E_BUILD_KM4_APP
	bool "Build the KM4 network-processor application as a second image"
	help
	  Also build the KM4 (Cortex-M55) application as a sysbuild image.
	  Requires RTL8730E_KM4_APP_SOURCE_DIR.

config RTL8730E_KM4_APP_SOURCE_DIR
	string "Source directory of the KM4 application"
	depends on RTL8730E_BUILD_KM4_APP
	help
	  KM4 application path, absolute or relative to APP_DIR.

config RTL8730E_BUILD_KM0_APP
	bool "Build the KM0 low-power application as a second image"
	help
	  Also build the KM0 (Cortex-M23) application as a sysbuild image, which
	  requires RTL8730E_KM0_APP_SOURCE_DIR. merge_bin.py handle_amebasmart folds
	  its image2 into the CA32 app.bin.

config RTL8730E_KM0_APP_SOURCE_DIR
	string "Source directory of the KM0 application"
	depends on RTL8730E_BUILD_KM0_APP
	help
	  KM0 application path, absolute or relative to APP_DIR.
```
