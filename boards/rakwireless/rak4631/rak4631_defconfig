## boards/rakwireless/rak4631/rak4631_defconfig
```kconfig
# SPDX-License-Identifier: Apache-2.0

# Enable MPU
CONFIG_ARM_MPU=y

# Enable hardware stack protection
CONFIG_HW_STACK_PROTECTION=y

# Enable RTT
CONFIG_USE_SEGGER_RTT=y

# Reassign pinctrl for WisBlock modules
CONFIG_PINCTRL_DYNAMIC=y

# Disable runtime PM by default
CONFIG_PM_DEVICE_RUNTIME_DEFAULT_ENABLE=n
```

## boards/rakwireless/rak5010/Kconfig.defconfig
```kconfig
# RAKWIRELESS RAK5010 Board configuration

# Copyright (c) 2020 Guillaume Paquet <guillaume.paquet@smile.fr>
# Copyright (c) 2026 JaeHwan Jin <jaehwan.jin@rakwireless.com>
# SPDX-License-Identifier: Apache-2.0

if BOARD_RAK5010

source "boards/common/usb/Kconfig.cdc_acm_serial.defconfig"

endif # BOARD_RAK5010
```

## boards/rakwireless/rak5010/board.yml
```yaml
board:
  name: rak5010
  full_name: RAK5010
  vendor: rakwireless
  socs:
  - name: nrf52840
```

## boards/rapidsilicon/virgo_proto/Kconfig.virgo_proto
```kconfig
# Copyright (c) 2024 Rapid Silicon
# SPDX-License-Identifier: Apache-2.0

config BOARD_VIRGO_PROTO
	select SOC_VIRGO
```

## boards/rapidsilicon/virgo_proto/virgo_proto_defconfig
```kconfig
CONFIG_XIP=y
CONFIG_CONSOLE=y
CONFIG_UART_CONSOLE=y

# Serial driver options
CONFIG_SERIAL=y

# GPIO driver options
CONFIG_GPIO=n

# Syscon driver options
CONFIG_SYSCON=n

# hwinfo driver options
CONFIG_HWINFO=n
CONFIG_HWINFO_ANDES=n

# FPU (single precision) options
#CONFIG_FPU=y
#CONFIG_FPU_SHARING=y
#CONFIG_FLOAT_HARD=y
#CONFIG_SINGLE_PRECISION_FPU=y

# FPU (double precision) options
#CONFIG_FPU=y
#CONFIG_FPU_SHARING=y
#CONFIG_FLOAT_HARD=y
#CONFIG_DOUBLE_PRECISION_FPU=y

# HW DSP options
#CONFIG_SOC_ANDES_V5_HWDSP=y

# EXEC.IT options
# CONFIG_SOC_ANDES_V5_EXECIT=y

# Sys Clock HW Cycles for Virgo Proto used by mtimer
CONFIG_SYS_CLOCK_HW_CYCLES_PER_SEC=13333333

# Enabling the SPI Peripheral
CONFIG_SPI=y
CONFIG_SPI_NOR=y

# Enabling the Crypto Peripheral
CONFIG_CRYPTO=y
CONFIG_PUFCC_SECURITY=y
CONFIG_CRYPTO_PUF_SECURITY=y
CONFIG_CRYPTO_PUF_SECURITY_OTP=y

# Enabling the DMA Peripheral
CONFIG_DMA=y
CONFIG_DMA_ANDES_ATCDMAC100=y

# Enabling the SPI and Flash Peripheral
CONFIG_FLASH=y
CONFIG_SPI_NOR_SFDP_DEVICETREE=y
CONFIG_SPI_ANDES_ATCSPI200=y
CONFIG_ANDES_SPI_DMA_MODE=n

# Enabling the Counter Peripheral
CONFIG_COUNTER=y
CONFIG_COUNTER_ANDES_ATCPIT100=y

# Enabling the Sensor Peripheral
CONFIG_SENSOR=y
CONFIG_DTI_PVT=y

# Enable Rapid Silicon Specific IPs
CONFIG_RAPIDSI_OFE=y

# Enable Rapid Silicon Pin Controller
CONFIG_PINCTRL=y
CONFIG_PINCTRL_RAPIDSI=y

# Enable FPGA Bitstream loading functionality
CONFIG_FPGA=y
CONFIG_RS_FPGA=y
CONFIG_RS_FPGA_FCB=y
CONFIG_RS_FPGA_ICB=y
CONFIG_RS_FPGA_PCB=y
```

## boards/raspberry_pi/rpi_pico/Kconfig.defconfig
```kconfig
# Copyright (c) 2021 Yonatan Schachter
# SPDX-License-Identifier: Apache-2.0

if BOARD_RPI_PICO

config RP2_FLASH_W25Q080
	default y

if I2C_DW

config I2C_DW_CLOCK_SPEED
	default 125

endif # I2C_DW

config USB_SELF_POWERED
	default n

endif # BOARD_RPI_PICO
```

## boards/raspberry_pi/rpi_pico/board.yml
```yaml
board:
  name: rpi_pico
  vendor: Raspberry Pi
  socs:
  - name: rp2040
    variants:
    - name: w
```

## boards/raspberrypi/rpi_4b/Kconfig.defconfig
```kconfig
# Copyright (c) 2026 Muhammad Waleed Badar
# SPDX-License-Identifier: Apache-2.0

if BOARD_RPI_4B

if NET_L2_ETHERNET

configdefault NET_BUF_RX_COUNT
	default 270

configdefault NET_RX_STACK_SIZE
	default 3072

configdefault NET_MGMT_EVENT_STACK_SIZE
	default 2048

configdefault NET_TCP_WORKQ_STACK_SIZE
	default 2048

endif # NET_L2_ETHERNET

endif # BOARD_RPI_4B
```

## boards/raspberrypi/rpi_4b/Kconfig.rpi_4b
```kconfig
# Copyright 2023 honglin leng <a909204013@gmail.com>
# SPDX-License-Identifier: Apache-2.0

config BOARD_RPI_4B
	select SOC_BCM2711
```

## boards/raspberrypi/rpi_4b/board.yml
```yaml
board:
  name: rpi_4b
  full_name: Raspberry Pi 4 Model B (Cortex-A72)
  vendor: raspberrypi
  socs:
  - name: bcm2711
```

## boards/raspberrypi/rpi_4b/rpi_4b_defconfig
```kconfig
# SPDX-License-Identifier: Apache-2.0

# ARM CPU and VideoCore GPU requires at least 16M of virtual space
CONFIG_KERNEL_VM_SIZE=0x1000000

# Platform Configuration
CONFIG_ARM64_VA_BITS_36=y
CONFIG_ARM64_PA_BITS_36=y

# MMU Options
CONFIG_MAX_XLAT_TABLES=24

# Serial Drivers
CONFIG_SERIAL=y
CONFIG_UART_INTERRUPT_DRIVEN=y

# Enable Console
CONFIG_CONSOLE=y
CONFIG_UART_CONSOLE=y

# Timer Drivers
CONFIG_TIMER_READS_ITS_FREQUENCY_AT_RUNTIME=y
```

## boards/raspberrypi/rpi_5/Kconfig.rpi_5
```kconfig
# Copyright 2024 Junho Lee <junho@tsnlab.com>
# SPDX-License-Identifier: Apache-2.0

config BOARD_RPI_5
	select SOC_BCM2712
```

## boards/raspberrypi/rpi_5/board.yml
```yaml
board:
  name: rpi_5
  full_name: Raspberry Pi 5 (Cortex-A76)
  vendor: raspberrypi
  socs:
  - name: bcm2712
```

## boards/raspberrypi/rpi_5/rpi_5_defconfig
```kconfig
# SPDX-License-Identifier: Apache-2.0

CONFIG_ARM64_VA_BITS_40=y
CONFIG_ARM64_PA_BITS_40=y
CONFIG_TIMER_READS_ITS_FREQUENCY_AT_RUNTIME=y

# Enable serial console.
CONFIG_SERIAL=y
CONFIG_CONSOLE=y
CONFIG_UART_CONSOLE=y

CONFIG_MFD=y
CONFIG_PCIE=y
CONFIG_PCIE_CONTROLLER=y

CONFIG_NETWORKING=y
CONFIG_NET_L2_ETHERNET=y

CONFIG_ENTROPY_GENERATOR=y

# TODO: Find an appopriate random generator, since this casues a warning.
CONFIG_TEST_RANDOM_GENERATOR=y

CONFIG_POSIX_API=y
CONFIG_POSIX_THREADS=y
CONFIG_POSIX_SPIN_LOCKS=y
```

## boards/raspberrypi/rpi_debug_probe/Kconfig
```kconfig
# Copyright (c) 2025 Jonas Berg
# SPDX-License-Identifier: Apache-2.0

config BOARD_RPI_DEBUG_PROBE
	select RP2_FLASH_W25Q080
```

## boards/raspberrypi/rpi_debug_probe/board.yml
```yaml
board:
  name: rpi_debug_probe
  full_name: Raspberry Pi Debug Probe
  vendor: raspberrypi
  socs:
  - name: rp2040
```

## boards/raspberrypi/rpi_debug_probe/rpi_debug_probe_defconfig
```kconfig
# Copyright (c) 2025 Jonas Berg
# SPDX-License-Identifier: Apache-2.0

CONFIG_BUILD_OUTPUT_HEX=y
CONFIG_BUILD_OUTPUT_UF2=y
CONFIG_CLOCK_CONTROL=y
CONFIG_CONSOLE=y
CONFIG_GPIO=y
CONFIG_RESET=y
CONFIG_SERIAL=y
CONFIG_UART_CONSOLE=y
CONFIG_UART_INTERRUPT_DRIVEN=y
CONFIG_USE_DT_CODE_PARTITION=y
```

## boards/raspberrypi/rpi_pico/Kconfig.defconfig
```kconfig
# Copyright (c) 2021 Yonatan Schachter
# SPDX-License-Identifier: Apache-2.0

if BOARD_RPI_PICO

if I2C_DW

config I2C_DW_CLOCK_SPEED
	default 125

endif # I2C_DW

config USB_SELF_POWERED
	default n

if BOARD_RPI_PICO_RP2040_W && WIFI_AIROC

config MAIN_STACK_SIZE
	default 4096

config HEAP_MEM_POOL_ADD_SIZE_BOARD
	int
	default 16384

endif # BOARD_RPI_PICO_RP2040_W && WIFI_AIROC

endif # BOARD_RPI_PICO
```

## boards/raspberrypi/rpi_pico/board.yml
```yaml
board:
  name: rpi_pico
  full_name: Raspberry Pi Pico
  vendor: raspberrypi
  socs:
  - name: rp2040
    variants:
    - name: w
```

## boards/raspberrypi/rpi_pico/rpi_pico_rp2040_w_defconfig
```kconfig
CONFIG_SYS_CLOCK_HW_CYCLES_PER_SEC=125000000
CONFIG_SERIAL=y
CONFIG_CONSOLE=y
CONFIG_UART_CONSOLE=y
CONFIG_GPIO=y
CONFIG_USE_DT_CODE_PARTITION=y
CONFIG_BUILD_OUTPUT_UF2=y
CONFIG_BUILD_OUTPUT_HEX=y
CONFIG_UART_INTERRUPT_DRIVEN=y
CONFIG_RESET=y
CONFIG_CLOCK_CONTROL=y

# Increase memory areas for WiFi stack
CONFIG_MAIN_STACK_SIZE=4096
CONFIG_HEAP_MEM_POOL_SIZE=16384
CONFIG_SHELL_STACK_SIZE=2560

# Default networking configuration
CONFIG_AIROC_WIFI_COUNTRY="US"
CONFIG_CYW43439=y
```

## boards/raspberrypi/rpi_pico2/Kconfig
```kconfig
# Copyright (c) 2025 Magpie Embedded
# SPDX-License-Identifier: Apache-2.0

config HEAP_MEM_POOL_ADD_SIZE_BOARD
	int
	default 16384 if NETWORKING
```

## boards/raspberrypi/rpi_pico2/Kconfig.defconfig
```kconfig
# Copyright (c) 2024 Andrew Featherstone
# SPDX-License-Identifier: Apache-2.0

if BOARD_RPI_PICO2

config USB_SELF_POWERED
	default n

if WIFI_AIROC

choice AIROC_PART
	default CYW43439
endchoice

config WHD_DISABLE_SDIO_PULLUP_DURING_SPI_SLEEP
	default y

endif # WIFI_AIROC

if I2C_DW

config I2C_DW_CLOCK_SPEED
	default 150

endif # I2C_DW

endif # BOARD_RPI_PICO2
```

## boards/raspberrypi/rpi_pico2/Kconfig.rpi_pico2
```kconfig
# Copyright (c) 2024 Andrew Featherstone
# Copyright (c) 2025 Magpie Embedded
# SPDX-License-Identifier: Apache-2.0

config BOARD_RPI_PICO2
	select SOC_RP2350A_M33 if BOARD_RPI_PICO2_RP2350A_M33 || BOARD_RPI_PICO2_RP2350A_M33_W || BOARD_RPI_PICO2_RP2350A_M33_MCUBOOT || BOARD_RPI_PICO2_RP2350A_M33_W_MCUBOOT
```
