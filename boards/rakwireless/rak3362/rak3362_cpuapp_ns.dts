/*
 * Copyright (c) 2026 RAKwireless Technology Limited
 * SPDX-License-Identifier: Apache-2.0
 */

/dts-v1/;

#define USE_NON_SECURE_ADDRESS_MAP 1

#include <rakwireless/rak3162_cpuapp_ns.dtsi>
#include "rak3362_cpuapp_common.dtsi"

/ {
	chosen {
		zephyr,code-partition = &slot0_ns_partition;
		zephyr,sram = &sram0_ns;
		zephyr,entropy = &psa_rng;
	};

	/delete-node/ rng;

	psa_rng: psa-rng {
		status = "okay";
	};
};

#include <vendor/nordic/nrf54l15_cpuapp_ns_partition.dtsi>
