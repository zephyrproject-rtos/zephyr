## boards/rakwireless/rak3112/board.yml
```yaml
board:
  name: rak3112
  full_name: RAK3112
  vendor: rakwireless
  socs:
  - name: esp32s3
```

## boards/rakwireless/rak3172/Kconfig.rak3172
```kconfig
# Copyright (c) 2024 Kenneth Lu <kuohsianglu@gmail.com>
# SPDX-License-Identifier: Apache-2.0

config BOARD_RAK3172
	select SOC_STM32WLE5XX
```

## boards/rakwireless/rak3172/board.yml
```yaml
board:
  name: rak3172
  full_name: RAK3172
  vendor: rakwireless
  socs:
  - name: stm32wle5xx
```

## boards/rakwireless/rak3172_sip/board.yml
```yaml
board:
  name: rak3172_sip
  full_name: RAKWireless RAK3172-SiP (STM32WLE5CC, HP PA)
  vendor: rakwireless
  socs:
    - name: stm32wle5xx
```

## boards/rakwireless/rak3172lp_sip/board.yml
```yaml
board:
  name: rak3172lp_sip
  full_name: RAKWireless RAK3172-SiP LP (STM32WLE5CC, LP PA)
  vendor: rakwireless
  socs:
    - name: stm32wle5xx
```

## boards/rakwireless/rak3212/Kconfig
```kconfig
# Copyright (c) 2025 Kenneth Lu
# Copyright (c) 2026 JaeHwan Jin <jaehwan.jin@rakwireless.com>
# SPDX-License-Identifier: Apache-2.0

config HEAP_MEM_POOL_ADD_SIZE_BOARD
	int
	default 4096 if BOARD_RAK3212_ESP32S3_PROCPU
	default 256 if BOARD_RAK3212_ESP32S3_APPCPU
```

## boards/rakwireless/rak3212/board.yml
```yaml
board:
  name: rak3212
  full_name: RAK3212 Breakout Board
  vendor: rakwireless
  socs:
  - name: esp32s3
```

## boards/rakwireless/rak3212/rak3212_procpu_defconfig
```kconfig
# Copyright (c) 2025 Kenneth Lu
# SPDX-License-Identifier: Apache-2.0

CONFIG_GPIO=y
CONFIG_CONSOLE=y
CONFIG_SERIAL=y
CONFIG_UART_CONSOLE=y
CONFIG_CLOCK_CONTROL=y
```

## boards/rakwireless/rak3272s/board.yml
```yaml
board:
  name: rak3272s
  full_name: RAK3272S Breakout Board
  vendor: rakwireless
  socs:
  - name: stm32wle5xx
```

## boards/rakwireless/rak3312/Kconfig.sysbuild
```kconfig
# SPDX-License-Identifier: Apache-2.0
# Copyright (c) 2026 RAKwireless Technology Limited

choice BOOTLOADER
	default BOOTLOADER_MCUBOOT
endchoice

choice BOOT_SIGNATURE_TYPE
	default BOOT_SIGNATURE_TYPE_NONE
endchoice
```

## boards/rakwireless/rak3312/rak3312_procpu_defconfig
```kconfig
# SPDX-License-Identifier: Apache-2.0
# Copyright (c) 2026 RAKwireless Technology Limited

CONFIG_CLOCK_CONTROL=y
CONFIG_GPIO=y

# Required for board.c dynamic pinctrl (wisblock_init)
CONFIG_PINCTRL_DYNAMIC=y
CONFIG_PINCTRL_KEEP_SLEEP_STATE=y
```

## boards/rakwireless/rak3362/Kconfig.defconfig
```kconfig
# Copyright (c) 2026 RAKwireless Technology Limited
# SPDX-License-Identifier: Apache-2.0

if BOARD_RAK3362_NRF54L15_CPUAPP

config HAS_BT_CTLR
	default BT

config ROM_START_OFFSET
	default 0x800 if BOOTLOADER_MCUBOOT

endif # BOARD_RAK3362_NRF54L15_CPUAPP

if BOARD_RAK3362_NRF54L15_CPUAPP_NS

config BOARD_RAK3362
	select USE_DT_CODE_PARTITION

config HAS_BT_CTLR
	default BT

config BUILD_WITH_TFM
	default y

endif # BOARD_RAK3362_NRF54L15_CPUAPP_NS
```

## boards/rakwireless/rak3362/Kconfig.rak3362
```kconfig
# Copyright (c) 2026 RAKwireless Technology Limited
# SPDX-License-Identifier: Apache-2.0

config BOARD_RAK3362
	select SOC_NRF54L15_CPUAPP if BOARD_RAK3362_NRF54L15_CPUAPP || \
					BOARD_RAK3362_NRF54L15_CPUAPP_NS
	select SOC_NRF54L15_CPUFLPR if BOARD_RAK3362_NRF54L15_CPUFLPR || \
					BOARD_RAK3362_NRF54L15_CPUFLPR_XIP
```

## boards/rakwireless/rak3362/board.yml
```yaml
board:
  name: rak3362
  full_name: RAK3362 WisBlock Core Module
  vendor: rakwireless
  socs:
  - name: nrf54l15
    variants:
    - name: ns
      cpucluster: cpuapp
    - name: xip
      cpucluster: cpuflpr
```

## boards/rakwireless/rak3362/rak3362_cpuapp_defconfig
```kconfig
# SPDX-License-Identifier: Apache-2.0
# Copyright (c) 2026 RAKwireless Technology Limited

# Enable Clocks
CONFIG_CLOCK_CONTROL=y

# Power Management
CONFIG_PM_DEVICE=y
CONFIG_NRFX_POWER=y

# GPIO
CONFIG_GPIO=y

# Memory Protection
CONFIG_ARM_MPU=y
CONFIG_HW_STACK_PROTECTION=y
CONFIG_NULL_POINTER_EXCEPTION_DETECTION_NONE=y

# Cache
CONFIG_CACHE_MANAGEMENT=y
CONFIG_EXTERNAL_CACHE=y

# GRTC system timer
CONFIG_NRF_GRTC_START_SYSCOUNTER=y

# Regulator
CONFIG_REGULATOR=y
CONFIG_REGULATOR_FIXED_INIT_PRIORITY=45

# Required for board.c dynamic pinctrl (wisblock_init)
CONFIG_PINCTRL_DYNAMIC=y
CONFIG_PINCTRL_KEEP_SLEEP_STATE=y
```

## boards/rakwireless/rak3362/rak3362_cpuapp_ns_defconfig
```kconfig
# SPDX-License-Identifier: Apache-2.0
# Copyright (c) 2026 RAKwireless Technology Limited

# Memory Protection
CONFIG_ARM_MPU=y
CONFIG_NULL_POINTER_EXCEPTION_DETECTION_NONE=y

# TrustZone Non-Secure
CONFIG_ARM_TRUSTZONE_M=y
CONFIG_TRUSTED_EXECUTION_NONSECURE=y

# Cache is a secure-only peripheral on nRF54L15
CONFIG_CACHE_MANAGEMENT=n
CONFIG_EXTERNAL_CACHE=n

# GPIO
CONFIG_GPIO=y

# GRTC system timer
CONFIG_NRF_GRTC_START_SYSCOUNTER=y

# TF-M
CONFIG_TFM_BL2=n
CONFIG_TFM_LOG_LEVEL_SILENCE=y

# CRACEN is a secure-only peripheral, NS image accesses entropy via PSA
CONFIG_ENTROPY_GENERATOR=y

# Oscillators are secure; skip nrfx clock config to avoid bus fault
CONFIG_NRF_SKIP_CLOCK_CONFIG=y

# Required for board.c dynamic pinctrl (wisblock_init)
CONFIG_PINCTRL_DYNAMIC=y
CONFIG_PINCTRL_KEEP_SLEEP_STATE=y
```

## boards/rakwireless/rak3362/rak3362_cpuflpr_defconfig
```kconfig
# SPDX-License-Identifier: Apache-2.0
# Copyright (c) 2026 RAKwireless Technology Limited

# GPIO
CONFIG_GPIO=y

# Execute from SRAM
CONFIG_XIP=n
```

## boards/rakwireless/rak3362/rak3362_cpuflpr_xip_defconfig
```kconfig
# SPDX-License-Identifier: Apache-2.0
# Copyright (c) 2026 RAKwireless Technology Limited

# GPIO
CONFIG_GPIO=y

# Execute from RRAM
CONFIG_XIP=y
```

## boards/rakwireless/rak3372/rak3372_defconfig
```kconfig
# SPDX-License-Identifier: Apache-2.0
# Copyright (c) 2026 RAKwireless Technology Limited

# Enable Clocks
CONFIG_CLOCK_CONTROL=y

# Enable MPU
CONFIG_ARM_MPU=y

# Enable HW stack protection
CONFIG_HW_STACK_PROTECTION=y

# Required for board.c dynamic pinctrl (wisblock_init)
CONFIG_PINCTRL_DYNAMIC=y
CONFIG_PINCTRL_KEEP_SLEEP_STATE=y
```

## boards/rakwireless/rak4631/Kconfig.defconfig
```kconfig
# RAKWIRELESS RAK4631 Board configuration

# Copyright (c) 2021 Guillaume Paquet <guillaume.paquet@smile.fr>
# SPDX-License-Identifier: Apache-2.0

if BOARD_RAK4631

config WISBLOCK_CORE_BOARD_VENDOR
	string
	default "RAKwireless"

config WISBLOCK_CORE_BOARD_NAME
	string
	default "RAK4631 WisBlock LoRaWAN Module"

endif # BOARD_RAK4631
```

## boards/rakwireless/rak4631/board.yml
```yaml
board:
  name: rak4631
  full_name: RAK4631 WisBlock Core Module
  vendor: rakwireless
  socs:
  - name: nrf52840
```
