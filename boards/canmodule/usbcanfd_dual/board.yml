## boards/canmodule/usbcanfd_dual/board.yml
```yaml
board:
  name: usbcanfd_dual
  full_name: USBCANFD DUAL
  vendor: canmodule
  socs:
    - name: stm32g473xx
```

## boards/canmodule/usbcanfd_solo/board.yml
```yaml
board:
  name: usbcanfd_solo
  full_name: USBCANFD SOLO
  vendor: canmodule
  socs:
    - name: stm32g431xx
```

## boards/cdac/aries_v3/Kconfig.aries_v3
```kconfig
# Copyright (c) 2026 Anuj Deshpande
# SPDX-License-Identifier: Apache-2.0

config BOARD_ARIES_V3
	select SOC_THEJAS32
```

## boards/cdac/aries_v3/board.yml
```yaml
board:
  name: aries_v3
  full_name: ARIES v3.0 Development Board
  vendor: cdac
  socs:
    - name: thejas32
```

## boards/cdns/swerv/Kconfig
```kconfig
# Copyright (c) 2026 Intel Corporation
#
# SPDX-License-Identifier: Apache-2.0

config BOARD_CDNS_SWERV
	select 64BIT if BOARD_CDNS_SWERV_S420_64_WHISPER
```

## boards/cdns/swerv/Kconfig.cdns_swerv
```kconfig
# Copyright (c) 2026 Intel Corporation
#
# SPDX-License-Identifier: Apache-2.0

config BOARD_CDNS_SWERV
	select SOC_FAMILY_CDNS_SWERV
	select SOC_S400 if BOARD_CDNS_SWERV_S400_WHISPER
	select SOC_S400 if BOARD_CDNS_SWERV_S400_PMP_WHISPER
	select SOC_S420 if BOARD_CDNS_SWERV_S420_WHISPER
	select SOC_S420_64 if BOARD_CDNS_SWERV_S420_64_WHISPER
```

## boards/cdns/swerv/Kconfig.defconfig
```kconfig
# Copyright (c) 2026 Intel Corporation
#
# SPDX-License-Identifier: Apache-2.0

if BOARD_CDNS_SWERV

config BUILD_OUTPUT_BIN
	default n

config SYS_CLOCK_HW_CYCLES_PER_SEC
	default $(dt_node_int_prop_int,/cpus/cpu@0,clock-frequency)

config SYS_CLOCK_TICKS_PER_SEC
	default 100 if WHISPER_TARGET

endif

if BOARD_CDNS_SWERV_S400_WHISPER || BOARD_CDNS_SWERV_S400_PMP_WHISPER

# 32 in core RISC-V by MIE CSR
# 256 in SweRV PIC for external interrupts
config NUM_IRQS
	default 288

config SWERV_PIC_MAX_GENERIC_IRQ
	default 31

config WHISPER_TARGET
	default y

endif # BOARD_CDNS_SWERV_S400_WHISPER || BOARD_CDNS_SWERV_S400_PMP_WHISPER

if BOARD_CDNS_SWERV_S420_WHISPER

# 32 in core RISC-V by MIE CSR
# 256 in SweRV PIC for external interrupts
config NUM_IRQS
	default 288

config SWERV_PIC_MAX_GENERIC_IRQ
	default 31

config WHISPER_TARGET
	default y

config WHISPER_USE_SWINT
	default y

config WHISPER_SWINT_BASE_ADDRESS
	default 0x02000000

endif # BOARD_CDNS_SWERV_S420_WHISPER

if BOARD_CDNS_SWERV_S420_64_WHISPER

# 32 in core RISC-V by MIE CSR
# 256 in SweRV PIC for external interrupts
config NUM_IRQS
	default 288

config SWERV_PIC_MAX_GENERIC_IRQ
	default 31

config WHISPER_TARGET
	default y

config WHISPER_USE_SWINT
	default y

config WHISPER_SWINT_BASE_ADDRESS
	default 0x02000000

endif # BOARD_CDNS_SWERV_S420_64_WHISPER
```

## boards/cdns/swerv/board.yml
```yaml
board:
  name: cdns_swerv
  full_name: Cadence SweRV based boards
  vendor: cdns
  socs:
    - name: s400
      variants:
        - name: whisper
        - name: pmp
          variants:
            - name: whisper
    - name: s420
      variants:
        - name: whisper
    - name: s420_64
      variants:
        - name: whisper
```

## boards/cdns/swerv/cdns_swerv_s400_whisper_defconfig
```kconfig
# Copyright (c) 2026 Intel Corporation
#
# SPDX-License-Identifier: Apache-2.0

CONFIG_CONSOLE=y
CONFIG_SERIAL=y
CONFIG_WHISPER_CONSOLE=y
CONFIG_XIP=n

# MRAC - Region Access Control CSR
#   0x0000_0000 - 0x0FFF_FFFF is cacheable
#   0x4000_0000 - 0x4FFF_FFFF has side-effect
#   0xF000_0000 - 0xFFFF_FFFF has side-effect
CONFIG_SOC_CDNS_SWERV_BOOT_MRAC=0x80000201
```

## boards/cdns/swerv/cdns_swerv_s420_64_whisper_defconfig
```kconfig
# Copyright (c) 2026 Intel Corporation
#
# SPDX-License-Identifier: Apache-2.0

CONFIG_CONSOLE=y
CONFIG_SERIAL=y
CONFIG_WHISPER_CONSOLE=y
CONFIG_XIP=n
```

## boards/cdns/swerv/cdns_swerv_s420_whisper_defconfig
```kconfig
# Copyright (c) 2026 Intel Corporation
#
# SPDX-License-Identifier: Apache-2.0

CONFIG_CONSOLE=y
CONFIG_SERIAL=y
CONFIG_WHISPER_CONSOLE=y
CONFIG_XIP=n

# MRAC - Region Access Control CSR
CONFIG_SOC_CDNS_SWERV_BOOT_MRAC=0x55555555
```

## boards/cdns/xt-sim/Kconfig.xt-sim
```kconfig
# XTENSA board configuration

# Copyright (c) 2016 Cadence Design Systems, Inc.
# SPDX-License-Identifier: Apache-2.0

config BOARD_XT_SIM
	select SOC_XTENSA_SAMPLE_CONTROLLER
```

## boards/cdns/xt-sim/board.yml
```yaml
board:
  name: xt-sim
  full_name: Xtensa simulator
  vendor: cdns
  socs:
  - name: xtensa_sample_controller
```

## boards/cdns/xt-sim/xt-sim_defconfig
```kconfig
# SPDX-License-Identifier: Apache-2.0

CONFIG_MAIN_STACK_SIZE=2048
CONFIG_CONSOLE=y

CONFIG_GEN_ISR_TABLES=y
CONFIG_GEN_IRQ_VECTOR_TABLE=n
CONFIG_SIMULATOR_XTENSA=y

CONFIG_SYS_CLOCK_HW_CYCLES_PER_SEC=2000000
```

## boards/chipyard/arty/board.yml
```yaml
board:
  name: chipyard_arty
  full_name: Chipyard ARTY SoCs
  vendor: chipyard 
  socs:
    - name: rocketchip_virt_riscv64
      variants:
        - name: smp
```

## boards/chipyard/cygnus/Kconfig.defconfig
```kconfig
if BOARD_CHIPYARD_CYGNUS

config BUILD_OUTPUT_BIN
	default n

config HAS_COVERAGE_SUPPORT
	default y

config QEMU_ICOUNT_SHIFT
	default 6 if QEMU_ICOUNT

endif # BOARD_CHIPYARD_CYGNUS
```

## boards/chipyard/cygnus/board.yml
```yaml
board:
  name: chipyard_cygnus
  full_name: Chipyard RISCV64 SoCs
  vendor: chipyard 
  socs:
    - name: rocketchip_virt_riscv64
      variants:
        - name: smp
```

## boards/chipyard/cygnus/chipyard_cygnus_defconfig
```kconfig
# SPDX-License-Identifier: Apache-2.0

CONFIG_PRIVILEGED_STACK_SIZE=2048
CONFIG_REBOOT=y
CONFIG_UART_HTIF=y
CONFIG_CONSOLE=y
CONFIG_UART_CONSOLE=y
CONFIG_SERIAL=y
CONFIG_PRINTK=y
CONFIG_EARLY_CONSOLE=y
CONFIG_STACK_SENTINEL=y
CONFIG_XIP=n
CONFIG_RISCV_PMP=n
CONFIG_SMP=n
CONFIG_MP_MAX_NUM_CPUS=1
CONFIG_IDLE_STACK_SIZE=1024
CONFIG_QEMU_ICOUNT=n
CONFIG_PINCTRL=n
CONFIG_UART_SIFIVE_PORT_0=y

CONFIG_FPU=y
CONFIG_FP_HARDABI=y  # Use lp64d for hard float
CONFIG_SPEED_OPTIMIZATIONS=y


CONFIG_FPU=y
CONFIG_FLOAT_HARD=y
CONFIG_FPU_SHARING=y

CONFIG_SYS_CLOCK_HW_CYCLES_PER_SEC=40000
CONFIG_SYS_CLOCK_TICKS_PER_SEC=10000
CONFIG_RTC_CLOCK_DIVIDER_VALUE=500

CONFIG_TIMING_FUNCTIONS=y
CONFIG_SPEED_OPTIMIZATIONS=y

CONFIG_DEBUG=y
CONFIG_LOG_DEFAULT_LEVEL=4

CONFIG_RISCV_ISA_EXT_V_LAZY=n

CONFIG_MP_MAX_NUM_CPUS=8
```

## boards/chipyard/dsp24/board.yml
```yaml
board:
  name: chipyard_dsp24
  full_name: DSP24 SoC from Berkeley Tapeout Class
  vendor: chipyard 
  socs:
    - name: rocketchip_virt_riscv64
      variants:
        - name: smp
```
