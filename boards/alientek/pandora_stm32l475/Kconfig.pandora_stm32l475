## boards/alientek/pandora_stm32l475/Kconfig.pandora_stm32l475
```kconfig
# Copyright (c) 2023 Tisilicon
# SPDX-License-Identifier: Apache-2.0

config BOARD_PANDORA_STM32L475
	select SOC_STM32L475XX
```

## boards/alientek/pandora_stm32l475/board.yml
```yaml
board:
  name: pandora_stm32l475
  full_name: STM32L475 Pandora
  vendor: alientek
  socs:
    - name: stm32l475xx
```

## boards/alif/balletto_b1_dk/Kconfig.balletto_b1_dk
```kconfig
# SPDX-FileCopyrightText: Copyright Alif Semiconductor
# SPDX-License-Identifier: Apache-2.0

config BOARD_BALLETTO_B1_DK
	select SOC_AB1C1F4M51820PH0 if BOARD_BALLETTO_B1_DK_AB1C1F4M51820PH0
```

## boards/alif/balletto_b1_dk/board.yml
```yaml
board:
  name: balletto_b1_dk
  full_name: Alif Balletto B1 Development Kit
  vendor: alif
  socs:
  - name: ab1c1f4m51820ph0
```

## boards/alif/ensemble_e1c_dk/Kconfig.ensemble_e1c_dk
```kconfig
# SPDX-FileCopyrightText: Copyright Alif Semiconductor
# SPDX-License-Identifier: Apache-2.0

config BOARD_ENSEMBLE_E1C_DK
	select SOC_AE1C1F4051920PH0_RTSS_HE if BOARD_ENSEMBLE_E1C_DK_AE1C1F4051920PH0_RTSS_HE
```

## boards/alif/ensemble_e1c_dk/board.yml
```yaml
board:
  name: ensemble_e1c_dk
  full_name: Alif Ensemble E1C Development Kit
  vendor: alif
  socs:
  - name: ae1c1f4051920ph0
```

## boards/alif/ensemble_e8_ak/ensemble_e8_ak_ae822fa0e5597bs0_apss_defconfig
```kconfig
# SPDX-FileCopyrightText: Copyright Alif Semiconductor
# SPDX-License-Identifier: Apache-2.0

CONFIG_SERIAL=y
CONFIG_CONSOLE=y
CONFIG_UART_CONSOLE=y
CONFIG_UART_INTERRUPT_DRIVEN=y
```

## boards/alif/ensemble_e8_dk/Kconfig.ensemble_e8_dk
```kconfig
# Copyright (c) 2025 Alif Semiconductor
#
# SPDX-License-Identifier: Apache-2.0

config BOARD_ENSEMBLE_E8_DK
	select SOC_AE822FA0E5597LS0_RTSS_HE if BOARD_ENSEMBLE_E8_DK_AE822FA0E5597LS0_RTSS_HE
	select SOC_AE822FA0E5597LS0_RTSS_HP if BOARD_ENSEMBLE_E8_DK_AE822FA0E5597LS0_RTSS_HP
```

## boards/alif/ensemble_e8_dk/board.yml
```yaml
board:
  name: ensemble_e8_dk
  full_name: Alif Ensemble E8 Development Kit
  vendor: alif
  socs:
  - name: ae612fa0e5597ls0
  - name: ae822fa0e5597ls0
```

## boards/alif/ensemble_e8_dk/ensemble_e8_dk_ae822fa0e5597ls0_rtss_hp_defconfig
```kconfig
# Copyright (c) 2025 Alif Semiconductor
# SPDX-License-Identifier: Apache-2.0

CONFIG_ARM_MPU=y
CONFIG_HW_STACK_PROTECTION=y

CONFIG_SERIAL=y
CONFIG_CONSOLE=y
CONFIG_UART_CONSOLE=y
CONFIG_UART_INTERRUPT_DRIVEN=y
CONFIG_UART_NS16550=y
```

## boards/altera/altera_max10/Kconfig.altera_max10
```kconfig
# SPDX-License-Identifier: Apache-2.0

config BOARD_ALTERA_MAX10
	select SOC_ZEPHYR_NIOS2F
```

## boards/altera/altera_max10/board.yml
```yaml
board:
  name: altera_max10
  vendor: Altera Corporation
  socs:
  - name: zephyr_nios2f
```

## boards/altera_max10/altera_max10_defconfig
```kconfig
CONFIG_NIOS2=y
CONFIG_SOC_NIOS2F_ZEPHYR=y
CONFIG_BOARD_ALTERA_MAX10=y
CONFIG_CONSOLE=y
CONFIG_PRINTK=y
CONFIG_SERIAL=y
CONFIG_UART_NS16550=y
CONFIG_UART_CONSOLE=y
```

## boards/altr/max10/Kconfig.altera_max10
```kconfig
# SPDX-License-Identifier: Apache-2.0
# Copyright (c) 2018 Intel

config BOARD_ALTERA_MAX10
	select SOC_ZEPHYR_NIOS2F
```

## boards/altr/max10/Kconfig.defconfig
```kconfig
# SPDX-License-Identifier: Apache-2.0
# Copyright (c) 2018 Intel

if BOARD_ALTERA_MAX10

if FLASH

config SOC_FLASH_NIOS2_QSPI
	default y

endif # FLASH

endif # BOARD_ALTERA_MAX10
```

## boards/altr/max10/altera_max10_zephyr_nios2f_defconfig
```kconfig
# SPDX-License-Identifier: Apache-2.0
# Copyright (c) 2018 Intel

CONFIG_HAS_ALTERA_HAL=y
CONFIG_CONSOLE=y
CONFIG_SERIAL=y
CONFIG_UART_CONSOLE=y
```

## boards/altr/max10/board.yml
```yaml
board:
  name: altera_max10
  full_name: MAX10
  vendor: altr
  socs:
  - name: zephyr_nios2f
```

## boards/amat/calico/Kconfig.calico
```kconfig
# SPDX-License-Identifier: Apache-2.0
#
# Copyright (c) 2023 Antmicro <www.antmicro.com>

config BOARD_CALICO
	select SOC_APOLLO4P
	select HAS_SEGGER_RTT if ZEPHYR_SEGGER_MODULE
```

## boards/amat/calico/calico_defconfig
```kconfig
# SPDX-License-Identifier: Apache-2.0
#
# Copyright (c) 2023 Antmicro <www.antmicro.com>

CONFIG_USE_SEGGER_RTT=y

#console log
CONFIG_LOG=y
CONFIG_LOG_BACKEND_SWO=y
CONFIG_LOG_BACKEND_SWO_FREQ_HZ=1000000

CONFIG_PINCTRL=y
CONFIG_I2C=y
CONFIG_GPIO=y
CONFIG_REGULATOR=y


CONFIG_SHELL=y
CONFIG_SHELL_STACK_SIZE=1024
CONFIG_SHELL_BACKEND_SERIAL=n
CONFIG_SHELL_BACKEND_RTT=y
CONFIG_SHELL_CMDS=y
CONFIG_SHELL_ECHO_STATUS=y
CONFIG_SHELL_HELP=y
CONFIG_SHELL_PRINTF_BUFF_SIZE=30

#shell commands
CONFIG_GPIO_SHELL=y
CONFIG_I2C_SHELL=y
```

## boards/ambiq/apollo2_evb/Kconfig.apollo2_evb
```kconfig
# SPDX-License-Identifier: Apache-2.0
#
# Copyright (c) 2025 Linumiz GmbH
# Author: Sri Surya  <srisurya@linumiz.com>

config BOARD_APOLLO2_EVB
	select SOC_APOLLO2
```

## boards/ambiq/apollo2_evb/apollo2_evb_defconfig
```kconfig
# SPDX-License-Identifier: Apache-2.0
#
#  Copyright (c) 2025 Linumiz GmbH
#  Author: Sri Surya  <srisurya@linumiz.com>

CONFIG_CONSOLE=y
CONFIG_UART_CONSOLE=y
CONFIG_SERIAL=y
CONFIG_UART_INTERRUPT_DRIVEN=y
```

## boards/ambiq/apollo2_evb/board.yml
```yaml
board:
  name: apollo2_evb
  full_name: Apollo2 EVB
  vendor: ambiq
  socs:
  - name: apollo2
```

## boards/ambiq/apollo3_evb/Kconfig.apollo3_evb
```kconfig
# SPDX-License-Identifier: Apache-2.0
#
# Copyright (c) 2023 Ambiq Micro Inc. <www.ambiq.com>

config BOARD_APOLLO3_EVB
	select SOC_APOLLO3_BLUE
```
