/*
 * Copyright (c) 2026 The Zephyr Project Contributors
 *
 * SPDX-License-Identifier: Apache-2.0
 */

/dts-v1/;
#include "dnn647_common.dtsi"

/ {
	model = "Alientek DNN647 board";
	compatible = "alientek,dnn647-fsbl";

	aliases {
		mcuboot-button0 = &wk_up;
	};
};

&xspim {
	status = "okay";
};
