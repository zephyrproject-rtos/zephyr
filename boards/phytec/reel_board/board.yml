## boards/phytec/reel_board/board.yml
```yaml
board:
  name: reel_board
  full_name: reel board
  vendor: phytec
  socs:
  - name: nrf52840
  revision:
    format: number
    default: "1"
    revisions:
    - name: "1"
    - name: "2"
```

## boards/pimoroni/pico_plus2/Kconfig.defconfig
```kconfig
# Copyright (c) 2024 TOKITA Hiroshi
# SPDX-License-Identifier: Apache-2.0

if BOARD_PICO_PLUS2

config USB_SELF_POWERED
	default n

endif # BOARD_PICO_PLUS2
```

## boards/pimoroni/pico_plus2/Kconfig.pico_plus2
```kconfig
# Copyright (c) 2024 TOKITA Hiroshi
# SPDX-License-Identifier: Apache-2.0

config BOARD_PICO_PLUS2
	select SOC_RP2350B_M33 if BOARD_PICO_PLUS2_RP2350B_M33
```

## boards/pimoroni/pico_plus2/board.yml
```yaml
board:
  name: pico_plus2
  full_name: Pimoroni Pico Plus2
  vendor: pimoroni
  socs:
    - name: rp2350b
      variants:
        - name: w
          cpucluster: m33
```

## boards/pimoroni/tiny2040/Kconfig
```kconfig
# Copyright (c) 2026 Jonas Berg
# SPDX-License-Identifier: Apache-2.0

config BOARD_TINY2040
	select RP2_FLASH_W25Q080
```

## boards/pimoroni/tiny2040/Kconfig.tiny2040
```kconfig
# Copyright (c) 2026 Jonas Berg
# SPDX-License-Identifier: Apache-2.0

config BOARD_TINY2040
	select SOC_RP2040
```

## boards/pimoroni/tiny2040/board.yml
```yaml
board:
  name: tiny2040
  full_name: Pimoroni Tiny 2040
  vendor: pimoroni
  socs:
  - name: rp2040
```

## boards/pine64/pinecil_v2/Kconfig.defconfig
```kconfig
# Copyright (c) 2026 Canonical Limited
# SPDX-License-Identifier: Apache-2.0

if BOARD_PINECIL_V2

source "boards/common/usb/Kconfig.cdc_acm_serial.defconfig"

endif # BOARD_PINECIL_V2
```

## boards/pine64/pinecil_v2/Kconfig.pinecil_v2
```kconfig
# Copyright (c) 2026 Canonical Limited
# SPDX-License-Identifier: Apache-2.0

config BOARD_PINECIL_V2
	select SOC_BL706C10Q2I
```

## boards/pine64/pinecil_v2/board.yml
```yaml
# Copyright (c) 2026 Canonical Limited
# SPDX-License-Identifier: Apache-2.0

board:
  name: pinecil_v2
  full_name: Pine64 Pinecil v2
  vendor: pine64
  socs:
    - name: bl706c10q2i
```

## boards/pine64/pinecil_v2/pinecil_v2_defconfig
```kconfig
# Copyright (c) 2026 Canonical Limited
# SPDX-License-Identifier: Apache-2.0

CONFIG_GPIO=y
CONFIG_CONSOLE=y
CONFIG_SERIAL=y
CONFIG_UART_CONSOLE=y
CONFIG_USBD_CDC_ACM_CLASS=y
```

## boards/pine64/pinetime_devkit0/Kconfig.defconfig
```kconfig
# PineTime DevKit0 board configuration

# Copyright (c) 2020 Stephane Dorre <stephane.dorre@gmail.com>
# SPDX-License-Identifier: Apache-2.0

if BOARD_PINETIME_DEVKIT0

config INPUT
	default y if LVGL

if FLASH

config SPI_NOR_FLASH_LAYOUT_PAGE_SIZE
	default 4096

endif # FLASH

endif # BOARD_PINETIME_DEVKIT0
```

## boards/pine64/pinetime_devkit0/board.yml
```yaml
board:
  name: pinetime_devkit0
  full_name: PineTime DevKit0
  vendor: pine64
  socs:
  - name: nrf52832
```

## boards/pine64/pinetime_devkit0/pinetime_devkit0_defconfig
```kconfig
# SPDX-License-Identifier: Apache-2.0

CONFIG_ARM_MPU=y

CONFIG_GPIO=y

CONFIG_SERIAL=y

CONFIG_CONSOLE=y
CONFIG_UART_CONSOLE=y
```

## boards/pjrc/teensy4/Kconfig.teensy40
```kconfig
#
# Copyright (c) 2020, Bernhard Kraemer
# Copyright 2024 NXP
#
# SPDX-License-Identifier: Apache-2.0
#

config BOARD_TEENSY40
	select SOC_PART_NUMBER_MIMXRT1062DVJ6A
```

## boards/pjrc/teensy4/Kconfig.teensy41
```kconfig
#
# Copyright (c) 2020, Bernhard Kraemer
# Copyright 2024 NXP
#
# SPDX-License-Identifier: Apache-2.0
#

config BOARD_TEENSY41
	select SOC_PART_NUMBER_MIMXRT1062DVL6A
```

## boards/pjrc/teensy4/board.yml
```yaml
boards:
  - name: teensy40
    full_name: Teensy 4.0
    vendor: pjrc
    socs:
      - name: mimxrt1062
  - name: teensy41
    full_name: Teensy 4.1
    vendor: pjrc
    socs:
      - name: mimxrt1062
  - name: teensymm
    full_name: Teensy MicroMod
    vendor: pjrc
    socs:
      - name: mimxrt1062
```

## boards/pjrc/teensy4/teensymm_defconfig
```kconfig
#
# Copyright (c) 2020, Bernhard Kraemer
#
# SPDX-License-Identifier: Apache-2.0
#

CONFIG_DEVICE_CONFIGURATION_DATA=n
CONFIG_CONSOLE=y
CONFIG_UART_CONSOLE=y
CONFIG_SERIAL=y
CONFIG_GPIO=y
CONFIG_SYS_CLOCK_HW_CYCLES_PER_SEC=600000000
CONFIG_ARM_MPU=y
CONFIG_HW_STACK_PROTECTION=y
```

## boards/posix/native_posix/Kconfig
```kconfig
# SPDX-License-Identifier: Apache-2.0

config BOARD_NATIVE_POSIX
	bool
	imply NATIVE_POSIX_TIMER
	select POSIX_ARCH_CONSOLE
	select NATIVE_APPLICATION

if BOARD_NATIVE_POSIX

comment "Native POSIX options"

config NATIVE_POSIX_SLOWDOWN_TO_REAL_TIME
	bool "Slow down execution to real time"
	default n if ARCH_POSIX_LIBFUZZER
	default y if BT_USERCHAN || !TEST
	help
	  When selected the execution of the process will be slowed down to real time.
	  (if there is a lot of load it may be slower than real time)
	  If deselected, the process will run as fast as possible.
	  Note that this only decouples simulated time from real/wall time. In either
	  case the zephyr kernel and application cannot tell the difference unless they
	  interact with some other driver/device which runs at real time.

source "boards/$(ARCH)/common/sdl/Kconfig"

endif # BOARD_NATIVE_POSIX
```

## boards/posix/native_posix/Kconfig.board
```kconfig
# SPDX-License-Identifier: Apache-2.0

config BOARD_NATIVE_POSIX_32BIT
	bool "Native POSIX for 32-bit host"
	depends on SOC_POSIX
	select BOARD_NATIVE_POSIX
	help
	  Will produce a console Linux process which can be executed natively
	  as a 32-bit executable.
	  It provides some minimal needed models:
	  An interrupt controller, timer (system tick), and redirects kernel prints to
	  stdout.

config BOARD_NATIVE_POSIX_64BIT
	bool "Native POSIX for 64-bit host"
	depends on SOC_POSIX
	select BOARD_NATIVE_POSIX
	select 64BIT
	help
	  Will produce a console Linux process which can be executed natively
	  as a 64-bit executable.
	  It provides some minimal needed models:
	  An interrupt controller, timer (system tick), and redirects kernel prints to
	  stdout.
```

## boards/posix/native_posix/Kconfig.defconfig
```kconfig
# SPDX-License-Identifier: Apache-2.0

if BOARD_NATIVE_POSIX

config BUILD_OUTPUT_BIN
	default n

config BUILD_OUTPUT_EXE
	default y

config OUTPUT_PRINT_MEMORY_USAGE
	default n

config BOARD
	default "native_posix_64" if BOARD_NATIVE_POSIX_64BIT
	default "native_posix"

if NETWORKING

config NET_L2_ETHERNET
	default y if !NET_LOOPBACK && !NET_TEST

config ETH_NATIVE_POSIX
	default y if NET_L2_ETHERNET

endif # NETWORKING

config FAKE_ENTROPY_NATIVE_POSIX
	default y
	depends on ENTROPY_GENERATOR

choice BT_HCI_BUS_TYPE
	default BT_USERCHAN
	depends on BT_HCI
endchoice

config UART_NATIVE_POSIX
	default y
	depends on SERIAL

if LOG

# For native_posix we can log synchronously without any problem
# Doing so will be nicer for debugging
choice LOG_MODE
	default LOG_MODE_IMMEDIATE
endchoice

endif # LOG

if CONSOLE

config NATIVE_POSIX_CONSOLE
	default y if !SERIAL

config UART_CONSOLE
	default y if SERIAL

endif # CONSOLE

config SDL_DISPLAY
	default y
	depends on DISPLAY

config KSCAN_SDL
	default y
	depends on KSCAN

config FLASH_SIMULATOR
	default y
	depends on FLASH

config USB_NATIVE_POSIX
	default y
	depends on USB_DEVICE_DRIVER

config EEPROM_SIMULATOR
	default y
	depends on EEPROM

if I2C

config EMUL
	default y

config I2C_EMUL
	default y

endif # I2C

endif # BOARD_NATIVE_POSIX
```

## boards/posix/native_posix/Kconfig.native_posix
```kconfig
# Copyright (c) 2022 Zephyr Project members and individual contributors
# SPDX-License-Identifier: Apache-2.0

config BOARD_NATIVE_POSIX
	bool
	default y
	select SOC_POSIX
	select NATIVE_POSIX_TIMER
	select NATIVE_POSIX_CONSOLE
```

## boards/posix/native_posix/Kconfig.native_posix_64
```kconfig
# Copyright (c) 2022 Zephyr Project members and individual contributors
# SPDX-License-Identifier: Apache-2.0

config BOARD_NATIVE_POSIX_64
	bool
	default y
	select SOC_POSIX
	select 64BIT
	select NATIVE_POSIX_TIMER
	select NATIVE_POSIX_CONSOLE
```

## boards/posix/native_posix/native_posix_64_defconfig
```kconfig
# SPDX-License-Identifier: Apache-2.0

CONFIG_SOC_POSIX=y
CONFIG_BOARD_NATIVE_POSIX_64BIT=y
CONFIG_CONSOLE=y
CONFIG_SYS_CLOCK_HW_CYCLES_PER_SEC=1000000
```

## boards/posix/native_posix/native_posix_defconfig
```kconfig
# SPDX-License-Identifier: Apache-2.0

CONFIG_SOC_POSIX=y
CONFIG_BOARD_NATIVE_POSIX_32BIT=y
CONFIG_CONSOLE=y
CONFIG_SYS_CLOCK_HW_CYCLES_PER_SEC=1000000
# For native_posix we can log synchronously without any problem
# Doing so will be nicer for debugging
CONFIG_LOG_MODE_IMMEDIATE=y
```
