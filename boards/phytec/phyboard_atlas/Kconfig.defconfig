## boards/phytec/phyboard_atlas/Kconfig.defconfig
```kconfig
# PHYBOARD-ATLAS

# Copyright (c) 2025 PHYTEC America, LLC
# SPDX-License-Identifier: Apache-2.0

if BOARD_PHYBOARD_ATLAS

if CPU_CORTEX_M7

# Use External Memory Configuration Data (XMCD) by default when booting primary core (M7)
config EXTERNAL_MEM_CONFIG_DATA
	default y

config NXP_IMX_EXTERNAL_SDRAM
	default y

configdefault NET_L2_ETHERNET
	default y # No cache memory support is required for driver

endif # CPU_CORTEX_M7

if SECOND_CORE_MCUX && CPU_CORTEX_M4

config BUILD_OUTPUT_INFO_HEADER
	default y

DT_CHOSEN_IMAGE_M4 = nxp,m4-partition

# Adjust the offset of the output image if building for RT11xx SOC
config BUILD_OUTPUT_ADJUST_LMA
	default "($(dt_chosen_reg_addr_hex,$(DT_CHOSEN_IMAGE_M4)) + \
	$(dt_node_reg_addr_hex,/soc/spi@400cc000,1)) - \
	$(dt_node_reg_addr_hex,/soc/ocram@20200000)"

endif # SECOND_CORE_MCUX && CPU_CORTEX_M4

endif # BOARD_PHYBOARD_ATLAS
```

## boards/phytec/phyboard_atlas/Kconfig.phyboard_atlas
```kconfig
#
# Copyright 2025 PHYTEC America, LLC
#
# SPDX-License-Identifier: Apache-2.0

config BOARD_PHYBOARD_ATLAS
	select SOC_PART_NUMBER_MIMXRT1176DVMAA
	select SOC_MIMXRT1176_CM7 if BOARD_PHYBOARD_ATLAS_MIMXRT1176_CM7
```

## boards/phytec/phyboard_atlas/board.yml
```yaml
board:
  name: phyboard_atlas
  full_name: phyBOARD-Atlas i.MX RT1170
  vendor: phytec
  socs:
    - name: mimxrt1176
```

## boards/phytec/phyboard_atlas/phyboard_atlas_mimxrt1176_cm7_defconfig
```kconfig
# Copyright (c) 2025 PHYTEC America LLC
# SPDX-License-Identifier: Apache-2.0

CONFIG_CONSOLE=y
CONFIG_UART_CONSOLE=y
CONFIG_SERIAL=y
CONFIG_GPIO=y
CONFIG_ARM_MPU=y
CONFIG_HW_STACK_PROTECTION=y
```

## boards/phytec/phyboard_electra/Kconfig.phyboard_electra
```kconfig
# PHYTEC phyBOARD-Electra AM64x
#
# Copyright (c) 2024 PHYTEC Messtechnik GmbH
#
# SPDX-License-Identifier: Apache-2.0

config BOARD_PHYBOARD_ELECTRA
	select SOC_AM6442_M4 if BOARD_PHYBOARD_ELECTRA_AM6442_M4
```

## boards/phytec/phyboard_electra/board.yml
```yaml
board:
  name: phyboard_electra
  full_name: phyBOARD-Electra AM64x M4F Core
  vendor: phytec
  socs:
  - name: am6442
```

## boards/phytec/phyboard_electra/phyboard_electra_am6442_m4_defconfig
```kconfig
# PHYTEC AM64x M4 phyBOARD-Electra
#
# Copyright (C) 2024 PHYTEC Messtechnik GmbH
# Author: Daniel Schultz <d.schultz@phytec.de>
#
# SPDX-License-Identifier: Apache-2.0

# Platform Configuration
CONFIG_CORTEX_M_SYSTICK=y

# Zephyr Kernel Configuration
CONFIG_XIP=n

# Enable Pinctrl
CONFIG_PINCTRL=y

# Serial Driver
CONFIG_SERIAL=y

# GPIO Driver
CONFIG_GPIO=y

# Enable Console
CONFIG_CONSOLE=y
CONFIG_UART_CONSOLE=y
```

## boards/phytec/phyboard_lyra/Kconfig.phyboard_lyra
```kconfig
# PHYTEC phyBOARD-Lyra AM62x M4/A53
#
# Copyright (c) 2023 Texas Instruments Incorporated
# Copyright (c) 2023 L Lakshmanan
#
# SPDX-License-Identifier: Apache-2.0

config BOARD_PHYBOARD_LYRA
	select SOC_AM6234_A53 if BOARD_PHYBOARD_LYRA_AM6234_A53
	select SOC_AM6234_M4 if BOARD_PHYBOARD_LYRA_AM6234_M4
	help
	  PHYTEC phyBOARD-Lyra AM62x M4/A53
```

## boards/phytec/phyboard_lyra/board.yml
```yaml
board:
  name: phyboard_lyra
  full_name: phyBOARD-Lyra AM62x A53 Core
  vendor: phytec
  socs:
  - name: am6234
```

## boards/phytec/phyboard_lyra/phyboard_lyra_am6234_m4_defconfig
```kconfig
# PHYTEC phyBOARD-Lyra AM62x M4
#
# Copyright (C) 2023 PHYTEC Messtechnik GmbH
# Author: Daniel Schultz <d.schultz@phytec.de>
#
# SPDX-License-Identifier: Apache-2.0

# Platform Configuration
CONFIG_CORTEX_M_SYSTICK=y

# Zephyr Kernel Configuration
CONFIG_XIP=n

# Serial Driver
CONFIG_SERIAL=y

# GPIO Driver
CONFIG_GPIO=y

# Enable Console
CONFIG_CONSOLE=y
CONFIG_UART_CONSOLE=y
```

## boards/phytec/phyboard_nash/Kconfig.phyboard_nash
```kconfig
# Copyright 2024 PHYTEC Messtechnik GmbH
# SPDX-License-Identifier: Apache-2.0

config BOARD_PHYBOARD_NASH
	select SOC_MIMX9352_A55 if BOARD_PHYBOARD_NASH_MIMX9352_A55
	select SOC_MIMX9352_M33 if BOARD_PHYBOARD_NASH_MIMX9352_M33
	select SOC_PART_NUMBER_MIMX9352CVVXM
```

## boards/phytec/phyboard_nash/board.yml
```yaml
board:
  name: phyboard_nash
  full_name: phyBOARD-Nash i.MX93
  vendor: phytec
  socs:
  - name: mimx9352
```

## boards/phytec/phyboard_nash/phyboard_nash_a55_defconfig
```kconfig
# Copyright 2024 PHYTEC Messtechnik GmbH
# SPDX-License-Identifier: Apache-2.0

CONFIG_CLOCK_CONTROL=y
CONFIG_SERIAL=y
CONFIG_UART_CONSOLE=y
CONFIG_UART_INTERRUPT_DRIVEN=y
CONFIG_CONSOLE=y

# ARM Options
CONFIG_AARCH64_IMAGE_HEADER=y
CONFIG_ARMV8_A_NS=y

# MMU Options
CONFIG_MAX_XLAT_TABLES=64

# Cache Options
CONFIG_CACHE_MANAGEMENT=y
CONFIG_DCACHE_LINE_SIZE_DETECT=y
CONFIG_ICACHE_LINE_SIZE_DETECT=y

# Zephyr Kernel Configuration
CONFIG_XIP=n
CONFIG_KERNEL_DIRECT_MAP=y
```

## boards/phytec/phyboard_polis/Kconfig.phyboard_polis
```kconfig
# Copyright (c) 2022 PHYTEC Messtechnik GmbH
# Copyright 2024 NXP
# SPDX-License-Identifier: Apache-2.0

config BOARD_PHYBOARD_POLIS
	select SOC_PART_NUMBER_MIMX8MM6DVTLZ
	select SOC_MIMX8MM6_M4 if BOARD_PHYBOARD_POLIS_MIMX8MM6_M4
	select SOC_MIMX8MM6_A53 if BOARD_PHYBOARD_POLIS_MIMX8MM6_A53 || BOARD_PHYBOARD_POLIS_MIMX8MM6_A53_SMP
```

## boards/phytec/phyboard_polis/board.yml
```yaml
board:
  name: phyboard_polis
  full_name: phyBOARD-Polis i.MX8M Mini
  vendor: phytec
  socs:
    - name: mimx8mm6
```

## boards/phytec/phyboard_pollux/Kconfig.phyboard_pollux
```kconfig
# Copyright (c) 2022 PHYTEC Messtechnik GmbH
# SPDX-License-Identifier: Apache-2.0

config BOARD_PHYBOARD_POLLUX
	select SOC_MIMX8ML8_M7 if BOARD_PHYBOARD_POLLUX_MIMX8ML8_M7
	select SOC_PART_NUMBER_MIMX8ML8DVNLZ
```

## boards/phytec/phyboard_pollux/board.yml
```yaml
board:
  name: phyboard_pollux
  full_name: phyBOARD-Pollux i.MX8M Plus
  vendor: phytec
  socs:
    - name: mimx8ml8
```

## boards/phytec/phyboard_pollux/phyboard_pollux_mimx8ml8_m7_defconfig
```kconfig
#
# Copyright (c) 2022 PHYTEC Messtechnik GmbH
#
# SPDX-License-Identifier: Apache-2.0
#

CONFIG_CORTEX_M_SYSTICK=y
CONFIG_CLOCK_CONTROL=y
CONFIG_UART_CONSOLE=y
CONFIG_SERIAL=y
CONFIG_UART_INTERRUPT_DRIVEN=y
CONFIG_CONSOLE=y

# y for TCM memory space
CONFIG_CODE_ITCM=y

# y for DDR memory space
CONFIG_CODE_DDR=n
```

## boards/phytec/phycore_am62x/Kconfig.phycore_am62x
```kconfig
# Copyright (c) 2023 Enphase Energy
# SPDX-License-Identifier: Apache-2.0

config BOARD_PHYCORE_AM62X
	select SOC_AM6234_A53 if BOARD_PHYCORE_AM62X_AM6234_A53
```

## boards/phytec/phycore_rt1170/Kconfig.phycore_rt1170
```kconfig
#
# Copyright 2024 PHYTEC America, LLC
#
# SPDX-License-Identifier: Apache-2.0

config BOARD_PHYCORE_RT1170
	select SOC_PART_NUMBER_MIMXRT1176DVMAA
	select SOC_MIMXRT1176_CM7 if BOARD_PHYCORE_RT1170_MIMXRT1176_CM7
	select SOC_MIMXRT1176_CM4 if BOARD_PHYCORE_RT1170_MIMXRT1176_CM4
```

## boards/phytec/reel_board/Kconfig
```kconfig
# reel board configuration

# Copyright (c) 2018-2019 PHYTEC Messtechnik GmbH
# SPDX-License-Identifier: Apache-2.0

config BOARD_ENABLE_DCDC
	bool "DCDC mode"
	select SOC_DCDC_NRF52X
	default y
	depends on BOARD_REEL_BOARD
```

## boards/phytec/reel_board/Kconfig.reel_board
```kconfig
# reel board configuration

# Copyright (c) 2018-2019 PHYTEC Messtechnik GmbH
# SPDX-License-Identifier: Apache-2.0

config BOARD_REEL_BOARD
	select SOC_NRF52840_QIAA
```
