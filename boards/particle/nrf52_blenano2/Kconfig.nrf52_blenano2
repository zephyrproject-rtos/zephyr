## boards/particle/nrf52_blenano2/Kconfig.nrf52_blenano2
```kconfig
# nRF52 BLENANO 2 board configuration

# Copyright (c) 2016 Linaro Limited.
# SPDX-License-Identifier: Apache-2.0

config BOARD_NRF52_BLENANO2
	select SOC_NRF52832_QFAA
```

## boards/particle/nrf52_blenano2/board.yml
```yaml
board:
  name: nrf52_blenano2
  full_name: Redbear Labs Nano v2
  vendor: particle
  socs:
  - name: nrf52832
```

## boards/particle/particle_argon/board.yml
```yaml
board:
  name: particle_argon
  vendor: Particle Industries
  socs:
  - name: nrf52840
```

## boards/particle/particle_boron/board.yml
```yaml
board:
  name: particle_boron
  vendor: Particle Industries
  socs:
  - name: nrf52840
```

## boards/particle/xenon/Kconfig
```kconfig
# Copyright The Zephyr Project Contributors
# SPDX-License-Identifier: Apache-2.0

config BOARD_PARTICLE_XENON
	select BOARD_LATE_INIT_HOOK
```

## boards/particle/xenon/Kconfig.defconfig
```kconfig
# Particle Xenon board configuration

# Copyright (c) 2018 Endre Karlson
# Copyright (c) 2018 Peter Bigot Consulting, LLC
# SPDX-License-Identifier: Apache-2.0

if BOARD_PARTICLE_XENON

config BT_CTLR
	default BT

endif # BOARD_PARTICLE_XENON
```

## boards/particle/xenon/Kconfig.particle_xenon
```kconfig
# Particle Xenon configuration

# Copyright (c) 2018 Endre Karlson
# SPDX-License-Identifier: Apache-2.0

config BOARD_PARTICLE_XENON
	select SOC_NRF52840_QIAA
```

## boards/particle/xenon/board.yml
```yaml
board:
  name: particle_xenon
  full_name: Xenon
  vendor: particle
  socs:
  - name: nrf52840
```

## boards/pcbcupid/glyph_c3/Kconfig.glyph_c3
```kconfig
# GLYPH-C3 board configuration

# Copyright (c) 2024 Espressif Systems (Shanghai) Co., Ltd.
# Copyright (c) 2026 Nikhil S

# SPDX-License-Identifier: Apache-2.0

config BOARD_GLYPH_C3
	select SOC_ESP32C3_WROOM_02_N4
```

## boards/pcbcupid/glyph_c3/board.yml
```yaml
board:
  name: glyph_c3
  full_name: Glyph-C3
  vendor: pcbcupid
  socs:
  - name: esp32c3
```

## boards/pcbcupid/glyph_c6/board.yml
```yaml
board:
  name: glyph_c6
  full_name: Glyph-C6
  vendor: pcbcupid
  socs:
  - name: esp32c6
```

## boards/pcbcupid/glyph_h2/Kconfig
```kconfig
# Copyright (c) 2025 Espressif Systems (Shanghai) Co., Ltd.
# SPDX-License-Identifier: Apache-2.0

config HEAP_MEM_POOL_ADD_SIZE_BOARD
	int
	default 4096
```

## boards/pcbcupid/glyph_h2/Kconfig.glyph_h2
```kconfig
# Glyph-H2 board configuration

# Copyright (c) 2025 Espressif Systems (Shanghai) Co., Ltd.
# Copyright (c) 2026 Muhammed Asif

# SPDX-License-Identifier: Apache-2.0

config BOARD_GLYPH_H2
	select SOC_ESP32_H2_MINI_H4
```

## boards/pcbcupid/glyph_h2/board.yml
```yaml
board:
  name: glyph_h2
  full_name: Glyph-H2
  vendor: pcbcupid
  socs:
  - name: esp32h2
```

## boards/peregrine/sam4l_wm400_cape/Kconfig.defconfig
```kconfig
# Copyright (c) 2020-2025 Gerson Fernando Budke <nandojve@gmail.com>
# SPDX-License-Identifier: Apache-2.0

if BOARD_SAM4L_WM400_CAPE

if NETWORKING

config IEEE802154_RF2XX
	default y
	depends on IEEE802154

endif # NETWORKING

# By default the board uses BOSSA bootloader and require that to zephyr relocate
# the code_partition. This should be disabled when using the whole flash without
# bootloader.
config USE_DT_CODE_PARTITION
	default y

endif # BOARD_SAM4L_WM400_CAPE
```

## boards/peregrine/sam4l_wm400_cape/Kconfig.sam4l_wm400_cape
```kconfig
# Copyright (c) 2020-2025 Gerson Fernando Budke <nandojve@gmail.com>
# SPDX-License-Identifier: Apache-2.0

config BOARD_SAM4L_WM400_CAPE
	select SOC_SAM4LC4B
```

## boards/peregrine/sam4l_wm400_cape/board.yml
```yaml
board:
  name: sam4l_wm400_cape
  full_name: SAM4L WM-400 Cape Board
  vendor: peregrine
  socs:
    - name: sam4lc4b
```

## boards/peregrine/sam4l_wm400_cape/sam4l_wm400_cape_defconfig
```kconfig
# Copyright (c) 2020-2025 Gerson Fernando Budke <nandojve@gmail.com>
# SPDX-License-Identifier: Apache-2.0

CONFIG_ARM_MPU=y
CONFIG_HW_STACK_PROTECTION=y
CONFIG_CORTEX_M_SYSTICK=y
CONFIG_WDT_DISABLE_AT_BOOT=y

CONFIG_CONSOLE=y
CONFIG_SERIAL=y
CONFIG_UART_CONSOLE=y
```

## boards/phytec/mimx8mm_phyboard_polis/Kconfig.defconfig
```kconfig
# MIMX8MM_PHYBOARD_POLIS board defconfig
#
# Copyright (c) 2022 PHYTEC Messtechnik GmbH
# SPDX-License-Identifier: Apache-2.0

if BOARD_MIMX8MM_PHYBOARD_POLIS

if !XIP
config FLASH_SIZE
	default 0
config FLASH_BASE_ADDRESS
	default 0
endif

endif # BOARD_MIMX8MM_PHYBOARD_POLIS
```

## boards/phytec/mimx8mm_phyboard_polis/Kconfig.mimx8mm_phyboard_polis
```kconfig
# Copyright (c) 2022 PHYTEC Messtechnik GmbH
# Copyright 2024 NXP
# SPDX-License-Identifier: Apache-2.0

config BOARD_MIMX8MM_PHYBOARD_POLIS
	select SOC_PART_NUMBER_MIMX8MM6DVTLZ
	select SOC_MIMX8MM6_M4 if BOARD_MIMX8MM_PHYBOARD_POLIS_MIMX8MM6_M4
```

## boards/phytec/mimx8mm_phyboard_polis/board.yml
```yaml
board:
  name: mimx8mm_phyboard_polis
  full_name: PhyBOARD Polis (NXP i.MX8M Mini)
  vendor: phytec
  socs:
    - name: mimx8mm6
```

## boards/phytec/mimx8mp_phyboard_pollux/Kconfig.defconfig
```kconfig
# PhyBOARD Pollux (i.MX8MP) defconfig

# Copyright (c) 2022 PHYTEC Messtechnik GmbH
# SPDX-License-Identifier: Apache-2.0

if BOARD_MIMX8MP_PHYBOARD_POLLUX

if !XIP
config FLASH_SIZE
	default 0
config FLASH_BASE_ADDRESS
	default 0
endif

endif # BOARD_MIMX8MP_PHYBOARD_POLLUX
```

## boards/phytec/mimx8mp_phyboard_pollux/Kconfig.mimx8mp_phyboard_pollux
```kconfig
# Copyright (c) 2022 PHYTEC Messtechnik GmbH
# SPDX-License-Identifier: Apache-2.0

config BOARD_MIMX8MP_PHYBOARD_POLLUX
	select SOC_MIMX8ML8_M7 if BOARD_MIMX8MP_PHYBOARD_POLLUX_MIMX8ML8_M7
	select SOC_PART_NUMBER_MIMX8ML8DVNLZ
```

## boards/phytec/mimx8mp_phyboard_pollux/board.yml
```yaml
board:
  name: mimx8mp_phyboard_pollux
  full_name: PhyBOARD Pollux (NXP i.MX8M Plus)
  vendor: phytec
  socs:
    - name: mimx8ml8
```
