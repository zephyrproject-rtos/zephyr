/*
 * Copyright (c) 2019 Laird Connectivity
 * Copyright (c) 2023 Nordic Semiconductor ASA
 *
 * SPDX-License-Identifier: Apache-2.0
 */

#include "bl654_dvk.dts"

/ {
	/* Information from Nordic SDK-Based Application Development and SKY66112 datasheet */
	sky66112_fem: fem {
		compatible = "generic-fem-two-ctrl-pins";
		ctx-gpios = <&gpio1 2 GPIO_ACTIVE_HIGH>;
		crx-gpios = <&gpio1 4 GPIO_ACTIVE_HIGH>;
		ctx-settle-time-us = <23>;
		crx-settle-time-us = <5>;
		tx-gain-db = <22>;
		rx-gain-db = <11>;
	};
};

&radio {
	fem = <&sky66112_fem>;
};
