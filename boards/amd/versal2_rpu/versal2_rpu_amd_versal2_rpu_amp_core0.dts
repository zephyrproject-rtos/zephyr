/*
 * Copyright (c) 2025, Advanced Micro Devices, Inc.
 *
 * SPDX-License-Identifier: Apache-2.0
 *
 * Versal Gen 2 RPU AMP Core0: DDR @ 0x30000, console on uart0.
 */

#include "versal2_rpu_amd_versal2_rpu_amp.dts"

/ {
	chosen {
		zephyr,sram = &sram0;
		zephyr,console = &uart0;
		zephyr,shell-uart = &uart0;
		zephyr,ocm = &ocm;
	};
};

&soc {
	sram0: memory@30000 {
		compatible = "mmio-sram";
		reg = <0x30000 DT_SIZE_M(2047)>;
	};
};
