## boards/amd/acp_7_0_adsp/acp_7_0_adsp_defconfig
```kconfig
# Copyright (c) 2026 AMD
# SPDX-License-Identifier: Apache-2.0

CONFIG_GEN_ISR_TABLES=y
CONFIG_GEN_IRQ_VECTOR_TABLE=n
CONFIG_GEN_SW_ISR_TABLE=y
CONFIG_DYNAMIC_INTERRUPTS=y
CONFIG_SHARED_INTERRUPTS=n
CONFIG_MULTI_LEVEL_INTERRUPTS=n
CONFIG_XTENSA_TIMER=y
CONFIG_XTENSA_TIMER_ID=0
CONFIG_TICKLESS_KERNEL=y
CONFIG_CACHE_MANAGEMENT=y
CONFIG_DCACHE=y
CONFIG_SYS_HEAP_HARDENING_NONE=y
```

## boards/amd/acp_7_0_adsp/board.yml
```yaml
# Copyright (c) 2026 AMD
# SPDX-License-Identifier: Apache-2.0

board:
  name: acp_7_0_adsp
  full_name: ACP 7.0 Xtensa Audio DSP
  vendor: amd
  socs:
    - name: acp_7_0
```

## boards/amd/acp_7_x_adsp/Kconfig.acp_7_x_adsp
```kconfig
# SPDX-FileCopyrightText: Copyright (c) 2026 AMD
# SPDX-License-Identifier: Apache-2.0

config BOARD_ACP_7_X_ADSP
	select SOC_ACP_7_X
```

## boards/amd/acp_7_x_adsp/board.yml
```yaml
# SPDX-FileCopyrightText: Copyright (c) 2026 AMD
# SPDX-License-Identifier: Apache-2.0

board:
  name: acp_7_x_adsp
  full_name: ACP 7.X Xtensa Audio DSP
  vendor: amd
  socs:
    - name: acp_7_x
```

## boards/amd/amd_acp_6_0_adsp/amd_acp_6_0_adsp_defconfig
```kconfig
# SPDX-License-Identifier: Apache-2.0

CONFIG_GEN_ISR_TABLES=y
CONFIG_GEN_IRQ_VECTOR_TABLE=y
CONFIG_XTENSA_RESET_VECTOR=y
CONFIG_OUTPUT_SYMBOLS=y
CONFIG_MULTI_LEVEL_INTERRUPTS=n
CONFIG_2ND_LEVEL_INTERRUPTS=n
CONFIG_BUILD_OUTPUT_BIN=n
CONFIG_CLEANUP_INTERMEDIATE_FILES=y
CONFIG_DCACHE_LINE_SIZE_DETECT=n
CONFIG_DCACHE_LINE_SIZE=128
```

## boards/amd/kv260_a53/Kconfig.kv260_a53
```kconfig
# Copyright (c) 2019 Carlo Caione <ccaione@baylibre.com>
# SPDX-License-Identifier: Apache-2.0

config BOARD_KV260_A53
        bool "AMD KV260 Cortex-A53" 
	select SOC_XILINX_ZYNQMP_APU
	default y
```

## boards/amd/kv260_a53/board.yml
```yaml
board:
  name: kv260_a53
  full_name: KV260 Development Board APU Cortex-A53
  vendor: amd
  socs:
  - name: zynqmp_apu
```

## boards/amd/kv260_r5/Kconfig.kv260_r5
```kconfig
# Copyright (c) 2022 Linaro.
# SPDX-License-Identifier: Apache-2.0

config BOARD_KV260_R5
	select SOC_XILINX_ZYNQMP_RPU
```

## boards/amd/kv260_r5/board.yml
```yaml
board:
  name: kv260_r5
  full_name: KV260 Development Board RPU Cortex-R5
  vendor: amd
  socs:
  - name: zynqmp_rpu
```

## boards/amd/kv260_r5/kv260_r5_defconfig
```kconfig
CONFIG_XIP=n

CONFIG_ISR_STACK_SIZE=512
CONFIG_THREAD_STACK_INFO=y

# Enable UART driver
CONFIG_SERIAL=y

# Enable console
CONFIG_CONSOLE=y
CONFIG_UART_CONSOLE=y

CONFIG_SYS_CLOCK_TICKS_PER_SEC=1000
CONFIG_ARM_MPU=y
```

## boards/amd/mbv32/Kconfig.defconfig
```kconfig
#
# Copyright (c) 2026 Advanced Micro Devices, Inc.
#
# SPDX-License-Identifier: Apache-2.0
#

if BOARD_MBV32

config 2ND_LVL_INTR_00_OFFSET
	default 11

config 2ND_LVL_ISR_TBL_OFFSET
	default 12

config MAX_IRQ_PER_AGGREGATOR
	default 32

endif # BOARD_MBV32
```

## boards/amd/mbv32/Kconfig.mbv32
```kconfig
#
# Copyright (c) 2026 Advanced Micro Devices, Inc.
#
# SPDX-License-Identifier: Apache-2.0
#

config BOARD_MBV32
	select SOC_MBV32
```

## boards/amd/mbv32/board.yml
```yaml
# Copyright (c) 2026, Advanced Micro Devices, Inc.
# SPDX-License-Identifier: Apache-2.0

board:
  name: mbv32
  full_name: AMD MicroBlaze V Board
  vendor: amd
  socs:
    - name: mbv32
```

## boards/amd/mbv32/mbv32_defconfig
```kconfig
#
# Copyright (c) 2026 Advanced Micro Devices, Inc.
#
# SPDX-License-Identifier: Apache-2.0
#

CONFIG_XIP=n
CONFIG_CONSOLE=y
CONFIG_SERIAL=y
CONFIG_UART_CONSOLE=y
```

## boards/amd/versal2_apu/board.yml
```yaml
# Copyright (c) 2025, Advanced Micro Devices, Inc.
# SPDX-License-Identifier: Apache-2.0

board:
  name: versal2_apu
  full_name: AMD Versal Gen 2 APU Development Board
  vendor: amd
  socs:
  - name: amd_versal2_apu
```

## boards/amd/versal2_apu/versal2_apu_defconfig
```kconfig
# Xilinx Arm Trusted Firmware (ATF).
# Boot Flow is: Boot PDI -> TF-A -> Zephyr

CONFIG_ARM64_VA_BITS_40=y
CONFIG_ARM64_PA_BITS_40=y
CONFIG_TIMER_READS_ITS_FREQUENCY_AT_RUNTIME=y

# Enable UART driver
CONFIG_SERIAL=y

# Enable console
CONFIG_CONSOLE=y
CONFIG_UART_CONSOLE=y

# Enable serial port
CONFIG_UART_PL011=y

# This should be commented in order to test at EL1 S (EL1 Secure)
CONFIG_ARMV8_A_NS=y

# Default is 12 for ARM64_VA_BITS_40. With WDT and other peripheral MMU
# entries we may need up to 28 tables. Keep it at 40 so that all possible
# use cases like mem_protect and other tests will work.
CONFIG_MAX_XLAT_TABLES=40
```

## boards/amd/versal2_rpu/Kconfig.versal2_rpu
```kconfig
#
# Copyright (c) 2025 Advanced Micro Devices, Inc.
#
# SPDX-License-Identifier: Apache-2.0
#

config BOARD_VERSAL2_RPU
	select SOC_AMD_VERSAL2_RPU
```

## boards/amd/versal2_rpu/board.yml
```yaml
board:
  name: versal2_rpu
  full_name: Versal 2 RPU development board
  vendor: amd
  socs:
  - name: amd_versal2_rpu
```

## boards/amd/versal2_rpu/versal2_rpu_amd_versal2_rpu_amp_core1_defconfig
```kconfig
# Copyright (c) 2025, Advanced Micro Devices, Inc.
# SPDX-License-Identifier: Apache-2.0
#
# Versal Gen 2 RPU AMP Core1 defconfig

# Enable UART driver
CONFIG_SERIAL=y

# Enable console
CONFIG_CONSOLE=y
CONFIG_UART_CONSOLE=y

# Enable serial port
CONFIG_UART_PL011=y

# Disable lockstep — split mode
CONFIG_DCLS=n

# GICv3: Skip distributor re-init on secondary core
CONFIG_GIC_SAFE_CONFIG=y
```

## boards/amd/versal2_rpu/versal2_rpu_defconfig
```kconfig
# Enable UART driver
CONFIG_SERIAL=y

# Enable console
CONFIG_CONSOLE=y
CONFIG_UART_CONSOLE=y

# Enable serial port
CONFIG_UART_PL011=y

# Enable cache and arch timer
CONFIG_CACHE_MANAGEMENT=y
CONFIG_ARM_ARCH_TIMER=y
```

## boards/amd/versal_apu/Kconfig.defconfig
```kconfig
# Copyright (c) 2025, Advanced Micro Devices, Inc.
# SPDX-License-Identifier: Apache-2.0

if BOARD_VERSAL_APU

config BUILD_OUTPUT_BIN
	default y

endif # BOARD_VERSAL_APU
```

## boards/amd/versal_apu/board.yml
```yaml
# Copyright (c) 2025, Advanced Micro Devices, Inc.
# SPDX-License-Identifier: Apache-2.0

board:
  name: versal_apu
  full_name: AMD Versal APU Development Board
  vendor: amd
  socs:
  - name: versal_apu
```

## boards/amd/versal_apu/versal_apu_defconfig
```kconfig
# The Zephyr build from this defconfig is expected to boot from
# Xilinx Arm Trusted Firmware (ATF).
# Boot Flow is: Boot PDI -> TF-A -> Zephyr

CONFIG_BUILD_WITH_TFA=y

CONFIG_ARM64_VA_BITS_40=y
CONFIG_ARM64_PA_BITS_40=y
CONFIG_TIMER_READS_ITS_FREQUENCY_AT_RUNTIME=y

# Enable UART driver
CONFIG_SERIAL=y

# Enable console
CONFIG_CONSOLE=y
CONFIG_UART_CONSOLE=y

# Enable serial port
CONFIG_UART_PL011=y

# This should be commented in order to test at EL1 S (EL1 Secure)
CONFIG_ARMV8_A_NS=y
```
