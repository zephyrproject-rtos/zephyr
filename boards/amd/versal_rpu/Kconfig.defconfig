## boards/amd/versal_rpu/Kconfig.defconfig
```kconfig
# Copyright (c) 2026, Advanced Micro Devices, Inc.
# SPDX-License-Identifier: Apache-2.0

if BOARD_VERSAL_RPU

config BUILD_OUTPUT_BIN
	default y

if USERSPACE

config COMPILER_ISA_THUMB2
	default n

endif

endif # BOARD_VERSAL_RPU
```

## boards/amd/versal_rpu/Kconfig.versal_rpu
```kconfig
# Copyright (c) 2026, Advanced Micro Devices, Inc.
# SPDX-License-Identifier: Apache-2.0

config BOARD_VERSAL_RPU
	select SOC_VERSAL_RPU
```

## boards/amd/versal_rpu/board.yml
```yaml
# Copyright (c) 2026, Advanced Micro Devices, Inc.
# SPDX-License-Identifier: Apache-2.0

board:
  name: versal_rpu
  full_name: AMD Versal RPU Cortex-R5
  vendor: amd
  socs:
  - name: versal_rpu
```

## boards/amd/versal_rpu/versal_rpu_defconfig
```kconfig
# Copyright (c) 2026, Advanced Micro Devices, Inc.
# SPDX-License-Identifier: Apache-2.0

CONFIG_XIP=n

CONFIG_ISR_STACK_SIZE=512
CONFIG_THREAD_STACK_INFO=y

# Enable UART driver
CONFIG_SERIAL=y

# Enable console
CONFIG_CONSOLE=y
CONFIG_UART_CONSOLE=y

# Enable serial port
CONFIG_UART_PL011=y
```

## boards/amd/versal_rpu/versal_rpu_versal_rpu_amp_core0_defconfig
```kconfig
# Copyright (c) 2026, Advanced Micro Devices, Inc.
# SPDX-License-Identifier: Apache-2.0
#
# Versal RPU AMP Core0 defconfig

CONFIG_XIP=n

CONFIG_ISR_STACK_SIZE=512
CONFIG_THREAD_STACK_INFO=y

# Enable UART driver
CONFIG_SERIAL=y

# Enable console
CONFIG_CONSOLE=y
CONFIG_UART_CONSOLE=y

# Enable serial port
CONFIG_UART_PL011=y

# Disable lockstep — split mode
CONFIG_DCLS=n

# GIC: Skip distributor re-init if another core already configured it.
# In split mode either core may boot first; both must preserve shared
# GICD state (ISENABLER, ITARGETSR, priorities).
CONFIG_GIC_SAFE_CONFIG=y
```

## boards/amd/versal_rpu/versal_rpu_versal_rpu_amp_core1_defconfig
```kconfig
# Copyright (c) 2026, Advanced Micro Devices, Inc.
# SPDX-License-Identifier: Apache-2.0
#
# Versal RPU AMP Core1 defconfig
#
# CONFIG_GIC_SAFE_CONFIG prevents core1 from re-initializing the GIC
# distributor that core0 already configured. gic_dist_init() checks
# GICD_CTLR and returns early if forwarding is already enabled.

CONFIG_XIP=n

CONFIG_ISR_STACK_SIZE=512
CONFIG_THREAD_STACK_INFO=y

# Enable UART driver
CONFIG_SERIAL=y

# Enable console
CONFIG_CONSOLE=y
CONFIG_UART_CONSOLE=y

# Enable serial port
CONFIG_UART_PL011=y

# Disable lockstep — split mode
CONFIG_DCLS=n

# GIC: Skip distributor re-init on secondary core
CONFIG_GIC_SAFE_CONFIG=y
```

## boards/amd/versalnet_apu/Kconfig.versalnet_apu
```kconfig
#
# Copyright (c) 2025 Advanced Micro Devices, Inc.
#
# SPDX-License-Identifier: Apache-2.0
#

config BOARD_VERSALNET_APU
	select SOC_AMD_VERSALNET_APU
```

## boards/amd/versalnet_apu/board.yml
```yaml
board:
  name: versalnet_apu
  full_name: Versal Net APU Development Board
  vendor: amd
  socs:
  - name: amd_versalnet_apu
```

## boards/amd/versalnet_apu/versalnet_apu_amd_versalnet_apu_smp_defconfig
```kconfig
# The Zephyr build from this defconfig is expected to boot from
# Xilinx Arm Trusted Firmware (ATF).
# Boot Flow is: Boot PDI -> TF-A -> Zephyr
CONFIG_BUILD_WITH_TFA=y

CONFIG_ARM64_VA_BITS_40=y
CONFIG_ARM64_PA_BITS_40=y
CONFIG_TIMER_READS_ITS_FREQUENCY_AT_RUNTIME=y

# Enable UART driver
CONFIG_SERIAL=y

# Enable console
CONFIG_CONSOLE=y
CONFIG_UART_CONSOLE=y

# Enable serial port
CONFIG_UART_PL011=y

# This should be commented in order to test at EL1 S (EL1 Secure)
CONFIG_ARMV8_A_NS=y

# Enable Clock Manager
CONFIG_CLOCK_CONTROL=y

# Reset Manager
CONFIG_RESET=y

# PSCI support Enable
CONFIG_PM_CPU_OPS=y
CONFIG_PM_CPU_OPS_PSCI=y

# Enable SMP support
CONFIG_SMP=y
CONFIG_MP_MAX_NUM_CPUS=4
```

## boards/amd/versalnet_apu/versalnet_apu_defconfig
```kconfig
# The Zephyr build from this defconfig is expected to boot from
# Xilinx Arm Trusted Firmware (ATF).
# Boot Flow is: Boot PDI -> TF-A -> Zephyr

CONFIG_ARM64_VA_BITS_40=y
CONFIG_ARM64_PA_BITS_40=y
CONFIG_TIMER_READS_ITS_FREQUENCY_AT_RUNTIME=y

# Enable UART driver
CONFIG_SERIAL=y

# Enable console
CONFIG_CONSOLE=y
CONFIG_UART_CONSOLE=y

# Enable serial port
CONFIG_UART_PL011=y

# This should be commented in order to test at EL1 S (EL1 Secure)
CONFIG_ARMV8_A_NS=y

# FPU support is disabled due to QEMU limitations. When CONFIG_FPU_SHARING
# is enabled, it uses the swpal instruction which QEMU does not emulate.
# If testing is targeted on real hardware and FPU operations are needed,
# comment the lines below.
CONFIG_FPU=n
CONFIG_FPU_SHARING=n
```

## boards/amd/versalnet_rpu/board.yml
```yaml
board:
  name: versalnet_rpu
  full_name: Versal NET RPU development board
  vendor: amd
  socs:
  - name: amd_versalnet_rpu
```

## boards/amd/versalnet_rpu/versalnet_rpu_amd_versalnet_rpu_amp_core0_defconfig
```kconfig
# Copyright (c) 2025, Advanced Micro Devices, Inc.
# SPDX-License-Identifier: Apache-2.0
#
# VersalNet RPU AMP Core0 defconfig

# Enable UART driver
CONFIG_SERIAL=y

# Enable console
CONFIG_CONSOLE=y
CONFIG_UART_CONSOLE=y

# Enable serial port
CONFIG_UART_PL011=y

# Disable lockstep — split mode
CONFIG_DCLS=n

# GICv3: Skip distributor re-init if another core already configured it.
# In split mode either core may boot first; both must preserve shared
# GICD state (ISENABLER, IROUTER, priorities).
CONFIG_GIC_SAFE_CONFIG=y
```

## boards/amd/versalnet_rpu/versalnet_rpu_amd_versalnet_rpu_amp_core1_defconfig
```kconfig
# Copyright (c) 2025, Advanced Micro Devices, Inc.
# SPDX-License-Identifier: Apache-2.0
#
# VersalNet RPU AMP Core1 defconfig
#
# CONFIG_GIC_SAFE_CONFIG prevents core1 from re-initializing the GIC
# distributor that core0 already configured. gicv3_dist_init() checks
# GICD_CTLR and returns early if forwarding is already enabled.

# Enable UART driver
CONFIG_SERIAL=y

# Enable console
CONFIG_CONSOLE=y
CONFIG_UART_CONSOLE=y

# Enable serial port
CONFIG_UART_PL011=y

# Disable lockstep — split mode
CONFIG_DCLS=n

# GICv3: Skip distributor re-init on secondary core
CONFIG_GIC_SAFE_CONFIG=y
```

## boards/amd/versalnet_rpu/versalnet_rpu_defconfig
```kconfig
# Enable UART driver
CONFIG_SERIAL=y

# Enable console
CONFIG_CONSOLE=y
CONFIG_UART_CONSOLE=y

# Enable serial port
CONFIG_UART_PL011=y
```

## boards/amd/zynqmp_apu/Kconfig.defconfig
```kconfig
# Copyright (c) 2026 Advanced Micro Devices, Inc.
# SPDX-License-Identifier: Apache-2.0

if BOARD_ZYNQMP_APU

config BUILD_OUTPUT_BIN
	default y

endif # BOARD_ZYNQMP_APU
```

## boards/amd/zynqmp_apu/Kconfig.zynqmp_apu
```kconfig
# Copyright (c) 2026 Advanced Micro Devices, Inc.
# SPDX-License-Identifier: Apache-2.0

config BOARD_ZYNQMP_APU
	select SOC_XILINX_ZYNQMP_APU
```

## boards/amd/zynqmp_apu/board.yml
```yaml
# Copyright (c) 2026 Advanced Micro Devices, Inc.
# SPDX-License-Identifier: Apache-2.0

board:
  name: zynqmp_apu
  full_name: AMD Zynq UltraScale+ MPSoC APU
  vendor: amd
  socs:
  - name: zynqmp_apu
    variants:
    - name: smp
```

## boards/amd/zynqmp_apu/zynqmp_apu_defconfig
```kconfig
# Copyright (c) 2026 Advanced Micro Devices, Inc.
# SPDX-License-Identifier: Apache-2.0

# Zephyr is expected to run NS-EL1 with TF-A (or equivalent) providing PSCI.

CONFIG_BUILD_WITH_TFA=y

CONFIG_ARM64_VA_BITS_40=y
CONFIG_ARM64_PA_BITS_40=y
CONFIG_TIMER_READS_ITS_FREQUENCY_AT_RUNTIME=y

CONFIG_SERIAL=y
CONFIG_CONSOLE=y
CONFIG_UART_CONSOLE=y
CONFIG_UART_XLNX_PS=y

CONFIG_ARMV8_A_NS=y
```

## boards/amd/zynqmp_rpu/Kconfig.zynqmp_rpu
```kconfig
# Copyright (c) 2026 Advanced Micro Devices, Inc.
# SPDX-License-Identifier: Apache-2.0

config BOARD_ZYNQMP_RPU
	select SOC_XILINX_ZYNQMP_RPU
```

## boards/amd/zynqmp_rpu/board.yml
```yaml
# Copyright (c) 2026 Advanced Micro Devices, Inc.
# SPDX-License-Identifier: Apache-2.0

board:
  name: zynqmp_rpu
  full_name: AMD Zynq UltraScale+ MPSoC RPU
  vendor: amd
  socs:
  - name: zynqmp_rpu
```

## boards/andes/adp_xc7k_ae350/Kconfig.adp_xc7k
```kconfig
# Copyright (c) 2021 Andes Technology Corporation
# SPDX-License-Identifier: Apache-2.0

config BOARD_ADP_XC7K
	select SOC_ANDES_AE350 if BOARD_ADP_XC7K_AE350
```

## boards/andestech/adp_xc7k_ae350/Kconfig.adp_xc7k
```kconfig
# Copyright (c) 2021 Andes Technology Corporation
# SPDX-License-Identifier: Apache-2.0

config BOARD_ADP_XC7K
	select SOC_AE350 if BOARD_ADP_XC7K_AE350
	select SOC_AE350 if BOARD_ADP_XC7K_AE350_LM
	select SOC_AE350 if BOARD_ADP_XC7K_AE350_CLIC
	select SOC_AE350 if BOARD_ADP_XC7K_AE350_CLIC_LM
```

## boards/andestech/adp_xc7k_ae350/Kconfig.defconfig
```kconfig
#
# Copyright (c) 2026 Nordic Semiconductor ASA
# SPDX-License-Identifier: Apache-2.0
#

choice SOC_AE350_INTERRUPT_TYPE
	default SOC_AE350_INTERRUPT_TYPE_CLIC if BOARD_ADP_XC7K_AE350_CLIC

endchoice
```

## boards/andestech/adp_xc7k_ae350/adp_xc7k_ae350_clic_defconfig
```kconfig
CONFIG_XIP=n
CONFIG_CONSOLE=y
CONFIG_UART_CONSOLE=y
CONFIG_SERIAL=y
CONFIG_GPIO=y
CONFIG_PMP_GRANULARITY=8
```
