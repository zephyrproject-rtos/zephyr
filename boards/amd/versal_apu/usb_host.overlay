/*
 * Devicetree overlay: DWC3 xHCI USB host on in-tree board versal_apu (&soc DTS).
 *
 * Parent is `soc` in amd/versal_a72.dtsi + amd/versal_apu.dtsi. VCK190 APU CED
 * variants use `amba` instead — adjust the parent node accordingly.
 *
 * SPDX-FileCopyrightText: Copyright (c) 2026 Advanced Micro Devices, Inc.
 * SPDX-License-Identifier: Apache-2.0
 */

#include <zephyr/dt-bindings/interrupt-controller/arm-gic.h>

&soc {
	zephyr_uhc0: usb_host@fe200000 {
		compatible = "snps,dwc3";
		reg = <0x00 0xfe200000 0x00 0x10000>,
		      <0x00 0xff9d0000 0x00 0x100>;
		reg-names = "core", "usb2_wrapper";
		interrupts = <GIC_SPI 22 IRQ_TYPE_LEVEL IRQ_DEFAULT_PRIORITY>;
		status = "okay";
	};
};
