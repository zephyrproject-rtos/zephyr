/*
 * Copyright (c) 2026, Advanced Micro Devices, Inc.
 *
 * SPDX-License-Identifier: Apache-2.0
 */

/dts-v1/;
#include "versal_apu.dts"

/ {
	cpus {
		cpu1: cpu@1 {
			compatible = "arm,cortex-a72";
			reg = <0x1>;
			device_type = "cpu";
			enable-method = "psci";
		};
	};
};
