/*
 * Copyright (c) 2024 AMD
 *
 * SPDX-License-Identifier: Apache-2.0
 */

/dts-v1/;

#include <amd/amd_acp_6_0.dtsi>

/ {
	model = "AMD ACP_6_0  Audio DSP";
	compatible = "acp_6_0";

	/*chosen {
		zephyr,sram = &sram0;
	};*/
};
