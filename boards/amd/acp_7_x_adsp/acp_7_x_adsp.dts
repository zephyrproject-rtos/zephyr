/*
 * SPDX-FileCopyrightText: Copyright (c) 2026 AMD
 *
 * SPDX-License-Identifier: Apache-2.0
 */

/dts-v1/;

#include <amd/acp_7_x.dtsi>

/ {
	compatible = "acp_7_x";
	model = "AMD ACP_7_X Audio DSP";

	soc {
		/* ACP DSP0 External Timer1 */
		acp_timer: acp-timer {
			compatible = "amd,acp-timer";
			interrupts = <4>;
			interrupt-parent = <&acp_intc>;
			clock-frequency = <24000000>;
			status = "okay";
		};
	};
};
