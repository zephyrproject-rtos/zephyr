## boards/m5stack/m5stack_paper_color/Kconfig.defconfig
```kconfig
# Copyright (c) 2026 The Zephyr Project Contributors
# SPDX-License-Identifier: Apache-2.0

if BOARD_M5STACK_PAPER_COLOR_ESP32S3_PROCPU

config INPUT
	default y

config GPIO_HOGS_INIT_PRIORITY
	default 83 if GPIO_HOGS

config MIPI_DBI_INIT_PRIORITY
	default 84 if MIPI_DBI

config DISPLAY_INIT_PRIORITY
	default 85 if DISPLAY

if FUEL_GAUGE

# Composite fuel gauge gets battery voltage from ADC-based voltage-divider sensor

config ADC
	default y

config SENSOR
	default y

endif # FUEL_GAUGE

if LVGL

choice LV_COLOR_DEPTH
	default LV_COLOR_DEPTH_24
endchoice

config LV_Z_FULL_REFRESH
	default y

config LV_Z_VDB_CUSTOM_SECTION
	default y


config ESP_SPIRAM
	default y

endif # LVGL

choice SPIRAM_MODE
	default SPIRAM_MODE_OCT
endchoice

endif # BOARD_M5STACK_PAPER_COLOR_ESP32S3_PROCPU
```

## boards/m5stack/m5stack_paper_color/Kconfig.m5stack_paper_color
```kconfig
# Copyright (c) 2026 The Zephyr Project Contributors
# SPDX-License-Identifier: Apache-2.0

config BOARD_M5STACK_PAPER_COLOR
	select SOC_ESP32S3_WROOM_N16R8
	select SOC_ESP32S3_PROCPU if BOARD_M5STACK_PAPER_COLOR_ESP32S3_PROCPU
	select SOC_ESP32S3_APPCPU if BOARD_M5STACK_PAPER_COLOR_ESP32S3_APPCPU
```

## boards/m5stack/m5stack_paper_color/board.yml
```yaml
board:
  name: m5stack_paper_color
  full_name: PaperColor
  vendor: m5stack
  socs:
    - name: esp32s3
```

## boards/m5stack/m5stack_stackchan/board.yml
```yaml
board:
  name: m5stack_stackchan
  full_name: M5Stack StackChan
  vendor: m5stack
  socs:
  - name: esp32s3
```

## boards/m5stack/m5stack_stamps3/Kconfig
```kconfig
# Copyright (c) 2023 Martin Kiepfer <mrmarteng@teleschirm.org>
# SPDX-License-Identifier: Apache-2.0

config HEAP_MEM_POOL_ADD_SIZE_BOARD
	int
	default 4096 if BOARD_M5STACK_STAMPS3_ESP32S3_PROCPU
	default 256 if BOARD_M5STACK_STAMPS3_ESP32S3_APPCPU
```

## boards/m5stack/m5stack_stamps3/Kconfig.defconfig
```kconfig
# M5Stack StampS3 board configuration
# Copyright (c) 2023 Martin Kiepfer <mrmarteng@teleschirm.org>
# SPDX-License-Identifier: Apache-2.0

if BOARD_M5STACK_STAMPS3_ESP32S3_PROCPU

config KERNEL_MEM_POOL
	default y

endif # BOARD_M5STACK_STAMPS3_ESP32S3_PROCPU
```

## boards/m5stack/m5stack_stamps3/Kconfig.m5stack_stamps3
```kconfig
# M5Stack StampS3 board configuration

# Copyright (c) 2023 Martin Kiepfer <mrmarteng@teleschirm.org>
# SPDX-License-Identifier: Apache-2.0

config BOARD_M5STACK_STAMPS3
	select SOC_ESP32S3_FN8
	select SOC_ESP32S3_PROCPU if BOARD_M5STACK_STAMPS3_ESP32S3_PROCPU
	select SOC_ESP32S3_APPCPU if BOARD_M5STACK_STAMPS3_ESP32S3_APPCPU
```

## boards/m5stack/m5stack_stamps3/board.yml
```yaml
board:
  name: m5stack_stamps3
  full_name: StampS3
  vendor: m5stack
  socs:
  - name: esp32s3
```

## boards/m5stack/m5stack_sticks3/Kconfig
```kconfig
# M5Stack StickS3 board configuration
# Copyright (c) 2026 Hsiu-Chi Tsai
# SPDX-License-Identifier: Apache-2.0

config HEAP_MEM_POOL_ADD_SIZE_BOARD
	int
	default 4096 if BOARD_M5STACK_STICKS3_ESP32S3_PROCPU
	default 256 if BOARD_M5STACK_STICKS3_ESP32S3_APPCPU
```

## boards/m5stack/m5stack_sticks3/Kconfig.defconfig
```kconfig
# M5Stack StickS3 board configuration
# Copyright (c) 2026 Hsiu-Chi Tsai
# SPDX-License-Identifier: Apache-2.0

if BOARD_M5STACK_STICKS3_ESP32S3_PROCPU

config KERNEL_MEM_POOL
	default y

endif # BOARD_M5STACK_STICKS3_ESP32S3_PROCPU
```

## boards/m5stack/m5stack_sticks3/Kconfig.m5stack_sticks3
```kconfig
# M5Stack StickS3 board configuration
# Copyright (c) 2026 Hsiu-Chi Tsai
# SPDX-License-Identifier: Apache-2.0

config BOARD_M5STACK_STICKS3
	select SOC_ESP32S3_PICO_N8R8
	select SOC_ESP32S3_PROCPU if BOARD_M5STACK_STICKS3_ESP32S3_PROCPU
	select SOC_ESP32S3_APPCPU if BOARD_M5STACK_STICKS3_ESP32S3_APPCPU
```

## boards/m5stack/m5stack_sticks3/board.yml
```yaml
board:
  name: m5stack_sticks3
  full_name: M5Stack StickS3
  vendor: m5stack
  socs:
  - name: esp32s3
```

## boards/m5stack/m5stack_unitc6l/Kconfig
```kconfig
# Copyright (c) 2026 Espressif Systems (Shanghai) Co., Ltd.
# SPDX-License-Identifier: Apache-2.0

config HEAP_MEM_POOL_ADD_SIZE_BOARD
	int
	default 4096 if BOARD_M5STACK_UNITC6L_ESP32C6_HPCORE
	default 256 if BOARD_M5STACK_UNITC6L_ESP32C6_LPCORE
```

## boards/m5stack/m5stack_unitc6l/Kconfig.m5stack_unitc6l
```kconfig
# M5Stack Unit C6L board configuration
#
# Copyright (c) 2026 Espressif Systems (Shanghai) Co., Ltd.
# SPDX-License-Identifier: Apache-2.0

config BOARD_M5STACK_UNITC6L
	select SOC_ESP32C6
	select SOC_ESP32C6_HPCORE if BOARD_M5STACK_UNITC6L_ESP32C6_HPCORE
	select SOC_ESP32C6_LPCORE if BOARD_M5STACK_UNITC6L_ESP32C6_LPCORE
```

## boards/m5stack/m5stack_unitc6l/m5stack_unitc6l_hpcore_defconfig
```kconfig
# Copyright (c) 2026 Espressif Systems (Shanghai) Co., Ltd.
# SPDX-License-Identifier: Apache-2.0

CONFIG_CONSOLE=y
CONFIG_SERIAL=y
CONFIG_UART_CONSOLE=y
CONFIG_GPIO=y
```

## boards/m5stack/m5stickc_plus/Kconfig
```kconfig
# Copyright (c) 2022 AVSystem Sławomir Wolf Sp.j. (AVSystem)
# SPDX-License-Identifier: Apache-2.0

config HEAP_MEM_POOL_ADD_SIZE_BOARD
	int
	default 4096 if BOARD_M5STICKC_PLUS_ESP32_PROCPU
	default 256 if BOARD_M5STICKC_PLUS_ESP32_APPCPU
```

## boards/m5stack/m5stickc_plus/board.yml
```yaml
board:
  name: m5stickc_plus
  full_name: M5StickC PLUS
  vendor: m5stack
  socs:
  - name: esp32
```

## boards/m5stack/m5stickc_plus/m5stickc_plus_procpu_defconfig
```kconfig
# SPDX-License-Identifier: Apache-2.0

CONFIG_CONSOLE=y
CONFIG_SERIAL=y
CONFIG_UART_CONSOLE=y

CONFIG_REGULATOR=y

CONFIG_GPIO=y
CONFIG_I2C=y
```

## boards/m5stack/m5stickc_plus2/board.yml
```yaml
board:
  name: m5stickc_plus2
  full_name: M5StickC PLUS2
  vendor: m5stack
  socs:
  - name: esp32
```

## boards/m5stack/stamp_c3/Kconfig
```kconfig
# Copyright 2022 TOKITA Hiroshi <tokita.hiroshi@fujitsu.com>
# SPDX-License-Identifier: Apache-2.0

config HEAP_MEM_POOL_ADD_SIZE_BOARD
	int
	default 4096
```

## boards/m5stack/stamp_c3/Kconfig.defconfig
```kconfig
# M5Stack STAMP-C3 board configuration

# Copyright 2022 TOKITA Hiroshi <tokita.hiroshi@fujitsu.com>
# SPDX-License-Identifier: Apache-2.0

config HEAP_MEM_POOL_ADD_SIZE_BOARD
	int
	default $(UINT16_MAX) if WIFI && BT
	default 51200 if WIFI
	default 40960 if BT
	default 4096
```

## boards/m5stack/stamp_c3/Kconfig.stamp_c3
```kconfig
# M5Stack STAMP-C3 board configuration

# Copyright 2022 TOKITA Hiroshi <tokita.hiroshi@fujitsu.com>
# SPDX-License-Identifier: Apache-2.0

config BOARD_STAMP_C3
	select SOC_ESP32C3_FX4
```

## boards/m5stack/stamp_c3/board.yml
```yaml
board:
  name: stamp_c3
  full_name: STAMP-C3
  vendor: m5stack
  socs:
  - name: esp32c3
```

## boards/madmachine/mm_feather/Kconfig.defconfig
```kconfig
# MM-FEATHER board

# Copyright (c) 2021, MADMACHINE LIMITED
# Copyright 2023 NXP
# SPDX-License-Identifier: Apache-2.0

if BOARD_MM_FEATHER

config DEVICE_CONFIGURATION_DATA
	default y

config NXP_IMX_EXTERNAL_SDRAM
	default y

endif # BOARD_MM_FEATHER
```

## boards/madmachine/mm_feather/Kconfig.mm_feather
```kconfig
# Copyright (c) 2021, MADMACHINE LIMITED
# Copyright 2024 NXP
# SPDX-License-Identifier: Apache-2.0

config BOARD_MM_FEATHER
	select SOC_PART_NUMBER_MIMXRT1062DVL6A
	select SOC_MIMXRT1062
```
