## boards/m5stack/m5stack_coremp135/Kconfig.m5stack_coremp135
```kconfig
# SPDX-FileCopyrightText: Copyright The Zephyr Project Contributors
# SPDX-License-Identifier: Apache-2.0

config BOARD_M5STACK_COREMP135
	select SOC_STM32MP135DXX
```

## boards/m5stack/m5stack_stackchan/Kconfig.m5stack_stackchan
```kconfig
# M5Stack StackChan board configuration

# Copyright (c) 2024 Zhang Xingtao <zhxt@live.cn>
# SPDX-License-Identifier: Apache-2.0

config BOARD_M5STACK_STACKCHAN
	select SOC_ESP32S3
	select SOC_ESP32S3_PROCPU if BOARD_M5STACK_STACKCHAN_ESP32S3_PROCPU
	select SOC_ESP32S3_APPCPU if BOARD_M5STACK_STACKCHAN_ESP32S3_APPCPU
```

## boards/m5stack/m5stack_stackchan/m5stack_stackchan_procpu_defconfig
```kconfig
# SPDX-License-Identifier: Apache-2.0

CONFIG_CONSOLE=y
CONFIG_SERIAL=y
CONFIG_UART_CONSOLE=y
CONFIG_GPIO=y
CONFIG_REGULATOR=y
CONFIG_SOC_FAMILY_ESPRESSIF_FLASH_MODE_QIO=y
```

## boards/m5stack/m5stack_unitc6l/board.yml
```yaml
board:
  name: m5stack_unitc6l
  full_name: Unit C6L
  vendor: m5stack
  socs:
  - name: esp32c6
```

## boards/m5stack/m5stickc_plus/Kconfig.defconfig
```kconfig
# M5StickC PLUS board configuration

# Copyright (c) 2022 AVSystem Sławomir Wolf Sp.j. (AVSystem)
# SPDX-License-Identifier: Apache-2.0

if BOARD_M5STICKC_PLUS_ESP32_PROCPU

configdefault GPIO_HOGS_INIT_PRIORITY
	default MFD_INIT_PRIORITY

endif # BOARD_M5STICKC_PLUS_ESP32_PROCPU
```

## boards/m5stack/m5stickc_plus/Kconfig.m5stickc_plus
```kconfig
# M5StickC PLUS board configuration

# Copyright (c) 2022 AVSystem Sławomir Wolf Sp.j. (AVSystem)
# SPDX-License-Identifier: Apache-2.0

config BOARD_M5STICKC_PLUS
	select SOC_ESP32
	select SOC_ESP32_PROCPU if BOARD_M5STICKC_PLUS_ESP32_PROCPU
	select SOC_ESP32_APPCPU if BOARD_M5STICKC_PLUS_ESP32_APPCPU
```

## boards/mediatek/mt8370_genio_510_evk/Kconfig.mt8370_genio_510_evk
```kconfig
# Copyright (c) 2026 MediaTek Inc.
# SPDX-License-Identifier: Apache-2.0

config BOARD_MT8370_GENIO_510_EVK
	select SOC_MT8188_A55 if BOARD_MT8370_GENIO_510_EVK_MT8188_A55
```

## boards/mediatek/mt8370_genio_510_evk/board.yml
```yaml
board:
  name: mt8370_genio_510_evk
  full_name: Genio 510 EVK
  vendor: mediatek
  socs:
    - name: mt8188
```

## boards/mediatek/mt8370_genio_510_evk/mt8370_genio_510_evk_mt8188_a55_defconfig
```kconfig
# Copyright (c) 2026 MediaTek Inc.
# SPDX-License-Identifier: Apache-2.0

CONFIG_ARM64_VA_BITS_40=y
CONFIG_ARM64_PA_BITS_40=y

CONFIG_CACHE_MANAGEMENT=y

CONFIG_CLOCK_CONTROL=y

CONFIG_SERIAL=y
CONFIG_UART_INTERRUPT_DRIVEN=y
CONFIG_UART_USE_RUNTIME_CONFIGURE=y

CONFIG_CONSOLE=y
CONFIG_UART_CONSOLE=y
```

## boards/mediatek/mt8390_genio_700_evk/Kconfig.mt8390_genio_700_evk
```kconfig
# Copyright (c) 2026 MediaTek Inc.
# SPDX-License-Identifier: Apache-2.0

config BOARD_MT8390_GENIO_700_EVK
	select SOC_MT8188_A55 if BOARD_MT8390_GENIO_700_EVK_MT8188_A55
```

## boards/mediatek/mt8390_genio_700_evk/board.yml
```yaml
board:
  name: mt8390_genio_700_evk
  full_name: Genio 700 EVK
  vendor: mediatek
  socs:
    - name: mt8188
```

## boards/microchip/m2s_hello_fpga_kit/Kconfig.m2s_hello_fpga_kit
```kconfig
# SPDX-FileCopyrightText: Copyright Bavariamatic GmbH
# SPDX-License-Identifier: Apache-2.0

config BOARD_M2S_HELLO_FPGA_KIT
	select SOC_M2S010 if BOARD_M2S_HELLO_FPGA_KIT_M2S010
```

## boards/microchip/m2s_hello_fpga_kit/board.yml
```yaml
# SPDX-FileCopyrightText: Copyright Bavariamatic GmbH
# SPDX-License-Identifier: Apache-2.0

board:
  name: m2s_hello_fpga_kit
  full_name: Microchip M2S Hello FPGA Kit
  vendor: microchip
  socs:
    - name: m2s010
```

## boards/microchip/mpfs_icicle/Kconfig
```kconfig
# SPDX-FileCopyrightText: Copyright The Zephyr Project Contributors
# SPDX-License-Identifier: Apache-2.0

config BOARD_MPFS_ICICLE
	select QEMU_TARGET if BOARD_MPFS_ICICLE_POLARFIRE_E51_QEMU || \
		BOARD_MPFS_ICICLE_POLARFIRE_U54_QEMU || \
		BOARD_MPFS_ICICLE_POLARFIRE_U54_SMP_QEMU
```

## boards/microchip/mpfs_icicle/Kconfig.defconfig
```kconfig
# Copyright 2025 Google LLC
# SPDX-License-Identifier: Apache-2.0

if BOARD_MPFS_ICICLE

choice SPI_NOR_SFDP
	default SPI_NOR_SFDP_RUNTIME
endchoice

if QEMU_TARGET

# The harts do not run concurrently with icount
configdefault QEMU_ICOUNT
	default n if SMP

configdefault QEMU_ICOUNT_SHIFT
	default 6

endif # QEMU_TARGET

endif
```

## boards/microchip/mpfs_icicle/board.yml
```yaml
board:
  name: mpfs_icicle
  full_name: PolarFire SoC Icicle Kit
  vendor: microchip
  socs:
  - name: polarfire
    variants:
    - name: qemu
      cpucluster: e51
    - name: qemu
      cpucluster: u54
    - name: smp
      cpucluster: u54
      variants:
      - name: qemu
```

## boards/microchip/pic32c/pic32ck_sg01_cnano/board.yml
```yaml
# SPDX-FileCopyrightText: Copyright (c) 2026 Microchip Technology Inc.
# SPDX-License-Identifier: Apache-2.0

board:
  name: pic32ck_sg01_cnano
  full_name: PIC32CK SG01 Curiosity Nano
  vendor: microchip
  socs:
    - name: pic32ck2051sg01064
```

## boards/microchip/pic32c/pic32ck_sg01_cult/Kconfig.defconfig
```kconfig
# SPDX-FileCopyrightText: Copyright (c) 2026 Microchip Technology Inc.
# SPDX-License-Identifier: Apache-2.0

if BOARD_PIC32CK_SG01_CULT

config EEPROM
	default y if NVMEM

configdefault ETH_DRIVER
	default y

configdefault NET_L2_ETHERNET
	default y

endif # BOARD_PIC32CK_SG01_CULT
```

## boards/microchip/pic32c/pic32cx_sg41_cult/Kconfig.defconfig
```kconfig
# Copyright (c) 2026 Microchip Technology Inc.
# SPDX-License-Identifier: Apache-2.0

if BOARD_PIC32CX_SG41_CULT

config EEPROM
	default y if NVMEM

configdefault ETH_DRIVER
	default y

endif # BOARD_PIC32CX_SG41_CULT
```

## boards/microchip/pic32c/pic32cx_sg61_cult/Kconfig.defconfig
```kconfig
# Copyright (c) 2026 Microchip Technology Inc.
# SPDX-License-Identifier: Apache-2.0

if BOARD_PIC32CX_SG61_CULT

config EEPROM
	default y if NVMEM

configdefault NET_L2_ETHERNET
	default y

endif # BOARD_PIC32CX_SG61_CULT
```
