## boards/m5stack/m5stack_atom_lite/board.yml
```yaml
board:
  name: m5stack_atom_lite
  full_name: ATOM Lite
  vendor: m5stack
  socs:
  - name: esp32
```

## boards/m5stack/m5stack_atoms3/Kconfig.defconfig
```kconfig
# M5Stack AtomS3 board configuration
# Copyright (c) 2023 Benjamin Cabé <benjamin@zephyrproject.org>
# SPDX-License-Identifier: Apache-2.0

if BOARD_M5STACK_ATOMS3_ESP32S3_PROCPU

configdefault LV_COLOR_16_SWAP
	default y if LVGL

endif # BOARD_M5STACK_ATOMS3_ESP32S3_PROCPU
```

## boards/m5stack/m5stack_atoms3/board.yml
```yaml
board:
  name: m5stack_atoms3
  full_name: AtomS3
  vendor: m5stack
  socs:
  - name: esp32s3
```

## boards/m5stack/m5stack_atoms3/m5stack_atoms3_procpu_defconfig
```kconfig
# SPDX-License-Identifier: Apache-2.0

CONFIG_MAIN_STACK_SIZE=2048

CONFIG_GPIO=y
CONFIG_REGULATOR=y # for LCD backlight

CONFIG_CONSOLE=y
CONFIG_SERIAL=y
CONFIG_UART_CONSOLE=y
```

## boards/m5stack/m5stack_atoms3_lite/Kconfig
```kconfig
# Copyright (c) 2024 Espressif Systems (Shanghai) Co., Ltd.
# SPDX-License-Identifier: Apache-2.0

config BOARD_M5STACK_ATOMS3_LITE
	select SOC_ESP32S3_PROCPU if BOARD_M5STACK_ATOMS3_LITE_ESP32S3_PROCPU
	select SOC_ESP32S3_APPCPU if BOARD_M5STACK_ATOMS3_LITE_ESP32S3_APPCPU
```

## boards/m5stack/m5stack_atoms3_lite/Kconfig.defconfig
```kconfig
# M5Stack AtomS3 Lite board configuration
# Copyright (c) 2023 Martin Kiepfer <mrmarteng@teleschirm.org>
# SPDX-License-Identifier: Apache-2.0

if BOARD_M5STACK_ATOMS3_LITE_ESP32S3_PROCPU

config KERNEL_MEM_POOL
	default y

endif # BOARD_M5STACK_ATOMS3_LITE_ESP32S3_PROCPU
```

## boards/m5stack/m5stack_atoms3_lite/Kconfig.m5stack_atoms3_lite
```kconfig
# M5Stack AtomS3 Lite board configuration
# Copyright (c) 2023 Martin Kiepfer <mrmarteng@teleschirm.org>
# SPDX-License-Identifier: Apache-2.0

config BOARD_M5STACK_ATOMS3_LITE
	select SOC_ESP32S3_FN8
	select SOC_ESP32S3_PROCPU if BOARD_M5STACK_ATOMS3_LITE_ESP32S3_PROCPU
	select SOC_ESP32S3_APPCPU if BOARD_M5STACK_ATOMS3_LITE_ESP32S3_APPCPU
```

## boards/m5stack/m5stack_atoms3_lite/board.yml
```yaml
board:
  name: m5stack_atoms3_lite
  full_name: AtomS3 Lite
  vendor: m5stack
  socs:
  - name: esp32s3
```

## boards/m5stack/m5stack_core2/Kconfig.defconfig
```kconfig
# M5Stack Core2 board configuration
# Copyright (c) 2022 AVSystem Sławomir Wolf Sp.j. (AVSystem)
# Copyright (c) 2023 Martin Kiepfer <m.kiepfer@teleschirm.org>
# SPDX-License-Identifier: Apache-2.0

if BOARD_M5STACK_CORE2_ESP32_PROCPU

config KERNEL_MEM_POOL
	default y

config GPIO_HOGS_INIT_PRIORITY
	default 70

config MFD_INIT_PRIORITY
	default 70

config REGULATOR_AXP192_INIT_PRIORITY
	default 71

config GPIO_AXP192_INIT_PRIORITY
	default 72

config REGULATOR_FIXED_INIT_PRIORITY
	default 75

config INPUT_FT5336_INTERRUPT
	default y if INPUT

config INPUT
	default y

config LV_COLOR_16_SWAP
	default y if LVGL

# Increase initialization priority of MIPI DBI device, so that it initializes
# after the GPIO controller
if MIPI_DBI

config MIPI_DBI_INIT_PRIORITY
	default 82

endif # MIPI_DBI

endif # BOARD_M5STACK_CORE2_ESP32_PROCPU
```

## boards/m5stack/m5stack_core2/Kconfig.m5stack_core2
```kconfig
# M5Stack Core2 board configuration

# Copyright (c) 2023 Martin Kiepfer <m.kiepfer@teleschirm.org>
# SPDX-License-Identifier: Apache-2.0

config BOARD_M5STACK_CORE2
	select SOC_ESP32_D0WD_V3
```

## boards/m5stack/m5stack_core2/board.yml
```yaml
board:
  name: m5stack_core2
  full_name: Core2
  vendor: m5stack
  socs:
  - name: esp32
```

## boards/m5stack/m5stack_core2/m5stack_core2_esp32_procpu_defconfig
```kconfig
# SPDX-License-Identifier: Apache-2.0

CONFIG_MAIN_STACK_SIZE=2048
CONFIG_ESP_HEAP_MEM_POOL_REGION_1_SIZE=0

CONFIG_GPIO=y

CONFIG_REGULATOR=y

CONFIG_CONSOLE=y
CONFIG_SERIAL=y
CONFIG_UART_CONSOLE=y

# for debugging
CONFIG_SHELL=y
```

## boards/m5stack/m5stack_core2/m5stack_core2_procpu_defconfig
```kconfig
# SPDX-License-Identifier: Apache-2.0

CONFIG_GPIO=y
CONFIG_REGULATOR=y
CONFIG_CONSOLE=y
CONFIG_SERIAL=y
CONFIG_UART_CONSOLE=y

# for debugging
CONFIG_SHELL=y
```

## boards/m5stack/m5stack_cores3/Kconfig
```kconfig
# Copyright (c) 2024 Zhang Xingtao <zhxt@live.cn>
# SPDX-License-Identifier: Apache-2.0

config HEAP_MEM_POOL_ADD_SIZE_BOARD
	int
	default 4096 if BOARD_M5STACK_CORES3_ESP32S3_PROCPU || \
			BOARD_M5STACK_CORES3_ESP32S3_PROCPU_SE
	default 256 if BOARD_M5STACK_CORES3_ESP32S3_APPCPU
```

## boards/m5stack/m5stack_cores3/Kconfig.defconfig
```kconfig
# M5Stack CoreS3 board defconfig

# Copyright (c) 2024 TOKITA Hiroshi
# SPDX-License-Identifier: Apache-2.0

if BOARD_M5STACK_CORES3_ESP32S3_PROCPU || BOARD_M5STACK_CORES3_ESP32S3_PROCPU_SE

config INPUT
	default y

if LVGL

config LV_Z_BITS_PER_PIXEL
	default 16

choice LV_COLOR_DEPTH
	default LV_COLOR_DEPTH_16
endchoice

config LV_COLOR_16_SWAP
	default y

endif # LVGL

# Takes good care of initialization priorities

if REGULATOR_FIXED

# Needs to init after MFD_AW9523B (80), since bus_5v uses aw9523b_gpio.
config REGULATOR_FIXED_INIT_PRIORITY
	default 81

endif # REGULATOR_FIXED

if REGULATOR_AXP192_AXP2101

# Needs to init before the display (83), since AXP2101 powers it.
config REGULATOR_AXP192_AXP2101_INIT_PRIORITY
	default 81

endif # REGULATOR_AXP192_AXP2101

if MIPI_DBI

# Needs to init after MFD_AW9523B (80), since reset-gpios uses aw9523b_gpio on this board.
config MIPI_DBI_INIT_PRIORITY
	default 82

endif # MIPI_DBI

if DISPLAY

# Needs to init after REGULATOR_AXP192_AXP2101 (81) and MIPI_DBI (82).
config DISPLAY_INIT_PRIORITY
	default 83

endif # DISPLAY

endif # BOARD_M5STACK_CORES3_ESP32S3_PROCPU || BOARD_M5STACK_CORES3_ESP32S3_PROCPU_SE
```

## boards/m5stack/m5stack_cores3/Kconfig.m5stack_cores3
```kconfig
# M5Stack CoreS3 board configuration

# Copyright (c) 2024 Zhang Xingtao <zhxt@live.cn>
# SPDX-License-Identifier: Apache-2.0

config BOARD_M5STACK_CORES3
	select SOC_ESP32S3
	select SOC_ESP32S3_PROCPU if BOARD_M5STACK_CORES3_ESP32S3_PROCPU || \
				     BOARD_M5STACK_CORES3_ESP32S3_PROCPU_SE
	select SOC_ESP32S3_APPCPU if BOARD_M5STACK_CORES3_ESP32S3_APPCPU
```

## boards/m5stack/m5stack_cores3/board.yml
```yaml
board:
  name: m5stack_cores3
  full_name: CoreS3
  vendor: m5stack
  socs:
  - name: esp32s3
    variants:
    - name: se
      cpucluster: procpu
```

## boards/m5stack/m5stack_cores3/m5stack_cores3_procpu_defconfig
```kconfig
# SPDX-License-Identifier: Apache-2.0

CONFIG_CONSOLE=y
CONFIG_SERIAL=y
CONFIG_UART_CONSOLE=y
CONFIG_GPIO=y
CONFIG_REGULATOR=y
CONFIG_ESP_SPIRAM=y
CONFIG_SPIRAM_MODE_QUAD=y
CONFIG_ESP_SPIRAM_HEAP_SIZE=4194304
CONFIG_VIDEO_BUFFER_USE_SHARED_MULTI_HEAP=y
CONFIG_VIDEO_BUFFER_SMH_ATTRIBUTE=2
CONFIG_DMA_ESP32_MAX_DESCRIPTOR_NUM=128
```

## boards/m5stack/m5stack_fire/Kconfig.defconfig
```kconfig
# M5Stack Core2 board configuration
# Copyright (c) 2022 AVSystem Sławomir Wolf Sp.j. (AVSystem)
# Copyright (c) 2023 Martin Kiepfer <m.kiepfer@teleschirm.org>
# SPDX-License-Identifier: Apache-2.0

if BOARD_M5STACK_FIRE_ESP32_PROCPU

config KERNEL_MEM_POOL
	default y

config GPIO_HOGS_INIT_PRIORITY
	default 70

config INPUT
	default y

configdefault LV_COLOR_16_SWAP
	default y if LVGL

# Increase initialization priority of MIPI DBI device, so that it initializes
# after the GPIO controller
if MIPI_DBI

config MIPI_DBI_INIT_PRIORITY
	default 82

endif # MIPI_DBI

endif # BOARD_M5STACK_FIRE_ESP32_PROCPU
```

## boards/m5stack/m5stack_fire/Kconfig.m5stack_fire
```kconfig
# M5Stack Fire board configuration

# Copyright (c) 2023 Martin Kiepfer <m.kiepfer@teleschirm.org>
# SPDX-License-Identifier: Apache-2.0

config BOARD_M5STACK_FIRE
	select SOC_ESP32_D0WD_V3
	select SOC_ESP32_PROCPU if BOARD_M5STACK_FIRE_ESP32_PROCPU
	select SOC_ESP32_APPCPU if BOARD_M5STACK_FIRE_ESP32_APPCPU
```

## boards/m5stack/m5stack_fire/board.yml
```yaml
board:
  name: m5stack_fire
  full_name: Fire
  vendor: m5stack
  socs:
  - name: esp32
```

## boards/m5stack/m5stack_nanoc6/Kconfig.m5stack_nanoc6
```kconfig
# M5Stack NanoC6 devkitc board configuration

# Copyright (c) 2024 Espressif Systems (Shanghai) Co., Ltd.
# SPDX-License-Identifier: Apache-2.0

config BOARD_M5STACK_NANOC6
	select SOC_ESP32_C6_WROOM_1U_N4
	select SOC_ESP32C6_HPCORE if BOARD_M5STACK_NANOC6_ESP32C6_HPCORE
	select SOC_ESP32C6_LPCORE if BOARD_M5STACK_NANOC6_ESP32C6_LPCORE
```

## boards/m5stack/m5stack_nanoc6/board.yml
```yaml
board:
  name: m5stack_nanoc6
  full_name: NanoC6
  vendor: m5stack
  socs:
  - name: esp32c6
```

## boards/m5stack/m5stack_nanoc6/m5stack_nanoc6_hpcore_defconfig
```kconfig
# SPDX-License-Identifier: Apache-2.0

CONFIG_CONSOLE=y
CONFIG_SERIAL=y
CONFIG_UART_CONSOLE=y
CONFIG_GPIO=y

# For enabling RGB LED
CONFIG_REGULATOR=y
```

## boards/m5stack/m5stack_paper_color/Kconfig
```kconfig
# Copyright (c) 2026 The Zephyr Project Contributors
# SPDX-License-Identifier: Apache-2.0

config HEAP_MEM_POOL_ADD_SIZE_BOARD
	int
	default 4096 if BOARD_M5STACK_PAPER_COLOR_ESP32S3_PROCPU
	default 256 if BOARD_M5STACK_PAPER_COLOR_ESP32S3_APPCPU
```
