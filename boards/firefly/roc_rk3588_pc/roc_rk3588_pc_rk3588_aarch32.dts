/*
 * Copyright (c) 2025 Syswonder
 * SPDX-License-Identifier: Apache-2.0
 */

/dts-v1/;

#include <arm64/rockchip/rk3588.dtsi>
#include <common/mem.h>

/ {
	model = "Firefly ROC-RK3588";
	compatible = "rockchip,rk3588";

	chosen {
		zephyr,console = &uart3;
		zephyr,shell-uart = &uart3;
		zephyr,sram = &dram;
	};

	dram: memory@50000000 {
		compatible = "mmio-sram";
		device_type = "memory";
		reg = <0x50000000 DT_SIZE_M(1)>;
	};
};

&uart3 {
	status = "okay";
	current-speed = <115200>;
};
