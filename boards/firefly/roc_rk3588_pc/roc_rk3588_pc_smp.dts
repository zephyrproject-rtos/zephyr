/*
 * Copyright (c) 2025 Syswonder
 * SPDX-License-Identifier: Apache-2.0
 */

#include "roc_rk3588_pc.dts"

&a76_cpu0 {
	status = "disabled";
};

&a76_cpu1 {
	status = "disabled";
};

&a76_cpu2 {
	status = "disabled";
};

&a76_cpu3 {
	status = "disabled";
};
