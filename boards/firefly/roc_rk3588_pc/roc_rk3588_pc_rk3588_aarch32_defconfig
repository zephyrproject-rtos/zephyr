## boards/firefly/roc_rk3588_pc/roc_rk3588_pc_rk3588_aarch32_defconfig
```kconfig
# Copyright (c) 2025 Syswonder
# SPDX-License-Identifier: Apache-2.0

# Platform Configuration
CONFIG_ARM_ARCH_TIMER=y

# Serial Drivers
CONFIG_SERIAL=y
CONFIG_UART_NS16550=y
CONFIG_UART_INTERRUPT_DRIVEN=y

# Enable console
CONFIG_CONSOLE=y
CONFIG_UART_CONSOLE=y

CONFIG_CACHE_MANAGEMENT=y
```

## boards/firefly/roc_rk3588_pc/roc_rk3588_pc_smp_defconfig
```kconfig
# Copyright (c) 2025 Syswonder
# SPDX-License-Identifier: Apache-2.0

# Platform Configuration
CONFIG_ARM_ARCH_TIMER=y

# Serial Drivers
CONFIG_SERIAL=y
CONFIG_UART_NS16550=y
CONFIG_UART_INTERRUPT_DRIVEN=y

# Enable console
CONFIG_CONSOLE=y
CONFIG_UART_CONSOLE=y

# ARMv8 NS world with cache management
CONFIG_ARMV8_A_NS=y
CONFIG_CACHE_MANAGEMENT=y
CONFIG_DCACHE=y

CONFIG_TICKLESS_KERNEL=y

# SMP support
CONFIG_SMP=y
CONFIG_MP_MAX_NUM_CPUS=4
CONFIG_MAX_THREAD_BYTES=4

# PSCI support
CONFIG_PM_CPU_OPS=y
CONFIG_PM_CPU_OPS_PSCI=y
```

## boards/flysky/fs_i6s/Kconfig.defconfig
```kconfig
# FS_I6S board configuration

# Copyright (c) 2026 Sahaj Sarup
# SPDX-License-Identifier: Apache-2.0

if BOARD_FS_I6S

config ADC_STM32_DMA
	default y if ADC

endif # BOARD_FS_I6S
```

## boards/flysky/fs_i6s/Kconfig.fs_i6s
```kconfig
# Copyright (c) 2026 Sahaj Sarup
# SPDX-License-Identifier: Apache-2.0

config BOARD_FS_I6S
	select SOC_STM32F072XB
```

## boards/flysky/fs_i6s/board.yml
```yaml
board:
  name: fs_i6s
  full_name: FlySky FS-i6S
  vendor: flysky
  socs:
    - name: stm32f072xb
```

## boards/flysky/fs_i6s/fs_i6s_defconfig
```kconfig
# Copyright (c) 2026 Sahaj Sarup
# SPDX-License-Identifier: Apache-2.0

# Serial Drivers
CONFIG_SERIAL=y
CONFIG_UART_INTERRUPT_DRIVEN=y
# Enable console
CONFIG_CONSOLE=y
CONFIG_UART_CONSOLE=y
```

## boards/fobe/quill_nrf52840_mesh/Kconfig.defconfig
```kconfig
# QUILL NRF52840 MESH board configuration

# Copyright (c) 2025 Chiho Sin
# SPDX-License-Identifier: Apache-2.0

if BOARD_QUILL_NRF52840_MESH

source "boards/common/usb/Kconfig.cdc_acm_serial.defconfig"

endif # BOARD_QUILL_NRF52840_MESH
```

## boards/fobe/quill_nrf52840_mesh/Kconfig.quill_nrf52840_mesh
```kconfig
# QUILL NRF52840 MESH board configuration

# Copyright (c) 2025 Chiho Sin
# SPDX-License-Identifier: Apache-2.0

config BOARD_QUILL_NRF52840_MESH
	select SOC_NRF52840_QIAA
```

## boards/fobe/quill_nrf52840_mesh/board.yml
```yaml
board:
  name: quill_nrf52840_mesh
  full_name: Quill nRF52840 Mesh
  vendor: fobe
  socs:
  - name: nrf52840
```

## boards/fobe/quill_nrf52840_mesh/quill_nrf52840_mesh_defconfig
```kconfig
# SPDX-License-Identifier: Apache-2.0

# Enable MPU
CONFIG_ARM_MPU=y

# Enable hardware stack protection
CONFIG_HW_STACK_PROTECTION=y

# Enable GPIO
CONFIG_GPIO=y

# Enable UART driver
CONFIG_SERIAL=y

# Enable console
CONFIG_CONSOLE=y

# Enable Power
CONFIG_POWER_DOMAIN=y
CONFIG_PM_DEVICE=y
CONFIG_PM_DEVICE_POWER_DOMAIN=y

# Build UF2 by default, supported by the Adafruit nRF52 Bootloader
CONFIG_BUILD_OUTPUT_UF2=y
CONFIG_USE_DT_CODE_PARTITION=y
```

## boards/focaltech/ft9001_eval/Kconfig.ft9001_eval
```kconfig
# Copyright (c) 2025, FocalTech Systems CO.,Ltd
# SPDX-License-Identifier: Apache-2.0

config BOARD_FT9001_EVAL
	select SOC_FT9001
```

## boards/focaltech/ft9001_eval/board.yml
```yaml
board:
  name: ft9001_eval
  full_name: FocalTech FT9001 Evaluation Board
  vendor: focaltech
  socs:
    - name: ft9001
```

## boards/focaltech/ft9001_eval/ft9001_eval_defconfig
```kconfig
# Copyright (c) 2025, FocalTech Systems CO.,Ltd
# SPDX-License-Identifier: Apache-2.0

CONFIG_FLASH_LOAD_OFFSET=0x1000
CONFIG_ARM_MPU=y
CONFIG_HW_STACK_PROTECTION=y
CONFIG_LOG=y
CONFIG_SERIAL=y
CONFIG_CONSOLE=y
CONFIG_UART_CONSOLE=y
CONFIG_UART_INTERRUPT_DRIVEN=y
```

## boards/forlinx/ok3506b_s12/Kconfig.ok3506b_s12
```kconfig
# Copyright 2026 Hiyajomaho Num9
# SPDX-License-Identifier: Apache-2.0

config BOARD_OK3506B_S12
	select SOC_RK3506
```

## boards/forlinx/ok3506b_s12/board.yml
```yaml
board:
  name: ok3506b_s12
  full_name: OK3506B-S12
  vendor: forlinx
  socs:
  - name: rk3506
```

## boards/forlinx/ok3506b_s12/ok3506b_s12_defconfig
```kconfig
# SPDX-License-Identifier: Apache-2.0

CONFIG_ARM_ARCH_TIMER=y

CONFIG_SERIAL=y
CONFIG_UART_INTERRUPT_DRIVEN=y

CONFIG_CONSOLE=y
CONFIG_UART_CONSOLE=y
```

## boards/framework/framework_ledmatrix/Kconfig
```kconfig
# Copyright (c) 2025 Framework Computer Inc
# SPDX-License-Identifier: Apache-2.0

config BOARD_FRAMEWORK_LEDMATRIX
	select RP2_FLASH_W25Q080
```

## boards/framework/framework_ledmatrix/Kconfig.defconfig
```kconfig
# Copyright (c) 2025 Framework Computer Inc
# SPDX-License-Identifier: Apache-2.0

if BOARD_FRAMEWORK_LEDMATRIX

config RP2_FLASH_W25Q080
	default y

if I2C_DW

config I2C_DW_CLOCK_SPEED
	default 125

endif # I2C_DW

config USB_SELF_POWERED
	default n

endif # BOARD_FRAMEWORK_LEDMATRIX
```

## boards/framework/framework_ledmatrix/Kconfig.framework_ledmatrix
```kconfig
# Copyright (c) 2025 Framework Computer Inc
# SPDX-License-Identifier: Apache-2.0

config BOARD_FRAMEWORK_LEDMATRIX
	select SOC_RP2040
```

## boards/framework/framework_ledmatrix/board.yml
```yaml
board:
  name: framework_ledmatrix
  full_name: Framework LED Matrix
  vendor: framework
  socs:
  - name: rp2040
```

## boards/framework/framework_ledmatrix/framework_ledmatrix_defconfig
```kconfig
# Copyright (c) 2025 Framework Computer Inc
# SPDX-License-Identifier: Apache-2.0

CONFIG_SERIAL=y
CONFIG_CONSOLE=y

# Enable reset by default
CONFIG_RESET=y
CONFIG_CLOCK_CONTROL=y

# Code partition needed to target the correct flash range
CONFIG_USE_DT_CODE_PARTITION=y

# Output UF2 by default, maskrom bootloader supports it.
CONFIG_BUILD_OUTPUT_UF2=y
CONFIG_BUILD_OUTPUT_HEX=y
```

## boards/framework/laptop16_keyboard/board.yml
```yaml
boards:
- name: framework_laptop16_keyboard
  full_name: Framework Laptop 16 Keyboard
  vendor: framework
  socs:
  - name: rp2040
```

## boards/franzininho/esp32s2_franzininho/Kconfig.defconfig
```kconfig
# ESP32S2 Franzininho board configuration

# Copyright (c) 2022 Felipe Neves
# SPDX-License-Identifier: Apache-2.0

config ENTROPY_GENERATOR
	default y
```

## boards/franzininho/esp32s2_franzininho/Kconfig.esp32s2_franzininho
```kconfig
# ESP32S2 Franzininho board configuration

# Copyright (c) 2022 Felipe Neves
# SPDX-License-Identifier: Apache-2.0

config BOARD_ESP32S2_FRANZININHO
	select SOC_ESP32S2_WROOM
```

## boards/franzininho/esp32s2_franzininho/board.yml
```yaml
board:
  name: esp32s2_franzininho
  full_name: ESP32-S2 Franzininho
  vendor: franzininho
  socs:
  - name: esp32s2
```
