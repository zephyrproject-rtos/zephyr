/*
 * Copyright 2022 HNU-ESNL
 * Copyright 2022 openEuler SIG-Zephyr
 * SPDX-License-Identifier: Apache-2.0
 */

/dts-v1/;

#include <arm64/rockchip/rk3568.dtsi>
#include <common/mem.h>

/ {
	compatible = "rockchip,rk3568";
	model = "Firefly ROC-RK3568-PC";

	chosen {
		zephyr,console = &uart2;
		zephyr,shell-uart = &uart2;
		zephyr,sram = &sram0;
	};

	sram0: memory@40000000 {
		compatible = "mmio-sram";
		reg = <0x40000000 DT_SIZE_M(1)>;
		device_type = "memory";
	};
};

&uart2 {
	current-speed = <1500000>;
	status = "okay";
};
