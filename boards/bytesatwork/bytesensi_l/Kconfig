## boards/bytesatwork/bytesensi_l/Kconfig
```kconfig
# Copyright (c) 2024 bytesatwork AG
# SPDX-License-Identifier: Apache-2.0

config BOARD_ENABLE_DCDC
	bool "DCDC mode"
	select SOC_DCDC_NRF52X
	default y
	depends on BOARD_BYTESENSI_L
```

## boards/bytesatwork/bytesensi_l/Kconfig.bytesensi_l
```kconfig
# Copyright (c) 2024 bytesatwork AG
# SPDX-License-Identifier: Apache-2.0

config BOARD_BYTESENSI_L
	select SOC_NRF52832_QFAA
```

## boards/bytesatwork/bytesensi_l/board.yml
```yaml
# Copyright (c) 2024 bytesatwork AG
# SPDX-License-Identifier: Apache-2.0
board:
  name: bytesensi_l
  full_name: byteSENSI-L
  vendor: bytesatwork
  socs:
  - name: nrf52832
```

## boards/bytesatwork/bytesensi_l/bytesensi_l_defconfig
```kconfig
# Copyright (c) 2024 bytesatwork AG
# SPDX-License-Identifier: Apache-2.0

# Enable MPU
CONFIG_ARM_MPU=y

# enable GPIO
CONFIG_GPIO=y

# enable UART
CONFIG_SERIAL=y
CONFIG_UART_INTERRUPT_DRIVEN=y

# Enable hardware stack protection
CONFIG_HW_STACK_PROTECTION=y

# enable console over segger RTT
CONFIG_CONSOLE=y
CONFIG_RTT_CONSOLE=y
CONFIG_USE_SEGGER_RTT=y
```

## boards/can-module_com/usbcan_iso/Kconfig.usbcan_iso
```kconfig
# Copyright (c) 2024 Henrik Brix Andersen <henrik@brixandersen.dk>
# SPDX-License-Identifier: Apache-2.0

config BOARD_USBCAN_ISO
	select SOC_STM32F072XB
```

## boards/can-module_com/usbcanfd_Oleksii_g431/board.yml
```yaml
board:
  name: usbcanfd_Oleksii_g431
  full_name: USB CANFD SOLO 
  vendor: can-module.com
  socs:
    - name: stm32g431xx
```

## boards/can-module_com/usbcanfd_Oleksii_g473/board.yml
```yaml
board:
  name: usbcanfd_Oleksii_g473
  full_name: USB CANFD DUAL 
  vendor: can-module.com
  socs:
    - name: stm32g473xx
```

## boards/canaan/canmv_k230/Kconfig.canmv_k230
```kconfig
# Copyright (c) 2024 Junhui Liu <liujh2818@outlook.com>
# SPDX-License-Identifier: Apache-2.0

config BOARD_CANMV_K230
	select SOC_CANAAN_K230
```

## boards/canaan/canmv_k230/board.yml
```yaml
# Copyright (c) 2024 Junhui Liu <liujh2818@outlook.com>
# SPDX-License-Identifier: Apache-2.0

board:
  name: canmv_k230
  vendor: canaan
  socs:
    - name: k230
```

## boards/canaan/canmv_k230/canmv_k230_defconfig
```kconfig
# SPDX-License-Identifier: Apache-2.0

# Zephyr Kernel Configuration
CONFIG_XIP=n

# Serial Drivers
CONFIG_SERIAL=y
CONFIG_UART_INTERRUPT_DRIVEN=y
CONFIG_UART_NS16550_ACCESS_WORD_ONLY=y

# Enable Console
CONFIG_CONSOLE=y
CONFIG_UART_CONSOLE=y
```

## boards/canmodule/canBridge_Oleksii_g473/board.yml
```yaml
board:
  name: canBridge_Oleksii_g473
  full_name: USB CANFD TRIO (can-module.com)
  vendor: canmodule
  socs:
    - name: stm32g473xx
```

## boards/canmodule/canBridge_Oleksii_g473/canBridge_Oleksii_g473_defconfig
```kconfig
# Copyright (c) 2026 Oleksii Mamontov <mamontov1@gmail.com>
# SPDX-License-Identifier: Apache-2.0
CONFIG_GPIO=y
CONFIG_ARM_MPU=y
```

## boards/canmodule/canbridge_g473/board.yml
```yaml
board:
  name: canbridge_g473
  vendor: canmodule
  full_name: CANBRIDGE G473
  socs:
    - name: stm32g473xx
```

## boards/canmodule/usbcan_iso/Kconfig.usbcan_iso
```kconfig
# Copyright (c) 2026 Oleksii Mamontov <mamontov1@gmail.com>
# SPDX-License-Identifier: Apache-2.0

config BOARD_USBCAN_ISO
	select SOC_STM32F072XB
```

## boards/canmodule/usbcan_iso/board.yml
```yaml
board:
  name: usbcan_iso
  full_name: USBCAN ISO
  vendor: canmodule
  socs:
    - name: stm32f072xb
```

## boards/canmodule/usbcan_iso/usbcan_iso_defconfig
```kconfig
# Copyright (c) 2026 Oleksii Mamontov <mamontov1@gmail.com>
# SPDX-License-Identifier: Apache-2.0

CONFIG_SOC_SERIES_STM32F0X=y
CONFIG_SOC_STM32F072XB=y
CONFIG_BOARD_USBCAN_ISO=y

CONFIG_GPIO=y
```

## boards/canmodule/usbcanfd_Oleksii_g431/Kconfig.usbcanfd_Oleksii_g431
```kconfig
# Copyright (c) 2026 Oleksii Mamontov <mamontov1@gmail.com>
# SPDX-License-Identifier: Apache-2.0
config BOARD_USBCANFD_OLEKSII_G431
	select SOC_STM32G431XX
```

## boards/canmodule/usbcanfd_Oleksii_g431/usbcanfd_Oleksii_g431_defconfig
```kconfig
# Copyright (c) 2026 Oleksii Mamontov <mamontov1@gmail.com>
# SPDX-License-Identifier: Apache-2.0

CONFIG_SOC_SERIES_STM32G4X=y
CONFIG_SOC_STM32G431XX=y
CONFIG_BOARD_USBCANFD_OLEKSII_G431=y

# Hardware Support
CONFIG_GPIO=y
CONFIG_ARM_MPU=y
```

## boards/canmodule/usbcanfd_Oleksii_g473/Kconfig.usbcanfd_Oleksii_g473
```kconfig
# Copyright (c) 2026 Oleksii Mamontov <mamontov1@gmail.com>
# SPDX-License-Identifier: Apache-2.0
config BOARD_USBCANFD_OLEKSII_G473
	select SOC_STM32G473XX
```

## boards/canmodule/usbcanfd_Oleksii_g473/board.yml
```yaml
board:
  name: usbcanfd_Oleksii_g473
  full_name: USB CANFD DUAL (can-module.com)
  vendor: canmodule
  socs:
    - name: stm32g473xx
```

## boards/canmodule/usbcanfd_dual/Kconfig.usbcanfd_dual
```kconfig
# Copyright (c) 2026 Oleksii Mamontov <mamontov1@gmail.com>
# SPDX-License-Identifier: Apache-2.0

config BOARD_USBCANFD_DUAL
	select SOC_STM32G473XX
```
