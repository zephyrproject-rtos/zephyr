## boards/sensry/ganymed_sk/Kconfig.defconfig
```kconfig
# Copyright (c) 2025 sensry.io
# SPDX-License-Identifier: Apache-2.0

configdefault ETH_DRIVER
	default y
```

## boards/shields/3dr_n1_fpv/Kconfig.shield
```kconfig
# SPDX-FileCopyrightText: Copyright The Zephyr Project Contributors
# SPDX-License-Identifier: Apache-2.0

config SHIELD_3DR_N1_FPV
	def_bool $(shields_list_contains,3dr_n1_fpv)
```

## boards/shields/3dr_n1_longy/Kconfig.shield
```kconfig
# SPDX-FileCopyrightText: Copyright The Zephyr Project Contributors
# SPDX-License-Identifier: Apache-2.0

config SHIELD_3DR_N1_LONGY
	def_bool $(shields_list_contains,3dr_n1_longy)
```

## boards/shields/adafruit_2_4_tft/Kconfig.defconfig
```kconfig
# Copyright (c) 2026 Conclusive Engineering
# Copyright (c) 2026 Texas Instruments
# SPDX-License-Identifier: Apache-2.0

if SHIELD_ADAFRUIT_2_4_TFT

if DISPLAY

if LVGL

config LV_Z_VDB_SIZE
	default 64

config LV_Z_BITS_PER_PIXEL
	default 24

choice LV_COLOR_DEPTH
	default LV_COLOR_DEPTH_32
endchoice

config INPUT
	default y

endif # LVGL

endif # DISPLAY

endif # SHIELD_ADAFRUIT_2_4_TFT
```

## boards/shields/adafruit_2_4_tft/Kconfig.shield
```kconfig
# Copyright (c) 2026 Conclusive Engineering
# Copyright (c) 2026 Texas Instruments
# SPDX-License-Identifier: Apache-2.0

config SHIELD_ADAFRUIT_2_4_TFT
	def_bool $(shields_list_contains,adafruit_2_4_tft)
```

## boards/shields/adafruit_featherwing_128x32_oled/Kconfig.defconfig
```kconfig
# Copyright The Zephyr Project Contributors
# SPDX-License-Identifier: Apache-2.0

if SHIELD_ADAFRUIT_FEATHERWING_128X32_OLED

if DISPLAY

if LVGL

config LV_Z_VDB_SIZE
	default 64

config LV_DPI_DEF
	default 148

config LV_Z_COLOR_MONO_HW_INVERSION
	default y

choice LV_COLOR_FORMAT_DEFAULT
	default LV_COLOR_FORMAT_I1
endchoice

endif # LVGL

endif # DISPLAY

endif # SHIELD_ADAFRUIT_FEATHERWING_128X32_OLED
```

## boards/shields/adafruit_ism330dhcx/Kconfig.shield
```kconfig
# Copyright (c) 2026 Analog Devices, Inc
# SPDX-License-Identifier: Apache-2.0

config SHIELD_ADAFRUIT_ISM330DHCX
	def_bool $(shields_list_contains,adafruit_ism330dhcx)
```

## boards/shields/adafruit_max98357a/Kconfig.shield
```kconfig
# SPDX-FileCopyrightText: 2026 Muhammad Waleed Badar
# SPDX-License-Identifier: Apache-2.0

config SHIELD_ADAFRUIT_MAX98357A
	def_bool $(shields_list_contains,adafruit_max98357a)
```

## boards/shields/arceli_eth_w5500/Kconfig.defconfig
```kconfig
# Copyright (c) 2022 Linumiz
# SPDX-License-Identifier: Apache-2.0

if SHIELD_ARCELI_ETH_W5500

configdefault ETH_DRIVER
	default y

endif # SHIELD_ARCELI_ETH_W5500
```

## boards/shields/arduino_giga_display_shield/Kconfig.defconfig
```kconfig
# Copyright (c) 2025 Arduino SA
# SPDX-License-Identifier: Apache-2.0

if SHIELD_ARDUINO_GIGA_DISPLAY_SHIELD

if LVGL

config INPUT
	default y

config LV_DPI_DEF
	default 128

config LV_Z_FLUSH_THREAD
	default y

endif # LVGL

endif # SHIELD_ARDUINO_GIGA_DISPLAY_SHIELD
```

## boards/shields/buydisplay_3_5_tft_touch_arduino/Kconfig.defconfig
```kconfig
# Copyright (c) 2020 Teslabs Engineering S.L.
# SPDX-License-Identifier: Apache-2.0

if SHIELD_BUYDISPLAY_3_5_TFT_TOUCH_ARDUINO

if DISPLAY

if LVGL

config LV_Z_VDB_SIZE
	default 32

config LV_Z_BITS_PER_PIXEL
	default 24

config INPUT
	default y

endif # LVGL

endif # DISPLAY

endif # SHIELD_BUYDISPLAY_3_5_TFT_TOUCH_ARDUINO
```

## boards/shields/cy15framkit_001/Kconfig.shield
```kconfig
# SPDX-FileCopyrightText: Copyright (c) 2026 Infineon Technologies AG,
# SPDX-FileCopyrightText: or an affiliate of Infineon Technologies AG. All rights reserved.
#
# SPDX-License-Identifier: Apache-2.0

config SHIELD_CY15FRAMKIT_001
	def_bool $(shields_list_contains,cy15framkit_001)
```

## boards/shields/dhsbc_rs485_can_shield/Kconfig.shield
```kconfig
# Copyright (C) 2026 DH electronics GmbH
# SPDX-License-Identifier: Apache-2.0

config SHIELD_DHSBC_RS485_CAN_SHIELD
	def_bool $(shields_list_contains,dhsbc_rs485_can_shield)
```

## boards/shields/dvp_24pin_ov2640/Kconfig.shield
```kconfig
# SPDX-FileCopyrightText: Copyright Panoramix Labs
# SPDX-License-Identifier: Apache-2.0

config SHIELD_DVP_24PIN_OV2640
	def_bool $(shields_list_contains,dvp_24pin_ov2640)
```

## boards/shields/esp_threadbr_ethernet/Kconfig.defconfig
```kconfig
# Copyright (c) 2026 Espressif Systems (Shanghai) Co., Ltd.
# SPDX-License-Identifier: Apache-2.0

if SHIELD_ESP_THREADBR_ETHERNET

configdefault ETH_DRIVER
	default y

endif # SHIELD_ESP_THREADBR_ETHERNET
```

## boards/shields/espressif_sc2336_cam_module/Kconfig.shield
```kconfig
# Copyright (c) 2026 Espressif Systems (Shanghai) Co., Ltd.
# SPDX-License-Identifier: Apache-2.0

config SHIELD_ESPRESSIF_SC2336_CAM_MODULE
	def_bool $(shields_list_contains,espressif_sc2336_cam_module)
```

## boards/shields/eval_adis16607_2_pcbz/Kconfig.shield
```kconfig
# Copyright (c) 2026 Analog Devices, Inc.
# SPDX-License-Identifier: Apache-2.0

config SHIELD_EVAL_ADIS16607_2_PCBZ
	def_bool $(shields_list_contains,eval_adis16607_2_pcbz)
```

## boards/shields/eval_adis16607_3_pcbz/Kconfig.shield
```kconfig
# Copyright (c) 2026 Analog Devices, Inc.
# SPDX-License-Identifier: Apache-2.0

config SHIELD_EVAL_ADIS16607_3_PCBZ
	def_bool $(shields_list_contains,eval_adis16607_3_pcbz)
```

## boards/shields/g1120b0mipi/Kconfig.defconfig
```kconfig
# Copyright 2023 NXP
# SPDX-License-Identifier: Apache-2.0

if SHIELD_G1120B0MIPI

# Enable input subsystem for FT5336 driver
config INPUT
	default y

if LVGL

config LV_Z_VDB_SIZE
	default 16

config LV_DPI_DEF
	default 128

# Use offloaded render thread
config LV_Z_FLUSH_THREAD
	default y

choice LV_COLOR_FORMAT_DEFAULT
	default LV_COLOR_FORMAT_RGB565
endchoice

endif # LVGL

endif # SHIELD_G1120B0MIPI
```

## boards/shields/heltec_t114_v2_display/Kconfig.shield
```kconfig
# Copyright (c) 2026 Yeray Lois Sanchez
# SPDX-License-Identifier: Apache-2.0

config SHIELD_HELTEC_T114_V2_DISPLAY
	def_bool $(shields_list_contains,heltec_t114_v2_display)
```

## boards/shields/holybro_m10/Kconfig.shield
```kconfig
# SPDX-FileCopyrightText: Copyright The Zephyr Project Contributors
# SPDX-License-Identifier: Apache-2.0

config SHIELD_HOLYBRO_M10
	def_bool $(shields_list_contains,holybro_m10)
```
