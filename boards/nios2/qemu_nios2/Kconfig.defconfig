## boards/nios2/qemu_nios2/Kconfig.defconfig
```kconfig
if BOARD_QEMU_NIOS2

config BUILD_OUTPUT_BIN
        default n

config BOARD
	default "qemu_nios2"

endif
```

## boards/nios2/qemu_nios2/Kconfig.qemu_nios2
```kconfig
# Copyright (c) 2022 Zephyr Project members and individual contributors
# SPDX-License-Identifier: Apache-2.0

config BOARD_QEMU_NIOS2
	bool
	default y
	select SOC_NIOS2_QEMU
	select QEMU_TARGET
```

## boards/nios2/qemu_nios2/qemu_nios2_defconfig
```kconfig
# SPDX-License-Identifier: Apache-2.0

CONFIG_SOC_NIOS2_QEMU=y
CONFIG_BOARD_QEMU_NIOS2=y
CONFIG_HAS_ALTERA_HAL=y
CONFIG_CONSOLE=y
CONFIG_PRINTK=y
CONFIG_SERIAL=y
CONFIG_UART_ALTERA_JTAG=y
CONFIG_UART_NS16550=y
CONFIG_UART_CONSOLE=y
CONFIG_INCLUDE_RESET_VECTOR=n
CONFIG_EXTRA_EXCEPTION_INFO=y
CONFIG_QEMU_ICOUNT_SHIFT=4
```

## boards/nordic/nrf21540dk/Kconfig.defconfig
```kconfig
# nRF21540 DK NRF52840 board configuration

# Copyright (c) 2020 Nordic Semiconductor ASA
# SPDX-License-Identifier: Apache-2.0

if BOARD_NRF21540DK

config HW_STACK_PROTECTION
	default ARCH_HAS_STACK_PROTECTION

endif # BOARD_NRF21540DK
```

## boards/nordic/nrf21540dk/Kconfig.nrf21540dk
```kconfig
# nRF21540 DK NRF52840 board configuration

# Copyright (c) 2020 Nordic Semiconductor ASA
# SPDX-License-Identifier: Apache-2.0

config BOARD_NRF21540DK
	select SOC_NRF52840_QIAA
```

## boards/nordic/nrf21540dk/board.yml
```yaml
board:
  name: nrf21540dk
  full_name: nRF21540 DK
  vendor: nordic
  socs:
  - name: nrf52840
```

## boards/nordic/nrf51dk/Kconfig.nrf51dk
```kconfig
# Copyright (c) 2023 Nordic Semiconductor ASA

# SPDX-License-Identifier: Apache-2.0

config BOARD_NRF51DK
	select SOC_NRF51822_QFAC
```

## boards/nordic/nrf51dk/board.yml
```yaml
board:
  name: nrf51dk
  full_name: nRF51 DK
  vendor: nordic
  socs:
  - name: nrf51822
```

## boards/nordic/nrf51dongle/Kconfig.nrf51dongle
```kconfig
# nRF51 Dongle NRF51822 board configuration

# Copyright (c) 2018 Nordic Semiconductor ASA.
# SPDX-License-Identifier: Apache-2.0

config BOARD_NRF51DONGLE
	select SOC_NRF51822_QFAC
```

## boards/nordic/nrf51dongle/board.yml
```yaml
board:
  name: nrf51dongle
  full_name: nRF51 Dongle
  vendor: nordic
  socs:
  - name: nrf51822
```

## boards/nordic/nrf52833dk/Kconfig.defconfig
```kconfig
# nRF52833 DK NRF52833 board configuration

# Copyright (c) 2019 Nordic Semiconductor ASA
# SPDX-License-Identifier: Apache-2.0

if BOARD_NRF52833DK

config HW_STACK_PROTECTION
	default ARCH_HAS_STACK_PROTECTION

endif # BOARD_NRF52833DK
```

## boards/nordic/nrf52833dk/Kconfig.nrf52833dk
```kconfig
# nRF52833 DK NRF52833 board configuration

# Copyright (c) 2019 Nordic Semiconductor ASA
# SPDX-License-Identifier: Apache-2.0

config BOARD_NRF52833DK
	select SOC_NRF52820_QDAA if BOARD_NRF52833DK_NRF52820
	select SOC_NRF52833_QIAA if BOARD_NRF52833DK_NRF52833
```

## boards/nordic/nrf52833dk/board.yml
```yaml
board:
  name: nrf52833dk
  full_name: nRF52833 DK
  vendor: nordic
  socs:
  - name: nrf52820
  - name: nrf52833
```

## boards/nordic/nrf52840dk/Kconfig
```kconfig
# nRF52840 DK NRF52840 board configuration

# Copyright (c) 2016 Nordic Semiconductor ASA
# SPDX-License-Identifier: Apache-2.0

if BOARD_NRF52840DK

config BOARD_ENABLE_DCDC
	bool "DCDC mode"
	select SOC_DCDC_NRF52X
	default y

config BOARD_ENABLE_DCDC_HV
	bool "High Voltage DCDC converter"
	select SOC_DCDC_NRF52X_HV
	default y
	depends on SOC_NRF52840_QIAA

endif # BOARD_NRF52840DK
```

## boards/nordic/nrf52840dk/Kconfig.defconfig
```kconfig
# nRF52840 DK NRF52840 board configuration

# Copyright (c) 2016 Nordic Semiconductor ASA
# SPDX-License-Identifier: Apache-2.0

if BOARD_NRF52840DK

config HW_STACK_PROTECTION
	default ARCH_HAS_STACK_PROTECTION

if NORDIC_QSPI_NOR

config NORDIC_QSPI_NOR_FLASH_LAYOUT_PAGE_SIZE
	default 4096 if MCUBOOT || BOOTLOADER_MCUBOOT

endif # NORDIC_QSPI_NOR

endif # BOARD_NRF52840DK
```

## boards/nordic/nrf52840dk/Kconfig.nrf52840dk
```kconfig
# Copyright (c) 2022 Zephyr Project members and individual contributors
# SPDX-License-Identifier: Apache-2.0

config BOARD_NRF52840DK
	select SOC_NRF52840_QIAA if BOARD_NRF52840DK_NRF52840
	select SOC_NRF52811_QFAA if BOARD_NRF52840DK_NRF52811
```

## boards/nordic/nrf52840dk/board.yml
```yaml
board:
  name: nrf52840dk
  full_name: nRF52840 DK
  vendor: nordic
  socs:
  # Physical nRF52840 SoC on PCA10056
  - name: nrf52840
  # nRF52840 SoC in nRF52811 emulation mode on PCA10056
  - name: nrf52811
```

## boards/nordic/nrf52840dk/nrf52840dk_nrf52811_defconfig
```kconfig
# Copyright (c) 2016 Nordic Semiconductor ASA

# SPDX-License-Identifier: Apache-2.0

# Enable MPU
CONFIG_ARM_MPU=y

# Enable hardware stack protection
CONFIG_HW_STACK_PROTECTION=y

# Enable UART
CONFIG_SERIAL=y

# enable console
CONFIG_CONSOLE=y
CONFIG_UART_CONSOLE=y

# enable GPIO
CONFIG_GPIO=y

# Bluetooth not enabled by default on nRF52811 due to RAM limitations when
# running the default set of kernel tests.
# Enable this on your prj.conf to include Bluetooth support
```

## boards/nordic/nrf52840dongle/Kconfig
```kconfig
# nRF52840 Dongle NRF52840 board configuration

# Copyright (c) 2018-2023 Nordic Semiconductor ASA
# SPDX-License-Identifier: Apache-2.0

config BOARD_NRF52840DONGLE
	select BOARD_EARLY_INIT_HOOK

config BOARD_HAS_NRF5_BOOTLOADER
	bool
	default y if !BOARD_NRF52840DONGLE_NRF52840_BARE
	help
	  If selected, applications are linked so that they can be loaded by Nordic
	  nRF5 bootloader.
```

## boards/nordic/nrf52840dongle/Kconfig.defconfig
```kconfig
# nRF52840 Dongle NRF52840 board configuration
#
# Copyright (c) 2018-2023 Nordic Semiconductor ASA
#
# SPDX-License-Identifier: Apache-2.0

if BOARD_NRF52840DONGLE

config HW_STACK_PROTECTION
	default ARCH_HAS_STACK_PROTECTION

# To let the nRF5 bootloader load an application, the application
# must be linked after Nordic MBR, that is factory-programmed on the board.

# If the application wants to use the full partition size, a "bare" board
# variant should be used instead.

config FLASH_LOAD_OFFSET
	default 0x1000
	depends on BOARD_HAS_NRF5_BOOTLOADER && !USE_DT_CODE_PARTITION

source "boards/common/usb/Kconfig.cdc_acm_serial.defconfig"

endif # BOARD_NRF52840DONGLE
```

## boards/nordic/nrf52840dongle/Kconfig.nrf52840dongle
```kconfig
# nRF52840 Dongle NRF52840 board configuration

# Copyright (c) 2018 Nordic Semiconductor ASA
# SPDX-License-Identifier: Apache-2.0

config BOARD_NRF52840DONGLE
	select SOC_NRF52840_QIAA
```

## boards/nordic/nrf52840dongle/board.yml
```yaml
board:
  name: nrf52840dongle
  full_name: nRF52840 Dongle
  vendor: nordic
  socs:
  - name: nrf52840
```

## boards/nordic/nrf52dk/Kconfig
```kconfig
# nRF52 DK nRF52810 board configuration

# Copyright (c) 2018 Nordic Semiconductor ASA
# SPDX-License-Identifier: Apache-2.0

if BOARD_NRF52DK

# BT_CTLR depends on BT. When BT is enabled we should default to also
# enabling the controller.
config BT_CTLR
	default y if BT

endif # BOARD_NRF52DK
```

## boards/nordic/nrf52dk/Kconfig.defconfig
```kconfig
# nRF52 DK board configuration

# Copyright (c) 2025 Nordic Semiconductor ASA
# SPDX-License-Identifier: Apache-2.0

if BOARD_NRF52DK

config HW_STACK_PROTECTION
	default ARCH_HAS_STACK_PROTECTION

endif # BOARD_NRF52DK
```
