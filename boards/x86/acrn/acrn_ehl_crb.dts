/*
 * Copyright (c) 2019 Intel Corporation
 *
 * SPDX-License-Identifier: Apache-2.0
 */

#include "acrn.dts"

/ {
	ibecc: ibecc {
	       compatible = "intel,ibecc";
	       label = "ibecc";
	       status = "okay";
	};
};
