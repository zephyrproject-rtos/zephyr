## boards/x86/intel_ehl/Kconfig.board
```kconfig
# Copyright (c) 2020 Intel Corporation
# SPDX-License-Identifier: Apache-2.0

config BOARD_INTEL_EHL_CRB
	bool "Elkhart Lake CRB"
	depends on SOC_ELKHART_LAKE
	select X86_64
	select HAS_COVERAGE_SUPPORT

config BOARD_INTEL_EHL_CRB_SBL
	bool "Elkhart Lake CRB (with Slim Bootloader)"
	depends on SOC_ELKHART_LAKE
	select X86_64
```

## boards/x86/intel_ehl/Kconfig.defconfig
```kconfig
# Copyright (c) 2020 Intel Corporation
# SPDX-License-Identifier: Apache-2.0

if BOARD_INTEL_EHL_CRB || BOARD_INTEL_EHL_CRB_SBL

config BOARD
	default "intel_ehl_crb_sbl" if BOARD_INTEL_EHL_CRB_SBL
	default "intel_ehl_crb"

config BUILD_OUTPUT_STRIPPED
	default y

config MP_MAX_NUM_CPUS
	default 2

if BOARD_INTEL_EHL_CRB_SBL
config SHELL_BACKEND_SERIAL_INTERRUPT_DRIVEN
	depends on SHELL_BACKEND_SERIAL
	default n
endif

config HEAP_MEM_POOL_SIZE
	default 32768 if ACPI
	depends on KERNEL_MEM_POOL

# TSC on this board is 1.9 GHz, HPET and APIC are 19.2 MHz
config SYS_CLOCK_HW_CYCLES_PER_SEC
	default 1900000000 if APIC_TSC_DEADLINE_TIMER
	default 1900000000 if APIC_TIMER_TSC
	default 19200000

if APIC_TIMER
config APIC_TIMER_IRQ
	default 24
config APIC_TIMER_TSC_M
	default 3
config APIC_TIMER_TSC_N
	default 249
endif

endif # BOARD_INTEL_EHL_CRB || BOARD_INTEL_EHL_CRB_SBL
```

## boards/x86/intel_ish/Kconfig.board
```kconfig
# Copyright (c) 2023 Intel Corporation
#
# SPDX-License-Identifier: Apache-2.0
#

config BOARD_INTEL_ISH_5_4_1
	bool "Intel ISH 5.4.1 board"
	depends on SOC_INTEL_ISH_5_4_1

config BOARD_INTEL_ISH_5_6_0
	bool "Intel ISH 5.6.0 board"
	depends on SOC_INTEL_ISH_5_6_0

config BOARD_INTEL_ISH_5_8_0
	bool "Intel ISH 5.8.0 board"
	depends on SOC_INTEL_ISH_5_8_0
```

## boards/x86/intel_ish/Kconfig.defconfig
```kconfig
# Copyright (c) 2023 Intel Corporation
#
# SPDX-License-Identifier: Apache-2.0
#

if BOARD_INTEL_ISH_5_4_1 || BOARD_INTEL_ISH_5_6_0 || BOARD_INTEL_ISH_5_8_0

config BOARD
	default "intel_ish_5_4_1" if BOARD_INTEL_ISH_5_4_1
	default "intel_ish_5_6_0" if BOARD_INTEL_ISH_5_6_0
	default "intel_ish_5_8_0" if BOARD_INTEL_ISH_5_8_0

if TEST
config TEST_EXTRA_STACK_SIZE
	int
	default 1024
endif # TEST

config HPET_TIMER
	default y

config SYS_CLOCK_TICKS_PER_SEC
	default 2048 if HPET_TIMER # HPET is 32768 HZ

endif # BOARD_INTEL_ISH_5_4_1 || BOARD_INTEL_ISH_5_6_0 || BOARD_INTEL_ISH_5_8_0
```

## boards/x86/intel_ish/intel_ish_5_8_0_defconfig
```kconfig
#
# Copyright (c) 2023 Intel Corporation
#
# SPDX-License-Identifier: Apache-2.0
#

CONFIG_SOC_FAMILY_INTEL_ISH=y
CONFIG_SOC_SERIES_INTEL_ISH5=y
CONFIG_SOC_INTEL_ISH_5_8_0=y
CONFIG_BOARD_INTEL_ISH_5_8_0=y

# uart & console
CONFIG_CONSOLE=y
CONFIG_UART_CONSOLE=y
CONFIG_SERIAL=y
```

## boards/x86/intel_rpl/Kconfig.board
```kconfig
# Copyright (c) 2022-2023 Intel Corporation
# SPDX-License-Identifier: Apache-2.0

config BOARD_INTEL_RPL_S_CRB
	bool "Raptor Lake S CRB"
	depends on SOC_RAPTOR_LAKE
	select X86_64
	select HAS_COVERAGE_SUPPORT

config BOARD_INTEL_RPL_P_CRB
	bool "Raptor Lake P CRB"
	depends on SOC_RAPTOR_LAKE
	select X86_64
	select HAS_COVERAGE_SUPPORT
```

## boards/x86/intel_rpl/Kconfig.defconfig
```kconfig
# Copyright (c) 2022-2023 Intel Corporation
# SPDX-License-Identifier: Apache-2.0

if BOARD_INTEL_RPL_S_CRB || BOARD_INTEL_RPL_P_CRB

config BOARD
	default "intel_rpl_p_crb" if BOARD_INTEL_RPL_P_CRB
	default "intel_rpl_s_crb" if BOARD_INTEL_RPL_S_CRB

config BUILD_OUTPUT_STRIPPED
	default y

config MP_MAX_NUM_CPUS
	default 2

# TSC on this board is 1.9 GHz, HPET and APIC are 19.2 MHz
config SYS_CLOCK_HW_CYCLES_PER_SEC
	default 1900000000 if APIC_TSC_DEADLINE_TIMER
	default 1900000000 if APIC_TIMER_TSC
	default 19200000

if APIC_TIMER
config APIC_TIMER_IRQ
	default 24
config APIC_TIMER_TSC_M
	default 3
config APIC_TIMER_TSC_N
	default 249
endif

config ACPI
	default y

if ACPI
config HEAP_MEM_POOL_ADD_SIZE_ACPI
	default 64000000
config MAIN_STACK_SIZE
	default 320000

if SHELL
config SHELL_STACK_SIZE
	default 320000
endif # SHELL
endif # ACPI

if DMA
config DMA_64BIT
	default y
config DMA_DW_HW_LLI
	default n
config DMA_DW_CHANNEL_COUNT
	default 2
endif

config UART_NS16550_INTEL_LPSS_DMA
	default y if BOARD_INTEL_RPL_S_CRB

if SHELL
config SHELL_STACK_SIZE
	default 320000
endif

endif # BOARD_INTEL_RPL_S_CRB || BOARD_INTEL_RPL_P_CRB
```

## boards/x86/intel_rpl/intel_rpl_s_crb_defconfig
```kconfig
# SPDX-License-Identifier: Apache-2.0

CONFIG_SOC_RAPTOR_LAKE=y
CONFIG_BOARD_INTEL_RPL_S_CRB=y
CONFIG_PIC_DISABLE=y
CONFIG_LOAPIC=y
CONFIG_CONSOLE=y
CONFIG_SERIAL=y
CONFIG_UART_NS16550=y
CONFIG_UART_NS16550_VARIANT_NS16750=y
CONFIG_UART_CONSOLE=y
CONFIG_X2APIC=y
CONFIG_SMP=y
CONFIG_BUILD_OUTPUT_EFI=y
CONFIG_BUILD_NO_GAP_FILL=y
CONFIG_HEAP_MEM_POOL_SIZE=64000000
CONFIG_MAIN_STACK_SIZE=320000
```

## boards/x86/minnowboard/Kconfig.board
```kconfig
# MinnowBoard Max

# SPDX-License-Identifier: Apache-2.0

config BOARD_MINNOWBOARD
	def_bool "$(BOARD)" = "minnowboard"
	depends on SOC_ATOM
```

## boards/x86/minnowboard/Kconfig.defconfig
```kconfig
# SPDX-License-Identifier: Apache-2.0

if BOARD_MINNOWBOARD

config BOARD
	default "minnowboard"

config BUILD_OUTPUT_STRIPPED
	default y

config X86_MMU_PAGE_POOL_PAGES
	default 3086 if X86_MMU

endif # BOARD_MINNOWBOARD
```

## boards/x86/minnowboard/minnowboard_defconfig
```kconfig
# SPDX-License-Identifier: Apache-2.0

CONFIG_SOC_ATOM=y
CONFIG_BOARD_MINNOWBOARD=y
CONFIG_HPET_TIMER=y
CONFIG_PIC_DISABLE=y
CONFIG_LOAPIC=y
CONFIG_CONSOLE=y
CONFIG_SERIAL=y
CONFIG_UART_NS16550=y
CONFIG_UART_CONSOLE=y
CONFIG_SYS_CLOCK_HW_CYCLES_PER_SEC=25000000
```

## boards/x86/panther/Kconfig.defconfig
```kconfig
if BOARD_PANTHER

config BOARD
	default "panther"

if BT_H4

config BT_UART_ON_DEV_NAME
	default UART_QMSI_0_NAME

config UART_QMSI_0_BAUDRATE
	default 1000000

config UART_QMSI_0_HW_FC
	def_bool y

endif

if UART_PIPE

config UART_PIPE_ON_DEV_NAME
	default UART_QMSI_1_NAME

endif

config BT_MONITOR_ON_DEV_NAME
	default UART_QMSI_1_NAME if BT_DEBUG_MONITOR

if WIFI_WINC1500

config SPI
	def_bool y
config GPIO
	def_bool y

if GPIO_QMSI

config WINC1500_GPIO_0_NAME
	default GPIO_QMSI_0_NAME
config WINC1500_GPIO_1_NAME
	default GPIO_QMSI_1_NAME

endif # GPIO_QMSI

if SPI_QMSI
config SPI_CS_GPIO
	def_bool y
config SPI_1_CS_GPIO_PORT
	default GPIO_QMSI_0_NAME
config SPI_1_CS_GPIO_PIN
	default 11
config WINC1500_GPIO_0_NAME
	string
	default GPIO_QMSI_0_NAME
config WINC1500_GPIO_1_NAME
	string
	default GPIO_QMSI_1_NAME
endif

endif # WIFI_WINC1500



config LEDS_GPIO_NAME
	string
	default GPIO_QMSI_0_NAME

config SPI_0
	def_bool n


endif # BOARD_PANTHER
```

## boards/x86/panther/panther_defconfig
```kconfig
CONFIG_X86=y
CONFIG_SOC_QUARK_SE_C1000=y
CONFIG_BOARD_PANTHER=y
CONFIG_SOC_SERIES_QUARK_SE=y
CONFIG_SOC_FAMILY_QUARK=y
CONFIG_CPU_MINUTEIA=y
CONFIG_SET_GDT=n
CONFIG_CONSOLE=y
CONFIG_UART_QMSI=y
CONFIG_UART_CONSOLE=y
CONFIG_SERIAL=y
CONFIG_PRINTK=y
CONFIG_PINMUX=y
CONFIG_GPIO=y
CONFIG_UART_CONSOLE_INIT_PRIORITY=65
```

## boards/x86/qemu_x86/Kconfig.board
```kconfig
# SPDX-License-Identifier: Apache-2.0

config BOARD_QEMU_X86
	bool "QEMU x86"
	depends on SOC_IA32
	select QEMU_TARGET
	select CPU_HAS_FPU
	select HAS_COVERAGE_SUPPORT

config BOARD_QEMU_X86_64
	bool "QEMU x86_64"
	depends on SOC_IA32
	select QEMU_TARGET
	select X86_64
```

## boards/x86/qemu_x86/Kconfig.defconfig
```kconfig
# SPDX-License-Identifier: Apache-2.0

if BOARD_QEMU_X86 || BOARD_QEMU_X86_64 || BOARD_QEMU_X86_LAKEMONT || BOARD_QEMU_X86_TINY

# The EEPROM emulator must be initialized after the flash simulator
config EEPROM_INIT_PRIORITY
	default 60
	depends on EEPROM

config BUILD_OUTPUT_BIN
	default n

endif # BOARD_QEMU_X86 || BOARD_QEMU_X86_64 || BOARD_QEMU_X86_LAKEMONT || BOARD_QEMU_X86_TINY

if BOARD_QEMU_X86

config BOARD
	default "qemu_x86"

config FLASH_SIMULATOR
	default y
	depends on FLASH

config KERNEL_VM_SIZE
	default 0x10000000 if ACPI

config HEAP_MEM_POOL_SIZE
	default 32768 if ACPI
	depends on KERNEL_MEM_POOL

config MULTIBOOT
	default y

config MULTIBOOT_INFO
	default y if MULTIBOOT

config MULTIBOOT_MEMMAP
	default y if MULTIBOOT

config QEMU_ICOUNT
	default n if HPET_TIMER && SHELL

config QEMU_ICOUNT_SHIFT
	default 5

endif # BOARD_QEMU_X86

if BOARD_QEMU_X86_64

config BOARD
	default "qemu_x86_64"

config KERNEL_VM_SIZE
	default 0x10000000 if ACPI

config HEAP_MEM_POOL_SIZE
	default 32768 if ACPI
	depends on KERNEL_MEM_POOL

endif # BOARD_QEMU_X86_64

if BOARD_QEMU_X86_LAKEMONT

config BOARD
	default "qemu_x86_lakemont"

config KERNEL_VM_SIZE
	default 0x400000

config MULTIBOOT
	# This is needed for QEMU to load the ELF image
	default y

config X86_PC_COMPATIBLE
	# QEMU presents a PC-compatible machine
	default y

config QEMU_ICOUNT
	default n if HPET_TIMER && SHELL

config QEMU_ICOUNT_SHIFT
	default 5

endif # BOARD_QEMU_X86_LAKEMONT

if BOARD_QEMU_X86_TINY

config BOARD
	default "qemu_x86_tiny"

config KERNEL_VM_SIZE
	default 0x400000

config MULTIBOOT
	# This is needed for QEMU to load the ELF image
	default y

config X86_PC_COMPATIBLE
	# QEMU presents a PC-compatible machine
	default y

config QEMU_ICOUNT
	default n if HPET_TIMER && SHELL

config QEMU_ICOUNT_SHIFT
	default 5

config HAVE_CUSTOM_LINKER_SCRIPT
	default y

config CUSTOM_LINKER_SCRIPT
	default "${ZEPHYR_BASE}/boards/x86/qemu_x86/qemu_x86_tiny.ld"

config X86_EXTRA_PAGE_TABLE_PAGES
	# This is needed for gen_mmu.py to map the flash into memory
	default 2 if DEMAND_PAGING && !LINKER_GENERIC_SECTIONS_PRESENT_AT_BOOT

config DEMAND_PAGING_PAGE_FRAMES_RESERVE
	# Need to accommodate the heap for newlib or common malloc in libc-hook.c
	default 6 if NEWLIB_LIBC || (COMMON_LIBC_MALLOC && COMMON_LIBC_MALLOC_ARENA_SIZE != 0)

endif # BOARD_QEMU_X86_TINY
```

## boards/x86/qemu_x86/Kconfig.qemu_x86_64
```kconfig
# SPDX-License-Identifier: Apache-2.0

config BOARD_QEMU_X86_64
	bool
	default y
	select SOC_IA32
	select QEMU_TARGET
	select X86_64
	select HAS_COVERAGE_SUPPORT
```

## boards/x86/qemu_x86/Kconfig.qemu_x86_64_nokpti
```kconfig
# Copyright (c) 2022 Zephyr Project members and individual contributors
# SPDX-License-Identifier: Apache-2.0

config BOARD_QEMU_X86_64_NOKPTI
	bool
	default y
	select SOC_IA32
	select QEMU_TARGET
	select X86_64
	select HAS_COVERAGE_SUPPORT
```

## boards/x86/qemu_x86/Kconfig.qemu_x86_nommu
```kconfig
# Copyright (c) 2022 Zephyr Project members and individual contributors
# SPDX-License-Identifier: Apache-2.0

config BOARD_QEMU_X86_NOMMU
	bool
	default y
	select SOC_IA32
	select QEMU_TARGET
	select CPU_HAS_FPU
	select HAS_COVERAGE_SUPPORT
```

## boards/x86/qemu_x86/qemu_x86_64_defconfig
```kconfig
# SPDX-License-Identifier: Apache-2.0

CONFIG_SOC_IA32=y
CONFIG_BOARD_QEMU_X86_64=y
CONFIG_HPET_TIMER=y
CONFIG_PIC_DISABLE=y
CONFIG_LOAPIC=y
CONFIG_CONSOLE=y
CONFIG_SERIAL=y
CONFIG_UART_NS16550=y
CONFIG_UART_CONSOLE=y
CONFIG_SYS_CLOCK_HW_CYCLES_PER_SEC=25000000
CONFIG_TEST_RANDOM_GENERATOR=y
CONFIG_DEBUG_INFO=y
CONFIG_SMP=y
CONFIG_MP_NUM_CPUS=2
CONFIG_X86_MMU=y
CONFIG_X86_VERY_EARLY_CONSOLE=y
CONFIG_QEMU_ICOUNT=n
```

## boards/x86/qemu_x86/qemu_x86_coverage_defconfig
```kconfig
# SPDX-License-Identifier: Apache-2.0

CONFIG_SOC_IA32=y
CONFIG_BOARD_QEMU_X86=y
CONFIG_HPET_TIMER=y
CONFIG_PIC_DISABLE=y
CONFIG_LOAPIC=y
CONFIG_CONSOLE=y
CONFIG_SERIAL=y
CONFIG_UART_NS16550=y
CONFIG_UART_CONSOLE=y
CONFIG_SYS_CLOCK_HW_CYCLES_PER_SEC=25000000
CONFIG_TEST_RANDOM_GENERATOR=y
CONFIG_X86_MMU=y
CONFIG_DEBUG_INFO=y
CONFIG_SCHED_SCALABLE=y
CONFIG_WAITQ_SCALABLE=y
CONFIG_COVERAGE=y
CONFIG_X86_VERY_EARLY_CONSOLE=y
CONFIG_QEMU_ICOUNT_SHIFT=5
```

## boards/x86/qemu_x86/qemu_x86_nommu_defconfig
```kconfig
CONFIG_X86=y
CONFIG_SOC_IA32=y
CONFIG_BOARD_QEMU_X86=y
CONFIG_CPU_MINUTEIA=y
CONFIG_IA32_LEGACY_IO_PORTS=y
CONFIG_HPET_TIMER=y
CONFIG_HPET_TIMER_IRQ=2
CONFIG_HPET_TIMER_LEGACY_EMULATION=y
CONFIG_HPET_TIMER_RISING_EDGE=y
CONFIG_PIC_DISABLE=y
CONFIG_LOAPIC=y
CONFIG_CONSOLE=y
CONFIG_SERIAL=y
CONFIG_UART_NS16550=y
CONFIG_UART_CONSOLE=y
CONFIG_SYS_CLOCK_HW_CYCLES_PER_SEC=25000000
CONFIG_TEST_RANDOM_GENERATOR=y
CONFIG_XIP=y
```

## boards/x86/qemu_x86/qemu_x86_virt_defconfig
```kconfig
# SPDX-License-Identifier: Apache-2.0

CONFIG_SOC_IA32=y
CONFIG_BOARD_QEMU_X86=y
CONFIG_PIC_DISABLE=y
CONFIG_LOAPIC=y
CONFIG_CONSOLE=y
CONFIG_SERIAL=y
CONFIG_UART_CONSOLE=y
CONFIG_SYS_CLOCK_HW_CYCLES_PER_SEC=25000000
CONFIG_TEST_RANDOM_GENERATOR=y
CONFIG_X86_MMU=y
CONFIG_DEBUG_INFO=y
CONFIG_SCHED_SCALABLE=y
CONFIG_WAITQ_SCALABLE=y
CONFIG_X86_VERY_EARLY_CONSOLE=y

CONFIG_SRAM_OFFSET=0x100000
CONFIG_KERNEL_VM_SIZE=0x400000
CONFIG_KERNEL_VM_BASE=0x40000000
CONFIG_KERNEL_VM_OFFSET=0

CONFIG_LINKER_USE_BOOT_SECTION=y
CONFIG_LINKER_USE_PINNED_SECTION=y
```

## boards/x86/quark_d2000_crb/Kconfig.board
```kconfig
# SPDX-License-Identifier: Apache-2.0

config BOARD_QUARK_D2000_CRB
	bool "Intel Quark D2000 CRB"
	depends on SOC_SERIES_QUARK_D2000
```

## boards/x86/quark_d2000_crb/quark_d2000_crb_defconfig
```kconfig
CONFIG_X86=y
CONFIG_SOC_QUARK_D2000=y
CONFIG_SOC_SERIES_QUARK_D2000=y
CONFIG_BOARD_QUARK_D2000_CRB=y
CONFIG_CPU_MINUTEIA=y
CONFIG_SET_GDT=n
CONFIG_IDT_NUM_VECTORS=64
CONFIG_UART_QMSI=y
CONFIG_UART_CONSOLE=y
CONFIG_CONSOLE=y
CONFIG_SERIAL=y
CONFIG_SERIAL_HAS_DRIVER=y
CONFIG_PRINTK=y
CONFIG_ISR_STACK_SIZE=512
CONFIG_MAIN_STACK_SIZE=1024
CONFIG_PINMUX=y
```
