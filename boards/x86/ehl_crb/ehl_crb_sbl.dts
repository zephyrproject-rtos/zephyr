/*
 * Copyright (c) 2020 Intel Corporation
 *
 * SPDX-License-Identifier: Apache-2.0
 */

/dts-v1/;

#include <mem.h>

#define DT_DRAM_SIZE		DT_SIZE_M(2048)

#include <intel/elkhart_lake.dtsi>

&uart2 {
	status = "disabled";
};

&uart2_fixed {
	status = "okay";
};

/ {
	model = "ehl_crb";
	compatible = "intel,elkhart_lake_crb_sbl";

	chosen {
		zephyr,sram = &dram0;
		zephyr,console = &uart2_fixed;
		zephyr,shell-uart = &uart2_fixed;
	};
};
