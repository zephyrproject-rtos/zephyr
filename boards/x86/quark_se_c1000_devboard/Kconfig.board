## boards/x86/quark_se_c1000_devboard/Kconfig.board
```kconfig
config BOARD_QUARK_SE_C1000_DEVBOARD
	bool "Quark SE C1000 Devboard"
	depends on SOC_SERIES_QUARK_SE
	select HAS_DTS
	select HAS_DTS_I2C
```

## boards/x86/quark_se_c1000_devboard/Kconfig.defconfig
```kconfig
# SPDX-License-Identifier: Apache-2.0

if BOARD_QUARK_SE_C1000_DEVBOARD

config BOARD
	default "quark_se_c1000_devboard"


config UART_QMSI_0_HW_FC
	default y

if IEEE802154_CC2520

config SPI
	default y

config GPIO
	default y

config IEEE802154_CC2520_GPIO_SPI_CS
	default y

endif # IEEE802154_CC2520

if USB_DEVICE_STACK

config USB_VBUS_GPIO
	default y

config USB_VBUS_GPIO_DEV_NAME
	default "GPIO_0"

config USB_VBUS_GPIO_PIN_NUM
        default 28

endif # USB_DEVICE_STACK

endif # BOARD_QUARK_SE_C1000_DEVBOARD
```

## boards/x86/quark_se_c1000_devboard/quark_se_c1000_devboard_defconfig
```kconfig
# SPDX-License-Identifier: Apache-2.0

CONFIG_X86=y
CONFIG_SOC_QUARK_SE_C1000=y
CONFIG_BOARD_QUARK_SE_C1000_DEVBOARD=y
CONFIG_SOC_SERIES_QUARK_SE=y
CONFIG_SOC_FAMILY_QUARK=y
CONFIG_CPU_MINUTEIA=y
CONFIG_SET_GDT=n
CONFIG_CONSOLE=y
CONFIG_UART_QMSI=y
CONFIG_UART_CONSOLE=y
CONFIG_SERIAL=y
CONFIG_PRINTK=y
CONFIG_PINMUX=y
```

## boards/x86/rpl_crb/Kconfig.board
```kconfig
# Copyright (c) 2022 Intel Corporation
# SPDX-License-Identifier: Apache-2.0

config BOARD_RPL_CRB
	bool "Raptor Lake CRB"
	depends on SOC_RAPTOR_LAKE
	select X86_64
	select HAS_COVERAGE_SUPPORT
```

## boards/x86/rpl_crb/Kconfig.defconfig
```kconfig
# Copyright (c) 2022 Intel Corporation
# SPDX-License-Identifier: Apache-2.0

if BOARD_RPL_CRB

config BOARD
	default "rpl_crb"

config BUILD_OUTPUT_STRIPPED
	default y

config MP_MAX_NUM_CPUS
	default 2

config SYS_CLOCK_HW_CYCLES_PER_SEC
	default 1900000000 if APIC_TSC_DEADLINE_TIMER
	default 1900000000 if APIC_TIMER_TSC
	default 19200000

if APIC_TIMER
config APIC_TIMER_IRQ
	default 24
config APIC_TIMER_TSC_M
	default 3
config APIC_TIMER_TSC_N
	default 249
endif

endif # BOARD_RPL_CRB
```

## boards/x86/tinytile/Kconfig.board
```kconfig
# SPDX-License-Identifier: Apache-2.0

config BOARD_TINYTILE
	bool "TinyTILE"
	depends on SOC_SERIES_QUARK_SE
```

## boards/x86/tinytile/Kconfig.defconfig
```kconfig
# SPDX-License-Identifier: Apache-2.0

if BOARD_TINYTILE

config BOARD
	default "tinytile"

config TEXT_SECTION_OFFSET
	default 0x30

config SS_RESET_VECTOR
	default 0x40034000

if USB

config USB_DW
	default y

config USB_DEVICE_STACK
	default y

config USB_VBUS_GPIO
	default y

config USB_VBUS_GPIO_DEV_NAME
	default "GPIO_0"

config USB_VBUS_GPIO_PIN_NUM
        default 28

if USB_UART_CONSOLE

config UART_INTERRUPT_DRIVEN
	default y

config UART_LINE_CTRL
	default y

endif
endif
endif # BOARD_TINYTILE
```

## boards/x86/tinytile/tinytile_defconfig
```kconfig
CONFIG_X86=y
CONFIG_SOC_QUARK_SE_C1000=y
CONFIG_SOC_SERIES_QUARK_SE=y
CONFIG_BOARD_TINYTILE=y
CONFIG_CPU_MINUTEIA=y
CONFIG_CONSOLE=y
CONFIG_UART_CONSOLE=y
CONFIG_SERIAL=y
CONFIG_UART_QMSI=y
CONFIG_UART_QMSI_0_HW_FC=y
CONFIG_PRINTK=y
CONFIG_PINMUX=y
CONFIG_GPIO=y
CONFIG_USB=y
CONFIG_USB_UART_CONSOLE=y
```

## boards/x86/up_squared/Kconfig
```kconfig
# UP Squared board options

#
# Copyright (c) 2018 Intel Corporation
#
# SPDX-License-Identifier: Apache-2.0
#

if BOARD_UP_SQUARED

comment "UP Squared Board Options"

choice
prompt "UP Squared SoC variant"
default BOARD_UP_SQUARED_ATOM

config BOARD_UP_SQUARED_ATOM
	bool "Atom E3940"

config BOARD_UP_SQUARED_CELERON
	bool "Celeron N3350"

config BOARD_UP_SQUARED_PENTIUM
	bool "Pentium N4200"

endchoice

endif # BOARD_UP_SQUARED
```

## boards/x86/up_squared/Kconfig.board
```kconfig
# Copyright (c) 2018 Intel Corporation
# SPDX-License-Identifier: Apache-2.0

config BOARD_UP_SQUARED
	bool "UP Squared (x86_64)"
	depends on SOC_APOLLO_LAKE
	select X86_64

config BOARD_UP_SQUARED_32
	bool "UP Squared (x86)"
	depends on SOC_APOLLO_LAKE
```

## boards/x86/up_squared/Kconfig.defconfig
```kconfig
# SPDX-License-Identifier: Apache-2.0

if BOARD_UP_SQUARED

config BOARD
	default "up_squared"

config MP_MAX_NUM_CPUS
	default 2 if BOARD_UP_SQUARED

config BUILD_OUTPUT_STRIPPED
	default y

config APIC_TSC_DEADLINE_TIMER
	default y

# TSC on this board is 1.5936 GHz, HPET and APIC are 19.2 MHz
config SYS_CLOCK_HW_CYCLES_PER_SEC
	default 1593600000 if APIC_TSC_DEADLINE_TIMER
	default 1593600000 if APIC_TIMER_TSC
	default 19200000

if APIC_TIMER
config APIC_TIMER_IRQ
	default 24
config APIC_TIMER_TSC_M
	default 3
config APIC_TIMER_TSC_N
	default 249
endif

endif # BOARD_UP_SQUARED
```

## boards/x86/up_squared/Kconfig.up_squared
```kconfig
# Copyright (c) 2022 Zephyr Project members and individual contributors
# SPDX-License-Identifier: Apache-2.0

config BOARD_UP_SQUARED
	bool
	default y
	select SOC_APOLLO_LAKE
	select X86_64
```

## boards/x86/up_squared/up_squared_32_defconfig
```kconfig
# SPDX-License-Identifier: Apache-2.0

CONFIG_SOC_APOLLO_LAKE=y
CONFIG_BOARD_UP_SQUARED_32=y
CONFIG_PIC_DISABLE=y
CONFIG_LOAPIC=y
CONFIG_CONSOLE=y
CONFIG_SERIAL=y
CONFIG_UART_NS16550=y
CONFIG_UART_CONSOLE=y
CONFIG_I2C=y
CONFIG_X2APIC=y
```

## boards/x86/up_squared/up_squared_defconfig
```kconfig
# SPDX-License-Identifier: Apache-2.0

CONFIG_SOC_APOLLO_LAKE=y
CONFIG_BOARD_UP_SQUARED=y
CONFIG_PIC_DISABLE=y
CONFIG_LOAPIC=y
CONFIG_CONSOLE=y
CONFIG_SERIAL=y
CONFIG_UART_NS16550=y
CONFIG_UART_CONSOLE=y
CONFIG_X2APIC=y
CONFIG_SMP=y
CONFIG_MP_NUM_CPUS=2
```

## boards/x86/x86_jailhouse/Kconfig.board
```kconfig
config BOARD_X86_JAILHOUSE
	bool "QEMU x86 (root cell)"
	depends on SOC_IA32
	select QEMU_TARGET
	select HAS_DTS
	select CPU_HAS_FPU if !X86_IAMCU
```

## boards/x86/x86_jailhouse/Kconfig.defconfig
```kconfig
# SPDX-License-Identifier: Apache-2.0

if BOARD_X86_JAILHOUSE

config BOARD
	default "x86_jailhouse"

config JAILHOUSE
	bool "Zephyr port to boot as a (x86) Jailhouse inmate cell payload"
	default y

endif # BOARD_X86_JAILHOUSE
```

## boards/x86/x86_jailhouse/x86_jailhouse_defconfig
```kconfig
CONFIG_X86=y
CONFIG_SOC_IA32=y
CONFIG_BOARD_X86_JAILHOUSE=y
CONFIG_CPU_MINUTEIA=y
CONFIG_IA32_LEGACY_IO_PORTS=y
CONFIG_JAILHOUSE=y
CONFIG_JAILHOUSE_X2APIC=y
CONFIG_KERNEL_ENTRY="__jh_entry"
CONFIG_IOAPIC_MASK_RTE=n
CONFIG_PIC_DISABLE=n
CONFIG_LOAPIC=y
CONFIG_LOAPIC_TIMER=y
CONFIG_CONSOLE=y
CONFIG_SERIAL=y
CONFIG_UART_NS16550=y
CONFIG_UART_CONSOLE=y
CONFIG_TEST_RANDOM_GENERATOR=y
CONFIG_XIP=n
CONFIG_X86_MMU=y
CONFIG_HW_STACK_PROTECTION=y
CONFIG_USERSPACE=y
CONFIG_X86_PAE_MODE=y
```

## boards/x86_64/qemu_x86_64/Kconfig.board
```kconfig
# SPDX-License-Identifier: Apache-2.0

config BOARD_QEMU_X86_64
	bool "QEMU x86_64"
	depends on SOC_X86_64
	select QEMU_TARGET
```

## boards/x86_64/qemu_x86_64/Kconfig.defconfig
```kconfig
if BOARD_QEMU_X86_64

config BUILD_OUTPUT_BIN
	default n

config BOARD
	default "qemu_x86_64"

# In theory we could ask qemu for any configuration, but this seems
# like a good default.
config MP_NUM_CPUS
	default 2

endif # BOARD_QEMU_X86_64
```

## boards/x86_64/qemu_x86_64/qemu_x86_64_defconfig
```kconfig
# SPDX-License-Identifier: Apache-2.0

CONFIG_X86_64=y
CONFIG_SOC_X86_64=y
CONFIG_BOARD_QEMU_X86_64=y
CONFIG_CONSOLE=y
CONFIG_SERIAL=y
CONFIG_TEST_RANDOM_GENERATOR=y
CONFIG_XIP=y
CONFIG_HPET_TIMER=y
CONFIG_SYS_CLOCK_HW_CYCLES_PER_SEC=1000000000
CONFIG_MAIN_STACK_SIZE=1024
CONFIG_IDLE_STACK_SIZE=1024
CONFIG_TEST_EXTRA_STACKSIZE=2048
```

## boards/xen/xenvm/Kconfig.defconfig
```kconfig
# Copyright (c) 2020 EPAM Systems
# SPDX-License-Identifier: Apache-2.0

if BOARD_XENVM

config BUILD_OUTPUT_BIN
	default y

config HEAP_MEM_POOL_SIZE
	default 16384

endif # BOARD_XENVM
```

## boards/xen/xenvm/xenvm_xenvm_defconfig
```kconfig
# Enable UART driver
CONFIG_SERIAL=y

CONFIG_MAX_XLAT_TABLES=24

# Enable console
CONFIG_CONSOLE=y
CONFIG_UART_CONSOLE=y

# Enable logging subsys
CONFIG_LOG=y
CONFIG_LOG_MODE_MINIMAL=n
CONFIG_TIMER_READS_ITS_FREQUENCY_AT_RUNTIME=y
```

## boards/xhsc/hc32f4a0_evb/Kconfig.hc32f4a0_evb
```kconfig
# Copyright (C) 2024-2025, Xiaohua Semiconductor Co., Ltd.
# SPDX-License-Identifier: Apache-2.0

config BOARD_HC32F4A0_EVB
	select SOC_HC32F4A0
```

## boards/xhsc/hc32f4a0_evb/hc32f4a0_evb_defconfig
```kconfig
# Copyright (C) 2024-2025, Xiaohua Semiconductor Co., Ltd.
# SPDX-License-Identifier: Apache-2.0

# Enable MPU
CONFIG_ARM_MPU=y

# Enable FPU
CONFIG_FPU=y

# GPIO Controller
CONFIG_GPIO=y

CONFIG_CLOCK_CONTROL=y

CONFIG_CONSOLE=y
CONFIG_UART_CONSOLE=y
CONFIG_SERIAL=y
```
