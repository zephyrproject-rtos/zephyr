/*
 * Copyright (c) 2023 Intel Corporation
 *
 * SPDX-License-Identifier: Apache-2.0
 */

#include "intel_adl.dts"

/ {
	model = "Intel Alder Lake RVP";
	compatible = "intel,alder-lake-rvp";

	chosen {
		zephyr,console = &uart_legacy_0;
		zephyr,shell-uart = &uart_legacy_0;
	};
};

&uart_legacy_0 {
	status = "okay";
};
