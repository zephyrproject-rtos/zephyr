/*
 * SPDX-FileCopyrightText: Copyright The Zephyr Project Contributors
 * SPDX-License-Identifier: Apache-2.0
 */

/dts-v1/;
#include "py32f003_minimal.dtsi"

/ {
	model = "PY32F003L16S6TU Minimal Circuit";
};

&gpioa {
	/* PA10 shares physical pin 6 with PA13/SWDIO; preserve the debug pad. */
	gpio-reserved-ranges = <3 10>, <15 1>;
};

&gpiob {
	status = "disabled";
};

&gpiof {
	status = "disabled";
};
