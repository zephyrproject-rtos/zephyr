/*
 * Copyright (c) 2026 Icy Electronics
 *
 * SPDX-License-Identifier: Apache-2.0
 */

/dts-v1/;

#define USE_NON_SECURE_ADDRESS_MAP 1

#include <arm/nordic/nrf54l15_cpuapp_ns.dtsi>
#include "nrf54l15_discovery_nrf54l15_cpuapp_common.dtsi"

/ {
	model = "Icy Electrnics nRF54L15 Discovery nRF54L15 Application MCU";
	compatible = "ie,nrf54l15_discovery_nrf54l15-cpuapp";

	chosen {
		zephyr,code-partition = &slot0_ns_partition;
		zephyr,sram = &sram0_ns;
		zephyr,entropy = &psa_rng;
	};

	/delete-node/ rng;

	psa_rng: psa-rng {
		status = "okay";
	};
};

/* Include default memory partition configuration file */
#include <vendor/nordic/nrf54l15_cpuapp_ns_partition.dtsi>
