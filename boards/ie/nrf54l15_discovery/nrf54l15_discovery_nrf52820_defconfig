## boards/ie/nrf54l15_discovery/nrf54l15_discovery_nrf52820_defconfig
```kconfig
# Copyright (c) 2026 Icy Electronics
# SPDX-License-Identifier: Apache-2.0

# Enable MPU
CONFIG_ARM_MPU=y

# enable GPIO
CONFIG_GPIO=y

# enable I2C
CONFIG_I2C=y

# enable PWM
CONFIG_PWM=y

# Support UF2 Bootloader
CONFIG_USE_DT_CODE_PARTITION=y
CONFIG_BUILD_OUTPUT_UF2=y
CONFIG_BUILD_OUTPUT_UF2_FAMILY_ID="0x820D9A5F"
```

## boards/ie/nrf54l15_discovery/nrf54l15_discovery_nrf54l15_cpuapp_defconfig
```kconfig
# Copyright (c) 2026 Icy Electronics
# SPDX-License-Identifier: Apache-2.0

# Enable UART driver
CONFIG_SERIAL=y

# Enable console
CONFIG_CONSOLE=y
CONFIG_UART_CONSOLE=y

# Enable GPIO
CONFIG_GPIO=y

# Enable MPU
CONFIG_ARM_MPU=y

# Enable hardware stack protection
CONFIG_HW_STACK_PROTECTION=y

# Enable voltage regulators
CONFIG_REGULATOR=y
CONFIG_REGULATOR_NPM13XX=y
```

## boards/infineon/cy8ckit_041s_max/board.yml
```yaml
# SPDX-FileCopyrightText: <text>Copyright (c) 2026 Infineon Technologies AG,
# or an affiliate of Infineon Technologies AG. All rights reserved.</text>
#
# SPDX-License-Identifier: Apache-2.0

board:
  name: cy8ckit_041s_max
  full_name: PSOC™ 4100S Max pioneer kit
  vendor: infineon
  socs:
  - name: cy8c4149azi_s598
```

## boards/infineon/cy8ckit_062s2_ai/Kconfig.cy8ckit_062s2_ai
```kconfig
# Copyright (c) 2024 Arrow Electronics.
# SPDX-License-Identifier: Apache-2.0

config BOARD_CY8CKIT_062S2_AI
	select SOC_CY8C624ABZI_S2D44 if BOARD_CY8CKIT_062S2_AI_CY8C624ABZI_S2D44_M4
	select SOC_CY8C624ABZI_S2D44_M4 if BOARD_CY8CKIT_062S2_AI_CY8C624ABZI_S2D44_M4_DUAL
	select SOC_CY8C624ABZI_S2D44_M0 if BOARD_CY8CKIT_062S2_AI_CY8C624ABZI_S2D44_M0
```

## boards/infineon/cy8ckit_062s2_ai/Kconfig.defconfig
```kconfig
# CY8CKIT-062S2-AI PSOC™ 6 Artificial Intelligence Evaluation Kit configuration

# Copyright (c) 2021 Cypress Semiconductor Corporation.
# SPDX-License-Identifier: Apache-2.0

if BOARD_CY8CKIT_062S2_AI

if WIFI || BT

# Select AIROC part and module
choice AIROC_PART
	default CYW43439
endchoice

choice CYW43439_MODULE
	default CYW43439_MURATA_1YN
endchoice

endif # WIFI || BT

if WIFI

config WIFI_AIROC
	default y

# Enable L2 Ethernet
config NET_L2_ETHERNET
	default y

endif # WIFI

if BT

# Select HCI components
config UART
	bool
	default y

endif # BT

# Heap Pool Size
config HEAP_MEM_POOL_ADD_SIZE_BOARD
	int
	default 15000 if WIFI
	default 4096

endif # BOARD_CY8CKIT_062S2_AI
```

## boards/infineon/cy8ckit_062s2_ai/board.yml
```yaml
# Copyright (c) 2024 Arrow Electronics.
# SPDX-License-Identifier: Apache-2.0

board:
  name: cy8ckit_062s2_ai
  full_name: PSOC 6 AI Evaluation Kit
  vendor: infineon
  socs:
    - name: cy8c624abzi_s2d44
```

## boards/infineon/cy8ckit_062s2_ai/cy8ckit_062s2_ai_cy8c624abzi_s2d44_m0_defconfig
```kconfig
# M0 core configuration for dual-core CY8CKIT board

# Enable MPU
CONFIG_ARM_MPU=y

# Enable HW stack protection
CONFIG_HW_STACK_PROTECTION=y

# Enable console
CONFIG_CONSOLE=y
CONFIG_UART_CONSOLE=y

# Enable UART driver
CONFIG_SERIAL=y

# Enable GPIO driver
CONFIG_GPIO=y

# Enable clock controller
CONFIG_CLOCK_CONTROL=y

# General configuration
CONFIG_BUILD_OUTPUT_HEX=y
```

## boards/infineon/cy8ckit_062s2_ai/cy8ckit_062s2_ai_cy8c624abzi_s2d44_m4_defconfig
```kconfig
# Copyright (c) 2024 Arrow Electronics.
# SPDX-License-Identifier: Apache-2.0

# Enable MPU
CONFIG_ARM_MPU=y

# Enable HW stack protection
CONFIG_HW_STACK_PROTECTION=y

# Enable console
CONFIG_CONSOLE=y
CONFIG_UART_CONSOLE=y

# Enable UART driver
CONFIG_SERIAL=y

# Enable GPIO driver
CONFIG_GPIO=y

# Enable clock controller
CONFIG_CLOCK_CONTROL=y

# Add catcm0p sleep images for CM0 Devices
CONFIG_SOC_PSOC6_CM0P_IMAGE_SLEEP=y
```

## boards/infineon/cy8ckit_062s2_ai_dual/Kconfig.cy8ckit_062s2_ai_dual
```kconfig
# Copyright (c) 2025 Cypress Semiconductor Corporation (an Infineon company) or
# an affiliate of Cypress Semiconductor Corporation
# SPDX-License-Identifier: Apache-2.0

config BOARD_CY8CKIT_062S2_AI_DUAL
	select SOC_CY8C624ABZI_S2D44_M4 if BOARD_CY8CKIT_062S2_AI_DUAL_CY8C624ABZI_S2D44_M4
	select SOC_CY8C624ABZI_S2D44_M0 if BOARD_CY8CKIT_062S2_AI_DUAL_CY8C624ABZI_S2D44_M0
```

## boards/infineon/cy8ckit_062s2_ai_dual/board.yml
```yaml
# Copyright (c) 2025 Cypress Semiconductor Corporation (an Infineon company) or
# an affiliate of Cypress Semiconductor Corporation
# SPDX-License-Identifier: Apache-2.0

board:
  name: cy8ckit_062s2_ai_dual
  full_name: PSOC 6 AI Evaluation Kit (Dual Core)
  vendor: infineon
  socs:
    - name: cy8c624abzi_s2d44
```

## boards/infineon/cy8ckit_062s4/Kconfig.cy8ckit_062s4
```kconfig
# Copyright (c) 2023 David Ullmann
# SPDX-License-Identifier: Apache-2.0

config BOARD_CY8CKIT_062S4
	select SOC_CY8C6244LQI_S4D92
```

## boards/infineon/cy8ckit_062s4/board.yml
```yaml
board:
  name: cy8ckit_062s4
  full_name: PSOC 62S4 Pioneer Kit
  vendor: infineon
  socs:
  - name: cy8c6244lqi_s4d92
```

## boards/infineon/cy8ckit_062s4/cy8ckit_062s4_defconfig
```kconfig
# Copyright (c) 2023 David Ullmann
# SPDX-License-Identifier: Apache-2.0

CONFIG_CONSOLE=y
CONFIG_UART_CONSOLE=y
CONFIG_SERIAL=y

CONFIG_CORTEX_M_SYSTICK=y
CONFIG_XIP=y

CONFIG_SOC_PSOC6_CM0P_IMAGE_SLEEP=y
```

## boards/infineon/cy8cproto_041tp/board.yml
```yaml
# SPDX-FileCopyrightText: <text>Copyright (c) 2026 Infineon Technologies AG,
# or an affiliate of Infineon Technologies AG. All rights reserved.</text>
#
# SPDX-License-Identifier: Apache-2.0

board:
  name: cy8cproto_041tp
  full_name: CY8CPROTO-041TP
  vendor: infineon
  socs:
  - name: cy8c4147azq_t495
```

## boards/infineon/cy8cproto_041tp/cy8cproto_041tp_defconfig
```kconfig
# SPDX-FileCopyrightText: <text>Copyright (c) 2026 Infineon Technologies AG,
# or an affiliate of Infineon Technologies AG. All rights reserved.</text>
#
# SPDX-License-Identifier: Apache-2.0

# Console
CONFIG_CONSOLE=y
CONFIG_UART_CONSOLE=y

# UART driver
CONFIG_SERIAL=y

#GPIO driver
CONFIG_GPIO=y

# Clock controller
CONFIG_CLOCK_CONTROL=y
```

## boards/infineon/cy8cproto_062_4343w/Kconfig.cy8cproto_062_4343w
```kconfig
# CY8CPROTO-062-4343W PSOC™ 6 Wi-Fi BT Prototyping Kit

# Copyright (c) 2021 Cypress Semiconductor Corporation.
# SPDX-License-Identifier: Apache-2.0

config BOARD_CY8CPROTO_062_4343W
	select SOC_CY8C624ABZI_S2D44
```

## boards/infineon/cy8cproto_062_4343w/Kconfig.defconfig
```kconfig
# CY8CPROTO-062-4343W PSOC™ 6 Wi-Fi BT Prototyping Kit configuration

# Copyright (c) 2021 Cypress Semiconductor Corporation.
# SPDX-License-Identifier: Apache-2.0

if BOARD_CY8CPROTO_062_4343W

if WIFI || BT

# Select AIROC part and module
choice AIROC_PART
	default CYW4343W
endchoice

choice CYW4343W_MODULE
	default CYW4343W_MURATA_1DX
endchoice

endif # WIFI || BT

if WIFI

config WIFI_AIROC
	default y

# Enable L2 Ethernet
config NET_L2_ETHERNET
	default y

endif # WIFI

if BT

# Select HCI components
config UART
	bool
	default y

endif # BT

# Heap Pool Size
config HEAP_MEM_POOL_ADD_SIZE_BOARD
	int
	default 15000 if WIFI
	default 4096

endif   # BOARD_CY8CPROTO_062_4343W
```

## boards/infineon/cy8cproto_062_4343w/board.yml
```yaml
board:
  name: cy8cproto_062_4343w
  full_name: CY8CPROTO-062-4343W
  vendor: infineon
  socs:
  - name: cy8c624abzi_s2d44
```

## boards/infineon/cy8cproto_062s3_4343w/Kconfig
```kconfig
# Copyright (c) 2025 Hari Udayakumar <hariudkmr@gmail.com>
# SPDX-License-Identifier: Apache-2.0

config HEAP_MEM_POOL_ADD_SIZE_BOARD
	int
	default 15000 if WIFI
	default 4096
```

## boards/infineon/cy8cproto_062s3_4343w/Kconfig.cy8cproto_062s3_4343w
```kconfig
# Copyright (c) 2025 Hari Udayakumar <hariudkmr@gmail.com>
# SPDX-License-Identifier: Apache-2.0

config BOARD_CY8CPROTO_062S3_4343W
	select SOC_CY8C6245LQI_S3D72
```

## boards/infineon/cy8cproto_062s3_4343w/board.yml
```yaml
board:
  name: cy8cproto_062s3_4343w
  full_name: CY8CPROTO-062S3-4343W
  vendor: infineon
  socs:
  - name: cy8c6245lqi_s3d72
```

## boards/infineon/cy8cproto_063_ble/Kconfig.cy8cproto_063_ble
```kconfig
# ==================================================================================================
# Copyright (c) 2025 Cypress Semiconductor Corporation (an Infineon company) or
# an affiliate of Cypress Semiconductor Corporation
#
# SPDX-License-Identifier: Apache-2.0
# ==================================================================================================

# CY8CPROTO-063-BLE PSOC™ 6 BLE Prototyping Kit

config BOARD_CY8CPROTO_063_BLE
	select SOC_CYBLE_416045_02
```

## boards/infineon/cy8cproto_063_ble/board.yml
```yaml
board:
  name: cy8cproto_063_ble
  full_name: CY8CPROTO-063-BLE
  vendor: infineon
  socs:
  - name: cyble_416045_02
```

## boards/infineon/cy8cproto_063_ble/cy8cproto_063_ble_defconfig
```kconfig
#**************************************************************************
# Copyright (c) 2023 Cypress Semiconductor Corporation (an Infineon company) or
# an affiliate of Cypress Semiconductor Corporation.
# SPDX-Licence-Identifier: Apache-2.0
#***************************************************************************

# General configuration
CONFIG_CORTEX_M_SYSTICK=y
CONFIG_BUILD_OUTPUT_HEX=y

CONFIG_ARM_MPU=y
CONFIG_HW_STACK_PROTECTION=y

# Enable console
CONFIG_CONSOLE=y
CONFIG_UART_CONSOLE=y

# Enable UART driver
CONFIG_SERIAL=y

# Enable clock controller
CONFIG_CLOCK_CONTROL=y

# Main Stack Size
CONFIG_MAIN_STACK_SIZE=2048

# Add catcm0p sleep images for CM0 Devices
CONFIG_SOC_PSOC6_CM0P_IMAGE_SLEEP=y
```
