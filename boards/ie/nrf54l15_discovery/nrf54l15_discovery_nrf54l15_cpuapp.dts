/*
 * Copyright (c) 2026 Icy Electronics
 * Copyright (c) 2024 Nordic Semiconductor ASA
 *
 * SPDX-License-Identifier: Apache-2.0
 */

/dts-v1/;

#include <nordic/nrf54l15_cpuapp.dtsi>
#include "nrf54l15_discovery_nrf54l15_cpuapp_common.dtsi"

/ {
	model = "Icy Electronics nRF54L15 Discovery nRF54L15 Application MCU";
	compatible = "ie,nrf54l15_discovery_nrf54l15-cpuapp";

	chosen {
		zephyr,code-partition = &slot0_partition;
		zephyr,sram = &cpuapp_sram;
	};
};

/* Include default memory partition configuration file */
#include <vendor/nordic/nrf54l15_cpuapp_partition.dtsi>
