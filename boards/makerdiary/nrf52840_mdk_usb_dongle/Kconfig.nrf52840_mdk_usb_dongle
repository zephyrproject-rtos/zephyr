## boards/makerdiary/nrf52840_mdk_usb_dongle/Kconfig.nrf52840_mdk_usb_dongle
```kconfig
# nRF52840 MDK USB Dongle board configuration

# Copyright (c) 2022 Nikola Trifunovic
# Copyright (c) 2018 Nordic Semiconductor ASA
# SPDX-License-Identifier: Apache-2.0

config BOARD_NRF52840_MDK_USB_DONGLE
	select SOC_NRF52840_QIAA
```

## boards/makerdiary/nrf52840_mdk_usb_dongle/board.yml
```yaml
board:
  name: nrf52840_mdk_usb_dongle
  full_name: nRF52840 MDK USB Dongle
  vendor: makerdiary
  socs:
  - name: nrf52840
```

## boards/makerdiary/nrf52840_mdk_usb_dongle/nrf52840_mdk_usb_dongle_defconfig
```kconfig
# SPDX-License-Identifier: Apache-2.0

# Enable MPU
CONFIG_ARM_MPU=y

# Console
CONFIG_CONSOLE=y
CONFIG_SERIAL=y
CONFIG_UART_CONSOLE=y

# Enable hardware stack protection
CONFIG_HW_STACK_PROTECTION=y

# enable GPIO
CONFIG_GPIO=y
```

## boards/makerfabs/matouch_mtro128g/Kconfig
```kconfig
# Copyright (c) 2026 Sahaj Sarup
# SPDX-License-Identifier: Apache-2.0

config HEAP_MEM_POOL_ADD_SIZE_BOARD
	int
	default 4096 if BOARD_MATOUCH_MTRO128G_ESP32S3_PROCPU
	default 256 if BOARD_MATOUCH_MTRO128G_ESP32S3_APPCPU
```

## boards/makerfabs/matouch_mtro128g/Kconfig.defconfig
```kconfig
# Copyright (c) 2026 Sahaj Sarup
# SPDX-License-Identifier: Apache-2.0

if BOARD_MATOUCH_MTRO128G

configdefault KERNEL_MEM_POOL
	default y

if DISPLAY

if LVGL

configdefault LV_COLOR_16_SWAP
	default y

configdefault LV_Z_VDB_SIZE
	default 20

endif # LVGL

config REGULATOR
	default y

endif # DISPLAY

if DISK_ACCESS

config SPI
	default y

config DISK_DRIVER_SDMMC
	default y

endif # CONFIG_DISK_ACCESS

endif # BOARD_MATOUCH_MTRO128G
```

## boards/makerfabs/matouch_mtro128g/Kconfig.matouch_mtro128g
```kconfig
# Copyright (c) 2026 Sahaj Sarup
# SPDX-License-Identifier: Apache-2.0

config BOARD_MATOUCH_MTRO128G
	select SOC_ESP32S3_WROOM_N8
	select SOC_ESP32S3_PROCPU if BOARD_MATOUCH_MTRO128G_ESP32S3_PROCPU
	select SOC_ESP32S3_APPCPU if BOARD_MATOUCH_MTRO128G_ESP32S3_APPCPU
```

## boards/makerfabs/matouch_mtro128g/board.yml
```yaml
board:
  name: matouch_mtro128g
  full_name: Matouch MTRO128G
  vendor: makerfabs
  socs:
  - name: esp32s3
```

## boards/mediatek/mt8186/Kconfig.mt8186
```kconfig
# Copyright 2024 The ChromiumOS Authors
# SPDX-License-Identifier: Apache-2.0

config BOARD_MT8186
	select SOC_MT8186
```

## boards/mediatek/mt8186/board.yml
```yaml
boards:
  - name: mt8186
    full_name: MT8186 ADSP
    vendor: mediatek
    socs:
      - name: mt8186
```

## boards/mediatek/mt8186_adsp/Kconfig.mt8186_adsp
```kconfig
# Copyright 2024 The ChromiumOS Authors
# SPDX-License-Identifier: Apache-2.0

config BOARD_MT8186_ADSP
	bool "Mediatek MT8186 Audio DSP"
	select SOC_MT8186_ADSP
```

## boards/mediatek/mt8186_adsp/board.yml
```yaml
boards:
  - name: mt8186_adsp
    vendor: mediatek
    socs:
      - name: mt8186_adsp
```

## boards/mediatek/mt8188/Kconfig.mt8188
```kconfig
# Copyright 2024 The ChromiumOS Authors
# SPDX-License-Identifier: Apache-2.0

config BOARD_MT8188
	select SOC_MT8188
```

## boards/mediatek/mt8188/board.yml
```yaml
boards:
  - name: mt8188
    full_name: MT8188 ADSP
    vendor: mediatek
    socs:
      - name: mt8188
```

## boards/mediatek/mt8188_adsp/Kconfig.mt8188_adsp
```kconfig
# Copyright 2024 The ChromiumOS Authors
# SPDX-License-Identifier: Apache-2.0

config BOARD_MT8188_ADSP
	bool "Mediatek MT8188 Audio DSP"
	select SOC_MT8188_ADSP
```

## boards/mediatek/mt8188_adsp/board.yml
```yaml
boards:
  - name: mt8188_adsp
    vendor: mediatek
    socs:
      - name: mt8188_adsp
```

## boards/mediatek/mt8195/Kconfig.mt8195
```kconfig
# Copyright 2023 The ChromiumOS Authors
# SPDX-License-Identifier: Apache-2.0

config BOARD_MT8195
	select SOC_MT8195
```

## boards/mediatek/mt8195/board.yml
```yaml
boards:
  - name: mt8195
    full_name: MT8195 ADSP
    vendor: mediatek
    socs:
      - name: mt8195
```

## boards/mediatek/mt8195_adsp/Kconfig.mt8195_adsp
```kconfig
# Copyright 2023 The ChromiumOS Authors
# SPDX-License-Identifier: Apache-2.0

config BOARD_MT8195_ADSP
	select SOC_MT8195_ADSP
	help
	  Board with Mediatek MT8195 Audio DSP
```

## boards/mediatek/mt8195_adsp/board.yml
```yaml
boards:
  - name: mt8195_adsp
    full_name: MT8195 ADSP
    vendor: mediatek
    socs:
      - name: mt8195_adsp
```

## boards/mediatek/mt8195_adsp/mt8195_adsp_defconfig
```kconfig
# Copyright 2023 The ChromiumOS Authors
# SPDX-License-Identifier: Apache-2.0

CONFIG_SYS_CLOCK_HW_CYCLES_PER_SEC=13000000
```

## boards/mediatek/mt8196/Kconfig.mt8196
```kconfig
# Copyright 2024 The ChromiumOS Authors
# SPDX-License-Identifier: Apache-2.0

config BOARD_MT8196
	select SOC_MT8196
```

## boards/mediatek/mt8196/board.yml
```yaml
boards:
  - name: mt8196
    full_name: MT8196 ADSP
    vendor: mediatek
    socs:
      - name: mt8196
```

## boards/mediatek/mt8365/Kconfig.mt8365
```kconfig
# Copyright 2025 Mediatek
# SPDX-License-Identifier: Apache-2.0

config BOARD_MT8365
	select SOC_MT8365
```

## boards/mediatek/mt8365/board.yml
```yaml
boards:
  - name: mt8365
    full_name: MT8365 ADSP
    vendor: mediatek
    socs:
      - name: mt8365
```

## boards/microchip/curiosity_nano_mc/Kconfig.curiosity_nano_mc
```kconfig
# Copyright (c) 2025 GP Orcullo
# SPDX-License-Identifier: Apache-2.0

config BOARD_CURIOSITY_NANO_MC
	select SOC_PIC32CM1216MC00032
```
