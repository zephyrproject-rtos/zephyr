/*
 * Copyright (c) 2024 Texas Instruments Incorporated
 * Copyright (c) 2024 BayLibre, SAS
 *
 * SPDX-License-Identifier: Apache-2.0
 */

/ {
	boosterpack_header: connector {
		compatible = "ti,boosterpack-header";
		#gpio-cells = <2>;
		gpio-map = <3 0 &gpio0 22 0>,
			   <4 0 &gpio0 20 0>,
			   <7 0 &gpio0 18 0>,
			   <8 0 &gpio0 3 0>,
			   <9 0 &gpio0 24 0>,
			   <10 0 &gpio0 0 0>,

			   <12 0 &gpio0 9 0>,
			   <13 0 &gpio0 10 0>,
			   <14 0 &gpio0 12 0>,
			   <15 0 &gpio0 13 0>,
			   <17 0 &gpio0 19 0>,
			   <18 0 &gpio0 11 0>,

			   <23 0 &gpio0 23 0>,
			   <24 0 &gpio0 25 0>,
			   <25 0 &gpio0 1 0>,
			   <26 0 &gpio0 2 0>,
			   <27 0 &gpio0 5 0>,
			   <28 0 &gpio0 7 0>,

			   <36 0 &gpio0 8 0>,
			   <37 0 &gpio0 21 0>,
			   <38 0 &gpio0 6 0>,
			   <39 0 &gpio0 14 0>,
			   <40 0 &gpio0 15 0>;
	};
};
