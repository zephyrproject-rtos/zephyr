/*
 * Copyright (c) 2025 Texas Instruments Incorporated
 *
 * SPDX-License-Identifier: Apache-2.0
 */

#include <ti/am26x/am261x_r5f0_0.dtsi>

/ {
	model = "TI AM261X LP Development Board R5F0_0";
	compatible = "ti,am261x-lp";

	chosen {
		zephyr,sram = &sram0;
		zephyr,code-partition = &sram0;
	};
};
