/*
 * Copyright (c) 2025 Texas Instruments Incorporated
 *
 * SPDX-License-Identifier: Apache-2.0
 */

#include <zephyr/dt-bindings/pinctrl/ti-k3-pinctrl.h>

&mcu_pinctrl {
	status = "okay";

	mcu_uart0_rx: mcu_uart0_rx_default {
		pinmux = <K3_PINMUX(0x028, PIN_INPUT, MUX_MODE_0)>;
	};

	mcu_uart0_tx: mcu_uart0_tx_default {
		pinmux = <K3_PINMUX(0x02C, PIN_OUTPUT, MUX_MODE_0)>;
	};

	mcu_gpio0_led: mcu_gpio0_led_default {
		pinmux = <K3_PINMUX(0x014, PIN_INPUT, MUX_MODE_7)>;
	};
};
