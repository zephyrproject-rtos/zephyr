/*
 * SPDX-FileCopyrightText: Copyright 2026 Texas Instruments Incorporated
 * SPDX-License-Identifier: Apache-2.0
 */

#include <zephyr/dt-bindings/pinctrl/mspm0-pinctrl.h>

&pinctrl {
	analog_pa23: analog_pa23 {
		pinmux = <MSP_PINMUX(53, MSPM0_PIN_FUNCTION_ANALOG)>;
	};

	status = "okay";
};
