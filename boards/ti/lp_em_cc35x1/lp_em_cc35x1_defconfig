## boards/ti/lp_em_cc35x1/lp_em_cc35x1_defconfig
```kconfig
#
# Copyright (c) 2025 Conclusive Engineering Sp. z o.o.
#
# SPDX-License-Identifier: Apache-2.0
#

CONFIG_SERIAL=y

CONFIG_CONSOLE=y
CONFIG_UART_CONSOLE=y
CONFIG_SHELL=y
CONFIG_UART_INTERRUPT_DRIVEN=y
CONFIG_SHELL_BACKEND_SERIAL_INTERRUPT_DRIVEN=y
CONFIG_SHELL_BACKEND_SERIAL_API_INTERRUPT_DRIVEN=y

CONFIG_FLASH=y
CONFIG_SOC_FLASH_CC35XX=y
CONFIG_FLASH_SHELL=y
```

## boards/ti/lp_mspm33c321a/lp_mspm33c321a_defconfig
```kconfig
# SPDX-FileCopyrightText: Copyright (c) 2026 Texas Instruments Incorporated
# SPDX-License-Identifier: Apache-2.0

CONFIG_CLOCK_CONTROL=y

CONFIG_SERIAL=y

CONFIG_CONSOLE=y
CONFIG_UART_CONSOLE=y
```

## boards/ti/lpf3_common/Kconfig
```kconfig
# Copyright (c) 2024 Texas Instruments Incorporated
#
# SPDX-License-Identifier: Apache-2.0

config TI_MCUMGR_BT_OTA_DFU
	bool "MCUMgr OTA DFU over Bluetooth"
	select NET_BUF
	select ZCBOR
	select ZEPHYR_ZCBOR_MODULE
	select CRC
	select MCUMGR
	select MCUMGR_TRANSPORT_BT
	select MCUMGR_TRANSPORT_BT_REASSEMBLY
	select IMG_MANAGER
	select MCUMGR_GRP_IMG
	select FLASH
	select FLASH_MAP
	select STREAM_FLASH
	imply MCUMGR_GRP_OS
	imply MCUMGR_GRP_OS_MCUMGR_PARAMS
	imply MCUMGR_GRP_OS_BOOTLOADER_INFO
	depends on BT
	depends on BT_SMP
	depends on BT_PERIPHERAL
	depends on BOOTLOADER_MCUBOOT
	default n

config BT_LL_HEAP_SIZE
	hex "TI BLE LL Heap Size"
	depends on BT
	default 0x4000
```

## boards/ti/lpf3_common/Kconfig.defconfig
```kconfig
# Copyright (c) 2024 Texas Instruments Incorporated
#
# SPDX-License-Identifier: Apache-2.0

if TI_MCUMGR_BT_OTA_DFU
	config MCUMGR_TRANSPORT_NETBUF_SIZE
		default 550
	config BT_L2CAP_TX_MTU
		default 65
endif # TI_MCUMGR_BT_OTA_DFU

if BT
	config ZEPHYR
		bool
		default y

	config CRYPTO
		default y

	config ENTROPY_GENERATOR
		default y

	config BT_BUF_EVT_RX_SIZE
		default 255

	config BT_BUF_ACL_RX_SIZE
		default 255

	config BT_BUF_ACL_TX_SIZE
		default 255

	config BT_BUF_CMD_TX_SIZE
		default 255

	config BT_COMPANY_ID
		default 0x000D

	choice BT_RECV_CONTEXT
		bool
		default BT_RECV_WORKQ_BT if BT_MESH
		default BT_RECV_WORKQ_SYS
	endchoice
endif # BT

if BT_MESH
	config BT_HOST_CRYPTO_PRNG
		default n

	config BT_CTLR_CRYPTO
		default y

	config BT_HOST_CRYPTO
		default y

if BT_MESH_FRIEND
	config BT_MESH_FRIEND_ADV_LATENCY
		default 7
endif # BT_MESH_FRIEND

if BT_MESH_LOW_POWER
	config BT_MESH_LPN_SCAN_LATENCY
		default 3

	config BT_MESH_GATT_PROXY
		default n

	config BT_MESH_PRIV_BEACONS
		default n

	config BT_MESH_BEACON_ENABLED
		default n

	config BT_MESH_RELAY
		default n

	config BT_MESH_FRIEND
		default n

endif # BT_MESH_LOW_POWER
endif # BT_MESH

# Choose non-hardware based RNG
choice RNG_GENERATOR_CHOICE
	default XOSHIRO_RANDOM_GENERATOR
endchoice

# Use CTR DRBG since the entropy driver is not designed to provide continuous RNG
choice CSPRNG_GENERATOR_CHOICE
	default CTR_DRBG_CSPRNG_GENERATOR
endchoice

# By default mbedTLS uses RAM for AES tables, which are too big
if MBEDTLS
	config MBEDTLS_AES_ROM_TABLES
		default y
	config TEST_EXTRA_STACK_SIZE
	default 1024
endif # MBEDTLS

# Object tracking for semaphores is currently not supported
config OBJ_CORE_SEM
		default n

config TRACING_SEMAPHORE
		default n
```

## boards/ti/sk_am62a/Kconfig.sk_am62a
```kconfig
# Texas Instruments SK-AM62A
#
# Copyright (c) 2026 Texas Instruments Incorporated
#
# SPDX-License-Identifier: Apache-2.0

config BOARD_SK_AM62A
	select SOC_AM62A7_MCU_R5F0_0 if BOARD_SK_AM62A_AM62A7_MCU_R5F0_0
```

## boards/ti/sk_am62a/board.yml
```yaml
board:
  name: sk_am62a
  full_name: SK-AM62A
  vendor: ti
  socs:
  - name: am62a7
```

## boards/ti/tm4c129exl/board.yml
```yaml
board:
  name: tm4c129exl
  full_name: TI Tiva C Series TM4C129E Crypto Connected LaunchPad
  vendor: ti
  socs:
    - name: ti_tm4c129encpdt
```

## boards/tplink/wa850re_v6/Kconfig.wa850re_v6
```kconfig
# SPDX-FileCopyrightText: 2026 Muhammad Waleed Badar
# SPDX-License-Identifier: Apache-2.0

config BOARD_WA850RE_V6
	select SOC_MT7628
```

## boards/tplink/wa850re_v6/board.yml
```yaml
board:
  name: wa850re_v6
  full_name: TP-Link TL-WA850RE v6
  vendor: tplink
  socs:
  - name: mt7628
```

## boards/tuya/t5ai_core/Kconfig.t5ai_core
```kconfig
# Copyright (c) 2026 Embracecactus
# SPDX-License-Identifier: Apache-2.0

config BOARD_T5AI_CORE
	select SOC_BK7258_CPU0 if BOARD_T5AI_CORE_BK7258_CPU0
```

## boards/tuya/t5ai_core/t5ai_core_bk7258_cpu0_defconfig
```kconfig
# Copyright (c) 2026 Embracecactus
# SPDX-License-Identifier: Apache-2.0

CONFIG_SERIAL=y
CONFIG_CONSOLE=y
CONFIG_UART_CONSOLE=y
CONFIG_CLOCK_CONTROL=y
```

## boards/u-blox/ubx_evkannab5/board.yml
```yaml
board:
  name: ubx_evkannab5
  full_name: EVK-ANNA-B50
  vendor: u-blox
  socs:
    - name: nrf54l15
      variants:
        - name: ns
          cpucluster: cpuapp
        - name: xip
          cpucluster: cpuflpr
runners:
  run_once:
    '--recover':
      - runners:
          - nrfjprog
          - nrfutil
        run: first
        groups:
          - boards:
              - ubx_evkannab5/nrf54l15/cpuapp
              - ubx_evkannab5/nrf54l15/cpuapp/ns
              - ubx_evkannab5/nrf54l15/cpuflpr
              - ubx_evkannab5/nrf54l15/cpuflpr/xip
    '--erase':
      - runners:
          - nrfjprog
          - jlink
          - nrfutil
        run: first
        groups:
          - boards:
              - ubx_evkannab5/nrf54l15/cpuapp
              - ubx_evkannab5/nrf54l15/cpuapp/ns
              - ubx_evkannab5/nrf54l15/cpuflpr
              - ubx_evkannab5/nrf54l15/cpuflpr/xip
    '--reset':
      - runners:
          - nrfjprog
          - jlink
          - nrfutil
        run: last
        groups:
          - boards:
              - ubx_evkannab5/nrf54l15/cpuapp
              - ubx_evkannab5/nrf54l15/cpuapp/ns
              - ubx_evkannab5/nrf54l15/cpuflpr
              - ubx_evkannab5/nrf54l15/cpuflpr/xip
```

## boards/udoo/udoo_key/Kconfig
```kconfig
# Copyright (c) 2026 UDOO
# SPDX-License-Identifier: Apache-2.0

config BOARD_UDOO_KEY
	select RP2_FLASH_W25Q080 if BOARD_UDOO_KEY_RP2040

config HEAP_MEM_POOL_ADD_SIZE_BOARD
	int
	default 4096 if BOARD_UDOO_KEY_ESP32_PROCPU
	default 256 if BOARD_UDOO_KEY_ESP32_APPCPU
```

## boards/udoo/udoo_key/Kconfig.defconfig
```kconfig
# Copyright (c) 2026 Mohan Nagaraj
# SPDX-License-Identifier: Apache-2.0

if BOARD_UDOO_KEY_RP2040

config USB_SELF_POWERED
	default n

if I2C_DW

config I2C_DW_CLOCK_SPEED
	default 125

endif

endif # BOARD_UDOO_KEY_RP2040
```

## boards/udoo/udoo_key/Kconfig.sysbuild
```kconfig
# Copyright (c) 2026 Mohan Nagaraj
# SPDX-License-Identifier: Apache-2.0

if BOARD_UDOO_KEY_ESP32_PROCPU || BOARD_UDOO_KEY_ESP32_APPCPU

choice BOOTLOADER
	default BOOTLOADER_MCUBOOT
endchoice

choice BOOT_SIGNATURE_TYPE
	default BOOT_SIGNATURE_TYPE_NONE
endchoice

endif
```

## boards/udoo/udoo_key/board.yml
```yaml
board:
  name: udoo_key
  full_name: UDOO KEY
  vendor: udoo
  socs:
    - name: esp32
    - name: rp2040
```

## boards/ulanzi/ulanzi_tc001/Kconfig
```kconfig
# Copyright (c) 2026 Bruno Vunderl
# SPDX-License-Identifier: Apache-2.0

config HEAP_MEM_POOL_ADD_SIZE_BOARD
	int
	default 4096 if BOARD_ULANZI_TC001_ESP32_PROCPU
```

## boards/ulanzi/ulanzi_tc001/Kconfig.sysbuild
```kconfig
# Copyright (c) 2026 Bruno Vunderl
# SPDX-License-Identifier: Apache-2.0

choice BOOTLOADER
	default BOOTLOADER_MCUBOOT
endchoice
```

## boards/ulanzi/ulanzi_tc001/Kconfig.ulanzi_tc001
```kconfig
# Copyright (c) 2026 Bruno Vunderl
# SPDX-License-Identifier: Apache-2.0

config BOARD_ULANZI_TC001
	select SOC_ESP32
	select SOC_ESP32_PROCPU if BOARD_ULANZI_TC001_ESP32_PROCPU
```

## boards/ulanzi/ulanzi_tc001/board.yml
```yaml
board:
  name: ulanzi_tc001
  full_name: TC001 Smart Pixel Clock
  vendor: ulanzi
  socs:
  - name: esp32
```

## boards/ulanzi/ulanzi_tc001/ulanzi_tc001_procpu_defconfig
```kconfig
# Copyright (c) 2026 Bruno Vunderl
# SPDX-License-Identifier: Apache-2.0

CONFIG_CONSOLE=y
CONFIG_SERIAL=y
CONFIG_UART_CONSOLE=y

CONFIG_GPIO=y

CONFIG_ESP32_USE_UNSUPPORTED_REVISION=y
```

## boards/um/feathers3/um_feathers3_procpu_defconfig
```kconfig
# SPDX-License-Identifier: Apache-2.0

CONFIG_MAIN_STACK_SIZE=2048

CONFIG_CONSOLE=y
CONFIG_SERIAL=y
CONFIG_UART_CONSOLE=y
CONFIG_GPIO=y
CONFIG_CLOCK_CONTROL=y
CONFIG_ESP_SPIRAM=y

CONFIG_PM_DEVICE=y
CONFIG_PM_DEVICE_POWER_DOMAIN=y
CONFIG_POWER_DOMAIN=y
CONFIG_POWER_DOMAIN_GPIO=y
# for stemma2_connector on ldo2_pwr
CONFIG_POWER_DOMAIN_GPIO_INIT_PRIORITY=45
```
