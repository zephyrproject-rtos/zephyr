## boards/ti/cc1352r1_launchxl/Kconfig.cc1352r1_launchxl
```kconfig
# TI CC1352R LaunchXL board

# Copyright (c) 2019 Brett Witherspoon
# SPDX-License-Identifier: Apache-2.0

config BOARD_CC1352R1_LAUNCHXL
	select SOC_CC1352R
```

## boards/ti/cc1352r1_launchxl/board.yml
```yaml
board:
  name: cc1352r1_launchxl
  full_name: CC1352R1 LaunchXL
  vendor: ti
  socs:
  - name: cc1352r
```

## boards/ti/cc1352r_sensortag/Kconfig.defconfig
```kconfig
# TI CC1352R SensorTag board

# Copyright (c) 2019 Brett Witherspoon
# Copyright (c) 2020 Friedt Professional Engineering Services, Inc
# SPDX-License-Identifier: Apache-2.0

if BOARD_CC1352R_SENSORTAG

config SPI
	default SENSOR

endif # BOARD_CC1352R_SENSORTAG
```

## boards/ti/cc1352r_sensortag/board.yml
```yaml
board:
  name: cc1352r_sensortag
  full_name: CC1352R SensorTag
  vendor: ti
  socs:
  - name: cc1352r
```

## boards/ti/cc26x2r1_launchxl/Kconfig.cc26x2r1_launchxl
```kconfig
# TI CC26x2R1 LaunchXL board

# Copyright (c) 2019 Brett Witherspoon
# SPDX-License-Identifier: Apache-2.0

config BOARD_CC26X2R1_LAUNCHXL
	select SOC_CC2652R
```

## boards/ti/cc26x2r1_launchxl/board.yml
```yaml
board:
  name: cc26x2r1_launchxl
  full_name: CC26x2R1 LaunchXL
  vendor: ti
  socs:
  - name: cc2652r
```

## boards/ti/cc26x2r1_launchxl/cc26x2r1_launchxl_defconfig
```kconfig
#
# Copyright (c) 2019 Brett Witherspoon
#
# SPDX-License-Identifier: Apache-2.0
#

CONFIG_BUILD_OUTPUT_HEX=y

CONFIG_CC13X2_CC26X2_BOOTLOADER_ENABLE=y
CONFIG_CC13X2_CC26X2_BOOTLOADER_BACKDOOR_ENABLE=y
CONFIG_CC13X2_CC26X2_BOOTLOADER_BACKDOOR_PIN=13

# Enable MPU and hardware stack protection
CONFIG_ARM_MPU=y
CONFIG_HW_STACK_PROTECTION=y

CONFIG_GPIO=y
CONFIG_SERIAL=y

CONFIG_CONSOLE=y
CONFIG_UART_CONSOLE=y
```

## boards/ti/cc3220sf_launchxl/Kconfig.cc3220sf_launchxl
```kconfig
# TI SimpleLink CC3220SF LaunchXL Board
# SPDX-License-Identifier: Apache-2.0
# Copyright (c) 2022 Dhruva Gole

config BOARD_CC3220SF_LAUNCHXL
	select SOC_CC3220SF
```

## boards/ti/cc3220sf_launchxl/board.yml
```yaml
board:
  name: cc3220sf_launchxl
  full_name: CC3220SF LaunchXL
  vendor: ti
  socs:
  - name: cc3220sf
```

## boards/ti/cc3220sf_launchxl/cc3220sf_launchxl_defconfig
```kconfig
# SPDX-License-Identifier: Apache-2.0
# Copyright (c) 2022 Dhruva Gole

CONFIG_BUILD_OUTPUT_HEX=y

# Enable GPIO driver
CONFIG_GPIO=y

# Enable UART driver
CONFIG_SERIAL=y

# Enable console
CONFIG_CONSOLE=y
CONFIG_UART_CONSOLE=y
```

## boards/ti/cc3235sf_launchxl/Kconfig.cc3235sf_launchxl
```kconfig
# TI SimpleLink CC3235SF LaunchXL Board
# Copyright (c) 2019, Texas Instruments Incorporated
# SPDX-License-Identifier: Apache-2.0

config BOARD_CC3235SF_LAUNCHXL
	select SOC_CC3235SF
```

## boards/ti/cc3235sf_launchxl/board.yml
```yaml
board:
  name: cc3235sf_launchxl
  full_name: CC3235SF LaunchXL
  vendor: ti
  socs:
  - name: cc3235sf
```

## boards/ti/common/Kconfig
```kconfig
# TI CC1352R LaunchXL board

# Copyright (c) 2021 Florin Stancu
# SPDX-License-Identifier: Apache-2.0

config BOARD_CC1352_LP_SKY13317
	bool "CC1352 LP common board antenna init"
	default y if DT_HAS_SKYWORKS_SKY13317_ENABLED
	help
	  Some CC1352 boards have a SKY13317 component
	  to select the antenna. This enables support
	  for this component for the CC1352 boards using it.

if BOARD_CC1352_LP_SKY13317

config BOARD_ANTENNA_INIT_PRIO
	int "Board antenna switch initialization priority"
	default 70
	help
	  Set the priority for board init, must be greater than
	  KERNEL_INIT_PRIORITY_DEVICE but smaller than
	  IEEE802154_CC13XX_CC26XX_SUB_GHZ_INIT_PRIO.

endif # BOARD_CC1352_LP_SKY13317

config BOARD_TI_MSPI_FLASH_BOOT_MODE_RESET
	bool "Reset MSPI flash from 8D-8D-8D to 1S-1S-1S on boot"
	depends on FLASH_MSPI
	help
	  TI K3 ROM bootloader may leave OSPI flash devices in 8D-8D-8D mode
	  depending on the boot configuration. Enabling this option will
	  reset the flash in 8D-8D-8D mode so that it resets to the default
	  1S-1S-1S mode.

	  This is required when the ROM bootloader configures flash devices in
	  high-speed modes before transferring control to Zephyr, which would
	  cause normal flash initialization to fail.
```

## boards/ti/lp_am13e230/Kconfig.lp_am13e230
```kconfig
# Copyright (c) 2026 Texas Instruments Incorporated
#
# SPDX-License-Identifier: Apache-2.0

config BOARD_LP_AM13E230
	select SOC_AM13E23019
```

## boards/ti/lp_am13e230/board.yml
```yaml
# Copyright (c) 2026 Texas Instruments Incorporated
# SPDX-License-Identifier: Apache-2.0

board:
  name: lp_am13e230
  full_name: AM13E230X Launchpad
  vendor: ti
  socs:
    - name: am13e23019
```

## boards/ti/lp_am13e230/lp_am13e230_defconfig
```kconfig
# SPDX-License-Identifier: Apache-2.0

# Enable UART driver
CONFIG_SERIAL=y

# Enable Console
CONFIG_CONSOLE=y
CONFIG_UART_CONSOLE=y

CONFIG_CLOCK_CONTROL=y
```

## boards/ti/lp_am243/Kconfig.defconfig
```kconfig
# Texas Instruments AM243x Launchpad
#
# SPDX-FileCopyrightText: Copyright The Zephyr Project Contributors
# SPDX-FileCopyrightText: Copyright 2026 Siemens Mobility GmbH
# SPDX-License-Identifier: Apache-2.0

if BOARD_LP_AM243

# The ELF needs to have the exception vector at 0x0 so the SBL can load it
# correctly after it is converted by the TI MCU+ SDK tools
if SOC_SERIES_AM64X_R5

DT_ROMSTART := romstart

config ROMSTART_RELOCATION_ROM
	default y if $(dt_nodelabel_exists,$(DT_ROMSTART))

config ROMSTART_REGION_SIZE_UNIT
	default 1

config ROMSTART_REGION_ADDRESS
	default $(dt_nodelabel_reg_addr_hex,$(DT_ROMSTART))

config ROMSTART_REGION_SIZE
	default $(dt_nodelabel_reg_size_hex,$(DT_ROMSTART))

endif # SOC_SERIES_AM64X_R5

endif # BOARD_LP_AM243
```

## boards/ti/lp_am243/Kconfig.lp_am243
```kconfig
# Texas Instruments AM243x Launchpad
#
# SPDX-FileCopyrightText: Copyright The Zephyr Project Contributors
# SPDX-FileCopyrightText: Copyright 2025 - 2026 Siemens Mobility GmbH
# SPDX-License-Identifier: Apache-2.0

config BOARD_LP_AM243
	select SOC_AM2434_R5F0_0 if BOARD_LP_AM243_AM2434_R5F0_0
	select SOC_AM2434_M4 if BOARD_LP_AM243_AM2434_M4
```

## boards/ti/lp_am243/board.yml
```yaml
# SPDX-FileCopyrightText: Copyright The Zephyr Project Contributors
# SPDX-FileCopyrightText: Copyright 2026 Siemens Mobility GmbH
# SPDX-License-Identifier: Apache-2.0
board:
  name: lp_am243
  full_name: TI AM243x LaunchPad
  vendor: ti
  socs:
  - name: am2434
```

## boards/ti/lp_am243/lp_am243_m4_defconfig
```kconfig
# Texas Instruments AM243x Launchpad
#
# SPDX-FileCopyrightText: Copyright The Zephyr Project Contributors
# SPDX-FileCopyrightText: Copyright 2026 Siemens Mobility GmbH
# SPDX-License-Identifier: Apache-2.0

# XIP is deactivated for now since we have no flash support yet
CONFIG_XIP=n

# Serial Driver
CONFIG_SERIAL=y

# Enable Console
CONFIG_CONSOLE=y
CONFIG_UART_CONSOLE=y
```

## boards/ti/lp_am243/lp_am243_r5f0_0_defconfig
```kconfig
# Texas Instruments AM243x Launchpad
#
# SPDX-FileCopyrightText: Copyright The Zephyr Project Contributors
# SPDX-FileCopyrightText: Copyright 2025 - 2026 Siemens Mobility GmbH
# SPDX-License-Identifier: Apache-2.0

# XIP is deactivated for now since we have no flash support yet
CONFIG_XIP=n

# Serial Driver
CONFIG_SERIAL=y

# Enable Console
CONFIG_CONSOLE=y
CONFIG_UART_CONSOLE=y

# The ELF needs to have the exception vector at 0x0 so the SBL can load it
# correctly after it is converted by the TI MCU+ SDK tools
CONFIG_ROMSTART_RELOCATION_ROM=y
CONFIG_ROMSTART_REGION_ADDRESS=0
CONFIG_ROMSTART_REGION_SIZE=1
```

## boards/ti/lp_am243x/Kconfig.lp_am243x
```kconfig
# Texas Instruments Sitara AM243x LaunchPad
#
# Copyright (c) 2025 Texas Instruments Incorporated
#
# SPDX-License-Identifier: Apache-2.0

config BOARD_LP_AM243X
	select SOC_AM2434_M4 if BOARD_LP_AM243X_AM2434_M4
	select SOC_AM2434_R5F0_0 if BOARD_LP_AM243X_AM2434_R5F0_0
```

## boards/ti/lp_am243x/board.yml
```yaml
board:
  name: lp_am243x
  full_name: AM243x LaunchPad
  vendor: ti
  socs:
  - name: am2434
```

## boards/ti/lp_em_cc2340r5/Kconfig.lp_em_cc2340r5
```kconfig
# Copyright (c) 2024 Texas Instruments Incorporated
# Copyright (c) 2024 BayLibre, SAS
#
# SPDX-License-Identifier: Apache-2.0

config BOARD_LP_EM_CC2340R5
	select SOC_CC2340R5
```

## boards/ti/lp_em_cc2340r5/board.yml
```yaml
board:
  name: lp_em_cc2340r5
  full_name: CC2340R5 LaunchPad
  vendor: ti
  socs:
    - name: cc2340r5
```
