/*
 * Copyright (c) 2019 Brett Witherspoon
 *
 * SPDX-License-Identifier: Apache-2.0
 */

/dts-v1/;

#include <ti/cc1352r.dtsi>
#include "../common/launchxl.dtsi"
#include "../common/launchxl-flash.dtsi"

/ {
	compatible = "ti,launchxl-cc1352r1";
	model = "TI CC1352R1 LaunchXL";
};

&adc0 {
	status = "okay";
};
