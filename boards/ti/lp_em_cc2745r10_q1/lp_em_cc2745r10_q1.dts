/*
 * Copyright (c) 2025 Texas Instruments Incorporated
 * Copyright (c) 2024 BayLibre, SAS
 *
 * SPDX-License-Identifier: Apache-2.0
 */

/dts-v1/;

#include <ti/cc2745r10_q1.dtsi>

/ {
	model = "LP_EM_CC2745R10_Q1";
	compatible = "ti,lp_em_cc2745r10_q1";

	chosen {
		zephyr,sram = &sram0;
		zephyr,flash = &flash0;
	};

};

&cpu0 {
	clock-frequency = <96000000>;
};

&gpio0 {
	status = "okay";
};
