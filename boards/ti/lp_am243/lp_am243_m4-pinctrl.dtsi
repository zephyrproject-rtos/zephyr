/*
 * SPDX-FileCopyrightText: Copyright The Zephyr Project Contributors
 * SPDX-FileCopyrightText: Copyright 2026 Siemens Mobility GmbH
 * SPDX-License-Identifier: Apache-2.0
 */

#include <zephyr/dt-bindings/pinctrl/ti-k3-pinctrl.h>

&mcu_pinctrl {
	mcu_uart0_rx_default: mcu-uart0-rx-default { // GPIO 0_3
		pinmux = <K3_PINMUX(0x028, PIN_INPUT, MUX_MODE_0)>;
	};

	mcu_uart0_tx_default: mcu-uart0-tx-default { // GPIO 0_2
		pinmux = <K3_PINMUX(0x02C, PIN_OUTPUT, MUX_MODE_0)>;
	};

	status = "okay";
};
