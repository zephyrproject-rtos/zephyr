## boards/ti/lp_em_cc2340r53_wcsp/Kconfig.lp_em_cc2340r53_wcsp
```kconfig
# Copyright (c) 2026 Texas Instruments Incorporated
# Copyright (c) 2024 BayLibre, SAS
#
# SPDX-License-Identifier: Apache-2.0

config BOARD_LP_EM_CC2340R53_WCSP
	select SOC_CC2340R53
```

## boards/ti/lp_em_cc2340r53_wcsp/board.yml
```yaml
board:
  name: lp_em_cc2340r53_wcsp
  full_name: CC2340R53 WCSP LaunchPad
  vendor: ti
  socs:
    - name: cc2340r53
```

## boards/ti/lp_em_cc2340r53_wcsp/lp_em_cc2340r53_wcsp_defconfig
```kconfig
# Copyright (c) 2026 Texas Instruments Incorporated
# Copyright (c) 2024 BayLibre, SAS
#
# SPDX-License-Identifier: Apache-2.0

CONFIG_BUILD_OUTPUT_HEX=y

CONFIG_GPIO=y
CONFIG_PINCTRL=y
CONFIG_SERIAL=y

CONFIG_CONSOLE=y
CONFIG_UART_CONSOLE=y
```

## boards/ti/lp_em_cc2340r5moda/Kconfig.lp_em_cc2340r5moda
```kconfig
# Copyright (c) 2026 Texas Instruments Incorporated
#
# SPDX-License-Identifier: Apache-2.0

config BOARD_LP_EM_CC2340R5MODA
	select SOC_CC2340R53
```

## boards/ti/lp_em_cc2340r5moda/board.yml
```yaml
board:
  name: lp_em_cc2340r5moda
  full_name: CC2340R5MODA LaunchPad
  vendor: ti
  socs:
    - name: cc2340r53
```

## boards/ti/lp_em_cc2340r5moda/lp_em_cc2340r5moda_defconfig
```kconfig
# Copyright (c) 2026 Texas Instruments Incorporated
#
# SPDX-License-Identifier: Apache-2.0

CONFIG_GPIO=y
CONFIG_SERIAL=y

CONFIG_CONSOLE=y
CONFIG_UART_CONSOLE=y

CONFIG_BT_HCI_ACL_FLOW_CONTROL=n

CONFIG_PM=y
```

## boards/ti/lp_em_cc2745r10_q1/Kconfig
```kconfig
# Copyright (c) 2025 Texas Instruments Incorporated
#
# SPDX-License-Identifier: Apache-2.0

rsource "../lpf3_common/Kconfig"
```

## boards/ti/lp_em_cc2745r10_q1/Kconfig.lp_em_cc2745r10_q1
```kconfig
# Copyright (c) 2025-2026 Texas Instruments Incorporated
# Copyright (c) 2024 BayLibre, SAS
#
# SPDX-License-Identifier: Apache-2.0

config BOARD_LP_EM_CC2745R10_Q1
	select SOC_CC2745R10_Q1 if BOARD_LP_EM_CC2745R10_Q1_CC2745R10_Q1
	select SOC_CC2755R10 if BOARD_LP_EM_CC2745R10_Q1_CC2755R10
```

## boards/ti/lp_em_cc2745r10_q1/board.yml
```yaml
board:
  name: lp_em_cc2745r10_q1
  full_name: CC2745R10-Q1 LaunchPad
  vendor: ti
  socs:
    - name: cc2745r10_q1
    - name: cc2755r10
```

## boards/ti/lp_em_cc2745r10_q1/lp_em_cc2745r10_q1_cc2745r10_q1_defconfig
```kconfig
# Copyright (c) 2025 Texas Instruments Incorporated
# Copyright (c) 2024 BayLibre, SAS
#
# SPDX-License-Identifier: Apache-2.0

CONFIG_GPIO=y
CONFIG_SERIAL=y

CONFIG_CONSOLE=y
CONFIG_UART_CONSOLE=y

CONFIG_BT_HCI_ACL_FLOW_CONTROL=n

CONFIG_PM=y
```

## boards/ti/lp_em_cc2755p10/Kconfig.lp_em_cc2755p10
```kconfig
# Copyright (c) 2026 Texas Instruments Incorporated
# Copyright (c) 2024 BayLibre, SAS
#
# SPDX-License-Identifier: Apache-2.0

config BOARD_LP_EM_CC2755P10
	select SOC_CC2755P10 if BOARD_LP_EM_CC2755P10
```

## boards/ti/lp_em_cc2755p10/board.yml
```yaml
board:
  name: lp_em_cc2755p10
  full_name: CC2755P10 LaunchPad
  vendor: ti
  socs:
    - name: cc2755p10
```

## boards/ti/lp_em_cc2755p20/Kconfig.lp_em_cc2755p20
```kconfig
# Copyright (c) 2026 Texas Instruments Incorporated
#
# SPDX-License-Identifier: Apache-2.0

config BOARD_LP_EM_CC2755P20
	select SOC_CC2755P20 if BOARD_LP_EM_CC2755P20
```

## boards/ti/lp_em_cc2755p20/board.yml
```yaml
board:
  name: lp_em_cc2755p20
  full_name: CC2755P20 LaunchPad
  vendor: ti
  socs:
    - name: cc2755p20
```

## boards/ti/lp_em_cc2755r10_bg/Kconfig.lp_em_cc2755r10_bg
```kconfig
# Copyright (c) 2026 Texas Instruments Incorporated
# Copyright (c) 2024 BayLibre, SAS
#
# SPDX-License-Identifier: Apache-2.0

config BOARD_LP_EM_CC2755R10_BG
	select SOC_CC2755R10 if BOARD_LP_EM_CC2755R10_BG
```

## boards/ti/lp_em_cc2755r10_bg/board.yml
```yaml
board:
  name: lp_em_cc2755r10_bg
  full_name: CC2755R10 BG LaunchPad
  vendor: ti
  socs:
    - name: cc2755r10
```

## boards/ti/lp_em_cc2755r7_bg/Kconfig.lp_em_cc2755r7_bg
```kconfig
# Copyright (c) 2026 Texas Instruments Incorporated
# Copyright (c) 2024 BayLibre, SAS
#
# SPDX-License-Identifier: Apache-2.0

config BOARD_LP_EM_CC2755R7_BG
	select SOC_CC2755R7 if BOARD_LP_EM_CC2755R7_BG
```

## boards/ti/lp_em_cc2755r7_bg/board.yml
```yaml
board:
  name: lp_em_cc2755r7_bg
  full_name: CC2755R7 BG LaunchPad
  vendor: ti
  socs:
    - name: cc2755r7
```

## boards/ti/lp_em_cc35x1/Kconfig.lp_em_cc35x1
```kconfig
# TI CC35X1 LaunchPad board
# Copyright (c) 2025 Conclusive Engineering Sp. z o.o.
# SPDX-License-Identifier: Apache-2.0

config BOARD_LP_EM_CC35X1
	bool
	select SOC_CC3500E if BOARD_LP_EM_CC35X1_CC3500E
	select SOC_CC3501E if BOARD_LP_EM_CC35X1_CC3501E
	select SOC_CC3550E if BOARD_LP_EM_CC35X1_CC3550E
	select SOC_CC3551E if BOARD_LP_EM_CC35X1_CC3551E
```

## boards/ti/lp_em_cc35x1/board.yml
```yaml
board:
  name: lp_em_cc35x1
  full_name: CC35x1 LaunchPad
  vendor: ti
  socs:
    - name: cc3500e
    - name: cc3501e
    - name: cc3550e
    - name: cc3551e
```

## boards/ti/lp_em_cc35x1/lp_em_cc35x1_cc3550e_defconfig
```kconfig
#
# Copyright (c) 2026 Conclusive Engineering Sp. z o.o.
#
# SPDX-License-Identifier: Apache-2.0
#

CONFIG_SHARED_MULTI_HEAP=y
CONFIG_THREAD_STACK_INFO=y
CONFIG_DYNAMIC_THREAD=y
CONFIG_TEST_RANDOM_GENERATOR=y
CONFIG_TIMER_RANDOM_GENERATOR=y

CONFIG_GPIO=y

CONFIG_SERIAL=y

CONFIG_CONSOLE=y
CONFIG_UART_CONSOLE=y
```
