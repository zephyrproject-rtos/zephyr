## boards/ti/am13e230x_lp/am13e230x_lp_defconfig
```kconfig
# Copyright (c) 2026 Texas Instruments Incorporated
#
# SPDX-License-Identifier: Apache-2.0

CONFIG_XIP=n
```

## boards/ti/am13e230x_lp/board.yml
```yaml
# Copyright (c) 2026 Texas Instruments Incorporated
# SPDX-License-Identifier: Apache-2.0

board:
  name: am13e230x_lp
  full_name: AM13E230X Launchpad
  vendor: ti
  socs:
    - name: am13e230x
```

## boards/ti/am243x_evm/Kconfig.am243x_evm
```kconfig
# Texas Instruments Sitara AM243x EVM
#
# Copyright (c) 2025 Texas Instruments Incorporated
#
# SPDX-License-Identifier: Apache-2.0

config BOARD_AM243X_EVM
	select SOC_AM2434_M4 if BOARD_AM243X_EVM_AM2434_M4
	select SOC_AM2434_R5F0_0 if BOARD_AM243X_EVM_AM2434_R5F0_0
```

## boards/ti/am243x_evm/am243x_evm_am2434_r5f0_0_defconfig
```kconfig
# Copyright (c) 2025 Texas Instruments Incorporated
#
# SPDX-License-Identifier: Apache-2.0

# Zephyr Kernel Configuration
CONFIG_XIP=n

# Serial Driver
CONFIG_SERIAL=y
CONFIG_UART_INTERRUPT_DRIVEN=y

# Enable Console
CONFIG_CONSOLE=y
CONFIG_UART_CONSOLE=y

# Enable MPU
CONFIG_ARM_MPU=y

# Enable OSPI flash boot mode reset
CONFIG_TI_K3_OSPI_FLASH_BOOT_MODE_RESET=y

# Flash configuration
CONFIG_FLASH_MSPI_NOR_LAYOUT_PAGE_SIZE=262144
```

## boards/ti/am243x_evm/am243x_evm_am2434_r5f1_1_defconfig
```kconfig
# SPDX-FileCopyrightText: 2026 Texas Instruments Incorporated
# SPDX-License-Identifier: Apache-2.0

# Zephyr Kernel Configuration
CONFIG_XIP=n

# Enable MPU
CONFIG_ARM_MPU=y
```

## boards/ti/am243x_evm/board.yml
```yaml
board:
  name: am243x_evm
  full_name: TI AM243x-EVM
  vendor: ti
  socs:
  - name: am2434
```

## boards/ti/am261x_lp/Kconfig
```kconfig
# TI AM261X LaunchPad board
#
# Copyright (c) 2025 Texas Instruments Incorporated
#
# SPDX-License-Identifier: Apache-2.0

config SOC_PACKAGE_ZFG
	bool "This Board has ZFG package"
	default y
```

## boards/ti/am261x_lp/Kconfig.am261x_lp
```kconfig
# TI AM261X LaunchPad board
#
# Copyright (c) 2025 Texas Instruments Incorporated
#
# SPDX-License-Identifier: Apache-2.0

config BOARD_AM261X_LP
	select SOC_AM261X_R5F0_0 if BOARD_AM261X_LP_AM2612_R5F0_0
	select SOC_AM261X_R5F0_1 if BOARD_AM261X_LP_AM2612_R5F0_1
```

## boards/ti/am261x_lp/Kconfig.defconfig
```kconfig
# TI AM261X LaunchPad board
#
# Copyright (c) 2026 Texas Instruments Incorporated
#
# SPDX-License-Identifier: Apache-2.0

config ROMSTART_RELOCATION_ROM
	default y

config ROMSTART_REGION_ADDRESS
	default 0x00 # corresponds to ATCM of either R5F core

config ROMSTART_REGION_SIZE
	default 1 # denotes 1KB of data reserved for ROMSTART
```

## boards/ti/am261x_lp/am261x_lp_am2612_r5f0_0_defconfig
```kconfig
CONFIG_CONSOLE=y
CONFIG_UART_CONSOLE=y

CONFIG_SERIAL=y
CONFIG_UART_INTERRUPT_DRIVEN=y

CONFIG_SYS_CLOCK_TICKS_PER_SEC=1000
CONFIG_GPIO=y
CONFIG_GPIO_HOGS=y
```

## boards/ti/am261x_lp/am261x_lp_am2612_r5f0_1_defconfig
```kconfig
# Copyright (c) 2026 Texas Instruments Incorporated
#
# SPDX-License-Identifier: Apache-2.0

CONFIG_CONSOLE=y
CONFIG_UART_CONSOLE=y

CONFIG_SERIAL=y

CONFIG_SYS_CLOCK_TICKS_PER_SEC=1000
CONFIG_GPIO=y
CONFIG_GPIO_HOGS=y

# MPU Configurations
CONFIG_ARM_MPU=y

# Cache Configurations
CONFIG_CACHE_MANAGEMENT=y
CONFIG_DCACHE=y
CONFIG_ICACHE=y
```

## boards/ti/am261x_lp/board.yml
```yaml
# Copyright (c) 2026 Texas Instruments Incorporated
# SPDX-License-Identifier: Apache-2.0

board:
  name: am261x_lp
  full_name: AM261x LaunchPad
  vendor: ti
  socs:
  - name: am2612
```

## boards/ti/am62l_evm/Kconfig
```kconfig
# SPDX-FileCopyrightText: 2026 Texas Instruments Incorporated
# SPDX-License-Identifier: Apache-2.0

source "boards/ti/common/Kconfig"
```

## boards/ti/am62l_evm/Kconfig.am62l_evm
```kconfig
# Texas Instruments Sitara AM62L EVM
#
# Copyright (c) 2025 Texas Instruments Incorporated
#
# SPDX-License-Identifier: Apache-2.0

config BOARD_AM62L_EVM
	select SOC_AM62L3_A53
```

## boards/ti/am62l_evm/board.yml
```yaml
board:
  name: am62l_evm
  full_name: AM62L TMDS62LEVM evaluation module (EVM)
  vendor: ti
  socs:
  - name: am62l3
```

## boards/ti/cc1312r1_launchxl/Kconfig
```kconfig
# TI CC1312R1 LaunchXL board

# Copyright (c) 2026 Jean-Pierre De Jesus DIAZ
#
# SPDX-License-Identifier: Apache-2.0

source "boards/ti/common/Kconfig"
```

## boards/ti/cc1312r1_launchxl/Kconfig.cc1312r1_launchxl
```kconfig
# TI CC1312R LaunchXL board

# Copyright (c) 2026 Jean-Pierre De Jesus DIAZ
# SPDX-License-Identifier: Apache-2.0

config BOARD_CC1312R1_LAUNCHXL
	select SOC_CC1312R
```

## boards/ti/cc1312r1_launchxl/board.yml
```yaml
board:
  name: cc1312r1_launchxl
  full_name: CC1312R1 LaunchXL
  vendor: ti
  socs:
  - name: cc1312r
```

## boards/ti/cc1352p1_launchxl/Kconfig
```kconfig
# TI CC1352R LaunchXL board

# Copyright (c) 2024 Alexandre Bailon
# SPDX-License-Identifier: Apache-2.0

source "boards/ti/common/Kconfig"
```

## boards/ti/cc1352p1_launchxl/Kconfig.cc1352p1_launchxl
```kconfig
# TI CC1352R LaunchXL board

# Copyright (c) 2021 Florin Stancu
# SPDX-License-Identifier: Apache-2.0

config BOARD_CC1352P1_LAUNCHXL
	select SOC_CC1352P
```

## boards/ti/cc1352p1_launchxl/board.yml
```yaml
board:
  name: cc1352p1_launchxl
  full_name: CC1352P1 LaunchXL
  vendor: ti
  socs:
  - name: cc1352p
```

## boards/ti/cc1352p1_launchxl/dts/bindings/skyworks,sky13317.yaml
```yaml
# Copyright (c) 2022 Stancu Florin
# SPDX-License-Identifier: Apache-2.0

description: Skyworks SKY13317 pHEMT GaAs SP3T Antenna Switch

compatible: "skyworks,sky13317"

include: [pinctrl-device.yaml, base.yaml]

properties:
  gpios:
    type: phandle-array
    required: true
    description: Antenna mux control pins
```

## boards/ti/cc1352p7_launchpad/Kconfig
```kconfig
# TI CC1352P7 LaunchPad board

# Copyright (c) 2024 Alexandre Bailon
# SPDX-License-Identifier: Apache-2.0

source "boards/ti/common/Kconfig"
```

## boards/ti/cc1352p7_launchpad/Kconfig.cc1352p7_lp
```kconfig
# TI CC1352P7 LaunchPad board

# Copyright (c) 2024 Alexandre Bailon
# SPDX-License-Identifier: Apache-2.0

config BOARD_CC1352P7_LP
	select SOC_CC1352P7
```

## boards/ti/cc1352p7_launchpad/board.yml
```yaml
board:
  name: cc1352p7_lp
  full_name: CC1352P7 LaunchPad
  vendor: ti
  socs:
  - name: cc1352p7
```
