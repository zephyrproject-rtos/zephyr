## boards/ti/tm4c123gxl/Kconfig.tm4c123gxl
```kconfig
# SPDX-License-Identifier: Apache-2.0
#
# Copyright (c) 2026 Linumiz
# Author: Sri Surya <srisurya@linumiz.com>

config BOARD_TM4C123GXL
	select SOC_TI_TM4C123GH6PM
```

## boards/ti/tm4c123gxl/board.yml
```yaml
board:
  name: tm4c123gxl
  full_name: TI Tiva C Series TM4C123G LaunchPad
  vendor: ti
  socs:
    - name: ti_tm4c123gh6pm
```

## boards/ti/tm4c123gxl/tm4c123gxl_defconfig
```kconfig
# SPDX-License-Identifier: Apache-2.0
#
# Copyright (c) 2026 Linumiz
# Author: Sri Surya <srisurya@linumiz.com>

# Default configuration for TI TM4C123GXL LaunchPad
CONFIG_SERIAL=y
CONFIG_CONSOLE=y
CONFIG_UART_CONSOLE=y
```

## boards/ti/tms570_launchxl2/Kconfig.tms570_launchxl2
```kconfig
# Copyright (c) 2025 ispace, inc.
#
# SPDX-License-Identifier: Apache-2.0

config BOARD_TMS570_LAUNCHXL2
	select SOC_TI_TMS570LC43X if BOARD_TMS570_LAUNCHXL2
```

## boards/ti/tms570_launchxl2/board.yml
```yaml
board:
  name: tms570_launchxl2
  full_name: Hercules TMS570LC43x LaunchPad
  vendor: ti
  socs:
  - name: ti_tms570lc43x
```

## boards/ti/tms570_launchxl2/tms570_launchxl2_defconfig
```kconfig
# SPDX-License-Identifier: Apache-2.0
CONFIG_PINCTRL=y
CONFIG_PINCTRL_TI_TMS570=y
CONFIG_SERIAL=y
CONFIG_CONSOLE=y
CONFIG_UART_CONSOLE=y
CONFIG_GPIO=y
CONFIG_GPIO_TMS570=y
```

## boards/toradex/colibri_imx7d/Kconfig.colibri_imx7d
```kconfig
# Copyright 2017,2024 NXP
# SPDX-License-Identifier: Apache-2.0

config BOARD_COLIBRI_IMX7D
	select SOC_PART_NUMBER_MCIMX7D5EVM10SC
	select SOC_MCIMX7D_M4 if BOARD_COLIBRI_IMX7D_MCIMX7D_M4
```

## boards/toradex/colibri_imx7d/Kconfig.defconfig
```kconfig
# Colibri iMX7D M4 board

# Copyright 2017,2024 NXP
# SPDX-License-Identifier: Apache-2.0

if BOARD_COLIBRI_IMX7D_MCIMX7D_M4

if !XIP
config FLASH_SIZE
	default 0
config FLASH_BASE_ADDRESS
	default 0
endif


endif # BOARD_COLIBRI_IMX7D_MCIMX7D_M4
```

## boards/toradex/colibri_imx7d/board.yml
```yaml
board:
  name: colibri_imx7d
  full_name: i.MX 7 Computer on Module - Colibri iMX7
  vendor: toradex
  socs:
    - name: mcimx7d
```

## boards/toradex/verdin_am62/Kconfig.verdin_am62
```kconfig
# Toradex Verdin AM62
#
# Copyright (c) 2025 Toradex
#
# SPDX-License-Identifier: Apache-2.0

config BOARD_VERDIN_AM62
	select SOC_AM6234_M4 if BOARD_VERDIN_AM62_AM6234_M4
```

## boards/toradex/verdin_am62/board.yml
```yaml
board:
  name: verdin_am62
  full_name: Verdin AM62
  vendor: toradex
  socs:
  - name: am6234
```

## boards/toradex/verdin_am62/verdin_am62_am6234_m4_defconfig
```kconfig
# Toradex Verdin AM62
#
# Copyright (c) 2025 Toradex
#
# SPDX-License-Identifier: Apache-2.0

# Platform Configuration
CONFIG_CORTEX_M_SYSTICK=y

# Zephyr Kernel Configuration
CONFIG_XIP=n

# Serial Driver
CONFIG_SERIAL=y

# Enable Console
CONFIG_CONSOLE=y
CONFIG_UART_CONSOLE=y
```

## boards/toradex/verdin_imx8mm/Kconfig.defconfig
```kconfig
# VERDIN_IMX8MM board defconfig
#
# Copyright (c) 2024, Toradex
# SPDX-License-Identifier: Apache-2.0

if BOARD_VERDIN_IMX8MM

if !XIP
config FLASH_SIZE
	default 0
config FLASH_BASE_ADDRESS
	default 0
endif

endif # BOARD_VERDIN_IMX8MM
```

## boards/toradex/verdin_imx8mm/Kconfig.verdin_imx8mm
```kconfig
# Copyright (c) 2024 Toradex
# SPDX-License-Identifier: Apache-2.0

config BOARD_VERDIN_IMX8MM
	select SOC_PART_NUMBER_MIMX8MM6DVTLZ
	select SOC_MIMX8MM6_M4 if BOARD_VERDIN_IMX8MM_MIMX8MM6_M4
```

## boards/toradex/verdin_imx8mm/board.yml
```yaml
board:
  name: verdin_imx8mm
  full_name: Verdin iMX8M Mini
  vendor: toradex
  socs:
    - name: mimx8mm6
```

## boards/toradex/verdin_imx8mm/verdin_imx8mm_mimx8mm6_m4_defconfig
```kconfig
#
# Copyright (c) 2024 Toradex
#
# SPDX-License-Identifier: Apache-2.0
#

CONFIG_CLOCK_CONTROL=y
CONFIG_UART_CONSOLE=y
CONFIG_SERIAL=y
CONFIG_CONSOLE=y
CONFIG_XIP=y
CONFIG_GPIO=y
```

## boards/toradex/verdin_imx8mp/Kconfig.defconfig
```kconfig
# VERDIN_IMX8MP board defconfig

# Copyright (c) 2023 Toradex
# SPDX-License-Identifier: Apache-2.0

if BOARD_VERDIN_IMX8MP

if !XIP
config FLASH_SIZE
	default 0
config FLASH_BASE_ADDRESS
	default 0
endif

endif # BOARD_VERDIN_IMX8MP
```

## boards/toradex/verdin_imx8mp/Kconfig.verdin_imx8mp
```kconfig
# VERDIN_IMX8MP board

# Copyright (c) 2023 Toradex
# Copyright 2024 NXP
# SPDX-License-Identifier: Apache-2.0

config BOARD_VERDIN_IMX8MP
	select SOC_MIMX8MP_M7 if BOARD_VERDIN_IMX8MP_MIMX8ML8_M7 || BOARD_VERDIN_IMX8MP_MIMX8ML8_M7_DDR
	select SOC_PART_NUMBER_MIMX8ML8DVNLZ
```

## boards/toradex/verdin_imx8mp/board.yml
```yaml
board:
  name: verdin_imx8mp
  full_name: Verdin iMX8M Plus SoM
  vendor: toradex
  socs:
  - name: mimx8ml8
    variants:
    - name: ddr
      cpucluster: m7
```

## boards/toradex/verdin_imx8mp/verdin_imx8mp_mimx8ml8_m7_defconfig
```kconfig
#
# Copyright (c) 2023 Toradex
# Copyright 2024 NXP
#
# SPDX-License-Identifier: Apache-2.0
#

CONFIG_CLOCK_CONTROL=y
CONFIG_UART_CONSOLE=y
CONFIG_SERIAL=y
CONFIG_CONSOLE=y
CONFIG_XIP=y
CONFIG_CODE_ITCM=y
```

## boards/tq-systems/mba117xl/Kconfig
```kconfig
# Copyright (c) 2025 TQ-Systems GmbH <oss@ew.tq-group.com>
# SPDX-License-Identifier: Apache 2.0
# Author: Isaac L. L. Yuki

config BOARD_MBA117XL
    select BOARD_LATE_INIT_HOOK
    select SOC_LATE_INIT_HOOK
    select PINCTRL
```

## boards/tq-systems/mba117xl/Kconfig.defconfig
```kconfig
# Copyright (c) 2025 TQ-Systems GmbH <oss@ew.tq-group.com>
# SPDX-License-Identifier: Apache 2.0
# Author: Isaac L. L. Yuki

if BOARD_MBA117XL

config DEVICE_CONFIGURATION_DATA
	default y

config ADJUST_DCDC
	default n

config ADJUST_PMIC
	bool
	default y

config NXP_IMX_EXTERNAL_SDRAM
	default y

config BUILD_OUTPUT_INFO_HEADER
	default y

if BOOT_FLEXSPI_NOR
	config FLEXSPI_CONFIG_BLOCK_OFFSET
		default 0x400
	config FLASH_MCUX_FLEXSPI_XIP
		default y
endif #CONFIG_BOOT_FLEXSPI_NOR

endif

if NETWORKING

config NET_L2_ETHERNET
	default y if CPU_CORTEX_M7 # No cache memory support is required for driver

endif # NETWORKING

if DISPLAY

if SHIELD_RK055HDMIPI4MA0

config HX8394
	default y
	select INPUT
	select INPUT_GT911
    select INPUT_GT911_INTERRUPT

endif

config MIPI_DSI
	default y
	depends on SHIELD_MBA117XL_TM070 || SHIELD_RK055HDMIPI4MA0

if LVGL

# LVGL should allocate buffers equal to size of display
config LV_Z_VDB_SIZE
	default 100

# Enable double buffering
config LV_Z_DOUBLE_VDB
	default y

# Force full refresh. This prevents memory copy associated with partial
# display refreshes, which is not necessary for the eLCDIF driver
config LV_Z_FULL_REFRESH
	default y

config LV_Z_BITS_PER_PIXEL
	default 16

config LV_DPI_DEF
	default 128

# Use offloaded render thread
config LV_Z_FLUSH_THREAD
	default y

choice LV_COLOR_DEPTH
	default LV_COLOR_DEPTH_16
endchoice

endif # LVGL

endif #DISPLAY
```

## boards/tq-systems/mba117xl/Kconfig.mba117xl
```kconfig
# Copyright (c) 2025 TQ-Systems GmbH <oss@ew.tq-group.com>
# SPDX-License-Identifier: Apache 2.0
# Author: Isaac L. L. Yuki

config BOARD_MBA117XL
	select SOC_PART_NUMBER_MIMXRT1176DVMAA
	select SOC_MIMXRT1176_CM7
```

## boards/tq-systems/mba117xl/board.yml
```yaml
# Copyright (c) 2025 TQ-Systems GmbH <oss@ew.tq-group.com>
# SPDX-License-Identifier: Apache 2.0
# Author: Isaac L. L. Yuki

board:
  name: mba117xl
  full_name: MBa117xL
  vendor: tq-systems
  socs:
    - name: mimxrt1176
  revision:
    format: "number"
    default: "200"
    revisions:
      - name: "200"
```

## boards/tq-systems/mba117xl/mba117xl_cm7_defconfig
```kconfig
# Copyright (c) 2025 TQ-Systems GmbH <oss@ew.tq-group.com>
# SPDX-License-Identifier: Apache 2.0
# Author: Isaac L. L. Yuki

CONFIG_CONSOLE=y
CONFIG_UART_CONSOLE=y
CONFIG_SERIAL=y
CONFIG_GPIO=y
CONFIG_I2C=y
CONFIG_PWM=y

CONFIG_ARM_MPU=y
CONFIG_HW_STACK_PROTECTION=y
CONFIG_GPIO_PCA95XX=y
CONFIG_GPIO_PCA95XX_INTERRUPT=y

#important settings for bootSource

CONFIG_BOOT_FLEXSPI_NOR=y
CONFIG_NXP_IMX_EXTERNAL_SDRAM=y

CONFIG_CBPRINTF_FP_SUPPORT=y
```
