## boards/ti/lp_mspm0g3507/Kconfig.lp_mspm0g3507
```kconfig
# Copyright (c) 2024 Texas Instruments
# SPDX-License-Identifier: Apache-2.0

config BOARD_LP_MSPM0G3507
	select SOC_MSPM0G350X
```

## boards/ti/lp_mspm0g3507/board.yml
```yaml
board:
  name: lp_mspm0g3507
  full_name: MSPM0G3507 Launchpad
  vendor: ti
  socs:
    - name: mspm0g3507
```

## boards/ti/lp_mspm0g3507/lp_mspm0g3507_defconfig
```kconfig
# SPDX-License-Identifier: Apache-2.0

CONFIG_CORTEX_M_SYSTICK=y

# Enable gpio driver
CONFIG_GPIO=y

# Enable uart driver
CONFIG_SERIAL=y

# Enable console
CONFIG_CONSOLE=y
CONFIG_UART_CONSOLE=y

# Enable pinctrl
CONFIG_PINCTRL=y
```

## boards/ti/lp_mspm0g3507/lp_mspm0g3507_mspm0g3507_defconfig
```kconfig
# SPDX-License-Identifier: Apache-2.0

CONFIG_CORTEX_M_SYSTICK=y

# Enable GPIO driver
CONFIG_GPIO=y

# Enable UART driver
CONFIG_SERIAL=y

# Enable Console
CONFIG_CONSOLE=y
CONFIG_UART_CONSOLE=y

# Enable Clock Control
CONFIG_CLOCK_CONTROL=y
```

## boards/ti/lp_mspm0g3519/Kconfig.lp_mspm0g3519
```kconfig
# Copyright (c) 2025 Texas Instruments
# SPDX-License-Identifier: Apache-2.0

config BOARD_LP_MSPM0G3519
	select SOC_MSPM0G3519
```

## boards/ti/lp_mspm0g3519/board.yml
```yaml
board:
  name: lp_mspm0g3519
  full_name: MSPM0G3519 Launchpad
  vendor: ti
  socs:
    - name: mspm0g3519
```

## boards/ti/lp_mspm0g3519/lp_mspm0g3519_defconfig
```kconfig
# SPDX-License-Identifier: Apache-2.0

# Enable UART driver
CONFIG_SERIAL=y

# Enable Console
CONFIG_CONSOLE=y
CONFIG_UART_CONSOLE=y

CONFIG_CLOCK_CONTROL=y
CONFIG_SYS_CLOCK_HW_CYCLES_PER_SEC=32000000
```

## boards/ti/lp_mspm0g5187/board.yml
```yaml
board:
  name: lp_mspm0g5187
  full_name: MSPM0G5187 Launchpad
  vendor: ti
  socs:
    - name: mspm0g5187
```

## boards/ti/lp_mspm0l1117/board.yml
```yaml
board:
  name: lp_mspm0l1117
  full_name: MSPM0L1117 Launchpad
  vendor: ti
  socs:
    - name: mspm0l1117
```

## boards/ti/lp_mspm0l2228/Kconfig.lp_mspm0l2228
```kconfig
# Copyright (c) 2024 Texas Instruments
# SPDX-License-Identifier: Apache-2.0

config BOARD_LP_MSPM0L2228
	select SOC_MSPM0L2228
```

## boards/ti/lp_mspm0l2228/board.yml
```yaml
board:
  name: lp_mspm0l2228
  full_name: MSPM0L2228 Launchpad
  vendor: ti
  socs:
    - name: mspm0l2228
```

## boards/ti/lp_mspm0l2228/lp_mspm0l2228_defconfig
```kconfig
# SPDX-License-Identifier: Apache-2.0

# Enable UART driver
CONFIG_SERIAL=y

# Enable console
CONFIG_CONSOLE=y
CONFIG_UART_CONSOLE=y

CONFIG_CLOCK_CONTROL=y
```

## boards/ti/lp_mspm33c321a/Kconfig.lp_mspm33c321a
```kconfig
# Copyright (c) 2026 Texas Instruments
# SPDX-License-Identifier: Apache-2.0

config BOARD_LP_MSPM33C321A
	select SOC_MSPM33C321A
```

## boards/ti/lp_mspm33c321a/board.yml
```yaml
board:
  name: lp_mspm33c321a
  full_name: MSPM33C321A Launchpad
  vendor: ti
  socs:
    - name: mspm33c321a
```

## boards/ti/msp_exp432p401r_launchxl/Kconfig.msp_exp432p401r_launchxl
```kconfig
# TI SimpleLink MSP-EXP432P401R LaunchXL Development Board
# SPDX-License-Identifier: Apache-2.0
# Copyright (c) 2017 Linaro

config BOARD_MSP_EXP432P401R_LAUNCHXL
	select SOC_MSP432P401R
```

## boards/ti/msp_exp432p401r_launchxl/board.yml
```yaml
board:
  name: msp_exp432p401r_launchxl
  full_name: MSP-EXP432P401R LaunchXL
  vendor: ti
  socs:
  - name: msp432p401r
```

## boards/ti/msp_exp432p401r_launchxl/msp_exp432p401r_launchxl_defconfig
```kconfig
# SPDX-License-Identifier: Apache-2.0
# Copyright (c) 2017 Linaro

CONFIG_BUILD_OUTPUT_HEX=y

# Floating point options
CONFIG_FPU=y

# Enable UART driver
CONFIG_SERIAL=y

# Enable console
CONFIG_CONSOLE=y
CONFIG_UART_CONSOLE=y
```

## boards/ti/sk_am62/Kconfig.sk_am62
```kconfig
# Texas Instruments Sitara AM62x-SK-M4 EVM
#
# Copyright (c) 2023 Texas Instruments Incorporated
# Copyright (c) 2023 L Lakshmanan
#
# SPDX-License-Identifier: Apache-2.0

config BOARD_SK_AM62
	select SOC_AM6234_M4 if BOARD_SK_AM62_AM6234_M4
```

## boards/ti/sk_am62/board.yml
```yaml
board:
  name: sk_am62
  full_name: SK-AM62 Evaluation board
  vendor: ti
  socs:
  - name: am6234
```

## boards/ti/sk_am62/sk_am62_am6234_a53_defconfig
```kconfig
# Texas Instruments Sitara AM62x-SK-A53 EVM
#
# Copyright (c) 2025 Texas Instruments Incorporated
# Copyright (c) 2025 Dave Paul Joseph
#
# SPDX-License-Identifier: Apache-2.0

# Zephyr Kernel Configuration
CONFIG_XIP=n

# Serial Driver
CONFIG_SERIAL=y

# Enable Console
CONFIG_CONSOLE=y
CONFIG_UART_CONSOLE=y
CONFIG_UART_INTERRUPT_DRIVEN=y
```

## boards/ti/sk_am62/sk_am62_am6254_a53_defconfig
```kconfig
# Texas Instruments Sitara AM62x-SK-A53 EVM
#
# Copyright (c) 2025 Texas Instruments Incorporated
# Copyright (c) 2025 Dave Paul Joseph
#
# SPDX-License-Identifier: Apache-2.0

# Zephyr Kernel Configuration
CONFIG_XIP=n

# Serial Driver
CONFIG_SERIAL=y

# Enable Console
CONFIG_CONSOLE=y
CONFIG_UART_CONSOLE=y
CONFIG_UART_INTERRUPT_DRIVEN=y

# ARM Options
CONFIG_AARCH64_IMAGE_HEADER=y
CONFIG_ARMV8_A_NS=y
CONFIG_ARM64_VA_BITS_36=y
CONFIG_ARM64_PA_BITS_36=y

# Cache Options
CONFIG_CACHE_MANAGEMENT=y
CONFIG_DCACHE_LINE_SIZE_DETECT=y
CONFIG_ICACHE_LINE_SIZE_DETECT=y

# Multicore Support
CONFIG_SMP=y
CONFIG_PM_CPU_OPS=y
CONFIG_MP_MAX_NUM_CPUS=4
```

## boards/ti/sk_am64/Kconfig.sk_am64
```kconfig
# Texas Instruments SK-AM64
#
# Copyright (c) 2025 Texas Instruments Incorporated
#
# SPDX-License-Identifier: Apache-2.0

config BOARD_SK_AM64
	select SOC_AM6442_M4 if BOARD_SK_AM64_AM6442_M4
	select SOC_AM6442_R5F0_0 if BOARD_SK_AM64_AM6442_R5F0_0
	select SOC_AM6442_R5F0_1 if BOARD_SK_AM64_AM6442_R5F0_1
	select SOC_AM6442_R5F1_0 if BOARD_SK_AM64_AM6442_R5F1_0
	select SOC_AM6442_R5F1_1 if BOARD_SK_AM64_AM6442_R5F1_1
```

## boards/ti/sk_am64/board.yml
```yaml
board:
  name: sk_am64
  full_name: SK-AM64
  vendor: ti
  socs:
  - name: am6442
```

## boards/ti/sk_am64/sk_am64_am6442_r5f0_0_defconfig
```kconfig
# Copyright (c) 2024 Texas Instruments Incorporated
#	Andrew Davis <afd@ti.com>
#
# SPDX-License-Identifier: Apache-2.0

# Zephyr Kernel Configuration
CONFIG_XIP=n
```

## boards/ti/sk_am64/sk_am64_am6442_r5f0_1_defconfig
```kconfig
# Copyright (c) 2024 Texas Instruments Incorporated
#	Andrew Davis <afd@ti.com>
#
# SPDX-License-Identifier: Apache-2.0

# Zephyr Kernel Configuration
CONFIG_XIP=n

# Enable OpenAMP resource table needed for remoteproc booting
CONFIG_OPENAMP_RSC_TABLE=y
```
