## boards/laird_connect/mg100/mg100_defconfig
```kconfig
# Copyright (c) 2022 Laird Connectivity
# SPDX-License-Identifier: Apache-2.0

# Enable MPU
CONFIG_ARM_MPU=y

# Enable GPIO
CONFIG_GPIO=y

# Enable uart driver
CONFIG_SERIAL=y

# Enable console
CONFIG_CONSOLE=y
CONFIG_UART_CONSOLE=y

# 32KHz clock source
CONFIG_CLOCK_CONTROL_NRF_K32SRC_XTAL=y
CONFIG_CLOCK_CONTROL_NRF_K32SRC_150PPM=y
```

## boards/laird_connect/pinnacle_100_dvk/board.yml
```yaml
board:
  name: pinnacle_100_dvk
  vendor: Laird Connectivity
  socs:
  - name: nrf52840
```

## boards/lairdconnect/bl5340_dvk/board.yml
```yaml
board:
  name: bl5340_dvk
  vendor: lairdconnect
  socs:
  - name: 'nrf5340'
    variants:
    - name: 'ns'
      cpucluster: 'cpuapp'
```

## boards/lairdconnect/bl652_dvk/Kconfig.defconfig
```kconfig
# BL652 DVK board configuration

# Copyright (c) 2019 Laird Connectivity
# SPDX-License-Identifier: Apache-2.0

if BOARD_BL652_DVK

config BT_CTLR
	default BT

if DAC

config I2C
	default y

endif # DAC

endif # BOARD_BL652_DVK
```

## boards/lairdconnect/bl653_dvk/bl653_dvk_nrf52833_defconfig
```kconfig
# SPDX-License-Identifier: Apache-2.0


# Enable MPU
CONFIG_ARM_MPU=y

# Enable RTT
CONFIG_USE_SEGGER_RTT=y

# enable GPIO
CONFIG_GPIO=y

# enable uart driver
CONFIG_SERIAL=y

# enable console
CONFIG_CONSOLE=y
CONFIG_UART_CONSOLE=y

# 32kHz clock source
CONFIG_CLOCK_CONTROL_NRF_K32SRC_RC=y
CONFIG_CLOCK_CONTROL_NRF_K32SRC_500PPM=y
```

## boards/lairdconnect/bl654_dvk/Kconfig
```kconfig
# BL654 DVK board configuration

# Copyright (c) 2019 Laird Connectivity
# SPDX-License-Identifier: Apache-2.0

config BOARD_ENABLE_DCDC
	bool "DCDC mode"
	select SOC_DCDC_NRF52X
	default y
	depends on BOARD_BL654_DVK
```

## boards/lairdconnect/bl654_dvk/Kconfig.defconfig
```kconfig
# BL654 DVK board configuration

# Copyright (c) 2019 Laird Connectivity
# SPDX-License-Identifier: Apache-2.0

if BOARD_BL654_DVK

config BT_CTLR
	default BT

if DAC

config I2C
	default y

endif # DAC

endif # BOARD_BL654_DVK
```

## boards/lairdconnect/bl654_dvk/board.yml
```yaml
board:
  name: bl654_dvk
  vendor: lairdconnect
  socs:
  - name: nrf52840
    variants:
    - name: pa
```

## boards/lairdconnect/bl654_sensor_board/Kconfig.bl654_sensor_board
```kconfig
# BL654 Sensor Board configuration

# Copyright (c) 2021 Laird Connectivity
# SPDX-License-Identifier: Apache-2.0

config BOARD_BL654_SENSOR_BOARD
	select SOC_NRF52840_QIAA
```

## boards/lairdconnect/bl654_sensor_board/board.yml
```yaml
board:
  name: bl654_sensor_board
  vendor: lairdconnect
  socs:
  - name: nrf52840
```

## boards/lairdconnect/bl654_usb/bl654_usb_nrf52840_defconfig
```kconfig
# SPDX-License-Identifier: Apache-2.0


# Enable MPU
CONFIG_ARM_MPU=y

# Enable uart driver
CONFIG_SERIAL=y

# Enable console
CONFIG_CONSOLE=y

# Enable GPIO
CONFIG_GPIO=y

# Enable USB
CONFIG_USB_DEVICE_STACK=y

# 32KHz clock source
CONFIG_CLOCK_CONTROL_NRF_K32SRC_XTAL=y
CONFIG_CLOCK_CONTROL_NRF_K32SRC_150PPM=y
```

## boards/lairdconnect/bt510/Kconfig.bt510
```kconfig
# BT510 DVK board configuration

# Copyright (c) 2020 Laird Connectivity
# SPDX-License-Identifier: Apache-2.0

config BOARD_BT510
	select SOC_NRF52840_QIAA
```

## boards/lairdconnect/bt510/Kconfig.defconfig
```kconfig
# BT510 Sensor configuration

# Copyright (c) 2020 Laird Connectivity
# SPDX-License-Identifier: Apache-2.0

if BOARD_BT510

config BT_CTLR
	default BT

config I2C
	default SENSOR

endif # BOARD_BT510
```

## boards/lairdconnect/pinnacle_100_dvk/Kconfig
```kconfig
# Pinnacle(TM) 100 DVK board configuration
#
# Copyright (c) 2020 Laird Connectivity
# SPDX-License-Identifier: Apache-2.0

config BOARD_ENABLE_DCDC
	bool "DCDC mode"
	select SOC_DCDC_NRF52X
	default y
	depends on BOARD_PINNACLE_100_DVK
```

## boards/lairdconnect/rm1xx_dvk/rm1xx_dvk_defconfig
```kconfig
# SPDX-License-Identifier: Apache-2.0

# enable GPIO
CONFIG_GPIO=y

# enable uart driver
CONFIG_SERIAL=y

# enable console
CONFIG_CONSOLE=y
CONFIG_UART_CONSOLE=y

CONFIG_PINCTRL=y
```

## boards/lckfb/skystar_gd32f407v/Kconfig.skystar_gd32f407v
```kconfig
# Copyright (c) 2025, Liu Changjie <liucj1228@outlook.com>
# SPDX-License-Identifier: Apache-2.0

config BOARD_SKYSTAR_GD32F407V
	select SOC_GD32F407
```

## boards/lckfb/skystar_gd32f407v/board.yml
```yaml
board:
  name: skystar_gd32f407v
  full_name: skystar_gd32f407v
  vendor: gd
  socs:
    - name: gd32f407
```

## boards/lilygo/t_deck/Kconfig
```kconfig
# SPDX-FileCopyrightText: Copyright The Zephyr Project Contributors
# SPDX-License-Identifier: Apache-2.0

config HEAP_MEM_POOL_ADD_SIZE_BOARD
	int
	default 4096 if BOARD_T_DECK_ESP32S3_PROCPU
	default 256 if BOARD_T_DECK_ESP32S3_APPCPU
```
