/*
 * Copyright (c) 2026 Norik Systems
 *
 * SPDX-License-Identifier: Apache-2.0
 */

/dts-v1/;

#include <nordic/nrf9151_ns_laca.dtsi>
#include "dect_nr_plus_usb_dongle_common.dtsi"

/ {
	chosen {
		zephyr,flash = &flash0;
		zephyr,sram = &sram0_ns_app;
		zephyr,code-partition = &slot0_ns_partition;
	};
};
