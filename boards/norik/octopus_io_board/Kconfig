## boards/norik/octopus_io_board/Kconfig
```kconfig
# Copyright (c) 2024 Norik Systems
# SPDX-License-Identifier: Apache-2.0

config BOARD_OCTOPUS_IO_BOARD
	select BOARD_LATE_INIT_HOOK
	select GPIO

module = OCTOPUS_IO_BOARD_CONTROL
module-str = Board Control
source "subsys/logging/Kconfig.template.log_config"
```

## boards/norik/octopus_io_board/Kconfig.octopus_io_board
```kconfig
# Copyright (c) 2024 Norik Systems
# SPDX-License-Identifier: Apache-2.0

config BOARD_OCTOPUS_IO_BOARD
	select SOC_NRF9160_SICA
```

## boards/norik/octopus_io_board/board.yml
```yaml
board:
  name: octopus_io_board
  full_name: Octopus IO-Board
  vendor: norik
  socs:
  - name: nrf9160
    variants:
    - name: 'ns'
```

## boards/norik/octopus_io_board/dts/bindings/norik,power-controller.yaml
```yaml
# Copyright (c) 2024 Norik Systems
# SPDX-License-Identifier: Apache-2.0

description: |
  This binding is used for controlling battery charger and
  LDO regulator on the Octopus IO Board.

compatible: "norik,power-controller"

include: base.yaml

properties:
  debounce-interval-ms:
    type: int
    default: 30
    description: |
        Debouncing interval time in milliseconds.
        If not specified defaults to 30.

  polling-mode:
    type: boolean
    description: |
      Do not use interrupts for the key GPIOs, poll the pin periodically at the
      specified debounce-interval-ms instead.

child-binding:
  description: Child Node for the power controller
  properties:
    gpios:
      type: phandle-array
      required: true

    label:
      type: string
      description: Descriptive name of the gpio

    zephyr,code:
      type: int
      description: Key code to emit.
```

## boards/norik/octopus_io_board/dts/bindings/norik,sim_select.yaml
```yaml
# Copyright (c) 2024 Norik Systems
# SPDX-License-Identifier: Apache-2.0

description: |
  The Octopus SoM provides the user 2 options for connecting
  a SIM card to the nRF9160. Option one is to use on-board eSIM or
  external nano SIM. Which SIM is used can be selected using the 'sim'
  property of the 'sim_select' dt node.

compatible: "norik,sim_select"

include: base.yaml

properties:
  sim-gpios:
    type: phandle-array
    required: true
    description: Pin used to select which SIM is used

  sim:
    type: string
    required: true
    enum:
      - "on-board"
      - "external"
    description: SIM choice (on-board eSIM or external nano SIM)
```

## boards/norik/octopus_som/Kconfig
```kconfig
# Copyright (c) 2024 Norik Systems
# SPDX-License-Identifier: Apache-2.0

config BOARD_OCTOPUS_SOM
	select BOARD_LATE_INIT_HOOK
	select GPIO

module = OCTOPUS_SOM_CONTROL
module-str = Board Control
source "subsys/logging/Kconfig.template.log_config"
```

## boards/norik/octopus_som/board.yml
```yaml
board:
  name: octopus_som
  full_name: Octopus SoM
  vendor: norik
  socs:
  - name: nrf9160
    variants:
    - name: 'ns'
```

## boards/nrf51_pca10028/Kconfig.defconfig
```kconfig
# Kconfig - nRF51 PCA10028 board configuration
#
# Copyright (c) 2016 Linaro Limited.
#
# Licensed under the Apache License, Version 2.0 (the "License");
# you may not use this file except in compliance with the License.
# You may obtain a copy of the License at
#
#     http://www.apache.org/licenses/LICENSE-2.0
#
# Unless required by applicable law or agreed to in writing, software
# distributed under the License is distributed on an "AS IS" BASIS,
# WITHOUT WARRANTIES OR CONDITIONS OF ANY KIND, either express or implied.
# See the License for the specific language governing permissions and
# limitations under the License.

if BOARD_NRF51_PCA10028

config BOARD
	default nrf51_pca10028

if UART_NRF5

config GPIO
	default y

config GPIO_NRF5
	default y

config GPIO_NRF5_P0
	default y

endif # UART_NRF5

endif # BOARD_NRF51_PCA10028
```

## boards/nrf52_nitrogen/nrf52_nitrogen_defconfig
```kconfig
CONFIG_ARM=y
CONFIG_BOARD_NRF52_NITROGEN=y
CONFIG_SOC_FAMILY_NRF5=y
CONFIG_SOC_SERIES_NRF52X=y
CONFIG_SYS_CLOCK_HW_CYCLES_PER_SEC=64000000
CONFIG_CORTEX_M_SYSTICK=y
CONFIG_FLASH_SIZE=512
CONFIG_SRAM_SIZE=64
CONFIG_XIP=y

# enable uart driver
CONFIG_SERIAL=y
CONFIG_UART_NRF5=y
CONFIG_UART_NRF5_GPIO_TX_PIN=13
CONFIG_UART_NRF5_GPIO_RX_PIN=15

# enable console
CONFIG_CONSOLE=y
CONFIG_UART_CONSOLE=y

# additional board options
CONFIG_GPIO_AS_PINRESET=y

# bluetooth
CONFIG_BLUETOOTH=y
CONFIG_BLUETOOTH_CONTROLLER=y
```

## boards/nucleo_f103rb/nucleo_f103rb_defconfig
```kconfig
CONFIG_ARM=y
CONFIG_BOARD_NUCLEO_F103RB=y
CONFIG_SOC_STM32=y
CONFIG_SOC_STM32F1X=y
CONFIG_SOC_STM32F103RB=y
CONFIG_CORTEX_M_SYSTICK=y
# 36MHz system clock
CONFIG_SYS_CLOCK_HW_CYCLES_PER_SEC=36000000

# enable uart driver
CONFIG_SERIAL=y
CONFIG_UART_STM32=y
# enable USART2 - passthrough to STLINK v2 connector
CONFIG_UART_STM32_PORT_1=y
CONFIG_UART_STM32_PORT_1_BAUD_RATE=9600
# enable console on this port by default
CONFIG_CONSOLE=y
CONFIG_UART_CONSOLE=y
CONFIG_UART_CONSOLE_ON_DEV_NAME="UART_1"

# enable pinmux
CONFIG_PINMUX=y
CONFIG_PINMUX_BASE=0
CONFIG_PINMUX_STM32=y

# enable GPIO ports A, B, C
CONFIG_GPIO=y
CONFIG_GPIO_STM32=y
CONFIG_GPIO_STM32_PORTA=y
CONFIG_GPIO_STM32_PORTB=y
CONFIG_GPIO_STM32_PORTC=y

# configure clocks to get 36MHz on APB1 and APB2
CONFIG_CLOCK_CONTROL=y
CONFIG_CLOCK_CONTROL_STM32F10X=y
CONFIG_CLOCK_STM32F10X_SYSCLK_SRC_PLL=y
CONFIG_CLOCK_STM32F10X_PLL_SRC_HSI=y
CONFIG_CLOCK_STM32F10X_PLL_MULTIPLIER=9
CONFIG_CLOCK_STM32F10X_AHB_PRESCALER=0
CONFIG_CLOCK_STM32F10X_APB1_PRESCALER=0
CONFIG_CLOCK_STM32F10X_APB2_PRESCALER=0
```

## boards/nucode/nucode_nu32/Kconfig.defconfig
```kconfig
# NUCODE NU32 board configuration

# Copyright (c) 2026 NUCODE Co., Ltd.
# SPDX-License-Identifier: Apache-2.0

if BOARD_NUCODE_NU32

config HW_STACK_PROTECTION
	default ARCH_HAS_STACK_PROTECTION

endif # BOARD_NUCODE_NU32
```

## boards/nucode/nucode_nu32/Kconfig.nucode_nu32
```kconfig
# NUCODE NU32 board configuration

# Copyright (c) 2026 NUCODE Co., Ltd.
# SPDX-License-Identifier: Apache-2.0

config BOARD_NUCODE_NU32
	select SOC_NRF52832_QFAA
```

## boards/nucode/nucode_nu32/board.yml
```yaml
board:
  name: nucode_nu32
  full_name: NUCODE NU32
  vendor: nucode
  socs:
  - name: nrf52832
```

## boards/nucode/nucode_nu32/nucode_nu32_nrf52832_defconfig
```kconfig
# SPDX-License-Identifier: Apache-2.0

# Enable MPU
CONFIG_ARM_MPU=y

# Use the internal low-frequency RC oscillator by default.
CONFIG_CLOCK_CONTROL_NRF_K32SRC_RC=y

# Enable GPIO
CONFIG_GPIO=y

# Enable UART driver
CONFIG_SERIAL=y

# Enable console
CONFIG_CONSOLE=y
CONFIG_UART_CONSOLE=y
```

## boards/nucode/nucode_nu40/Kconfig
```kconfig
# NUCODE NU40 board configuration

# Copyright (c) 2026 NUCODE Co., Ltd.
# SPDX-License-Identifier: Apache-2.0

config BOARD_NUCODE_NU40
	select BOARD_EARLY_INIT_HOOK

config BOARD_HAS_NRF5_BOOTLOADER
	bool
	default y if !BOARD_NUCODE_NU40_NRF52840_BARE
	help
	  If selected, applications are linked so that they can be loaded by the
	  onboard UF2 bootloader (Adafruit nRF52 fork).
```

## boards/nucode/nucode_nu40/Kconfig.defconfig
```kconfig
# NUCODE NU40 board configuration

# Copyright (c) 2026 NUCODE Co., Ltd.
# SPDX-License-Identifier: Apache-2.0

if BOARD_NUCODE_NU40

config HW_STACK_PROTECTION
	default ARCH_HAS_STACK_PROTECTION

# To let the onboard UF2 bootloader load an application, the application
# must be linked after the bootloader's MBR region.
#
# If the application wants to use the full partition size, use the "bare"
# board variant instead.

config FLASH_LOAD_OFFSET
	default 0x1000
	depends on BOARD_HAS_NRF5_BOOTLOADER && !USE_DT_CODE_PARTITION

source "boards/common/usb/Kconfig.cdc_acm_serial.defconfig"

endif # BOARD_NUCODE_NU40
```

## boards/nucode/nucode_nu40/Kconfig.nucode_nu40
```kconfig
# NUCODE NU40 board configuration

# Copyright (c) 2026 NUCODE Co., Ltd.
# SPDX-License-Identifier: Apache-2.0

config BOARD_NUCODE_NU40
	select SOC_NRF52840_QIAA
```

## boards/nucode/nucode_nu40/board.yml
```yaml
board:
  name: nucode_nu40
  full_name: NUCODE NU40
  vendor: nucode
  socs:
  - name: nrf52840
    variants:
    - name: bare
```

## boards/nuvoton/nct6694b_evb/Kconfig.nct6694b_evb
```kconfig
# Copyright (c) 2025 Nuvoton Technology Corporation.
# SPDX-License-Identifier: Apache-2.0

config BOARD_NCT6694B_EVB
	bool "Nuvoton NCT6694B EVB Development board"
	select SOC_NCT6694B
```

## boards/nuvoton/nct6694b_evb/nct6694b_evb_defconfig
```kconfig
#
# Copyright (c) 2025 Nuvoton Technology Corporation.
#
# SPDX-License-Identifier: Apache-2.0
#

CONFIG_SRAM_VECTOR_TABLE=y
CONFIG_BOOTLOADER_SRAM_SIZE=0
# General Kernel Options
CONFIG_SYS_CLOCK_HW_CYCLES_PER_SEC=96000000
CONFIG_XIP=y
CONFIG_DEVICE_MUTABLE=y

# CONFIG_ARM_MPU=y
# CONFIG_NCT_ITIM_SYSTICK=y

# Clock Driver
CONFIG_CLOCK_CONTROL=y
CONFIG_CLOCK_CONTROL_NCT=y

# Pinctrl Driver
CONFIG_PINCTRL=y
CONFIG_PINCTRL_NCT=y

# UART Driver
CONFIG_SERIAL=y
CONFIG_UART_INTERRUPT_DRIVEN=y
CONFIG_UART_NCT=y

# Console Driver
CONFIG_CONSOLE=y
CONFIG_UART_CONSOLE=y

# GPIO Driver
CONFIG_GPIO=y
CONFIG_GPIO_NCT=y

# MIWU Driver
CONFIG_NCT_MIWU=y

# Flash Driver
CONFIG_FLASH=y
CONFIG_FLASH_SHELL=y
CONFIG_FLASH_NCT_NOR=y
CONFIG_FLASH_NCT_SPIM_QSPI=y
CONFIG_FLASH_NCT_FIU_QSPI=y
CONFIG_FLASH_NCT_SPIP_QSPI=y

# SPI Driver
CONFIG_SPI=y
CONFIG_SPI_SHELL=y
CONFIG_SPI_NCT_SPIP=y

# ESPI Driver
CONFIG_ESPI=y
CONFIG_ESPI_NCT=y

# Watchdog Driver
CONFIG_WATCHDOG=y
CONFIG_WDT_NCT=y

# ADC Driver
CONFIG_ADC=y
CONFIG_ADC_NCT=y

# I2C Driver
CONFIG_I2C=y
CONFIG_I2C_NCT=y

# USBD Driver
CONFIG_USB_DEVICE_DRIVER=y
CONFIG_USB_DC_NCT=y

# USBH Driver
CONFIG_USBH_OHCI=n
CONFIG_USBH_HID=n

# EMAC Driver
CONFIG_ETH_NCT=y

# Networking config
CONFIG_NETWORKING=y
CONFIG_NET_L2_ETHERNET=y
CONFIG_NET_IPV4=y
CONFIG_NET_IPV6=n
CONFIG_NET_TCP=y
CONFIG_NET_SOCKETS=y
CONFIG_POSIX_API=y
CONFIG_NET_SHELL=y

# Network driver config
CONFIG_TEST_RANDOM_GENERATOR=y

# Counter Driver
CONFIG_COUNTER=y
CONFIG_COUNTER_SHELL=y
CONFIG_COUNTER_NCT_ITIM32=y

# TACH Driver
CONFIG_SENSOR=y
CONFIG_SENSOR_SHELL=y
CONFIG_TACH_NCT=y

# PWM Driver
CONFIG_PWM=y
CONFIG_PWM_SHELL=y
CONFIG_PWM_NCT=y

#I3C Driver
CONFIG_I3C=y
CONFIG_I3C_USE_IBI=y
CONFIG_I3C_SHELL=y
CONFIG_I3C_NCT=y

# C2H Driver
CONFIG_C2H_NCT=y

# RTC Driver
CONFIG_RTC=y
CONFIG_RTC_ALARM=y
CONFIG_RTC_NCT=y
```

## boards/nuvoton/nct6832d_mdb/Kconfig.nct6832d_mdb
```kconfig
# Copyright (c) 2025 Nuvoton Technology Corporation.
# SPDX-License-Identifier: Apache-2.0

config BOARD_NCT6832D_MDB
	bool "Nuvoton NCT6832D MDB Development board"
	select SOC_NCT6832D
```

## boards/nuvoton/npck3m8k_evb/Kconfig.npck3m8k_evb
```kconfig
# Copyright (c) 2025 Nuvoton Technology Corporation.
# SPDX-License-Identifier: Apache-2.0

config BOARD_NPCK3M8K_EVB
	select SOC_NPCK3M8K
```
