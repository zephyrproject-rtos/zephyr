/*
 * Copyright (c) 2024 Norik Systems
 * SPDX-License-Identifier: Apache-2.0
 */

/dts-v1/;
#include <nordic/nrf9160ns_sica.dtsi>
#include "octopus_som_common.dtsi"

/ {
	chosen {
		zephyr,flash = &flash0;
		zephyr,sram = &sram0_ns_app;
		zephyr,code-partition = &slot0_ns_partition;
	};
};
