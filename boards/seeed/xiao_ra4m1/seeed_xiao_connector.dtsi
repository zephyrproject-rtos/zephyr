/*
 * Copyright (c) 2025 Pete Johanson
 *
 * SPDX-License-Identifier: Apache-2.0
 */

/ {
	xiao_d: connector {
		compatible = "seeed,xiao-gpio";
		#gpio-cells = <2>;
		gpio-map-mask = <0xffffffff 0xffffffc0>;
		gpio-map-pass-thru = <0 0x3f>;
		gpio-map
			= <0 0 &ioport0 14 0>		/* D0 */
			, <1 0 &ioport0 0 0>		/* D1 */
			, <2 0 &ioport0 1 0>		/* D2 */
			, <3 0 &ioport0 2 0>		/* D3 */
			, <4 0 &ioport2 6 0>		/* D4 */
			, <5 0 &ioport1 0 0>		/* D5 */
			, <6 0 &ioport3 2 0>		/* D6 */
			, <7 0 &ioport3 1 0>		/* D7 */
			, <8 0 &ioport1 11 0>		/* D8 */
			, <9 0 &ioport1 10 0>		/* D9 */
			, <10 0 &ioport1 9 0>		/* D10 */
			;
	};
};

xiao_spi: &spi1 {};

xiao_serial: &uart0 {};
