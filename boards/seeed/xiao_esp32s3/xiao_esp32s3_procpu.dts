/*
 * Copyright (c) 2023 Seeed Studio inc.
 *
 * SPDX-License-Identifier: Apache-2.0
 */

/dts-v1/;

#include "xiao_esp32s3_procpu_common.dtsi"
#include "xiao_esp32s3-pinctrl.dtsi"
#include "seeed_xiao_connector.dtsi"
#include <espressif/partitions_0x0_amp.dtsi>

/ {
	model = "Seeed Xiao ESP32S3 PROCPU";
	compatible = "seeed,xiao-esp32s3";
};
