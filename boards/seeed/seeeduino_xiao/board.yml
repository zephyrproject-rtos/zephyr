## boards/seeed/seeeduino_xiao/board.yml
```yaml
board:
  name: seeeduino_xiao
  full_name: Seeeduino XIAO
  vendor: seeed
  socs:
    - name: samd21g18a
```

## boards/seeed/wio_terminal/Kconfig.defconfig
```kconfig
# Copyright (c) 2023 Joel Guittet
# Wio Terminal  board configuration

# SPDX-License-Identifier: Apache-2.0

source "boards/common/usb/Kconfig.cdc_acm_serial.defconfig"
```

## boards/seeed/wio_terminal/Kconfig.wio_terminal
```kconfig
# Copyright (c) 2023 Joel Guittet
# Copyright (c) 2024 Gerson Fernando Budke <nandojve@gmail.com>
# SPDX-License-Identifier: Apache-2.0

config BOARD_WIO_TERMINAL
	select SOC_SAMD51P19A
```

## boards/seeed/wio_terminal/board.yml
```yaml
board:
  name: wio_terminal
  full_name: Wio Terminal
  vendor: seeed
  socs:
    - name: samd51p19a
```

## boards/seeed/wio_terminal/wio_terminal_defconfig
```kconfig
# Copyright (c) 2023 Joel Guittet
# Copyright (c) 2024 Gerson Fernando Budke <nandojve@gmail.com>
# SPDX-License-Identifier: Apache-2.0

CONFIG_SOC_ATMEL_SAMD5X_XOSC32K=y
CONFIG_SOC_ATMEL_SAMD5X_XOSC32K_AS_MAIN=y

CONFIG_ARM_MPU=y
CONFIG_CORTEX_M_SYSTICK=y
CONFIG_HW_STACK_PROTECTION=y
CONFIG_REGULATOR=y

# BOSSA bootloader
CONFIG_BOOTLOADER_BOSSA=y
CONFIG_BOOTLOADER_BOSSA_ADAFRUIT_UF2=y
CONFIG_BUILD_OUTPUT_UF2=y
```

## boards/seeed/wio_tracker_l1/Kconfig.defconfig
```kconfig
# Copyright (c) 2026 Carlo Caione <ccaione@baylibre.com>
# SPDX-License-Identifier: Apache-2.0

if BOARD_WIO_TRACKER_L1

source "boards/common/usb/Kconfig.cdc_acm_serial.defconfig"

endif # BOARD_WIO_TRACKER_L1
```

## boards/seeed/wio_tracker_l1/Kconfig.wio_tracker_l1
```kconfig
# Copyright (c) 2026 Carlo Caione <ccaione@baylibre.com>
# SPDX-License-Identifier: Apache-2.0

config BOARD_WIO_TRACKER_L1
	select SOC_NRF52840_QIAA
```

## boards/seeed/wio_tracker_l1/board.yml
```yaml
# Copyright (c) 2026 Carlo Caione <ccaione@baylibre.com>
# SPDX-License-Identifier: Apache-2.0

board:
  name: wio_tracker_l1
  full_name: Wio Tracker L1
  vendor: seeed
  socs:
  - name: nrf52840
```

## boards/seeed/wio_tracker_l1/wio_tracker_l1_defconfig
```kconfig
# Copyright (c) 2026 Carlo Caione <ccaione@baylibre.com>
# SPDX-License-Identifier: Apache-2.0

CONFIG_ARM_MPU=y
CONFIG_HW_STACK_PROTECTION=y

CONFIG_GPIO=y
CONFIG_SERIAL=y
CONFIG_CONSOLE=y

# Build a UF2 image for the Adafruit nRF52 bootloader and lay code at the
# bootloader-compatible offset.
CONFIG_BUILD_OUTPUT_UF2=y
CONFIG_USE_DT_CODE_PARTITION=y
```

## boards/seeed/wio_wm1110_dev_kit/Kconfig.wio_wm1110_dev_kit
```kconfig
# Copyright (c) 2025 Ishraq Ibne Ashraf <ishraq.i.ashraf@gmail.com>
#
# SPDX-License-Identifier: Apache-2.0

config BOARD_WIO_WM1110_DEV_KIT
	select SOC_NRF52840_QIAA
```

## boards/seeed/wio_wm1110_dev_kit/board.yml
```yaml
# Copyright (c) 2025 Ishraq Ibne Ashraf <ishraq.i.ashraf@gmail.com>
#
# SPDX-License-Identifier: Apache-2.0

board:
  name: wio_wm1110_dev_kit
  full_name: Wio-WM1110 Dev Kit
  vendor: seeed
  socs:
  - name: nrf52840
```

## boards/seeed/wio_wm1110_dev_kit/wio_wm1110_dev_kit_defconfig
```kconfig
# Copyright (c) 2025 Ishraq Ibne Ashraf <ishraq.i.ashraf@gmail.com>
#
# SPDX-License-Identifier: Apache-2.0

CONFIG_GPIO=y
CONFIG_SERIAL=y
CONFIG_ARM_MPU=y
CONFIG_CONSOLE=y
CONFIG_UART_CONSOLE=y
```

## boards/seeed/xiao_ble/Kconfig.defconfig
```kconfig
# XIAO BLE board configuration

# Copyright (c) 2022 Marcin Niestroj
# SPDX-License-Identifier: Apache-2.0

if BOARD_XIAO_BLE

source "boards/common/usb/Kconfig.cdc_acm_serial.defconfig"

endif # BOARD_XIAO_BLE
```

## boards/seeed/xiao_ble/Kconfig.xiao_ble
```kconfig
# XIAO BLE board configuration

# Copyright (c) 2022 Marcin Niestroj
# SPDX-License-Identifier: Apache-2.0

config BOARD_XIAO_BLE
	select SOC_NRF52840_QIAA
```

## boards/seeed/xiao_ble/board.yml
```yaml
board:
  name: xiao_ble
  full_name: XIAO BLE (Sense)
  vendor: seeed
  socs:
  - name: nrf52840
    variants:
    - name: 'sense'
```

## boards/seeed/xiao_ble/xiao_ble_nrf52840_sense_defconfig
```kconfig
# SPDX-License-Identifier: Apache-2.0

# Enable MPU
CONFIG_ARM_MPU=y

# Enable hardware stack protection
CONFIG_HW_STACK_PROTECTION=y

# Enable GPIO
CONFIG_GPIO=y

# Enable UART driver
CONFIG_SERIAL=y

# Enable console
CONFIG_CONSOLE=y

# Logger cannot use itself to log
CONFIG_USB_CDC_ACM_LOG_LEVEL_OFF=y

# Build UF2 by default, supported by the Adafruit nRF52 Bootloader
CONFIG_BUILD_OUTPUT_UF2=y
CONFIG_USE_DT_CODE_PARTITION=y

# Required to enable LSM6DS3TR-C power
CONFIG_REGULATOR=y
```

## boards/seeed/xiao_esp32c3/Kconfig.xiao_esp32c3
```kconfig
# Copyright 2022 Google LLC
# SPDX-License-Identifier: Apache-2.0

config BOARD_XIAO_ESP32C3
	select SOC_ESP32C3_FX4
```

## boards/seeed/xiao_esp32c3/board.yml
```yaml
board:
  name: xiao_esp32c3
  full_name: XIAO ESP32C3
  vendor: seeed
  socs:
  - name: esp32c3
```

## boards/seeed/xiao_esp32c5/Kconfig
```kconfig
# SPDX-FileCopyrightText: Copyright The Zephyr Project Contributors
# SPDX-License-Identifier: Apache-2.0

config HEAP_MEM_POOL_ADD_SIZE_BOARD
	int
	default 4096 if BOARD_XIAO_ESP32C5_ESP32C5_HPCORE
	default 256 if BOARD_XIAO_ESP32C5_ESP32C5_LPCORE
```

## boards/seeed/xiao_esp32c5/Kconfig.xiao_esp32c5
```kconfig
# Seeed XIAO ESP32C5 board configuration

# SPDX-FileCopyrightText: Copyright The Zephyr Project Contributors
# SPDX-License-Identifier: Apache-2.0

config BOARD_XIAO_ESP32C5
	select SOC_ESP32_C5_WROOM_1_N8R8
	select SOC_ESP32C5_HPCORE if BOARD_XIAO_ESP32C5_ESP32C5_HPCORE
	select SOC_ESP32C5_LPCORE if BOARD_XIAO_ESP32C5_ESP32C5_LPCORE
```

## boards/seeed/xiao_esp32c5/board.yml
```yaml
board:
  name: xiao_esp32c5
  full_name: XIAO ESP32C5
  vendor: seeed
  socs:
  - name: esp32c5
```

## boards/seeed/xiao_esp32c6/Kconfig
```kconfig
# Copyright (c) 2024 Mario Paja
# SPDX-License-Identifier: Apache-2.0

config HEAP_MEM_POOL_ADD_SIZE_BOARD
	int
	default 4096 if BOARD_XIAO_ESP32C6_ESP32C6_HPCORE
	default 256 if BOARD_XIAO_ESP32C6_ESP32C6_LPCORE

config XIAO_ESP32C6_EXT_ANTENNA
	bool "XIAO ESP32C6 external antenna configuration"
	depends on BOARD_XIAO_ESP32C6_ESP32C6_HPCORE
	select BOARD_LATE_INIT_HOOK
```

## boards/seeed/xiao_esp32c6/Kconfig.xiao_esp32c6
```kconfig
# XIAO ESP32C6 board configuration

# Copyright (c) 2024 Mario Paja
# SPDX-License-Identifier: Apache-2.0

config BOARD_XIAO_ESP32C6
	select SOC_ESP32_C6_WROOM_1U_N4
	select SOC_ESP32C6_HPCORE if BOARD_XIAO_ESP32C6_ESP32C6_HPCORE
	select SOC_ESP32C6_LPCORE if BOARD_XIAO_ESP32C6_ESP32C6_LPCORE
```

## boards/seeed/xiao_esp32c6/board.yml
```yaml
board:
  name: xiao_esp32c6
  full_name: XIAO ESP32C6
  vendor: seeed
  socs:
  - name: esp32c6
```
