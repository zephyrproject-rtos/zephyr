/*
 * SPDX-FileCopyrightText: Copyright The Zephyr Project Contributors
 * SPDX-License-Identifier: Apache-2.0
 */

/ {
	xiao_plus_d: xiao-plus-connector {
		compatible = "seeed,xiao-plus-gpio";
		#gpio-cells = <2>;
		gpio-map-mask = <0xffffffff 0xffffffc0>;
		gpio-map-pass-thru = <0 0x3f>;
		gpio-map = <11 0 &gpio0 15 0>,	/* D11 */
			   <12 0 &gpio0 19 0>,	/* D12 */
			   <13 0 &gpio1 1 0>,	/* D13 */
			   <14 0 &gpio0 9 0>,	/* D14 (NFC1) */
			   <15 0 &gpio0 10 0>,	/* D15 (NFC2) */
			   <16 0 &gpio0 31 0>,	/* D16 (battery voltage divider) */
			   <17 0 &gpio1 3 0>,	/* D17 */
			   <18 0 &gpio1 5 0>,	/* D18 */
			   <19 0 &gpio1 7 0>;	/* D19 */
	};
};

xiao_plus_spi: &spi2 {};

xiao_plus_serial: &uart1 {};
