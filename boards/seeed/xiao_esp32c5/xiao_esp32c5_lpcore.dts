/*
 * SPDX-FileCopyrightText: Copyright The Zephyr Project Contributors
 * SPDX-License-Identifier: Apache-2.0
 */
/dts-v1/;

#include <espressif/esp32c5/esp32c5_lpcore.dtsi>
#include <espressif/partitions_0x2000_default_8M.dtsi>

/ {
	model = "Seeed XIAO ESP32C5 LP Core";
	compatible = "seeed,xiao-esp32c5";

	chosen {
		zephyr,flash = &flash0;
		zephyr,sram = &sramlp;
		zephyr,code-partition = &slot0_lpcore_partition;
		zephyr,console = &lp_uart;
		zephyr,shell-uart = &lp_uart;
	};
};

&flash0 {
	reg = <0x0 DT_SIZE_M(8)>;
	ranges = <0x0 0x0 DT_SIZE_M(8)>;
};

&lp_uart {
	status = "okay";
	current-speed = <115200>;
};
