## boards/seeed/xiao_esp32c6/dts/bindings/seeed,xiao-gpio-rf-switch.yaml
```yaml
# Copyright (c) 2025 Mario Paja
# SPDX-License-Identifier: Apache-2.0

description: |
  Group of GPIO-controlled relays used to enable an RF switch and select the active antenna.

compatible: "seeed,xiao-gpio-rf-switch"

properties:
  enable-gpios:
    type: phandle-array
    required: true
    description: |
      GPIOs to enable the RF switch module.

  select-gpios:
    type: phandle-array
    required: true
    description: |
      GPIOs to select the active antenna
```

## boards/seeed/xiao_esp32s3/Kconfig
```kconfig
# Copyright (c) 2023 Seeed Studio inc.
# SPDX-License-Identifier: Apache-2.0

config HEAP_MEM_POOL_ADD_SIZE_BOARD
	int
	default 4096 if BOARD_XIAO_ESP32S3_ESP32S3_PROCPU
	default 256 if BOARD_XIAO_ESP32S3_ESP32S3_APPCPU
```

## boards/seeed/xiao_esp32s3/Kconfig.defconfig
```kconfig
# Copyright (c) 2023 Seeed Studio inc.
# SPDX-License-Identifier: Apache-2.0

if BOARD_XIAO_ESP32S3_ESP32S3_PROCPU

config HEAP_MEM_POOL_ADD_SIZE_BOARD
	int
	default 8192

endif # BOARD_XIAO_ESP32S3_ESP32S3_PROCPU

if BOARD_XIAO_ESP32S3_ESP32S3_APPCPU

config HEAP_MEM_POOL_ADD_SIZE_BOARD
	default 256

endif # BOARD_XIAO_ESP32S3_ESP32S3_APPCPU
```

## boards/seeed/xiao_esp32s3/Kconfig.sysbuild
```kconfig
# Copyright (c) 2023 Espressif Systems (Shanghai) Co., Ltd.
# SPDX-License-Identifier: Apache-2.0

choice BOOTLOADER
	default BOOTLOADER_MCUBOOT
endchoice

choice BOOT_SIGNATURE_TYPE
	default BOOT_SIGNATURE_TYPE_NONE
endchoice
```

## boards/seeed/xiao_esp32s3/Kconfig.xiao_esp32s3
```kconfig
# XIAO ESP32S3 board configuration

# Copyright (c) 2023 Seeed Studio inc.
# SPDX-License-Identifier: Apache-2.0

config BOARD_XIAO_ESP32S3
	select SOC_ESP32S3_WROOM_N8R8
	select SOC_ESP32S3_PROCPU if BOARD_XIAO_ESP32S3_ESP32S3_PROCPU || BOARD_XIAO_ESP32S3_ESP32S3_PROCPU_SENSE
	select SOC_ESP32S3_APPCPU if BOARD_XIAO_ESP32S3_ESP32S3_APPCPU
```

## boards/seeed/xiao_esp32s3/xiao_esp32s3_procpu_sense_defconfig
```kconfig
# SPDX-License-Identifier: Apache-2.0

CONFIG_CONSOLE=y
CONFIG_SERIAL=y
CONFIG_UART_CONSOLE=y
CONFIG_GPIO=y

# Camera (OV2640) support requires external SPIRAM
CONFIG_ESP_SPIRAM=y
CONFIG_SPIRAM_MODE_OCT=y

# Enable I2C for camera sensor communication
CONFIG_I2C=y

# Enable DMA for camera data transfer
CONFIG_DMA=y
```

## boards/seeed/xiao_mg24/Kconfig.defconfig
```kconfig
# Copyright (c) 2020 Piotr Mienkowski
# Copyright (c) 2020 TriaGnoSys GmbH
# Copyright (c) 2025 Pete Johanson
# SPDX-License-Identifier: Apache-2.0

if BOARD_XIAO_MG24

config LOG_BACKEND_SWO_FREQ_HZ
	default 875000
	depends on LOG_BACKEND_SWO

if SOC_GECKO_USE_RAIL

config FPU
	default y

endif # SOC_GECKO_USE_RAIL

if BT

# Used to enable RF switch and selection
config GPIO_HOGS
	default y

config FPU
	default y

config MAIN_STACK_SIZE
	default 3072 if PM
	default 2304

endif # BT

endif # BOARD_XIAO_MG24
```

## boards/seeed/xiao_mg24/Kconfig.xiao_mg24
```kconfig
# Copyright (c) 2020 Piotr Mienkowski
# Copyright (c) 2020 TriaGnoSys GmbH
# Copyright (c) 2025 Pete Johanson
# SPDX-License-Identifier: Apache-2.0

config BOARD_XIAO_MG24
	select SOC_EFR32MG24B220F1536IM48
```

## boards/seeed/xiao_mg24/board.yml
```yaml
board:
  name: xiao_mg24
  full_name: XIAO MG24
  vendor: seeed
  socs:
    - name: efr32mg24b220f1536im48
```

## boards/seeed/xiao_nrf54l15/Kconfig.defconfig
```kconfig
# Copyright (c) 2025 Seeed Technology Co., Ltd.
# SPDX-License-Identifier: Apache-2.0
if BOARD_XIAO_NRF54L15_NRF54L15_CPUAPP

config HAS_BT_CTLR
	default BT

endif # BOARD_XIAO_NRF54L15_NRF54L15_CPUAPP
```

## boards/seeed/xiao_nrf54l15/Kconfig.xiao_nrf54l15
```kconfig
# Copyright (c) 2025 Seeed Technology Co., Ltd.
# SPDX-License-Identifier: Apache-2.0
config BOARD_XIAO_NRF54L15
	select SOC_NRF54L15_CPUAPP if BOARD_XIAO_NRF54L15_NRF54L15_CPUAPP
	select SOC_NRF54L15_CPUFLPR if \
		BOARD_XIAO_NRF54L15_NRF54L15_CPUFLPR || \
		BOARD_XIAO_NRF54L15_NRF54L15_CPUFLPR_XIP
```

## boards/seeed/xiao_nrf54l15/xiao_nrf54l15_nrf54l15_cpuapp_defconfig
```kconfig
# Copyright (c) 2025 Seeed Technology Co., Ltd.
# SPDX-License-Identifier: Apache-2.0
# Enable UART driver
CONFIG_SERIAL=y

# Enable console
CONFIG_CONSOLE=y
CONFIG_UART_CONSOLE=y
CONFIG_PM_DEVICE=y
CONFIG_NRFX_POWER=y

# Enable GPIO
CONFIG_GPIO=y

CONFIG_ARM_MPU=y
CONFIG_HW_STACK_PROTECTION=y

CONFIG_NULL_POINTER_EXCEPTION_DETECTION_NONE=y

CONFIG_CACHE_MANAGEMENT=y
CONFIG_EXTERNAL_CACHE=y

CONFIG_NRF_GRTC_START_SYSCOUNTER=y

CONFIG_REGULATOR=y
CONFIG_REGULATOR_FIXED_INIT_PRIORITY=45
```

## boards/seeed/xiao_nrf54l15/xiao_nrf54l15_nrf54l15_cpuflpr_defconfig
```kconfig
# Copyright (c) 2025 Seeed Technology Co., Ltd.
# SPDX-License-Identifier: Apache-2.0

# Enable GPIO
CONFIG_GPIO=y

CONFIG_USE_DT_CODE_PARTITION=y

# Execute from SRAM
CONFIG_XIP=n

# Use internal LFCLK
CONFIG_CLOCK_CONTROL_NRF_K32SRC_RC=y
```

## boards/seeed/xiao_nrf54lm20a/xiao_nrf54lm20a_nrf54lm20a_cpuflpr_defconfig
```kconfig
# Copyright (c) 2025 Seeed Technology Co., Ltd.
# SPDX-License-Identifier: Apache-2.0

# Enable GPIO
CONFIG_GPIO=y

# Execute from SRAM
CONFIG_XIP=n
```

## boards/seeed/xiao_ra4m1/Kconfig.xiao_ra4m1
```kconfig
# Copyright (c) 2025 Pete Johanson
# SPDX-License-Identifier: Apache-2.0

config BOARD_XIAO_RA4M1
	select SOC_R7FA4M1AB3CNE
```

## boards/seeed/xiao_ra4m1/board.yml
```yaml
board:
  name: xiao_ra4m1
  full_name: XIAO RA4M1
  vendor: seeed
  socs:
  - name: r7fa4m1ab3cne
```

## boards/seeed/xiao_rp2040/Kconfig
```kconfig
# Copyright (c) 2023 Seeed Studio inc.
# SPDX-License-Identifier: Apache-2.0

config BOARD_XIAO_RP2040
	select RP2_FLASH_W25Q080
```

## boards/seeed/xiao_rp2040/Kconfig.xiao_rp2040
```kconfig
# XIAO RP2040 board configuration

# Copyright (c) 2023 Seeed Studio inc.
# SPDX-License-Identifier: Apache-2.0

config BOARD_XIAO_RP2040
	select SOC_RP2040
```

## boards/seeed/xiao_rp2040/board.yml
```yaml
board:
  name: xiao_rp2040
  full_name: XIAO RP2040
  vendor: seeed
  socs:
  - name: rp2040
```

## boards/seeed/xiao_rp2350/Kconfig.xiao_rp2350
```kconfig
# XIAO RP2350 board configuration

# SPDX-FileCopyrightText: Copyright (c) 2026 Navimatix GmbH
# SPDX-FileCopyrightText: Copyright (c) 2026 TiaC Systems
# SPDX-License-Identifier: Apache-2.0

config BOARD_XIAO_RP2350
	select SOC_RP2350A_HAZARD3 if BOARD_XIAO_RP2350_RP2350A_HAZARD3
	select SOC_RP2350A_M33 if BOARD_XIAO_RP2350_RP2350A_M33
```

## boards/seeed/xiao_rp2350/board.yml
```yaml
# SPDX-FileCopyrightText: Copyright (c) 2026 Navimatix GmbH
# SPDX-FileCopyrightText: Copyright (c) 2026 TiaC Systems
# SPDX-License-Identifier: Apache-2.0

board:
  name: xiao_rp2350
  full_name: XIAO RP2350
  vendor: seeed
  socs:
  - name: rp2350a
```

## boards/seeed/xiao_stm32c5/Kconfig.xiao_stm32c5
```kconfig
# Copyright (c) 2026 Seeed Technology Co., Ltd.
# SPDX-License-Identifier: Apache-2.0

config BOARD_XIAO_STM32C5
	select SOC_STM32C5A3XX
```

## boards/seeed/xiao_stm32c5/board.yml
```yaml
board:
  name: xiao_stm32c5
  full_name: XIAO STM32C5
  vendor: seeed
  socs:
    - name: stm32c5a3xx
```

## boards/seeed/xiao_stm32c5/xiao_stm32c5_defconfig
```kconfig
# Copyright (c) 2026 Seeed Technology Co., Ltd.
# SPDX-License-Identifier: Apache-2.0

# Enable UART driver
CONFIG_SERIAL=y

# Console
CONFIG_CONSOLE=y
CONFIG_UART_CONSOLE=y

# Enable GPIO
CONFIG_GPIO=y
CONFIG_GPIO_HOGS=y

# ARM Cortex-M33 features
CONFIG_ARM_MPU=y
CONFIG_HW_STACK_PROTECTION=y

# UF2 bootloader chain-load support
CONFIG_USE_DT_CODE_PARTITION=y
CONFIG_INIT_ARCH_HW_AT_BOOT=y

# USB device stack + CDC ACM (virtual serial port)
CONFIG_USB_DEVICE_STACK_NEXT=y
CONFIG_USBD_CDC_ACM_CLASS=y
CONFIG_UART_LINE_CTRL=y
```
