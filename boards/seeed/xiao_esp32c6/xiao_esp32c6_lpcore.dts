/*
 * Copyright (c) 2025 Espressif Systems (Shanghai) Co., Ltd.
 *
 * SPDX-License-Identifier: Apache-2.0
 */
/dts-v1/;

#include <espressif/esp32c6/esp32c6_lpcore_wroom_n4.dtsi>
#include <espressif/partitions_0x0_default.dtsi>

/ {
	compatible = "seeed,xiao-esp32c6";
	model = "Seeed XIAO ESP32C6 LP Core";

	chosen {
		zephyr,sram = &sramlp;
		zephyr,code-partition = &slot0_lpcore_partition;
	};
};
