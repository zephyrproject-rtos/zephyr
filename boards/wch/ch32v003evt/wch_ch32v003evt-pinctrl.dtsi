/*
 * Copyright (c) 2024 Michael Hope <michaelh@juju.nz>
 * SPDX-License-Identifier: Apache-2.0
 */

#include <zephyr/dt-bindings/pinctrl/ch32v003-pinctrl.h>

&pinctrl {
	usart1_default: usart1_default {
		group0 {
			pinmux = <USART1_TX_PD5_0>, <USART1_RX_PD6_0>;
			bias-pull-up;
			drive-push-pull;
		};
	};
};
