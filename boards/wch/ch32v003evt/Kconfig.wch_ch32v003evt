## boards/wch/ch32v003evt/Kconfig.wch_ch32v003evt
```kconfig
# Copyright (c) 2024 Michael Hope
# SPDX-License-Identifier: Apache-2.0

config BOARD_WCH_CH32V003EVT
	select SOC_CH32V003
```

## boards/wch/ch32v003evt/board.yml
```yaml
board:
  name: ch32v003evt
  full_name: WCH CH32V003EVT
  vendor: wch
  socs:
    - name: ch32v003
```

## boards/wch/ch32v003evt/wch_ch32v003evt_defconfig
```kconfig
# Copyright (c) 2024 Michael Hope
# SPDX-License-Identifier: Apache-2.0

CONFIG_CLOCK_CONTROL=y
CONFIG_PINCTRL=y
```

## boards/wch/ch32v003f4p6_dev_board/Kconfig
```kconfig
# Copyright (c) 2025 Andrei-Edward Popa
# SPDX-License-Identifier: Apache-2.0

config BOARD_CH32V003F4P6_DEV_BOARD
	select BOARD_LATE_INIT_HOOK
```

## boards/wch/ch32v003f4p6_dev_board/Kconfig.ch32v003f4p6_dev_board
```kconfig
# Copyright (c) 2025 Andrei-Edward Popa
# SPDX-License-Identifier: Apache-2.0

config BOARD_CH32V003F4P6_DEV_BOARD
	select SOC_CH32V003
```

## boards/wch/ch32v003f4p6_dev_board/board.yml
```yaml
board:
  name: ch32v003f4p6_dev_board
  full_name: WCH CH32V003F4P6 Development Board
  vendor: wch
  socs:
    - name: ch32v003
```

## boards/wch/ch32v003f4p6_dev_board/ch32v003f4p6_dev_board_defconfig
```kconfig
# Copyright (c) 2025 Andrei-Edward Popa
# SPDX-License-Identifier: Apache-2.0

CONFIG_GPIO=y

CONFIG_SERIAL=y
CONFIG_CONSOLE=y
CONFIG_UART_CONSOLE=y
```

## boards/wch/ch32v006evt/Kconfig.ch32v006evt
```kconfig
# Copyright (c) 2025 Michael Hope
# SPDX-License-Identifier: Apache-2.0

config BOARD_CH32V006EVT
	select SOC_CH32V006
```

## boards/wch/ch32v006evt/board.yml
```yaml
board:
  name: ch32v006evt
  full_name: WCH CH32V006EVT
  vendor: wch
  socs:
    - name: ch32v006
```

## boards/wch/ch32v006evt/ch32v006evt_defconfig
```kconfig
# Copyright (c) 2025 Michael Hope <michaelh@juju.nz>
# SPDX-License-Identifier: Apache-2.0

CONFIG_GPIO=y
CONFIG_SERIAL=y
CONFIG_CONSOLE=y
CONFIG_UART_CONSOLE=y
```

## boards/wch/ch32v103evt/Kconfig.ch32v103evt
```kconfig
# Copyright (c) 2026 Lucy Wong
# SPDX-License-Identifier: Apache-2.0

config BOARD_CH32V103EVT
	select SOC_CH32V103
```

## boards/wch/ch32v103evt/board.yml
```yaml
board:
  name: ch32v103evt
  full_name: WCH CH32V103EVT
  vendor: wch
  socs:
    - name: ch32v103
```

## boards/wch/ch32v203c8t6evt/Kconfig.ch32v203c8t6evt
```kconfig
# Copyright (c) Fiona Behrens
# SPDX-License-Identifier: Apache-2.0

config BOARD_CH32V203C8T6EVT
	select SOC_CH32V203
```

## boards/wch/ch32v203c8t6evt/board.yml
```yaml
board:
  name: ch32v203c8t6evt
  full_name: WCH CH32V203EVT
  vendor: wch
  revision:
    format: "number"
    default: "0"
    revisions:
      - name: "0"
      - name: "1"
  socs:
    - name: ch32v203
```

## boards/wch/ch32v203c8t6evt/ch32v203c8t6evt_defconfig
```kconfig
# Copyright (c) 2026 Fiona Behrens
# SPDX-License-Identifier: Apache-2.0

CONFIG_GPIO=y

CONFIG_SERIAL=y
CONFIG_CONSOLE=y
CONFIG_UART_CONSOLE=y
```

## boards/wch/ch32v303evt/Kconfig.ch32v303evt
```kconfig
# Copyright (c) 2025 Bootlin
# SPDX-License-Identifier: Apache-2.0

config BOARD_CH32V303EVT
	select SOC_CH32V303
```

## boards/wch/ch32v303evt/board.yml
```yaml
board:
  name: ch32v303evt
  full_name: WCH CH32V303EVT
  vendor: wch
  socs:
    - name: ch32v303
```

## boards/wch/ch32v303vct6_evt/Kconfig.ch32v303vct6_evt
```kconfig
# Copyright (c) 2025 Bootlin
# SPDX-License-Identifier: Apache-2.0

config BOARD_CH32V303VCT6_EVT
	select SOC_CH32V303
```

## boards/wch/ch32v303vct6_evt/board.yml
```yaml
board:
  name: ch32v303vct6_evt
  full_name: WCH CH32V303VCT6_EVT
  vendor: wch
  socs:
    - name: ch32v303
```

## boards/wch/ch32v305f_evt_r0/Kconfig.ch32v305f_evt_r0
```kconfig
# Copyright (c) 2026 James Bennion-Pedley
# SPDX-License-Identifier: Apache-2.0

config BOARD_CH32V305F_EVT_R0
	select SOC_CH32V305
```

## boards/wch/ch32v305f_evt_r0/board.yml
```yaml
board:
  name: ch32v305f_evt_r0
  full_name: WCH CH32V305F-EVT-R0
  vendor: wch
  socs:
    - name: ch32v305
```

## boards/wch/ch32v305f_evt_r0/ch32v305f_evt_r0_defconfig
```kconfig
# Copyright (c) 2026 James Bennion-Pedley
# SPDX-License-Identifier: Apache-2.0

CONFIG_GPIO=y

CONFIG_SERIAL=y
CONFIG_CONSOLE=y
CONFIG_UART_CONSOLE=y
```

## boards/wch/ch32v307v_evt_r1/Kconfig.ch32v307v_evt_r1
```kconfig
# Copyright (c) 2026 Pavel Löbl
# SPDX-License-Identifier: Apache-2.0

config BOARD_CH32V307V_EVT_R1
	select SOC_CH32V307
```

## boards/wch/ch32v307v_evt_r1/board.yml
```yaml
board:
  name: ch32v307v_evt_r1
  full_name: WCH CH32V307V-EVT-R1
  vendor: wch
  socs:
    - name: ch32v307
      variants:
        - name: ram_64k
        - name: ram_96k
        - name: ram_128k
        - name: ram_192k
```

## boards/wch/ch565w_evt/Kconfig.ch565w_evt
```kconfig
# Copyright (c) 2023-2024 Chen Xingyu <hi@xingrz.me>
# SPDX-License-Identifier: Apache-2.0

config BOARD_CH565W_EVT
	select SOC_CH565
```
