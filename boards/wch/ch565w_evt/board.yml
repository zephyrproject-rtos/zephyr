## boards/wch/ch569w_evt/Kconfig.ch569w_evt
```kconfig
# Copyright (c) 2023-2024 Chen Xingyu <hi@xingrz.me>
# SPDX-License-Identifier: Apache-2.0

config BOARD_CH569W_EVT
	select SOC_CH569
```

## boards/wch/ch569w_evt/ch569w_evt_defconfig
```kconfig
# Copyright (c) 2023-2024 Chen Xingyu <hi@xingrz.me>
# SPDX-License-Identifier: Apache-2.0

CONFIG_GPIO=y
CONFIG_SERIAL=y
CONFIG_CONSOLE=y
CONFIG_UART_CONSOLE=y
```

## boards/wch/linkw/Kconfig.linkw
```kconfig
# Copyright (c) 2024 MASSDRIVER EI (massdriver.space)
# SPDX-License-Identifier: Apache-2.0

config BOARD_LINKW
	select SOC_CH32V208
```

## boards/wch/linkw/board.yml
```yaml
board:
  name: linkw
  full_name: WCH LinkW
  vendor: wch
  socs:
    - name: ch32v208
```

## boards/we/oceanus1ev/Kconfig.defconfig
```kconfig
# Copyright (c) 2025 Würth Elektronik eiSos GmbH & Co. KG
# SPDX-License-Identifier: Apache-2.0

if BOARD_WE_OCEANUS1EV

if LORA

config MAIN_STACK_SIZE
	default 2048

endif # LORA

endif # BOARD_WE_OCEANUS1EV
```

## boards/we/oceanus1ev/Kconfig.we_oceanus1ev
```kconfig
# Copyright (c) 2025 Würth Elektronik eiSos GmbH & Co. KG
# SPDX-License-Identifier: Apache-2.0

config BOARD_WE_OCEANUS1EV
	select SOC_STM32WLE5XX
```

## boards/we/oceanus1ev/board.yml
```yaml
board:
  name: we_oceanus1ev
  full_name: Oceanus-I EV
  vendor: we
  revision:
    format: "major.minor.patch"
    default: "1.1.0"
    exact: true
    revisions:
    - name: "1.1.0"
  socs:
  - name: stm32wle5xx
```

## boards/we/oceanus1ev/we_oceanus1ev_defconfig
```kconfig
# Enable UART driver
CONFIG_SERIAL=y

# Enable GPIO
CONFIG_GPIO=y

# Console
CONFIG_CONSOLE=y
CONFIG_UART_CONSOLE=y

# Enable MPU
CONFIG_ARM_MPU=y

# Enable HW stack protection
CONFIG_HW_STACK_PROTECTION=y
```

## boards/we/ophelia1ev/Kconfig.defconfig
```kconfig
# Copyright (c) 2022 Nordic Semiconductor ASA
# SPDX-License-Identifier: Apache-2.0

if BOARD_WE_OPHELIA1EV

config BT_CTLR
	default BT

endif
```

## boards/we/ophelia1ev/Kconfig.we_ophelia1ev
```kconfig
# Copyright (c) 2022 Nordic Semiconductor ASA
# SPDX-License-Identifier: Apache-2.0

config BOARD_WE_OPHELIA1EV
	select SOC_NRF52805_CAAA
```

## boards/we/ophelia1ev/board.yml
```yaml
board:
  name: we_ophelia1ev
  full_name: Ophelia-I EV NRF52805
  vendor: we
  socs:
  - name: nrf52805
```

## boards/we/ophelia4ev/Kconfig.defconfig
```kconfig
# Copyright (c) 2025 Würth Elektronik eiSos GmbH & Co. KG
# SPDX-License-Identifier: Apache-2.0

config HW_STACK_PROTECTION
	default ARCH_HAS_STACK_PROTECTION
```

## boards/we/ophelia4ev/Kconfig.ophelia4ev
```kconfig
# Copyright (c) 2025 Würth Elektronik eiSos GmbH & Co. KG
# SPDX-License-Identifier: Apache-2.0

config BOARD_OPHELIA4EV
	select SOC_NRF54L15_CPUAPP if BOARD_OPHELIA4EV_NRF54L15_CPUAPP
	select SOC_NRF54L15_CPUFLPR if BOARD_OPHELIA4EV_NRF54L15_CPUFLPR
```

## boards/we/ophelia4ev/board.yml
```yaml
board:
  name: ophelia4ev
  full_name: Ophelia-IV EV
  vendor: we
  socs:
  - name: nrf54l15
    variants:
    - name: xip
      cpucluster: cpuflpr
```

## boards/we/ophelia4ev/ophelia4ev_nrf54l15_cpuapp_defconfig
```kconfig
# Copyright (c) 2025 Würth Elektronik eiSos GmbH & Co. KG
# SPDX-License-Identifier: Apache-2.0

# Enable UART driver
CONFIG_SERIAL=y

# Enable console
CONFIG_CONSOLE=y
CONFIG_UART_CONSOLE=y

# Enable GPIO
CONFIG_GPIO=y

# Enable MPU
CONFIG_ARM_MPU=y

# Use internal LFCLK
CONFIG_CLOCK_CONTROL_NRF_K32SRC_RC=y
```

## boards/we/ophelia4ev/ophelia4ev_nrf54l15_cpuflpr_defconfig
```kconfig
# Copyright (c) 2025 Würth Elektronik eiSos GmbH & Co. KG
# SPDX-License-Identifier: Apache-2.0

# Enable UART driver
CONFIG_SERIAL=y

# Enable console
CONFIG_CONSOLE=y
CONFIG_UART_CONSOLE=y

# Enable GPIO
CONFIG_GPIO=y

# Execute from SRAM
CONFIG_XIP=n

# Use internal LFCLK
CONFIG_CLOCK_CONTROL_NRF_K32SRC_RC=y
```

## boards/we/orthosie1ev/Kconfig
```kconfig
# Copyright (c) Würth Elektronik GmbH & Co. KG
# SPDX-License-Identifier: Apache-2.0

config HEAP_MEM_POOL_ADD_SIZE_BOARD
	int
	default 4096
```

## boards/we/orthosie1ev/Kconfig.we_orthosie1ev
```kconfig
# Copyright (c) 2024 Würth Elektronik GmbH & Co. KG
# SPDX-License-Identifier: Apache-2.0

config BOARD_WE_ORTHOSIE1EV
	select SOC_ESP32C3
```

## boards/we/orthosie1ev/board.yml
```yaml
board:
  name: we_orthosie1ev
  full_name: Orthosie-I-EV
  vendor: we
  socs:
  - name: esp32c3
```

## boards/we/proteus2ev/Kconfig.we_proteus2ev
```kconfig
# Copyright (c) 2022 Nordic Semiconductor ASA
# SPDX-License-Identifier: Apache-2.0

config BOARD_WE_PROTEUS2EV_NRF52832
	select SOC_NRF52832_CIAA
```

## boards/we/proteus2ev/board.yml
```yaml
board:
  name: we_proteus2ev
  full_name: Proteus-II-EV
  vendor: we
  socs:
  - name: nrf52832
```

## boards/we/proteus2ev/we_proteus2ev_nrf52832_defconfig
```kconfig
# Copyright (c) 2022 Nordic Semiconductor ASA
# SPDX-License-Identifier: Apache-2.0

# Enable MPU
CONFIG_ARM_MPU=y

# Enable hardware stack protection
CONFIG_HW_STACK_PROTECTION=y

# Enable RTT
CONFIG_USE_SEGGER_RTT=y

# enable GPIO
CONFIG_GPIO=y

# enable uart driver
CONFIG_SERIAL=y

# enable console
CONFIG_CONSOLE=y
CONFIG_UART_CONSOLE=y

# Use internal oscillator
CONFIG_CLOCK_CONTROL_NRF_K32SRC_RC=y
```
