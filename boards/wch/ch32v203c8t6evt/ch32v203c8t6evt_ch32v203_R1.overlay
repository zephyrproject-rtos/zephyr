/*
 * Copyright (c) 2026 Fiona Behrens
 * SPDX-License-Identifier: Apache-2.0
 */

&spi1 {
	status = "okay";
	pinctrl-0 = <&spi1_default>;
	pinctrl-names = "default";

	w25q16: spi-nor@0 {
		compatible = "jedec,spi-nor";
		reg = <0>;
		spi-max-frequency = <DT_FREQ_M(133)>;
		status = "okay";
	};
};
