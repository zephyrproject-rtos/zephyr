/*
 * Copyright (c) 2026 Liu Changjie
 *
 * SPDX-License-Identifier: Apache-2.0
 */

/dts-v1/;

#include <wch/ch32h417/ch32h417_v3f.dtsi>

/ {
	compatible = "wch,ch32h417";
	model = "WCH CH32H417EVT V3F waker";

	chosen {
		zephyr,sram = &sram0;
		zephyr,flash = &flash0;
	};
};
