## boards/wch/ch32x035evt/board.yml
```yaml
board:
  name: ch32x035evt
  full_name: WCH CH32X035EVT
  vendor: wch
  socs:
    - name: ch32x035
```

## boards/wch/ch582m_dev_board/Kconfig.ch582m_dev_board
```kconfig
# SPDX-FileCopyrightText: Copyright The Zephyr Project Contributors
# SPDX-License-Identifier: Apache-2.0

config BOARD_CH582M_DEV_BOARD
	select SOC_CH582M
```

## boards/wch/ch582m_dev_board/board.yml
```yaml
board:
  name: ch582m_dev_board
  full_name: WCH CH582M Dev Board
  vendor: wch
  socs:
    - name: ch582m
```

## drivers/adc/Kconfig.ad7794
```kconfig
# Copyright (c) 2026 Testo SE & Co. KGaA
# SPDX-License-Identifier: Apache-2.0

config ADC_AD7794
	bool "Analog Devices AD7794 ADC driver"
	default y
	depends on DT_HAS_ADI_AD7794_ENABLED
	select SPI
	select ADC_CONFIGURABLE_INPUTS
	select ADC_CONFIGURABLE_EXCITATION_CURRENT_SOURCE_PIN
	select ADC_CONFIGURABLE_VBIAS_PIN
	help
	  Enable the driver for the Analog Devices AD7794 24-bit
	  sigma-delta ADC.

if ADC_AD7794 && ADC_ASYNC

config ADC_AD7794_ACQUISITION_THREAD_STACK_SIZE
	int "Stack size for the ADC data acquisition thread"
	default 1024
	help
	  Size of the stack used for the internal data acquisition
	  thread.

config ADC_AD7794_ACQUISITION_THREAD_PRIO
	int "Priority for the ADC data acquisition thread"
	default 0
	help
	  Priority level for the internal ADC data acquisition thread.

endif # ADC_AD7794 && ADC_ASYNC
```

## drivers/adc/Kconfig.ads1x2s14
```kconfig
# Copyright (c) 2026 Testo SE & Co. KGaA
# SPDX-License-Identifier: Apache-2.0

config ADC_ADS1X2S14
	bool "Texas Instruments ADS112S14/ADS122S14 ADC driver"
	default y
	depends on DT_HAS_TI_ADS112S14_ENABLED || DT_HAS_TI_ADS122S14_ENABLED
	select SPI
	select ADC_CONFIGURABLE_INPUTS
	select ADC_CONFIGURABLE_EXCITATION_CURRENT_SOURCE_PIN
	help
	  Enable the driver for the Texas Instruments ADS112S14 (16-bit) and
	  ADS122S14 (24-bit) delta-sigma ADCs with eight multiplexed analog
	  inputs, PGA, internal voltage reference and two excitation current
	  sources, connected via SPI.

if ADC_ADS1X2S14 && ADC_ASYNC

config ADC_ADS1X2S14_ACQUISITION_THREAD_STACK_SIZE
	int "Stack size for the ADC data acquisition thread"
	default 512
	help
	  Size of the stack of the per-device thread that performs the
	  conversions when asynchronous reads are enabled.

config ADC_ADS1X2S14_ACQUISITION_THREAD_PRIO
	int "Priority of the ADC data acquisition thread"
	default 0
	help
	  Priority of the per-device thread that performs the conversions
	  when asynchronous reads are enabled.

endif # ADC_ADS1X2S14 && ADC_ASYNC
```

## drivers/adc/Kconfig.infineon_dsadc
```kconfig
# SPDX-FileCopyrightText: Copyright (c) 2026 Infineon Technologies AG,
# SPDX-FileCopyrightText: or an affiliate of Infineon Technologies AG. All rights reserved.
#
# SPDX-License-Identifier: Apache-2.0

# Infineon Delta-Sigma ADC configuration options

config ADC_INFINEON_DSADC
	bool "Infineon Delta-Sigma ADC driver"
	default y
	depends on DT_HAS_INFINEON_DSADC_ENABLED
	select ADC_CONFIGURABLE_INPUTS
	select USE_INFINEON_DSADC
	help
	  Enable the Delta-Sigma ADC (PACSS) driver for Infineon PSOC4 HVPA devices.
```

## drivers/audio/Kconfig.es8311
```kconfig
# Copyright (c) 2026 Hsiu-Chi Tsai
# SPDX-License-Identifier: Apache-2.0

config AUDIO_CODEC_ES8311
	bool "Everest Semiconductor ES8311 audio codec"
	default y
	depends on DT_HAS_EVEREST_ES8311_ENABLED
	select I2C
	select GPIO if $(dt_compat_any_has_prop,$(DT_COMPAT_EVEREST_ES8311),pa-gpios)
	select REGULATOR if $(dt_compat_any_has_prop,$(DT_COMPAT_EVEREST_ES8311),vin-supply)
	help
	  Enable the ES8311 mono ADC/DAC with I2C control and standard I2S:
	  two 16-bit slots, MSB first, normal clock polarity. The codec must
	  receive continuous bit and frame clocks from the I2S controller.

	  Set audio_codec_cfg.mclk_freq to the external MCLK frequency at
	  256 times the sample rate. Supported rates are 8000, 11025, 12000,
	  16000, 22050, 24000, 32000, 44100 and 48000 Hz. Zero selects BCLK
	  multiplication, limited to 32000, 44100 and 48000 Hz by the 1 MHz
	  multiplier-input minimum for 3.3 V operation.

	  Input and output volume use whole dB, clamped to -95 through +32 dB.
	  Capture uses differential MIC1, a DT-selected PGA gain and a fixed
	  +24 dB digital scale before input volume. Output uses headphone mode.

	  Configuration leaves both directions muted. Start the I2S transport
	  before audio_codec_start(); a stopped direction applies its cached
	  volume and mute on start. Use audio_codec_apply_properties() for
	  running directions. A failed property unmute stops each direction
	  rolled back to mute; call audio_codec_start() to retry.

	  Check audio_codec_stop() before stopping I2S clocks. The application
	  manages clocks; device PM is not implemented. An optional vin-supply
	  enables codec power before initialization, and pa-gpios gates an
	  external amplifier with playback. Without vin-supply, power must be
	  available before initialization, or use zephyr,deferred-init and
	  device_init() after enabling it. Muting cannot be guaranteed when I2C
	  fails; validate analog settling and power transitions on the board.

config AUDIO_CODEC_ES8311_INIT_PRIORITY
	int "ES8311 initialization priority"
	default 90
	depends on AUDIO_CODEC_ES8311
	help
	  Initialize after the I2C controller, GPIO controller and optional
	  codec supply regulator.

config EMUL_ES8311
	bool "Everest ES8311 audio codec emulator"
	default y
	depends on EMUL
	# The emulator uses the codec subsystem's log level.
	depends on AUDIO_CODEC_ES8311
	help
	  I2C emulator for the Everest ES8311 audio codec, for native_sim driver
	  unit tests.
```

## drivers/audio/Kconfig.tlv320aic3104
```kconfig
# SPDX-FileCopyrightText: Copyright The Zephyr Project Contributors
# SPDX-License-Identifier: Apache-2.0

config AUDIO_TLV320AIC3104
	bool "TLV320AIC3104 and TLV320AIC3106 audio codecs"
	default y
	depends on DT_HAS_TI_TLV320AIC3104_ENABLED || DT_HAS_TI_TLV320AIC3106_ENABLED
	select I2C
	select GPIO
	help
	  Texas Instruments TLV320AIC3104 and TLV320AIC3106 low-power stereo
	  audio codecs.
	  I2C control, supports volume and mute via the audio_codec API.
```

## drivers/cache/Kconfig.sam0_cmcc
```kconfig
# SPDX-FileCopyrightText: Copyright The Zephyr Project Contributors
# SPDX-License-Identifier: Apache-2.0

config CACHE_SAM0_CMCC
	bool "Atmel SAM0 Cortex M Cache Controller (CMCC) driver"
	default y
	depends on SOC_ATMEL_SAM0_HAS_CMCC
	select CACHE_HAS_DRIVER
	help
	  Driver for the CMCC of the Atmel SAM D5x/E5x, which caches the code
	  region on the Cortex-M4F code bus. It is managed as the i-cache.
```

## drivers/cache/Kconfig.ti_mspm0
```kconfig
# SPDX-FileCopyrightText: Copyright The Zephyr Project Contributors
# SPDX-License-Identifier: Apache-2.0

config CACHE_TI_MSPM0
	bool "TI MSPM0 CPUSS cache driver"
	default y
	depends on SOC_SERIES_MSPM0G || SOC_SERIES_MSPM0L
	depends on EXTERNAL_CACHE
	depends on SYSCON
	depends on $(dt_nodelabel_enabled,cpuss)
	depends on $(dt_nodelabel_enabled,sysctl)
	select CACHE_HAS_DRIVER
	help
	  Driver for the prefetch and cache logic of the MSPM0 CPU subsystem, which caches
	  instruction and literal fetches from flash. It is handled as an instruction cache;
	  invalidating it also drops the cached literals.
```

## drivers/can/Kconfig.sam0
```kconfig
# SAM CAN configuration options
# Copyright (c) 2022 Kamil Serwus
# SPDX-License-Identifier: Apache-2.0

config CAN_SAM0
	bool "Atmel SAM0 CAN driver"
	default y
	depends on DT_HAS_ATMEL_SAM0_CAN_ENABLED
	select CAN_MCAN
	select PINCTRL

config CAN_SAM0_MRAM_SECTION
	bool
	depends on CAN_SAM0
	help
	  Place the M_CAN message RAM in the .can_message_ram section. A SoC whose M_CAN core can
	  only address the first 64 KB of SRAM, but which has more SRAM than that, enables this
	  option and links the section at the start of SRAM.
```

## drivers/clock_monitor/Kconfig.ti_k3_dcc
```kconfig
# Copyright (c) 2026 BeagleBoard.org Foundation
# SPDX-License-Identifier: Apache-2.0

config CLOCK_MONITOR_TI_K3_DCC
	bool "TI K3 Dual Clock Comparator (DCC) driver"
	default y
	depends on DT_HAS_TI_K3_DCC_ENABLED
	help
	  Zephyr clock_monitor back-end for the TI K3 Dual Clock Comparator.
	  Supports MEASURE (DONE IRQ) and WINDOW (ERR status poll) modes.
```

## drivers/comparator/Kconfig.adc
```kconfig
# Copyright 2026 Google LLC
# SPDX-License-Identifier: Apache-2.0

config COMPARATOR_ADC
	bool "ADC voltage comparator driver"
	default y
	depends on DT_HAS_ADC_COMPARATOR_ENABLED
	select ADC
	help
	  Enable the ADC-backed voltage comparator driver.

config COMPARATOR_ADC_INIT_PRIORITY
	int "ADC voltage comparator init priority"
	default ADC_INIT_PRIORITY
	depends on COMPARATOR_ADC
	help
	  ADC voltage comparator device driver initialization priority.
	  Defaults to ADC_INIT_PRIORITY, relying on devicetree dependency
	  ordering to initialize after the backing ADC controller.
```

## drivers/comparator/Kconfig.esp32_ana_cmpr
```kconfig
# Copyright (c) 2026 Espressif Systems (Shanghai) Co., Ltd.
# SPDX-License-Identifier: Apache-2.0

config COMPARATOR_ESP32_ANA_CMPR
	bool "ESP32 Analog Comparator (ana_cmpr) driver"
	default y
	depends on DT_HAS_ESPRESSIF_ESP32_ANA_CMPR_ENABLED
	help
	  Enable the driver for Espressif's analog comparator (ana_cmpr)
	  peripheral, present on the ESP32-P4, ESP32-C5, ESP32-C61, and ESP32-H2
	  SoCs.

config COMPARATOR_ESP32_ANA_CMPR_ZD
	bool "Espressif analog comparator zero detector driver"
	default y
	depends on DT_HAS_ESPRESSIF_ESP32_ANA_CMPR_ZD_ENABLED
	depends on ESP32_SYS_TIMER
	depends on SOC_FAMILY_ESPRESSIF_ETM_SUPPORTED
	select SOC_FAMILY_ESPRESSIF_ETM
	help
	  Enable the driver for Espressif's analog comparator zero detector.
	  Each enabled input is a comparator device. The inputs share one
	  reference and are sampled by a periodic hardware scan.
```

## drivers/counter/Kconfig.aesc
```kconfig
# SPDX-FileCopyrightText: 2026 Aesc Silicon
# SPDX-License-Identifier: Apache-2.0

config COUNTER_AESC_TIMER
	bool "Aesc Silicon general-purpose timer driver"
	default y
	depends on DT_HAS_AESC_TIMER_ENABLED
	help
	  Enable the counter driver for the Aesc Silicon general-purpose timer.
```

## drivers/counter/Kconfig.arm_timer_mem
```kconfig
# SPDX-FileCopyrightText: Copyright Analog Devices, Inc.
# SPDX-License-Identifier: Apache-2.0

config COUNTER_ARM_TIMER_MEM
	bool "ARM memory-mapped timer counter driver"
	default y
	depends on DT_HAS_ARM_ARMV7_TIMER_MEM_FRAME_ENABLED
	select CLOCK_CONTROL
	select COUNTER_SUPPORTS_64BITS_TICKS
	help
	  Enable the counter driver for an Arm Generic Timer memory-mapped
	  frame. Each frame is a count-up counter with one physical compare
	  channel. The tick rate is the frame CNTFRQ register. When that
	  register is zero, the driver uses the clock named by the block.
	  The clock cell is named clkid.
	  counter_stop() makes counter_get_value() return 0. The next
	  counter_start() counts from 0 again.
```

## drivers/counter/Kconfig.k3_rtc_counter
```kconfig
# Copyright (c) 2026 Texas Instruments Inc.
# SPDX-License-Identifier: Apache-2.0

config COUNTER_TI_K3_RTC
	bool "RTC Counter Driver for TI K3 SoCs"
	default y
	depends on DT_HAS_TI_K3_RTC_COUNTER_ENABLED
	select COUNTER_SUPPORTS_64BITS_TICKS
	help
	  Enable the RTC driver for TI K3 SoCs. The hardware second
	  counter is 48 bits, so enable COUNTER_64BITS_TICKS to use the
	  64-bit counter APIs.
```

## drivers/counter/Kconfig.mcux_lpc_rit
```kconfig
# SPDX-FileCopyrightText: Copyright The Zephyr Project Contributors
# SPDX-License-Identifier: Apache-2.0

config COUNTER_MCUX_LPC_RIT
	bool "NXP LPC Repetitive Interrupt Timer driver"
	default y
	depends on DT_HAS_NXP_LPC_RIT_ENABLED
	help
	  Enable the Repetitive Interrupt Timer found on NXP LPC parts such as
	  the LPC546xx. The single compare register backs the counter top value,
	  so the device has no alarm channels.
```

## drivers/counter/Kconfig.npcm
```kconfig
# Copyright (c) 2026 Nuvoton Technology Corporation.
# SPDX-License-Identifier: Apache-2.0

config COUNTER_NPCM_ITIM32
	bool "Nuvoton NPCM internal 32-bit timer (ITIM32) counter driver"
	default y
	depends on DT_HAS_NUVOTON_NPCM_ITIM32_ENABLED
	help
	  Enable the counter driver for the internal 32-bit timers (ITIM32)
	  of the Nuvoton NPCM family.
```

## drivers/crc/Kconfig.armv8
```kconfig
# Armv8 CRC32 instruction driver configuration options

# Copyright (c) 2026 Nokia
# SPDX-License-Identifier: Apache-2.0

config CRC_ARMV8
	bool "Armv8 CRC32 instruction driver"
	default y
	depends on DT_HAS_ARM_ARMV8_CRC32_ENABLED
	depends on ARMV8_A || ARMV9_A || AARCH32_ARMV8_A
	select CRC_DRIVER_HAS_CRC32_IEEE
	select CRC_DRIVER_HAS_CRC32_C
	help
	  Enable CRC32 (IEEE) and CRC32C (Castagnoli) computation with the
	  Armv8 CRC extension (FEAT_CRC32) instructions, in the AArch64 and
	  AArch32 execution states.

	  The CPU must implement the CRC extension. This is optional in
	  Armv8.0-A (for example Cortex-A53 r0p4 and later) and mandatory
	  from Armv8.1-A.
```

## drivers/crypto/Kconfig.mcux_lpc_sha
```kconfig
# SPDX-FileCopyrightText: Copyright The Zephyr Project Contributors
# SPDX-License-Identifier: Apache-2.0

config CRYPTO_MCUX_LPC_SHA
	bool "NXP LPC SHA driver"
	default y
	depends on DT_HAS_NXP_LPC_SHA_ENABLED
	help
	  Enable the SHA engine found on NXP LPC parts such as the LPC546xx.
	  The driver exposes SHA-256 through the crypto hash API.
```

## drivers/dac/Kconfig.am13
```kconfig
# TI AM13 CMPSS DAC Driver Configuration

# Copyright (c) 2026 Texas Instruments Incorporated
# SPDX-License-Identifier: Apache-2.0

config DAC_AM13
	bool "TI AM13 CMPSS low DAC driver"
	default y
	depends on DT_HAS_TI_AM13_CMPSS_DAC_ENABLED
	select SYSCON
	help
	  Enable support for the 12-bit low DAC (DACL) of the CMPSS modules
	  on Texas Instruments AM13 MCUs, used as a general purpose DAC.
```

## drivers/dac/Kconfig.infineon_hppass
```kconfig
# SPDX-FileCopyrightText: Copyright (c) 2026 Infineon Technologies AG,
# SPDX-FileCopyrightText: or an affiliate of Infineon Technologies AG. All rights reserved.
#
# SPDX-License-Identifier: Apache-2.0

config DAC_INFINEON_HPPASS
	bool "Infineon HPPASS standalone DAC driver"
	default y
	depends on DT_HAS_INFINEON_HPPASS_DAC_V3_ENABLED
	depends on DT_HAS_INFINEON_HPPASS_ANALOG_V3_ENABLED
	select MFD
	help
	  Enable the standalone 12-bit DACs on MCPASS v3. Each device exposes
	  channel 0 for direct writes to its buffered pin output. These DACs
	  are independent of the 10-bit DACs in the HPPASS CSG block.
```

## drivers/disk/Kconfig.usb_msc
```kconfig
# Copyright (c) 2026 Espressif Systems (Shanghai) Co., Ltd.
# SPDX-License-Identifier: Apache-2.0

config USB_MSC_DISK
	bool "USB mass storage disk access"
	depends on DT_HAS_ZEPHYR_USB_MSC_DISK_ENABLED
	default y
	select USB_HOST_STACK
	select USBH_MSC
	help
	  Expose a USB mass storage device attached to the USB host stack
	  as a disk access device, so a file system can be mounted on it.

if USB_MSC_DISK

config USB_MSC_DISK_INITIALIZE_AT_BOOT
	bool "Initialize the USB host stack at boot"
	default y
	help
	  Initialize and enable, at boot, the USB host controller that the
	  zephyr,usb-msc-disk nodes are children of, so the application
	  needs no USB host code. All the nodes must then share one
	  controller. Disable it when the application initializes the USB
	  host stack of that controller itself, for example to use other
	  host classes on it.

module = USB_MSC_DISK
module-str = usb msc disk
source "subsys/logging/Kconfig.template.log_config"

endif # USB_MSC_DISK
```
