/* SPDX-License-Identifier: Apache-2.0 */
/*
 * Copyright 2019 Broadcom.
 */

/dts-v1/;

#include <broadcom/valkyrie.dtsi>

/ {
	model = "Broadcom BCM958401M2";
	compatible = "brcm,valkyrie";
	#address-cells = <1>;
	#size-cells = <1>;

	chosen {
		zephyr,console = &uart1;
		zephyr,shell-uart = &uart1;
		zephyr,sram = &sram0;
	};
};

&uart1 {
	/*
	 * Setting the current-speed as 0 will retain the baud rate
	 * configured by bootrom and it will not be re-configured.
	 */
	current-speed = <0>;
	status = "okay";
};
