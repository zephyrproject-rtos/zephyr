/*
 * Copyright 2020 Broadcom
 *
 * SPDX-License-Identifier: Apache-2.0
 */

/dts-v1/;

#include <broadcom/viper-a72.dtsi>

/ {
	compatible = "brcm,viper";
	model = "Broadcom BCM958402M2_A72";
	#address-cells = <1>;
	#size-cells = <1>;

	chosen {
		zephyr,console = &uart1;
		zephyr,shell-uart = &uart1;
		zephyr,sram = &sram0;
	};
};

&uart1 {
	current-speed = <57600>;
	status = "okay";
};
