/*
 * Copyright (c) 2024 KWS Computersysteme Gmbh
 *
 * SPDX-License-Identifier: Apache-2.0
 */

#include <zephyr/dt-bindings/pinctrl/rpi-pico-rp2040-pinctrl.h>

#include "../common/pico_spe-pinctrl-common.dtsi"
