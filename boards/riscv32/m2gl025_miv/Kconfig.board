## boards/riscv32/m2gl025_miv/Kconfig.board
```kconfig
config BOARD_M2GL025_MIV
	bool "Microsemi M2GL025 IGLOO2 dev board with Mi-V SoC"
	depends on SOC_RISCV32_MIV
```

## boards/riscv32/m2gl025_miv/Kconfig.defconfig
```kconfig
# SPDX-License-Identifier: Apache-2.0

if BOARD_M2GL025_MIV

config BOARD
	default "m2gl025_miv"

endif
```

## boards/riscv32/m2gl025_miv/m2gl025_miv_defconfig
```kconfig
CONFIG_RISCV32=y
CONFIG_SOC_SERIES_RISCV32_MIV=y
CONFIG_SOC_RISCV32_MIV=y
CONFIG_BOARD_M2GL025_MIV=y
CONFIG_CONSOLE=y
CONFIG_SERIAL=y
CONFIG_UART_MIV=y
CONFIG_UART_MIV_PORT_0=y
CONFIG_UART_MIV_PORT_0_BAUD_RATE=115200
CONFIG_UART_MIV_PORT_0_NAME="uart0"
CONFIG_UART_CONSOLE=y
CONFIG_UART_CONSOLE_ON_DEV_NAME="uart0"
CONFIG_PLIC=y
CONFIG_RISCV_MACHINE_TIMER=y
CONFIG_GPIO=n
CONFIG_XIP=y
```

## boards/riscv32/qemu_riscv32/Kconfig.board
```kconfig
config BOARD_QEMU_RISCV32
	bool "QEMU RISC-V 32-bit sifive_e target"
	depends on SOC_RISCV32_SIFIVE_FREEDOM
	select QEMU_TARGET
	select HAS_DTS
```

## boards/riscv32/qemu_riscv32/Kconfig.defconfig
```kconfig
# SPDX-License-Identifier: Apache-2.0

if BOARD_QEMU_RISCV32

config BUILD_OUTPUT_BIN
        default n

config BOARD
	default "qemu_riscv32"

endif
```

## boards/riscv32/qemu_riscv32/qemu_riscv32_defconfig
```kconfig
CONFIG_RISCV32=y
CONFIG_SOC_RISCV32_QEMU=y
CONFIG_BOARD_QEMU_RISCV32=y
CONFIG_CONSOLE=y
CONFIG_PRINTK=y
CONFIG_SERIAL=y
CONFIG_UART_RISCV_QEMU=y
CONFIG_UART_CONSOLE=y
CONFIG_UART_CONSOLE_ON_DEV_NAME="uart0"
CONFIG_RISCV_MACHINE_TIMER=y
CONFIG_BOOT_BANNER=y
```

## boards/riscv32/rv32m1_vega/Kconfig.defconfig
```kconfig
if BOARD_RV32M1_VEGA

config BOARD
	default "rv32m1_vega_ri5cy" if SOC_OPENISA_RV32M1_RI5CY
	default "rv32m1_vega_zero_riscy" if SOC_OPENISA_RV32M1_ZERO_RISCY

if UART_RV32M1_LPUART

config UART_RV32M1_LPUART_0
	def_bool y if UART_CONSOLE

endif # UART_RV32M1

if PINMUX_RV32M1

config PINMUX_RV32M1_PORTA
	def_bool y

config PINMUX_RV32M1_PORTB
	def_bool y

config PINMUX_RV32M1_PORTC
	def_bool y

config PINMUX_RV32M1_PORTD
	def_bool y

config PINMUX_RV32M1_PORTE
	def_bool y if RV32M1_INTMUX

endif # PINMUX_RV32M1

if GPIO_RV32M1

config GPIO_RV32M1_PORTA
	def_bool y

config GPIO_RV32M1_PORTB
	def_bool y if RV32M1_INTMUX

config GPIO_RV32M1_PORTC
	def_bool y if RV32M1_INTMUX

config GPIO_RV32M1_PORTD
	def_bool y if RV32M1_INTMUX

config GPIO_RV32M1_PORTE
	def_bool y if RV32M1_INTMUX

endif # GPIO_RV32M1

if SERIAL

config UART_RV32M1_LPUART
	def_bool y

endif # SERIAL

endif # BOARD_RV32M1_VEGA
```

## boards/riscv32/sifive-multicore/Kconfig.board
```kconfig
config BOARD_SIFIVE_MULTICORE
	bool "Multicore Generic Sifive Target"
	depends on SOC_RISCV32_SIFIVE_FREEDOM
	select HAS_DTS
```

## boards/riscv32/sifive-multicore/sifive-multicore_defconfig
```kconfig
CONFIG_RISCV32=y
CONFIG_SOC_SERIES_RISCV32_SIFIVE_FREEDOM=y
CONFIG_SOC_RISCV32_SIFIVE_FREEDOM=y
CONFIG_BOARD_SIFIVE_MULTICORE=y
CONFIG_SMP=y
CONFIG_TICKLESS_KERNEL=n
CONFIG_TICKLESS_IDLE=n
CONFIG_USE_SWITCH=y
CONFIG_MP_NUM_CPUS=2
CONFIG_CONSOLE=y
CONFIG_PRINTK=y
CONFIG_SERIAL=y
CONFIG_UART_SIFIVE=y
CONFIG_UART_SIFIVE_PORT_0=y
CONFIG_UART_CONSOLE=y
CONFIG_PLIC=y
CONFIG_PINMUX=y
CONFIG_PINMUX_SIFIVE=y
CONFIG_RISCV_MACHINE_TIMER=y
CONFIG_GPIO=y
CONFIG_GPIO_SIFIVE=y
CONFIG_BOOT_BANNER=y
```

## boards/riscv32/zedboard_pulpino/Kconfig.board
```kconfig
config BOARD_ZEDBOARD_PULPINO
	bool "Zedboard pulpino target"
	depends on SOC_RISCV32_PULPINO
	select BUILD_OUTPUT_S19
```

## boards/riscv32/zedboard_pulpino/zedboard_pulpino_defconfig
```kconfig
CONFIG_RISCV32=y
CONFIG_SOC_RISCV32_PULPINO=y
CONFIG_BOARD_ZEDBOARD_PULPINO=y
CONFIG_CONSOLE=y
CONFIG_PRINTK=y
CONFIG_SERIAL=y
CONFIG_UART_NS16550=y
CONFIG_UART_CONSOLE=y
CONFIG_UART_CONSOLE_ON_DEV_NAME="UART_0"
CONFIG_PULPINO_TIMER=y
CONFIG_GPIO=y
CONFIG_GPIO_PULPINO=y
CONFIG_BOOT_BANNER=y
```

## boards/ronoth/lodev/Kconfig.ronoth_lodev
```kconfig
# Copyright (c) 2020/2021 Dean Weiten <dmw@weiten.com>
# SPDX-License-Identifier: Apache-2.0

config BOARD_RONOTH_LODEV
	select SOC_STM32L073XX
```

## boards/ronoth/lodev/board.yml
```yaml
board:
  name: ronoth_lodev
  full_name: LoDev
  vendor: ronoth
  socs:
    - name: stm32l073xx
```

## boards/ruiside/art_pi/Kconfig.art_pi
```kconfig
# Copyright (c) 2025 Dejiang He <2995560796@qq.com>
# SPDX-License-Identifier: Apache-2.0

config BOARD_ART_PI
	select SOC_STM32H750XX
```

## boards/ruiside/art_pi/art_pi_defconfig
```kconfig
# Copyright (c) 2025 Dejiang He <2995560796@qq.com>
# SPDX-License-Identifier: Apache-2.0

# Enable MPU
CONFIG_ARM_MPU=y

# Enable HW Stack Protection
CONFIG_HW_STACK_PROTECTION=y

CONFIG_SERIAL=y

# Console
CONFIG_CONSOLE=y
CONFIG_UART_CONSOLE=y

# Enable GPIO
CONFIG_GPIO=y
```

## boards/ruiside/art_pi/board.yml
```yaml
board:
  name: art_pi
  full_name: ART-Pi
  vendor: ruiside
  socs:
    - name: stm32h750xx
```

## boards/ruiside/art_pi2/Kconfig.art_pi2
```kconfig
# Copyright (c) 2025 Shan Pen <bricle031@gmail.com>
# SPDX-License-Identifier: Apache-2.0

config BOARD_ART_PI2
	select SOC_STM32H7R7XX
```

## boards/ruiside/art_pi2/Kconfig.defconfig
```kconfig
# ART-Pi2 board configuration
#
# Copyright (c) 2025 Shan Pen <bricle031@gmail.com>
#
# SPDX-License-Identifier: Apache-2.0

if DISK_DRIVER_SDMMC

config SDMMC_STM32_CLOCK_CHECK
	default n

endif # DISK_DRIVER_SDMMC
```

## boards/ruiside/art_pi2/art_pi2_defconfig
```kconfig
# Copyright (c) 2025 Shan Pen <bricle031@gmail.com>
# SPDX-License-Identifier: Apache-2.0

# Enable SMPS
CONFIG_POWER_SUPPLY_DIRECT_SMPS=y

# Enable MPU
CONFIG_ARM_MPU=y

# Enable HW stack protection
CONFIG_HW_STACK_PROTECTION=y

# Enable UART driver
CONFIG_SERIAL=y
# Enable console
CONFIG_CONSOLE=y
CONFIG_UART_CONSOLE=y

# Enable GPIO
CONFIG_GPIO=y
```

## boards/ruiside/art_pi2/board.yml
```yaml
board:
  name: art_pi2
  full_name: ART-Pi2
  vendor: ruiside
  socs:
    - name: stm32h7r7xx
```

## boards/ruiside/ra8d1_vision_board/Kconfig.defconfig
```kconfig
# Copyright (c) 2025 Shan Pen <bricle031@gmail.com>
# SPDX-License-Identifier: Apache-2.0

if BOARD_RA8D1_VISION_BOARD

if DISK_DRIVER_SDMMC

config SD_CMD_TIMEOUT
	default 1000

endif # DISK_DRIVER_SDMMC

endif # BOARD_RA8D1_VISION_BOARD
```

## boards/ruiside/ra8d1_vision_board/Kconfig.ra8d1_vision_board
```kconfig
# Copyright (c) 2025 Shan Pen <bricle031@gmail.com>
# SPDX-License-Identifier: Apache-2.0

config BOARD_RA8D1_VISION_BOARD
	select SOC_R7FA8D1BHECBD
```

## boards/ruiside/ra8d1_vision_board/board.yml
```yaml
board:
  name: ra8d1_vision_board
  full_name: RA8D1 Vision Board
  vendor: ruiside
  socs:
    - name: r7fa8d1bhecbd
```
