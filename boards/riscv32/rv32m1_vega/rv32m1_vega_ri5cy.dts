/*
 * Copyright 2018 Foundries.io Ltd
 * SPDX-License-Identifier: Apache-2.0
 */

/dts-v1/;

#include "rv32m1_ri5cy.dtsi"
#include "rv32m1_vega.dtsi"

/ {
	model = "OpenISA RV32M1 Vega RI5CY";
	compatible = "openisa,rv32m1";

	chosen {
		zephyr,sram = &m4_dtcm;
		zephyr,flash = &ri5cy_code_partition;
		zephyr,console = &uart0;
		zephyr,uart-pipe = &uart0;
	};
};
