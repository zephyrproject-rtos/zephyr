## boards/element14/warp7/warp7_mcimx7d_m4_defconfig
```kconfig
#
# Copyright (c) 2018, Diego Sueiro
#
# SPDX-License-Identifier: Apache-2.0
#

CONFIG_UART_CONSOLE=y
CONFIG_SERIAL=y
CONFIG_UART_INTERRUPT_DRIVEN=y
CONFIG_CONSOLE=y
CONFIG_XIP=y
```

## boards/em_starterkit/Kconfig.board
```kconfig
# Kconfig - DesignWare ARC EM Starter Kit board configuration
#
# Copyright (c) 2016 Synopsys, Inc. All rights reserved.
#
# Licensed under the Apache License, Version 2.0 (the "License");
# you may not use this file except in compliance with the License.
# You may obtain a copy of the License at
#
#     http://www.apache.org/licenses/LICENSE-2.0
#
# Unless required by applicable law or agreed to in writing, software
# distributed under the License is distributed on an "AS IS" BASIS,
# WITHOUT WARRANTIES OR CONDITIONS OF ANY KIND, either express or implied.
# See the License for the specific language governing permissions and
# limitations under the License.
#
config BOARD_EM_STARTERKIT
	bool "ARC EM Starter Kit"
	depends on (SOC_EM7D || SOC_EM9D || SOC_EM11D)
	help
	The DesignWare ARC EM Starter Kit board is a board
	that can host up to 3 different SOC FPGA bit files.
	Version 2.2 firmware supports EM7D, EM9D and EM11D configurations.
	EM9D using CCM memories and is a Harvard Architecture.
	EM7D and EM11D have access to 128MB DRAM and use i-cache and d-cache.
```

## boards/embedsky/tq_h503a/Kconfig.tq_h503a
```kconfig
# Copyright (c) 2025 MA Junyi
# SPDX-License-Identifier: Apache-2.0

config BOARD_TQ_H503A
	select SOC_STM32H503XX
```

## boards/embedsky/tq_h503a/board.yml
```yaml
# Copyright (c) 2025 MA Junyi
# SPDX-License-Identifier: Apache-2.0

board:
  name: tq_h503a
  full_name: TQ H503A
  vendor: embedsky
  socs:
    - name: stm32h503xx
```

## boards/embedsky/tq_h503a/tq_h503a_defconfig
```kconfig
# Copyright (c) 2025 MA Junyi
# SPDX-License-Identifier: Apache-2.0

# Enable UART driver
CONFIG_SERIAL=y

# Console
CONFIG_CONSOLE=y
CONFIG_UART_CONSOLE=y

# Enable MPU
CONFIG_ARM_MPU=y

# Enable HW stack protection
CONFIG_HW_STACK_PROTECTION=y

# Enable GPIO
CONFIG_GPIO=y
```

## boards/emtrion/emsbc_neon_cm7/board.yml
```yaml
# Copyright (c) 2025 emtrion GmbH
# SPDX-License-Identifier: Apache-2.0

board:
  name: emsbc_neon_cm7
  full_name: emSBC-NEON-CM7
  vendor: emtrion
  socs:
    - name: stm32f769xx
```

## boards/emtrion/emsbc_neon_cm7/dts/bindings/emtrion,eth-phy-reset.yaml
```yaml
# Copyright (c) 2025 emtrion GmbH
# SPDX-License-Identifier: Apache-2.0

description: GPIO used to reset the ethernet phy

compatible: "emtrion,eth-phy-reset"

include: base.yaml

properties:
  status:
    required: true

  gpios:
    type: phandle-array
    required: true
    description: |
      GPIO to use as ethernet phy reset line: output.
```

## boards/emtrion/emsbc_neon_cm7/emsbc_neon_cm7_R3_defconfig
```kconfig
# Copyright (c) 2025 emtrion GmbH
# SPDX-License-Identifier: Apache-2.0

CONFIG_EEPROM=y
CONFIG_EEPROM_INIT_PRIORITY=55
CONFIG_EEPROM_AT2X_INIT_PRIORITY=55
CONFIG_NVMEM=y
CONFIG_NVMEM_EEPROM=y
```

## boards/emtrion/emsbc_neon_cm7/emsbc_neon_cm7_defconfig
```kconfig
# Copyright (c) 2025 emtrion GmbH
# SPDX-License-Identifier: Apache-2.0

# Enable MPU
CONFIG_ARM_MPU=y

# Enable HW stack protection
CONFIG_HW_STACK_PROTECTION=y

CONFIG_SERIAL=y

# Enable Console
CONFIG_CONSOLE=y
CONFIG_UART_CONSOLE=y

# Enable GPIO
CONFIG_GPIO=y
```

## boards/enclustra/mercury_xu/Kconfig
```kconfig
# Copyright (c) 2024 Nordic Semiconductor ASA
# SPDX-License-Identifier: Apache-2.0

config UART_XLNX_PS
	select PINCTRL if BOARD_MERCURY_XU
```

## boards/enclustra/mercury_xu/Kconfig.mercury_xu
```kconfig
# Copyright (c) 2020, Antmicro
# SPDX-License-Identifier: Apache-2.0

config BOARD_MERCURY_XU
	select SOC_XILINX_ZYNQMP_RPU
```

## boards/enclustra/mercury_xu/board.yml
```yaml
board:
  name: mercury_xu
  full_name: MERCURY-XU
  vendor: enclustra
  socs:
  - name: zynqmp_rpu
```

## boards/enclustra/mercury_xu/mercury_xu_defconfig
```kconfig
# Copyright (c) 2020, Antmicro

# Enable UART driver
CONFIG_SERIAL=y

# Enable console
CONFIG_CONSOLE=y
CONFIG_UART_CONSOLE=y

# Enable timer
CONFIG_SYS_CLOCK_TICKS_PER_SEC=100

CONFIG_PINCTRL=y
```

## boards/ene/kb1062_evb/Kconfig.kb1062_evb
```kconfig
# Copyright (c) 2025 ENE Technology Inc.
# SPDX-License-Identifier: Apache-2.0

config BOARD_KB1062_EVB
	select SOC_KB1062
```

## boards/ene/kb1062_evb/board.yml
```yaml
board:
  name: kb1062_evb
  full_name: ENE KB1062_EVB
  vendor: ene
  socs:
  - name: kb1062
```

## boards/ene/kb1062_evb/kb1062_evb_defconfig
```kconfig
# Copyright (c) 2025 ENE Technology Inc.
# SPDX-License-Identifier: Apache-2.0

# Enable console & UART driver
CONFIG_SERIAL=y
CONFIG_CONSOLE=y
CONFIG_UART_CONSOLE=y

# Enable GPIO
CONFIG_GPIO=y
```

## boards/ene/kb1200_evb/Kconfig.kb1200_evb
```kconfig
# Copyright (c) 2023 ENE Technology Inc.
# SPDX-License-Identifier: Apache-2.0

config BOARD_KB1200_EVB
	select SOC_KB1200
```

## boards/ene/kb1200_evb/board.yml
```yaml
board:
  name: kb1200_evb
  full_name: ENE KB1200_EVB
  vendor: ene
  socs:
  - name: kb1200
```

## boards/ene/kb1200_evb/kb1200_evb_defconfig
```kconfig
# Copyright (c) 2023 ENE Technology Inc.
# SPDX-License-Identifier: Apache-2.0

# Enable console & UART driver
CONFIG_SERIAL=y
CONFIG_CONSOLE=y
CONFIG_UART_CONSOLE=y
CONFIG_UART_INTERRUPT_DRIVEN=y

# Enable GPIO
CONFIG_GPIO=y
```

## boards/enjoydigital/litex_vexiiriscv/Kconfig.litex_vexiiriscv
```kconfig
# SPDX-FileCopyrightText: Copyright The Zephyr Project Contributors
# SPDX-License-Identifier: Apache-2.0

config BOARD_LITEX_VEXIIRISCV
	select SOC_LITEX_VEXIIRISCV
```

## boards/enjoydigital/litex_vexiiriscv/board.yml
```yaml
board:
  name: litex_vexiiriscv
  full_name: LiteX VexiiRiscv
  vendor: enjoydigital
  socs:
  - name: litex_vexiiriscv
```

## boards/enjoydigital/litex_vexiiriscv/litex_vexiiriscv_defconfig
```kconfig
#
# SPDX-FileCopyrightText: Copyright The Zephyr Project Contributors
#
# SPDX-License-Identifier: Apache-2.0
#

CONFIG_CONSOLE=y
CONFIG_SERIAL=y
CONFIG_UART_CONSOLE=y
CONFIG_HEAP_MEM_POOL_SIZE=4096
```

## boards/enjoydigital/litex_vexriscv/Kconfig.litex_vexriscv
```kconfig
# Copyright (c) 2018 - 2019 Antmicro <www.antmicro.com>
# SPDX-License-Identifier: Apache-2.0

config BOARD_LITEX_VEXRISCV
	select SOC_LITEX_VEXRISCV
```

## boards/enjoydigital/litex_vexriscv/board.yml
```yaml
board:
  name: litex_vexriscv
  full_name: LiteX VexRiscv
  vendor: enjoydigital
  socs:
  - name: litex_vexriscv
```
