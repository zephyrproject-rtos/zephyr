## boards/racyics/riev_fpga_dev_board/Kconfig.riev_fpga_dev_board
```kconfig
# SPDX-FileCopyrightText: Copyright 2026 sensry.io
# SPDX-License-Identifier: Apache-2.0

config BOARD_RIEV_FPGA_DEV_BOARD
	select SOC_EDGEVISION_M85 if BOARD_RIEV_FPGA_DEV_BOARD_EDGEVISION_M85
```

## boards/racyics/riev_fpga_dev_board/board.yml
```yaml
# SPDX-FileCopyrightText: Copyright 2026 sensry.io
# SPDX-License-Identifier: Apache-2.0

board:
  name: riev_fpga_dev_board
  full_name: Racyics edgeVision FPGA Development Board
  vendor: racyics
  socs:
    - name: edgevision
      variants:
        - name: m85
          cpucluster: m85
```

## boards/radxa/radxa_zero_3e/Kconfig.radxa_zero_3e
```kconfig
# SPDX-FileCopyrightText: 2026 Seunghoon Park
# SPDX-License-Identifier: Apache-2.0

config BOARD_RADXA_ZERO_3E
	select SOC_RK3566
```

## boards/radxa/radxa_zero_3e/board.yml
```yaml
board:
  name: radxa_zero_3e
  full_name: Radxa ZERO 3E
  vendor: radxa
  socs:
  - name: rk3566
    variants:
    - name: smp
```

## boards/rakwireless/rak11162/Kconfig
```kconfig
# SPDX-FileCopyrightText: Copyright (c) 2026 RAKwireless Technology Limited
# SPDX-License-Identifier: Apache-2.0

config BOARD_RAK11162
	select BOARD_EARLY_INIT_HOOK if ADC_STM32 || PWM_STM32
	select PINCTRL_DYNAMIC if ADC_STM32 || PWM_STM32
```

## boards/raspberrypi/rpi_5/Kconfig.defconfig
```kconfig
# SPDX-FileCopyrightText: Copyright The Zephyr Project Contributors
# SPDX-License-Identifier: Apache-2.0

if BOARD_RPI_5

configdefault PM_DEVICE
	default y if UDC_DWC2

if PM_DEVICE

configdefault POWER_DOMAIN
	default y

configdefault PM_DEVICE_RUNTIME
	default y if UDC_DWC2

endif # PM_DEVICE

endif # BOARD_RPI_5
```

## boards/raspberrypi/rpi_pico2/board.yml
```yaml
board:
  name: rpi_pico2
  full_name: Raspberry Pi Pico 2
  vendor: raspberrypi
  socs:
    - name: rp2350a
      variants:
        - name: w
          cpucluster: m33_0
          variants:
            - name: mcuboot
              cpucluster: m33_0
        - name: mcuboot
          cpucluster: m33_0
runners:
  run_once:
    '--reset':
      - runners:
          - openocd
        run: last
        groups:
          - boards:
              - rpi_pico2/rp2350a/hazard3_0
              - rpi_pico2/rp2350a/m33_0
              - rpi_pico2/rp2350a/m33_0/mcuboot
              - rpi_pico2/rp2350a/m33_0/w
              - rpi_pico2/rp2350a/m33_0/w/mcuboot
              - rpi_pico2/rp2350a/m33_1
```

## boards/raspberrypi/rpi_zero_w/rpi_zero_w_defconfig
```kconfig
# Copyright (c) 2026 Jonathan Elliot Peace <jep@alphabetiq.com>
# SPDX-License-Identifier: Apache-2.0

# The firmware loads the image into RAM; there is no flash to execute from.
CONFIG_XIP=n

# Serial / console
CONFIG_SERIAL=y
CONFIG_UART_INTERRUPT_DRIVEN=y
CONFIG_CONSOLE=y
CONFIG_UART_CONSOLE=y

# Exception mode stacks
CONFIG_ARMV6_EXCEPTION_STACK_SIZE=4096
CONFIG_ARMV6_FIQ_STACK_SIZE=4096
CONFIG_ARMV6_SVC_STACK_SIZE=4096
CONFIG_ARMV6_SYS_STACK_SIZE=4096

# Kernel stacks
CONFIG_ISR_STACK_SIZE=4096
CONFIG_MAIN_STACK_SIZE=4096
CONFIG_IDLE_STACK_SIZE=4096
```

## boards/renesas/cpk_ra8t2/Kconfig.cpk_ra8t2
```kconfig
# SPDX-FileCopyrightText: Copyright (c) 2026 Process Mission
# SPDX-License-Identifier: Apache-2.0

config BOARD_CPK_RA8T2
	select SOC_R7KA8T2LFLCAC_CM85 if BOARD_CPK_RA8T2_R7KA8T2LFLCAC_CM85
	select SOC_R7KA8T2LFLCAC_CM33 if BOARD_CPK_RA8T2_R7KA8T2LFLCAC_CM33
```

## boards/renesas/cpk_ra8t2/board.yml
```yaml
board:
  name: cpk_ra8t2
  full_name: CPK-RA8T2 Development Kit
  vendor: renesas
  socs:
  - name: r7ka8t2lflcac
```

## boards/seeed/reterminal_sticky/Kconfig.defconfig
```kconfig
# SPDX-FileCopyrightText: Copyright The Zephyr Project Contributors
# SPDX-License-Identifier: Apache-2.0

if BOARD_RETERMINAL_STICKY_ESP32S3_PROCPU

# Needed for the power button long press handling
configdefault INPUT
	default y if !MCUBOOT

if LVGL

choice LV_Z_COLOR_FORMAT
	default LV_Z_COLOR_FORMAT_I1
endchoice

endif # LVGL

endif # BOARD_RETERMINAL_STICKY_ESP32S3_PROCPU
```

## boards/seeed/wio_rp2040_mini/Kconfig
```kconfig
# Copyright (c) 2023 Seeed Studio inc.
# SPDX-License-Identifier: Apache-2.0

if BOARD_WIO_RP2040_MINI

config RP2_FLASH_W25Q080
	bool "W25Q080 flash support"
	default y

endif # BOARD_WIO_RP2040_MINI
```

## boards/seeed/wio_rp2040_mini/Kconfig.defconfig
```kconfig
# Copyright (c) 2023 Seeed Studio inc.
# SPDX-License-Identifier: Apache-2.0

if BOARD_WIO_RP2040_MINI

if I2C_DW

config I2C_DW_CLOCK_SPEED
	default 125

endif # I2C_DW

config USB_SELF_POWERED
	default n

endif # BOARD_WIO_RP2040_MINI
```

## boards/seeed/wio_rp2040_mini/Kconfig.wio_rp2040_mini
```kconfig
# wio_rp2040_mini board configuration

# Copyright (c) 2023 Seeed Studio inc.
# SPDX-License-Identifier: Apache-2.0

config BOARD_WIO_RP2040_MINI
	select SOC_RP2040
```

## boards/seeed/wio_rp2040_mini/board.yml
```yaml
board:
  name: wio_rp2040_mini
  full_name: Wio RP2040 Mini Dev Board
  vendor: seeed
  socs:
    - name: rp2040
```

## boards/seeed/wio_tracker_l2/Kconfig.wio_tracker_l2
```kconfig
# SPDX-FileCopyrightText: Copyright The Zephyr Project Contributors
# SPDX-License-Identifier: Apache-2.0

config BOARD_WIO_TRACKER_L2
	select SOC_ESP32S3
	select SOC_ESP32S3_PROCPU if BOARD_WIO_TRACKER_L2_ESP32S3_PROCPU
	select SOC_ESP32S3_APPCPU if BOARD_WIO_TRACKER_L2_ESP32S3_APPCPU
```

## boards/seeed/wio_tracker_l2/board.yml
```yaml
# SPDX-FileCopyrightText: Copyright The Zephyr Project Contributors
# SPDX-License-Identifier: Apache-2.0

board:
  name: wio_tracker_l2
  full_name: Wio Tracker L2 Pro
  vendor: seeed
  socs:
    - name: esp32s3
```

## boards/seeed/wio_tracker_l2/wio_tracker_l2_procpu_defconfig
```kconfig
# SPDX-FileCopyrightText: Copyright The Zephyr Project Contributors
# SPDX-License-Identifier: Apache-2.0

CONFIG_CONSOLE=y
CONFIG_SERIAL=y
CONFIG_UART_CONSOLE=y
CONFIG_GPIO=y
CONFIG_I2C=y
CONFIG_SOC_FAMILY_ESPRESSIF_SPIRAM=y
```

## boards/shields/mikroe_flash_15_click/Kconfig.shield
```kconfig
# Copyright The Zephyr Project Contributors
# SPDX-License-Identifier: Apache-2.0

config SHIELD_MIKROE_FLASH_15_CLICK
	def_bool $(shields_list_contains,mikroe_flash_15_click)
```

## boards/shields/mikroe_relay_2_click/Kconfig.shield
```kconfig
# Copyright The Zephyr Project Contributors
# SPDX-License-Identifier: Apache-2.0

config SHIELD_MIKROE_RELAY_2_CLICK
	def_bool $(shields_list_contains,mikroe_relay_2_click)
```
