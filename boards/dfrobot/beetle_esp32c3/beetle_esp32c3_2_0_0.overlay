/*
 * Copyright (c) 2025 Mikołaj Rosowski
 *
 * SPDX-License-Identifier: Apache-2.0
 */

#include <zephyr/dt-bindings/gpio/gpio.h>
#include <zephyr/dt-bindings/input/input-event-codes.h>

/ {
	aliases {
		sw0 = &boot_button;
	};

	buttons {
		compatible = "gpio-keys";

		boot_button: button0 {
			gpios = <&gpio0 9 (GPIO_PULL_UP | GPIO_ACTIVE_LOW)>;
			label = "BOOT button";
			zephyr,code = <INPUT_KEY_0>;
		};
	};
};
