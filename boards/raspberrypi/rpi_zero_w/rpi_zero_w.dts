/*
 * Copyright (c) 2026 Jonathan Elliot Peace <jep@alphabetiq.com>
 *
 * SPDX-License-Identifier: Apache-2.0
 */

/dts-v1/;

#include <broadcom/bcm2835.dtsi>

/ {
	model = "Raspberry Pi Zero W";
	compatible = "raspberrypi,model-zero-w", "brcm,bcm2835";

	chosen {
		zephyr,console = &uart1;
		zephyr,shell-uart = &uart1;
		zephyr,sram = &sram0;
	};
};

/* Console on the AUX mini-UART (GPIO 14/15, ALT5). PL011 is left on the
 * Bluetooth modem; using the mini-UART avoids the disable-bt dance.
 */
&uart1 {
	current-speed = <115200>;
	pinctrl-0 = <&uart1_gpio14>;
	pinctrl-names = "default";
	status = "okay";
};
