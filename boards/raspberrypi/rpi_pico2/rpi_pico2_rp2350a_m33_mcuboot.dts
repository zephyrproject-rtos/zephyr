/*
 * Copyright (c) 2024 Andrew Featherstone
 *
 * SPDX-License-Identifier: Apache-2.0
 */

/dts-v1/;

/* The build system assumes that there's a cpucluster-specific file.
 *
 * This file provides composition of the device tree:
 * 1. The common features of the SoC
 * 2. Core-specific configuration.
 * 3. Board-specific configuration.
 */
#include <raspberrypi/rpi_pico/rp2350a.dtsi>
#include <raspberrypi/rpi_pico/m33.dtsi>

/* there's nothing specific to the Cortex-M33 cores vs the (not yet
 * implemented) Hazard3 cores.
 */
#include "rpi_pico2.dtsi"

/* Partitioning for the RP2350A-M33 board using 4M flash.
 */
#include <raspberrypi/partitions_4M_sysbuild.dtsi>
/ {
	chosen {
		zephyr,code-partition = &slot0_partition;
	};
};
