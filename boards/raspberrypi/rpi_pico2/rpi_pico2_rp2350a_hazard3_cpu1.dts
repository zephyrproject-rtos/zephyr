/*
 * Copyright (c) 2026 The Zephyr Project Contributors
 *
 * SPDX-License-Identifier: Apache-2.0
 */

/dts-v1/;

#include <raspberrypi/rpi_pico/rp2350a.dtsi>
#include <riscv/raspberrypi/hazard3.dtsi>
#include "rpi_pico2_cpu1_common.dtsi"
