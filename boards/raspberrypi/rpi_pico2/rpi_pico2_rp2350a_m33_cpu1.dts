/*
 * Copyright (c) 2024 Andrew Featherstone
 *
 * SPDX-License-Identifier: Apache-2.0
 */

/dts-v1/;

/* The build system assumes that there's a cpucluster-specific file.
 *
 * This file provides composition of the devicetree:
 * 1. The common features of the SoC
 * 2. Core-specific configuration.
 * 3. Board-specific configuration.
 */
#include <raspberrypi/rpi_pico/rp2350a.dtsi>
#include <raspberrypi/rpi_pico/m33.dtsi>

/* there's nothing specific to the Cortex-M33 cores vs the (not yet
 * implemented) Hazard3 cores.
 */
#include "rpi_pico2.dtsi"
#include <raspberrypi/rp2350_shared_reserved_memory.dtsi>

/ {
	chosen {
		zephyr,sram = &sram0_cpu1;
		/* Flash is only assigned to CPU0, CPU1 must
		 * execute from RAM to avoid access conflicts
		 * You can add a code-partition
		 * Then add image-source to the &cpu1_launcher on cpu0
		 * zephyr,code-partition = &cpu1_slot0_partition;
		 */
		// zephyr,code-partition = &sram0_cpu1;

		/* It is possible to have a zephyr,code-partition in a partition the
		 * board does not control. This is necessary to have the image start
		 * address in flash, so openocd can flash the cpu1 image. I am not sure
		 * if it is necessary to re-define the flash node with the cpu1-specific
		 * address space in this dts since, with CONFIG_XIP=n, cpu1 should not
		 * access the flash while its code is executing (I think????).
		 */
		zephyr,code-partition = &cpu1_slot0_partition;
	};
};

zephyr_udc0: &usbd {
	status = "okay";
};

/* Include default memory partition configuration file */
#define WITH_CPU1_PARTITIONS
#include <raspberrypi/partitions_4M_default.dtsi>
