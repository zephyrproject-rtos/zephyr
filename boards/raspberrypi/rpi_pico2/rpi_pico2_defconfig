## boards/raspberrypi/rpi_pico2/rpi_pico2_defconfig
```kconfig
CONFIG_CLOCK_CONTROL=y
CONFIG_CONSOLE=y
CONFIG_GPIO=y
CONFIG_RESET=y
CONFIG_SERIAL=y
CONFIG_SYS_CLOCK_HW_CYCLES_PER_SEC=150000000
CONFIG_UART_CONSOLE=y
CONFIG_UART_INTERRUPT_DRIVEN=y
CONFIG_USE_DT_CODE_PARTITION=y
```

## boards/raspberrypi/rpi_pico2/rpi_pico2_rp2350a_m33_w_mcuboot_defconfig
```kconfig
# This configuration is orthogonal to whether the Cortex-M33 or Hazard3 cores
# are in use, but Zephyr does not support providing a qualifier-agnostic
# _defconfig file.
CONFIG_BUILD_OUTPUT_HEX=y
CONFIG_BUILD_OUTPUT_UF2=y
CONFIG_CLOCK_CONTROL=y
CONFIG_CONSOLE=y
CONFIG_GPIO=y
CONFIG_RESET=y
CONFIG_SERIAL=y
CONFIG_UART_CONSOLE=y
CONFIG_UART_INTERRUPT_DRIVEN=y
CONFIG_USE_DT_CODE_PARTITION=y
```

## boards/raspberrypi/rpi_zero_w/Kconfig.rpi_zero_w
```kconfig
# Copyright (c) 2026 Jonathan Elliot Peace <jep@alphabetiq.com>
# SPDX-License-Identifier: Apache-2.0

config BOARD_RPI_ZERO_W
	select SOC_BCM2835
```

## boards/raspberrypi/rpi_zero_w/board.yml
```yaml
board:
  name: rpi_zero_w
  full_name: Raspberry Pi Zero / Zero W (ARM1176)
  vendor: raspberrypi
  socs:
  - name: bcm2835
```

## boards/raspberrypi/rpi_zero_w/rpi_zero_w_defconfig
```kconfig
# SPDX-License-Identifier: Apache-2.0

# RAM-loaded image -- no execute-in-place flash.
CONFIG_XIP=n

# Serial / console, interrupt-driven (shell needs UART RX interrupts).
CONFIG_SERIAL=y
CONFIG_CONSOLE=y
CONFIG_UART_CONSOLE=y
CONFIG_UART_INTERRUPT_DRIVEN=y

# Full managed MMU (arm_mmu.c) — auto-enabled via CPU_HAS_MMU + the
# VMSA_V7 short-descriptor path (ARM1176 uses it with XP instead of AFE).

# Classic ARM mode / exception stacks.
CONFIG_ARMV6_EXCEPTION_STACK_SIZE=4096
CONFIG_ARMV6_FIQ_STACK_SIZE=4096
CONFIG_ARMV6_SVC_STACK_SIZE=4096
CONFIG_ARMV6_SYS_STACK_SIZE=4096

# Kernel stacks.
CONFIG_ISR_STACK_SIZE=4096
CONFIG_MAIN_STACK_SIZE=4096
CONFIG_IDLE_STACK_SIZE=4096

# VC mailbox firmware driver -- required to power on the USB PHY
# (rpi_fw SET_POWER_STATE) when the DWC2 USB controller is in use.
# Cheap when unused; enables the upstream `cdc-acm-console` snippet
# to bring up a single-cable shell on the OTG micro-USB port.
CONFIG_RASPBERRYPI_FIRMWARE=y

# BCM2835-specific USB-CDC tuning -- the upstream `cdc-acm-console`
# snippet is generic and assumes the DWC2 controller's DMA-mode init
# and default stack sizes work. They don't on BCM2835/AArch32:
#   - DWC2 IP variant hangs in DMA-descriptor init (use buffered I/O)
#   - default 1KB USBD/UDC thread stacks silently overflow on AArch32
#   - boot-time CDC ACM auto-init races the rpi_fw USB power-on
CONFIG_UDC_DWC2_DMA=n
CONFIG_UDC_DWC2_STACK_SIZE=4096
CONFIG_USBD_THREAD_STACK_SIZE=4096
CONFIG_CDC_ACM_SERIAL_INITIALIZE_AT_BOOT=n
```

## boards/raytac/an54l15q_db/board.yml
```yaml
board:
  name: raytac_an54l15q_db
  full_name: AN54L15Q-DB
  vendor: raytac
  socs:
    - name: nrf54l15
      variants:
        - name: xip
          cpucluster: cpuflpr
        - name: ns
          cpucluster: cpuapp
runners:
  run_once:
    '--recover':
      - runners:
          - nrfjprog
          - nrfutil
        run: first
        groups:
          - boards:
              - raytac_an54l15q_db/nrf54l15/cpuapp
              - raytac_an54l15q_db/nrf54l15/cpuflpr
              - raytac_an54l15q_db/nrf54l15/cpuflpr/xip
    '--erase':
      - runners:
          - nrfjprog
          - jlink
          - nrfutil
        run: first
        groups:
          - boards:
              - raytac_an54l15q_db/nrf54l15/cpuapp
              - raytac_an54l15q_db/nrf54l15/cpuflpr
              - raytac_an54l15q_db/nrf54l15/cpuflpr/xip
    '--reset':
      - runners:
          - nrfjprog
          - jlink
          - nrfutil
        run: last
        groups:
          - boards:
              - raytac_an54l15q_db/nrf54l15/cpuapp
              - raytac_an54l15q_db/nrf54l15/cpuflpr
              - raytac_an54l15q_db/nrf54l15/cpuflpr/xip
```

## boards/raytac/an54lq_db_15/Kconfig.defconfig
```kconfig
# Copyright (c) 2024 Nordic Semiconductor ASA
# Copyright (c) 2025 Raytac Corporation.
# SPDX-License-Identifier: Apache-2.0

config HW_STACK_PROTECTION
	default ARCH_HAS_STACK_PROTECTION

if BOARD_RAYTAC_AN54LQ_DB_15_NRF54L15_CPUAPP

config ROM_START_OFFSET
	default 0x800 if BOOTLOADER_MCUBOOT

endif # BOARD_RAYTAC_AN54LQ_DB_15_NRF54L15_CPUAPP

if BOARD_RAYTAC_AN54LQ_DB_15_NRF54L15_CPUAPP_NS

config BOARD_RAYTAC_AN54LQ_DB_15
	select USE_DT_CODE_PARTITION if BOARD_RAYTAC_AN54LQ_DB_15_NRF54L15_CPUAPP_NS

config HAS_BT_CTLR
	default BT

# By default, if we build for a Non-Secure version of the board,
# enable building with TF-M as the Secure Execution Environment.
config BUILD_WITH_TFM
	default y

endif # BOARD_RAYTAC_AN54LQ_DB_15_NRF54L15_CPUAPP_NS
```

## boards/raytac/an54lq_db_15/Kconfig.raytac_an54lq_db_15
```kconfig
# Copyright (c) 2024 Nordic Semiconductor ASA
# Copyright (c) 2025 Raytac Corporation.
# SPDX-License-Identifier: Apache-2.0

config BOARD_RAYTAC_AN54LQ_DB_15
	select SOC_NRF54L15_CPUAPP if BOARD_RAYTAC_AN54LQ_DB_15_NRF54L15_CPUAPP || BOARD_RAYTAC_AN54LQ_DB_15_NRF54L15_CPUAPP_NS
	select SOC_NRF54L15_CPUFLPR if BOARD_RAYTAC_AN54LQ_DB_15_NRF54L15_CPUFLPR || \
					    BOARD_RAYTAC_AN54LQ_DB_15_NRF54L15_CPUFLPR_XIP
```

## boards/raytac/an54lq_db_15/board.yml
```yaml
board:
  name: raytac_an54lq_db_15
  full_name: AN54LQ-DB-15
  vendor: raytac
  socs:
    - name: nrf54l15
      variants:
        - name: xip
          cpucluster: cpuflpr
        - name: ns
          cpucluster: cpuapp
runners:
  run_once:
    '--recover':
      - runners:
          - nrfjprog
          - nrfutil
        run: first
        groups:
          - boards:
              - raytac_an54lq_db_15/nrf54l15/cpuapp
              - raytac_an54lq_db_15/nrf54l15/cpuapp/ns
              - raytac_an54lq_db_15/nrf54l15/cpuflpr
              - raytac_an54lq_db_15/nrf54l15/cpuflpr/xip
    '--erase':
      - runners:
          - nrfjprog
          - jlink
          - nrfutil
        run: first
        groups:
          - boards:
              - raytac_an54lq_db_15/nrf54l15/cpuapp
              - raytac_an54lq_db_15/nrf54l15/cpuapp/ns
              - raytac_an54lq_db_15/nrf54l15/cpuflpr
              - raytac_an54lq_db_15/nrf54l15/cpuflpr/xip
    '--reset':
      - runners:
          - nrfjprog
          - jlink
          - nrfutil
        run: last
        groups:
          - boards:
              - raytac_an54lq_db_15/nrf54l15/cpuapp
              - raytac_an54lq_db_15/nrf54l15/cpuapp/ns
              - raytac_an54lq_db_15/nrf54l15/cpuflpr
              - raytac_an54lq_db_15/nrf54l15/cpuflpr/xip
```

## boards/raytac/an7002q_db/Kconfig
```kconfig
# Raytac AN7002Q-DB-5340 board configuration

# Copyright (c) 2024 Nordic Semiconductor ASA
# Copyright (c) 2025 Raytac Corporation.
# SPDX-License-Identifier: Apache-2.0

config IPM_NRFX
	default IPM

config MBOX_NRFX_IPC
	default MBOX

if BOARD_RAYTAC_AN7002Q_DB_NRF5340_CPUAPP

config BT_HCI_IPC
	default y if BT

config HEAP_MEM_POOL_ADD_SIZE_BOARD
	int
	default 4096 if BT_HCI_IPC

endif

if BOARD_RAYTAC_AN7002Q_DB_NRF5340_CPUNET

config BT_ECC
	default y if BT

endif
```

## boards/raytac/an7002q_db/Kconfig.raytac_an7002q_db
```kconfig
# Copyright (c) 2024 Nordic Semiconductor
# Copyright (c) 2025 Raytac Corporation.
# SPDX-License-Identifier: Apache-2.0

config BOARD_RAYTAC_AN7002Q_DB
	select SOC_NRF5340_CPUNET_QKAA if BOARD_RAYTAC_AN7002Q_DB_NRF5340_CPUNET
	select SOC_NRF5340_CPUAPP_QKAA if BOARD_RAYTAC_AN7002Q_DB_NRF5340_CPUAPP
```

## boards/raytac/an7002q_db/board.yml
```yaml
board:
  name: raytac_an7002q_db
  full_name: AN7002Q-DB-5340
  vendor: raytac
  socs:
    - name: nrf5340
```

## boards/raytac/an7002q_db/raytac_an7002q_db_nrf5340_cpuapp_defconfig
```kconfig
# SPDX-License-Identifier: Apache-2.0

# Enable MPU
CONFIG_ARM_MPU=y

# Enable hardware stack protection
CONFIG_HW_STACK_PROTECTION=y

# Enable TrustZone-M
CONFIG_ARM_TRUSTZONE_M=y

# Enable GPIO
CONFIG_GPIO=y

# Enable UART driver
CONFIG_SERIAL=y

# Enable console
CONFIG_CONSOLE=y
CONFIG_UART_CONSOLE=y

# Enable RNG
CONFIG_MBEDTLS_PSA_CRYPTO_EXTERNAL_RNG=y
CONFIG_MBEDTLS_PSA_CRYPTO_EXTERNAL_RNG_ALLOW_NON_CSPRNG=y

# ISN needs CS-Rand which isn't supported upstream for nRF boards
CONFIG_NET_TCP_ISN_RFC6528=n
```

## boards/raytac/mdbt50q_cx_40_dongle/Kconfig
```kconfig
# Raytac MDBT50Q-CX Dongle NRF52840 board configuration
#
# Copyright (c) 2018-2023 Nordic Semiconductor ASA
# Copyright (c) 2025 Raytac Corporation.
# SPDX-License-Identifier: Apache-2.0

if BOARD_RAYTAC_MDBT50Q_CX_40_DONGLE

config BOARD_HAS_NRF5_BOOTLOADER
	bool "Board has nRF5 bootloader"
	default y
	help
	  If selected, applications are linked so that they can be loaded by Nordic
	  nRF5 bootloader.

endif # BOARD_RAYTAC_MDBT50Q_CX_40_DONGLE
```

## boards/raytac/mdbt50q_cx_40_dongle/Kconfig.raytac_mdbt50q_cx_40_dongle
```kconfig
# Raytac MDBT50Q-CX-40 Dongle nRF52840 board configuration
#
# Copyright (c) 2018 Nordic Semiconductor ASA
# Copyright (c) 2025 Raytac Corporation
# SPDX-License-Identifier: Apache-2.0

config BOARD_RAYTAC_MDBT50Q_CX_40_DONGLE
	select SOC_NRF52840_QIAA
```

## boards/raytac/mdbt50q_cx_40_dongle/board.yml
```yaml
board:
  name: raytac_mdbt50q_cx_40_dongle
  full_name: MDBT50Q-CX-40 Dongle
  vendor: raytac
  socs:
  - name: nrf52840
```

## boards/raytac/mdbt50q_db_33/Kconfig.defconfig
```kconfig
# Raytac MDBT50Q-DB-33 NRF52833 board configuration

# Copyright (c) 2022 Raytac Corporation
# SPDX-License-Identifier: Apache-2.0

if BOARD_RAYTAC_MDBT50Q_DB_33

config BT_CTLR
	default BT

endif # BOARD_RAYTAC_MDBT50Q_DB_33
```

## boards/raytac/mdbt50q_db_33/Kconfig.raytac_mdbt50q_db_33
```kconfig
# Raytac MDBT50Q-DB-33 nRF52833 board configuration

# Copyright (c) 2022 Nordic Semiconductor ASA
# SPDX-License-Identifier: Apache-2.0

config BOARD_RAYTAC_MDBT50Q_DB_33
	select SOC_NRF52833_QIAA
```

## boards/raytac/mdbt50q_db_33/board.yml
```yaml
board:
  name: raytac_mdbt50q_db_33
  full_name: MDBT50Q-DB-33
  vendor: raytac
  socs:
  - name: nrf52833
```

## boards/raytac/mdbt50q_db_33/raytac_mdbt50q_db_33_nrf52833_defconfig
```kconfig
# Raytac MDBT50Q_DB_33 NRF52833 board configuration

# Copyright (c) 2022 Raytac Corporation
# SPDX-License-Identifier: Apache-2.0

# Enable MPU
CONFIG_ARM_MPU=y

# Enable hardware stack protection
CONFIG_HW_STACK_PROTECTION=y

# Enable RTT
CONFIG_USE_SEGGER_RTT=y

# enable GPIO
CONFIG_GPIO=y

# enable uart driver
CONFIG_SERIAL=y

# enable console
CONFIG_CONSOLE=y
CONFIG_UART_CONSOLE=y
```

## boards/raytac/mdbt50q_db_40/Kconfig.raytac_mdbt50q_db_40
```kconfig
# Raytac MDBT50Q-DB-40 nRF52840 board configuration

# Copyright (c) 2022 Raytac Corporation
# SPDX-License-Identifier: Apache-2.0

config BOARD_RAYTAC_MDBT50Q_DB_40
	select SOC_NRF52840_QIAA
```

## boards/raytac/mdbt50q_db_40/board.yml
```yaml
board:
  name: raytac_mdbt50q_db_40
  full_name: MDBT50Q-DB-40
  vendor: raytac
  socs:
  - name: nrf52840
```

## boards/raytac/mdbt53v_db_40/Kconfig
```kconfig
# Ratac MDBT53V-DB-40 nRF5340 board configuration

# Copyright (c) 2019 - 2021 Nordic Semiconductor ASA
# SPDX-License-Identifier: Apache-2.0

if BOARD_RAYTAC_MDBT53V_DB_40_NRF5340_CPUAPP || BOARD_RAYTAC_MDBT53V_DB_40_NRF5340_CPUAPP_NS

config BOARD_ENABLE_DCDC_APP
	bool "Application MCU DCDC converter"
	select SOC_DCDC_NRF53X_APP
	default y

config BOARD_ENABLE_DCDC_NET
	bool "Network MCU DCDC converter"
	select SOC_DCDC_NRF53X_NET
	default y

config BOARD_ENABLE_DCDC_HV
	bool "High Voltage DCDC converter"
	select SOC_DCDC_NRF53X_HV
	default y

config DOMAIN_CPUNET_BOARD
	string
	default "raytac_mdbt53v_db_40/nrf5340/cpunet"
	help
	  The board which will be used for CPUNET domain when creating a multi
	  image application where one or more images should be located on
	  another board. For example hci_ipc on the nRF5340_cpunet for
	  Bluetooth applications.

endif # BOARD_RAYTAC_MDBT53V_DB_40_NRF5340_CPUAPP || BOARD_RAYTAC_MDBT53V_DB_40_NRF5340_CPUAPP_NS

if BOARD_RAYTAC_MDBT53V_DB_40_NRF5340_CPUNET

config DOMAIN_CPUAPP_BOARD
	string
	default "raytac_mdbt53v_db_40/nrf5340/cpuapp"
	help
	  The board which will be used for CPUAPP domain when creating a multi
	  image application where one or more images should be located on
	  another board.

endif # BOARD_RAYTAC_MDBT53V_DB_40_NRF5340_CPUNET
```

## boards/raytac/mdbt53v_db_40/Kconfig.raytac_mdbt53v_db_40
```kconfig
# Raytac MDBT53-DB-40 NRF5340 board configuration

# Copyright (c) 2019-2020 Nordic Semiconductor ASA
# SPDX-License-Identifier: Apache-2.0

config BOARD_RAYTAC_MDBT53V_DB_40
	select SOC_NRF5340_CPUAPP_QKAA if BOARD_RAYTAC_MDBT53V_DB_40_NRF5340_CPUAPP
	select SOC_NRF5340_CPUAPP_QKAA if BOARD_RAYTAC_MDBT53V_DB_40_NRF5340_CPUAPP_NS
	select SOC_NRF5340_CPUNET_QKAA if BOARD_RAYTAC_MDBT53V_DB_40_NRF5340_CPUNET
```
