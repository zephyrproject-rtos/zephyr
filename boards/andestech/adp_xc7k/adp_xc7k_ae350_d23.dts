/*
 * Copyright (c) 2026 Andes Technology Corporation
 *
 * SPDX-License-Identifier: Apache-2.0
 */

/dts-v1/;

#include <andes/andes_v5_ae350_d23.dtsi>
#include "adp_xc7k_common.dtsi"
#include <zephyr/dt-bindings/input/input-event-codes.h>

/ {
	compatible = "andestech,adp_xc7k_ae350";
	model = "Andes ADP-XC7K AE350";
};

&mbox {
	status = "okay";
};
