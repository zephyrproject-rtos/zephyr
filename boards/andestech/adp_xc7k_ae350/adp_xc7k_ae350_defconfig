## boards/andestech/adp_xc7k_ae350/adp_xc7k_ae350_defconfig
```kconfig
CONFIG_XIP=n
CONFIG_CONSOLE=y
CONFIG_UART_CONSOLE=y

# Serial driver options
CONFIG_SERIAL=y

# GPIO driver options
CONFIG_GPIO=y

# PMP granularity options
CONFIG_PMP_GRANULARITY=8
```

## boards/andestech/adp_xc7k_ae350/board.yml
```yaml
board:
  name: adp_xc7k
  full_name: ADP-XC7K AE350
  vendor: andestech
  socs:
  - name: ae350
```

## boards/antmicro/myra_sip_baseboard/Kconfig.defconfig
```kconfig
# Copyright (c) 2024 Antmicro <www.antmicro.com>
# SPDX-License-Identifier: Apache-2.0

if BOARD_MYRA_SIP_BASEBOARD

config SPI_STM32_INTERRUPT
	default y
	depends on SPI

endif # BOARD_MYRA_SIP_BASEBOARD
```

## boards/antmicro/myra_sip_baseboard/Kconfig.myra_sip_baseboard
```kconfig
# Copyright (c) 2024 Antmicro
# SPDX-License-Identifier: Apache-2.0

config BOARD_MYRA_SIP_BASEBOARD
	select SOC_MYRA
```

## boards/antmicro/myra_sip_baseboard/myra_sip_baseboard_defconfig
```kconfig
# Copyright (c) 2024 Antmicro <www.antmicro.com>
# SPDX-License-Identifier: Apache-2.0

CONFIG_SERIAL=y
CONFIG_GPIO=y
CONFIG_CLOCK_CONTROL=y
CONFIG_CONSOLE=y
CONFIG_UART_CONSOLE=y
CONFIG_ARM_MPU=y
CONFIG_HW_STACK_PROTECTION=y
```

## boards/antmicro/stm32h7_renode_reference_board/Kconfig.defconfig
```kconfig
# Copyright (c) 2026 Antmicro <www.antmicro.com>
# SPDX-License-Identifier: Apache-2.0

if BOARD_STM32H7_RENODE_REFERENCE_BOARD

configdefault NET_L2_ETHERNET
	default y

endif # BOARD_STM32H7_RENODE_REFERENCE_BOARD
```

## boards/antmicro/stm32h7_renode_reference_board/Kconfig.stm32h7_renode_reference_board
```kconfig
# Copyright (c) 2026 Antmicro <www.antmicro.com>
# SPDX-License-Identifier: Apache-2.0

config BOARD_STM32H7_RENODE_REFERENCE_BOARD
	select SOC_STM32H753XX
```

## boards/antmicro/stm32h7_renode_reference_board/board.yml
```yaml
board:
  name: stm32h7_renode_reference_board
  full_name: STM32H7 Renode Reference Platform
  vendor: antmicro
  socs:
    - name: stm32h753xx
```

## boards/antmicro/stm32h7_renode_reference_board/stm32h7_renode_reference_board_defconfig
```kconfig
# Copyright (c) 2026 Antmicro <www.antmicro.com>
# SPDX-License-Identifier: Apache-2.0

# Enable MPU
CONFIG_ARM_MPU=y

# Enable HW stack protection
CONFIG_HW_STACK_PROTECTION=y

# Enable UART
CONFIG_SERIAL=y

# Enable console
CONFIG_CONSOLE=y
CONFIG_UART_CONSOLE=y

# GPIO with HOGS
CONFIG_GPIO=y
CONFIG_GPIO_HOGS=y
```

## boards/arc/arduino_101_sss/Kconfig.board
```kconfig
config BOARD_ARDUINO_101_SSS
	bool "Arduino 101 Sensor Sub System"
	depends on SOC_QUARK_SE_C1000_SS
	select HAS_DTS
```

## boards/arc/arduino_101_sss/Kconfig.defconfig
```kconfig
if BOARD_ARDUINO_101_SSS

config BOARD
	default "arduino_101_sss"

if FLASH && SPI

config SPI_FLASH_W25QXXDV
	def_bool y

config SPI_FLASH_W25QXXDV_SPI_NAME
	default "SPI_2"

config SPI_FLASH_W25QXXDV_SPI_SLAVE
	default 1

endif # FLASH && SPI

endif # BOARD_ARDUINO_101_SSS
```

## boards/arc/arduino_101_sss/arduino_101_sss_defconfig
```kconfig
CONFIG_ARC=y
CONFIG_SOC_QUARK_SE_C1000_SS=y
CONFIG_BOARD_ARDUINO_101_SSS=y
CONFIG_SYS_CLOCK_TICKS_PER_SEC=100
CONFIG_SYS_CLOCK_HW_CYCLES_PER_SEC=32000000
CONFIG_XIP=y
CONFIG_PRINTK=y
CONFIG_CPU_ARCEM4=y
CONFIG_CPU_ARCV2=y
CONFIG_ARCV2_INTERRUPT_UNIT=y
CONFIG_ARCV2_TIMER=y
CONFIG_SPI_DW_PORT_0_INTERRUPT_SINGLE_LINE=n
CONFIG_UART_QMSI=y
CONFIG_CONSOLE=y
CONFIG_UART_CONSOLE=y
CONFIG_SERIAL=y
```

## boards/arc/axs/Kconfig.board
```kconfig
# DesignWare ARC HS Development Kit board configuration

# Copyright (c) 2020 Synopsys, Inc. All rights reserved.
# SPDX-License-Identifier: Apache-2.0

config BOARD_AXS
	bool "ARC AXS Board"
	depends on SOC_ARC_AXS
	help
	  ARC AXS Board
```

## boards/arc/axs/Kconfig.defconfig
```kconfig
# Copyright (c) 2020 Synopsys, Inc. All rights reserved.
# SPDX-License-Identifier: Apache-2.0

if BOARD_AXS

config BOARD
	default "axs"

endif # BOARD_AXS
```

## boards/arc/em_starterkit/Kconfig
```kconfig
# DesignWare ARC EM Starter Kit board configuration options

# Copyright (c) 2017 Synopsys, Inc. All rights reserved.
# SPDX-License-Identifier: Apache-2.0

choice
	prompt "Board Firmware Version"
	default BOARD_EM_STARTERKIT_R23
	depends on BOARD_EM_STARTERKIT

	config BOARD_EM_STARTERKIT_R22
		bool "2.2"

	config BOARD_EM_STARTERKIT_R23
		bool "2.3"

endchoice
```

## boards/arc/em_starterkit/Kconfig.defconfig
```kconfig
# SPDX-License-Identifier: Apache-2.0

if BOARD_EM_STARTERKIT

config BOARD
	default "em_starterkit"

if GPIO

config GPIO_INIT_PRIORITY
	default 70

endif # GPIO

if I2C

config I2C_DW
	default y

if I2C_DW

config I2C_DW_CLOCK_SPEED
	default 100

endif # I2C_DW

endif # I2C

if SPI_DW

config SPI_DW_FIFO_DEPTH
	default 32

config SPI_DW_ARC_AUX_REGS
	default n

endif # SPI_DW

endif # BOARD_EM_STARTERKIT
```

## boards/arc/em_starterkit/Kconfig.em_starterkit_em11d
```kconfig
# Copyright (c) 2022 Zephyr Project members and individual contributors
# SPDX-License-Identifier: Apache-2.0

config BOARD_EM_STARTERKIT_R23
	bool
	default y
	select SOC_EMSK
	select SOC_EMSK_EM11D
```

## boards/arc/em_starterkit/em_starterkit_defconfig
```kconfig
# SPDX-License-Identifier: Apache-2.0

CONFIG_ARC=y
CONFIG_CPU_ARCEM=y
CONFIG_SOC_EMSK=y
CONFIG_SOC_EMSK_EM9D=y
CONFIG_BOARD_EM_STARTERKIT=y
CONFIG_BOARD_EM_STARTERKIT_R23=y
CONFIG_XIP=n
CONFIG_BUILD_OUTPUT_BIN=n
CONFIG_PRINTK=y
CONFIG_ARCV2_INTERRUPT_UNIT=y
CONFIG_ARCV2_TIMER=y
CONFIG_CONSOLE=y
CONFIG_UART_CONSOLE=y
CONFIG_SERIAL=y
CONFIG_UART_INTERRUPT_DRIVEN=y
CONFIG_GPIO=y
```

## boards/arc/em_starterkit/em_starterkit_em11d_defconfig
```kconfig
CONFIG_ARC=y
CONFIG_SOC_EMSK=y
CONFIG_SOC_EMSK_EM11D=y
CONFIG_BOARD_EM_STARTERKIT=y
CONFIG_BOARD_EM_STARTERKIT_R23=y
CONFIG_SYS_CLOCK_TICKS_PER_SEC=100
CONFIG_XIP=n
CONFIG_BUILD_OUTPUT_BIN=n
CONFIG_PRINTK=y
CONFIG_ARCV2_INTERRUPT_UNIT=y
CONFIG_ARCV2_TIMER=y
CONFIG_CONSOLE=y
CONFIG_UART_CONSOLE=y
CONFIG_SERIAL=y
CONFIG_UART_INTERRUPT_DRIVEN=y
CONFIG_GPIO=y
```

## boards/arc/em_starterkit/em_starterkit_em7d_v22_defconfig
```kconfig
# SPDX-License-Identifier: Apache-2.0

CONFIG_ARC=y
CONFIG_CPU_ARCEM=y
CONFIG_SOC_EMSK=y
CONFIG_SOC_EMSK_EM7D=y
CONFIG_BOARD_EM_STARTERKIT=y
CONFIG_BOARD_EM_STARTERKIT_R22=y
CONFIG_XIP=n
CONFIG_BUILD_OUTPUT_BIN=n
CONFIG_PRINTK=y
CONFIG_ARCV2_INTERRUPT_UNIT=y
CONFIG_ARCV2_TIMER=y
CONFIG_CONSOLE=y
CONFIG_UART_CONSOLE=y
CONFIG_SERIAL=y
CONFIG_UART_INTERRUPT_DRIVEN=y
CONFIG_GPIO=y
CONFIG_ARC_MPU_ENABLE=y
```

## boards/arc/emsdp/Kconfig.board
```kconfig
# DesignWare ARC EM Software Development Platform board configuration

# Copyright (c) 2019 Synopsys, Inc. All rights reserved.
# SPDX-License-Identifier: Apache-2.0

config BOARD_EMSDP
	bool "EM Software Development Platform"
	depends on SOC_ARC_EMSDP
	help
	  The ARC EM Software Development Platform (emsdp) is an FPGA based
	  development platform intended to support ARC licenses in developing
	  their software for the ARC EM processor family and ARC EM Subsystems.
	  It has the support for ARC EM4, EM5D, EM6, EM7D, EM9D and EM11D
	  processors. ARC EM Enhanced Security Package (ESP) and ARC EM
	  Subsystems (DFSS, SCSS, DSS) are also supported.
```

## boards/arc/emsdp/Kconfig.defconfig
```kconfig
# DesignWare ARC EM Software Development Platform board configuration

# Copyright (c) 2019 Synopsys, Inc. All rights reserved.
# SPDX-License-Identifier: Apache-2.0

if BOARD_EMSDP

config BOARD
	default "emsdp"


if GPIO

config GPIO_INIT_PRIORITY
	default 70

endif # GPIO

if SPI

config SPI_DW
	default y

endif # SPI

if I2C

config I2C_DW
	default y

if I2C_DW

config I2C_DW_CLOCK_SPEED
	default 200

config I2C_DW_ARC_AUX_REGS
	default y

endif #I2C_DW

endif # I2C

endif # BOARD_EMSDP
```

## boards/arc/emsdp/Kconfig.emsdp
```kconfig
# SPDX-License-Identifier: Apache-2.0

config BOARD_EMSDP
	bool
	default y
	select SOC_ARC_EMSDP
	select SOC_EMSDP_EM11D
```

## boards/arc/emsdp/Kconfig.emsdp_em4
```kconfig
# Copyright (c) 2022 Zephyr Project members and individual contributors
# SPDX-License-Identifier: Apache-2.0

config BOARD_EMSDP_EM4
	bool
	default y
	select SOC_ARC_EMSDP
	select SOC_EMSDP_EM4
```

## boards/arc/emsdp/Kconfig.emsdp_em6
```kconfig
# SPDX-License-Identifier: Apache-2.0

config BOARD_EMSDP_EM6
	bool
	default y
	select SOC_ARC_EMSDP
	select SOC_EMSDP_EM6
```
