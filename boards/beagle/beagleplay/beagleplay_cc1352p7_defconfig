## boards/beagle/beagleplay/beagleplay_cc1352p7_defconfig
```kconfig
#
# Copyright (c) 2022 Jason Kridner, BeagleBoard.org Foundation
#
# SPDX-License-Identifier: Apache-2.0
#

CONFIG_GPIO=y

CONFIG_BUILD_OUTPUT_HEX=y
# Custom callback for the antenna switch configuration
CONFIG_CC13X2_CC26X2_HAS_CUSTOM_RF_HWATTRS=y
CONFIG_CC13X2_CC26X2_BOOTLOADER_ENABLE=y
CONFIG_CC13X2_CC26X2_BOOTLOADER_BACKDOOR_ENABLE=y
CONFIG_CC13X2_CC26X2_BOOTLOADER_BACKDOOR_PIN=15

CONFIG_ARM_MPU=y
CONFIG_HW_STACK_PROTECTION=y

# Disable internal capacitors. BeaglePlay has external load capacitors.
# Source: https://www.ti.com/lit/er/swrz109a/swrz109a.pdf?ts=1761755410798 Radio_01
CONFIG_CC13X2_CC26X2_XOSC_CAPARRAY_DELTA=0xFF

# Enable default uart console
CONFIG_SERIAL=y
CONFIG_CONSOLE=y
CONFIG_UART_CONSOLE=y
```

## boards/beagle/beagleplay/board.yml
```yaml
board:
  name: beagleplay
  full_name: BeaglePlay
  vendor: beagle
  socs:
  - name: cc1352p7
  - name: am6254
```

## boards/beagle/beagleplay_cc1352/Kconfig.beagleplay_cc1352
```kconfig
# BeaglePlay CC1352 board configuration

# Copyright (c) 2020 Erik Larson
# Copyright (c) 2021-2022 Jason Kridner, BeagleBoard.org Foundation
# SPDX-License-Identifier: Apache-2.0

config BOARD_BEAGLEPLAY_CC1352
	select SOC_CC1352P7
```

## boards/beagle/beaglev_fire/Kconfig
```kconfig
# Copyright (c) 2023 Microchip Technology Inc
# SPDX-License-Identifier: Apache-2.0

config BOARD_BEAGLEV_FIRE
	select 64BIT
	select SCHED_IPI_SUPPORTED
	select CPU_HAS_FPU_DOUBLE_PRECISION
```

## boards/beagle/beaglev_fire/Kconfig.beaglev_fire
```kconfig
# Copyright (c) 2023 Microchip Technology Inc
# SPDX-License-Identifier: Apache-2.0

config BOARD_BEAGLEV_FIRE
	select SOC_POLARFIRE_U54 if BOARD_BEAGLEV_FIRE_POLARFIRE_U54 || \
				       BOARD_BEAGLEV_FIRE_POLARFIRE_U54_SMP
	select SOC_POLARFIRE_E51 if BOARD_BEAGLEV_FIRE_POLARFIRE_E51
```

## boards/beagle/beaglev_fire/beaglev_fire_polarfire_u54_smp_defconfig
```kconfig
# Copyright (c) 2023 Microchip Technology Inc
# SPDX-License-Identifier: Apache-2.0

CONFIG_MPFS_HAL=n
CONFIG_BASE64=y
CONFIG_INCLUDE_RESET_VECTOR=y
CONFIG_CONSOLE=y
CONFIG_SERIAL=y
CONFIG_UART_CONSOLE=y
CONFIG_XIP=n
CONFIG_INIT_STACKS=y
CONFIG_SYS_CLOCK_TICKS_PER_SEC=1000
CONFIG_RV_BOOT_HART=1
CONFIG_SMP=y
```

## boards/beagle/beaglev_fire/board.yml
```yaml
board:
  name: beaglev_fire
  full_name: BeagleV®-Fire
  vendor: beagle
  socs:
  - name: polarfire
    variants:
    - name: smp
      cpucluster: u54
```

## boards/beagle/beagley_ai/Kconfig.beagley_ai
```kconfig
# Copyright (c) 2024 Texas Instruments Incorporated
#	Andrew Davis <afd@ti.com>
#
# SPDX-License-Identifier: Apache-2.0

config BOARD_BEAGLEY_AI
	select SOC_J722S_MAIN_R5F0_0 if BOARD_BEAGLEY_AI_J722S_MAIN_R5F0_0
	select SOC_J722S_MCU_R5F0_0 if BOARD_BEAGLEY_AI_J722S_MCU_R5F0_0
```

## boards/beagle/beagley_ai/board.yml
```yaml
board:
  name: beagley_ai
  full_name: BeagleY-AI
  vendor: beagle
  socs:
  - name: j722s
```

## boards/beagle/pocketbeagle_2/Kconfig.pocketbeagle_2
```kconfig
# BeagleBoard.org PocketBeagle 2
#
# Copyright (c) 2025 Ayush Singh, BeagleBoard.org Foundation
#
# SPDX-License-Identifier: Apache-2.0

config BOARD_POCKETBEAGLE_2
	select SOC_AM6232_A53 if BOARD_POCKETBEAGLE_2_AM6232_A53
	select SOC_AM6254_A53 if BOARD_POCKETBEAGLE_2_AM6254_A53
	select SOC_AM6232_M4 if BOARD_POCKETBEAGLE_2_AM6232_M4
	select SOC_AM6254_M4 if BOARD_POCKETBEAGLE_2_AM6254_M4
	select SOC_MSPM0L1105 if BOARD_POCKETBEAGLE_2_MSPM0L1105
```

## boards/beagle/pocketbeagle_2/Kconfig.pocketbeagle_2_industrial
```kconfig
# BeagleBoard.org PocketBeagle 2 Industrial
#
# Copyright (c) 2026 BeagleBoard.org Foundation
#
# SPDX-License-Identifier: Apache-2.0

config BOARD_POCKETBEAGLE_2_INDUSTRIAL
	select SOC_AM6254_A53 if BOARD_POCKETBEAGLE_2_INDUSTRIAL_AM6254_A53
	select SOC_AM6254_M4 if BOARD_POCKETBEAGLE_2_INDUSTRIAL_AM6254_M4
	select SOC_MSPM0L1105 if BOARD_POCKETBEAGLE_2_INDUSTRIAL_MSPM0L1105
```

## boards/beagle/pocketbeagle_2/board.yml
```yaml
boards:
  - name: pocketbeagle_2
    full_name: PocketBeagle 2
    vendor: beagle
    socs:
      - name: am6232
      - name: am6254
      - name: mspm0l1105
    revision:
      format: custom
      exact: true
      default: "A1"
      revisions:
        - name: "A0"
        - name: "A1"

  - name: pocketbeagle_2_industrial
    full_name: PocketBeagle 2 Industrial
    vendor: beagle
    socs:
      - name: am6254
      - name: mspm0l1105
    revision:
      format: custom
      exact: true
      default: "A1"
      revisions:
        - name: "A1"
```

## boards/beagle/pocketbeagle_2/pocketbeagle_2_am6232_m4_defconfig
```kconfig
# BeagleBoard.org PocketBeagle 2
#
# Copyright (c) 2025 Ayush Singh, BeagleBoard.org Foundation
#
# SPDX-License-Identifier: Apache-2.0

# Platform Configuration
CONFIG_CORTEX_M_SYSTICK=y

# Zephyr Kernel Configuration
CONFIG_XIP=n

# Serial Driver
CONFIG_SERIAL=y

# Enable Console
CONFIG_CONSOLE=y
CONFIG_UART_CONSOLE=y
```

## boards/beagle/pocketbeagle_2/pocketbeagle_2_am6254_m4_defconfig
```kconfig
# BeagleBoard.org PocketBeagle 2
#
# Copyright (c) 2025 Ayush Singh, BeagleBoard.org Foundation
#
# SPDX-License-Identifier: Apache-2.0

# Platform Configuration
CONFIG_CORTEX_M_SYSTICK=y

# XIP is required to place text and data sections in I-RAM and D-RAM
# respectively.
CONFIG_XIP=y

# Serial Driver
CONFIG_SERIAL=y

# Enable Console
CONFIG_CONSOLE=y
CONFIG_UART_CONSOLE=y
```

## boards/beagle/pocketbeagle_2/pocketbeagle_2_industrial_mspm0l1105_defconfig
```kconfig
# BeagleBoard.org PocketBeagle 2 Industrial
#
# Copyright (c) 2026 BeagleBoard.org Foundation
#
# SPDX-License-Identifier: Apache-2.0

CONFIG_CLOCK_CONTROL=y

# Enable Console
CONFIG_SERIAL=y
CONFIG_CONSOLE=y
CONFIG_UART_CONSOLE=y
```

## boards/beagleboard/beagleconnect_freedom/board.yml
```yaml
board:
  name: beagleconnect_freedom
  vendor: BeagleBoard
  socs:
  - name: cc1352p7
```

## boards/beagleboard/beaglev_fire/Kconfig.beaglev_fire
```kconfig
# Copyright (c) 2023 Microchip Technology Inc
# SPDX-License-Identifier: Apache-2.0

config BOARD_BEAGLEV_FIRE
	select SOC_POLARFIRE
```

## boards/bflb/bl60x/bl604e_iot_dvk/Kconfig.bl604e_iot_dvk
```kconfig
# Copyright (c) 2022-2025 ATL Electronics
#
# SPDX-License-Identifier: Apache-2.0

config BOARD_BL604E_IOT_DVK
	select SOC_BL604E20Q2I
```

## boards/bflb/bl60x/bl604e_iot_dvk/bl604e_iot_dvk_defconfig
```kconfig
# Copyright (c) 2022-2025 ATL Electronics
#
# SPDX-License-Identifier: Apache-2.0

CONFIG_CONSOLE=y
CONFIG_SERIAL=y

CONFIG_UART_CONSOLE=y
CONFIG_UART_BFLB=y
```

## boards/bflb/bl60x/bl604e_iot_dvk/board.yml
```yaml
board:
  name: bl604e_iot_dvk
  full_name: BL604E IOT DVK development board
  vendor: bflb
  socs:
    - name: bl604e20q2i
```

## boards/bflb/bl61x/bl618g0/Kconfig.bl618g0
```kconfig
# Copyright The Zephyr Project Contributors
#
# SPDX-License-Identifier: Apache-2.0

config BOARD_BL618G0
	select SOC_BL618M05Q2I
```

## boards/bflb/bl61x/bl618g0/board.yml
```yaml
board:
  name: bl618g0
  full_name: Bouffalo Lab BL618 G0 evaluation board
  vendor: bflb
  socs:
    - name: bl618m05q2i
```

## boards/bflb/bl70x/bl706_iot_dvk/Kconfig.bl706_iot_dvk
```kconfig
# SPDX-FileCopyrightText: Copyright The Zephyr Project Contributors
# SPDX-License-Identifier: Apache-2.0

config BOARD_BL706_IOT_DVK
	select SOC_BL706C00Q2I
```
