/*
 * Copyright (c) 2025 Ayush Singh, BeagleBoard.org Foundation
 *
 * SPDX-License-Identifier: Apache-2.0
 */

/dts-v1/;

#include "pocketbeagle_2_mspm0l1105-common.dtsi"

/ {
	compatible = "beagle,pocketbeagle_2_mspm0l1105";
	model = "BeagleBoard.org PocketBeagle 2";
};
