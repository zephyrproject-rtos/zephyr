/*
 * Copyright (c) 2025 Ayush Singh, BeagleBoard.org Foundation
 *
 * SPDX-License-Identifier: Apache-2.0
 */

/dts-v1/;

#include <ti/ti_am6232_a53.dtsi>
#include "pocketbeagle_2_am62_a53-common.dtsi"
#include "pocketbeagle_2_a53-ddr.dtsi"

/ {
	model = "BeagleBoard.org PocketBeagle 2";
	compatible = "beagle,pocketbeagle_2_am6232_a53";

	cpus {
		cpu@0 {
			status = "okay";
		};

		cpu@1 {
			status = "okay";
		};
	};
};
