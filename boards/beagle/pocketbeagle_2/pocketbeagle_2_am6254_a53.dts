/*
 * Copyright (c) 2025 Ayush Singh, BeagleBoard.org Foundation
 *
 * SPDX-License-Identifier: Apache-2.0
 */

/dts-v1/;

#include "pocketbeagle_2_am6254_a53-common.dtsi"
#include "pocketbeagle_2_a53-ddr.dtsi"

/ {
	model = "BeagleBoard.org PocketBeagle 2";
	compatible = "beagle,pocketbeagle_2_am6254_a53";
};
