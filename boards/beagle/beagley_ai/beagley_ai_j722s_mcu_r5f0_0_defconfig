## boards/bearpi/bearpi_hm_nano/Kconfig
```kconfig
# SPDX-FileCopyrightText: Copyright The Zephyr Project Contributors
# SPDX-License-Identifier: Apache-2.0

config BOARD_BEARPI_HM_NANO
	select BOARD_EARLY_INIT_HOOK
```

## boards/bearpi/bearpi_hm_nano/Kconfig.bearpi_hm_nano
```kconfig
# SPDX-FileCopyrightText: Copyright The Zephyr Project Contributors
# SPDX-License-Identifier: Apache-2.0

config BOARD_BEARPI_HM_NANO
	select SOC_HI3861
```

## boards/bearpi/bearpi_hm_nano/board.yml
```yaml
# SPDX-FileCopyrightText: Copyright The Zephyr Project Contributors
# SPDX-License-Identifier: Apache-2.0

board:
  name: bearpi_hm_nano
  full_name: BearPi-HM Nano
  vendor: bearpi
  socs:
    - name: hi3861
```

## boards/beken/bk7258_evb/board.yml
```yaml
# Copyright (c) 2026 Beken Corporation
# SPDX-License-Identifier: Apache-2.0
#
# HWMv2 board metadata

board:
  name: bk7258_evb
  full_name: Beken BK7258 Evaluation Board
  vendor: beken
  socs:
    - name: bk7258
```

## boards/cheyao/comu/Kconfig.comu
```kconfig
# SPDX-FileCopyrightText: Copyright Michael Hope <michaelh@juju.nz>
# SPDX-License-Identifier: Apache-2.0

config BOARD_COMU
	select SOC_CH32V203
```

## boards/cheyao/comu/board.yml
```yaml
# SPDX-FileCopyrightText: Copyright Michael Hope <michaelh@juju.nz>
# SPDX-License-Identifier: Apache-2.0

board:
  name: comu
  full_name: Icy Electronics COMU
  vendor: cheyao
  socs:
    - name: ch32v203
```

## boards/cheyao/comu/comu_defconfig
```kconfig
# SPDX-FileCopyrightText: Copyright Michael Hope <michaelh@juju.nz>
# SPDX-License-Identifier: Apache-2.0

CONFIG_GPIO=y

CONFIG_SERIAL=y
CONFIG_CONSOLE=y
CONFIG_UART_CONSOLE=y
CONFIG_USE_DT_CODE_PARTITION=y
```

## boards/coredevices/pr2/Kconfig.pr2
```kconfig
# Copyright (c) 2026 Core Devices LLC
# SPDX-License-Identifier: Apache-2.0

config BOARD_PR2
	select SOC_SF32LB52JUD6
```

## boards/coredevices/pr2/board.yml
```yaml
# Copyright (c) 2026 Core Devices LLC
# SPDX-License-Identifier: Apache-2.0

board:
  name: pr2
  full_name: Pebble Round 2
  vendor: coredevices
  socs:
    - name: sf32lb52jud6
```

## boards/cytron/motion_2350_pro/Kconfig.motion_2350_pro
```kconfig
# Copyright (c) 2025 Jonas Berg
# SPDX-License-Identifier: Apache-2.0

config BOARD_MOTION_2350_PRO
	select SOC_RP2350A_HAZARD3_0 if BOARD_MOTION_2350_PRO_RP2350A_HAZARD3_0
	select SOC_RP2350A_M33_0 if BOARD_MOTION_2350_PRO_RP2350A_M33_0
```

## boards/dfrobot/beetle_esp32c3/Kconfig.beetle_esp32c3
```kconfig
# Copyright (c) 2025 Mikołaj Rosowski
# SPDX-License-Identifier: Apache-2.0

config BOARD_BEETLE_ESP32C3
	select SOC_ESP32C3
```

## boards/dfrobot/beetle_esp32c3/Kconfig.sysbuild
```kconfig
# Copyright (c) 2025 Mikołaj Rosowski
# SPDX-License-Identifier: Apache-2.0

choice BOOTLOADER
	default BOOTLOADER_MCUBOOT
endchoice
```

## boards/dh/stm32mp255c_dhsbc/Kconfig.stm32mp255c_dhsbc
```kconfig
# Copyright (C) 2026 DH electronics GmbH
# SPDX-License-Identifier: Apache-2.0

config BOARD_STM32MP255C_DHSBC
	select SOC_STM32MP255CXX_M33
```

## boards/dh/stm32mp255c_dhsbc/board.yml
```yaml
board:
  name: stm32mp255c_dhsbc
  full_name: DHSBC STM32MP255C
  vendor: dh
  socs:
    - name: stm32mp255cxx
```

## boards/digilent/arty_a7/arty_a7_designstart_fpga_cortex_m3_defconfig
```kconfig
# SPDX-License-Identifier: Apache-2.0

CONFIG_ARM_MPU=y

CONFIG_SERIAL=y
CONFIG_UART_INTERRUPT_DRIVEN=y
CONFIG_CONSOLE=y
CONFIG_UART_CONSOLE=y
```

## boards/digilent/pynq_z1/Kconfig
```kconfig
# Copyright (c) 2026 Radu Pirea
# SPDX-License-Identifier: Apache-2.0

config UART_XLNX_PS
	select PINCTRL if BOARD_PYNQ_Z1
```

## boards/digilent/pynq_z1/Kconfig.defconfig
```kconfig
# Copyright (c) 2026 Radu Pirea
# SPDX-License-Identifier: Apache-2.0

if BOARD_PYNQ_Z1

configdefault ETH_DRIVER
	default y

config SYS_CLOCK_HW_CYCLES_PER_SEC
	default $(dt_nodelabel_int_prop,arch_timer,clock-frequency)

endif # BOARD_PYNQ_Z1
```

## boards/digilent/pynq_z1/Kconfig.pynq_z1
```kconfig
# Digilent PYNQ-Z1 board configuration

# Copyright (c) 2026 Radu Pirea
# SPDX-License-Identifier: Apache-2.0

config BOARD_PYNQ_Z1
	select SOC_XC7Z020
```

## boards/digilent/pynq_z1/board.yml
```yaml
board:
  name: pynq_z1
  full_name: PYNQ-Z1
  vendor: digilent
  socs:
  - name: xc7z020
```

## boards/dsdtech/shc31a/Kconfig.dsdtech_shc31a
```kconfig
# Copyright (c) 2026 Base Power Company
# SPDX-License-Identifier: Apache-2.0

config BOARD_DSDTECH_SHC31A
	select SOC_STM32G431XX
```
