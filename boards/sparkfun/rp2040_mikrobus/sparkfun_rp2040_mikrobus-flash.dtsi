/*
 * SPDX-FileCopyrightText: Copyright (c) 2026 Navimatix GmbH
 * SPDX-FileCopyrightText: Copyright (c) 2026 TiaC Systems
 * SPDX-License-Identifier: Apache-2.0
 */

#include <mem.h>
#include <raspberrypi/partitions_2M_default.dtsi>

/ {
	chosen {
		zephyr,flash = &flash0;
		zephyr,flash-controller = &ssi;
		zephyr,code-partition = &code_partition;
	};
};

&flash0 {
	status = "okay";
	reg = <0x10000000 DT_SIZE_M(16)>;
};

&storage_partition {
	reg = <0x100000 DT_SIZE_M(15)>;
};
