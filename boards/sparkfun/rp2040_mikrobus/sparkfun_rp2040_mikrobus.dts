/*
 * SPDX-FileCopyrightText: Copyright (c) 2026 Navimatix GmbH
 * SPDX-FileCopyrightText: Copyright (c) 2026 TiaC Systems
 * SPDX-License-Identifier: Apache-2.0
 */

/dts-v1/;

/ {
	compatible = "sparkfun,rp2040-mikrobus";
	model = "Sparkfun RP2040 mikroBUS Development Board";
};

#include "sparkfun_rp2040_mikrobus-common.dtsi"
#include "sparkfun_rp2040_mikrobus-flash.dtsi"
#include "sparkfun_rp2040_mikrobus-led.dtsi"
#include "sparkfun_rp2040_mikrobus-ws2812.dtsi"
#include "sparkfun_rp2040_mikrobus-max17048.dtsi"
#include "sparkfun_rp2040_mikrobus-sdcard.dtsi"
#include "sparkfun_rp2040_mikrobus-stemma.dtsi"
#include "sparkfun_rp2040_mikrobus-mikrobus.dtsi"
#include "sparkfun_rp2040_mikrobus-feather.dtsi"
