## boards/sparkfun/pro_micro_rp2040/Kconfig.defconfig
```kconfig
# Copyright (c) 2021 Pete Johanson
# SPDX-License-Identifier: Apache-2.0

if BOARD_SPARKFUN_PRO_MICRO_RP2040

config RP2_FLASH_W25Q080
	default y

if I2C_DW

config I2C_DW_CLOCK_SPEED
	default 125

endif # I2C_DW

config USB_SELF_POWERED
	default n

endif # BOARD_SPARKFUN_PRO_MICRO_RP2040
```

## boards/sparkfun/pro_micro_rp2040/Kconfig.sparkfun_pro_micro_rp2040
```kconfig
# Copyright (c) 2021 Pete Johanson
# SPDX-License-Identifier: Apache-2.0

config BOARD_SPARKFUN_PRO_MICRO_RP2040
	select SOC_RP2040
```

## boards/sparkfun/pro_micro_rp2040/board.yml
```yaml
board:
  name: sparkfun_pro_micro_rp2040
  full_name: Pro Micro RP2040
  vendor: sparkfun
  socs:
  - name: rp2040
```

## boards/sparkfun/red_v_things_plus/Kconfig.defconfig
```kconfig
# Copyright (c) 2019 SiFive Inc.
# SPDX-License-Identifier: Apache-2.0

if BOARD_SPARKFUN_RED_V_THINGS_PLUS

config SYS_CLOCK_TICKS_PER_SEC
	default 128

config HAS_FLASH_LOAD_OFFSET
	default y

config FLASH_LOAD_OFFSET
	default 0x0

config FLASH_BASE_ADDRESS
	default $(dt_node_reg_addr_hex,/soc/spi@10014000,1)

endif # BOARD_SPARKFUN_RED_V_THINGS_PLUS
```

## boards/sparkfun/red_v_things_plus/Kconfig.sparkfun_red_v_things_plus
```kconfig
# Copyright (c) 2024 Antmicro <www.antmicro.com>
# SPDX-License-Identifier: Apache-2.0

config BOARD_SPARKFUN_RED_V_THINGS_PLUS
	select SOC_SIFIVE_FREEDOM_FE310
```

## boards/sparkfun/red_v_things_plus/board.yml
```yaml
board:
  name: sparkfun_red_v_things_plus
  full_name: RED-V Things Plus
  vendor: sparkfun
  socs:
    - name: fe310
```

## boards/sparkfun/red_v_things_plus/sparkfun_red_v_things_plus_defconfig
```kconfig
# Copyright (c) 2019 SiFive Inc.
# SPDX-License-Identifier: Apache-2.0

CONFIG_GPIO=y
CONFIG_PINCTRL=y
CONFIG_CONSOLE=y
CONFIG_SERIAL=y
CONFIG_UART_SIFIVE_PORT_0=y
CONFIG_UART_CONSOLE=y
```

## boards/sparkfun/rp2040_mikrobus/Kconfig
```kconfig
# SPDX-FileCopyrightText: Copyright (c) 2026 Navimatix GmbH
# SPDX-FileCopyrightText: Copyright (c) 2026 TiaC Systems
# SPDX-License-Identifier: Apache-2.0

config BOARD_SPARKFUN_RP2040_MIKROBUS
	select RP2_FLASH_W25Q080
```

## boards/sparkfun/rp2040_mikrobus/Kconfig.sparkfun_rp2040_mikrobus
```kconfig
# SPDX-FileCopyrightText: Copyright (c) 2026 Navimatix GmbH
# SPDX-FileCopyrightText: Copyright (c) 2026 TiaC Systems
# SPDX-License-Identifier: Apache-2.0

config BOARD_SPARKFUN_RP2040_MIKROBUS
	select SOC_RP2040
```

## boards/sparkfun/rp2040_mikrobus/board.yml
```yaml
# SPDX-FileCopyrightText: Copyright (c) 2026 Navimatix GmbH
# SPDX-FileCopyrightText: Copyright (c) 2026 TiaC Systems
# SPDX-License-Identifier: Apache-2.0

board:
  name: sparkfun_rp2040_mikrobus
  full_name: Sparkfun RP2040 mikroBUS Development Board
  vendor: sparkfun
  socs:
    - name: rp2040
```

## boards/sparkfun/samd21_dev_breakout/Kconfig.sparkfun_samd21_breakout
```kconfig
# Copyright The Zephyr Project Contributors
# SPDX-License-Identifier: Apache-2.0

config BOARD_SPARKFUN_SAMD21_BREAKOUT
	select SOC_SAMD21G18A
```

## boards/sparkfun/samd21_dev_breakout/board.yml
```yaml
board:
  name: sparkfun_samd21_breakout
  full_name: Sparkfun SAMD21 Dev Breakout
  vendor: sparkfun
  socs:
    - name: samd21g18a
```

## boards/sparkfun/samd21_dev_breakout/sparkfun_samd21_breakout_defconfig
```kconfig
# Copyright The Zephyr Project Contributors
# SPDX-License-Identifier: Apache-2.0

CONFIG_SOC_ATMEL_SAMD_XOSC32K=y
CONFIG_SOC_ATMEL_SAMD_XOSC32K_AS_MAIN=y

CONFIG_BUILD_OUTPUT_UF2=y
CONFIG_BOOTLOADER_BOSSA=y
CONFIG_BOOTLOADER_BOSSA_ADAFRUIT_UF2=y

CONFIG_CONSOLE=y
CONFIG_SERIAL=y
CONFIG_UART_CONSOLE=y
CONFIG_UART_INTERRUPT_DRIVEN=y
```

## boards/sparkfun/sparkfun_pro_micro_rp2040/board.yml
```yaml
board:
  name: sparkfun_pro_micro_rp2040
  vendor: SparkFun Electronics
  socs:
  - name: rp2040
```

## boards/sparkfun/sparkfun_red_v_things_plus/board.yml
```yaml
board:
  name: sparkfun_red_v_things_plus
  vendor: SparkFun Electronics
  socs:
    - name: fe310
```

## boards/sparkfun/sparkfun_thing_plus/board.yml
```yaml
board:
  name: sparkfun_thing_plus
  vendor: SparkFun Electronics
  socs:
  - name: nrf9160
    variants:
    - name: 'ns'
```

## boards/sparkfun/thing_plus/Kconfig
```kconfig
# Sparkfun nRF9160 Thing Plus configuration

# Copyright (c) 2018-2020 Nordic Semiconductor ASA
# Copyright (c) 2020 Circuit Dojo LLC
# SPDX-License-Identifier: Apache-2.0

config BOARD_SPARKFUN_THING_PLUS
	# The GPIO driver is required by this board's initialization code
	# (board.c), so it is forced here to be enabled always, not only
	# enabled by default (in defconfig).
	select GPIO
```

## boards/sparkfun/thing_plus/Kconfig.sparkfun_thing_plus
```kconfig
# Sparkfun nRF9160 Thing Plus configuration

# Copyright (c) 2018-2020 Nordic Semiconductor ASA
# Copyright (c) 2020 Circuit Dojo LLC
# SPDX-License-Identifier: Apache-2.0

config BOARD_SPARKFUN_THING_PLUS
	select SOC_NRF9160_SICA
```

## boards/sparkfun/thing_plus/board.yml
```yaml
board:
  name: sparkfun_thing_plus
  full_name: nRF9160 Thing Plus
  vendor: sparkfun
  socs:
  - name: nrf9160
    variants:
    - name: 'ns'
```

## boards/sparkfun/thing_plus/sparkfun_thing_plus_nrf9160_defconfig
```kconfig
# SPDX-License-Identifier: Apache-2.0

# Enable MPU
CONFIG_ARM_MPU=y

# Enable TrustZone-M
CONFIG_ARM_TRUSTZONE_M=y

# Hardware stack protection
CONFIG_HW_STACK_PROTECTION=y

# Enable UART driver
CONFIG_SERIAL=y

# Enable console
CONFIG_CONSOLE=y
CONFIG_UART_CONSOLE=y

CONFIG_REGULATOR=y
```

## boards/sparkfun/thing_plus_matter_mgm240p/Kconfig
```kconfig
# SPARKFUN THING PLUS MGM240P board

# Copyright (c) 2024 Daikin Comfort Technologies North America, Inc.
# Copyright (c) 2022, Silicon Labs
# SPDX-License-Identifier: Apache-2.0

module = BOARD_SPARKFUN_THING_PLUS_MATTER_MGM240P
module-str = Board Control
source "subsys/logging/Kconfig.template.log_config"
```

## boards/sparkfun/thing_plus_matter_mgm240p/Kconfig.defconfig
```kconfig
# SPARKFUN THING PLUS MGM240P board

# Copyright (c) 2024 Daikin Comfort Technologies North America, Inc.
# Copyright (c) 2021, Sateesh Kotapati
# SPDX-License-Identifier: Apache-2.0

if BOARD_SPARKFUN_THING_PLUS_MATTER_MGM240P

if SOC_GECKO_USE_RAIL

config FPU
	default y

endif # SOC_GECKO_USE_RAIL

if BT

config FPU
	default y

config MAIN_STACK_SIZE
	default 2304

if SHELL

config SHELL_STACK_SIZE
	default 4096

endif # SHELL

endif # BT
endif # BOARD_SPARKFUN_THING_PLUS_MGM240P
```

## boards/sparkfun/thing_plus_matter_mgm240p/Kconfig.sparkfun_thing_plus_matter_mgm240p
```kconfig
# EFR32XG24 MGM240P board

# Copyright (c) 2024 Daikin Comfort Technologies North America, Inc.
# SPDX-License-Identifier: Apache-2.0

config BOARD_SPARKFUN_THING_PLUS_MATTER_MGM240P
	select SOC_MGM240PB32VNA
```

## boards/sparkfun/thing_plus_matter_mgm240p/board.yml
```yaml
board:
  name: sparkfun_thing_plus_matter_mgm240p
  full_name: Thing Plus Matter
  vendor: sparkfun
  socs:
  - name: mgm240pb32vna
```

## boards/sparkfun/thing_plus_matter_mgm240p/sparkfun_thing_plus_matter_mgm240p_defconfig
```kconfig
# Copyright (c) 2024 Daikin Comfort Technologies North America, Inc.
# Copyright (c) 2022 Silicon Labs
# SPDX-License-Identifier: Apache-2.0

CONFIG_ARM_MPU=y
CONFIG_CONSOLE=y
CONFIG_UART_CONSOLE=y
CONFIG_SERIAL=y
CONFIG_GPIO=y
```
