/*
 * SPDX-FileCopyrightText: Copyright (c) 2026 EPAM Systems
 *
 * SPDX-License-Identifier: Apache-2.0
 */

#include "xenvm_xenvm_gicv3.dts"

&{/cpus} {
	cpu@1 {
		compatible = "arm,armv8";
		reg = <0x01>;
		device_type = "cpu";
		enable-method = "psci";
	};
};
