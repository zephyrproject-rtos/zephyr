## boards/trenz/te0950/Kconfig.te0950
```kconfig
#
# Copyright (c) 2025 Space Cubics Inc.
#
# SPDX-License-Identifier: Apache-2.0
#

config BOARD_TE0950
	select SOC_VERSAL_RPU
```

## boards/trenz/te0950/board.yml
```yaml
board:
  name: te0950
  full_name: Trenz Electronic TE0950
  vendor: trenz
  socs:
  - name: versal_rpu
```

## boards/trenz/te0950/te0950_versal_rpu_defconfig
```kconfig
# Enable UART driver
CONFIG_SERIAL=y

# Enable console
CONFIG_CONSOLE=y
CONFIG_UART_CONSOLE=y
```

## boards/tsi/ek_tsi/Kconfig
```kconfig
# Copyright (c) 2024 TSI
# SPDX-License-Identifier: Apache-2.0

config BOARD_EK_TSI
	select QEMU_TARGET
```

## boards/tsi/ek_tsi/Kconfig.ek_tsi
```kconfig
# Copyright (c) 2024 TSI
# SPDX-License-Identifier: Apache-2.0

#config BOARD_EK_TSI
#	select SOC_SKYP_M85 if BOARD_EK_TSI_SKYP_M85

config BOARD_EK_TSI
	select SOC_SKYP
```

## boards/tsi/ek_tsi_skyp/Kconfig
```kconfig
# Copyright (c) 2024 TSI
# SPDX-License-Identifier: Apache-2.0

config BOARD_EK_TSI_SKYP
	select QEMU_TARGET
```

## boards/tsi/ek_tsi_skyp/ek_tsi_skyp_defconfig
```kconfig
# Copyright (c) 2024 TSI
# SPDX-License-Identifier: Apache-2.0

CONFIG_RUNTIME_NMI=y
CONFIG_ARM_TRUSTZONE_M=n
CONFIG_ARM_MPU=y
CONFIG_QEMU_ICOUNT_SHIFT=7

# Serial
CONFIG_CONSOLE=y
CONFIG_UART_CONSOLE=y
CONFIG_SERIAL=y

# Build a Secure firmware image
CONFIG_TRUSTED_EXECUTION_SECURE=n

# Build the zephyr.hex and zephyrstrp.hex for FPGA
CONFIG_BUILD_OUTPUT_TSV_STRIPPED_HEX=y
```

## boards/tsi/skylp/Kconfig.tsi_skylp
```kconfig
# Copyright (c) 2024 TSI
# SPDX-License-Identifier: Apache-2.0

config BOARD_TSI_SKYLP
	select SOC_SKYLP_M85
```

## boards/tsi/skylp/board.yml
```yaml
board:
  name: tsi_skylp
  vendor: tsi
  socs:
  - name: skylp
    variants:
    - name: tensilica
      cpucluster: txe
    - name: cortex-m85
      cpucluster: m85
```

## boards/tsi/skyp/Kconfig.defconfig
```kconfig
# Copyright (c) 2024 TSI
# SPDX-License-Identifier: Apache-2.0

if BOARD_TSI

# MPU-based null-pointer dereferencing detection cannot
# be applied as the (0x0 - 0x400) is unmapped but QEMU
# will still permit bus access.
choice NULL_POINTER_EXCEPTION_DETECTION
	bool
	default NULL_POINTER_EXCEPTION_DETECTION_NONE if QEMU_TARGET
endchoice

if SERIAL

config UART_INTERRUPT_DRIVEN
	default n

endif # SERIAL

endif
```

## boards/tsi/skyp/Kconfig.tsi
```kconfig
# Copyright (c) 2024 TSI
# SPDX-License-Identifier: Apache-2.0

config BOARD_TSI
	select SOC_PART_NUMBER_MIMX8ML8DVNLZ
	select SOC_SKYP_M85 if BOARD_TSI_SKYP_M85
	select SOC_MIMX8ML8_ADSP if BOARD_TSI_SKYP_TXE
```

## boards/tsi/skyp/board.yml
```yaml
board:
  name: tsi
  vendor: tsi
  socs:
  - name: skyp
    variants:
    - name: tensilica
      cpucluster: txe
    - name: cortex-m85
      cpucluster: m85
```

## boards/tsi/skyp/tsi_skyp_txe_defconfig
```kconfig
# SPDX-License-Identifier: Apache-2.0

# size of stack for initialization and main thread
CONFIG_MAIN_STACK_SIZE=3072

# enable logger
CONFIG_LOG=y

# no need for a "raw" binary zephyr/zephyr.bin in the build directory
CONFIG_BUILD_OUTPUT_BIN=y
CONFIG_BUILD_OUTPUT_HEX=y

# enable uart driver
CONFIG_SERIAL=y

# clock configuration
CONFIG_CLOCK_CONTROL=y

# console (remote proc console by default)
CONFIG_CONSOLE=y

# uart console (overrides remote proc console)
CONFIG_UART_CONSOLE=y

# enable pin controller
CONFIG_PINCTRL=y
```

## boards/tsi/tsi/Kconfig
```kconfig
# Copyright (c) 2024 TSI
# SPDX-License-Identifier: Apache-2.0

config BOARD_TSI
	select QEMU_TARGET
```

## boards/tsi/tsi/board.yml
```yaml
board:
  name: tsi
  vendor: Tsavorite
  socs:
  - name: skyp
    variants:
    - name: cortex-m85
      cpucluster: m85
```

## boards/tuya/t5ai_core/board.yml
```yaml
board:
  name: t5ai_core
  full_name: T5AI Core
  vendor: tuya
  socs:
    - name: bk7258
```

## boards/tuya/t5ai_core/t5ai_core_defconfig
```kconfig
# Copyright (c) 2026 Embracecactus
# SPDX-License-Identifier: Apache-2.0

CONFIG_MAIN_STACK_SIZE=4096
CONFIG_IDLE_STACK_SIZE=1024
CONFIG_ISR_STACK_SIZE=2048

CONFIG_SOC_RESET_HOOK=y
CONFIG_SERIAL=y
CONFIG_CONSOLE=y
CONFIG_UART_CONSOLE=y
CONFIG_CLOCK_CONTROL=y
CONFIG_CLOCK_CONTROL_BEKEN_BK7258=y
CONFIG_PINCTRL_BEKEN_BK7258=y
```

## boards/tuya/tyzs3/Kconfig.tyzs3
```kconfig
# Copyright (c) 2020 Piotr Mienkowski
# Copyright (c) 2020 TriaGnoSys GmbH
# SPDX-License-Identifier: Apache-2.0

config BOARD_TYZS3
	select SOC_EFR32MG13P732F512GM48
```

## boards/tuya/tyzs3/board.yml
```yaml
board:
  name: tyzs3
  full_name: TYZS3
  vendor: tuya
  socs:
  - name: efr32mg13p732f512gm48
```

## boards/u-blox/ubx_bmd300eval/Kconfig.ubx_bmd300eval
```kconfig
# BMD-300-EVAL, BMD-301-EVAL, and BMD-350-EVAL board configuration

# Copyright (c) 2021 u-blox AG
# SPDX-License-Identifier: Apache-2.0

config BOARD_UBX_BMD300EVAL
	select SOC_NRF52832_QFAA
```

## boards/u-blox/ubx_bmd300eval/board.yml
```yaml
board:
  name: ubx_bmd300eval
  full_name: "EVK-BMD-30/35: BMD-300-EVAL, BMD-301-EVAL, and BMD-350-EVAL"
  vendor: u-blox
  socs:
  - name: nrf52832
```

## boards/u-blox/ubx_bmd330eval/Kconfig
```kconfig
# BMD-330-EVAL board configuration

# Copyright (c) 2021 u-blox AG
# SPDX-License-Identifier: Apache-2.0

# BT_CTLR depends on BT. When BT is enabled we should default to also
# enabling the controller.
config BT_CTLR
	default y if BT
```
