## boards/heltec/heltec_mesh_node_t114/Kconfig.heltec_mesh_node_t114
```kconfig
# Copyright (c) 2026 Yeray Lois Sanchez
# SPDX-License-Identifier: Apache-2.0

config BOARD_HELTEC_MESH_NODE_T114
	select SOC_NRF52840_QIAA
```

## boards/heltec/heltec_mesh_node_t114/board.yml
```yaml
board:
  name: heltec_mesh_node_t114
  full_name: Mesh Node T114
  vendor: heltec
  socs:
    - name: nrf52840
      variants:
        - name: uf2
```

## boards/heltec/heltec_t114_v2/Kconfig.defconfig
```kconfig
# Copyright (c) 2024 MASSDRIVER EI (massdriver.space)
# Copyright (c) 2018-2023 Nordic Semiconductor ASA
#
# SPDX-License-Identifier: Apache-2.0

if BOARD_HELTEC_T114_V2

config ARM_MPU
	default y

config HW_STACK_PROTECTION
	default y

config GPIO
	default y

config USB_DEVICE_REMOTE_WAKEUP
	default n

source "boards/common/usb/Kconfig.cdc_acm_serial.defconfig"

endif # BOARD_HELTEC_T114_V2
```

## boards/heltec/heltec_t114_v2/Kconfig.heltec_t114_v2
```kconfig
# SPDX-FileCopyrightText: Copyright The Zephyr Project Contributors
# SPDX-License-Identifier: Apache-2.0

config BOARD_HELTEC_T114_V2
	select SOC_NRF52840_QIAA
```

## boards/heltec/heltec_t114_v2/board.yml
```yaml
board:
  name: heltec_t114_v2
  full_name: Heltec T114 v2
  vendor: heltec
  socs:
  - name: nrf52840
    variants:
    - name: uf2
```

## boards/heltec/heltec_t114_v2/heltec_t114_v2_nrf52840_uf2_defconfig
```kconfig
# SPDX-License-Identifier: Apache-2.0

CONFIG_BUILD_OUTPUT_UF2=y
CONFIG_USE_DT_CODE_PARTITION=y
```

## boards/heltec/heltec_wifi_lora32_v2/Kconfig
```kconfig
# Copyright (c) 2024 Espressif Systems (Shanghai) Co., Ltd.
# SPDX-License-Identifier: Apache-2.0

config HEAP_MEM_POOL_ADD_SIZE_BOARD
	int
	default 4096 if BOARD_HELTEC_WIFI_LORA32_V2_ESP32_PROCPU
	default 256 if BOARD_HELTEC_WIFI_LORA32_V2_ESP32_APPCPU
```

## boards/heltec/heltec_wifi_lora32_v2/Kconfig.defconfig
```kconfig
# HELTEC board configuration

# Copyright (c) 2021 Instituto de Pesquisas Eldorado (eldorado.org.br)
# SPDX-License-Identifier: Apache-2.0

if BOARD_HELTEC_WIFI_LORA32_V2_ESP32_PROCPU

config HEAP_MEM_POOL_ADD_SIZE_BOARD
	int
	default 65535 if WIFI && BT
	default 51200 if WIFI
	default 40960 if BT
	default 4096

endif # BOARD_HELTEC_WIFI_LORA32_V2_ESP32_PROCPU

if BOARD_HELTEC_WIFI_LORA32_V2_ESP32_APPCPU

config HEAP_MEM_POOL_ADD_SIZE_BOARD
	default 256

endif # BOARD_HELTEC_WIFI_LORA_V2_ESP32_APPCPU
```

## boards/heltec/heltec_wifi_lora32_v2/Kconfig.heltec_wifi_lora32_v2
```kconfig
# HELTEC ESP32 board configuration

# Copyright (c) 2021 Instituto de Pesquisas Eldorado (eldorado.org.br)
# SPDX-License-Identifier: Apache-2.0

config BOARD_HELTEC_WIFI_LORA32_V2
	select SOC_ESP32_D0WD_V3
	select SOC_ESP32_PROCPU if BOARD_HELTEC_WIFI_LORA32_V2_ESP32_PROCPU
	select SOC_ESP32_APPCPU if BOARD_HELTEC_WIFI_LORA32_V2_ESP32_APPCPU
```

## boards/heltec/heltec_wifi_lora32_v2/board.yml
```yaml
board:
  name: heltec_wifi_lora32_v2
  full_name: WiFi LoRa 32 (V2)
  vendor: heltec
  socs:
  - name: esp32
```

## boards/heltec/heltec_wifi_lora32_v3/Kconfig
```kconfig
# Copyright (c) 2024 Espressif Systems (Shanghai) Co., Ltd.
# SPDX-FileCopyrightText: Copyright The Zephyr Project Contributors
# SPDX-License-Identifier: Apache-2.0

config HEAP_MEM_POOL_ADD_SIZE_BOARD
	int
	default 4096 if BOARD_HELTEC_WIFI_LORA32_V3_ESP32S3_PROCPU
	default 256 if BOARD_HELTEC_WIFI_LORA32_V3_ESP32S3_APPCPU
```

## boards/heltec/heltec_wifi_lora32_v3/Kconfig.defconfig
```kconfig
# SPDX-FileCopyrightText: Copyright The Zephyr Project Contributors
# SPDX-License-Identifier: Apache-2.0

if BOARD_HELTEC_WIFI_LORA32_V3_ESP32S3_PROCPU

config POWER_DOMAIN
	default y

config POWER_DOMAIN_GPIO
	default y

if LVGL

config LV_Z_VDB_SIZE
	default 64

config LV_DPI_DEF
	default 116

config LV_Z_BITS_PER_PIXEL
	default 1

config LV_Z_COLOR_MONO_HW_INVERSION
	default y

choice LV_COLOR_DEPTH
	default LV_COLOR_DEPTH_1
endchoice

endif # LVGL

endif # BOARD_HELTEC_WIFI_LORA32_V3_ESP32S3_PROCPU
```

## boards/heltec/heltec_wifi_lora32_v3/Kconfig.heltec_wifi_lora32_v3
```kconfig
# HELTEC Wifi LoRa 32 (V3) board configuration

# Copyright (c) 2021 Instituto de Pesquisas Eldorado (eldorado.org.br)
# SPDX-FileCopyrightText: Copyright The Zephyr Project Contributors
# SPDX-License-Identifier: Apache-2.0

config BOARD_HELTEC_WIFI_LORA32_V3
	select SOC_ESP32S3_FN8
	select SOC_ESP32S3_PROCPU if BOARD_HELTEC_WIFI_LORA32_V3_ESP32S3_PROCPU
	select SOC_ESP32S3_APPCPU if BOARD_HELTEC_WIFI_LORA32_V3_ESP32S3_APPCPU
```

## boards/heltec/heltec_wifi_lora32_v3/board.yml
```yaml
board:
  name: heltec_wifi_lora32_v3
  full_name: WiFi LoRa 32 (V3)
  vendor: heltec
  socs:
  - name: esp32s3
```

## boards/heltec/heltec_wireless_stick_lite_v3/Kconfig
```kconfig
# Copyright (c) 2024 Espressif Systems (Shanghai) Co., Ltd.
# SPDX-License-Identifier: Apache-2.0

config BOARD_HELTEC_WIRELESS_STICK_LITE_V3
	select SOC_ESP32S3_PROCPU if BOARD_HELTEC_WIRELESS_STICK_LITE_V3_ESP32S3_PROCPU
	select SOC_ESP32S3_APPCPU if BOARD_HELTEC_WIRELESS_STICK_LITE_V3_ESP32S3_APPCPU
```

## boards/heltec/heltec_wireless_stick_lite_v3/Kconfig.defconfig
```kconfig
# SPDX-FileCopyrightText: Copyright The Zephyr Project Contributors
# SPDX-License-Identifier: Apache-2.0

if BOARD_HELTEC_WIRELESS_STICK_LITE_V3_ESP32S3_PROCPU

config POWER_DOMAIN
	default y

config POWER_DOMAIN_GPIO
	default y

endif # BOARD_HELTEC_WIFI_LORA32_V3_ESP32S3_PROCPU
```

## boards/heltec/heltec_wireless_stick_lite_v3/Kconfig.heltec_wireless_stick_lite_v3
```kconfig
# Heltec Wireless Stick Lite (V3) board configuration

# Copyright (c) 2021 Instituto de Pesquisas Eldorado (eldorado.org.br)
# Copyright (c) 2023 The Zephyr Project Contributors
# SPDX-License-Identifier: Apache-2.0

config BOARD_HELTEC_WIRELESS_STICK_LITE_V3
	select SOC_ESP32S3_FN8
	select SOC_ESP32S3_PROCPU if BOARD_HELTEC_WIRELESS_STICK_LITE_V3_ESP32S3_PROCPU
	select SOC_ESP32S3_APPCPU if BOARD_HELTEC_WIRELESS_STICK_LITE_V3_ESP32S3_APPCPU
```

## boards/heltec/heltec_wireless_stick_lite_v3/board.yml
```yaml
board:
  name: heltec_wireless_stick_lite_v3
  full_name: Wireless Stick Lite (V3)
  vendor: heltec
  socs:
  - name: esp32s3
```

## boards/heltec/heltec_wireless_stick_lite_v3/heltec_wireless_stick_lite_v3_esp32s3_procpu_defconfig
```kconfig
# SPDX-License-Identifier: Apache-2.0

CONFIG_MAIN_STACK_SIZE=2048

CONFIG_CLOCK_CONTROL=y
CONFIG_CONSOLE=y
CONFIG_GPIO=y
CONFIG_PWM=y
CONFIG_SERIAL=y
CONFIG_SPI=y
CONFIG_UART_CONSOLE=y
```

## boards/heltec/heltec_wireless_stick_lite_v3/heltec_wireless_stick_lite_v3_procpu_defconfig
```kconfig
# SPDX-License-Identifier: Apache-2.0

CONFIG_CLOCK_CONTROL=y
CONFIG_CONSOLE=y
CONFIG_GPIO=y
CONFIG_PWM=y
CONFIG_SERIAL=y
CONFIG_SPI=y
CONFIG_UART_CONSOLE=y
```

## boards/heltec/heltec_wireless_tracker/Kconfig
```kconfig
# SPDX-FileCopyrightText: Copyright (c) 2024 Espressif Systems (Shanghai) Co., Ltd.
# SPDX-FileCopyrightText: Copyright The Zephyr Project Contributors
# SPDX-License-Identifier: Apache-2.0

config HEAP_MEM_POOL_ADD_SIZE_BOARD
	int
	default 4096 if BOARD_HELTEC_WIRELESS_TRACKER_ESP32S3_PROCPU
	default 256 if BOARD_HELTEC_WIRELESS_TRACKER_ESP32S3_APPCPU
```

## boards/heltec/heltec_wireless_tracker/Kconfig.heltec_wireless_tracker
```kconfig
# Heltec Wireless Tracker (V1.1) board configuration
#
# SPDX-FileCopyrightText: Copyright (c) 2021 Instituto de Pesquisas Eldorado (eldorado.org.br)
# SPDX-FileCopyrightText: Copyright (c) 2023 The Zephyr Project Contributors
# SPDX-License-Identifier: Apache-2.0

config BOARD_HELTEC_WIRELESS_TRACKER
	select SOC_ESP32S3_FN8
	select SOC_ESP32S3_PROCPU if BOARD_HELTEC_WIRELESS_TRACKER_ESP32S3_PROCPU
	select SOC_ESP32S3_APPCPU if BOARD_HELTEC_WIRELESS_TRACKER_ESP32S3_APPCPU
```

## boards/heltec/heltec_wireless_tracker/board.yml
```yaml
board:
  name: heltec_wireless_tracker
  full_name: Wireless Tracker (V1.1)
  vendor: heltec
  socs:
  - name: esp32s3
```
