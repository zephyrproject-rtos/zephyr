## boards/chipyard/dsp24/chipyard_dsp24_defconfig
```kconfig
# SPDX-License-Identifier: Apache-2.0

CONFIG_PRIVILEGED_STACK_SIZE=2048
CONFIG_REBOOT=y
CONFIG_UART_HTIF=y
CONFIG_CONSOLE=y
CONFIG_UART_CONSOLE=y
CONFIG_SERIAL=y
CONFIG_PRINTK=y
CONFIG_EARLY_CONSOLE=y
CONFIG_STACK_SENTINEL=y
CONFIG_XIP=y
CONFIG_RISCV_PMP=y
CONFIG_SMP=y
CONFIG_MP_MAX_NUM_CPUS=1
CONFIG_IDLE_STACK_SIZE=1024
CONFIG_QEMU_ICOUNT=n
CONFIG_PINCTRL=n
CONFIG_UART_SIFIVE_PORT_0=y

CONFIG_FPU=y
CONFIG_FP_HARDABI=y  # Use lp64d for hard float
```

## boards/chipyard/riscv64/board.yml
```yaml
board:
  name: chipyard_riscv64
  full_name: Chipyard RISCV64 SoCs
  vendor: chipyard 
  socs:
    - name: rocketchip_virt_riscv64
      variants:
        - name: smp
```

## boards/chipyard/riscv64/chipyard_riscv64_defconfig
```kconfig
# SPDX-License-Identifier: Apache-2.0

CONFIG_PRIVILEGED_STACK_SIZE=2048
CONFIG_REBOOT=y
CONFIG_UART_HTIF=y
CONFIG_CONSOLE=y
CONFIG_UART_CONSOLE=y
CONFIG_SERIAL=y
CONFIG_PRINTK=y
CONFIG_EARLY_CONSOLE=y
CONFIG_STACK_SENTINEL=y
CONFIG_XIP=n
CONFIG_RISCV_PMP=n
CONFIG_SMP=y
CONFIG_MP_MAX_NUM_CPUS=1
CONFIG_IDLE_STACK_SIZE=1024
CONFIG_QEMU_ICOUNT=n

CONFIG_FPU=y
CONFIG_FLOAT_HARD=y
CONFIG_FPU_SHARING=y

# CONFIG_TIMER=y
CONFIG_TIMING_FUNCTIONS=y
CONFIG_SPEED_OPTIMIZATIONS=y

CONFIG_SYS_CLOCK_HW_CYCLES_PER_SEC=1000000
CONFIG_SYS_CLOCK_TICKS_PER_SEC=10000
```

## boards/circuit_dojo/circuitdojo_feather/board.yml
```yaml
board:
  name: circuitdojo_feather
  vendor: Circuit Dojo
  socs:
  - name: nrf9160
    variants:
    - name: 'ns'
```

## boards/circuit_dojo/feather/board.yml
```yaml
board:
  name: circuitdojo_feather
  vendor: circuitdojo
  socs:
  - name: nrf9160
    variants:
    - name: 'ns'
```

## boards/circuitdojo/feather/Kconfig.circuitdojo_feather
```kconfig
# Circuit Dojo nRF9160 Feather configuration

# Copyright (c) 2018-2020 Nordic Semiconductor ASA
# Copyright (c) 2020 Circuit Dojo LLC
# SPDX-License-Identifier: Apache-2.0

config BOARD_CIRCUITDOJO_FEATHER
	select SOC_NRF9160_SICA
```

## boards/circuitdojo/feather/Kconfig.defconfig
```kconfig
# Circuit Dojo nRF9160 Feather configuration

# Copyright (c) 2018-2020 Nordic Semiconductor ASA
# Copyright (c) 2020 Circuit Dojo LLC
# SPDX-License-Identifier: Apache-2.0

# For the secure version of the board the firmware is linked at the beginning
# of the flash, or into the code-partition defined in DT if it is intended to
# be loaded by MCUboot. If the secure firmware is to be combined with a non-
# secure image (TRUSTED_EXECUTION_SECURE=y), the secure FW image shall always
# be restricted to the size of its code partition.
# For the non-secure version of the board, the firmware
# must be linked into the code-partition (non-secure) defined in DT, regardless.
# Apply this configuration below by setting the Kconfig symbols used by
# the linker according to the information extracted from DT partitions.

config BOARD_CIRCUITDOJO_FEATHER
	select USE_DT_CODE_PARTITION if BOARD_CIRCUITDOJO_FEATHER_NRF9160_NS
```

## boards/circuitdojo/feather/board.yml
```yaml
board:
  name: circuitdojo_feather
  full_name: nRF9160 Feather
  vendor: circuitdojo
  socs:
  - name: nrf9160
    variants:
    - name: 'ns'
```

## boards/circuitdojo/feather/circuitdojo_feather_nrf9160_defconfig
```kconfig
# SPDX-License-Identifier: Apache-2.0

# Enable MPU
CONFIG_ARM_MPU=y

# Enable TrustZone-M
CONFIG_ARM_TRUSTZONE_M=y

# Hardware stack protection
CONFIG_HW_STACK_PROTECTION=y

# Enable GPIO
CONFIG_GPIO=y

# Enable UART driver
CONFIG_SERIAL=y

# Enable console
CONFIG_CONSOLE=y
CONFIG_UART_CONSOLE=y

# Required to enable 3V3 power rail
CONFIG_REGULATOR=y
```

## boards/cirrus/crd40l26/Kconfig.crd40l26
```kconfig
# Copyright (c) 2026 Cirrus Logic, Inc.
# SPDX-License-Identifier: Apache-2.0

config BOARD_CRD40L26
	select SOC_STM32F401XD
```

## boards/cirrus/crd40l26/Kconfig.defconfig
```kconfig
# Cirrus CRD40L26 Holdout board configuration

# Copyright (c) 2026 Cirrus Logic, Inc.
# SPDX-License-Identifier: Apache-2.0

if BOARD_CRD40L26

configdefault SPI_STM32_INTERRUPT
	default y

endif # BOARD_CRD40L26
```

## boards/cirrus/crd40l26/board.yml
```yaml
board:
  name: crd40l26
  full_name: CRD40L26-POC-C
  vendor: cirrus
  socs:
    - name: stm32f401xd
```

## boards/cirrus/crd40l50/Kconfig.crd40l50
```kconfig
# Copyright (c) 2026 Cirrus Logic, Inc.
# SPDX-License-Identifier: Apache-2.0

# Required to select STM32F401XE instead of STM32F401XD because the STM32 HAL
# does not provide a #define for STM32F401xD variants. Because STM32F401xD and
# STM32F401xE microcontrollers are identical apart from the size of embedded
# flash memory, we select SOC_STM32F401XE.

config BOARD_CRD40L50
	select SOC_STM32F401XE
```

## boards/cirrus/crd40l50/Kconfig.defconfig
```kconfig
# Cirrus CRD40L50 Blackstar board configuration

# Copyright (c) 2026 Cirrus Logic, Inc.
# SPDX-License-Identifier: Apache-2.0

if BOARD_CRD40L50

configdefault SPI_STM32_INTERRUPT
	default y

endif # BOARD_CRD40L50
```

## boards/cirrus/crd40l50/board.yml
```yaml
board:
  name: crd40l50
  full_name: CRD40L50-POC-Q
  vendor: cirrus
  socs:
    - name: stm32f401xd
```

## boards/cirrus/crd40l50/crd40l50_defconfig
```kconfig
# Copyright (c) 2026 Cirrus Logic, Inc.
# SPDX-License-Identifier: Apache-2.0

CONFIG_GPIO=y
```

## boards/common/Kconfig.cdc_acm_serial
```kconfig
# Copyright (c) 2023-2024 Nordic Semiconductor ASA
#
# SPDX-License-Identifier: Apache-2.0

config SERIAL
	default y

config CONSOLE
	default y

config UART_CONSOLE
	default CONSOLE

config SHELL_BACKEND_SERIAL_CHECK_DTR
	default SHELL
	depends on UART_LINE_CTRL

config UART_LINE_CTRL
	default SHELL

config USB_DEVICE_STACK
	default y

config USB_DEVICE_INITIALIZE_AT_BOOT
	default y if !MCUBOOT

config USB_DEVICE_REMOTE_WAKEUP
	default n

if LOG

choice USB_CDC_ACM_LOG_LEVEL_CHOICE
	default USB_CDC_ACM_LOG_LEVEL_OFF
endchoice

choice USB_DEVICE_LOG_LEVEL_CHOICE
	default USB_DEVICE_LOG_LEVEL_OFF
endchoice

# Wait 4000ms at startup for logging
config LOG_PROCESS_THREAD_STARTUP_DELAY_MS
	default 4000

endif # LOG
```

## boards/common/usb/Kconfig.cdc_acm_serial.defconfig
```kconfig
# Copyright (c) 2023-2024 Nordic Semiconductor ASA
#
# SPDX-License-Identifier: Apache-2.0

config BOARD_REQUIRES_SERIAL_BACKEND_CDC_ACM
	default y

if BOARD_SERIAL_BACKEND_CDC_ACM

config SERIAL
	default y

config CONSOLE
	default y

config UART_CONSOLE
	default CONSOLE

config SHELL_BACKEND_SERIAL_CHECK_DTR
	default SHELL
	depends on UART_LINE_CTRL

config UART_LINE_CTRL
	default SHELL

config USB_DEVICE_STACK_NEXT
	default y if !MCUBOOT

config CDC_ACM_SERIAL_INITIALIZE_AT_BOOT
	default y if !MCUBOOT

if LOG

choice USBD_CDC_ACM_LOG_LEVEL_CHOICE
	default USBD_CDC_ACM_LOG_LEVEL_OFF
endchoice

choice USBD_LOG_LEVEL_CHOICE
	default USBD_LOG_LEVEL_OFF
endchoice

# Wait 4000ms at startup for logging
config LOG_PROCESS_THREAD_STARTUP_DELAY_MS
	default 4000

endif # LOG

endif # BOARD_SERIAL_BACKEND_CDC_ACM
```

## boards/contextual_electronics/contextualelectronics_abc/board.yml
```yaml
board:
  name: contextualelectronics_abc
  vendor: Contextual Electronics
  socs:
  - name: nrf52840
```

## boards/contextualelectronics/abc/Kconfig.contextualelectronics_abc
```kconfig
# ABC board configuration

# Copyright (c) 2020 Analog Life LLC
# SPDX-License-Identifier: Apache-2.0

config BOARD_CONTEXTUALELECTRONICS_ABC
	select SOC_NRF52840_QIAA
```

## boards/contextualelectronics/abc/board.yml
```yaml
board:
  name: contextualelectronics_abc
  vendor: contextualelectronics
  socs:
  - name: nrf52840
```

## boards/coredevices/p2d/Kconfig.p2d
```kconfig
# Copyright (c) 2025 Core Devices LLC
# SPDX-License-Identifier: Apache-2.0

config BOARD_P2D
	select SOC_NRF52840_QIAA
```
