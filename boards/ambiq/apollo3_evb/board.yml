## boards/ambiq/apollo3_evb/board.yml
```yaml
board:
  name: apollo3_evb
  full_name: Apollo3 Blue EVB
  vendor: ambiq
  socs:
  - name: apollo3_blue
```

## boards/ambiq/apollo3p_evb/Kconfig.apollo3p_evb
```kconfig
# SPDX-License-Identifier: Apache-2.0
#
# Copyright (c) 2023 Ambiq Micro Inc. <www.ambiq.com>

config BOARD_APOLLO3P_EVB
	select SOC_APOLLO3P_BLUE
```

## boards/ambiq/apollo3p_evb/Kconfig.defconfig
```kconfig
# SPDX-License-Identifier: Apache-2.0
#
# Copyright (c) 2024 Ambiq Micro Inc. <www.ambiq.com>

if BOARD_APOLLO3P_EVB

config LOG_BACKEND_SWO_FREQ_HZ
	default 1000000
	depends on LOG_BACKEND_SWO

endif # BOARD_APOLLO3P_EVB
```

## boards/ambiq/apollo3p_evb/board.yml
```yaml
board:
  name: apollo3p_evb
  full_name: Apollo3 Blue Plus EVB
  vendor: ambiq
  socs:
  - name: apollo3p_blue
```

## boards/ambiq/apollo4p_blue_kxr_evb/Kconfig.apollo4p_blue_kxr_evb
```kconfig
# SPDX-License-Identifier: Apache-2.0
#
# Copyright (c) 2023 Ambiq Micro Inc. <www.ambiq.com>

config BOARD_APOLLO4P_BLUE_KXR_EVB
	select SOC_APOLLO4P_BLUE
```

## boards/ambiq/apollo4p_blue_kxr_evb/Kconfig.defconfig
```kconfig
# SPDX-License-Identifier: Apache-2.0
#
# Copyright (c) 2023 Ambiq Micro Inc. <www.ambiq.com>

if BOARD_APOLLO4P_BLUE_KXR_EVB

config SYS_CLOCK_HW_CYCLES_PER_SEC
	default 32768 if AMBIQ_STIMER_TIMER

config LOG_BACKEND_SWO_FREQ_HZ
	default 1000000
	depends on LOG_BACKEND_SWO

if BT

config MAIN_STACK_SIZE
	default 2048

config BT_BUF_ACL_TX_COUNT
	default 14

config BT_BUF_EVT_RX_COUNT
	default 15

config BT_BUF_CMD_TX_SIZE
	default $(UINT8_MAX)

config BT_BUF_EVT_RX_SIZE
	default $(UINT8_MAX)

config BT_BUF_ACL_TX_SIZE
	default 251

config BT_BUF_ACL_RX_SIZE
	default 251

# L2CAP SDU/PDU TX MTU
# BT_L2CAP_RX_MTU = CONFIG_BT_BUF_ACL_RX_SIZE - BT_L2CAP_HDR_SIZE
config BT_L2CAP_TX_MTU
	default 247

endif # BT

endif # BOARD_APOLLO4P_BLUE_KXR_EVB
```

## boards/ambiq/apollo4p_blue_kxr_evb/apollo4p_blue_kxr_evb_apollo4p_blue_defconfig
```kconfig
# SPDX-License-Identifier: Apache-2.0
#
# Copyright (c) 2023 Ambiq Micro Inc. <www.ambiq.com>

CONFIG_CONSOLE=y
CONFIG_UART_CONSOLE=y
CONFIG_SERIAL=y
CONFIG_UART_INTERRUPT_DRIVEN=y
```

## boards/ambiq/apollo4p_blue_kxr_evb/board.yml
```yaml
board:
  name: apollo4p_blue_kxr_evb
  full_name: Apollo4 Blue Plus KXR EVB
  vendor: ambiq
  socs:
  - name: apollo4p_blue
```

## boards/ambiq/apollo4p_evb/Kconfig.apollo4p_evb
```kconfig
# SPDX-License-Identifier: Apache-2.0
#
# Copyright (c) 2023 Antmicro <www.antmicro.com>

config BOARD_APOLLO4P_EVB
	select SOC_APOLLO4P
```

## boards/ambiq/apollo4p_evb/Kconfig.defconfig
```kconfig
# SPDX-License-Identifier: Apache-2.0
#
# Copyright (c) 2024 Ambiq Micro Inc. <www.ambiq.com>

if BOARD_APOLLO4P_EVB

config SYS_CLOCK_HW_CYCLES_PER_SEC
	default 32768 if AMBIQ_STIMER_TIMER

config LOG_BACKEND_SWO_FREQ_HZ
	default 1000000
	depends on LOG_BACKEND_SWO

endif # BOARD_APOLLO4P_EVB
```

## boards/ambiq/apollo4p_evb/apollo4p_evb_defconfig
```kconfig
# SPDX-License-Identifier: Apache-2.0
#
# Copyright (c) 2023 Antmicro <www.antmicro.com>

CONFIG_CONSOLE=y
CONFIG_UART_CONSOLE=y
CONFIG_SERIAL=y
CONFIG_UART_INTERRUPT_DRIVEN=y
```

## boards/ambiq/apollo4p_evb/board.yml
```yaml
board:
  name: apollo4p_evb
  full_name: Apollo4P EVB
  vendor: ambiq
  socs:
  - name: apollo4p
```

## boards/ambiq/apollo510_eb/board.yml
```yaml
board:
  name: apollo510_eb
  full_name: Apollo510 SOC Engineering Board
  vendor: ambiq
  socs:
  - name: apollo510
```

## boards/ambiq/apollo510_evb/Kconfig
```kconfig
# SPDX-License-Identifier: Apache-2.0
#
# Copyright (c) 2025 Ambiq Micro Inc. <www.ambiq.com>

config BOARD_APOLLO510_EVB
	select BOARD_EARLY_INIT_HOOK
```

## boards/ambiq/apollo510_evb/Kconfig.apollo510_evb
```kconfig
# SPDX-License-Identifier: Apache-2.0
#
# Copyright (c) 2025 Ambiq Micro Inc. <www.ambiq.com>

config BOARD_APOLLO510_EVB
	select SOC_APOLLO510
```

## boards/ambiq/apollo510_evb/Kconfig.defconfig
```kconfig
# SPDX-License-Identifier: Apache-2.0
#
# Copyright (c) 2025 Ambiq Micro Inc.

if BOARD_APOLLO510_EVB

config SYS_CLOCK_HW_CYCLES_PER_SEC
	default 32768 if AMBIQ_STIMER_TIMER
	default 96000000 if CORTEX_M_SYSTICK

config LOG_BACKEND_SWO_FREQ_HZ
	default 1000000
	depends on LOG_BACKEND_SWO

if MSPI

config MSPI_INIT_PRIORITY
	default 40

endif # MSPI

if MEMC

config MEMC_INIT_PRIORITY
	default 50

endif # MEMC

if FLASH

config FLASH_INIT_PRIORITY
	default 50

endif # FLASH

endif # BOARD_APOLLO510_EVB
```

## boards/ambiq/apollo510_evb/apollo510_evb_defconfig
```kconfig
# SPDX-License-Identifier: Apache-2.0
#
# Copyright (c) 2025 Ambiq Micro Inc.

CONFIG_CONSOLE=y
CONFIG_UART_CONSOLE=y
CONFIG_SERIAL=y
CONFIG_UART_INTERRUPT_DRIVEN=y
CONFIG_HW_STACK_PROTECTION=y
CONFIG_ARM_MPU=y
CONFIG_PM=y
CONFIG_PM_DEVICE=y
CONFIG_PM_DEVICE_RUNTIME=y
```

## boards/ambiq/apollo510_evb/board.yml
```yaml
board:
  name: apollo510_evb
  full_name: Apollo510 SOC Evaluation Board
  vendor: ambiq
  socs:
  - name: apollo510
```

## boards/ambiq/apollo510b_evb/Kconfig
```kconfig
# SPDX-License-Identifier: Apache-2.0
#
# Copyright (c) 2025 Ambiq Micro Inc. <www.ambiq.com>

config BOARD_APOLLO510B_EVB
	select BOARD_EARLY_INIT_HOOK

if BOARD_APOLLO510B_EVB
config BOARD_ENABLE_GPU_ASSET_RELOCATION
	bool "Relocate GPU asset from MRAM to PSRAM or SSRAM"
	default y if LVGL
	select BOARD_LATE_INIT_HOOK
	help
	  The Apollo510B GPU has limited access to MRAM. If this option is
	  enabled, large constant assets (like LVGL fonts and images) will
	  be loaded into MRAM but copied to external XIP RAM at BOARD_LATE_INIT_HOOK
	  for direct access by the GPU. This is essential for any LVGL
	  application with large assets on this board.
endif
```

## boards/ambiq/apollo510b_evb/Kconfig.sysbuild
```kconfig
# SPDX-License-Identifier: Apache-2.0
#
# Copyright (c) 2025 Ambiq Micro Inc.

choice BOOTLOADER
	default BOOTLOADER_MCUBOOT
endchoice
```

## boards/ambiq/apollo510b_evb/board.yml
```yaml
board:
  name: apollo510b_evb
  full_name: Apollo510 Blue SoC Evaluation Board
  vendor: ambiq
  socs:
  - name: apollo510b
```

## boards/amd/acp_6_0_adsp/Kconfig.acp_6_0_adsp
```kconfig
# Copyright (c) 2024 AMD
# SPDX-License-Identifier: Apache-2.0

config BOARD_ACP_6_0_ADSP
select SOC_ACP_6_0
```

## boards/amd/acp_6_0_adsp/acp_6_0_adsp_defconfig
```kconfig
# Copyright (c) 2026 AMD
# SPDX-License-Identifier: Apache-2.0

CONFIG_GEN_ISR_TABLES=y
CONFIG_GEN_IRQ_VECTOR_TABLE=n
CONFIG_XTENSA_RESET_VECTOR=n
CONFIG_OUTPUT_SYMBOLS=n
CONFIG_MULTI_LEVEL_INTERRUPTS=n
CONFIG_2ND_LEVEL_INTERRUPTS=n
```

## boards/amd/acp_6_0_adsp/board.yml
```yaml
board:
  name: acp_6_0_adsp
  full_name: ACP 6.0 Xtensa Audio DSP
  vendor: amd
  socs:
    - name: acp_6_0
```

## boards/amd/acp_7_0_adsp/Kconfig.acp_7_0_adsp
```kconfig
# Copyright (c) 2026 AMD
# SPDX-License-Identifier: Apache-2.0

config BOARD_ACP_7_0_ADSP
	select SOC_ACP_7_0
```
