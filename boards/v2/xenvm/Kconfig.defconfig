## boards/v2/xenvm/Kconfig.defconfig
```kconfig
# Copyright (c) 2020 EPAM Systems
# SPDX-License-Identifier: Apache-2.0

if BOARD_XENVM

config BUILD_OUTPUT_BIN
	default y

endif # BOARD_XENVM
```

## boards/v2/xenvm/board.yml
```yaml
board:
  name: xenvm
  vendor: Xen
  socs:
  - name: xenvm
    variants:
    - name: gicv3
```

## boards/variscite/imx8mp_var_dart/Kconfig.imx8mp_var_dart
```kconfig
# Copyright 2025 Variscite Ltd.
# Copyright 2021-2022, 2024 NXP
# SPDX-License-Identifier: Apache-2.0

config BOARD_IMX8MP_VAR_DART
	select SOC_MIMX8ML8_A53 if BOARD_IMX8MP_VAR_DART_MIMX8ML8_A53
	select SOC_MIMX8ML8_M7 if BOARD_IMX8MP_VAR_DART_MIMX8ML8_M7 || BOARD_IMX8MP_VAR_DART_MIMX8ML8_M7_DDR
	select SOC_PART_NUMBER_MIMX8ML8DVNLZ
```

## boards/variscite/imx8mp_var_dart/board.yml
```yaml
boards:
  - name: imx8mp_var_dart
    full_name: DART-MX8M-PLUS
    vendor: variscite
    socs:
      - name: mimx8ml8
        variants:
          - name: ddr
            cpucluster: m7
```

## boards/variscite/imx8mp_var_dart/imx8mp_var_dart_mimx8ml8_m7_ddr_defconfig
```kconfig
#
# Copyright 2025 Variscite Ltd.
# Copyright (c) 2021, Laird Connectivity
#
# SPDX-License-Identifier: Apache-2.0
#

CONFIG_CLOCK_CONTROL=y
CONFIG_UART_CONSOLE=y
CONFIG_SERIAL=y
CONFIG_CONSOLE=y
CONFIG_XIP=y
CONFIG_CODE_DDR=y
CONFIG_FLASH_BASE_ADDRESS=0x7b000000
CONFIG_FLASH_SIZE=2048
```

## boards/variscite/imx8mp_var_som/board.yml
```yaml
boards:
  - name: imx8mp_var_som
    full_name: VAR-SOM-MX8M-PLUS
    vendor: variscite
    socs:
      - name: mimx8ml8
        variants:
          - name: ddr
            cpucluster: m7
```

## boards/variscite/imx93_var_dart/Kconfig.imx93_var_dart
```kconfig
# Copyright 2025 Variscite Ltd.
# Copyright 2022,2024 NXP
# SPDX-License-Identifier: Apache-2.0

config BOARD_IMX93_VAR_DART
	select SOC_MIMX9352_A55 if BOARD_IMX93_VAR_DART_MIMX9352_A55
	select SOC_MIMX9352_M33 if BOARD_IMX93_VAR_DART_MIMX9352_M33
	select SOC_PART_NUMBER_MIMX9352DVVXM
```

## boards/variscite/imx93_var_dart/board.yml
```yaml
boards:
  - name: imx93_var_dart
    full_name: DART-MX93
    vendor: variscite
    socs:
      - name: mimx9352
```

## boards/variscite/imx93_var_som/board.yml
```yaml
boards:
  - name: imx93_var_som
    full_name: VAR-SOM-MX93
    vendor: variscite
    socs:
      - name: mimx9352
```

## boards/variscite/imx95_var_dart/Kconfig.imx95_var_dart
```kconfig
# Copyright 2024 NXP
# SPDX-License-Identifier: Apache-2.0

config BOARD_IMX95_VAR_DART
	select SOC_MIMX9596_M7 if BOARD_IMX95_VAR_DART_MIMX9596_M7
	select SOC_MIMX9596_A55 if BOARD_IMX95_VAR_DART_MIMX9596_A55
	select SOC_PART_NUMBER_MIMX9596AVZXN
```

## boards/variscite/imx95_var_dart/board.yml
```yaml
board:
  name: imx95_var_dart
  full_name: DART-MX95
  vendor: variscite
  socs:
  - name: mimx9596
```

## boards/vcc-gnd/yd_esp32/Kconfig
```kconfig
# Copyright (c) 2023 Julio Cesar <hi@jcsx.dev>
# SPDX-License-Identifier: Apache-2.0

config HEAP_MEM_POOL_ADD_SIZE_BOARD
	int
	default 4096 if BOARD_YD_ESP32_ESP32_PROCPU
	default 256 if BOARD_YD_ESP32_ESP32_APPCPU
```

## boards/vcc-gnd/yd_esp32/Kconfig.defconfig
```kconfig
# YD-ESP32 board configuration

# Copyright (c) 2023 Julio Cesar <hi@jcsx.dev>
# SPDX-License-Identifier: Apache-2.0

if BOARD_YD_ESP32_ESP32_PROCPU

config HEAP_MEM_POOL_ADD_SIZE_BOARD
	int
	default $(UINT16_MAX) if WIFI && BT
	default 51200 if WIFI
	default 40960 if BT
	default 4096

endif # BOARD_YD_ESP32_ESP32_PROCPU

if BOARD_YD_ESP32_ESP32_APPCPU

config HEAP_MEM_POOL_ADD_SIZE_BOARD
	default 256

endif # BOARD_YD_ESP32_ESP32_PROCPU
```

## boards/vcc-gnd/yd_esp32/Kconfig.yd_esp32
```kconfig
# YD-ESP32 board configuration

# Copyright (c) 2023 Julio Cesar <hi@jcsx.dev>
# SPDX-License-Identifier: Apache-2.0

config BOARD_YD_ESP32
	select SOC_ESP32_WROOM_32UE_N4
```

## boards/vcc-gnd/yd_esp32/board.yml
```yaml
board:
  name: yd_esp32
  full_name: YD-ESP32
  vendor: vcc-gnd
  socs:
  - name: esp32
```

## boards/vcc-gnd/yd_esp32/yd_esp32_procpu_defconfig
```kconfig
# Copyright (c) 2023 Julio Cesar <hi@jcsx.dev>
# SPDX-License-Identifier: Apache-2.0

CONFIG_CONSOLE=y
CONFIG_SERIAL=y
CONFIG_UART_CONSOLE=y

CONFIG_GPIO=y
```

## boards/vcc-gnd/yd_stm32h750vb/Kconfig.defconfig
```kconfig
# YD-STM32H750VB board configuration

# Copyright(c) 2024 John Sanpe <sanpeqf@gmail.com>
# SPDX-License-Identifier: Apache-2.0

if BOARD_YD_STM32H750VB

config DISK_DRIVER_SDMMC
	default y if DISK_DRIVERS

endif # BOARD_YD_STM32H750VB
```

## boards/vcc-gnd/yd_stm32h750vb/Kconfig.yd_stm32h750vb
```kconfig
# YD-STM32H750VB board configuration

# Copyright(c) 2024 John Sanpe <sanpeqf@gmail.com>
# SPDX-License-Identifier: Apache-2.0

config BOARD_YD_STM32H750VB
	select SOC_STM32H750XX
```

## boards/vcc-gnd/yd_stm32h750vb/board.yml
```yaml
board:
  name: yd_stm32h750vb
  full_name: YD-STM32H750VB
  vendor: vcc-gnd
  socs:
    - name: stm32h750xx
```

## boards/vcc-gnd/yd_stm32h750vb/yd_stm32h750vb_defconfig
```kconfig
# Copyright(c) 2024 John Sanpe <sanpeqf@gmail.com>
# SPDX-License-Identifier: Apache-2.0

# Enable the internal SMPS regulator
CONFIG_POWER_SUPPLY_LDO=y

# Enable MPU
CONFIG_ARM_MPU=y

# Enable HW stack protection
CONFIG_HW_STACK_PROTECTION=y

CONFIG_SERIAL=y

# console
CONFIG_CONSOLE=y
CONFIG_UART_CONSOLE=y

# enable GPIO
CONFIG_GPIO=y

# Enable Clocks
CONFIG_CLOCK_CONTROL=y
```

## boards/vicharak/shrike_lite/Kconfig.defconfig
```kconfig
# Shrike Lite board configuration
#
# Copyright (c) 2026 Dhruv Menon <dhruvmenon1104@gmail.com>
#
# SPDX-License-Identifier: Apache-2.0

if BOARD_SHRIKE_LITE

if I2C_DW

config I2C_DW_CLOCK_SPEED
	default 125

endif # I2C_DW

config USB_SELF_POWERED
	default n

endif # BOARD_SHRIKE_LITE
```

## boards/vicharak/shrike_lite/Kconfig.shrike_lite
```kconfig
# Copyright (C) 2025 Dhruv Menon <dhruvmenon1104@gmail.com>
# SPDX-License-Identifier: Apache-2.0

config BOARD_SHRIKE_LITE
	select SOC_RP2040
```

## boards/vicharak/shrike_lite/board.yml
```yaml
board:
  name: shrike_lite
  full_name: Shrike-lite
  vendor: vicharak
  socs:
  - name: rp2040
```

## boards/vicharak/shrike_lite/shrike_lite_defconfig
```kconfig
# Shrike Lite board configuration
#
# Copyright (c) 2026 Dhruv Menon <dhruvmenon1104@gmail.com>
#
# SPDX-License-Identifier: Apache-2.0

CONFIG_SERIAL=y
CONFIG_UART_INTERRUPT_DRIVEN=y
CONFIG_CONSOLE=y
CONFIG_UART_CONSOLE=y
CONFIG_GPIO=y
CONFIG_RESET=y
CONFIG_CLOCK_CONTROL=y
CONFIG_USE_DT_CODE_PARTITION=y
CONFIG_BUILD_OUTPUT_UF2=y
```

## boards/viewe/uedx24240013_md50e/Kconfig.defconfig
```kconfig
# Copyright (c) 2026 VIEWE Display Co., Ltd.
# SPDX-License-Identifier: Apache-2.0

if BOARD_UEDX24240013_MD50E

config KERNEL_MEM_POOL
	default y

if DISPLAY

if LVGL

configdefault LV_COLOR_16_SWAP
	default y

config LV_Z_VDB_SIZE
	default 20

endif # LVGL

config REGULATOR
	default y

endif # DISPLAY

endif # BOARD_UEDX24240013_MD50E
```
