## boards/v2/gd/gd32e507v_start/board.yml
```yaml
board:
  name: gd32e507v_start
  vendor: GigaDevice Semiconductor
  socs:
    - name: gd32e507
```

## boards/v2/gd/gd32e507z_eval/board.yml
```yaml
board:
  name: gd32e507z_eval
  vendor: GigaDevice Semiconductor
  socs:
    - name: gd32e507
```

## boards/v2/gd/gd32f350r_eval/board.yml
```yaml
board:
  name: gd32f350r_eval
  vendor: GigaDevice Semiconductor
  socs:
    - name: gd32f350
```

## boards/v2/gd/gd32f407v_start/board.yml
```yaml
board:
  name: gd32f407v_start
  vendor: GigaDevice Semiconductor
  socs:
    - name: gd32f407
```

## boards/v2/gd/gd32f450i_eval/board.yml
```yaml
board:
  name: gd32f450i_eval
  vendor: GigaDevice Semiconductor
  socs:
    - name: gd32f450
```

## boards/v2/gd/gd32f470i_eval/board.yml
```yaml
board:
  name: gd32f470i_eval
  vendor: GigaDevice Semiconductor
  socs:
    - name: gd32f470
```

## boards/v2/gd/gd32l233r_eval/board.yml
```yaml
board:
  name: gd32l233r_eval
  vendor: GigaDevice Semiconductor
  socs:
    - name: gd32l233
```

## boards/v2/khadas/khadas_edgev/khadas_edgev_defconfig
```kconfig
# SPDX-License-Identifier: Apache-2.0

# Platform Configuration
CONFIG_ARM64_VA_BITS_40=y
CONFIG_ARM64_PA_BITS_40=y
CONFIG_SYS_CLOCK_HW_CYCLES_PER_SEC=24000000
CONFIG_CACHE_MANAGEMENT=y
CONFIG_ARMV8_A_NS=y

# Serial Drivers
CONFIG_SERIAL=y
CONFIG_UART_INTERRUPT_DRIVEN=y

# Enable Console
CONFIG_CONSOLE=y
CONFIG_UART_CONSOLE=y
```

## boards/v2/phytec/phyboard_lyra_am62x/Kconfig.phyboard_lyra_am62x
```kconfig
# Texas Instruments Sitara AM62x-SK-M4 EVM
#
# Copyright (c) 2023 Texas Instruments Incorporated
# Copyright (c) 2023 L Lakshmanan
#
# SPDX-License-Identifier: Apache-2.0

config BOARD_PHYBOARD_LYRA_AM62X
	select SOC_AM6234_M4 if BOARD_PHYBOARD_LYRA_AM62X_AM6234_M4
	help
	  PHYTEC AM62x M4 phyBOARD-Lyra
```

## boards/v2/qemu/nios2/qemu_nios2_defconfig
```kconfig
# Copyright (c) 2018 Intel Corporation
# SPDX-License-Identifier: Apache-2.0

CONFIG_HAS_ALTERA_HAL=y
CONFIG_CONSOLE=y
CONFIG_SERIAL=y
CONFIG_UART_CONSOLE=y
CONFIG_INCLUDE_RESET_VECTOR=n
CONFIG_EXTRA_EXCEPTION_INFO=y
CONFIG_QEMU_ICOUNT_SHIFT=4
```

## boards/v2/qemu/qemu_leon3/Kconfig
```kconfig
# Copyright (c) 2019-2020 Cobham Gaisler AB
#
# SPDX-License-Identifier: Apache-2.0

config BOARD_QEMU_LEON3
	select QEMU_TARGET
	select CPU_HAS_FPU
```

## boards/v2/quicklogic/quick_feather/Kconfig
```kconfig
# Quick Feather board

# Copyright (c) 2020 Antmicro <www.antmicro.com>
# SPDX-License-Identifier: Apache-2.0

config BOARD_INIT_PRIORITY
	int
	default KERNEL_INIT_PRIORITY_DEFAULT
	help
	  Board initialization priority.
```

## boards/v2/quicklogic/quick_feather/board.yml
```yaml
board:
  name: quick_feather
  vendor: QuickLogic
  socs:
  - name: quicklogic_eos_s3
```

## boards/v2/raspberry_pi/rpi_pico/Kconfig.rpi_pico
```kconfig
# Copyright (c) 2021 Yonatan Schachter
# SPDX-License-Identifier: Apache-2.0

config BOARD_RPI_PICO
	select SOC_RP2040
```

## boards/v2/riscv/riscv32_virtual/Kconfig.riscv32_virtual
```kconfig
# Copyright (c) 2024 Meta
#
# SPDX-License-Identifier: Apache-2.0

config BOARD_RISCV32_VIRTUAL
	select SOC_RISCV32_VIRTUAL_RENODE
```

## boards/v2/st/stm32f072_eval/Kconfig.stm32f072_eval
```kconfig
# Copyright (c) 2017 BayLibre, SAS
# SPDX-License-Identifier: Apache-2.0

config BOARD_STM32F072_EVAL
	select SOC_STM32F072XB
```

## boards/v2/ti/sk_am62/sk_am62_am6234_m4_defconfig
```kconfig
# Texas Instruments Sitara AM62x-SK-M4 EVM
#
# Copyright (c) 2023 Texas Instruments Incorporated
# Copyright (c) 2023 L Lakshmanan
#
# SPDX-License-Identifier: Apache-2.0

# Platform Configuration
CONFIG_CORTEX_M_SYSTICK=y

# Zephyr Kernel Configuration
CONFIG_XIP=n

# Enable Pinctrl
CONFIG_PINCTRL=y

# Serial Driver
CONFIG_SERIAL=y

# Enable Console
CONFIG_CONSOLE=y
CONFIG_UART_CONSOLE=y
```
