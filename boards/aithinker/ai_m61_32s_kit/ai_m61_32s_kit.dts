/*
 * Copyright (c) 2025-2026 MASSDRIVER EI (massdriver.space)
 *
 * SPDX-License-Identifier: Apache-2.0
 */

/dts-v1/;

#include "../common/ai_m61_32s_blifn8ir4all.dtsi"
#include "ai_m61_32s_kit_common.dtsi"
