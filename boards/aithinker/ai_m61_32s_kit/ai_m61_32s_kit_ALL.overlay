/*
 * Copyright (c) 2026 MASSDRIVER EI (massdriver.space)
 *
 * SPDX-License-Identifier: Apache-2.0
 */

&flash0 {
	/* ALL revision is BL618M65, which has an internal XMC Flash die
	 * instead of an external SOIC Flash.
	 */
	compatible = "soc-nv-flash", "xmc,xm25qw64";
};
