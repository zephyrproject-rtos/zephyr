/*
 * Copyright (c) 2026 MASSDRIVER EI (massdriver.space)
 *
 * SPDX-License-Identifier: Apache-2.0
 */

&flash0 {
	/* BLIFN8IR4 revision is BL618M65, which has an internal XMC Flash die
	 * instead of an external SOIC Flash.
	 */
	compatible = "bflb,sf-flash", "soc-nv-flash", "xmc,xm25qw64";
	rx-clock-invert;
};

/* With the settings used for their flash (Dual Out mode), the BLIFN8IR4 and BLOFN8IR4 revisions
 * need different flash clock settings to work properly at 640MHz FCLK.
 */

&clk_bclk {
	/* 100 + 20/3 (106.66...) MHz BCLK */
	divider = <6>;
};
