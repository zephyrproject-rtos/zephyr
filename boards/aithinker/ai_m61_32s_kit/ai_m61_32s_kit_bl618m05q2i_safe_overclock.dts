/*
 * Copyright (c) 2026 MASSDRIVER EI (massdriver.space)
 *
 * SPDX-License-Identifier: Apache-2.0
 */

/dts-v1/;

#include "ai_m61_32s.dtsi"
#include "ai_m61_32s_kit_common.dtsi"

&clk_wifipll {
	/* Increased PLL top output frequency to 480 MHz */
	top-frequency = <BL61X_WIFIPLL_TOP_FREQ_OC1>;
};

&clk_bclk {
	/* 120 MHz BCLK and so Flash clock at this FCLK works for both revisions */
	divider = <4>;
};

&clk_flash {
	/* 0 Units of delay for GD Flash but inverted RX */
	read-delay = <0>;
	rx-clock-invert;
	divider = <1>;
};
