/*
 * Copyright (c) 2026 MASSDRIVER EI (massdriver.space)
 *
 * SPDX-License-Identifier: Apache-2.0
 */

/dts-v1/;

#include "../common/ai_m61_32s_blofn8ir4all.dtsi"
#include "aipi_eyes_s2_common.dtsi"
