/*
 * Copyright (c) 2026 MASSDRIVER EI (massdriver.space)
 *
 * SPDX-License-Identifier: Apache-2.0
 */

/dts-v1/;

#include "ai_m61_32s.dtsi"
#include "aipi_eyes_s2_common.dtsi"

&clk_aupll {
	/* Increased PLL top output frequency to 640MHz */
	top-frequency = <BL61X_TOP_FREQ_OC2>;
};

&reg_soc {
	/* SoC LDO at 1.25v to handle 640MHz FCLK*/
	regulator-init-microvolt = <1250000>;
};

&clk_bclk {
	/* 640/7 (91.429...) MHz BCLK required, divider = <6> did not work */
	divider = <7>;
};
