## boards/xunlong/opi_zero/opi_zero_defconfig
```kconfig
# Copyright (c) 2025 Muhammad Waleed Badar
# SPDX-License-Identifier: Apache-2.0

# Serial Drivers
CONFIG_SERIAL=y

# Enable Console
CONFIG_CONSOLE=y
CONFIG_UART_CONSOLE=y
```

## boards/xunlong/opi_zero2w/Kconfig.opi_zero2w
```kconfig
# Copyright (c) 2026 Khai Do
# SPDX-License-Identifier: Apache-2.0

config BOARD_OPI_ZERO2W
	select SOC_SUN50I_H618
```

## boards/xunlong/opi_zero2w/board.yml
```yaml
# Copyright (c) 2026 Khai Do
# SPDX-License-Identifier: Apache-2.0

board:
  name: opi_zero2w
  full_name: Orange Pi Zero 2W
  vendor: xunlong
  socs:
  - name: sun50i_h618
```

## boards/xunlong/opi_zero2w/opi_zero2w_defconfig
```kconfig
# Copyright (c) 2026 Khai Do
# SPDX-License-Identifier: Apache-2.0
CONFIG_SERIAL=y
CONFIG_UART_INTERRUPT_DRIVEN=y
CONFIG_CONSOLE=y
CONFIG_UART_CONSOLE=y
CONFIG_ARMV8_A_NS=y
CONFIG_CACHE_MANAGEMENT=y
CONFIG_ARM64_DCACHE_ALL_OPS=y
CONFIG_ARM64_BOOT_DISABLE_DCACHE=y
```

## boards/xunlong/orangepi_5_ultra_rk3588/Kconfig.orangepi_5_ultra_rk3588
```kconfig
# Copyright The Zephyr Project Contributors
# SPDX-License-Identifier: Apache-2.0

config BOARD_ORANGEPI_5_ULTRA_RK3588
	select SOC_RK3588
```

## boards/xunlong/orangepi_5_ultra_rk3588/board.yml
```yaml
board:
  name: orangepi_5_ultra_rk3588
  full_name: Orange Pi 5 Ultra RK3588
  vendor: xunlong
  socs:
  - name: rk3588
```

## boards/xunlong/orangepi_5_ultra_rk3588/orangepi_5_ultra_rk3588_defconfig
```kconfig
# SPDX-License-Identifier: Apache-2.0
# Copyright The Zephyr Project Contributors

# Platform Configuration
CONFIG_ARM_ARCH_TIMER=y
CONFIG_CLOCK_CONTROL=y
CONFIG_ARM64_VA_BITS_40=y
CONFIG_ARM64_PA_BITS_40=y

# Serial Drivers
CONFIG_SERIAL=y
CONFIG_UART_NS16550=y
CONFIG_UART_INTERRUPT_DRIVEN=y

# Enable console
CONFIG_CONSOLE=y
CONFIG_UART_CONSOLE=y

# ARMv8 NS world with cache management
CONFIG_ARMV8_A_NS=y
CONFIG_CACHE_MANAGEMENT=y
```

## boards/zhaw/mc1board/Kconfig.defconfig
```kconfig
# MC1 board configuration
#
# SPDX-FileCopyrightText: Copyright (c) 2026 Institute of Embedded Systems ZHAW
#
# SPDX-License-Identifier: Apache-2.0
#

if BOARD_MC1BOARD

if NETWORKING

config NET_L2_ETHERNET
	default y

endif # NETWORKING

if DISK_DRIVER_SDMMC

config SDMMC_STM32_CLOCK_CHECK
	default n

endif # DISK_DRIVER_SDMMC

if DISPLAY

# Required to enable LCD backlight
config REGULATOR
	default y

config INPUT
	default y if LVGL

config I2C_STM32_V2_TIMING
	default y if INPUT

endif # DISPLAY

endif # BOARD_MC1BOARD
```

## boards/zhaw/mc1board/Kconfig.mc1board
```kconfig
# SPDX-FileCopyrightText: Copyright (c) 2026 Institute of Embedded Systems ZHAW
# SPDX-License-Identifier: Apache-2.0

config BOARD_MC1BOARD
	select SOC_STM32H573XX
```

## boards/zhaw/mc1board/board.yml
```yaml
board:
  name: mc1board
  full_name: MC1 Board
  vendor: zhaw
  socs:
    - name: stm32h573xx
```

## boards/zhaw/mc1board/mc1board_defconfig
```kconfig
# SPDX-FileCopyrightText: Copyright (c) 2026 Institute of Embedded Systems ZHAW
# SPDX-License-Identifier: Apache-2.0

# enable MPU
CONFIG_ARM_MPU=y

# enable HW stack protection
CONFIG_HW_STACK_PROTECTION=y

# enable UART driver
CONFIG_SERIAL=y

# enable console
CONFIG_CONSOLE=y
CONFIG_UART_CONSOLE=y

# enable GPIO
CONFIG_GPIO=y
```

## cmake/Kconfig.template.build_strategy
```kconfig
#
# Copyright (c) 2019 Nordic Semiconductor ASA
#
# SPDX-License-Identifier: Apache-2.0
#

choice
	prompt "build strategy"
	default $(image)_BUILD_STRATEGY_FROM_SOURCE

config $(image)_BUILD_STRATEGY_SKIP_BUILD
	# Mandatory option when being built through 'zephyr_add_image'
	bool "Skip building"

config $(image)_BUILD_STRATEGY_FROM_SOURCE
	# Mandatory option when being built through 'zephyr_add_image'
	bool "Build from source"

endchoice
```

## cmake/sca/Kconfig
```kconfig
# Static Code Analysis (SCA) options

# Copyright (c) 2024 Baumer (www.baumer.com)
# SPDX-License-Identifier: Apache-2.0

menu "Static Code Analysis (SCA) tools"

if "$(ZEPHYR_SCA_VARIANT)" = "eclair"
source "cmake/sca/eclair/Kconfig.eclair"
endif

endmenu
```

## cmake/sca/eclair/Kconfig.eclair
```kconfig
# SPDX-License-Identifier: Apache-2.0
#
# Copyright (c) 2023, BUGSENG Srl

mainmenu "ECLAIR Configurations"

menu "ECLAIR env configurations"

config ECLAIR
	bool
	default y
	select EXPERIMENTAL

choice ECLAIR_RULESET
	prompt "ECLAIR analysis ruleset"
	default ECLAIR_RULESET_FIRST_ANALYSIS

config ECLAIR_RULESET_FIRST_ANALYSIS
	bool "first analysis [EXPERIMENTAL]"
	help
	  A tiny selection of the projects coding guideline rules to verify that everything is
	  correctly working.

config ECLAIR_RULESET_STU
	bool "Single translation unit[EXPERIMENTAL]"
	help
	  Selection of the projects coding guidelines, which can be verified by analysing the single
	  translation units independently.

config ECLAIR_RULESET_STU_HEAVY
	bool "STU heavy [EXPERIMENTAL]"
	help
	  Selection of complex STU project coding guidelines that require a significant amount
	  of time.

config ECLAIR_RULESET_WP
	bool "Whole Program rules [EXPERIMENTAL]"
	help
	  All whole program project coding guidelines ("system" in MISRA's parlance).

config ECLAIR_RULESET_STD_LIB
	bool "Std library [EXPERIMENTAL]"
	help
	  Project coding guidelines about the C Standard Library.

config ECLAIR_RULESET_USER
	bool "user defined ruleset [EXPERIMENTAL]"
	help
	  With this option, a user specific ruleset can be defined and analyzed.

endchoice

config ECLAIR_USER_RULESET_NAME
	string "Name of the user defined ruleset [EXPERIMENTAL]"
	depends on ECLAIR_RULESET_USER
	help
	  Name of the user defined analysis ruleset for example: analysis_user.ecl.
	  The name always need the prefix analysis_ and need to end with .ecl

config ECLAIR_USER_RULESET_PATH
	string "Path to the user defined ruleset [EXPERIMENTAL]"
	depends on ECLAIR_RULESET_USER
	help
	  Path to the user defined analysis ruleset. The Path can be an absolute path or a relative path
	  in the application source directory. If this is option is not set the default path is always
	  the application source directory.

endmenu

menu "ECLAIR report generation configurations"

config ECLAIR_METRICS_TAB
	bool "Creation of metrics in spreadsheet format [EXPERIMENTAL]"
	help
	  Metrics in a spreadsheet format

config ECLAIR_REPORTS_TAB
	bool "Creation of findings in spreadsheet format [EXPERIMENTAL]"
	help
	  Findings in a spreadsheet format

config ECLAIR_REPORTS_SARIF
	bool "Creation of findings in sarif format [EXPERIMENTAL]"
	help
	  Findings in sarif JSON format

config ECLAIR_SUMMARY_TXT
	bool "Creation of summary report in plain textual format [EXPERIMENTAL]"
	help
	  Plain textual summary format

config ECLAIR_SUMMARY_DOC
	bool "Creation of summary report in DOC format [EXPERIMENTAL]"
	help
	  DOC summary format

config ECLAIR_SUMMARY_ODT
	bool "Creation of summary report in ODT format [EXPERIMENTAL]"
	help
	  ODT summary format

config ECLAIR_FULL_TXT
	bool "Creation of rich/detailed report in plain textual format [EXPERIMENTAL]"
	help
	  Detailed plain textual format

config ECLAIR_FULL_DOC
	bool "Creation of rich/detailed report in DOC format [EXPERIMENTAL]"
	help
	  Detailed DOC format

config ECLAIR_FULL_ODT
	bool "Creation of rich/detailed report in ODT format [EXPERIMENTAL]"
	help
	  Detailed ODT format

choice ECLAIR_FULL_DOC_AREAS
	prompt "Detail level of full DOC/ODT reports"
	depends on (ECLAIR_FULL_DOC || ECLAIR_FULL_ODT)
	default ECLAIR_FULL_DOC_FIRST_AREA

config ECLAIR_FULL_DOC_ALL_AREAS
	bool "areas [EXPERIMENTAL]"
	help
	  Show all areas

config ECLAIR_FULL_DOC_FIRST_AREA
	bool "first area [EXPERIMENTAL]"
	help
	  Show only the first area

endchoice

choice ECLAIR_FULL_TXT_AREAS
	prompt "Detail level of full txt reports"
	depends on ECLAIR_FULL_TXT
	default ECLAIR_FULL_TXT_FIRST_AREA

config ECLAIR_FULL_TXT_ALL_AREAS
	bool "areas [EXPERIMENTAL]"
	help
	  Show all areas

config ECLAIR_FULL_TXT_FIRST_AREA
	bool "first area [EXPERIMENTAL]"
	help
	  Show only the first area

endchoice

endmenu
```

## cmake/toolchain/andes/Kconfig
```kconfig
# Copyright (c) 2025 Andes Technology Corporation
# SPDX-License-Identifier: Apache-2.0

config TOOLCHAIN_ANDES_SUPPORTS_THREAD_LOCAL_STORAGE
	def_bool y
	select TOOLCHAIN_SUPPORTS_THREAD_LOCAL_STORAGE
	select THREAD_LOCAL_STORAGE if CPP

config TOOLCHAIN_ANDES_SUPPORTS_GNU_EXTENSIONS
	def_bool y
	select TOOLCHAIN_SUPPORTS_GNU_EXTENSIONS
```

## cmake/toolchain/arcmwdt/Kconfig
```kconfig
# Copyright (c) 2022 Synopsys
# SPDX-License-Identifier: Apache-2.0

config TOOLCHAIN_ARCMWDT_SUPPORTS_THREAD_LOCAL_STORAGE
	def_bool y
	select TOOLCHAIN_SUPPORTS_THREAD_LOCAL_STORAGE
```

## cmake/toolchain/armclang/Kconfig
```kconfig
# Copyright (c) 2021 Nordic Semiconductor ASA
# SPDX-License-Identifier: Apache-2.0

config LD_LINKER_SCRIPT_SUPPORTED
	bool
	default n

choice LINKER_SCRIPT
	default CMAKE_LINKER_GENERATOR
endchoice

choice LIBC_IMPLEMENTATION
	prompt "C Library Implementation"
	default ARMCLANG_STD_LIBC

config ARMCLANG_STD_LIBC
	bool "ARM Compiler C library"
	select COMMON_LIBC_STRNLEN
	select COMMON_LIBC_TIME if POSIX_CLOCK
	help
	  Use the full Arm Compiler runtime libraries.
	  A reduced Zephyr minimal libc will be used for library functionality
	  not provided by ARM Compiler standard libraries.

endchoice

config TOOLCHAIN_ARMCLANG_SUPPORTS_GNU_EXTENSIONS
	def_bool y
	select TOOLCHAIN_SUPPORTS_GNU_EXTENSIONS
```

## cmake/toolchain/armclang/Kconfig.defconfig
```kconfig
# Copyright (c) 2021 Nordic Semiconductor ASA
# Copyright 2026 Arm Limited and/or its affiliates <open-source-office@arm.com>
# SPDX-License-Identifier: Apache-2.0

config MINIMAL_LIBC_SUPPORTED
	bool
	default n

config PICOLIBC_SUPPORTED
	default n
```

## cmake/toolchain/atfe/Kconfig
```kconfig
# ARM Toolchain for Embedded (ATfE)

# Copyright (c) 2025 Alex Fabre.
# SPDX-License-Identifier: Apache-2.0

config TOOLCHAIN_ATFE
	def_bool y
	select PICOLIBC_SUPPORTED

config TOOLCHAIN_ATFE_SUPPORTS_THREAD_LOCAL_STORAGE
	depends on ARM || ARM64
	def_bool y
	select TOOLCHAIN_SUPPORTS_THREAD_LOCAL_STORAGE

config TOOLCHAIN_ATFE_SUPPORTS_GNU_EXTENSIONS
	def_bool y
	select TOOLCHAIN_SUPPORTS_GNU_EXTENSIONS
```

## cmake/toolchain/cross-compile/Kconfig
```kconfig
# Copyright © 2022 Keith Packard
# SPDX-License-Identifier: Apache-2.0

config TOOLCHAIN_CROSS_COMPILE_SUPPORTS_THREAD_LOCAL_STORAGE
	bool "Cross-compile toolchain supports TLS"
	select TOOLCHAIN_SUPPORTS_THREAD_LOCAL_STORAGE
	help
	  Set this if the cross-compile toolchain being used for the build
	  supports thread local storage.
```

## cmake/toolchain/espressif/Kconfig
```kconfig
# Copyright © 2023 Keith Packard
# SPDX-License-Identifier: Apache-2.0

config NEWLIB_LIBC_SUPPORTED
	def_bool y
	help
	  Espressif supports newlib for C and C++ development.
```

## cmake/toolchain/gnuarc/Kconfig
```kconfig
# GNU ARC Toolchain

# Copyright (c) 2020 Synopsys
# SPDX-License-Identifier: Apache-2.0

config TOOLCHAIN_GNUARC
	def_bool y
	select HAS_NEWLIB_LIBC_NANO
```

## cmake/toolchain/gnuarmemb/Kconfig
```kconfig
# GNU ARM Embedded Toolchain

# Copyright (c) 2020 Linaro Limited.
# SPDX-License-Identifier: Apache-2.0

config TOOLCHAIN_GNUARMEMB
	def_bool y
	select HAS_NEWLIB_LIBC_NANO
	select NEWLIB_LIBC_SUPPORTED

config TOOLCHAIN_GNUARMEMB_SUPPORTS_GNU_EXTENSIONS
	def_bool y
	select TOOLCHAIN_SUPPORTS_GNU_EXTENSIONS
```

## cmake/toolchain/host/gnu/Kconfig
```kconfig
# Copyright (c) 2024 Basalte bv
# SPDX-License-Identifier: Apache-2.0

config TOOLCHAIN_HOST_SUPPORTS_GNU_EXTENSIONS
	def_bool y
	select TOOLCHAIN_SUPPORTS_GNU_EXTENSIONS
```
