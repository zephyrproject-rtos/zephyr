## boards/enjoydigital/litex_vexriscv/litex_vexriscv_defconfig
```kconfig
#
# Copyright (c) 2019 Antmicro <www.antmicro.com>
#
# SPDX-License-Identifier: Apache-2.0
#

CONFIG_CONSOLE=y
CONFIG_SERIAL=y
CONFIG_UART_CONSOLE=y
CONFIG_GPIO=y
CONFIG_XIP=n
CONFIG_CLOCK_CONTROL=y
CONFIG_HEAP_MEM_POOL_SIZE=4096
CONFIG_SPI_NOR_SFDP_RUNTIME=y
```

## boards/espressif/esp32_devkitc/Kconfig.esp32_devkitc
```kconfig
# Copyright (c) 2023-2025 Espressif Systems (Shanghai) Co., Ltd.
# SPDX-License-Identifier: Apache-2.0

config BOARD_ESP32_DEVKITC
	select SOC_ESP32_WROVER_E_N4R8
	select SOC_ESP32_PROCPU if BOARD_ESP32_DEVKITC_ESP32_PROCPU
	select SOC_ESP32_APPCPU if BOARD_ESP32_DEVKITC_ESP32_APPCPU
```

## boards/espressif/esp32_devkitc_wroom/Kconfig
```kconfig
# Copyright (c) 2024 Espressif Systems (Shanghai) Co., Ltd.
# SPDX-License-Identifier: Apache-2.0

config BOARD_ESP32_DEVKITC_WROOM
	select SOC_ESP32_PROCPU if BOARD_ESP32_DEVKITC_WROOM_ESP32_PROCPU
	select SOC_ESP32_APPCPU if BOARD_ESP32_DEVKITC_WROOM_ESP32_APPCPU
```

## boards/espressif/esp32_devkitc_wroom/Kconfig.defconfig
```kconfig
# ESP32 board configuration

# Copyright (c) 2017 Intel Corporation
# SPDX-License-Identifier: Apache-2.0

if BOARD_ESP32_DEVKITC_WROOM_ESP32_PROCPU

config HEAP_MEM_POOL_ADD_SIZE_BOARD
	int
	default 65535 if WIFI && BT
	default 51200 if WIFI
	default 40960 if BT
	default 4096

endif # BOARD_ESP32_DEVKITC_WROOM_ESP32_PROCPU

if BOARD_ESP32_DEVKITC_WROOM_ESP32_APPCPU

config HEAP_MEM_POOL_ADD_SIZE_BOARD
	default 4096

endif # BOARD_ESP32_DEVKITC_WROOM_ESP32_APPCPU
```

## boards/espressif/esp32_devkitc_wroom/Kconfig.esp32_devkitc_wroom
```kconfig
# Copyright (c) 2023 Espressif Systems (Shanghai) Co., Ltd.
# SPDX-License-Identifier: Apache-2.0

config BOARD_ESP32_DEVKITC_WROOM
	select SOC_ESP32_WROOM_32UE_N4
	select SOC_ESP32_PROCPU if BOARD_ESP32_DEVKITC_WROOM_ESP32_PROCPU
	select SOC_ESP32_APPCPU if BOARD_ESP32_DEVKITC_WROOM_ESP32_APPCPU
```

## boards/espressif/esp32_devkitc_wroom/board.yml
```yaml
board:
  name: esp32_devkitc_wroom
  full_name: ESP32-DevKitC-WROOM
  vendor: espressif
  socs:
  - name: esp32
```

## boards/espressif/esp32_devkitc_wroom/esp32_devkitc_wroom_procpu_defconfig
```kconfig
# Copyright (c) 2023 Espressif Systems (Shanghai) Co., Ltd.
# SPDX-License-Identifier: Apache-2.0

CONFIG_CONSOLE=y
CONFIG_SERIAL=y
CONFIG_UART_CONSOLE=y

CONFIG_GPIO=y
```

## boards/espressif/esp32_devkitc_wrover/Kconfig
```kconfig
# Copyright (c) 2024 Espressif Systems (Shanghai) Co., Ltd.
# SPDX-License-Identifier: Apache-2.0

config BOARD_ESP32_DEVKITC_WROVER
	select SOC_ESP32_PROCPU if BOARD_ESP32_DEVKITC_WROVER_ESP32_PROCPU
	select SOC_ESP32_APPCPU if BOARD_ESP32_DEVKITC_WROVER_ESP32_APPCPU
```

## boards/espressif/esp32_devkitc_wrover/Kconfig.defconfig
```kconfig
# Copyright (c) 2023 Espressif Systems (Shanghai) Co., Ltd.
# SPDX-License-Identifier: Apache-2.0

if BOARD_ESP32_DEVKITC_WROVER_ESP32_PROCPU

config HEAP_MEM_POOL_ADD_SIZE_BOARD
	int
	default 65535 if WIFI && BT
	default 51200 if WIFI
	default 40960 if BT
	default 4096

config BT_ESP32
	default y if BT

endif # BOARD_ESP32_DEVKITC_WROVER_ESP32_PROCPU

if BOARD_ESP32_DEVKITC_WROVER_ESP32_APPCPU

config HEAP_MEM_POOL_ADD_SIZE_BOARD
	default 4096

endif # BOARD_ESP32_DEVKITC_WROVER_ESP32_APPCPU
```

## boards/espressif/esp32_devkitc_wrover/Kconfig.esp32_devkitc_wrover
```kconfig
# Copyright (c) 2023 Espressif Systems (Shanghai) Co., Ltd.
# SPDX-License-Identifier: Apache-2.0

config BOARD_ESP32_DEVKITC_WROVER
	select SOC_ESP32_WROVER_E_N4R8
	select SOC_ESP32_PROCPU if BOARD_ESP32_DEVKITC_WROVER_ESP32_PROCPU
	select SOC_ESP32_APPCPU if BOARD_ESP32_DEVKITC_WROVER_ESP32_APPCPU
```

## boards/espressif/esp32_devkitc_wrover/board.yml
```yaml
board:
  name: esp32_devkitc_wrover
  full_name: ESP32-DevKitC-WROVER
  vendor: espressif
  socs:
  - name: esp32
```

## boards/espressif/esp32_ethernet_kit/Kconfig.esp32_ethernet_kit
```kconfig
# ESP32-ETHERNET-KIT board configuration

# Copyright (c) 2022 Grant Ramsay <grant.ramsay@hotmail.com>
# SPDX-License-Identifier: Apache-2.0

config BOARD_ESP32_ETHERNET_KIT
	select SOC_ESP32_WROVER_E_N4R8
	select SOC_ESP32_PROCPU if BOARD_ESP32_ETHERNET_KIT_ESP32_PROCPU
	select SOC_ESP32_APPCPU if BOARD_ESP32_ETHERNET_KIT_ESP32_APPCPU
```

## boards/espressif/esp32_ethernet_kit/Kconfig.sysbuild
```kconfig
# Copyright (c) 2023 Espressif Systems (Shanghai) Co., Ltd.
# SPDX-License-Identifier: Apache-2.0

choice BOOT_SIGNATURE_TYPE
	default BOOT_SIGNATURE_TYPE_NONE
endchoice
```

## boards/espressif/esp32_ethernet_kit/board.yml
```yaml
board:
  name: esp32_ethernet_kit
  full_name: ESP32-Ethernet-Kit
  vendor: espressif
  socs:
  - name: esp32
```

## boards/espressif/esp32c3_devkitc/Kconfig.defconfig
```kconfig
# ESP32C3 devkitc board configuration

# Copyright (c) 2024 Espressif Systems (Shanghai) Co., Ltd.
# SPDX-License-Identifier: Apache-2.0

config HEAP_MEM_POOL_ADD_SIZE_BOARD
	int
	default 8192
```

## boards/espressif/esp32c3_devkitc/Kconfig.esp32c3_devkitc
```kconfig
# ESP32C3 devkitc board configuration

# Copyright (c) 2024 Espressif Systems (Shanghai) Co., Ltd.
# SPDX-License-Identifier: Apache-2.0

config BOARD_ESP32C3_DEVKITC
	select SOC_ESP32C3_WROOM_02_N4
```

## boards/espressif/esp32c3_devkitc/board.yml
```yaml
board:
  name: esp32c3_devkitc
  full_name: ESP32-C3-DevKitC
  vendor: espressif
  socs:
  - name: esp32c3
```

## boards/espressif/esp32c3_devkitm/Kconfig.defconfig
```kconfig
# ESP32C3 devkitm board configuration

# Copyright (c) 2021 Espressif Systems (Shanghai) Co., Ltd.
# SPDX-License-Identifier: Apache-2.0

config HEAP_MEM_POOL_ADD_SIZE_BOARD
	int
	default 65535 if WIFI && BT
	default 51200 if WIFI
	default 40960 if BT
	default 4096
```

## boards/espressif/esp32c3_devkitm/Kconfig.esp32c3_devkitm
```kconfig
# ESP32C3 devkitm board configuration

# Copyright (c) 2021 Espressif Systems (Shanghai) Co., Ltd.
# SPDX-License-Identifier: Apache-2.0

config BOARD_ESP32C3_DEVKITM
	select SOC_ESP32C3_MINI_N4
```

## boards/espressif/esp32c3_lckfb/board.yml
```yaml
board:
  name: esp32c3_lckfb
  full_name: ESP32-C3 Development Board (LCKFB)
  vendor: espressif
  socs:
  - name: esp32c3
```

## boards/espressif/esp32c3_rust/Kconfig.esp32c3_rust
```kconfig
# Copyright (c) 2024 Espressif Systems (Shanghai) Co., Ltd.
# SPDX-License-Identifier: Apache-2.0

config BOARD_ESP32C3_RUST
	select SOC_ESP32C3_MINI_N4
```

## boards/espressif/esp32c3_rust/board.yml
```yaml
# Copyright (c) 2024 Espressif Systems (Shanghai) Co., Ltd.
# SPDX-License-Identifier: Apache-2.0

board:
  name: esp32c3_rust
  full_name: ESP32-C3-DevKit-RUST
  vendor: espressif
  socs:
  - name: esp32c3
```

## boards/espressif/esp32c3_rust/esp32c3_rust_defconfig
```kconfig
# Copyright (c) 2024 Espressif Systems (Shanghai) Co., Ltd.
# SPDX-License-Identifier: Apache-2.0

CONFIG_CONSOLE=y
CONFIG_SERIAL=y
CONFIG_UART_CONSOLE=y
CONFIG_GPIO=y
CONFIG_I2C=y
CONFIG_LED_STRIP=y
CONFIG_SENSOR=y
```
