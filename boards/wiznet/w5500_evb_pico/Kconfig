## boards/wiznet/w5500_evb_pico/Kconfig
```kconfig
# SPDX-FileCopyrightText: Copyright 2021 Yonatan Schachter
# SPDX-FileCopyrightText: Copyright 2023 Ian Wakely
# SPDX-License-Identifier: Apache-2.0

config BOARD_W5500_EVB_PICO
	select RP2_FLASH_W25Q080
```

## boards/wiznet/w5500_evb_pico/Kconfig.defconfig
```kconfig
# Copyright (c) 2021 Yonatan Schachter
# Copyright (c) 2023 Ian Wakely
# SPDX-License-Identifier: Apache-2.0

if BOARD_W5500_EVB_PICO

if NETWORKING

config NET_L2_ETHERNET
	default y

endif # NETWORKING

if I2C_DW

config I2C_DW_CLOCK_SPEED
	default 125

endif # I2C_DW

config USB_SELF_POWERED
	default n

endif # BOARD_W5500_EVB_PICO
```

## boards/wiznet/w5500_evb_pico/Kconfig.w5500_evb_pico
```kconfig
# Copyright (c) 2021 Yonatan Schachter
# Copyright (c) 2023 Ian Wakely
# SPDX-License-Identifier: Apache-2.0

config BOARD_W5500_EVB_PICO
	select SOC_RP2040
```

## boards/wiznet/w5500_evb_pico/board.yml
```yaml
board:
  name: w5500_evb_pico
  full_name: W5500-EVB-Pico
  vendor: wiznet
  socs:
  - name: rp2040
```

## boards/wiznet/w5500_evb_pico2/Kconfig.w5500_evb_pico2
```kconfig
# Copyright (c) 2025 TOKITA Hiroshi
# SPDX-License-Identifier: Apache-2.0

config BOARD_W5500_EVB_PICO2
	select SOC_RP2350A_M33 if BOARD_W5500_EVB_PICO2_RP2350A_M33
```

## boards/wiznet/w5500_evb_pico2/board.yml
```yaml
board:
  name: w5500_evb_pico2
  full_name: W5500-EVB-Pico2
  vendor: wiznet
  socs:
  - name: rp2350a
```

## boards/wiznet/w55rp20_evb_pico/Kconfig
```kconfig
# Copyright (c) 2026 Mason Lee
# SPDX-License-Identifier: Apache-2.0

config BOARD_W55RP20_EVB_PICO
	select RP2_FLASH_W25Q080
	select RP2_REQUIRES_SECOND_STAGE_BOOT
```

## boards/wiznet/w55rp20_evb_pico/Kconfig.w55rp20_evb_pico
```kconfig
# Copyright (c) 2026 Mason Lee
# SPDX-License-Identifier: Apache-2.0

config BOARD_W55RP20_EVB_PICO
	select SOC_RP2040
```

## boards/wiznet/w55rp20_evb_pico/board.yml
```yaml
board:
  name: w55rp20_evb_pico
  full_name: W55RP20-EVB-Pico
  vendor: wiznet
  socs:
  - name: rp2040
```

## boards/wiznet/w6100_evb_pico/Kconfig.defconfig
```kconfig
# SPDX-FileCopyrightText: Copyright 2021 Yonatan Schachter
# SPDX-FileCopyrightText: Copyright 2023 Ian Wakely
# SPDX-FileCopyrightText: Copyright 2026 Sayed Naser Moravej
# SPDX-License-Identifier: Apache-2.0

if BOARD_W6100_EVB_PICO

configdefault NET_L2_ETHERNET
	default y

if I2C_DW

config I2C_DW_CLOCK_SPEED
	default 125

endif # I2C_DW

config USB_SELF_POWERED
	default n

endif # BOARD_W6100_EVB_PICO
```

## boards/wiznet/w6100_evb_pico/Kconfig.w6100_evb_pico
```kconfig
# SPDX-FileCopyrightText: Copyright 2021 Yonatan Schachter
# SPDX-FileCopyrightText: Copyright 2023 Ian Wakely
# SPDX-FileCopyrightText: Copyright 2026 Sayed Naser Moravej
# SPDX-License-Identifier: Apache-2.0

config BOARD_W6100_EVB_PICO
	select SOC_RP2040
```

## boards/wiznet/w6100_evb_pico/board.yml
```yaml
board:
  name: w6100_evb_pico
  full_name: W6100-EVB-Pico
  vendor: wiznet
  socs:
  - name: rp2040
```

## boards/wiznet/w6100_evb_pico2/Kconfig.w6100_evb_pico2
```kconfig
# SPDX-FileCopyrightText: 2025 TOKITA Hiroshi
# SPDX-License-Identifier: Apache-2.0

config BOARD_W6100_EVB_PICO2
	select SOC_RP2350A_M33 if BOARD_W6100_EVB_PICO2_RP2350A_M33
```

## boards/wiznet/w6100_evb_pico2/board.yml
```yaml
board:
  name: w6100_evb_pico2
  full_name: W6100-EVB-Pico2
  vendor: wiznet
  socs:
  - name: rp2350a
```

## boards/wiznet/w6300_evb_pico/Kconfig
```kconfig
# Copyright (c) 2026 WIZnet Co., Ltd.
# SPDX-License-Identifier: Apache-2.0

config BOARD_W6300_EVB_PICO
	select RP2_FLASH_W25Q080
	select RP2_REQUIRES_SECOND_STAGE_BOOT
```

## boards/wiznet/w6300_evb_pico/Kconfig.defconfig
```kconfig
# Copyright (c) 2026 WIZnet Co., Ltd.
# SPDX-License-Identifier: Apache-2.0

if BOARD_W6300_EVB_PICO

configdefault NET_L2_ETHERNET
	default y

if I2C_DW

config I2C_DW_CLOCK_SPEED
	default 125

endif # I2C_DW

config USB_SELF_POWERED
	default n

endif # BOARD_W6300_EVB_PICO
```

## boards/wiznet/w6300_evb_pico/Kconfig.w6300_evb_pico
```kconfig
# Copyright (c) 2026 WIZnet Co., Ltd.
# SPDX-License-Identifier: Apache-2.0

config BOARD_W6300_EVB_PICO
	select SOC_RP2040
```

## boards/wiznet/w6300_evb_pico/board.yml
```yaml
board:
  name: w6300_evb_pico
  full_name: W6300-EVB-Pico
  vendor: wiznet
  socs:
  - name: rp2040
```

## boards/wiznet/w6300_evb_pico/w6300_evb_pico_defconfig
```kconfig
CONFIG_SERIAL=y
CONFIG_CONSOLE=y
CONFIG_UART_CONSOLE=y
CONFIG_GPIO=y
CONFIG_USE_DT_CODE_PARTITION=y
CONFIG_BUILD_OUTPUT_UF2=y
CONFIG_BUILD_OUTPUT_HEX=y
CONFIG_UART_INTERRUPT_DRIVEN=y
CONFIG_RESET=y
CONFIG_CLOCK_CONTROL=y
```

## boards/wiznet/w6300_evb_pico2/Kconfig.w6300_evb_pico2
```kconfig
# Copyright (c) 2025 WIZnet Co., Ltd.
# SPDX-License-Identifier: Apache-2.0

config BOARD_W6300_EVB_PICO2
	select SOC_RP2350A_M33 if BOARD_W6300_EVB_PICO2_RP2350A_M33
```

## boards/wiznet/w6300_evb_pico2/board.yml
```yaml
board:
  name: w6300_evb_pico2
  full_name: W6300-EVB-Pico2
  vendor: wiznet
  socs:
  - name: rp2350a
```

## boards/wurth_elektronik/we_ophelia1ev/Kconfig.we_ophelia1ev
```kconfig
# Copyright (c) 2022 Nordic Semiconductor ASA
# SPDX-License-Identifier: Apache-2.0

config BOARD_WE_OPHELIA1EV
	bool
	default y
	select SOC_NRF52805_CAAA
```

## boards/wurth_elektronik/we_ophelia1ev/board.yml
```yaml
board:
  name: we_ophelia1ev
  vendor: Würth Elektronik
  socs:
  - name: nrf52805
```

## boards/wurth_elektronik/we_proteus2ev/board.yml
```yaml
board:
  name: we_proteus2ev
  vendor: Würth Elektronik
  socs:
  - name: nrf52832
```

## boards/wurth_elektronik/we_proteus3ev/Kconfig.defconfig
```kconfig
# Copyright (c) 2022 Nordic Semiconductor ASA
# SPDX-License-Identifier: Apache-2.0

if BOARD_WE_PROTEUS3EV

config BT_CTLR
	default BT

endif # BOARD_WE_PROTEUS3EV
```
