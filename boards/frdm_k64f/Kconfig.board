## boards/frdm_k64f/Kconfig.board
```kconfig
config BOARD_FRDM_K64F
	bool "Freescale FRDM-K64F"
	depends on SOC_SERIES_KINETIS_K6X
```

## boards/frdm_k64f/Kconfig.defconfig
```kconfig
# Kconfig - FRDM-K64F board
#
# Copyright (c) 2016, Freescale Semiconductor, Inc.
#
# Licensed under the Apache License, Version 2.0 (the "License");
# you may not use this file except in compliance with the License.
# You may obtain a copy of the License at
#
#     http://www.apache.org/licenses/LICENSE-2.0
#
# Unless required by applicable law or agreed to in writing, software
# distributed under the License is distributed on an "AS IS" BASIS,
# WITHOUT WARRANTIES OR CONDITIONS OF ANY KIND, either express or implied.
# See the License for the specific language governing permissions and
# limitations under the License.
#

if BOARD_FRDM_K64F

config BOARD
	default frdm_k64f

config FLASH_SIZE
	default 1024

config SRAM_SIZE
	default 192

config OSC_XTAL0_FREQ
	default 50000000

config MCG_PRDIV0
	default 0x13

config MCG_VDIV0
	default 0x18

config MCG_FCRDIV
	default 1

endif # BOARD_FRDM_K64F
```

## boards/fsl_frdm_k64f/Kconfig
```kconfig
if BOARD_FSL_FRDM_K64F

config BOARD
        default fsl_frdm_k64f

endif # BOARD_FSL_FRDM_K64F
```

## boards/fsl_frdm_k64f/Kconfig.board
```kconfig
config  BOARD_FSL_FRDM_K64F
        bool "Freescale FRDM-K64F"
        select PLATFORM_FSL_FRDM_K64F
	depends on ARM
```

## boards/fsl_frdm_k64f/fsl_frdm_k64f_defconfig
```kconfig
CONFIG_ARM=y
CONFIG_SOC_FSL_FRDM_K64F=y
CONFIG_BOARD_FSL_FRDM_K64F=y
CONFIG_CONSOLE=y
CONFIG_UART_CONSOLE=y
CONFIG_SERIAL=y
CONFIG_CORTEX_M_SYSTICK=y
CONFIG_UART_K20=y
```

## boards/fysetc/ucan/Kconfig.ucan
```kconfig
# Copyright (c) 2024 Henrik Brix Andersen <henrik@brixandersen.dk>
# SPDX-License-Identifier: Apache-2.0

config BOARD_UCAN
	select SOC_STM32F072XB
```

## boards/fysetc/ucan/board.yml
```yaml
board:
  name: ucan
  full_name: UCAN
  vendor: fysetc
  socs:
    - name: stm32f072xb
```

## boards/gaisler/generic_leon3/Kconfig.generic_leon3
```kconfig
# Copyright (c) 2019-2020 Cobham Gaisler AB
#
# SPDX-License-Identifier: Apache-2.0

config BOARD_GENERIC_LEON3
	select SOC_LEON3
```

## boards/gaisler/generic_leon3/board.yml
```yaml
board:
  name: generic_leon3
  full_name: Generic LEON3
  vendor: gaisler
  socs:
  - name: leon3
```

## boards/gaisler/gr716a_mini/Kconfig.gr716a_mini
```kconfig
# Copyright (c) 2019-2020 Cobham Gaisler AB
#
# SPDX-License-Identifier: Apache-2.0

config BOARD_GR716A_MINI
	select SOC_GR716A
```

## boards/gaisler/gr716a_mini/board.yml
```yaml
board:
  name: gr716a_mini
  full_name: GR716-MINI Development Board
  vendor: gaisler
  socs:
  - name: gr716a
```

## boards/gaisler/gr716a_mini/gr716a_mini_defconfig
```kconfig
# SPDX-License-Identifier: Apache-2.0

CONFIG_CONSOLE=y
CONFIG_SERIAL=y
CONFIG_UART_CONSOLE=y
```

## boards/galileo/Kconfig
```kconfig
if BOARD_GALILEO

config BOARD
        default galileo

config PINMUX
        def_bool y

config I2C
	def_bool y

config GPIO
	def_bool y

config PWM
	def_bool y

config SPI
	def_bool y

config ADC
	def_bool y

config SHARED_IRQ
	def_bool y

if PINMUX
config PINMUX_BASE
	default 0x00000000
config PINMUX_NUM_PINS
        default 20
config PINMUX_BASE
        default 0x00000000
config PINMUX_GALILEO_EXP0_NAME
        default GPIO_PCAL9535A_0_DEV_NAME
config PINMUX_GALILEO_EXP1_NAME
        default GPIO_PCAL9535A_1_DEV_NAME
config PINMUX_GALILEO_EXP2_NAME
        default GPIO_PCAL9535A_2_DEV_NAME
config PINMUX_GALILEO_PWM0_NAME
        default PWM_PCA9685_0_DEV_NAME
config PINMUX_GALILEO_GPIO_DW_NAME
	default GPIO_DW_0_NAME
config PINMUX_GALILEO_GPIO_INTEL_CW_NAME
	default GPIO_SCH_0_DEV_NAME
config PINMUX_GALILEO_GPIO_INTEL_RW_NAME
	default GPIO_SCH_1_DEV_NAME
endif

if ADC
config ADC_TI_ADC108S102
	def_bool y
config ADC_TI_ADC108S102_0
	def_bool y
config ADC_TI_ADC108S102_0_SPI_PORT_NAME
	default "SPI0"
config ADC_TI_ADC108S102_0_SPI_CONFIGURATION
	default 0x81
config ADC_TI_ADC108S102_0_SPI_MAX_FREQ
	default 0x20000000
endif

if GPIO && I2C

config GPIO_PCAL9535A
	def_bool y

config GPIO_PCAL9535A_0
	def_bool y
config GPIO_PCAL9535A_0_DEV_NAME
	default "EXP0"
config GPIO_PCAL9535A_0_I2C_ADDR
	default 0x25
config GPIO_PCAL9535A_0_I2C_MASTER_DEV_NAME
	default I2C_DW_0_NAME

config GPIO_PCAL9535A_1
	def_bool y
config GPIO_PCAL9535A_1_DEV_NAME
	default "EXP1"
config GPIO_PCAL9535A_1_I2C_ADDR
	default 0x26
config GPIO_PCAL9535A_1_I2C_MASTER_DEV_NAME
	default I2C_DW_0_NAME

config GPIO_PCAL9535A_2
	def_bool y
config GPIO_PCAL9535A_2_DEV_NAME
	default "EXP2"
config GPIO_PCAL9535A_2_I2C_ADDR
	default 0x27
config GPIO_PCAL9535A_2_I2C_MASTER_DEV_NAME
	default I2C_DW_0_NAME
endif

if PWM

config PWM_PCA9685
	def_bool y

config PWM_PCA9685_0
	def_bool y

if PWM_PCA9685_0

config PWM_PCA9685_0_DEV_NAME
	default "PWM0"
config PWM_PCA9685_0_I2C_ADDR
	default 0x47
config PWM_PCA9685_0_I2C_MASTER_DEV_NAME
	default I2C_DW_0_NAME

endif
endif


# TI ADC108S102 uses SPI bus, thus
# initialized after SPI driver
config ADC_TI_ADC108S102_INIT_PRIORITY
	default 80

# PCA9685 uses I2C, thus initialized after it
config PWM_PCA9685_INIT_PRIORITY
	default 70

# Pin multiplexer uses PCAL9535A, needs to be initialized after it
config PINMUX_INIT_PRIORITY
	default 80

endif # BOARD_GALILEO
```

## boards/galileo/Kconfig.board
```kconfig
config  BOARD_GALILEO
        bool "Galileo Gen2"
        select PLATFORM_GALILEO
```

## boards/galileo/Kconfig.defconfig
```kconfig
if BOARD_GALILEO

config BOARD
        default galileo

config PINMUX
        def_bool y

config I2C
	def_bool y

config GPIO
	def_bool y

config PWM
	def_bool y

config SPI
	def_bool y

config ADC
	def_bool y

config SHARED_IRQ
	def_bool y

if PINMUX

config PINMUX_BASE
	default 0x00000000
config PINMUX_NUM_PINS
        default 20
config PINMUX_BASE
        default 0x00000000

config PINMUX_GALILEO_EXP0_NAME
        default GPIO_PCAL9535A_0_DEV_NAME
config PINMUX_GALILEO_EXP1_NAME
        default GPIO_PCAL9535A_1_DEV_NAME
config PINMUX_GALILEO_EXP2_NAME
        default GPIO_PCAL9535A_2_DEV_NAME
config PINMUX_GALILEO_PWM0_NAME
        default PWM_PCA9685_0_DEV_NAME
config PINMUX_GALILEO_GPIO_DW_NAME
	default GPIO_DW_0_NAME
config PINMUX_GALILEO_GPIO_INTEL_CW_NAME
	default GPIO_SCH_0_DEV_NAME
config PINMUX_GALILEO_GPIO_INTEL_RW_NAME
	default GPIO_SCH_1_DEV_NAME

endif # PINMUX

if ADC

config ADC_TI_ADC108S102
	def_bool y

if ADC_TI_ADC108S102

config ADC_TI_ADC108S102_SPI_PORT_NAME
	default "SPI0"
config ADC_TI_ADC108S102_SPI_CONFIGURATION
	default 0x81
config ADC_TI_ADC108S102_SPI_MAX_FREQ
	default 0x20000000

endif # ADC_TI_AC108S102

endif # ADC

if GPIO && I2C

config GPIO_PCAL9535A
	def_bool y

if GPIO_PCAL9535A

config GPIO_PCAL9535A_0
	def_bool y

if GPIO_PCAL9535A_0

config GPIO_PCAL9535A_0_DEV_NAME
	default "EXP0"
config GPIO_PCAL9535A_0_I2C_ADDR
	default 0x25
config GPIO_PCAL9535A_0_I2C_MASTER_DEV_NAME
	default I2C_DW_0_NAME

endif # GPIO_PCAL9535A_0

config GPIO_PCAL9535A_1
	def_bool y

if GPIO_PCAL9535A_1

config GPIO_PCAL9535A_1_DEV_NAME
	default "EXP1"
config GPIO_PCAL9535A_1_I2C_ADDR
	default 0x26
config GPIO_PCAL9535A_1_I2C_MASTER_DEV_NAME
	default I2C_DW_0_NAME

endif # GPIO_PCAL9535A_1

config GPIO_PCAL9535A_2
	def_bool y

if GPIO_PCAL9535A_2

config GPIO_PCAL9535A_2_DEV_NAME
	default "EXP2"
config GPIO_PCAL9535A_2_I2C_ADDR
	default 0x27
config GPIO_PCAL9535A_2_I2C_MASTER_DEV_NAME
	default I2C_DW_0_NAME

endif # GPIO_PCAL9535A_2

endif # GPIO_PCAL9535A

endif # GPIO && I2C

if PWM && I2C

config PWM_PCA9685
	def_bool y

if PWM_PCA9685

config PWM_PCA9685_0
	def_bool y

if PWM_PCA9685_0

config PWM_PCA9685_0_DEV_NAME
	default "PWM0"
config PWM_PCA9685_0_I2C_ADDR
	default 0x47
config PWM_PCA9685_0_I2C_MASTER_DEV_NAME
	default I2C_DW_0_NAME

endif # PWM_PCA9685_0
endif # PWM_PCA9685
endif # PWM && I2C


# TI ADC108S102 uses SPI bus, thus
# initialized after SPI driver
config ADC_TI_ADC108S102_INIT_PRIORITY
	default 80 if ADC_TI_ADC108S102

# PCA9685 uses I2C, thus initialized after it
config PWM_PCA9685_INIT_PRIORITY
	default 70 if PWM_PCA9685

# Pin multiplexer uses PCAL9535A, needs to be initialized after it
config PINMUX_INIT_PRIORITY
	default 80 if PINMUX

endif # BOARD_GALILEO
```

## boards/gardena/boac/Kconfig.boac
```kconfig
# Copyright (c) 2025 Reto Schneider
#
# SPDX-License-Identifier: Apache-2.0

config BOARD_BOAC
	select SOC_NRF52840_QIAA if BOARD_BOAC_NRF52840
```

## boards/gardena/boac/board.yml
```yaml
# Copyright (c) 2025 Reto Schneider
#
# SPDX-License-Identifier: Apache-2.0

board:
  name: boac
  full_name: AquaPrecise
  vendor: gardena
  socs:
    - name: nrf52840
```

## boards/gardena/sgrm/Kconfig.sgrm
```kconfig
# Copyright (c) 2024 GARDENA GmbH
#
# SPDX-License-Identifier: Apache-2.0

config BOARD_SGRM
	select SOC_SIM3U167BGM
```

## boards/gardena/sgrm/board.yml
```yaml
# Copyright (c) 2024 GARDENA GmbH
#
# SPDX-License-Identifier: Apache-2.0

board:
  name: sgrm
  full_name: Smart Garden Radio Module
  vendor: gardena
  socs:
    - name: sim3u167
```

## boards/gardena/sgrm/sgrm_defconfig
```kconfig
# Enable UART driver
CONFIG_SERIAL=y

# Enable console
CONFIG_CONSOLE=y
CONFIG_UART_CONSOLE=y

# Enable GPIO
CONFIG_GPIO=y
```

## boards/gd/gd32a503v_eval/Kconfig.gd32a503v_eval
```kconfig
# Copyright (c) 2024 Nordic Semiconductor ASA
# SPDX-License-Identifier: Apache-2.0

config BOARD_GD32A503V_EVAL
	select SOC_GD32A503
```

## boards/gd/gd32a503v_eval/board.yml
```yaml
board:
  name: gd32a503v_eval
  full_name: GD32A503V-EVAL
  vendor: gd
  socs:
    - name: gd32a503
```

## boards/gd/gd32c231c_eval/Kconfig.gd32c231c_eval
```kconfig
# Copyright (c) 2026 GigaDevice Semiconductor Inc.
# SPDX-License-Identifier: Apache-2.0

config BOARD_GD32C231C_EVAL
	select SOC_GD32C231
```

## boards/gd/gd32c231c_eval/board.yml
```yaml
board:
  name: gd32c231c_eval
  full_name: GD32C231C-EVAL
  vendor: gd
  socs:
    - name: gd32c231
```

## boards/gd/gd32e103v_eval/Kconfig.gd32e103v_eval
```kconfig
# Copyright (c) 2024 Nordic Semiconductor ASA
# SPDX-License-Identifier: Apache-2.0

config BOARD_GD32E103V_EVAL
	select SOC_GD32E103
```
