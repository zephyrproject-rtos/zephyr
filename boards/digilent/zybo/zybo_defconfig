## boards/digilent/zybo/zybo_defconfig
```kconfig
# SPDX-License-Identifier: Apache-2.0

# The GTC is always clocked at 1/2 of the CPU frequency (CPU_3x2x)
CONFIG_ARM_ARCH_TIMER=y
CONFIG_SYS_CLOCK_HW_CYCLES_PER_SEC=325000000

CONFIG_PINCTRL=y
CONFIG_SERIAL=y
CONFIG_CONSOLE=y
CONFIG_UART_CONSOLE=y
```

## boards/doit/dt_bl10_devkit/dt_bl10_devkit_defconfig
```kconfig
# Copyright (c) 2021-2024 ATL Electronics
#
# SPDX-License-Identifier: Apache-2.0

CONFIG_CONSOLE=y
CONFIG_SERIAL=y

CONFIG_UART_CONSOLE=y
CONFIG_UART_BFLB=y
CONFIG_UART_INTERRUPT_DRIVEN=y
```

## boards/doiting/dt_bl10_devkit/Kconfig.dt_bl10_devkit
```kconfig
# Copyright (c) 2021-2025 ATL Electronics
# SPDX-License-Identifier: Apache-2.0

config BOARD_DT_BL10_DEVKIT
	select SOC_BL602C20Q2I
```

## boards/doiting/dt_bl10_devkit/board.yml
```yaml
board:
  name: dt_bl10_devkit
  full_name: DT-BL10 coexistence Module Development Kit
  vendor: doiting
  socs:
    - name: bl602c20q2i
```

## boards/doiting/dt_bl10_devkit/dt_bl10_devkit_defconfig
```kconfig
# Copyright (c) 2021-2025 ATL Electronics
# SPDX-License-Identifier: Apache-2.0

CONFIG_CONSOLE=y
CONFIG_SERIAL=y

CONFIG_UART_CONSOLE=y
CONFIG_UART_INTERRUPT_DRIVEN=y
```

## boards/doiting/dt_xt_zb1_devkit/Kconfig.dt_xt_zb1_devkit
```kconfig
# Copyright (c) 2025 MASSDRIVER EI (massdriver.space)
# SPDX-License-Identifier: Apache-2.0

config BOARD_DT_XT_ZB1_DEVKIT
	select SOC_BL702C10Q2H
```

## boards/doiting/dt_xt_zb1_devkit/board.yml
```yaml
board:
  name: dt_xt_zb1_devkit
  full_name: XT-ZB1 Zigbee 3.0 and BLE 5.0 Coexistence Module Development Kit
  vendor: doiting
  socs:
    - name: bl702c10q2h
```

## boards/dptechnics/walter/Kconfig
```kconfig
# Copyright (c) 2024 Espressif Systems (Shanghai) Co., Ltd.
# SPDX-License-Identifier: Apache-2.0

config HEAP_MEM_POOL_ADD_SIZE_BOARD
	int
	default 4096 if BOARD_WALTER_ESP32S3_PROCPU
	default 256 if BOARD_WALTER_ESP32S3_APPCPU
```

## boards/dptechnics/walter/Kconfig.defconfig
```kconfig
# Copyright (c) 2024 DPTechnics bv
# SPDX-License-Identifier: Apache-2.0

if BOARD_WALTER_ESP32S3_PROCPU

config HEAP_MEM_POOL_ADD_SIZE_BOARD
	int
	default 8192

endif # BOARD_WALTER_ESP32S3_PROCPU

if BOARD_WALTER_ESP32S3_APPCPU

config HEAP_MEM_POOL_ADD_SIZE_BOARD
	default 256

endif # BOARD_WALTER_ESP32S3_APPCPU
```

## boards/dptechnics/walter/Kconfig.walter
```kconfig
# Copyright (c) 2024 DPTechnics bv
# SPDX-License-Identifier: Apache-2.0

config BOARD_WALTER
	select SOC_ESP32S3_WROOM_N16R2
	select SOC_ESP32S3_PROCPU if BOARD_WALTER_ESP32S3_PROCPU
	select SOC_ESP32S3_APPCPU if BOARD_WALTER_ESP32S3_APPCPU
```

## boards/dptechnics/walter/board.yml
```yaml
board:
  name: walter
  full_name: Walter
  vendor: dptechnics
  socs:
  - name: esp32s3
```

## boards/dptechnics/walter/walter_esp32s3_procpu_defconfig
```kconfig
# SPDX-License-Identifier: Apache-2.0

CONFIG_MAIN_STACK_SIZE=2048

CONFIG_CONSOLE=y
CONFIG_SERIAL=y
CONFIG_UART_CONSOLE=y
CONFIG_UART_INTERRUPT_DRIVEN=y
CONFIG_GPIO=y
CONFIG_CLOCK_CONTROL=y
```

## boards/dragino/lsn50/Kconfig.dragino_lsn50
```kconfig
# Copyright (c) 2018 Endre Karlson <endre.karlson@gmail.com>
# SPDX-License-Identifier: Apache-2.0

config BOARD_DRAGINO_LSN50
	select SOC_STM32L072XX
```

## boards/dragino/lsn50/board.yml
```yaml
board:
  name: dragino_lsn50
  full_name: LSN50 LoRA Sensor Node
  vendor: dragino
  socs:
    - name: stm32l072xx
```

## boards/dragino/nbsn95/Kconfig.dragino_nbsn95
```kconfig
# Copyright (c) 2021 Next Big Thing AG
# SPDX-License-Identifier: Apache-2.0

config BOARD_DRAGINO_NBSN95
	select SOC_STM32L072XX
```

## boards/dragino/nbsn95/board.yml
```yaml
board:
  name: dragino_nbsn95
  full_name: NBSN95 NB-IoT Sensor Node
  vendor: dragino
  socs:
    - name: stm32l072xx
```

## boards/dragino/nbsn95/dragino_nbsn95_defconfig
```kconfig
# SPDX-License-Identifier: Apache-2.0

# Serial Drivers
CONFIG_SERIAL=y
CONFIG_UART_INTERRUPT_DRIVEN=y

# enable console
CONFIG_CONSOLE=y
CONFIG_UART_CONSOLE=y

# GPIO Controller
CONFIG_GPIO=y

# Enable Clocks
CONFIG_CLOCK_CONTROL=y

# enable pin controller
CONFIG_PINCTRL=y
```

## boards/ebyte/e73_tbb/Kconfig.ebyte_e73_tbb
```kconfig
# EBYTE-TBB board configuration

# Copyright (c) 2021 Michal Morsisko
# SPDX-License-Identifier: Apache-2.0

config BOARD_EBYTE_E73_TBB
	select SOC_NRF52832_QFAA
```

## boards/ebyte/e73_tbb/board.yml
```yaml
board:
  name: ebyte_e73_tbb
  full_name: E73-TBB
  vendor: ebyte
  socs:
  - name: nrf52832
```

## boards/ebyte/e80_900mbl_01/Kconfig.defconfig
```kconfig
# SPDX-FileCopyrightText: Copyright The Zephyr Project Contributors
# SPDX-License-Identifier: Apache-2.0

if BOARD_E80_900MBL_01

if LORA

choice LORA_MODULE_BACKEND
	default LORA_MODULE_BACKEND_NATIVE
endchoice

endif # LORA

endif # BOARD_E80_900MBL_01
```

## boards/ebyte/e80_900mbl_01/Kconfig.e80_900mbl_01
```kconfig
# Copyright (c) 2026 MASSDRIVER EI (massdriver.space)
# SPDX-License-Identifier: Apache-2.0

config BOARD_E80_900MBL_01
	select SOC_STM32F103X8
```

## boards/ebyte/e80_900mbl_01/board.yml
```yaml
board:
  name: e80_900mbl_01
  full_name: Ebyte E80 Module Development Board (HF)
  vendor: ebyte
  socs:
    - name: stm32f103xb
```

## boards/ebyte/ebyte_e73_tbb/board.yml
```yaml
board:
  name: ebyte_e73_tbb
  vendor: Chengdu Ebyte Electronic Technology
  socs:
  - name: nrf52832
```
