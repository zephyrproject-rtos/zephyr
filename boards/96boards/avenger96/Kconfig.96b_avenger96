## boards/96boards/avenger96/Kconfig.96b_avenger96
```kconfig
# Copyright (c) 2019 Linaro Ltd.
# SPDX-License-Identifier: Apache-2.0

config BOARD_96B_AVENGER96
	select SOC_STM32MP15_M4
```

## boards/96boards/avenger96/board.yml
```yaml
board:
  name: 96b_avenger96
  full_name: Avenger96
  vendor: 96boards
  socs:
    - name: stm32mp157cxx
```

## boards/96boards/carbon/Kconfig.96b_carbon
```kconfig
# Copyright (c) 2016 Linaro Limited.
# SPDX-License-Identifier: Apache-2.0

config BOARD_96B_CARBON
	select SOC_STM32F401XE if BOARD_96B_CARBON_STM32F401XE
	select SOC_NRF51822_QFAC if BOARD_96B_CARBON_NRF51822
```

## boards/96boards/carbon/Kconfig.defconfig
```kconfig
# 96boards Carbon board configuration

# Copyright (c) 2016 Linaro Limited.
# SPDX-License-Identifier: Apache-2.0

if BOARD_96B_CARBON_STM32F401XE

config SPI_STM32_INTERRUPT
	default y
	depends on SPI

endif # BOARD_96B_CARBON_STM32F401XE

if BOARD_96B_CARBON_NRF51822

endif # BOARD_96B_CARBON_NRF51822
```

## boards/96boards/carbon/board.yml
```yaml
board:
  name: 96b_carbon
  full_name: Carbon
  vendor: 96boards
  socs:
  - name: stm32f401xe
  - name: nrf51822
```

## boards/96boards/meerkat96/96b_meerkat96_mcimx7d_m4_defconfig
```kconfig
#
# Copyright (c) 2019, Linaro Ltd.
#
# SPDX-License-Identifier: Apache-2.0
#

# enable uart driver
CONFIG_SERIAL=y
CONFIG_UART_INTERRUPT_DRIVEN=y

# console
CONFIG_CONSOLE=y
CONFIG_UART_CONSOLE=y

CONFIG_XIP=y
```

## boards/96boards/meerkat96/Kconfig.96b_meerkat96
```kconfig
# Copyright (c) 2019, Linaro Ltd.
# Copyright 2024 NXP
# SPDX-License-Identifier: Apache-2.0

config BOARD_96B_MEERKAT96
	select SOC_PART_NUMBER_MCIMX7D5EVM10SC
	select SOC_MCIMX7D_M4 if BOARD_96B_MEERKAT96_MCIMX7D_M4
```

## boards/96boards/meerkat96/Kconfig.defconfig
```kconfig
# 96Boards Meerkat96 board

# Copyright (c) 2019, Linaro Ltd.
# SPDX-License-Identifier: Apache-2.0

if BOARD_96B_MEERKAT96

if !XIP
config FLASH_SIZE
	default 0
config FLASH_BASE_ADDRESS
	default 0
endif

endif # BOARD_96B_MEERKAT96
```

## boards/96boards/meerkat96/board.yml
```yaml
board:
  name: 96b_meerkat96
  full_name: Meerkat96
  vendor: 96boards
  socs:
    - name: mcimx7d
```

## boards/96boards/neonkey/Kconfig.96b_neonkey
```kconfig
# Copyright (c) 2017 Linaro Limited
# SPDX-License-Identifier: Apache-2.0

config BOARD_96B_NEONKEY
	select SOC_STM32F411XE
```

## boards/96boards/neonkey/Kconfig.defconfig
```kconfig
# 96Boards Neonkey Board Configuration

# Copyright (c) 2017 Linaro Limited
# SPDX-License-Identifier: Apache-2.0

if BOARD_96B_NEONKEY

config SPI_STM32_INTERRUPT
	default y
	depends on SPI

endif # BOARD_96B_NEONKEY
```

## boards/96boards/neonkey/board.yml
```yaml
board:
  name: 96b_neonkey
  full_name: Neonkey
  vendor: 96boards
  socs:
    - name: stm32f411xe
```

## boards/96boards/nitrogen/board.yml
```yaml
board:
  name: 96b_nitrogen
  full_name: Nitrogen
  vendor: 96boards
  socs:
  - name: nrf52832
```

## boards/96boards/stm32_sensor_mez/Kconfig.96b_stm32_sensor_mez
```kconfig
# Copyright (c) 2018 Linaro Limited.
# SPDX-License-Identifier: Apache-2.0

config BOARD_96B_STM32_SENSOR_MEZ
	select SOC_STM32F446XX
```

## boards/96boards/stm32_sensor_mez/board.yml
```yaml
board:
  name: 96b_stm32_sensor_mez
  full_name: STM32 Sensor Mezzanine
  vendor: 96boards
  socs:
    - name: stm32f446xx
```

## boards/96boards/wistrio/Kconfig
```kconfig
# Copyright The Zephyr Project Contributors
# SPDX-License-Identifier: Apache-2.0

config BOARD_96B_WISTRIO
	select BOARD_LATE_INIT_HOOK
```

## boards/96boards/wistrio/Kconfig.96b_wistrio
```kconfig
# Copyright (c) 2019 Linaro Ltd.
# SPDX-License-Identifier: Apache-2.0

config BOARD_96B_WISTRIO
	select SOC_STM32L151XBA
```

## boards/96boards/wistrio/Kconfig.defconfig
```kconfig
# 96boards WisTrio board configuration

# Copyright (c) 2019 Linaro Ltd.
# SPDX-License-Identifier: Apache-2.0

if BOARD_96B_WISTRIO

config REGULATOR
	default y if LORA

endif # BOARD_96B_WISTRIO
```

## boards/96boards/wistrio/board.yml
```yaml
board:
  name: 96b_wistrio
  full_name: WisTrio
  vendor: 96boards
  socs:
    - name: stm32l151xba
```

## boards/96boards/wistrio/dts/bindings/qorvo,rfsw8001.yaml
```yaml
# Copyright (c) 2022 Nordic Semiconductor ASA
# SPDX-License-Identifier: Apache-2.0

description: |
  Qorvo's RFSW8001 is a single pole triple throw (SP3T) RF switch. The RF1,
  RF2 and RF3 pins are used to control the behavior of the switch as detailed
  in the "Switch Control Logic Table" in the datasheet.

compatible: "qorvo,rfsw8001"

include: base.yaml

properties:
  rf1-gpios:
    type: phandle-array
    required: true
    description: Pin used to control the RF1 switch

  rf2-gpios:
    type: phandle-array
    required: true
    description: Pin used to control the RF2 switch

  rf3-gpios:
    type: phandle-array
    required: true
    description: Pin used to control the RF3 switch
```

## boards/Kconfig
```kconfig
# SPDX-License-Identifier: Apache-2.0

config BOARD
	string
	# When using hw model v2, then the board is inherited from CMake.
	default "$(BOARD)" if "$(HWM_SCHEME)" = "v2"
	help
	  This option holds the name of the board and is used to locate the files
	  related to the board in the source tree (under boards/).
	  The Board is the first location where we search for a linker.ld file,
	  if not found we look for the linker file in
	  soc/<arch>/<family>/<series>

config BOARD_REVISION
	def_string "$(BOARD_REVISION)"
	help
	  If the BOARD has a revision field set, this is the revision.
	  Otherwise, it is the empty string. For example, if BOARD is
	  "plank@foo", this option will be "foo". If BOARD is "plank",
	  this option will be the empty string.

config BOARD_TARGET
	string
	default "$(BOARD)@$(BOARD_REVISION)$(BOARD_QUALIFIERS)" if "$(BOARD_REVISION)" != ""
	default "$(BOARD)$(BOARD_QUALIFIERS)"
	help
	  Contains the board target (full string including name, revision, soc, cluster and
	  variant) of the board being used.

	  For example, if building for ``nrf5340dk/nrf5340/cpuapp`` then this will contain the
	  value ``nrf5340dk/nrf5340/cpuapp``.

config BOARD_DEPRECATED_RELEASE
	string
	help
	  This hidden option is set in the board configuration and indicates
	  the Zephyr release that the board configuration will be removed.
	  When set, any build for that board will generate a clearly visible
	  deprecation warning.
	  When adding this to a BOARD, remember to follow the instructions in
	  https://docs.zephyrproject.org/latest/develop/api/api_lifecycle.html#deprecated

config QEMU_TARGET
	bool
	help
	  Mark all QEMU targets with this variable for checking whether we are
	  running in an emulated environment.

config NET_DRIVERS
	bool
	default y if QEMU_TARGET && NETWORKING
	help
	  When building for a qemu target then NET_DRIVERS will be default
	  enabled to allow for easy use of SLIP or PPP

rsource "Kconfig.$(HWM_SCHEME)"

# Parse shields references
# Don't do it as a menuconfig, as shield selection is a CMake feature.
# This loads custom shields Kconfig (from BOARD_ROOT)
osource "$(KCONFIG_BINARY_DIR)/Kconfig.shield"
# This loads Zephyr base shield defconfigs
rsource "shields/*/Kconfig.shield"

menu "Board Options"
config QEMU_ICOUNT
	bool "QEMU icount mode"
	depends on QEMU_TARGET
	default y if !NETWORKING && !BT
	help
	  Enable QEMU virtual instruction counter. The virtual cpu will
	  execute one instruction every 2^N ns of virtual time. This will
	  give deterministic execution times from the guest point of view.

config QEMU_ICOUNT_SHIFT
	int "QEMU icount shift value"
	depends on QEMU_ICOUNT
	help
	  The virtual CPU will execute one instruction every 2^N nanoseconds
	  of virtual time, where N is the value provided here.

config QEMU_ICOUNT_SLEEP
	bool "QEMU icount sleep mode enable"
	depends on QEMU_ICOUNT
	help
	  When the virtual CPU is sleeping, the virtual time will advance
	  at default speed unless this option is set. With this option set,
	  the virtual time will jump to the next timer deadline instantly
	  whenever the virtual CPU goes to sleep mode and will not advance
	  if no timer is enabled. This behavior gives deterministic execution
	  times from the guest point of view.

config QEMU_IVSHMEM_PLAIN_MEM_SIZE
	int "QEMU ivshmem-plain shared memory size in mega-bytes"
	default 1
	depends on QEMU_TARGET && IVSHMEM && !IVSHMEM_DOORBELL
	help
	  This sets the size of the shared memory when using ivshmem-plain
	  device in Qemu. Note that it's in mega-bytes, so 1 means 1M for Qemu
	  etc..

config QEMU_UEFI_BOOT
	bool "QEMU uses UEFI to boot up"
	default n
	depends on BUILD_OUTPUT_EFI && QEMU_TARGET && X86_64
	help
	  This option indicates that QEMU will use UEFI bootable method
	  to boot up.

config QEMU_GDBSERVER_LISTEN_DEV
	string "QEMU gdbserver listen device"
	default "tcp::1234"
	depends on QEMU_TARGET
	help
	  This options is passed onto QEMU as a parameter to `-gdb` option.
	  The default value is equivalent to `-s` which is a shorthand for
	  `-gdb tcp::1234`. An empty value omits the `-gdb` parameter altogether.
	  This allows the injection of `-gdb` parameter from other sources such
	  as the `QEMU_EXTRA_FLAGS` environment variable. Refer to application
	  development doc and/or QEMU invocation doc for more info.

config QEMU_EXTRA_FLAGS
	string "QEMU extra flags"
	depends on QEMU_TARGET
	default ""
	help
	  This option is to pass onto QEMU an extra list of parameters
	  to setup devices, for example to allocate interface for Zephyr
	  GDBstub over serial with `-serial tcp:127.0.0.1:5678,server`

# There might not be any board options, hence the optional source
osource "$(BOARD_DIR)/Kconfig"
endmenu

config BOARD_HAS_TIMING_FUNCTIONS
	bool
	help
	  Should be selected if board provides custom method for retrieving
	  timestamps and cycle count.
```

## boards/Kconfig.v1
```kconfig
# Copyright (c) 2022 Nordic Semiconductor ASA

# SPDX-License-Identifier: Apache-2.0

# In HWMv1 the KCONFIG_BOARD_DIR points directly to the BOARD_DIR.
# Set the BOARD_DIR variable for backwards compatibility to legacy hardware model.
BOARD_DIR := $(KCONFIG_BOARD_DIR)

choice
	prompt "Board Selection"

source "$(KCONFIG_BOARD_DIR)/Kconfig.board"

endchoice
```

## boards/Kconfig.whisper
```kconfig
# Copyright (c) 2026 Intel Corporation
#
# SPDX-License-Identifier: Apache-2.0

if WHISPER_TARGET

menu "Whisper Simulator"

config WHISPER_USE_CLINT
	bool "Pass --clint command line argument"
	help
	  This enables passing --clint command line argument to Whisper.

config WHISPER_CLINT_BASE_ADDRESS
	hex "Address for --clint command line argument"
	depends on WHISPER_USE_CLINT
	help
	  Specify the base address for used with --clint command
	  line argument.

config WHISPER_USE_SWINT
	bool "Pass --softinterrupt command line argument"
	depends on !WHISPER_USE_CLINT
	help
	  This enables passing --softinterrupt command line argument to Whisper.

config WHISPER_SWINT_BASE_ADDRESS
	hex "Address for --softinterrupt command line argument"
	depends on WHISPER_USE_SWINT
	help
	  Specify the base address for used with --softinterrupt command
	  line argument.

endmenu

endif # WHISPER_TARGET
```

## boards/aconno/acn52832/Kconfig.acn52832
```kconfig
# aconno acn52832 board configuration

# Copyright (c) 2023 Sven Herrmann <sven.herrmann@posteo.de>
# SPDX-License-Identifier: Apache-2.0

config BOARD_ACN52832
	select SOC_NRF52832_QFAA
```
