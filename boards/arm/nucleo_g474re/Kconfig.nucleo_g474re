## boards/arm/nucleo_g474re/Kconfig.nucleo_g474re
```kconfig
# Copyright (c) 2022 Zephyr Project members and individual contributors
# SPDX-License-Identifier: Apache-2.0

config BOARD_NUCLEO_G474RE
	bool
	default y
	select SOC_SERIES_STM32G4X
	select SOC_STM32G474XX
```

## boards/arm/nucleo_h563zi/Kconfig.board
```kconfig
# STM32H563ZI Nucleo board configuration

# Copyright (c) 2023 Thomas Stranger
# SPDX-License-Identifier: Apache-2.0

config BOARD_NUCLEO_H563ZI
	bool "Nucleo H563ZI Development Board"
	depends on SOC_STM32H563XX
```

## boards/arm/nucleo_h723zg/Kconfig.board
```kconfig
# STM32H723ZG Nucleo board configuration

# Copyright (c) 2020 Alexander Kozhinov <AlexanderKozhinov@yandex.com>
# SPDX-License-Identifier: Apache-2.0

config BOARD_NUCLEO_H723ZG
	bool "NUCLEO-H723ZG Development Board"
	depends on SOC_STM32H723XX
```

## boards/arm/nucleo_h723zg/Kconfig.defconfig
```kconfig
# STM32H723ZG Nucleo board configuration

# Copyright (c) 2020 Alexander Kozhinov <AlexanderKozhinov@yandex.com>
# SPDX-License-Identifier: Apache-2.0

if BOARD_NUCLEO_H723ZG

config BOARD
	default "nucleo_h723zg"

if NETWORKING

config NET_L2_ETHERNET
	default y

endif # NETWORKING

config USB_DC_HAS_HS_SUPPORT
	default y
	depends on USB_DC_STM32

config BBRAM_STM32
	bool "ST STM32 Battery-backed RAM drivers"
	default y
	help
	  This option enables the BBRAM driver for STM32 family of
	  processors.
	  STM32 BBRAM are 32-bit registers which can be used for storing user
	  application data. They are implemented in the backup domain that remains
	  powered-on by VBAT when the VDD power is switched off. They are not reset
	  by system reset or when the device wakes up from Standby mode. They are
	  reset by a backup domain reset.

endif # BOARD_NUCLEO_H723ZG
```

## boards/arm/nucleo_h723zg/nucleo_h723zg_defconfig
```kconfig
# SPDX-License-Identifier: Apache-2.0

CONFIG_SOC_SERIES_STM32H7X=y
CONFIG_SOC_STM32H723XX=y
CONFIG_SYS_CLOCK_HW_CYCLES_PER_SEC=550000000

CONFIG_BOARD_NUCLEO_H723ZG=y

# Enable MPU
CONFIG_ARM_MPU=y

# Enable HW stack protection
CONFIG_HW_STACK_PROTECTION=y

# Enable UART
CONFIG_SERIAL=y

# Console
CONFIG_CONSOLE=y
CONFIG_UART_CONSOLE=y

# Enable Pinmux
CONFIG_PINMUX=y

# Enable GPIO
CONFIG_GPIO=y

# Clock Configuration
CONFIG_CLOCK_CONTROL=y

CONFIG_CLOCK_STM32_D1CPRE=1

# HCLK: 275MHz
CONFIG_CLOCK_STM32_HPRE=2

# APB1: 137.5MHz
CONFIG_CLOCK_STM32_D2PPRE1=2

# APB2: 137.5MHz
CONFIG_CLOCK_STM32_D2PPRE2=2

# APB3: 137.5MHz
CONFIG_CLOCK_STM32_D1PPRE=2

# APB4: 137.5MHz
CONFIG_CLOCK_STM32_D3PPRE=2

# STLINK provides 8MHz clock input
CONFIG_CLOCK_STM32_HSE_CLOCK=8000000
CONFIG_CLOCK_STM32_SYSCLK_SRC_PLL=y

# Use HSE (bypass) as PLL input
CONFIG_CLOCK_STM32_PLL_SRC_HSE=y
CONFIG_CLOCK_STM32_HSE_BYPASS=y

# Produce 550MHz clock at PLL1 output
CONFIG_CLOCK_STM32_PLL_M_DIVISOR=4
CONFIG_CLOCK_STM32_PLL_N_MULTIPLIER=275
CONFIG_CLOCK_STM32_PLL_P_DIVISOR=1
CONFIG_CLOCK_STM32_PLL_Q_DIVISOR=4
CONFIG_CLOCK_STM32_PLL_R_DIVISOR=2
```

## boards/arm/nucleo_h743zi/Kconfig.defconfig
```kconfig
# STM32H743ZI Nucleo board configuration

# Copyright (c) 2020 Teslabs Engineering S.L.
# SPDX-License-Identifier: Apache-2.0

if NETWORKING

config NET_L2_ETHERNET
	default y

endif # NETWORKING
```

## boards/arm/nucleo_h743zi/Kconfig.nucleo_h743zi
```kconfig
# Copyright (c) 2022 Zephyr Project members and individual contributors
# SPDX-License-Identifier: Apache-2.0

config BOARD_NUCLEO_H743ZI
	bool
	default y
	select SOC_SERIES_STM32H7X
	select SOC_STM32H743XX
```

## boards/arm/nucleo_h743zi/nucleo_h743zi_defconfig
```kconfig
# SPDX-License-Identifier: Apache-2.0

CONFIG_SOC_SERIES_STM32H7X=y
CONFIG_SOC_STM32H743XX=y
# 96MHz system clock (CubeMX Defaults)
CONFIG_SYS_CLOCK_HW_CYCLES_PER_SEC=96000000

# Enable MPU
CONFIG_ARM_MPU=y

# Enable HW stack protection
CONFIG_HW_STACK_PROTECTION=y

# Enable UART
CONFIG_SERIAL=y

# Console
CONFIG_CONSOLE=y
CONFIG_UART_CONSOLE=y

# Enable Pinmux
CONFIG_PINMUX=y

# Enable GPIO
CONFIG_GPIO=y

# Clock Configuration
CONFIG_CLOCK_CONTROL=y

# STLINK provides 8MHz clock input
CONFIG_CLOCK_STM32_HSE_CLOCK=8000000
CONFIG_CLOCK_STM32_SYSCLK_SRC_PLL=y
# Use HSE as PLL input
CONFIG_CLOCK_STM32_PLL_SRC_HSE=y
# Nucleo-144 boards do not have an external oscillator, so just use
# the 8MHz clock signal coming from integrated STLink
CONFIG_CLOCK_STM32_HSE_BYPASS=y

# Produce 96MHz clock at PLL output
CONFIG_CLOCK_STM32_PLL_M_DIVISOR=1
CONFIG_CLOCK_STM32_PLL_N_MULTIPLIER=24
CONFIG_CLOCK_STM32_PLL_P_DIVISOR=2
CONFIG_CLOCK_STM32_PLL_Q_DIVISOR=4
CONFIG_CLOCK_STM32_PLL_R_DIVISOR=2
```

## boards/arm/nucleo_h745zi_q/Kconfig.board
```kconfig
# STM32H745ZI Nucleo board configuration

# Copyright (c) 2020 Alexander Kozhinov
# AlexanderKozhinov@yandex.com
# SPDX-License-Identifier: Apache-2.0

config BOARD_NUCLEO_H745ZI_Q_M7
	bool "NUCLEO-H745ZI-Q Development Board"
	depends on SOC_STM32H745XX
	select CPU_CORTEX_M7

config BOARD_NUCLEO_H745ZI_Q_M4
	bool "NUCLEO-H745ZI-Q Development Board"
	depends on SOC_STM32H745XX
	select CPU_CORTEX_M4
```

## boards/arm/nucleo_h745zi_q/Kconfig.defconfig
```kconfig
# STM32H745ZI Nucleo board configuration

# Copyright (c) 2020 Alexander Kozhinov <AlexanderKozhinov@yandex.com>
# SPDX-License-Identifier: Apache-2.0

config STM32H7_DUAL_CORE
	default y

if NETWORKING

config NET_L2_ETHERNET
	default y

endif # NETWORKING
```

## boards/arm/nucleo_h745zi_q/Kconfig.nucleo_h745zi_q_m4
```kconfig
# Copyright (c) 2022 Zephyr Project members and individual contributors
# SPDX-License-Identifier: Apache-2.0

config BOARD_NUCLEO_H745ZI_Q_M4
	bool
	default y
	select SOC_SERIES_STM32H7X
	select SOC_STM32H745XX
	select CPU_CORTEX_M4
```

## boards/arm/nucleo_h745zi_q/nucleo_h745zi_q_m4_defconfig
```kconfig
# SPDX-License-Identifier: Apache-2.0


# Board config should be specified since there are 2 possible targets

# Enable GPIO
CONFIG_GPIO=y

# Enable clock
CONFIG_CLOCK_CONTROL=y

# By default SERIAL peripherals are assigned to m7

# Enable uart driver
#CONFIG_SERIAL=y

# Console
#CONFIG_CONSOLE=y
#CONFIG_UART_CONSOLE=y

# enable pin controller
CONFIG_PINCTRL=y
```

## boards/arm/nucleo_h745zi_q/nucleo_h745zi_q_m7_defconfig
```kconfig
# SPDX-License-Identifier: Apache-2.0


# Board config should be specified since there are 2 possible targets

# Enable the internal SMPS regulator
CONFIG_POWER_SUPPLY_DIRECT_SMPS=y

# Enable MPU
CONFIG_ARM_MPU=y

# Enable HW stack protection
CONFIG_HW_STACK_PROTECTION=y

# Enable UART ( disable to assign to M4 core)
CONFIG_SERIAL=y

# Console ( disable to assign to M4 core)
CONFIG_CONSOLE=y
CONFIG_UART_CONSOLE=y

# Enable GPIO
CONFIG_GPIO=y

# Enable Clock
CONFIG_CLOCK_CONTROL=y

# enable pin controller
CONFIG_PINCTRL=y
```

## boards/arm/nucleo_h753zi/Kconfig.defconfig
```kconfig
# STM32H753ZI Nucleo board configuration

# Copyright (c) 2021 Blue Clover Devices
# SPDX-License-Identifier: Apache-2.0

if NETWORKING

config NET_L2_ETHERNET
	default y

endif # NETWORKING
```

## boards/arm/nucleo_h753zi/nucleo_h753zi_defconfig
```kconfig
# SPDX-License-Identifier: Apache-2.0

CONFIG_SOC_SERIES_STM32H7X=y
CONFIG_SOC_STM32H753XX=y

# Enable MPU
CONFIG_ARM_MPU=y

# Enable HW stack protection
CONFIG_HW_STACK_PROTECTION=y

# Enable UART
CONFIG_SERIAL=y

# Console
CONFIG_CONSOLE=y
CONFIG_UART_CONSOLE=y

# Enable GPIO
CONFIG_GPIO=y

# Enable clocks
CONFIG_CLOCK_CONTROL=y

# enable pin controller
CONFIG_PINCTRL=y
```

## boards/arm/nucleo_h7a3zi_q/Kconfig.board
```kconfig
# STM32H7A3ZI-Q Nucleo board configuration

# Copyright (c) 2021 Electrolance Solutions
# SPDX-License-Identifier: Apache-2.0

config BOARD_NUCLEO_H7A3ZI_Q
	bool "Nucleo H75A3ZI-Q Development Board"
	depends on SOC_STM32H7A3XXQ
```

## boards/arm/nucleo_h7a3zi_q/Kconfig.defconfig
```kconfig
# STM32H7A3ZI-Q Nucleo board configuration

# Copyright (c) 2021 Electrolance Solutions
# SPDX-License-Identifier: Apache-2.0

if BOARD_NUCLEO_H7A3ZI_Q

config BOARD
	default "nucleo_h7a3zi_q"

endif # BOARD_NUCLEO_H7A3ZI_Q
```

## boards/arm/nucleo_h7a3zi_q/Kconfig.nucleo_h7a3zi_q
```kconfig
# Copyright (c) 2022 Zephyr Project members and individual contributors
# SPDX-License-Identifier: Apache-2.0

config BOARD_NUCLEO_H7A3ZI_Q
	bool
	default y
	select SOC_SERIES_STM32H7X
	select SOC_STM32H7A3XXQ
```

## boards/arm/nucleo_h7a3zi_q/nucleo_h7a3zi_q_defconfig
```kconfig
# Copyright (c) 2021 Electrolance Solutions
# SPDX-License-Identifier: Apache-2.0

CONFIG_SOC_SERIES_STM32H7X=y
CONFIG_SOC_STM32H7A3XXQ=y

# Enable MPU
CONFIG_ARM_MPU=y

# Enable HW stack protection
CONFIG_HW_STACK_PROTECTION=y

# Enable UART
CONFIG_SERIAL=y

# Console
CONFIG_CONSOLE=y
CONFIG_UART_CONSOLE=y

# Enable Pinctrl
CONFIG_PINCTRL=y

# Enable GPIO
CONFIG_GPIO=y

# Enable clocks
CONFIG_CLOCK_CONTROL=y

# Enable SMPS
CONFIG_POWER_SUPPLY_DIRECT_SMPS=y
```

## boards/arm/nucleo_l011k4/Kconfig.defconfig
```kconfig
# STM32 Nucleo-32 development board with STM32L011K4 MCU

# Copyright (c) 2020 Steven Daglish <s.c.daglish@gmail.com>
# SPDX-License-Identifier: Apache-2.0

config SPI_STM32_INTERRUPT
	default y
	depends on SPI
```

## boards/arm/nucleo_l011k4/nucleo_l011k4_defconfig
```kconfig
# SPDX-License-Identifier: Apache-2.0

# Zephyr Kernel Configuration
CONFIG_SOC_SERIES_STM32L0X=y

# Platform Configuration
CONFIG_SOC_STM32L011XX=y

# Kernel Options due to Low Memory (2k)
CONFIG_MAIN_STACK_SIZE=320
CONFIG_IDLE_STACK_SIZE=100
CONFIG_ISR_STACK_SIZE=256

# Serial Drivers
CONFIG_SERIAL=y
CONFIG_UART_INTERRUPT_DRIVEN=y
# enable console
CONFIG_CONSOLE=y
CONFIG_UART_CONSOLE=y

# GPIO Controller
CONFIG_GPIO=y

# Enable Clocks
CONFIG_CLOCK_CONTROL=y

# enable pin controller
CONFIG_PINCTRL=y
```

## boards/arm/nucleo_l031k6/Kconfig.board
```kconfig
# STM32 Nucleo-32 development board with STM32L031K6 MCU configuration

# Copyright (c) 2020 Steven Daglish <s.c.daglish@gmail.com>
# SPDX-License-Identifier: Apache-2.0

config BOARD_NUCLEO_L031K6
	bool "NUCLEO-32 L031K6 Development Board"
	depends on SOC_STM32L031XX
```

## boards/arm/nucleo_l031k6/nucleo_l031k6_defconfig
```kconfig
# SPDX-License-Identifier: Apache-2.0

# Zephyr Kernel Configuration
CONFIG_SOC_SERIES_STM32L0X=y

# Platform Configuration
CONFIG_SOC_STM32L031XX=y

# Kernel Options due to Low Memory (8k)
CONFIG_MAIN_STACK_SIZE=640
CONFIG_IDLE_STACK_SIZE=200
CONFIG_ISR_STACK_SIZE=512

# Serial Drivers
CONFIG_SERIAL=y
CONFIG_UART_INTERRUPT_DRIVEN=y
# enable console
CONFIG_CONSOLE=y
CONFIG_UART_CONSOLE=y

# GPIO Controller
CONFIG_GPIO=y

# Enable Clocks
CONFIG_CLOCK_CONTROL=y

# enable pin controller
CONFIG_PINCTRL=y
```

## boards/arm/nucleo_l053r8/Kconfig.board
```kconfig
# STM32 Nucleo-64 development board with STM32L053R8 MCU configuration

# Copyright (c) 2018 Anthony Kreft <anthony.kreft@gmail.com>
# SPDX-License-Identifier: Apache-2.0

config BOARD_NUCLEO_L053R8
	bool "NUCLEO-64 L053R8 Development Board"
	depends on SOC_STM32L053XX
```

## boards/arm/nucleo_l053r8/Kconfig.defconfig
```kconfig
# STM32 Nucleo-64 development board with STM32L053R8 MCU

# Copyright (c) 2018 Anthony Kreft <anthony.kreft@gmail.com>
# SPDX-License-Identifier: Apache-2.0

config SPI_STM32_INTERRUPT
	default y
	depends on SPI
```
