## boards/arm/lpcxpresso55s06/Kconfig.defconfig
```kconfig
# LPCXpresso55S06 board

# Copyright (c) 2022 metraTec
# SPDX-License-Identifier: Apache-2.0

if BOARD_LPCXPRESSO55S06

config BOARD
	default "lpcxpresso55s06"

endif # BOARD_LPCXPRESSO55S06
```

## boards/arm/lpcxpresso55s16/Kconfig.defconfig
```kconfig
# LPCXpresso55S16 board

# Copyright (c) 2020 Henrik Brix Andersen <henrik@brixandersen.dk>
# SPDX-License-Identifier: Apache-2.0

config FXOS8700_DRDY_INT1
	default y
	depends on FXOS8700_TRIGGER
```

## boards/arm/lpcxpresso55s16/Kconfig.lpcxpresso55s16
```kconfig
# Copyright (c) 2022 Zephyr Project members and individual contributors
# SPDX-License-Identifier: Apache-2.0

config BOARD_LPCXPRESSO55S16
	bool
	default y
	select SOC_SERIES_LPC55XXX
	select SOC_LPC55S16
	select SOC_PART_NUMBER_LPC55S16JBD100
```

## boards/arm/lpcxpresso55s16/lpcxpresso55s16_defconfig
```kconfig
#
# Copyright (c) 2020 Henrik Brix Andersen <henrik@brixandersen.dk>
#
# SPDX-License-Identifier: Apache-2.0
#

CONFIG_SOC_SERIES_LPC55XXX=y
CONFIG_SOC_LPC55S16=y
CONFIG_BOARD_LPCXPRESSO55S16=y
CONFIG_CONSOLE=y
CONFIG_UART_CONSOLE=y
CONFIG_SERIAL=y
CONFIG_UART_INTERRUPT_DRIVEN=y
CONFIG_GPIO=y
CONFIG_PINCTRL=y
CONFIG_ARM_MPU=y

CONFIG_RUNTIME_NMI=y
```

## boards/arm/lpcxpresso55s28/Kconfig.board
```kconfig
# LPCXpresso55S28 board

# Copyright (c) 2020 Lemonbeat GmbH
# SPDX-License-Identifier: Apache-2.0

config BOARD_LPCXPRESSO55S28
	bool "NXP LPCXPRESSO-55S28"
	depends on SOC_SERIES_LPC55XXX
	select SOC_PART_NUMBER_LPC55S28JBD100
```

## boards/arm/lpcxpresso55s28/Kconfig.defconfig
```kconfig
# LPCXpresso55S28 board

# Copyright (c) 2020 Lemonbeat GmbH
# SPDX-License-Identifier: Apache-2.0

if BOARD_LPCXPRESSO55S28

config BOARD
	default "lpcxpresso55S28"

if FXOS8700

choice FXOS8700_MODE
	default FXOS8700_MODE_ACCEL
endchoice

config FXOS8700_DRDY_INT1
	default y
	depends on FXOS8700_TRIGGER

endif # FXOS8700

# For the secure version of the board the firmware is linked at the beginning
# of the flash, or into the code-partition defined in DT if it is intended to
# be loaded by MCUboot. If the secure firmware is to be combined with a non-
# secure image (TRUSTED_EXECUTION_SECURE=y), the secure FW image shall always
# be restricted to the size of its code partition.
# For the non-secure version of the board, the firmware
# must be linked into the code-partition (non-secure) defined in DT, regardless.
# Apply this configuration below by setting the Kconfig symbols used by
# the linker according to the information extracted from DT partitions.

# Workaround for not being able to have commas in macro arguments
DT_CHOSEN_Z_CODE_PARTITION := zephyr,code-partition

config FLASH_LOAD_SIZE
	default $(dt_chosen_reg_size_hex,$(DT_CHOSEN_Z_CODE_PARTITION))
	depends on BOARD_LPCXPRESSO55S28 && TRUSTED_EXECUTION_SECURE

endif # BOARD_LPCXPRESSO55S28
```

## boards/arm/lpcxpresso55s28/lpcxpresso55s28_defconfig
```kconfig
#
# Copyright (c) 2020 Lemonbeat GmbH
#
# SPDX-License-Identifier: Apache-2.0
#

CONFIG_SOC_SERIES_LPC55XXX=y
CONFIG_SOC_LPC55S28=y
CONFIG_BOARD_LPCXPRESSO55S28=y
CONFIG_CONSOLE=y
CONFIG_UART_CONSOLE=y
CONFIG_SERIAL=y
CONFIG_UART_INTERRUPT_DRIVEN=y
CONFIG_CORTEX_M_SYSTICK=y
CONFIG_GPIO=y
CONFIG_PINMUX=y
CONFIG_SYS_CLOCK_HW_CYCLES_PER_SEC=96000000
CONFIG_ARM_MPU=y
CONFIG_HW_STACK_PROTECTION=y

# Enable TrustZone-M
CONFIG_TRUSTED_EXECUTION_SECURE=y
CONFIG_ARM_TRUSTZONE_M=y

CONFIG_RUNTIME_NMI=y

CONFIG_BUILD_OUTPUT_HEX=y
```

## boards/arm/lpcxpresso55s28/lpcxpresso55s28_ns_defconfig
```kconfig
#
# Copyright (c) 2020 Lemonbeat GmbH
#
# SPDX-License-Identifier: Apache-2.0
#

CONFIG_SOC_SERIES_LPC55XXX=y
CONFIG_SOC_LPC55S28=y
CONFIG_BOARD_LPCXPRESSO55S28=y
CONFIG_CONSOLE=y
CONFIG_UART_CONSOLE=y
CONFIG_SERIAL=y
CONFIG_UART_INTERRUPT_DRIVEN=y
CONFIG_CORTEX_M_SYSTICK=y
CONFIG_GPIO=y
CONFIG_PINMUX=y
CONFIG_SYS_CLOCK_HW_CYCLES_PER_SEC=96000000

# TFM sets up MPU_NS, can't correctly change this configuration yet
CONFIG_ARM_MPU=n

# Enable TrustZone-M
CONFIG_TRUSTED_EXECUTION_NONSECURE=y
CONFIG_RUNTIME_NMI=y
# TFM will run without MCUboot
CONFIG_TFM_BL2=n

CONFIG_BUILD_OUTPUT_HEX=y
```

## boards/arm/lpcxpresso55s36/Kconfig.board
```kconfig
# LPCXpresso55S36 board

# Copyright 2022 NXP
# SPDX-License-Identifier: Apache-2.0

config BOARD_LPCXPRESSO55S36
	bool "NXP LPCXPRESSO-55S36"
	depends on SOC_SERIES_LPC55XXX
	select SOC_PART_NUMBER_LPC55S36JBD100
```

## boards/arm/lpcxpresso55s36/Kconfig.defconfig
```kconfig
# LPCXpresso55S36 board

# Copyright 2022 NXP
# SPDX-License-Identifier: Apache-2.0

if BOARD_LPCXPRESSO55S36

config BOARD
	default "lpcxpresso55s36"

endif # BOARD_LPCXPRESSO55S36
```

## boards/arm/lpcxpresso55s36/Kconfig.lpcxpresso55s36
```kconfig
# Copyright (c) 2022 Zephyr Project members and individual contributors
# SPDX-License-Identifier: Apache-2.0

config BOARD_LPCXPRESSO55S36
	bool
	default y
	select SOC_SERIES_LPC55XXX
	select SOC_LPC55S36
	select SOC_PART_NUMBER_LPC55S36JBD100
```

## boards/arm/lpcxpresso55s36/lpcxpresso55s36_defconfig
```kconfig
#
# Copyright 2022 NXP
#
# SPDX-License-Identifier: Apache-2.0
#

CONFIG_SOC_SERIES_LPC55XXX=y
CONFIG_SOC_LPC55S36=y
CONFIG_BOARD_LPCXPRESSO55S36=y
CONFIG_CONSOLE=y
CONFIG_UART_CONSOLE=y
CONFIG_SERIAL=y
CONFIG_UART_INTERRUPT_DRIVEN=y
CONFIG_GPIO=y
CONFIG_PINCTRL=y
CONFIG_SYS_CLOCK_HW_CYCLES_PER_SEC=96000000
CONFIG_ARM_MPU=y

CONFIG_RUNTIME_NMI=y
```

## boards/arm/lpcxpresso55s69/Kconfig.board
```kconfig
# Kconfig - LPCXpresso55S69 board
#
# Copyright (c) 2019, NXP
#
# SPDX-License-Identifier: Apache-2.0
#

config BOARD_LPCXPRESSO55S69_CPU0
	bool "NXP LPCXPRESSO-55S69 [CPU0]"
	depends on SOC_SERIES_LPC55XXX
	select SOC_PART_NUMBER_LPC55S69JBD100

config BOARD_LPCXPRESSO55S69_CPU1
	bool "NXP LPCXPRESSO-55S69 [CPU1]"
	depends on SOC_SERIES_LPC55XXX
	select SOC_PART_NUMBER_LPC55S69JBD100
```

## boards/arm/lpcxpresso55s69/Kconfig.defconfig
```kconfig
# LPCXpresso55S69 board

# Copyright (c) 2019, NXP
# SPDX-License-Identifier: Apache-2.0

if BOARD_LPCXPRESSO55S69_CPU0 || BOARD_LPCXPRESSO55S69_CPU1

config BOARD
	default "lpcxpresso55S69_cpu0" if BOARD_LPCXPRESSO55S69_CPU0
	default "lpcxpresso55S69_cpu1" if BOARD_LPCXPRESSO55S69_CPU1

config FXOS8700_DRDY_INT1
	default y
	depends on FXOS8700_TRIGGER

# For the secure version of the board the firmware is linked at the beginning
# of the flash, or into the code-partition defined in DT if it is intended to
# be loaded by MCUboot. If the secure firmware is to be combined with a non-
# secure image (TRUSTED_EXECUTION_SECURE=y), the secure FW image shall always
# be restricted to the size of its code partition.
# For the non-secure version of the board, the firmware
# must be linked into the code-partition (non-secure) defined in DT, regardless.
# Apply this configuration below by setting the Kconfig symbols used by
# the linker according to the information extracted from DT partitions.

# Workaround for not being able to have commas in macro arguments
DT_CHOSEN_Z_CODE_PARTITION := zephyr,code-partition

config FLASH_LOAD_SIZE
	default $(dt_chosen_reg_size_hex,$(DT_CHOSEN_Z_CODE_PARTITION))
	depends on BOARD_LPCXPRESSO55S69_CPU0 && TRUSTED_EXECUTION_SECURE

if TRUSTED_EXECUTION_NONSECURE || BOARD_LPCXPRESSO55S69_CPU1

config FLASH_LOAD_OFFSET
	default 0x50000 if (!TFM_BL2 && BUILD_WITH_TFM)
	default $(dt_chosen_reg_addr_hex,$(DT_CHOSEN_Z_CODE_PARTITION))

config FLASH_LOAD_SIZE
	default 0x40000 if (!TFM_BL2 && BUILD_WITH_TFM)
	default $(dt_chosen_reg_size_hex,$(DT_CHOSEN_Z_CODE_PARTITION))

endif # TRUSTED_EXECUTION_NONSECURE || BOARD_LPCXPRESSO55S69_CPU1

choice TFM_PROFILE_TYPE
	depends on BUILD_WITH_TFM
	default TFM_PROFILE_TYPE_MEDIUM
endchoice

# Enable SD subsystem driver if disk driver is required
config DISK_DRIVER_SDMMC
	default y if DISK_DRIVERS

endif # BOARD_LPCXPRESSO55S69_CPU0 || BOARD_LPCXPRESSO55S69_CPU1

if DMA_MCUX_LPC

# Memory from the heap pool is used to allocate DMA descriptors for
# channels that use multiple blocks for a DMA transfer.
# Adjust HEAP_MEM_POOL_SIZE in case you need more memory.
config HEAP_MEM_POOL_SIZE
	default 4096

endif # DMA_MCUX_LPC
```

## boards/arm/lpcxpresso55s69/Kconfig.lpcxpresso55s69_cpu1
```kconfig
# Copyright (c) 2022 Zephyr Project members and individual contributors
# SPDX-License-Identifier: Apache-2.0

config BOARD_LPCXPRESSO55S69_CPU1
	bool
	default y
	select SOC_SERIES_LPC55XXX
	select SOC_LPC55S69_CPU1
	select SOC_PART_NUMBER_LPC55S69JBD100
```

## boards/arm/lpcxpresso55s69/Kconfig.lpcxpresso55s69_ns
```kconfig
# Copyright (c) 2022 Zephyr Project members and individual contributors
# SPDX-License-Identifier: Apache-2.0

config BOARD_LPCXPRESSO55S69_NS
	bool
	default y
	select SOC_SERIES_LPC55XXX
	select SOC_LPC55S69_CPU0
	select SOC_PART_NUMBER_LPC55S69JBD100
```

## boards/arm/lpcxpresso55s69/lpcxpresso55s69_cpu0_defconfig
```kconfig
#
# Copyright (c) 2019, NXP
#
# SPDX-License-Identifier: Apache-2.0
#

CONFIG_SOC_SERIES_LPC55XXX=y
CONFIG_SOC_LPC55S69_CPU0=y
CONFIG_BOARD_LPCXPRESSO55S69_CPU0=y
CONFIG_CONSOLE=y
CONFIG_UART_CONSOLE=y
CONFIG_SERIAL=y
CONFIG_UART_INTERRUPT_DRIVEN=y
CONFIG_GPIO=y
CONFIG_SYS_CLOCK_HW_CYCLES_PER_SEC=96000000
CONFIG_ARM_MPU=y
CONFIG_HW_STACK_PROTECTION=y
CONFIG_PINCTRL=y

# Enable TrustZone-M
CONFIG_TRUSTED_EXECUTION_SECURE=y
CONFIG_ARM_TRUSTZONE_M=y

CONFIG_RUNTIME_NMI=y
```

## boards/arm/lpcxpresso55s69/lpcxpresso55s69_cpu1_defconfig
```kconfig
#
# Copyright (c) 2019, NXP
#
# SPDX-License-Identifier: Apache-2.0
#

CONFIG_GPIO=y
CONFIG_SYS_CLOCK_HW_CYCLES_PER_SEC=96000000
CONFIG_PINCTRL=y

CONFIG_RUNTIME_NMI=y
```

## boards/arm/lpcxpresso55s69/lpcxpresso55s69_ns_defconfig
```kconfig
#
# Copyright (c) 2019, NXP
#
# SPDX-License-Identifier: Apache-2.0
#

CONFIG_SOC_SERIES_LPC55XXX=y
CONFIG_SOC_LPC55S69_CPU0=y
CONFIG_BOARD_LPCXPRESSO55S69_CPU0=y
CONFIG_CONSOLE=y
CONFIG_UART_CONSOLE=y
CONFIG_SERIAL=y
CONFIG_UART_INTERRUPT_DRIVEN=y
CONFIG_CORTEX_M_SYSTICK=y
CONFIG_GPIO=y
CONFIG_PINMUX=y
CONFIG_SYS_CLOCK_HW_CYCLES_PER_SEC=96000000

# TFM sets up MPU_NS, can't correctly change this configuration yet
CONFIG_ARM_MPU=n

# Enable TrustZone-M
CONFIG_TRUSTED_EXECUTION_NONSECURE=y
CONFIG_RUNTIME_NMI=y

CONFIG_BUILD_OUTPUT_HEX=y
```

## boards/arm/max32666fthr2/Kconfig.board
```kconfig
# MAX32666FTHR2 board configuration

# Copyright (c) 2023 Analog Devices, Inc.
# SPDX-License-Identifier: Apache-2.0

config BOARD_MAX32666FTHR2
	bool "MAX32666FTHR2"
	depends on SOC_SERIES_MAX32
	select SOC_PART_NUMBER_MAX32666
```

## boards/arm/max32666fthr2/Kconfig.defconfig
```kconfig
# MAX32666FTHR2 board configuration

# Copyright (c) 2023 Analog Devices, Inc.
# SPDX-License-Identifier: Apache-2.0

if BOARD_MAX32666FTHR2

config BOARD
	default "max32666fthr2"

endif # BOARD_MAX32666FTHR2
```

## boards/arm/max32666fthr2/max32666fthr2_defconfig
```kconfig
# SPDX-License-Identifier: Apache-2.0

CONFIG_SOC_SERIES_MAX32=y
CONFIG_SOC_MAX32666=y

# Enable GPIO
CONFIG_GPIO=y

CONFIG_SYS_CLOCK_HW_CYCLES_PER_SEC=96000000
#CONFIG_SYS_CLOCK_TICKS_PER_SEC=30000000
CONFIG_PINCTRL=y

# Console
CONFIG_CONSOLE=y
CONFIG_UART_CONSOLE=y

# enable uart driver
CONFIG_SERIAL=y
CONFIG_UART_MAX32=y

# Enable Clocks
CONFIG_CLOCK_CONTROL=y

# Enable I2C
CONFIG_I2C=y

# Enable SPI
CONFIG_SPI=y
```

## boards/arm/mec1501modular_assy6885/Kconfig.board
```kconfig
# Microchip MEC1501 Modular ASSY 6885 Development board

# Copyright (c) 2019, Intel Corporation
# SPDX-License-Identifier: Apache-2.0

config BOARD_MEC1501MODULAR_ASSY6885
	def_bool "$(BOARD)" = "mec1501modular_assy6885"
	depends on SOC_MEC1501_HSZ
```

## boards/arm/mec1501modular_assy6885/Kconfig.defconfig
```kconfig
# Copyright (c) 2019 Intel Corporation
# SPDX-License-Identifier: Apache-2.0

if BOARD_MEC1501MODULAR_ASSY6885

config BOARD
	default "mec1501modular_assy6885"

#PS/2 driver is compiled in terms of this flag.
config ESPI_PERIPHERAL_8042_KBC
	default y
	depends on ESPI_XEC

if RTOS_TIMER

# XEC RTOS timer HW frequency is fixed at 32768
# The driver requires tickless mode and ticks per
# second to be 32768 for accurate operation.

config SYS_CLOCK_HW_CYCLES_PER_SEC
	default 32768

config SYS_CLOCK_TICKS_PER_SEC
	default 32768

endif # RTOS_TIMER

if !RTOS_TIMER

# If RTOS timer is not enabled we use ARM Cortex-M
# SYSTICK. SYSTICK frequency is 48MHz divided by
# SOC_MEC1501_PROC_CLK_DIV.

config SYS_CLOCK_HW_CYCLES_PER_SEC
	default 48000000

config SYS_CLOCK_TICKS_PER_SEC
	default 1000

if ESPI

config ESPI_PERIPHERAL_UART_SOC_MAPPING
	default 1

endif # ESPI

endif # RTOS_TIMER

endif # BOARD_MEC1501MODULAR_ASSY6885
```

## boards/arm/mec1501modular_assy6885/Kconfig.mec1501modular_assy6885
```kconfig
# Copyright (c) 2022 Zephyr Project members and individual contributors
# SPDX-License-Identifier: Apache-2.0

config BOARD_MEC1501MODULAR_ASSY6885
	bool
	default y
	select SOC_MEC1501_HSZ
	select SOC_SERIES_MEC1501X
	select SOC_MEC1501_VCI_PINS_AS_GPIOS
```
