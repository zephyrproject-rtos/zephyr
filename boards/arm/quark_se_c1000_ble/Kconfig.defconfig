## boards/arm/quark_se_c1000_ble/Kconfig.defconfig
```kconfig
# Kconfig - Quark SE C1000 BLE (nRF51822) configuration
#
# Copyright (c) 2016 Intel Corporation
#
# SPDX-License-Identifier: Apache-2.0

if BOARD_QUARK_SE_C1000_BLE

config BOARD
	default "quark_se_c1000_ble"

endif # BOARD_QUARK_SE_C1000_BLE
```

## boards/arm/quark_se_c1000_ble/quark_se_c1000_ble_defconfig
```kconfig
# SPDX-License-Identifier: Apache-2.0

CONFIG_ARM=y
CONFIG_SOC_FAMILY_NRF=y
CONFIG_SOC_SERIES_NRF51X=y
CONFIG_SOC_NRF51822_QFAA=y
CONFIG_BOARD_QUARK_SE_C1000_BLE=y

# enable GPIO
CONFIG_GPIO=y

# enable uart driver
CONFIG_SERIAL=y
CONFIG_UART_0_NRF_UART=y
```

## boards/arm/quick_feather/Kconfig.board
```kconfig
# Quick Feather board

# Copyright (c) 2020 Antmicro <www.antmicro.com>
# SPDX-License-Identifier: Apache-2.0

config BOARD_QUICK_FEATHER
	bool "QuickLogic Quick Feather target"
	depends on SOC_EOS_S3
```

## boards/arm/quick_feather/Kconfig.defconfig
```kconfig
# QuickLogic Quick Feather board

# Copyright (c) 2020 Antmicro <www.antmicro.com>
# SPDX-License-Identifier: Apache-2.0

if BOARD_QUICK_FEATHER

config BOARD
	default "quick_feather"

endif # BOARD_QUICK_FEATHER
```

## boards/arm/quick_feather/Kconfig.quick_feather
```kconfig
# Copyright (c) 2022 Zephyr Project members and individual contributors
# SPDX-License-Identifier: Apache-2.0

config BOARD_QUICK_FEATHER
	bool
	default y
	select SOC_EOS_S3
```

## boards/arm/quick_feather/quick_feather_defconfig
```kconfig
# Copyright (c) 2020 Antmicro <www.antmicro.com>
# SPDX-License-Identifier: Apache-2.0

CONFIG_ARM_MPU=n
CONFIG_SOC_EOS_S3=y
CONFIG_BOARD_QUICK_FEATHER=y

# system clock
CONFIG_SYS_CLOCK_HW_CYCLES_PER_SEC=61440000
CONFIG_CORTEX_M_SYSTICK=y

# console
CONFIG_SERIAL=y
CONFIG_CONSOLE=y
CONFIG_PRINTK=y
CONFIG_UART_CONSOLE=y

# misc
CONFIG_BOOT_BANNER=y

# EOS S3 Configuartion Manager copies software from external flash to MCU
# memory using preconfigured DMA and execute it there.
# Thus we do not use flash directly.

CONFIG_XIP=n
CONFIG_FLASH=n
CONFIG_FLASH_SIZE=0
CONFIG_FLASH_BASE_ADDRESS=0x0
```

## boards/arm/rak4631_nrf52840/Kconfig.board
```kconfig
# RAKWIRELESS RAK4631 selection

# Copyright (c) 2021 Guillaume Paquet <guillaume.paquet@smile.fr>
# SPDX-License-Identifier: Apache-2.0

config BOARD_RAK4631_NRF52840
	bool "RAK4631 DK NRF52840"
	depends on SOC_NRF52840_QIAA
```

## boards/arm/rak4631_nrf52840/Kconfig.defconfig
```kconfig
# RAKWIRELESS RAK4631 Board configuration

# Copyright (c) 2021 Guillaume Paquet <guillaume.paquet@smile.fr>
# SPDX-License-Identifier: Apache-2.0

config BT_CTLR
	default BT
```

## boards/arm/rak4631_nrf52840/rak4631_nrf52840_defconfig
```kconfig
# SPDX-License-Identifier: Apache-2.0
CONFIG_SOC_SERIES_NRF52X=y
CONFIG_SOC_NRF52840_QIAA=y
CONFIG_BOARD_RAK4631_NRF52840=y

# Enable MPU
CONFIG_ARM_MPU=y

# Enable hardware stack protection
CONFIG_HW_STACK_PROTECTION=y

# Enable RTT
CONFIG_USE_SEGGER_RTT=y

# enable GPIO
CONFIG_GPIO=y

# enable uart driver
CONFIG_SERIAL=y

# enable console
CONFIG_CONSOLE=y
CONFIG_UART_CONSOLE=y

# additional board options
CONFIG_GPIO_AS_PINRESET=y

CONFIG_PINCTRL=y
```

## boards/arm/rak5010_nrf52840/Kconfig.board
```kconfig
# RAKWIRELESS RAK5010 selection

# Copyright (c) 2020 Guillaume Paquet <guillaume.paquet@smile.fr>
# SPDX-License-Identifier: Apache-2.0

config BOARD_RAK5010_NRF52840
	bool "RAK5010 DK NRF52840"
	depends on SOC_NRF52840_QIAA
```

## boards/arm/rak5010_nrf52840/Kconfig.defconfig
```kconfig
# RAKWIRELESS RAK5010 Board configuration

# Copyright (c) 2020 Guillaume Paquet <guillaume.paquet@smile.fr>
# SPDX-License-Identifier: Apache-2.0

config MODEM_QUECTEL_BG9X
	default y

config BT_CTLR
	default BT
```

## boards/arm/raspberrypi_pico/Kconfig.defconfig
```kconfig
# Copyright (c) 2021 Yonatan Schachter
# SPDX-License-Identifier: Apache-2.0

if BOARD_RPI_PICO

config BOARD
	default "raspberrypi_pico"

endif # BOARD_RPI_PICO
```

## boards/arm/raspberrypi_pico/raspberrypi_pico_defconfig
```kconfig
CONFIG_SOC_SERIES_RP2XXX=y
CONFIG_SOC_RP2040=y
CONFIG_SYS_CLOCK_HW_CYCLES_PER_SEC=125000000
CONFIG_RP2_FLASH_W25Q080=y
CONFIG_SERIAL=y
CONFIG_LOG=y
CONFIG_LOG_PRINTK=y
CONFIG_CONSOLE=y
CONFIG_UART_CONSOLE=y
```

## boards/arm/raytac_mdbt50q_db_33_nrf52833/Kconfig
```kconfig
# Raytac MDBT50Q-DB-33 nRF52833 board configuration

# Copyright (c) 2019 Nordic Semiconductor ASA
# SPDX-License-Identifier: Apache-2.0

config BOARD_ENABLE_DCDC
	bool "DCDC mode"
	select SOC_DCDC_NRF52X
	default y
	depends on BOARD_RAYTAC_MDBT50Q_DB_33_NRF52833
```

## boards/arm/raytac_mdbt50q_db_33_nrf52833/Kconfig.board
```kconfig
# Raytac MDBT50Q-DB-33 nRF52833 board configuration

# Copyright (c) 2022 Nordic Semiconductor ASA
# SPDX-License-Identifier: Apache-2.0

config BOARD_RAYTAC_MDBT50Q_DB_33_NRF52833
	bool "Raytac MDBT50Q-DB-33 nRF52833"
	depends on SOC_NRF52833_QIAA
```

## boards/arm/raytac_mdbt50q_db_33_nrf52833/Kconfig.defconfig
```kconfig
# Raytac MDBT50Q-DB-33 NRF52833 board configuration

# Copyright (c) 2022 Raytac Corporation
# SPDX-License-Identifier: Apache-2.0

if BOARD_RAYTAC_MDBT50Q_DB_33_NRF52833

config BOARD
	default "raytac_mdbt50q_db_33_nrf52833"

config BT_CTLR
	default BT

endif
```

## boards/arm/raytac_mdbt50q_db_40/Kconfig.board
```kconfig
# Copyright (c) 2022 Raytac Corporation
# SPDX-License-Identifier: Apache-2.0

config BOARD_RAYTAC_MDBT50Q_DB_40
	bool "Raytac MDBT50Q-DB-40"
	depends on SOC_NRF52840_QIAA
```

## boards/arm/raytac_mdbt50q_db_40_nrf52840/Kconfig.board
```kconfig
# Raytac MDBT50Q-DB-40 nRF52840 board configuration

# Copyright (c) 2022 Raytac Corporation
# SPDX-License-Identifier: Apache-2.0

config BOARD_RAYTAC_MDBT50Q_DB_40_NRF52840
	bool "Raytac MDBT50Q_DB_40_nRF52840"
	depends on SOC_NRF52840_QIAA
```

## boards/arm/raytac_mdbt53_db_40_nrf5340/Kconfig
```kconfig
# Ratac MDBT53-DB-40 nRF5340 board configuration

# Copyright (c) 2019 - 2021 Nordic Semiconductor ASA
# SPDX-License-Identifier: Apache-2.0

if BOARD_RAYTAC_MDBT53_DB_40_NRF5340_CPUAPP || BOARD_RAYTAC_MDBT53_DB_40_NRF5340_CPUAPP_NS

config BOARD_ENABLE_DCDC_APP
	bool "Application MCU DCDC converter"
	select SOC_DCDC_NRF53X_APP
	default y

config BOARD_ENABLE_DCDC_NET
	bool "Network MCU DCDC converter"
	select SOC_DCDC_NRF53X_NET
	default y

config BOARD_ENABLE_DCDC_HV
	bool "High Voltage DCDC converter"
	select SOC_DCDC_NRF53X_HV
	default y

config BOARD_ENABLE_CPUNET
	bool "NRF53 Network MCU"
	select SOC_NRF_GPIO_FORWARDER_FOR_NRF5340 if \
		$(dt_compat_enabled,$(DT_COMPAT_NORDIC_NRF_GPIO_FORWARDER))
	help
	  This option enables releasing the Network 'force off' signal, which
	  as a consequence will power up the Network MCU during system boot.
	  Additionally, the option allocates GPIO pins that will be used by UARTE
	  of the Network MCU.
	  Note: GPIO pin allocation can only be configured by the secure Application
	  MCU firmware, so when this option is used with the non-secure version of
	  the board, the application needs to take into consideration, that the
	  secure firmware image must already have configured GPIO allocation for the
	  Network MCU.
	default y if (BT || NRF_802154_SER_HOST)

config DOMAIN_CPUNET_BOARD
	string
	default "raytac_mdbt53_db_40_nrf5340_cpunet"
	depends on BOARD_ENABLE_CPUNET
	help
	  The board which will be used for CPUNET domain when creating a multi
	  image application where one or more images should be located on
	  another board. For example hci_rpmsg on the nRF5340_cpunet for
	  Bluetooth applications.

endif #  BOARD_RAYTAC_MDBT53_DB_40_NRF5340_CPUAPP || BOARD_RAYTAC_MDBT53_DB_40_NRF5340_CPUAPP_NS

config DOMAIN_CPUAPP_BOARD
	string
	default "raytac_mdbt53_db_40_nrf5340_cpuapp"
	depends on BOARD_RAYTAC_MDBT53_DB_40_NRF5340_CPUNET
	help
	  The board which will be used for CPUAPP domain when creating a multi
	  image application where one or more images should be located on
	  another board.
```

## boards/arm/raytac_mdbt53_db_40_nrf5340/Kconfig.board
```kconfig
# Raytac MDBT53-DB-40 NRF5340 board configuration

# Copyright (c) 2019-2020 Nordic Semiconductor ASA
# SPDX-License-Identifier: Apache-2.0

if SOC_NRF5340_CPUAPP_QKAA

config BOARD_RAYTAC_MDBT53_DB_40_NRF5340_CPUAPP
	bool "Raytac MDBT53-DB-40 nRF5340 Application MCU"

config BOARD_RAYTAC_MDBT53_DB_40_NRF5340_CPUAPP_NS
	bool "Raytac MDBT53-DB-40 nRF5340 Application MCU non-secure"

endif # SOC_NRF5340_CPUAPP_QKAA

config BOARD_RAYTAC_MDBT53_DB_40_NRF5340_CPUNET
	bool "Raytac MDBT53-DB-40 NRF5340 Network MCU"
	depends on SOC_NRF5340_CPUNET_QKAA
```

## boards/arm/raytac_mdbt53_db_40_nrf5340/Kconfig.defconfig
```kconfig
# Raytac MDBT53-DB-40 nRF5340 board configuration

# Copyright (c) 2019-2020 Nordic Semiconductor ASA
# SPDX-License-Identifier: Apache-2.0

if  BOARD_RAYTAC_MDBT53_DB_40_NRF5340_CPUAPP || BOARD_RAYTAC_MDBT53_DB_40_NRF5340_CPUAPP_NS

config BOARD
	default "raytac_mdbt53_db_40_nrf5340_cpuapp"

# By default, if we build for a Non-Secure version of the board,
# enable building with TF-M as the Secure Execution Environment.
config BUILD_WITH_TFM
	default n if BOARD_RAYTAC_MDBT53_DB_40_NRF5340_CPUAPP_NS

if BUILD_WITH_TFM

# By default, if we build with TF-M, instruct build system to
# flash the combined TF-M (Secure) & Zephyr (Non Secure) image
config TFM_FLASH_MERGED_BINARY
	bool
	default n

endif # BUILD_WITH_TFM

# Code Partition:
#
# For the secure version of the board the firmware is linked at the beginning
# of the flash, or into the code-partition defined in DT if it is intended to
# be loaded by MCUboot. If the secure firmware is to be combined with a non-
# secure image (TRUSTED_EXECUTION_SECURE=y), the secure FW image shall always
# be restricted to the size of its code partition.
#
# For the non-secure version of the board, the firmware
# must be linked into the code-partition (non-secure) defined in DT, regardless.
# Apply this configuration below by setting the Kconfig symbols used by
# the linker according to the information extracted from DT partitions.

# SRAM Partition:
#
# If the secure firmware is to be combined with a non-secure image
# (TRUSTED_EXECUTION_SECURE=y), the secure FW image SRAM shall always
# be restricted to the secure image SRAM partition (sram-secure-partition).
# Otherwise (if TRUSTED_EXECUTION_SECURE is not set) the whole zephyr,sram
# may be used by the image.
#
# For the non-secure version of the board, the firmware image SRAM is
# always restricted to the allocated non-secure SRAM partition.
#
# Workaround for not being able to have commas in macro arguments
DT_CHOSEN_Z_CODE_PARTITION := zephyr,code-partition
DT_CHOSEN_Z_SRAM_PARTITION := zephyr,sram-secure-partition

if BOARD_RAYTAC_MDBT53_DB_40_NRF5340_CPUAPP && TRUSTED_EXECUTION_SECURE

config FLASH_LOAD_SIZE
	default $(dt_chosen_reg_size_hex,$(DT_CHOSEN_Z_CODE_PARTITION))

config SRAM_SIZE
	default $(dt_chosen_reg_size_int,$(DT_CHOSEN_Z_SRAM_PARTITION),0,K)

endif # BOARD_RAYTAC_MDBT53_DB_40_NRF5340_CPUAPP && TRUSTED_EXECUTION_SECURE

if BOARD_RAYTAC_MDBT53_DB_40_NRF5340_CPUAPP_NS

config FLASH_LOAD_OFFSET
	default $(dt_chosen_reg_addr_hex,$(DT_CHOSEN_Z_CODE_PARTITION))

config FLASH_LOAD_SIZE
	default $(dt_chosen_reg_size_hex,$(DT_CHOSEN_Z_CODE_PARTITION))

endif # BOARD_RAYTAC_MDBT53_DB_40_NRF5340_CPUAPP_NS

endif # BOARD_RAYTAC_MDBT53_DB_40_NRF5340_CPUAPP || BOARD_RAYTAC_MDBT53_DB_40_NRF5340_CPUAPP_NS

config BOARD
	default "raytac_mdbt53_dv_40_nrf5340_cpunet" if BOARD_RAYTAC_MDBT53_DB_40_NRF5340_CPUNET

config IPM_NRFX
	default IPM

config MBOX_NRFX_IPC
	default MBOX

if BOARD_RAYTAC_MDBT53_DB_40_NRF5340_CPUAPP || BOARD_RAYTAC_MDBT53_DB_40_NRF5340_CPUAPP_NS

choice BT_HCI_BUS_TYPE
	default BT_RPMSG if BT
endchoice

config HEAP_MEM_POOL_SIZE
	default 4096 if BT_RPMSG

endif #  BOARD_RAYTAC_MDBT53_DB_40_NRF5340_CPUAPP || BOARD_RAYTAC_MDBT53_DB_40_NRF5340_CPUAPP_NS

if BOARD_RAYTAC_MDBT53_DB_40_NRF5340_CPUNET

config BT_CTLR
	default y if BT

endif # BOARD_RAYTAC_MDBT53_DB_40_NRF5340_CPUNET
```

## boards/arm/raytac_mdbt53_db_40_nrf5340/raytac_mdbt53_db_40_nrf5340_cpuapp_defconfig
```kconfig
# SPDX-License-Identifier: Apache-2.0

CONFIG_SOC_SERIES_NRF53X=y
CONFIG_SOC_NRF5340_CPUAPP_QKAA=y
CONFIG_BOARD_RAYTAC_MDBT53_DB_40_NRF5340_CPUAPP=y

# Enable MPU
CONFIG_ARM_MPU=y

# Enable hardware stack protection
CONFIG_HW_STACK_PROTECTION=y

# Enable TrustZone-M
CONFIG_ARM_TRUSTZONE_M=y

# enable GPIO
CONFIG_GPIO=y

# Enable uart driver
CONFIG_SERIAL=y

# enable console
CONFIG_CONSOLE=y
CONFIG_UART_CONSOLE=y
```

## boards/arm/raytac_mdbt53v_db_40_nrf5340/raytac_mdbt53v_db_40_nrf5340_cpuapp_ns_defconfig
```kconfig
# SPDX-License-Identifier: Apache-2.0

CONFIG_SOC_SERIES_NRF53X=y
CONFIG_SOC_NRF5340_CPUAPP_QKAA=y
CONFIG_BOARD_RAYTAC_MDBT53V_DB_40_NRF5340_CPUAPP_NS=y

# Enable MPU
CONFIG_ARM_MPU=y

# Enable hardware stack protection
CONFIG_HW_STACK_PROTECTION=y

# Enable TrustZone-M
CONFIG_ARM_TRUSTZONE_M=y

# This Board implies building Non-Secure firmware
CONFIG_TRUSTED_EXECUTION_NONSECURE=y

# enable GPIO
CONFIG_GPIO=y

# Enable uart driver
CONFIG_SERIAL=y

# enable console
CONFIG_CONSOLE=y
CONFIG_UART_CONSOLE=y
```

## boards/arm/rcar_h3_kingfisher/Kconfig.board
```kconfig
# Copyright (c) 2021 IoT.bzh
# SPDX-License-Identifier: Apache-2.0

config BOARD_RCAR_H3_KINGFISHER_CR7
	bool "Cortex-R7 for Renesas H3+Kingfisher"
	depends on SOC_R8A77951
```

## boards/arm/rcar_h3_kingfisher/Kconfig.defconfig
```kconfig
# Copyright (c) 2022 IoT.bzh
# SPDX-License-Identifier: Apache-2.0

if BOARD_RCAR_H3_KINGFISHER_CR7
config BOARD
	default "rcar_h3_kingfisher_cr7"
endif # BOARD_RCAR_H3_KINGFISHER_CR7
```
