## boards/arm/efr32bg_sltb010a/Kconfig.defconfig
```kconfig
# EFR32BG SLTB010A board

# Copyright (c) 2021, Sateesh Kotapati
# SPDX-License-Identifier: Apache-2.0

if BOARD_EFR32BG_SLTB010A

config BOARD
	default "efr32bg_sltb010a"

config CMU_HFXO_FREQ
	default 40000000

config CMU_LFXO_FREQ
	default 32768

endif # BOARD_EFR32BG_SLTB010A
```

## boards/arm/efr32mg_sltb004a/Kconfig
```kconfig
# EFR32MG SLTB004A board configuration

# Copyright (c) 2018 Christian Taedcke, Diego Sueiro
# SPDX-License-Identifier: Apache-2.0

config BOARD_INIT_PRIORITY
	int
	default KERNEL_INIT_PRIORITY_DEFAULT
	depends on BOARD_EFR32MG_SLTB004A
	help
	  Board initialization priority. This must be bigger than
	  GPIO_GECKO_COMMON_INIT_PRIORITY.
```

## boards/arm/efr32mg_sltb004a/Kconfig.board
```kconfig
# SiLabs EFR32MG-SLTB004A (Thunderboard Sense 2)

# Copyright (c) 2018, Diego Sueiro
# SPDX-License-Identifier: Apache-2.0

config BOARD_EFR32MG_SLTB004A
	def_bool "$(BOARD)" = "efr32mg_sltb004a"
	depends on SOC_SERIES_EFR32MG12P
	select SOC_PART_NUMBER_EFR32MG12P332F1024GL125
```

## boards/arm/efr32mg_sltb004a/Kconfig.defconfig
```kconfig
# EFR32MG SLTB004A board

# Copyright (c) 2018, Diego Sueiro
# SPDX-License-Identifier: Apache-2.0

config CMU_HFXO_FREQ
	default 40000000

config CMU_LFXO_FREQ
	default 32768
```

## boards/arm/efr32mg_sltb004a/Kconfig.efr32mg_sltb004a
```kconfig
# Copyright (c) 2022 Zephyr Project members and individual contributors
# SPDX-License-Identifier: Apache-2.0

config BOARD_EFR32MG_SLTB004A
	bool
	default y
	select SOC_SERIES_EFR32MG12P
	select SOC_PART_NUMBER_EFR32MG12P332F1024GL125
```

## boards/arm/efr32xg24_dk2601b/Kconfig
```kconfig
# EFR32XG24 DK2601B board

# Copyright (c) 2022, Silicon Labs
# SPDX-License-Identifier: Apache-2.0

if BOARD_EFR32XG24_DK2601B

module = BOARD_EFR32MG24
module-str = Board Control
source "subsys/logging/Kconfig.template.log_config"

endif # BOARD_EFR32XG24_DK2601B
```

## boards/arm/efr32xg24_dk2601b/Kconfig.board
```kconfig
# EFR32XG24 DK2601B board

# Copyright (c) 2021, Sateesh Kotapati
# SPDX-License-Identifier: Apache-2.0

config BOARD_EFR32XG24_DK2601B
	bool "Silicon Labs BRD2601B (Mighty Gecko Radio Board)"
	depends on SOC_SERIES_EFR32MG24
	select SOC_PART_NUMBER_EFR32MG24B310F1536IM48
```

## boards/arm/efr32xg24_dk2601b/Kconfig.defconfig
```kconfig
# EFR32XG24 DK2601B board

# Copyright (c) 2021, Sateesh Kotapati
# SPDX-License-Identifier: Apache-2.0

if BOARD_EFR32XG24_DK2601B

config BOARD
	default "efr32xg24_dk2601b"

config CMU_HFXO_FREQ
	default 40000000

config CMU_LFXO_FREQ
	default 32768

config FLASH_BASE_ADDRESS
	hex
	default 0x08000000

if SOC_GECKO_USE_RAIL

config FPU
	default y

endif # SOC_GECKO_USE_RAIL

if BT

config FPU
	default y

config MINIMAL_LIBC_MALLOC_ARENA_SIZE
	default 8192

config MAIN_STACK_SIZE
	default 2304

choice BT_HCI_BUS_TYPE
	default BT_SILABS_HCI
endchoice

endif # BT

endif # BOARD_EFR32XG24_DK2601B
```

## boards/arm/efr32xg24_dk2601b/efr32xg24_dk2601b_defconfig
```kconfig
# Copyright (c) 2022 Silicon Labs
# SPDX-License-Identifier: Apache-2.0

CONFIG_SOC_SERIES_EFR32MG24=y
CONFIG_BOARD_EFR32XG24_DK2601B=y
CONFIG_ARM_MPU=y
CONFIG_CONSOLE=y
CONFIG_UART_CONSOLE=y
CONFIG_SERIAL=y
CONFIG_CORTEX_M_SYSTICK=y
CONFIG_GPIO=y
CONFIG_SYS_CLOCK_HW_CYCLES_PER_SEC=76800000
CONFIG_CMU_HFCLK_HFXO=y
CONFIG_SOC_GECKO_EMU_DCDC=y
CONFIG_SOC_GECKO_EMU_DCDC_MODE_ON=y
CONFIG_CMU_HFCLK_LFXO=y
CONFIG_HW_STACK_PROTECTION=y
CONFIG_PINCTRL=y
```

## boards/arm/ehl_pse_crb/Kconfig.board
```kconfig
# Kconfig - INTEL EHL CRB board configuration
#
# Copyright (c) 2021 Intel Corporation.
#
# SPDX-License-Identifier: Apache-2.0

config BOARD_EHL_PSE_CRB
	bool "Intel EHL CRB board"
	depends on SOC_ELKHART_LAKE_PSE
	select SEDI_LIBRARY
```

## boards/arm/ehl_pse_crb/Kconfig.defconfig
```kconfig
# Kconfig - INTEL EHL CRB board configuration
#
# Copyright (c) 2021 Intel Corporation.
#
# SPDX-License-Identifier: Apache-2.0

if BOARD_EHL_PSE_CRB

config BOARD
	default "ehl_pse_crb"

endif # BOARD_EHL_PSE_CRB
```

## boards/arm/ehl_pse_crb/ehl_pse_crb_defconfig
```kconfig
# Copyright (c) 2021 Intel Corporation
#
# SPDX-License-Identifier: Apache-2.0

CONFIG_SOC_ELKHART_LAKE_PSE=y
CONFIG_BOARD_EHL_PSE_CRB=y
CONFIG_ARM_MPU=y
CONFIG_TIMESLICE_SIZE=200
CONFIG_TICKLESS_KERNEL=y
CONFIG_CORTEX_M_SYSTICK=n
CONFIG_PSE_HPET_TIMER=y
CONFIG_HPET_TIMER_BASE_ADDRESS=0x40a00000
CONFIG_HPET_TIMER_IRQ=19
CONFIG_ENABLE_SOC_NMI=y

# Configure IO Peripheral

#UART
#Selecting Uart for Console
#Note:UART driver has to be part of SEDI BSP to support uart console.
CONFIG_PRINTK=y
CONFIG_CONSOLE=y

CONFIG_UART_CONSOLE=y
CONFIG_SERIAL=y
CONFIG_UART_SEDI=y

#Configure float to use the floating point registers
CONFIG_FPU=y

CONFIG_FLASH=n
CONFIG_XIP=n
CONFIG_FLASH_SIZE=0
CONFIG_FLASH_BASE_ADDRESS=0x0
```

## boards/arm/ene_kb1200_evb/Kconfig.board
```kconfig
# Copyright (c) ENE
# SPDX-License-Identifier: Apache-2.0

config BOARD_ENE_KB1200_EVB
	bool "ENE KB1200 EVB Development Board"
	depends on SOC_ENE_KB1200
```

## boards/arm/ene_kb1200_evb/Kconfig.defconfig
```kconfig
# ENE ene_kb1062 board configuration

# Copyright (c) 2023 ENE.
# SPDX-License-Identifier: Apache-2.0

if BOARD_ENE_KB1200_EVB

config BUILD_OUTPUT_BIN
	default y

config BUILD_OUTPUT_HEX
	default y

config BOARD
	default "ene_kb1200_evb"

endif # BOARD_ENE_KB1200_EVB
```

## boards/arm/ene_kb1200_evb/ene_kb1200_evb_defconfig
```kconfig
# Copyright (c) 2023 ENE Technology

CONFIG_SYS_CLOCK_HW_CYCLES_PER_SEC=24000000
CONFIG_SOC_ENE_KB1200=y
CONFIG_BOARD_ENE_KB1200_EVB=y

# enable console & uart driver
CONFIG_SERIAL=y
CONFIG_CONSOLE=y
CONFIG_UART_CONSOLE=y
CONFIG_UART_KB1200=y

# enable GPIO
CONFIG_GPIO_KB1200=y

CONFIG_SCHED_DUMB=y

CONFIG_TICKLESS_KERNEL=y
CONFIG_SYS_CLOCK_TICKS_PER_SEC=4096
```

## boards/arm/ev11l78a/Kconfig.defconfig
```kconfig
# Microchip EV11L78A Board configuration

# Copyright (c) 2023 Meta Platforms, Inc. and its affiliates.
# SPDX-License-Identifier: Apache-2.0

config BOARD
	default "ev11l78a"
	depends on BOARD_EV11L78A
```

## boards/arm/ev11l78a/dts/bindings/microchip,ev11l78a-ensink.yaml
```yaml
# Copyright (c) 2023, Meta Platforms, Inc. and its affiliates.
# SPDX-License-Identifier: Apache-2.0

description: GPIO used to enable the power Sink on the EV11L78A board

compatible: "microchip,ev11l78a-ensink"

properties:
  gpios:
    type: phandle-array
    required: true
    description: |
      GPIO to enable the power sink on the EV11L78A board, output.
```

## boards/arm/ev11l78a/ev11l78a_defconfig
```kconfig
# SPDX-License-Identifier: Apache-2.0

CONFIG_SOC_SERIES_SAMD20=y
CONFIG_SOC_PART_NUMBER_SAMD20E16=y
CONFIG_SOC_ATMEL_SAMD_OSC8M=y
CONFIG_SOC_ATMEL_SAMD_OSC8M_AS_MAIN=y
CONFIG_BOARD_EV11L78A=y
CONFIG_BUILD_OUTPUT_HEX=y
CONFIG_CONSOLE=y
CONFIG_GPIO=y
CONFIG_SERIAL=y
CONFIG_UART_CONSOLE=y
CONFIG_UART_INTERRUPT_DRIVEN=y
```

## boards/arm/fanstel_bt840dk/Kconfig
```kconfig
# Fanstel BT840 DK board configuration

# Copyright (c) 2021 Brian Bradley
# SPDX-License-Identifier: Apache-2.0

config BOARD_ENABLE_DCDC
	bool "Enable DCDC mode"
	select SOC_DCDC_NRF52X
	default y
	depends on BOARD_FANSTEL_BT840DK
```

## boards/arm/fanstel_bt840dk/Kconfig.board
```kconfig
# Fanstel BT840 DK board configuration

# Copyright (c) 2021 Brian Bradley
# SPDX-License-Identifier: Apache-2.0

config BOARD_FANSTEL_BT840DK
	bool "Fanstel BT840 DK"
	depends on SOC_NRF52840_QIAA
```

## boards/arm/fanstel_bt840dk/Kconfig.defconfig
```kconfig
# Fanstel BT840 DK board configuration

# Copyright (c) 2021 Brian Bradley
# SPDX-License-Identifier: Apache-2.0

if BOARD_FANSTEL_BT840DK

config BOARD
	default "fanstel_bt840dk"

if USB

config USB_NRFX
	default y

config USB_DEVICE_STACK
	default y

endif # USB

config BT_CTLR
	default BT

endif # BOARD_FANSTEL_BT840DK
```

## boards/arm/fanstel_ev832x/Kconfig
```kconfig
# Kconfig - Fanstel EV-BT832X board configuration
#
# Copyright (c) 2019 SixOctets Systems
#
# SPDX-License-Identifier: Apache-2.0

if BOARD_FANSTEL_EV832X

config BOARD_ENABLE_DCDC
	bool "Enable DCDC mode"
	select SOC_DCDC_NRF52X
	default y

endif # BOARD_FANSTEL_EV832X
```

## boards/arm/fanstel_ev832x/Kconfig.board
```kconfig
# Kconfig - Fanstel EV-BT832X board configuration
#
# Copyright (c) 2019 SixOctets Systems
#
# SPDX-License-Identifier: Apache-2.0

config  BOARD_FANSTEL_EV832X
	bool "Fanstel EV-BT832X"
	depends on SOC_NRF52832_QFAA
```

## boards/arm/fanstel_ev832x/Kconfig.defconfig
```kconfig
# Kconfig - Fanstel EV-BT832X board configuration
#
# Copyright (c) 2019 SixOctets Systems
#
# SPDX-License-Identifier: Apache-2.0


if BOARD_FANSTEL_EV832X

config BOARD
	default "Fanstel EV-BT832X"

if I2C

config I2C_0
	default y

endif # I2C

if BT_CTLR

config GPIO
	default y

config BT_CTLR_GPIO_PA
	default y

config BT_CTLR_GPIO_LNA
	default y

endif # BT_CTLR

endif # BOARD_FANSTEL_EV832X
```

## boards/arm/fanstel_ev832x/fanstel_ev832x_defconfig
```kconfig
CONFIG_ARM=y
CONFIG_SOC_FAMILY_NRF=y
CONFIG_SOC_SERIES_NRF52X=y
CONFIG_SOC_NRF52832_QFAA=y
CONFIG_BOARD_FANSTEL_EV832X=y

# Enable MPU
CONFIG_ARM_MPU=y

# enable uart driver
CONFIG_SERIAL=y
CONFIG_UART_0_NRF_UART=y

# enable console
CONFIG_CONSOLE=y
CONFIG_UART_CONSOLE=y

# additional board options
CONFIG_GPIO_AS_PINRESET=y

# bluetooth
CONFIG_BT=y
CONFIG_BT_CTLR=y

# PA/LNA
CONFIG_BT_CTLR_GPIO_PA_PIN=17
CONFIG_BT_CTLR_GPIO_LNA_PIN=19
```
