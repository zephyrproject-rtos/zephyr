/*
 * Copyright (c) 2020 Nordic Semiconductor ASA
 *
 * SPDX-License-Identifier: Apache-2.0
 */

/ {
	zephyr,fixture {
		gpio-loopback {
			compatible = "zephyr,fixture,gpio-loopback";
			out-gpios = <&gpio0 22 0>;
			in-gpios = <&gpio0 21 0>;
		};
	};
