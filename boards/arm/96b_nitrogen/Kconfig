## boards/arm/96b_nitrogen/Kconfig.board
```kconfig
# 96Boards NITROGEN board configuration

# Copyright (c) 2016 Linaro Limited.
# SPDX-License-Identifier: Apache-2.0

config BOARD_96B_NITROGEN
	def_bool "$(BOARD)" = "96b_nitrogen"
	depends on SOC_NRF52832_QFAA
```

## boards/arm/96b_nitrogen/Kconfig.defconfig
```kconfig
# Kconfig - 96Boards NITROGEN board configuration
#
# Copyright (c) 2016 Nordic Semiconductor ASA
#
# SPDX-License-Identifier: Apache-2.0

if BOARD_96B_NITROGEN

config BOARD
	default "96b_nitrogen"

if I2C

config I2C_0
	default y

endif # I2C

if SPI

config SPI_1
	default y

endif # SPI

config BT_CTLR
	default BT

endif # BOARD_96B_NITROGEN
```

## boards/arm/96b_stm32_sensor_mez/96b_stm32_sensor_mez_defconfig
```kconfig
# SPDX-License-Identifier: Apache-2.0

CONFIG_SOC_SERIES_STM32F4X=y
CONFIG_SOC_STM32F446XX=y

# 84MHz system clock
CONFIG_SYS_CLOCK_HW_CYCLES_PER_SEC=84000000

# Enable MPU
CONFIG_ARM_MPU=y

# Enable HW stack protection
CONFIG_HW_STACK_PROTECTION=y

CONFIG_SERIAL=y

# console
CONFIG_CONSOLE=y
CONFIG_UART_CONSOLE=y

# enable pinmux
CONFIG_PINMUX=y

# enable GPIO
CONFIG_GPIO=y

# clock configuration
CONFIG_CLOCK_CONTROL=y

# SYSCLK selection
CONFIG_CLOCK_STM32_SYSCLK_SRC_PLL=y

# use HSE as PLL input
CONFIG_CLOCK_STM32_PLL_SRC_HSE=y
CONFIG_CLOCK_STM32_HSE_CLOCK=16000000

# produce 84MHz clock at PLL output
CONFIG_CLOCK_STM32_PLL_M_DIVISOR=8
CONFIG_CLOCK_STM32_PLL_N_MULTIPLIER=84
CONFIG_CLOCK_STM32_PLL_P_DIVISOR=2
CONFIG_CLOCK_STM32_PLL_Q_DIVISOR=8
CONFIG_CLOCK_STM32_AHB_PRESCALER=1

# APB1 clock must not exceed 50MHz limit
CONFIG_CLOCK_STM32_APB1_PRESCALER=2
CONFIG_CLOCK_STM32_APB2_PRESCALER=1
```

## boards/arm/96b_stm32_sensor_mez/Kconfig.board
```kconfig
# 96Boards STM32 Sensor Mezzanine board configuration

# Copyright (c) 2018 Linaro Limited.
# SPDX-License-Identifier: Apache-2.0

config BOARD_96B_STM32_SENSOR_MEZ
	def_bool "$(BOARD)" = "96b_stm32_sensor_mez"
	depends on SOC_STM32F446XX
```

## boards/arm/96b_stm32_sensor_mez/Kconfig.defconfig
```kconfig
# 96Boards STM32 Sensor Mezzanine board configuration

# Copyright (c) 2018 Linaro Limited.
# SPDX-License-Identifier: Apache-2.0

if BOARD_96B_STM32_SENSOR_MEZ

config BOARD
	default "96b_stm32_sensor_mez"

if I2S

# configure PLLI2S to generate a I2SxCLK=128MHz
config I2S_STM32_USE_PLLI2S_ENABLE
	default y

config I2S_STM32_PLLI2S_PLLM
	default 8

config I2S_STM32_PLLI2S_PLLN
	default 192

config I2S_STM32_PLLI2S_PLLR
	default 3

endif # I2S

config SPI_STM32_INTERRUPT
	default y
	depends on SPI

endif # BOARD_96B_STM32_SENSOR_MEZ
```

## boards/arm/96b_wistrio/96b_wistrio_defconfig
```kconfig
CONFIG_SOC_SERIES_STM32L1X=y
CONFIG_SOC_STM32L151XBA=y

# Enable MPU
CONFIG_ARM_MPU=y

# Enable HW stack protection
CONFIG_HW_STACK_PROTECTION=y

# enable uart driver
CONFIG_SERIAL=y

# enable GPIO
CONFIG_GPIO=y

# Enable Clocks
CONFIG_CLOCK_CONTROL=y

# console
CONFIG_CONSOLE=y
CONFIG_UART_CONSOLE=y

# enable pin controller
CONFIG_PINCTRL=y
```

## boards/arm/96b_wistrio/Kconfig.96b_wistrio
```kconfig
# Copyright (c) 2022 Zephyr Project members and individual contributors
# SPDX-License-Identifier: Apache-2.0

config BOARD_96B_WISTRIO
	bool
	default y
	select SOC_SERIES_STM32L1X
	select SOC_STM32L151XBA
```

## boards/arm/96b_wistrio/Kconfig.board
```kconfig
# 96boards WisTrio board configuration

# Copyright (c) 2019 Linaro Ltd.
# SPDX-License-Identifier: Apache-2.0

config BOARD_96B_WISTRIO
	def_bool "$(BOARD)" = "96b_wistrio"
	depends on SOC_STM32L151XBA
```

## boards/arm/96b_wistrio/Kconfig.defconfig
```kconfig
# 96boards WisTrio board configuration

# Copyright (c) 2019 Linaro Ltd.
# SPDX-License-Identifier: Apache-2.0

config REGULATOR
	default y if LORA
```

## boards/arm/acn52832/acn52832_defconfig
```kconfig
# SPDX-License-Identifier: Apache-2.0

CONFIG_SOC_SERIES_NRF52X=y
CONFIG_SOC_NRF52832_QFAA=y
CONFIG_BOARD_ACN52832=y

# Enable MPU
CONFIG_ARM_MPU=y

# enable GPIO
CONFIG_GPIO=y

# enable uart driver
CONFIG_SERIAL=y

# enable console
CONFIG_CONSOLE=y
CONFIG_UART_CONSOLE=y

# Enable P0_21 as RST
CONFIG_GPIO_AS_PINRESET=y

CONFIG_PINCTRL=y
```

## boards/arm/actinius_icarus/Kconfig
```kconfig
# Actinius Icarus board configuration

# Copyright (c) 2019 Actinius
# SPDX-License-Identifier: Apache-2.0

if BOARD_ACTINIUS_ICARUS || BOARD_ACTINIUS_ICARUS_NS

module = BOARD_ICARUS
module-str = Board Control
source "subsys/logging/Kconfig.template.log_config"

endif # BOARD_ACTINIUS_ICARUS || BOARD_ACTINIUS_ICARUS_NS
```

## boards/arm/actinius_icarus/Kconfig.actinius_icarus
```kconfig
# Copyright (c) 2022 Zephyr Project members and individual contributors
# SPDX-License-Identifier: Apache-2.0

config BOARD_ACTINIUS_ICARUS
	bool
	default y
	select SOC_SERIES_NRF91X
	select SOC_NRF9160_SICA
```

## boards/arm/actinius_icarus/Kconfig.board
```kconfig
# Actinius Icarus board configuration

# Copyright (c) 2019 Actinius
# SPDX-License-Identifier: Apache-2.0

if SOC_NRF9160_SICA

config BOARD_ACTINIUS_ICARUS
	def_bool "$(BOARD)" = "actinius_icarus"

config BOARD_ACTINIUS_ICARUS_NS
	def_bool "$(BOARD)" = "actinius_icarus_ns"

endif # SOC_NRF9160_SICA
```

## boards/arm/actinius_icarus/dts/bindings/actinius-charger-enable.yaml
```yaml
# Copyright (c) 2022 Actinius B.V.
# SPDX-License-Identifier: Apache-2.0

description: |
  The Icarus IoT Board v2 provides the user with an option to disable the
  charger or to leave it on auto. The option can be changed by changing
  the `charger` property in the associated dt node to `auto`
  or `disabled`.

compatible: "actinius-charger-enable"

include: base.yaml

properties:
    gpios:
      type: phandle-array
      required: true
      description: Pin used to enable/disable the charger

    charger:
      type: string
      required: true
      enum:
        - "auto"
        - "disabled"
      description: Charger enable choice (auto or disabled)
```

## boards/arm/actinius_icarus/dts/bindings/sim-select.yaml
```yaml
# Copyright (c) 2022 Nordic Semiconductor ASA
# SPDX-License-Identifier: Apache-2.0

description: |
  The Icarus boards provide the user with 2 options regarding SIM usage for
  LTE-M/NB-IoT communication. Either using the on-board eSIM or using an
  external nano-SIM. The SIM can be selected using the SIM select pin given by
  the sim-gpios property by setting it to 0 (eSIM) or to 1 (external nano-SIM).

compatible: "sim-select"

include: base.yaml

properties:
    sim-gpios:
      type: phandle-array
      required: true
      description: Pin used to select the SIM

    sim:
      type: string
      required: true
      enum:
        - "esim"
        - "external"
      description: SIM choice (eSIM or external nano-SIM)
```

## boards/arm/actinius_icarus_bee/Kconfig
```kconfig
# Actinius Icarus board configuration

# Copyright (c) 2021 Actinius
# SPDX-License-Identifier: Apache-2.0

module = BOARD_ICARUS_BEE
module-str = Board Control
source "subsys/logging/Kconfig.template.log_config"
```

## boards/arm/actinius_icarus_bee/Kconfig.board
```kconfig
# Actinius Icarus Bee board configuration

# Copyright (c) 2021 Actinius
# SPDX-License-Identifier: Apache-2.0

if SOC_NRF9160_SICA

config BOARD_ACTINIUS_ICARUS_BEE
	bool "Actinius Icarus Bee"

config BOARD_ACTINIUS_ICARUS_BEE_NS
	bool "Actinius Icarus Bee Non-Secure"

endif # SOC_NRF9160_SICA
```

## boards/arm/actinius_icarus_som/Kconfig
```kconfig
# Actinius Icarus SoM board configuration

# Copyright (c) 2021 Actinius
# SPDX-License-Identifier: Apache-2.0

module = BOARD_ICARUS_SOM
module-str = Board Control
source "subsys/logging/Kconfig.template.log_config"
```

## boards/arm/actinius_icarus_som/Kconfig.board
```kconfig
# Actinius Icarus SoM board configuration

# Copyright (c) 2021 Actinius
# SPDX-License-Identifier: Apache-2.0

if SOC_NRF9160_SICA

config BOARD_ACTINIUS_ICARUS_SOM
	bool "Actinius Icarus SoM"

config BOARD_ACTINIUS_ICARUS_SOM_NS
	bool "Actinius Icarus SoM Non-Secure"

endif # SOC_NRF9160_SICA
```

## boards/arm/actinius_icarus_som/dts/bindings/actinius-sim-select.yaml
```yaml
# Copyright (c) 2022 Nordic Semiconductor ASA
# SPDX-License-Identifier: Apache-2.0

description: |
  The Icarus boards provide the user with 2 options regarding SIM usage for
  LTE-M/NB-IoT communication. Either using the on-board eSIM or using an
  external nano-SIM. The SIM can be selected by changing the `sim` property
  of the `sim_select` dt node to `esim` or `external`.

compatible: "actinius-sim-select"

include: base.yaml

properties:
  sim-gpios:
    type: phandle-array
    required: true
    description: Pin used to select the SIM

  sim:
    type: string
    required: true
    enum:
      - "esim"
      - "external"
    description: SIM choice (eSIM or external nano-SIM)
```

## boards/arm/actinius_icarus_som_dk/Kconfig.board
```kconfig
# Actinius Icarus SoM DK board configuration

# Copyright (c) 2022 Actinius
# SPDX-License-Identifier: Apache-2.0

if SOC_NRF9160_SICA

config BOARD_ACTINIUS_ICARUS_SOM_DK
	bool "Actinius Icarus SoM DK"

config BOARD_ACTINIUS_ICARUS_SOM_DK_NS
	bool "Actinius Icarus SoM DK Non-Secure"

endif # SOC_NRF9160_SICA
```

## boards/arm/adafruit_clue_nrf52840/Kconfig.board
```kconfig
# Adafruit Feather nRF52840 Express board configuration

# Copyright (c) 2020 Tobias Svehagen
# SPDX-License-Identifier: Apache-2.0

config BOARD_ADAFRUIT_CLUE_NRF52840
	bool "Adafruit Clue nRF52840 Express"
	depends on SOC_NRF52840_QIAA
```

## boards/arm/adafruit_clue_nrf52840/Kconfig.defconfig
```kconfig
# Adafruit Feather nRF52840 Express board configuration

# Copyright (c) 2020 Tobias Svehagen
# SPDX-License-Identifier: Apache-2.0

if BOARD_ADAFRUIT_CLUE_NRF52840

config BOARD
	default "adafruit_clue_nrf52840"

#if USB

config USB_NRFX
	default y

config USB_DEVICE_STACK
	default y

# Enable UART driver, needed for CDC ACM
config SERIAL
	default USB_CDC_ACM

config UART_INTERRUPT_DRIVEN
	default USB_CDC_ACM

#endif # USB

config BT_CTLR
	default BT


if DISPLAY

config SPI
	default y

config ST7789V
	default y

choice ST7789V_PIXEL_FORMAT
	default ST7789V_RGB888 if SHIELD_ST7789V_TL019FQV01
	default ST7789V_RGB565 if SHIELD_ST7789V_WAVESHARE_240X240
endchoice

if LVGL

config LVGL_DISPLAY_DEV_NAME
	default "ST7789V"

config LVGL_HOR_RES_MAX
	default 240
	
config LVGL_VER_RES_MAX
	default 240
	
config LVGL_BITS_PER_PIXEL
	default 16

choice LVGL_COLOR_DEPTH
	default LVGL_COLOR_DEPTH_16
endchoice

config LVGL_COLOR_16_SWAP
	default y

endif # LVGL

endif # DISPLAY

endif # BOARD_ADAFRUIT_CLUE_NRF52840
```

## boards/arm/adafruit_clue_nrf52840/adafruit_clue_nrf52840_defconfig
```kconfig
# SPDX-License-Identifier: Apache-2.0

CONFIG_SOC_SERIES_NRF52X=y
CONFIG_SOC_NRF52840_QIAA=y
CONFIG_BOARD_ADAFRUIT_CLUE_NRF52840=y

# Enable MPU
CONFIG_ARM_MPU=y

# enable GPIO
CONFIG_GPIO=y

# enable uart driver
CONFIG_SERIAL=y

# enable console
CONFIG_CONSOLE=y
#CONFIG_UART_CONSOLE=y
CONFIG_USB_UART_CONSOLE=y

# additional board options
CONFIG_GPIO_AS_PINRESET=y
CONFIG_NFCT_PINS_AS_GPIOS=y

# move for Adafruit U2F bootloader and softdevice
CONFIG_USE_DT_CODE_PARTITION=y
CONFIG_ROM_START_OFFSET=26000

# clock control
CONFIG_CLOCK_CONTROL_NRF_K32SRC_RC=y
CONFIG_CLOCK_CONTROL_NRF_K32SRC_250PPM=y
CONFIG_NRFX_CLOCK_LFXO_TWO_STAGE_ENABLED=n

# USB
CONFIG_USB=y
CONFIG_USB_CDC_ACM=y

# during development
CONFIG_DEBUG_OPTIMIZATIONS=y
CONFIG_ASSERT=y

# DISPLAY
CONFIG_DISPLAY=y

# RTT instead of UART
#CONFIG_USE_SEGGER_RTT=y
#CONFIG_LOG_BACKEND_RTT=y
#CONFIG_RTT_CONSOLE=y
#CONFIG_SHELL_BACKEND_RTT=y
#CONFIG_UART_RTT=y
```
