/*
 * Copyright (c) 2017, embedjournal.com
 *
 * SPDX-License-Identifier: Apache-2.0
 */

/dts-v1/;
#include "stm32_min_dev.dtsi"

/ {
	model = "STM32 Minimum Development Board (Blue)";
	compatible = "stm32_min_dev_blue", "st,stm32f103c8";

	leds {
		led: led {
			gpios = <&gpioc 13 GPIO_ACTIVE_LOW>;
		};
	};
};
