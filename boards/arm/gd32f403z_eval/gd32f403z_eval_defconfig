## boards/arm/gd32f403z_eval/gd32f403z_eval_defconfig
```kconfig
# Copyright (c) 2021, ATL Electronics
# SPDX-License-Identifier: Apache-2.0

CONFIG_SOC_SERIES_GD32F403=y
CONFIG_SOC_GD32F403=y
CONFIG_BOARD_GD32F403Z_EVAL=y

CONFIG_ARM_MPU=y
CONFIG_HW_STACK_PROTECTION=y

CONFIG_CONSOLE=y
CONFIG_UART_CONSOLE=y
CONFIG_SERIAL=y

CONFIG_GPIO=y
```

## boards/arm/gd32f407v_start/Kconfig.board
```kconfig
# Copyright (c) 2022, TOKITA Hiroshi <tokita.hiroshi@gmail.com>
# SPDX-License-Identifier: Apache-2.0

config BOARD_GD32F407V_START
	bool "GigaDevice GD32F407V-START"
	depends on SOC_GD32F407
```

## boards/arm/gd32f407v_start/Kconfig.defconfig
```kconfig
# Copyright (c) 2022, TOKITA Hiroshi <tokita.hiroshi@gmail.com>
# SPDX-License-Identifier: Apache-2.0

if BOARD_GD32F407V_START

config BOARD
	default "gd32f407v_start"

endif # BOARD_GD32F407V_START
```

## boards/arm/gd32f407v_start/Kconfig.gd32f407v_start
```kconfig
# Copyright (c) 2022 Zephyr Project members and individual contributors
# SPDX-License-Identifier: Apache-2.0

config BOARD_GD32F407V_START
	bool
	default y
	select SOC_SERIES_GD32F4XX
	select SOC_GD32F407
```

## boards/arm/gd32f450i_eval/Kconfig.board
```kconfig
# Copyright (c) 2021, Teslabs Engineering S.L.
# SPDX-License-Identifier: Apache-2.0

config BOARD_GD32F450I_EVAL
	bool "GigaDevice GD32F450I-EVAL"
	depends on SOC_GD32F450
```

## boards/arm/gd32f450i_eval/Kconfig.defconfig
```kconfig
# Copyright (c) 2021 Teslabs Engineering S.L.
# SPDX-License-Identifier: Apache-2.0

if BOARD_GD32F450I_EVAL

config BOARD
	default "gd32f450i_eval"

endif # BOARD_GD32F450I_EVAL
```

## boards/arm/gd32f450i_eval/gd32f450i_eval_defconfig
```kconfig
# Copyright (c) 2021, Teslabs Engineering S.L.
# SPDX-License-Identifier: Apache-2.0

CONFIG_SOC_SERIES_GD32F4XX=y
CONFIG_SOC_GD32F450=y
CONFIG_BOARD_GD32F450I_EVAL=y

CONFIG_ARM_MPU=y
CONFIG_HW_STACK_PROTECTION=y
CONFIG_CORTEX_M_SYSTICK=y

CONFIG_CONSOLE=y
CONFIG_UART_CONSOLE=y
CONFIG_SERIAL=y

CONFIG_GPIO=y
```

## boards/arm/gd32f450v_start/Kconfig.board
```kconfig
# Copyright (c) 2022, Teslabs Engineering S.L.
# SPDX-License-Identifier: Apache-2.0

config BOARD_GD32F450V_START
	bool "GigaDevice GD32F450V-START"
	depends on SOC_GD32F450
```

## boards/arm/gd32f450v_start/Kconfig.defconfig
```kconfig
# Copyright (c) 2022 Teslabs Engineering S.L.
# SPDX-License-Identifier: Apache-2.0

if BOARD_GD32F450V_START

config BOARD
	default "gd32f450v_start"

endif # BOARD_GD32F450V_START
```

## boards/arm/gd32f450v_start/gd32f450v_start_defconfig
```kconfig
# Copyright (c) 2022, Teslabs Engineering S.L.
# SPDX-License-Identifier: Apache-2.0

CONFIG_SOC_SERIES_GD32F4XX=y
CONFIG_SOC_GD32F450=y
CONFIG_BOARD_GD32F450V_START=y

CONFIG_ARM_MPU=y
CONFIG_HW_STACK_PROTECTION=y

CONFIG_CONSOLE=y
CONFIG_UART_CONSOLE=y
CONFIG_SERIAL=y

CONFIG_GPIO=y
```

## boards/arm/gd32f450z_eval/Kconfig.board
```kconfig
# Copyright (c) 2022, Rtone.
# SPDX-License-Identifier: Apache-2.0

config BOARD_GD32F450Z_EVAL
	bool "GigaDevice GD32F450Z-EVAL"
	depends on SOC_GD32F450
```

## boards/arm/gd32f450z_eval/Kconfig.defconfig
```kconfig
# Copyright (c) 2022, Rtone.
# SPDX-License-Identifier: Apache-2.0

if BOARD_GD32F450Z_EVAL

config BOARD
	default "gd32f450z_eval"

endif # BOARD_GD32F450Z_EVAL
```

## boards/arm/gd32f470i_eval/Kconfig.board
```kconfig
# Copyright (c) 2022, Rtone.
# SPDX-License-Identifier: Apache-2.0

config BOARD_GD32F470I_EVAL
	bool "GigaDevice GD32F470I-EVAL"
	depends on SOC_GD32F470
```

## boards/arm/gd32f470i_eval/Kconfig.defconfig
```kconfig
# Copyright (c) 2022, Rtone.
# SPDX-License-Identifier: Apache-2.0

if BOARD_GD32F470I_EVAL

config BOARD
	default "gd32f470i_eval"

endif # BOARD_GD32F470I_EVAL
```

## boards/arm/gd32f470i_eval/gd32f470i_eval_defconfig
```kconfig
# Copyright (c) 2022, Rtone.
# SPDX-License-Identifier: Apache-2.0

CONFIG_SOC_SERIES_GD32F4XX=y
CONFIG_SOC_GD32F470=y
CONFIG_BOARD_GD32F470I_EVAL=y

CONFIG_ARM_MPU=y
CONFIG_HW_STACK_PROTECTION=y

CONFIG_CONSOLE=y
CONFIG_UART_CONSOLE=y
CONFIG_SERIAL=y

CONFIG_GPIO=y
```

## boards/arm/gd32l233r_eval/Kconfig.board
```kconfig
# Copyright (c) 2022 BrainCo Inc.
# SPDX-License-Identifier: Apache-2.0

config BOARD_GD32L233R_EVAL
	bool "GigaDevice GD32L233R Evaluation Kit"
	depends on SOC_GD32L233
```

## boards/arm/gd32l233r_eval/Kconfig.defconfig
```kconfig
# Copyright (c) 2022 BrainCo Inc.
# SPDX-License-Identifier: Apache-2.0

if BOARD_GD32L233R_EVAL

config BOARD
	default "gd32l233r_eval"

endif # BOARD_GD32L233R_EVAL
```

## boards/arm/gd32l233r_eval/gd32l233r_eval_defconfig
```kconfig
# Copyright (c) 2022 BrainCo Inc.
# SPDX-License-Identifier: Apache-2.0

CONFIG_SOC_SERIES_GD32L23X=y
CONFIG_SOC_GD32L233=y
CONFIG_BOARD_GD32L233R_EVAL=y

CONFIG_SERIAL=y
CONFIG_CONSOLE=y
CONFIG_UART_CONSOLE=y
```

## boards/arm/google_dragonclaw/google_dragonclaw_defconfig
```kconfig
# Copyright (c) 2022 Google Inc
# SPDX-License-Identifier: Apache-2.0

CONFIG_SOC_SERIES_STM32F4X=y
CONFIG_SOC_STM32F412CX=y
CONFIG_BOARD_GOOGLE_DRAGONCLAW=y

# Serial Drivers
CONFIG_SERIAL=y
CONFIG_UART_INTERRUPT_DRIVEN=y

# Console
CONFIG_CONSOLE=y
CONFIG_UART_CONSOLE=y

# GPIO Controller
CONFIG_GPIO=y

# Clock Controller
CONFIG_CLOCK_CONTROL=y

# Pin Controller
CONFIG_PINCTRL=y

# Enable MPU and HW stack protection
CONFIG_ARM_MPU=y
CONFIG_HW_STACK_PROTECTION=y
```

## boards/arm/google_kukui/Kconfig.board
```kconfig
# Google Kukui EC

# Copyright 2019 The Chromium OS Authors
# SPDX-License-Identifier: Apache-2.0

config BOARD_GOOGLE_KUKUI
	bool "Google Kukui EC"
	depends on SOC_STM32F098XX
	help
	  This is the EC (Embedded Controller) inside a Lenovo Chromebook
	  Duet and 10e Chromebook Tablet. The EC handles battery charging,
	  keyboard scanning, USB Power Delivery and sensors.

	  So far for Zephyr only a simple serial console and I2C are supported.
```

## boards/arm/google_kukui/Kconfig.defconfig
```kconfig
# Google Kukui EC

# Copyright 2019 The Chromium OS Authors
# SPDX-License-Identifier: Apache-2.0

if BOARD_GOOGLE_KUKUI

config BOARD
	default "google_kukui"

endif # BOARD_GOOGLE_KUKUI
```

## boards/arm/google_kukui/Kconfig.google_kukui
```kconfig
# Copyright (c) 2022 Zephyr Project members and individual contributors
# SPDX-License-Identifier: Apache-2.0

config BOARD_GOOGLE_KUKUI
	bool
	default y
	select SOC_SERIES_STM32F0X
	select SOC_STM32F098XX
```

## boards/arm/google_kukui/google_kukui_defconfig
```kconfig
# SPDX-License-Identifier: Apache-2.0

# Zephyr Kernel Configuration
CONFIG_SOC_SERIES_STM32F0X=y

# Platform Configuration
CONFIG_SOC_STM32F098XX=y
CONFIG_BOARD_GOOGLE_KUKUI=y

# Serial Drivers
CONFIG_SERIAL=y
CONFIG_UART_INTERRUPT_DRIVEN=y

# Enable console
CONFIG_CONSOLE=y
CONFIG_UART_CONSOLE=y

# GPIO Controller
CONFIG_GPIO=y

# Enable Clocks
CONFIG_CLOCK_CONTROL=y

# enable pin controller
CONFIG_PINCTRL=y
```

## boards/arm/google_twinkie_v2/Kconfig.board
```kconfig
# Copyright 2023 The ChromiumOS Authors
# SPDX-License-Identifier: Apache-2.0

config BOARD_GOOGLE_TWINKIE_V2
	bool "Google Twinkie V2 Board"
	depends on SOC_STM32G0B1XX
```

## boards/arm/google_twinkie_v2/Kconfig.defconfig
```kconfig
# Google Twinkie V2 board configuration

# Copyright 2022 The Chromium OS Authors
# SPDX-License-Identifier: Apache-2.0

if BOARD_GOOGLE_TWINKIE_V2

config BOARD
	default "google_twinkie_v2"

endif # BOARD_GOOGLE_TWINKIE_V2
```
