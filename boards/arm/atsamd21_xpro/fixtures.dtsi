/*
 * Copyright (c) 2020 Nordic Semiconductor ASA
 *
 * SPDX-License-Identifier: Apache-2.0
 */

/ {
	zephyr,fixture {
		gpio-loopback {
			compatible = "zephyr,fixture,gpio-loopback";
			out-gpios = <&portb 6 0>; /* EXT1.5 */
			in-gpios = <&portb 7 0>;  /* EXT1.6 */
		};
	};
};
