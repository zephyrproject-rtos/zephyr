## boards/arm/segger_trb_stm32f407/segger_trb_stm32f407_defconfig
```kconfig
# SPDX-License-Identifier: Apache-2.0

CONFIG_SOC_SERIES_STM32F4X=y
CONFIG_SOC_STM32F407XE=y

# Enable MPU
CONFIG_ARM_MPU=y

# Enable HW stack protection
CONFIG_HW_STACK_PROTECTION=y

# Enable RTT
CONFIG_USE_SEGGER_RTT=y

CONFIG_CONSOLE=y
CONFIG_RTT_CONSOLE=y

# no serial port
CONFIG_SERIAL=n
CONFIG_UART_STM32=n

# enable GPIO
CONFIG_GPIO=y

# Enable Clocks
CONFIG_CLOCK_CONTROL=y

# enable pin controller
CONFIG_PINCTRL=y
```

## boards/arm/sensortile_box/Kconfig.board
```kconfig
# SensorTile.box development board

# Copyright (c) 2019 STMicroelectronics
# SPDX-License-Identifier: Apache-2.0

config BOARD_SENSORTILE_BOX
	def_bool "$(BOARD)" = "sensortile_box"
	depends on SOC_STM32L4R9XX
```

## boards/arm/sensortile_box/Kconfig.defconfig
```kconfig
# SensorTile.box board configuration

# Copyright (c) 2019 STMicroelectronics
# SPDX-License-Identifier: Apache-2.0

if SPI

config SPI_STM32_INTERRUPT
	default y

endif # SPI
```

## boards/arm/sensortile_box/sensortile_box_defconfig
```kconfig
# SPDX-License-Identifier: Apache-2.0

CONFIG_SOC_SERIES_STM32L4X=y
CONFIG_SOC_STM32L4R9XX=y

# enable uart driver
CONFIG_SERIAL=y

# Enable GPIO
CONFIG_GPIO=y

# Enable Clocks
CONFIG_CLOCK_CONTROL=y

# Console
CONFIG_CONSOLE=y
CONFIG_UART_CONSOLE=y

# Enable MPU
CONFIG_ARM_MPU=y

# Enable HW stack protection
CONFIG_HW_STACK_PROTECTION=y

# enable pin controller
CONFIG_PINCTRL=y
```

## boards/arm/sensortile_box_pro/Kconfig.board
```kconfig
# SENSORTILE_BOX_PRO board configuration

# Copyright (c) 2023 STMicroelectronics
# SPDX-License-Identifier: Apache-2.0

config BOARD_SENSORTILE_BOX_PRO
	bool "SENSORTILE_BOX_PRO Board"
	depends on SOC_STM32U585XX
```

## boards/arm/sensortile_box_pro/Kconfig.defconfig
```kconfig
# SENSORTILE_BOX_PRO board configuration

# Copyright (c) 2023 STMicroelectronics
# SPDX-License-Identifier: Apache-2.0

if BOARD_SENSORTILE_BOX_PRO

config BOARD
	default "sensortile_box_pro"

config SPI_STM32_INTERRUPT
	default y
	depends on SPI

if LOG

# Logger cannot use itself to log
choice USB_CDC_ACM_LOG_LEVEL_CHOICE
	default USB_CDC_ACM_LOG_LEVEL_OFF
endchoice

endif # LOG

endif # BOARD_SENSORTILE_BOX_PRO
```

## boards/arm/sensortile_box_pro/sensortile_box_pro_defconfig
```kconfig
# SPDX-License-Identifier: Apache-2.0

CONFIG_SOC_SERIES_STM32U5X=y
CONFIG_SOC_STM32U585XX=y

# Enable MPU
CONFIG_ARM_MPU=y

# Enable hardware stack protection
CONFIG_HW_STACK_PROTECTION=y

# enable GPIO
CONFIG_GPIO=y

# Enable Clocks
CONFIG_CLOCK_CONTROL=y

# config USB and USB console
CONFIG_SERIAL=y
CONFIG_CONSOLE=y
CONFIG_UART_CONSOLE=y
CONFIG_UART_LINE_CTRL=y
CONFIG_UART_INTERRUPT_DRIVEN=y

# Comment out following USB config lines when
# switching console to UART
CONFIG_USB_DEVICE_STACK=y
CONFIG_USB_DEVICE_VID=0x0483
CONFIG_USB_DEVICE_PID=0x1235
CONFIG_USB_DEVICE_PRODUCT="Zephyr CDC SensorTile.box PRO"
CONFIG_USB_DEVICE_INITIALIZE_AT_BOOT=n

# enable pin controller
CONFIG_PINCTRL=y

# LSE defined as LPTIM clock source by the DTS
CONFIG_STM32_LPTIM_CLOCK_LSE=y
```

## boards/arm/serpente/Kconfig.board
```kconfig
# Serpente board configuration
# Copyright (c) 2020 Alexander Falb <fal3xx@gmail.com>
# SPDX-License-Identifier: Apache-2.0

config BOARD_SERPENTE
	bool "Serpente"
	depends on SOC_PART_NUMBER_SAMD21E18A
```

## boards/arm/serpente/Kconfig.serpente
```kconfig
# Copyright (c) 2022 Zephyr Project members and individual contributors
# SPDX-License-Identifier: Apache-2.0

config BOARD_SERPENTE
	bool
	default y
	select SOC_SERIES_SAMD21
	select SOC_PART_NUMBER_SAMD21E18A
```

## boards/arm/serpente/serpente_defconfig
```kconfig
# SPDX-License-Identifier: Apache-2.0

CONFIG_CONSOLE=y
CONFIG_GPIO=y
CONFIG_UART_CONSOLE=y
CONFIG_UART_INTERRUPT_DRIVEN=y
CONFIG_SERIAL=y
CONFIG_BOOTLOADER_BOSSA=y
CONFIG_BOOTLOADER_BOSSA_ADAFRUIT_UF2=y
```

## boards/arm/smartguardcom/Kconfig.board
```kconfig
# Smart Guard Com board configuration

# Copyright (c) 2021 RealTime Engineering AG
# SPDX-License-Identifier: Apache-2.0

config BOARD_SMARTGUARDCOM
	bool "Smart Guard Com Board"
	depends on SOC_STM32H743XX
```

## boards/arm/smartguardcom/Kconfig.defconfig
```kconfig
# Smart Guard Com board configuration

# Copyright (c) 2021 RealTime Engineering AG
# SPDX-License-Identifier: Apache-2.0

if BOARD_SMARTGUARDCOM

config BOARD
	default "smartguardcom"

if NETWORKING

config NET_L2_ETHERNET
	default y

endif # NETWORKING

endif # BOARD_SMARTGUARDCOM
```

## boards/arm/sparkfun_micromod_stm32/Kconfig.board
```kconfig
# Sparkfun MicroMod STM32 Processor

# Copyright (c) 2022 Alvaro Viebrantz
# SPDX-License-Identifier: Apache-2.0

config BOARD_SPARKFUN_MICROMOD_STM32
	bool "Sparkfun MicroMod STM32 Processor"
	depends on SOC_STM32F405XG
```

## boards/arm/sparkfun_micromod_stm32/Kconfig.defconfig
```kconfig
# Sparkfun MicroMod STM32 Processor

# Copyright (c) 2022 Alvaro Viebrantz
# SPDX-License-Identifier: Apache-2.0

if BOARD_SPARKFUN_MICROMOD_STM32

config BOARD
	default "sparkfun_micromod_stm32"

endif # BOARD_SPARKFUN_MICROMOD_STM32
```

## boards/arm/sparkfun_pro_micro_rp2040/Kconfig.board
```kconfig
# Copyright (c) 2021 Pete Johanson
# SPDX-License-Identifier: Apache-2.0

config BOARD_SPARKFUN_PRO_MICRO_RP2040
	bool "Sparkfun Pro-Micro RP2040 Board"
	depends on SOC_RP2040
```

## boards/arm/sparkfun_pro_micro_rp2040/Kconfig.defconfig
```kconfig
# Copyright (c) 2021 Pete Johanson
# SPDX-License-Identifier: Apache-2.0

if BOARD_SPARKFUN_PRO_MICRO_RP2040

config BOARD
	default "sparkfun_pro_micro_rp2040"

config RP2_FLASH_W25Q080
	default y

endif # BOARD_SPARKFUN_PRO_MICRO_RP2040
```

## boards/arm/sparkfun_pro_micro_rp2040/sparkfun_pro_micro_rp2040_defconfig
```kconfig
# SPDX-License-Identifier: Apache-2.0

CONFIG_SOC_SERIES_RP2XXX=y
CONFIG_SOC_RP2040=y
CONFIG_BOARD_SPARKFUN_PRO_MICRO_RP2040=y

CONFIG_SYS_CLOCK_HW_CYCLES_PER_SEC=125000000
CONFIG_RESET=y

# enable uart driver
CONFIG_SERIAL=y
CONFIG_UART_INTERRUPT_DRIVEN=y

# enable console
CONFIG_CONSOLE=y
CONFIG_UART_CONSOLE=y

# Code partition needed to target the correct flash range
CONFIG_USE_DT_CODE_PARTITION=y

# Output UF2 by default, native bootloader supports it.
CONFIG_BUILD_OUTPUT_UF2=y
```

## boards/arm/sparkfun_thing_plus_nrf9160/Kconfig.board
```kconfig
# Sparkfun nRF9160 Thing Plus configuration

# Copyright (c) 2018-2020 Nordic Semiconductor ASA
# Copyright (c) 2020 Circuit Dojo LLC
# SPDX-License-Identifier: Apache-2.0

if SOC_NRF9160_SICA

config BOARD_SPARKFUN_THING_PLUS_NRF9160
	bool "Sparkfun nRF9160 Thing Plus"
	# The GPIO driver is required by this board's initialization code
	# (board.c), so it is forced here to be enabled always, not only
	# enabled by default (in defconfig).
	select GPIO

config BOARD_SPARKFUN_THING_PLUS_NRF9160_NS
	bool "Sparkfun nRF9160 Thing Plus non-secure"
	# The GPIO driver is required by this board's initialization code
	# (board.c), so it is forced here to be enabled always, not only
	# enabled by default (in defconfig).
	select GPIO

endif # SOC_NRF9160_SICA
```

## boards/arm/sparkfun_thing_plus_nrf9160/Kconfig.defconfig
```kconfig
# Circuit Dojo nRF9160 Feather configuration

# Copyright (c) 2018-2020 Nordic Semiconductor ASA
# Copyright (c) 2020 Circuit Dojo LLC
# SPDX-License-Identifier: Apache-2.0

if BOARD_SPARKFUN_THING_PLUS_NRF9160 || BOARD_SPARKFUN_THING_PLUS_NRF9160_NS

config BOARD
	default "sparkfun_thing_plus_nrf9160"

# By default, if we build for a Non-Secure version of the board,
# enable building with TF-M as the Secure Execution Environment.
config BUILD_WITH_TFM
	default y if BOARD_SPARKFUN_THING_PLUS_NRF9160_NS

if BUILD_WITH_TFM

# By default, if we build with TF-M, instruct build system to
# flash the combined TF-M (Secure) & Zephyr (Non Secure) image
config TFM_FLASH_MERGED_BINARY
	bool
	default y

endif # BUILD_WITH_TFM

# For the secure version of the board the firmware is linked at the beginning
# of the flash, or into the code-partition defined in DT if it is intended to
# be loaded by MCUboot. If the secure firmware is to be combined with a non-
# secure image (TRUSTED_EXECUTION_SECURE=y), the secure FW image shall always
# be restricted to the size of its code partition.
# For the non-secure version of the board, the firmware
# must be linked into the code-partition (non-secure) defined in DT, regardless.
# Apply this configuration below by setting the Kconfig symbols used by
# the linker according to the information extracted from DT partitions.

# Workaround for not being able to have commas in macro arguments
DT_CHOSEN_Z_CODE_PARTITION := zephyr,code-partition

config FLASH_LOAD_SIZE
	default $(dt_chosen_reg_size_hex,$(DT_CHOSEN_Z_CODE_PARTITION))
	depends on BOARD_SPARKFUN_THING_PLUS_NRF9160 && TRUSTED_EXECUTION_SECURE

if BOARD_SPARKFUN_THING_PLUS_NRF9160_NS

config FLASH_LOAD_OFFSET
	default $(dt_chosen_reg_addr_hex,$(DT_CHOSEN_Z_CODE_PARTITION))

config FLASH_LOAD_SIZE
	default $(dt_chosen_reg_size_hex,$(DT_CHOSEN_Z_CODE_PARTITION))

endif # BOARD_SPARKFUN_THING_PLUS_NRF9160_NS

endif # BOARD_SPARKFUN_THING_PLUS_NRF9160 || BOARD_SPARKFUN_THING_PLUS_NRF9160_NS
```

## boards/arm/sparkfun_thing_plus_nrf9160/Kconfig.sparkfun_thing_plus_nrf9160_ns
```kconfig
# Copyright (c) 2022 Zephyr Project members and individual contributors
# SPDX-License-Identifier: Apache-2.0

config BOARD_SPARKFUN_THING_PLUS_NRF9160_NS
	bool
	default y
	select SOC_SERIES_NRF91X
	select SOC_NRF9160_SICA
```

## boards/arm/sparkfun_thing_plus_nrf9160/sparkfun_thing_plus_nrf9160_defconfig
```kconfig
# SPDX-License-Identifier: Apache-2.0

CONFIG_SOC_SERIES_NRF91X=y
CONFIG_SOC_NRF9160_SICA=y
CONFIG_BOARD_SPARKFUN_THING_PLUS_NRF9160=y

# Enable MPU
CONFIG_ARM_MPU=y

# Enable TrustZone-M
CONFIG_ARM_TRUSTZONE_M=y

# Hardware stack protection
CONFIG_HW_STACK_PROTECTION=y

# enable GPIO
CONFIG_GPIO=y

# Enable uart driver
CONFIG_SERIAL=y

# enable console
CONFIG_CONSOLE=y
CONFIG_UART_CONSOLE=y

CONFIG_PINCTRL=y
```

## boards/arm/steval_fcu001v1/Kconfig.board
```kconfig
# STM32 Flight Controller Unit board configuration

# Copyright (c) 2019 Linumiz
# SPDX-License-Identifier: Apache-2.0

config BOARD_STEVAL_FCU001V1
	bool "STM32 Flight Controller Unit"
	depends on SOC_STM32F401XC
```

## boards/arm/steval_fcu001v1/Kconfig.defconfig
```kconfig
# STM32 Flight Controller Unit board configuration

# Copyright (c) 2019 Linumiz
# SPDX-License-Identifier: Apache-2.0

if BOARD_STEVAL_FCU001V1

config BOARD
	default "steval_fcu001v1"

endif # BOARD_STEVAL_FCU001V1
```

## boards/arm/steval_fcu001v1/steval_fcu001v1_defconfig
```kconfig
# SPDX-License-Identifier: Apache-2.0

CONFIG_SOC_SERIES_STM32F4X=y
CONFIG_SOC_STM32F401XC=y

# Enable MPU
CONFIG_ARM_MPU=y

CONFIG_SERIAL=y

# console
CONFIG_CONSOLE=y
CONFIG_UART_CONSOLE=y

# enable GPIO
CONFIG_GPIO=y

# Enable Clocks
CONFIG_CLOCK_CONTROL=y

# enable pin controller
CONFIG_PINCTRL=y
```

## boards/arm/stm3210c_eval/Kconfig.board
```kconfig
# STM3210C-EVAL evaluation board

# Copyright (c) 2016 RnDity Sp. z o.o.
# SPDX-License-Identifier: Apache-2.0

config BOARD_STM3210C_EVAL
	def_bool "$(BOARD)" = "stm3210c_eval"
	depends on SOC_STM32F107XC
```
