## boards/arm/efm32wg_stk3800/Kconfig.defconfig
```kconfig
# Kconfig - EFM32WG STK3800 board
#
# Copyright (c) 2017, Christian Taedcke
#
# SPDX-License-Identifier: Apache-2.0
#

if BOARD_EFM32WG_STK3800

config BOARD
	default "efm32wg_stk3800"

config CMU_HFXO_FREQ
	default 48000000

config CMU_LFXO_FREQ
	default 32768

if GPIO_GECKO

config GPIO_GECKO_PORTA
	default y

config GPIO_GECKO_PORTB
	default y

config GPIO_GECKO_PORTC
	default n

config GPIO_GECKO_PORTD
	default n

config GPIO_GECKO_PORTE
	default y

config GPIO_GECKO_PORTF
	default y

endif # GPIO_GECKO

endif # BOARD_EFM32WG_STK3800
```

## boards/arm/efm32wg_stk3800/Kconfig.efm32wg_stk3800
```kconfig
# Copyright (c) 2022 Zephyr Project members and individual contributors
# SPDX-License-Identifier: Apache-2.0

config BOARD_EFM32WG_STK3800
	bool
	default y
	select SOC_SERIES_EFM32WG
	select SOC_PART_NUMBER_EFM32WG990F256
```

## boards/arm/efm32wg_stk3800/efm32wg_stk3800_defconfig
```kconfig
# SPDX-License-Identifier: Apache-2.0

CONFIG_ARM=y
CONFIG_SOC_FAMILY_EXX32=y
CONFIG_SOC_SERIES_EFM32WG=y
CONFIG_BOARD_EFM32WG_STK3800=y
CONFIG_CONSOLE=y
CONFIG_UART_CONSOLE=y
CONFIG_SERIAL=y
CONFIG_CORTEX_M_SYSTICK=y
CONFIG_GPIO=y
CONFIG_SYS_CLOCK_HW_CYCLES_PER_SEC=48000000
CONFIG_CMU_HFCLK_HFXO=y
```

## boards/arm/efr32_radio/Kconfig
```kconfig
# EFR32 radio board configuration

# Copyright (c) 2020 Piotr Mienkowski
# SPDX-License-Identifier: Apache-2.0

config BOARD_EFR32_RADIO
	bool
```

## boards/arm/efr32_radio/Kconfig.board
```kconfig
# EFR32BG13 BRD4104A / EFR32MG21 BRD4180A /
# EFR32FG1P BRD4250B / EFR32FG13P BRD4255A board

# Copyright (c) 2020 Piotr Mienkowski
# Copyright (c) 2020 TriaGnoSys GmbH
# SPDX-License-Identifier: Apache-2.0

config BOARD_EFR32_RADIO_BRD4104A
	bool "Silicon Labs BRD4104A (Blue Gecko Radio Board)"
	depends on SOC_SERIES_EFR32BG13P
	select BOARD_EFR32_RADIO
	select SOC_PART_NUMBER_EFR32BG13P632F512GM48

config BOARD_EFR32_RADIO_BRD4250B
	bool "Silicon Labs BRD4250B (Flex Gecko Radio Board)"
	depends on SOC_SERIES_EFR32FG1P
	select BOARD_EFR32_RADIO
	select SOC_PART_NUMBER_EFR32FG1P133F256GM48

config BOARD_EFR32_RADIO_BRD4180A
	bool "Silicon Labs BRD4180A (Mighty Gecko Radio Board)"
	depends on SOC_SERIES_EFR32MG21
	select BOARD_EFR32_RADIO
	select SOC_PART_NUMBER_EFR32MG21A020F1024IM32

config BOARD_EFR32_RADIO_BRD4255A
	bool "Silicon Labs BRD4255A (Flex Gecko Radio Board)"
	depends on SOC_SERIES_EFR32FG13P
	select BOARD_EFR32_RADIO
	select SOC_PART_NUMBER_EFR32FG13P233F512GM48
```

## boards/arm/efr32_radio/Kconfig.defconfig
```kconfig
# EFR32 radio board

# Copyright (c) 2020 Piotr Mienkowski
# Copyright (c) 2020 TriaGnoSys GmbH
# SPDX-License-Identifier: Apache-2.0

if BOARD_EFR32_RADIO

config BOARD
	default "efr32_radio_brd4104a" if BOARD_EFR32_RADIO_BRD4104A
	default "efr32_radio_brd4170a" if BOARD_EFR32_RADIO_BRD4170A
	default "efr32_radio_brd4161a" if BOARD_EFR32_RADIO_BRD4161A
	default "efr32_radio_brd4250b" if BOARD_EFR32_RADIO_BRD4250B
	default "efr32_radio_brd4180a" if BOARD_EFR32_RADIO_BRD4180A
	default "efr32_radio_brd4187c" if BOARD_EFR32_RADIO_BRD4187C
	default "efr32_radio_brd4255a" if BOARD_EFR32_RADIO_BRD4255A

config CMU_HFXO_FREQ
	default 39000000 if BOARD_EFR32_RADIO_BRD4187C
	default 38400000

config CMU_LFXO_FREQ
	default 32768

config FLASH_BASE_ADDRESS
	hex
	default 0x08000000 if BOARD_EFR32_RADIO_BRD4187C
	default 0x0

config LOG_BACKEND_SWO_FREQ_HZ
	default 875000
	depends on LOG_BACKEND_SWO

if SOC_GECKO_USE_RAIL

config FPU
	default n if SOC_GECKO_SERIES1
	default y

endif # SOC_GECKO_USE_RAIL

if BT

config FPU
	default y

config MINIMAL_LIBC_MALLOC_ARENA_SIZE
	default 8192

config MAIN_STACK_SIZE
	default 3072 if PM
	default 2304

choice BT_HCI_BUS_TYPE
	default BT_SILABS_HCI
endchoice

endif # BT

endif # BOARD_EFR32_RADIO
```

## boards/arm/efr32_radio/Kconfig.efr32_radio_brd4104a
```kconfig
# Copyright (c) 2022 Zephyr Project members and individual contributors
# SPDX-License-Identifier: Apache-2.0

config BOARD_EFR32_RADIO_BRD4104A
	bool
	default y
	select SOC_SERIES_EFR32BG13P
	select BOARD_EFR32_RADIO
	select SOC_PART_NUMBER_EFR32BG13P632F512GM48
```

## boards/arm/efr32_radio/Kconfig.efr32_radio_brd4180a
```kconfig
# Copyright (c) 2022 Zephyr Project members and individual contributors
# SPDX-License-Identifier: Apache-2.0

config BOARD_EFR32_RADIO_BRD4180A
	bool
	default y
	select SOC_SERIES_EFR32MG21
	select BOARD_EFR32_RADIO
	select SOC_PART_NUMBER_EFR32MG21A020F1024IM32
```

## boards/arm/efr32_radio/Kconfig.efr32_radio_brd4250b
```kconfig
# Copyright (c) 2022 Zephyr Project members and individual contributors
# SPDX-License-Identifier: Apache-2.0

config BOARD_EFR32_RADIO_BRD4250B
	bool
	default y
	select SOC_SERIES_EFR32FG1P
	select BOARD_EFR32_RADIO
	select SOC_PART_NUMBER_EFR32FG1P133F256GM48
```

## boards/arm/efr32_radio/Kconfig.efr32_radio_brd4255a
```kconfig
# Copyright (c) 2022 Zephyr Project members and individual contributors
# SPDX-License-Identifier: Apache-2.0

config BOARD_EFR32_RADIO_BRD4255A
	bool
	default y
	select SOC_SERIES_EFR32FG13P
	select BOARD_EFR32_RADIO
	select SOC_PART_NUMBER_EFR32FG13P233F512GM48
```

## boards/arm/efr32_radio/efr32_radio_brd4180a_defconfig
```kconfig
# SPDX-License-Identifier: Apache-2.0

CONFIG_SOC_SERIES_EFR32MG21=y
CONFIG_BOARD_EFR32_RADIO_BRD4180A=y
CONFIG_ARM_MPU=y
CONFIG_CONSOLE=y
CONFIG_UART_CONSOLE=y
CONFIG_SERIAL=y
CONFIG_GPIO=y
CONFIG_SYS_CLOCK_HW_CYCLES_PER_SEC=38400000
CONFIG_CMU_HFCLK_HFXO=y
```

## boards/arm/efr32_radio/efr32_radio_brd4187c_defconfig
```kconfig
# SPDX-License-Identifier: Apache-2.0

CONFIG_SOC_SERIES_EFR32MG24=y
CONFIG_BOARD_EFR32_RADIO_BRD4187C=y
CONFIG_ARM_MPU=y
CONFIG_CONSOLE=y
CONFIG_UART_CONSOLE=y
CONFIG_SERIAL=y
CONFIG_CORTEX_M_SYSTICK=y
CONFIG_GPIO=y
CONFIG_SYS_CLOCK_HW_CYCLES_PER_SEC=39000000
CONFIG_CMU_HFCLK_HFXO=y
```

## boards/arm/efr32_slwstk6061a/Kconfig
```kconfig
# Kconfig - EFR32 SLWSTK6061A board configuration
#
# Copyright (c) 2018 Christian Taedcke
#
# SPDX-License-Identifier: Apache-2.0

if BOARD_EFR32_SLWSTK6061A

config BOARD_INIT_PRIORITY
	int

	# omit prompt to signify a "hidden" option
	default KERNEL_INIT_PRIORITY_DEFAULT
	depends on GPIO
	help
	  Board initialization priority. This must be bigger than
	  GPIO_GECKO_COMMON_INIT_PRIORITY.

endif # BOARD_EFR32_SLWSTK6061A
```

## boards/arm/efr32_slwstk6061a/Kconfig.board
```kconfig
# SiLabs EFR32-SLWSTK6061A (Flex Gecko) board

# Copyright (c) 2018, Christian Taedcke
# SPDX-License-Identifier: Apache-2.0

config BOARD_EFR32_SLWSTK6061A
	def_bool "$(BOARD)" = "efr32_slwstk6061a"
	depends on SOC_SERIES_EFR32FG1P
	select SOC_PART_NUMBER_EFR32FG1P133F256GM48
```

## boards/arm/efr32_slwstk6061a/Kconfig.defconfig
```kconfig
# EFR32 SLWSTK6061A board

# Copyright (c) 2018, Christian Taedcke
# SPDX-License-Identifier: Apache-2.0

if BOARD_EFR32_SLWSTK6061A

config BOARD
	default "efr32_slwstk6061a"

config CMU_HFXO_FREQ
	default 38400000

config CMU_LFXO_FREQ
	default 32768

config LOG_BACKEND_SWO_FREQ_HZ
	default 875000
	depends on LOG_BACKEND_SWO

config COUNTER_GECKO_RTCC
	default y
	depends on COUNTER

endif # BOARD_EFR32_SLWSTK6061A
```

## boards/arm/efr32_slwstk6061a/efr32_slwstk6061a_defconfig
```kconfig
CONFIG_ARM=y
CONFIG_SOC_FAMILY_EXX32=y
CONFIG_SOC_SERIES_EFR32FG1P=y
CONFIG_BOARD_EFR32_SLWSTK6061A=y
CONFIG_CONSOLE=y
CONFIG_UART_CONSOLE=y
CONFIG_SERIAL=y
CONFIG_CORTEX_M_SYSTICK=y
CONFIG_GPIO=y
CONFIG_SYS_CLOCK_HW_CYCLES_PER_SEC=38400000
CONFIG_CMU_HFCLK_HFXO=y
```

## boards/arm/efr32_thunderboard/Kconfig
```kconfig
# EFR32BG SLTB010A board

# Copyright (c) 2022, Silicon Labs
# SPDX-License-Identifier: Apache-2.0

module = BOARD_THUNDERBOARD
module-str = Board Control
source "subsys/logging/Kconfig.template.log_config"
```

## boards/arm/efr32_thunderboard/Kconfig.board
```kconfig
# EFR32BG SLTB010A board

# Copyright (c) 2021, Sateesh Kotapati
# SPDX-License-Identifier: Apache-2.0

config BOARD_EFR32BG22_BRD4184A
	bool "SiLabs EFR32BG22-BRD4184A (Thunderboard EFR32BG22)"
	depends on SOC_SERIES_EFR32BG22
	select SOC_PART_NUMBER_EFR32BG22C224F512IM40

config BOARD_EFR32BG27_BRD2602A
	bool "SiLabs EFR32BG27-BRD2602A (EFR32BG27 +8 dBm Dev Kit Board)"
	depends on SOC_SERIES_EFR32BG27
	select SOC_PART_NUMBER_EFR32BG27C140F768IM40
```

## boards/arm/efr32_thunderboard/Kconfig.defconfig
```kconfig
# Thunderboard-style boards

# Copyright (c) 2023 Antmicro <www.antmicro.com>
# SPDX-License-Identifier: Apache-2.0

if BOARD_EFR32BG22_BRD4184A

config BOARD
	default "efr32bg22_brd4184a"

endif # BOARD_EFR32BG22_BRD4184A

if BOARD_EFR32BG27_BRD2602A

config BOARD
	default "efr32bg27_brd2602a"

endif # BOARD_EFR32BG27_BRD2602A

config CMU_HFXO_FREQ
	default 40000000

config CMU_LFXO_FREQ
	default 32768

if BT

config FPU
	default y

config MINIMAL_LIBC_MALLOC_ARENA_SIZE
	default 8192

config MAIN_STACK_SIZE
	default 2304

choice BT_HCI_BUS_TYPE
	default BT_SILABS_HCI
endchoice

endif # BT

config REGULATOR
	default y if SI7210
```

## boards/arm/efr32bg22/efr32bg22_brd4184a_defconfig
```kconfig
# SPDX-License-Identifier: Apache-2.0

CONFIG_ARM_MPU=y
CONFIG_SOC_SERIES_EFR32BG22=y
CONFIG_BOARD_EFR32BG22_BRD4184A=y
CONFIG_CONSOLE=y
CONFIG_UART_CONSOLE=y
CONFIG_SERIAL=y
CONFIG_CORTEX_M_SYSTICK=y
CONFIG_GPIO=y
CONFIG_SYS_CLOCK_HW_CYCLES_PER_SEC=76800000
CONFIG_CMU_HFCLK_HFXO=y
CONFIG_SOC_GECKO_EMU_DCDC=y
CONFIG_SOC_GECKO_EMU_DCDC_MODE_ON=y
CONFIG_HW_STACK_PROTECTION=y
CONFIG_CMU_HFCLK_HFRCO=y
CONFIG_PINCTRL=y
```

## boards/arm/efr32bg22_brd4184a/Kconfig
```kconfig
# EFR32BG22 BRD4184A board

# Copyright (c) 2022, Silicon Labs
# SPDX-License-Identifier: Apache-2.0

if BOARD_EFR32BG22_BRD4184A

module = BOARD_EFR32BG22
module-str = Board Control
source "subsys/logging/Kconfig.template.log_config"

endif # BOARD_EFR32BG22_BRD4184A
```

## boards/arm/efr32bg22_brd4184a/Kconfig.defconfig
```kconfig
# EFR32BG22 BRD4184A board

# Copyright (c) 2021, Sateesh Kotapati
# SPDX-License-Identifier: Apache-2.0

if BOARD_EFR32BG22_BRD4184A

config BOARD
	default "efr32bg22_brd4184a"

config CMU_HFXO_FREQ
	default 40000000

config CMU_LFXO_FREQ
	default 32768

endif # BOARD_EFR32BG22_BRD4184A
```

## boards/arm/efr32bg22_brd4184a/dts/bindings/silabs,gecko-wake-up-triggers.yaml
```yaml
# Copyright (c) 2022, Antmicro
# SPDX-License-Identifier: Apache-2.0

description: GPIO Wake Up Trigger for EFR32BG22

compatible: "silabs,gecko-wake-up-trigger"

include: base.yaml

properties:
  gpios:
    type: phandle-array
    required: true
    description: |
      GPIO used as wake up trigger from EM4 sleep
```

## boards/arm/efr32bg_sltb010a/Kconfig
```kconfig
# EFR32BG SLTB010A board

# Copyright (c) 2022, Silicon Labs
# SPDX-License-Identifier: Apache-2.0

if BOARD_EFR32BG_SLTB010A

module = BOARD_EFR32BG22
module-str = Board Control
source "subsys/logging/Kconfig.template.log_config"

endif # BOARD_EFR32BG_SLTB010A
```

## boards/arm/efr32bg_sltb010a/Kconfig.board
```kconfig
# EFR32BG SLTB010A board

# Copyright (c) 2021, Sateesh Kotapati
# SPDX-License-Identifier: Apache-2.0

config BOARD_EFR32BG_SLTB010A
	bool "SiLabs EFR32BG-SLTB010A (Thunderboard BG22)"
	depends on SOC_SERIES_EFR32BG22
	select SOC_PART_NUMBER_EFR32BG22C224F512IM40
```
