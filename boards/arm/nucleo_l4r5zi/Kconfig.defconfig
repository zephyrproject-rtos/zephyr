## boards/arm/nucleo_l4r5zi/Kconfig.defconfig
```kconfig
# STM32L4R5ZI Nucleo board configuration

# Copyright (c) 2018 Pushpal Sidhu
# SPDX-License-Identifier: Apache-2.0

config SPI_STM32_INTERRUPT
	default y
	depends on SPI

if NETWORKING

config USB_DEVICE_STACK
	default y

config USB_DEVICE_NETWORK_EEM
	default y

endif # NETWORKING
```

## boards/arm/nucleo_l4r5zi/Kconfig.nucleo_l4r5zi
```kconfig
# Copyright (c) 2022 Zephyr Project members and individual contributors
# SPDX-License-Identifier: Apache-2.0

config BOARD_NUCLEO_L4R5ZI
	bool
	default y
	select SOC_SERIES_STM32L4X
	select SOC_STM32L4R5XX
```

## boards/arm/nucleo_l4r5zi/nucleo_l4r5zi_defconfig
```kconfig
# SPDX-License-Identifier: Apache-2.0

CONFIG_ARM=y
CONFIG_SOC_SERIES_STM32L4X=y
CONFIG_SOC_STM32L4R5XX=y
CONFIG_BOARD_NUCLEO_L4R5ZI=y

# 120MHz system clock only in 'boost power' mode. DM00310109, section
# 5.1.7 states that the R1MODE bit must be cleared before system can
# be 120MHz. This requires an update to the stm32 clock control
# driver, so default to 80MHz until then.
# CONFIG_SYS_CLOCK_HW_CYCLES_PER_SEC=120000000

# 80MHz system clock in 'normal power' mode
CONFIG_SYS_CLOCK_HW_CYCLES_PER_SEC=80000000

# enable uart driver
CONFIG_SERIAL=y

# enable pinmux
CONFIG_PINMUX=y

# Enable GPIO
CONFIG_GPIO=y

# Clock Configuration
CONFIG_CLOCK_CONTROL=y

# Use PLLCLK for SYSCLK
CONFIG_CLOCK_STM32_SYSCLK_SRC_PLL=y

# Use HSI (16MHz) to feed into PLL
CONFIG_CLOCK_STM32_PLL_SRC_HSI=y

CONFIG_CLOCK_STM32_PLL_M_DIVISOR=4
CONFIG_CLOCK_STM32_PLL_P_DIVISOR=7
CONFIG_CLOCK_STM32_PLL_Q_DIVISOR=2
CONFIG_CLOCK_STM32_PLL_R_DIVISOR=2

# Produce 80MHz clock at PLLCLK output
CONFIG_CLOCK_STM32_PLL_N_MULTIPLIER=40

# Comment out above and uncomment below for 120MHz. Note that you
# must have configured the mcu for boost power mode.
# CONFIG_CLOCK_STM32_PLL_N_MULTIPLIER=60

# Produce Max (80MHz or 120MHz) HCLK
CONFIG_CLOCK_STM32_AHB_PRESCALER=1

# Produce Max (80MHz or 120MHz) APB1 clocks and APB2 clocks
CONFIG_CLOCK_STM32_APB1_PRESCALER=1
CONFIG_CLOCK_STM32_APB2_PRESCALER=1

# Console
CONFIG_CONSOLE=y
CONFIG_UART_CONSOLE=y

# Enable MPU
CONFIG_ARM_MPU=y
```

## boards/arm/nucleo_l552ze_q/Kconfig.board
```kconfig
# STM32L552ZE Q Nucleo board configuration

# Copyright (c) 2020 Linaro Limited
# SPDX-License-Identifier: Apache-2.0

config BOARD_NUCLEO_L552ZE_Q
	bool "Nucleo L552ZE Q Development Board"
	depends on SOC_STM32L552XX
```

## boards/arm/nucleo_l552ze_q/Kconfig.defconfig
```kconfig
# STM32L552ZE Q Nucleo board configuration

# Copyright (c) 2020 Linaro Limited
# SPDX-License-Identifier: Apache-2.0

if TRUSTED_EXECUTION_NONSECURE

# Get flash configuration for NS image from dts flash partition
config USE_DT_CODE_PARTITION
	default y

endif # TRUSTED_EXECUTION_NONSECURE
```

## boards/arm/nucleo_l552ze_q/Kconfig.nucleo_l552ze_q_ns
```kconfig
# Copyright (c) 2022 Zephyr Project members and individual contributors
# SPDX-License-Identifier: Apache-2.0

config BOARD_NUCLEO_L552ZE_Q_NS
	bool
	default y
	select SOC_SERIES_STM32L5X
	select SOC_STM32L552XX
```

## boards/arm/nucleo_l552ze_q/nucleo_l552ze_q_defconfig
```kconfig
# SPDX-License-Identifier: Apache-2.0

CONFIG_SOC_SERIES_STM32L5X=y
CONFIG_SOC_STM32L552XX=y

# enable uart driver
CONFIG_SERIAL=y

# enable GPIO
CONFIG_GPIO=y

# Enable clock
CONFIG_CLOCK_CONTROL=y

# console
CONFIG_CONSOLE=y
CONFIG_UART_CONSOLE=y

# Enable MPU
CONFIG_ARM_MPU=y

# Enable HW stack protection
CONFIG_HW_STACK_PROTECTION=y

# enable pin controller
CONFIG_PINCTRL=y
```

## boards/arm/nucleo_l552ze_q/nucleo_l552ze_q_ns_defconfig
```kconfig
# SPDX-License-Identifier: Apache-2.0

CONFIG_SOC_SERIES_STM32L5X=y
CONFIG_SOC_STM32L552XX=y
# 110MHz system clock
CONFIG_SYS_CLOCK_HW_CYCLES_PER_SEC=110000000

# enable uart driver
CONFIG_SERIAL=y

# enable pinmux
CONFIG_PINMUX=y

# enable GPIO
CONFIG_GPIO=y

# clock configuration
CONFIG_CLOCK_CONTROL=y
# SYSCLK selection
CONFIG_CLOCK_STM32_SYSCLK_SRC_PLL=y
# PLL configuration
CONFIG_CLOCK_STM32_PLL_SRC_MSI=y
CONFIG_CLOCK_STM32_MSI_RANGE=6
#CONFIG_CLOCK_STM32_LSE=y
#CONFIG_CLOCK_STM32_MSI_PLL_MODE=y
# produce 110MHz clock at PLL output
CONFIG_CLOCK_STM32_PLL_M_DIVISOR=1
CONFIG_CLOCK_STM32_PLL_N_MULTIPLIER=55
CONFIG_CLOCK_STM32_PLL_P_DIVISOR=7
CONFIG_CLOCK_STM32_PLL_Q_DIVISOR=2
CONFIG_CLOCK_STM32_PLL_R_DIVISOR=2
CONFIG_CLOCK_STM32_AHB_PRESCALER=1
CONFIG_CLOCK_STM32_APB1_PRESCALER=1
CONFIG_CLOCK_STM32_APB2_PRESCALER=1

# console
CONFIG_CONSOLE=y
CONFIG_UART_CONSOLE=y

# Enable MPU
# Issue #27809
# TFM integration sample tfm_ipc doesn't work when the MPU is enabled.
# In TF-M, for the nucleo_l552ze_q, TFM_BOOT_MPU_PROTECTION configures and
# enables a secure MPU and a non secure MPU. Either CONFIG_ARM_MPU or
# TFM_BOOT_MPU_PROTECTION must be disabled.
#CONFIG_ARM_MPU=y

CONFIG_ARM_TRUSTZONE_M=y
CONFIG_CORTEX_M_SYSTICK=y
CONFIG_RUNTIME_NMI=y
CONFIG_TRUSTED_EXECUTION_NONSECURE=y
# Flash configuration for TFM
CONFIG_FLASH_LOAD_OFFSET=0x51400
CONFIG_FLASH_LOAD_SIZE=0x2E000
```

## boards/arm/nucleo_u575zi_q/Kconfig.nucleo_u575zi_q
```kconfig
# Copyright (c) 2022 Zephyr Project members and individual contributors
# SPDX-License-Identifier: Apache-2.0

config BOARD_NUCLEO_U575ZI_Q
	bool
	default y
	select SOC_SERIES_STM32U5X
	select SOC_STM32U575XX
```

## boards/arm/nucleo_u575zi_q/nucleo_u575zi_q_defconfig
```kconfig
# SPDX-License-Identifier: Apache-2.0

CONFIG_SOC_SERIES_STM32U5X=y
CONFIG_SOC_STM32U575XX=y

# enable uart driver
CONFIG_SERIAL=y

# enable pinmux
CONFIG_PINMUX=y

# enable GPIO
CONFIG_GPIO=y

# Enable clock
CONFIG_CLOCK_CONTROL=y

# console
CONFIG_CONSOLE=y
CONFIG_UART_CONSOLE=y

# Enable MPU
CONFIG_ARM_MPU=y

# Enable HW stack protection
CONFIG_HW_STACK_PROTECTION=y
```

## boards/arm/nucleo_u5a5zj_q/Kconfig.defconfig
```kconfig
# STM32U5A5ZJ Q Nucleo board configuration

# Copyright (c) 2023 STMicroelectronics
# SPDX-License-Identifier: Apache-2.0

if BOARD_NUCLEO_U5A5ZJ_Q

config BOARD
	default "nucleo_u5a5zj_q"

endif # BOARD_NUCLEO_U5A5ZJ_Q
```

## boards/arm/nucleo_wb55cg_dongle/Kconfig.board
```kconfig
# STM32WB55CG Nucleo USB dongle configuration

# Copyright (c) 2020 Pete Johanson
# SPDX-License-Identifier: Apache-2.0

config BOARD_NUCLEO_WB55CG_DONGLE
	bool "Nucleo WB55CG USB DONGLE"
	depends on SOC_STM32WB55XX
```

## boards/arm/nucleo_wb55cg_dongle/Kconfig.defconfig
```kconfig
# STM32LWB55CG USB dongle configuration

# Copyright (c) 2020 Pete Johanson
# SPDX-License-Identifier: Apache-2.0

if BOARD_NUCLEO_WB55CG_DONGLE

config BOARD
	default "nucleo_wb55cg_dongle"

config CLOCK_STM32_LSE
	default y

choice STM32_LPTIM_CLOCK
	default STM32_LPTIM_CLOCK_LSE
	depends on STM32_LPTIM_TIMER
endchoice

choice BT_HCI_BUS_TYPE
	default BT_STM32_IPM
	depends on BT
endchoice

endif # BOARD_NUCLEO_WB55CG
```

## boards/arm/nucleo_wb55rg/Kconfig.board
```kconfig
# Nucleo WB55RG development board

# Copyright (c) 2019 Linaro Limited
# SPDX-License-Identifier: Apache-2.0

config BOARD_NUCLEO_WB55RG
	def_bool "$(BOARD)" = "nucleo_wb55rg"
	depends on SOC_STM32WB55XX
```

## boards/arm/nucleo_wb55rg/Kconfig.defconfig
```kconfig
# STM32LWB55RG Nucleo board configuration

# Copyright (c) 2019 Linaro Limited
# SPDX-License-Identifier: Apache-2.0

if BOARD_NUCLEO_WB55RG

config BOARD
	default "nucleo_wb55rg"

choice BT_HCI_BUS_TYPE
	default BT_STM32_IPM
	depends on BT
endchoice

# LPTIM clocked by LSE, force tick freq to 4096 for tick accuracy
config SYS_CLOCK_TICKS_PER_SEC
	default 4096 if STM32_LPTIM_TIMER

endif # BOARD_NUCLEO_WB55RG
```

## boards/arm/nucleo_wb55rg/Kconfig.nucleo_wb55rg
```kconfig
# Copyright (c) 2022 Zephyr Project members and individual contributors
# SPDX-License-Identifier: Apache-2.0

config BOARD_NUCLEO_WB55RG
	bool
	default y
	select SOC_SERIES_STM32WBX
	select SOC_STM32WB55XX
```

## boards/arm/nucleo_wb55rg/nucleo_wb55rg_defconfig
```kconfig
CONFIG_ARM=y
CONFIG_SOC_SERIES_STM32WBX=y
CONFIG_SOC_STM32WB55XX=y
# 32MHz system clock
CONFIG_SYS_CLOCK_HW_CYCLES_PER_SEC=32000000

# enable uart driver
CONFIG_SERIAL=y

# enable pinmux
CONFIG_PINMUX=y

# enable GPIO
CONFIG_GPIO=y

# clock configuration
CONFIG_CLOCK_CONTROL=y
# SYSCLK selection
#CONFIG_CLOCK_STM32_SYSCLK_SRC_PLL=y
CONFIG_CLOCK_STM32_SYSCLK_SRC_HSE=y
CONFIG_CLOCK_STM32_HSE_CLOCK=32000000

CONFIG_CLOCK_STM32_CPU1_PRESCALER=1
CONFIG_CLOCK_STM32_CPU2_PRESCALER=1
CONFIG_CLOCK_STM32_APB1_PRESCALER=1
CONFIG_CLOCK_STM32_APB2_PRESCALER=1
CONFIG_CLOCK_STM32_AHB4_PRESCALER=1

# console
CONFIG_CONSOLE=y
CONFIG_UART_CONSOLE=y

# Enable MPU
CONFIG_ARM_MPU=y
```

## boards/arm/nucleo_wba52cg/Kconfig.board
```kconfig
# STM32WBA52CG Nucleo board configuration

# Copyright (c) 2023 STMicroelectronics
# SPDX-License-Identifier: Apache-2.0

config BOARD_NUCLEO_WBA52CG
	bool "Nucleo WBA52CG Development Board"
	depends on SOC_STM32WBA52XX
```

## boards/arm/nucleo_wba52cg/Kconfig.defconfig
```kconfig
# STM32WBA52CG Nucleo board configuration

# Copyright (c) 2023 STMicroelectronics

# SPDX-License-Identifier: Apache-2.0

if BOARD_NUCLEO_WBA52CG

config BOARD
	default "nucleo_wba52cg"

config SPI_STM32_INTERRUPT
	default y
	depends on SPI

# LPTIM clocked by LSE, force tick freq to 4096 for tick accuracy
config SYS_CLOCK_TICKS_PER_SEC
	default 4096 if STM32_LPTIM_TIMER

endif # BOARD_NUCLEO_WBA52CG
```

## boards/arm/nucleo_wba52cg/nucleo_wba52cg_defconfig
```kconfig
# SPDX-License-Identifier: Apache-2.0

CONFIG_SOC_SERIES_STM32WBAX=y
CONFIG_SOC_STM32WBA52XX=y

# enable uart driver
CONFIG_SERIAL=y

# enable GPIO
CONFIG_GPIO=y

# Enable clock
CONFIG_CLOCK_CONTROL=y

# console
CONFIG_CONSOLE=y
CONFIG_UART_CONSOLE=y

# Enable MPU
CONFIG_ARM_MPU=y

# Enable HW stack protection
CONFIG_HW_STACK_PROTECTION=y

# enable pin controller
CONFIG_PINCTRL=y
```

## boards/arm/nucleo_wba55cg/Kconfig.board
```kconfig
# STM32WBA55CG Nucleo board configuration

# Copyright (c) 2023 STMicroelectronics
# SPDX-License-Identifier: Apache-2.0

config BOARD_NUCLEO_WBA55CG
	bool "Nucleo WBA55CG Development Board"
	depends on SOC_STM32WBA55XX
```

## boards/arm/nucleo_wba55cg/Kconfig.defconfig
```kconfig
# STM32WBA52CG Nucleo board configuration

# Copyright (c) 2023 STMicroelectronics

# SPDX-License-Identifier: Apache-2.0

if BOARD_NUCLEO_WBA55CG

config BOARD
	default "nucleo_wba55cg"

config SPI_STM32_INTERRUPT
	default y
	depends on SPI

endif # BOARD_NUCLEO_WBA55CG
```

## boards/arm/nucleo_wba55cg/nucleo_wba55cg_defconfig
```kconfig
# SPDX-License-Identifier: Apache-2.0
# Copyright (c) 2023 STMicroelectronics

CONFIG_SOC_SERIES_STM32WBAX=y
CONFIG_SOC_STM32WBA55XX=y

# enable uart driver
CONFIG_SERIAL=y

# enable GPIO
CONFIG_GPIO=y

# Enable clock
CONFIG_CLOCK_CONTROL=y

# console
CONFIG_CONSOLE=y
CONFIG_UART_CONSOLE=y

# Enable MPU
CONFIG_ARM_MPU=y

# Enable HW stack protection
CONFIG_HW_STACK_PROTECTION=y

# enable pin controller
CONFIG_PINCTRL=y

# LSE defined as LPTIM clock source by the DTS
CONFIG_STM32_LPTIM_CLOCK_LSE=y

# Enable the internal SMPS regulator
CONFIG_POWER_SUPPLY_DIRECT_SMPS=y
```

## boards/arm/nucleo_wl55jc/Kconfig.board
```kconfig
# STM32WL55JC Nucleo board configuration

# Copyright (c) 2020 STMicroelectronics
# SPDX-License-Identifier: Apache-2.0

config BOARD_NUCLEO_WL55JC
	bool "Nucleo WL55JC Development Board"
	depends on SOC_STM32WL55XX
```

## boards/arm/nucleo_wl55jc/Kconfig.defconfig
```kconfig
# STM32WL55JC Nucleo board configuration

# Copyright (c) 2020 STMicroelectronics
# SPDX-License-Identifier: Apache-2.0

if BOARD_NUCLEO_WL55JC

config BOARD
	default "nucleo_wl55jc"

endif # BOARD_NUCLEO_WL55JC
```
