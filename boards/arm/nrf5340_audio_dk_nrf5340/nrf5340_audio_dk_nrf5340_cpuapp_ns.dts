/*
 * Copyright (c) 2020 Nordic Semiconductor ASA
 *
 * SPDX-License-Identifier: Apache-2.0
 */

/dts-v1/;
#include <nordic/nrf5340_cpuappns_qkaa.dtsi>
#include "nrf5340_audio_dk_nrf5340_cpuapp_common.dtsi"

/ {
	model = "Nordic nRF5340 Audio DK NRF5340 Application";
	compatible = "nordic,nrf5340-audio-dk-nrf5340-cpuapp";

	chosen {
		zephyr,sram = &sram0_ns;
		zephyr,flash = &flash0;
		zephyr,code-partition = &slot0_ns_partition;
	};
};
