## boards/arm/ngultra_devkit/Kconfig.defconfig
```kconfig
# Copyright (c) 2022 NanoXplore
# SPDX-License-Identifier: Apache-2.0

if BOARD_NGULTRA_DEVKIT
config BOARD
	default "ngultra_devkit"
endif # BOARD_NGULTRA_DEVKIT
```

## boards/arm/ngultra_devkit/ngultra_devkit_defconfig
```kconfig
CONFIG_SOC_NGULTRA=y
CONFIG_SOC_SERIES_NANOXPLORE_NGULTRA=y
CONFIG_BOARD_NGULTRA_DEVKIT=y
CONFIG_SYS_CLOCK_HW_CYCLES_PER_SEC=100000000
CONFIG_FLASH_SIZE=0
CONFIG_FLASH_BASE_ADDRESS=0
```

## boards/arm/nicenano/Kconfig.board
```kconfig
# nRF52840 DK NRF52840 board configuration

# Copyright (c) 2016 Nordic Semiconductor ASA
# SPDX-License-Identifier: Apache-2.0

config BOARD_NICENANO
	bool "Nice!Nano"
	depends on SOC_NRF52840_QIAA
```

## boards/arm/nicenano/Kconfig.defconfig
```kconfig
# nRF52840 DK NRF52840 board configuration

# Copyright (c) 2016 Nordic Semiconductor ASA
# SPDX-License-Identifier: Apache-2.0

if BOARD_NICENANO

config BOARD
	default "nicenano"

config BT_CTLR
	default BT

endif # BOARD_NICENANO
```

## boards/arm/npcx7m6fb_evb/Kconfig.defconfig
```kconfig
# Copyright (c) 2020 Nuvoton Technology Corporation.
# SPDX-License-Identifier: Apache-2.0

if BOARD_NPCX7M6FB_EVB

config BOARD
	default "npcx7m6fb_evb"

endif # BOARD_NPCX7M6FB_EVB

config SYS_CLOCK_TICKS_PER_SEC
	default 1000

config INPUT
	default y if KSCAN
```

## boards/arm/npcx7m6fb_evb/Kconfig.npcx7m6fb_evb
```kconfig
# Copyright (c) 2022 Zephyr Project members and individual contributors
# SPDX-License-Identifier: Apache-2.0

config BOARD_NPCX7M6FB_EVB
	bool
	default y
	select SOC_NPCX7M6FB
	select SOC_SERIES_NPCX7
```

## boards/arm/npcx7m6fb_evb/npcx7m6fb_evb_defconfig
```kconfig
#
# Copyright (c) 2020 Nuvoton Technology Corporation.
#
# SPDX-License-Identifier: Apache-2.0
#

CONFIG_SOC_NPCX7M6FB=y
CONFIG_SOC_SERIES_NPCX7=y
CONFIG_BOARD_NPCX7M6FB_EVB=y
CONFIG_CORTEX_M_SYSTICK=y

# Enable MPU
CONFIG_ARM_MPU=y

# General Kernel Options
CONFIG_SYS_CLOCK_HW_CYCLES_PER_SEC=15000000

# Clock configuration
CONFIG_CLOCK_CONTROL=y

# PLL configuration
CONFIG_CLOCK_NPCX_OSC_CYCLES_PER_SEC=90000000
CONFIG_CLOCK_NPCX_APB1_PRESCALER=6
CONFIG_CLOCK_NPCX_APB2_PRESCALER=6
CONFIG_CLOCK_NPCX_APB3_PRESCALER=6

# Pinmux Driver
CONFIG_PINMUX=y

# UART Driver
CONFIG_SERIAL=y
CONFIG_UART_INTERRUPT_DRIVEN=y

# GPIO Driver
CONFIG_GPIO=y

# Console Driver
CONFIG_CONSOLE=y
CONFIG_UART_CONSOLE=y
```

## boards/arm/npcx9m6f_evb/Kconfig.board
```kconfig
# Copyright (c) 2021 Nuvoton Technology Corporation.
# SPDX-License-Identifier: Apache-2.0

config BOARD_NPCX9M6F_EVB
	bool "Nuvoton NPCX9M6F EVB Development board"
	depends on SOC_NPCX9M6F
```

## boards/arm/npcx9m6f_evb/Kconfig.defconfig
```kconfig
# Copyright (c) 2021 Nuvoton Technology Corporation.
# SPDX-License-Identifier: Apache-2.0

if BOARD_NPCX9M6F_EVB

config BOARD
	default "npcx9m6f_evb"

endif # BOARD_NPCX9M6F_EVB

config SYS_CLOCK_TICKS_PER_SEC
	default 1000

config INPUT
	default y if KSCAN
```

## boards/arm/npcx9m6f_evb/Kconfig.npcx9m6f_evb
```kconfig
# Copyright (c) 2022 Zephyr Project members and individual contributors
# SPDX-License-Identifier: Apache-2.0

config BOARD_NPCX9M6F_EVB
	bool
	default y
	select SOC_NPCX9M6F
	select SOC_SERIES_NPCX9
```

## boards/arm/nrf21540dk_nrf52840/Kconfig.board
```kconfig
# nRF21540 DK NRF52840 board configuration

# Copyright (c) 2020 Nordic Semiconductor ASA
# SPDX-License-Identifier: Apache-2.0

config BOARD_NRF21540DK_NRF52840
	bool "nRF21540 DK NRF52840"
	depends on SOC_NRF52840_QIAA
```

## boards/arm/nrf21540dk_nrf52840/Kconfig.defconfig
```kconfig
# nRF21540 DK NRF52840 board configuration

# Copyright (c) 2020 Nordic Semiconductor ASA
# SPDX-License-Identifier: Apache-2.0

config BT_CTLR
	default BT
```

## boards/arm/nrf51_ble400/Kconfig.defconfig
```kconfig
# nRF51 BLE400 board configuration

# Copyright (c) 2018 Roman Tataurov <diytronic@yandex.ru>
# SPDX-License-Identifier: Apache-2.0

config BT_CTLR
	default BT
```

## boards/arm/nrf51_ble400/nrf51_ble400_defconfig
```kconfig
CONFIG_ARM=y
CONFIG_SOC_FAMILY_NRF=y
CONFIG_SOC_SERIES_NRF51X=y
CONFIG_SOC_NRF51822_QFAA=y
CONFIG_BOARD_NRF51_BLE400=y

# enable uart driver
CONFIG_SERIAL=y
CONFIG_UART_NRFX=y
CONFIG_UART_0_NRF_UART=y

# enable console
CONFIG_CONSOLE=y
CONFIG_UART_CONSOLE=y

# bluetooth
CONFIG_BT=y
CONFIG_BT_CTLR=y
```

## boards/arm/nrf51_blenano/Kconfig.defconfig
```kconfig
# Kconfig - nRF51 BLENANO board configuration
#
# Copyright (c) 2016 Nordic Semiconductor ASA
#
# SPDX-License-Identifier: Apache-2.0

if BOARD_NRF51_BLENANO

config BOARD
	default "nrf51_blenano"

config BT_CTLR
	default BT

endif # BOARD_NRF51_BLENANO
```

## boards/arm/nrf51_blenano/nrf51_blenano_defconfig
```kconfig
# SPDX-License-Identifier: Apache-2.0

CONFIG_SOC_SERIES_NRF51X=y
CONFIG_SOC_NRF51822_QFAA=y
CONFIG_BOARD_NRF51_BLENANO=y

# enable GPIO
CONFIG_GPIO=y

# enable uart driver
CONFIG_SERIAL=y

# enable console
CONFIG_CONSOLE=y
CONFIG_UART_CONSOLE=y

CONFIG_PINCTRL=y
```

## boards/arm/nrf51_pca10028/Kconfig.board
```kconfig
# nRF51 PCA10028 board configuration

# Copyright (c) 2016 Linaro Limited.
# SPDX-License-Identifier: Apache-2.0

config BOARD_NRF51_PCA10028
	def_bool "$(BOARD)" = "nrf51_pca10028"
	depends on SOC_NRF51822_QFAC
```

## boards/arm/nrf51_pca10028/Kconfig.defconfig
```kconfig
# nRF51 PCA10028 board configuration

# Copyright (c) 2016 Linaro Limited.
# SPDX-License-Identifier: Apache-2.0

if BOARD_NRF51_PCA10028

config BOARD
	default "nrf51_pca10028"

config ADC_0
	default y
	depends on ADC

config I2C_0
	default y
	depends on I2C

config SPI_1
	default y
	depends on SPI

config BT_CTLR
	default BT

endif # BOARD_NRF51_PCA10028
```

## boards/arm/nrf51_pca10031/Kconfig.board
```kconfig
# Kconfig - nRF51 PCA10031 board configuration
#
# Copyright (c) 2018 Nordic Semiconductor ASA.
#
# SPDX-License-Identifier: Apache-2.0

config BOARD_NRF51_PCA10031
	bool "nRF51 PCA10031"
	depends on SOC_NRF51822_QFAC
```

## boards/arm/nrf51_pca10031/Kconfig.defconfig
```kconfig
# Kconfig - nRF51 PCA10031 board configuration
#
# Copyright (c) 2018 Nordic Semiconductor ASA.
#
# SPDX-License-Identifier: Apache-2.0

if BOARD_NRF51_PCA10031

config BOARD
	default "nrf51_pca10031"

if ADC

config ADC_0
	default y

endif # ADC

config BT_CTLR
	default BT

endif # BOARD_NRF51_PCA10031
```

## boards/arm/nrf51_vbluno51/Kconfig.board
```kconfig
# nRF51-VBLUNO51 BLE board

# Copyright (c) 2017 VNG IoT Lab Limited.
# SPDX-License-Identifier: Apache-2.0

config BOARD_NRF51_VBLUNO51
	def_bool "$(BOARD)" = "nrf51_vbluno51"
	depends on SOC_NRF51822_QFAC
```

## boards/arm/nrf51_vbluno51/Kconfig.defconfig
```kconfig
# nRF51 VBLUno51 board configuration

# Copyright (c) 2017 VNG IoT Lab Limited.
# SPDX-License-Identifier: Apache-2.0

config BT_CTLR
	default BT
```

## boards/arm/nrf51_vbluno51/Kconfig.nrf51_vbluno51
```kconfig
# Copyright (c) 2022 Zephyr Project members and individual contributors
# SPDX-License-Identifier: Apache-2.0

config BOARD_NRF51_VBLUNO51
	bool
	default y
	select SOC_SERIES_NRF51X
	select SOC_NRF51822_QFAC
```

## boards/arm/nrf51_vbluno51/nrf51_vbluno51_defconfig
```kconfig
# SPDX-License-Identifier: Apache-2.0

CONFIG_SOC_SERIES_NRF51X=y
CONFIG_SOC_NRF51822_QFAC=y
CONFIG_BOARD_NRF51_VBLUNO51=y

# enable GPIO
CONFIG_GPIO=y

# enable uart driver
CONFIG_SERIAL=y

# enable console
CONFIG_CONSOLE=y
CONFIG_UART_CONSOLE=y
```

## boards/arm/nrf51dk_nrf51422/Kconfig.defconfig
```kconfig
# nRF51 DK NRF51422 board configuration

# Copyright (c) 2016 Linaro Limited.
# SPDX-License-Identifier: Apache-2.0

config BT_CTLR
	default BT
```
