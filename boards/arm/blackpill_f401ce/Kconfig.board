## boards/arm/blackpill_f401ce/Kconfig.board
```kconfig
# Copyright (c) 2020 Kalyan Sriram
# SPDX-License-Identifier: Apache-2.0

# STM32F401CE based Black Pill V3.0+ board configuration

config BOARD_BLACKPILL_F401CE
	bool "WeAct Studio Black Pill V3.0+ Board"
	depends on SOC_STM32F401XE
```

## boards/arm/blackpill_f401ce/Kconfig.defconfig
```kconfig
# Copyright (c) 2020 Kalyan Sriram
# SPDX-License-Identifier: Apache-2.0

# F401CE based Black Pill V3.0+ board board configuration

config SPI_STM32_INTERRUPT
	default y
	depends on SPI
```

## boards/arm/blackpill_f401ce/blackpill_f401ce_defconfig
```kconfig
# SPDX-License-Identifier: Apache-2.0

CONFIG_SOC_SERIES_STM32F4X=y
CONFIG_SOC_STM32F401XE=y

# Enable MPU
CONFIG_ARM_MPU=y

# Enable HW stack protection
CONFIG_HW_STACK_PROTECTION=y

# Serial Drivers
CONFIG_SERIAL=y
CONFIG_UART_INTERRUPT_DRIVEN=y
CONFIG_CONSOLE=y
CONFIG_UART_CONSOLE=y

# Enable GPIO
CONFIG_GPIO=y

# Clock configuration
CONFIG_CLOCK_CONTROL=y

# enable pin controller
CONFIG_PINCTRL=y
```

## boards/arm/blackpill_f411ce/Kconfig.blackpill_f411ce
```kconfig
# Copyright (c) 2022 Zephyr Project members and individual contributors
# SPDX-License-Identifier: Apache-2.0

config BOARD_BLACKPILL_F411CE
	bool
	default y
	select SOC_SERIES_STM32F4X
	select SOC_STM32F411XE
```

## boards/arm/blackpill_f411ce/Kconfig.board
```kconfig
# Copyright (c) 2020 Brian Bradley
# SPDX-License-Identifier: Apache-2.0

# STM32F411CE based Black Pill V2.0+ board configuration

config BOARD_BLACKPILL_F411CE
	bool "WeAct Studio Black Pill V2.0+ Board"
	depends on SOC_STM32F411XE
```

## boards/arm/blackpill_f411ce/Kconfig.defconfig
```kconfig
# Copyright (c) 2020 Brian Bradley
# SPDX-License-Identifier: Apache-2.0

# F411CE based Black Pill V2.0+ board board configuration

if BOARD_BLACKPILL_F411CE

config BOARD
	default "blackpill_f411ce"

config SPI_STM32_INTERRUPT
	default y
	depends on SPI

endif # BOARD_BLACKPILL_F411CE
```

## boards/arm/blackpill_f411ce/blackpill_f411ce_defconfig
```kconfig
# SPDX-License-Identifier: Apache-2.0

CONFIG_SOC_SERIES_STM32F4X=y
CONFIG_SOC_STM32F411XE=y
# 96MHz system clock (highest value to get a precise USB clock should be 96MHz)
CONFIG_SYS_CLOCK_HW_CYCLES_PER_SEC=96000000

# Enable MPU
CONFIG_ARM_MPU=y

# Enable HW stack protection
CONFIG_HW_STACK_PROTECTION=y

# Serial Drivers
CONFIG_SERIAL=y
CONFIG_UART_INTERRUPT_DRIVEN=y
CONFIG_CONSOLE=y
CONFIG_UART_CONSOLE=y

# Enable pinmux
CONFIG_PINMUX=y

# Enable GPIO
CONFIG_GPIO=y

# Clock configuration
CONFIG_CLOCK_CONTROL=y
# SYSCLK selection
CONFIG_CLOCK_STM32_SYSCLK_SRC_PLL=y
# HSE configuration
CONFIG_CLOCK_STM32_HSE_CLOCK=25000000
# use HSE as PLL input
CONFIG_CLOCK_STM32_PLL_SRC_HSE=y
# Produce 96MHz clock at PLL output
CONFIG_CLOCK_STM32_PLL_M_DIVISOR=25
CONFIG_CLOCK_STM32_PLL_N_MULTIPLIER=192
CONFIG_CLOCK_STM32_PLL_P_DIVISOR=2
# Produce 48 MHz clock for USB
CONFIG_CLOCK_STM32_PLL_Q_DIVISOR=4
CONFIG_CLOCK_STM32_AHB_PRESCALER=1
CONFIG_CLOCK_STM32_APB1_PRESCALER=2
CONFIG_CLOCK_STM32_APB2_PRESCALER=1
```

## boards/arm/blueclover_plt_demo_v2_nrf52832/Kconfig.blueclover_plt_demo_v2_nrf52832
```kconfig
# Copyright (c) 2022 Zephyr Project members and individual contributors
# SPDX-License-Identifier: Apache-2.0

config BOARD_BLUECLOVER_PLT_DEMO_V2_NRF52832
	bool
	default y
	select SOC_SERIES_NRF52X
	select SOC_NRF52832_QFAA
```

## boards/arm/blueclover_plt_demo_v2_nrf52832/Kconfig.board
```kconfig
# Blue Clover PLT Demo V2 Configuration

# Copyright (c) 2021 Blue Clover
# SPDX-License-Identifier: Apache-2.0

config BOARD_BLUECLOVER_PLT_DEMO_V2_NRF52832
	bool "Blue Clover PLT Demo Board V2"
	depends on SOC_NRF52832_QFAA
```

## boards/arm/blueclover_plt_demo_v2_nrf52832/Kconfig.defconfig
```kconfig
# Blue Clover PLT Demo V2 Configuration

# Copyright (c) 2021 Blue Clover
# SPDX-License-Identifier: Apache-2.0

config BT_CTLR
	default BT

config I2C
	default SENSOR
```

## boards/arm/blueclover_plt_demo_v2_nrf52832/blueclover_plt_demo_v2_nrf52832_defconfig
```kconfig
# Kconfig - Blue Clover PLT Demo V2 Configuration
#
# Copyright (c) 2021 Blue Clover
#
# SPDX-License-Identifier: Apache-2.0

CONFIG_SOC_SERIES_NRF52X=y
CONFIG_SOC_NRF52832_QFAA=y
CONFIG_BOARD_BLUECLOVER_PLT_DEMO_V2_NRF52832=y

# Enable MPU
CONFIG_ARM_MPU=y

# Enable RTT
CONFIG_USE_SEGGER_RTT=y

# enable GPIO
CONFIG_GPIO=y

# enable uart driver
CONFIG_SERIAL=y

# enable console
CONFIG_CONSOLE=y
CONFIG_UART_CONSOLE=y

# additional board options
CONFIG_GPIO_AS_PINRESET=y

CONFIG_PINCTRL=y
```

## boards/arm/blufdali_nrf52840/Kconfig
```kconfig
# dalibluf nRF52840 board configuration

# Copyright (c) 2021 innblue

config BOARD_ENABLE_DCDC
	bool "Enable DCDC mode"
	select SOC_DCDC_NRF52X
	default y
	depends on BOARD_BLUFDALI_NRF52840
```

## boards/arm/blufdali_nrf52840/Kconfig.board
```kconfig
# blufdali nRF52840 board configuration

# Copyright (c) 2021 innblue

config BOARD_BLUFDALI_NRF52840
	bool "blufdali NRF52840"
	depends on SOC_NRF52840_QIAA
```

## boards/arm/blufdali_nrf52840/Kconfig.defconfig
```kconfig
# dalibluf nRF52840 board configuration
# Copyright (c) 2021 innblue
#
# dali2/sr board
# F = full assembly


if BOARD_BLUFDALI_NRF52840

config BOARD
	default "blufdali_nrf52840"

if USB

config USB_NRFX
	default y

config USB_DEVICE_STACK
	default y

endif # USB

config BT_CTLR
	default BT

endif # BOARD_BLUFDALI_NRF52840
```

## boards/arm/blufdali_nrf52840/blufdali_nrf52840_defconfig
```kconfig
# blufdali nRF52840 board configuration

# Copyright (c) 2021 innblue

CONFIG_SOC_SERIES_NRF52X=y
CONFIG_SOC_NRF52840_QIAA=y
CONFIG_BOARD_BLUFDALI_NRF52840=y

# Enable MPU
CONFIG_ARM_MPU=y

# Enable hardware stack protection
CONFIG_HW_STACK_PROTECTION=y

# Enable RTT
CONFIG_USE_SEGGER_RTT=y

# enable GPIO
CONFIG_GPIO=y

# enable uart driver
CONFIG_SERIAL=y

# enable console
CONFIG_CONSOLE=y
CONFIG_UART_CONSOLE=n

# additional board options
CONFIG_GPIO_AS_PINRESET=y

#board specific ppm value
CONFIG_CLOCK_CONTROL_NRF_K32SRC_250PPM=y
```

## boards/arm/bmd_345_eval/Kconfig
```kconfig
# Copyright (c) 2021 Linumiz
# SPDX-License-Identifier: Apache-2.0

config BOARD_ENABLE_DCDC
	bool "Enable DCDC mode"
	select SOC_DCDC_NRF52X
	default y
	depends on BOARD_BMD_345_EVAL
```

## boards/arm/bmd_345_eval/Kconfig.board
```kconfig
# Copyright (c) 2021 Linumiz
# SPDX-License-Identifier: Apache-2.0

config BOARD_BMD_345_EVAL
	bool "BMD 345 EVAL"
	depends on SOC_NRF52840_QIAA
```

## boards/arm/bmd_345_eval/Kconfig.defconfig
```kconfig
# EVK BMD 345 board configuration

# Copyright (c) 2021 Linumiz
# SPDX-License-Identifier: Apache-2.0

if BOARD_BMD_345_EVAL

config BOARD
	default "bmd_345_eval"

if USB

config USB_NRFX
	default y

config USB_DEVICE_STACK
	default y

endif # USB

config BT_CTLR
	default BT

endif # BOARD_BMD_345_EVAL
```

## boards/arm/bt510/Kconfig
```kconfig
# BT510 board configuration

# Copyright (c) 2020 Laird Connectivity
# SPDX-License-Identifier: Apache-2.0

config BOARD_ENABLE_DCDC
	bool "Enable DCDC mode"
	select SOC_DCDC_NRF52X
	default y
	depends on BOARD_BT510
```

## boards/arm/bt510/Kconfig.defconfig
```kconfig
# BT510 Sensor configuration

# Copyright (c) 2020 Laird Connectivity
# SPDX-License-Identifier: Apache-2.0

config BT_CTLR
	default BT

config I2C
	default SENSOR
```

## boards/arm/bt510/bt510_defconfig
```kconfig
# SPDX-License-Identifier: Apache-2.0

CONFIG_SOC_SERIES_NRF52X=y
CONFIG_SOC_NRF52840_QIAA=y
CONFIG_BOARD_BT510=y

# Enable MPU
CONFIG_ARM_MPU=y

# Enable RTT
CONFIG_USE_SEGGER_RTT=y

# Enable GPIO
CONFIG_GPIO=y

# Enable uart driver
CONFIG_SERIAL=y

# Enable accelerometer & temperature sensor
CONFIG_I2C=y
CONFIG_SENSOR=y
CONFIG_LIS2DH=y
CONFIG_LIS2DH_TRIGGER_GLOBAL_THREAD=y
CONFIG_LIS2DH_OPER_MODE_LOW_POWER=y
CONFIG_SI7055=y

# Enable magnetoresistive driver
CONFIG_SM351LT=y

# Enable console
CONFIG_CONSOLE=y
CONFIG_UART_CONSOLE=y
CONFIG_RTT_CONSOLE=y

# Additional board options
CONFIG_GPIO_AS_PINRESET=y

# 32KHz clock source
CONFIG_CLOCK_CONTROL_NRF_K32SRC_XTAL=y
CONFIG_CLOCK_CONTROL_NRF_K32SRC_150PPM=y
```

## boards/arm/bt610/Kconfig
```kconfig
# BT610 board configuration

# Copyright (c) 2021 Laird Connectivity
# SPDX-License-Identifier: Apache-2.0

config BOARD_ENABLE_DCDC
	bool "DCDC mode"
	select SOC_DCDC_NRF52X
	default y
	depends on BOARD_BT610
```

## boards/arm/bt610/Kconfig.defconfig
```kconfig
# BT6X0 Sensor configuration

# Copyright (c) 2021 Laird Connectivity
# SPDX-License-Identifier: Apache-2.0

config BT_CTLR
	default BT

config I2C
	default $(dt_compat_on_bus,$(DT_COMPAT_TI_TCA9538),i2c)
```

## boards/arm/bt6x0/Kconfig.board
```kconfig
# BT6X0 board configuration

# Copyright (c) 2021 Laird Connectivity
# SPDX-License-Identifier: Apache-2.0

config BOARD_BT6X0
	bool "BT6X0"
	depends on SOC_NRF52840_QIAA
```

## boards/arm/bt6x0/Kconfig.defconfig
```kconfig
# BT6X0 Sensor configuration

# Copyright (c) 2021 Laird Connectivity
# SPDX-License-Identifier: Apache-2.0

if BOARD_BT6X0

config BOARD
	default "bt6x0"

config IEEE802154_NRF5
	default y
	depends on IEEE802154

config BT_CTLR
	default BT

endif # BOARD_BT6X0
```
