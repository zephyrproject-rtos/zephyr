## boards/arm/atsamr34_xpro/atsamr34_xpro_defconfig
```kconfig
# Copyright (c) 2021 Argentum Systems Ltd.
# SPDX-License-Identifier: Apache-2.0
CONFIG_BUILD_OUTPUT_HEX=y
CONFIG_CONSOLE=y
CONFIG_UART_CONSOLE=y
CONFIG_SERIAL=y
CONFIG_UART_INTERRUPT_DRIVEN=y
CONFIG_GPIO=y
CONFIG_SOC_ATMEL_SAML_XOSC32K=y
CONFIG_SOC_ATMEL_SAML_XOSC32K_AS_MAIN=y
```

## boards/arm/az3166_iotdevkit/Kconfig.board
```kconfig
# MXChip AZ3166 DevKit board configuration

# Copyright (c) 2023 Benjamin Cabé <benjamin@zephyrproject.org>
# SPDX-License-Identifier: Apache-2.0

config BOARD_AZ3166_DEVKIT
	bool "MXChip AZ3166 DevKit"
	depends on SOC_STM32F412RX
```

## boards/arm/az3166_iotdevkit/Kconfig.defconfig
```kconfig
# MXChip AZ3166 DevKit board configuration

# Copyright (c) 2023 Benjamin Cabé <benjamin@zephyrproject.org>
# SPDX-License-Identifier: Apache-2.0

if BOARD_AZ3166_DEVKIT

config BOARD
	default "az3166_devkit"

choice HTS221_TRIGGER_MODE
	default HTS221_TRIGGER_NONE
endchoice

endif # BOARD_AZ3166_DEVKIT
```

## boards/arm/az3166_iotdevkit/az3166_iotdevkit_defconfig
```kconfig
# SPDX-License-Identifier: Apache-2.0

CONFIG_SOC_SERIES_STM32F4X=y
CONFIG_SOC_STM32F412RX=y

# Enable MPU
CONFIG_ARM_MPU=y

# Enable HW stack protection
CONFIG_HW_STACK_PROTECTION=y

CONFIG_SERIAL=y

# console
CONFIG_CONSOLE=y
CONFIG_UART_CONSOLE=y

# enable GPIO ports
CONFIG_GPIO=y

# Enable Clocks
CONFIG_CLOCK_CONTROL=y

# enable pin controller
CONFIG_PINCTRL=y
```

## boards/arm/b_g474e_dpow1/Kconfig.board
```kconfig
# B-G474E-DPOW1 Discovery board configuration

# Copyright 2022 The Chromium OS Authors
# SPDX-License-Identifier: Apache-2.0

config BOARD_B_G474E_DPOW1
	bool "B-G474E-DPOW1 Discovery Board"
	depends on SOC_STM32G474XX
```

## boards/arm/b_g474e_dpow1/Kconfig.defconfig
```kconfig
# B-G474E-DPOW1 Discovery board configuration

# Copyright 2022 The Chromium OS Authors
# SPDX-License-Identifier: Apache-2.0

if BOARD_B_G474E_DPOW1

config BOARD
	default "b_g474e_bpow1"

endif # BOARD_B_G474E_DPOW1
```

## boards/arm/b_g474e_dpow1/b_g474e_dpow1_defconfig
```kconfig
# Copyright 2022 The Chromium OS Authors
#
# SPDX-License-Identifier: Apache-2.0

CONFIG_SOC_SERIES_STM32G4X=y
CONFIG_SOC_STM32G474XX=y

# Serial Drivers
CONFIG_SERIAL=y
CONFIG_UART_INTERRUPT_DRIVEN=y

# enable console
CONFIG_CONSOLE=y
CONFIG_UART_CONSOLE=y

# GPIO Controller
CONFIG_GPIO=y

# Enable Clocks
CONFIG_CLOCK_CONTROL=y

# enable pin controller
CONFIG_PINCTRL=y

# Enable MPU
CONFIG_ARM_MPU=y

# Enable HW stack protection
CONFIG_HW_STACK_PROTECTION=y
```

## boards/arm/b_l072z_lrwan1/Kconfig.b_l072z_lrwan1
```kconfig
# Copyright (c) 2022 Zephyr Project members and individual contributors
# SPDX-License-Identifier: Apache-2.0

config BOARD_B_L072Z_LRWAN1
	bool
	default y
	select SOC_SERIES_STM32L0X
	select SOC_STM32L072XX
```

## boards/arm/b_l072z_lrwan1/Kconfig.board
```kconfig
# Kconfig - STMicroelectronics B-L072Z-LRWAN1 Discovery board configuration
#
# Copyright (c) 2018 Aleksandr Makarov <aleksandr.o.makarov@gmail.com>
#
# SPDX-License-Identifier: Apache-2.0
#

config BOARD_B_L072Z_LRWAN1
	bool "STMicroelectronics B-L072Z-LRWAN1 Discovery kit"
	depends on SOC_STM32L072XX
```

## boards/arm/b_l072z_lrwan1/Kconfig.defconfig
```kconfig
# STMicroelectronics B-L072Z-LRWAN1 Discovery board configuration

# Copyright (c) 2018 Aleksandr Makarov <aleksandr.o.makarov@gmail.com>
# SPDX-License-Identifier: Apache-2.0

choice COUNTER_RTC_STM32_CLOCK_SRC
	default COUNTER_RTC_STM32_CLOCK_LSE
	depends on COUNTER

endchoice # COUNTER_RTC_STM32_CLOCK_SRC
```

## boards/arm/b_l072z_lrwan1/b_l072z_lrwan1_defconfig
```kconfig
# SPDX-License-Identifier: Apache-2.0

# Zephyr Kernel Configuration
CONFIG_SOC_SERIES_STM32L0X=y

# Platform Configuration
CONFIG_SOC_STM32L072XX=y
CONFIG_BOARD_B_L072Z_LRWAN1=y

# Enable MPU
CONFIG_ARM_MPU=y

# Enable Clocks
CONFIG_CLOCK_CONTROL=y

# Serial Drivers
CONFIG_SERIAL=y
CONFIG_UART_INTERRUPT_DRIVEN=y
# enable console
CONFIG_CONSOLE=y
CONFIG_UART_CONSOLE=y

# GPIO Controller
CONFIG_GPIO=y

# enable pin controller
CONFIG_PINCTRL=y
```

## boards/arm/b_l4s5i_iot01a/Kconfig.b_l4s5i_iot01a
```kconfig
# Copyright (c) 2022 Zephyr Project members and individual contributors
# SPDX-License-Identifier: Apache-2.0

config BOARD_B_L4S5I_IOT01A
	bool
	default y
	select SOC_SERIES_STM32L4X
	select SOC_STM32L4S5XX
```

## boards/arm/b_l4s5i_iot01a/Kconfig.board
```kconfig
# B_L4S5I_IOT01A discovery kit configuration

# Copyright (c) 2020 STMicroelectronics
# SPDX-License-Identifier: Apache-2.0

config BOARD_B_L4S5I_IOT01A
	bool "STM32L4S5I IOT Discovery kit"
	depends on SOC_STM32L4S5XX
```

## boards/arm/b_l4s5i_iot01a/b_l4s5i_iot01a_defconfig
```kconfig
# SPDX-License-Identifier: Apache-2.0

CONFIG_SOC_SERIES_STM32L4X=y
CONFIG_SOC_STM32L4S5XX=y
# 80MHz system clock
CONFIG_SYS_CLOCK_HW_CYCLES_PER_SEC=80000000

# enable uart driver
CONFIG_SERIAL=y

# enable pinmux
CONFIG_PINMUX=y

# enable GPIO
CONFIG_GPIO=y

# clock configuration
CONFIG_CLOCK_CONTROL=y
# SYSCLK selection
CONFIG_CLOCK_STM32_SYSCLK_SRC_PLL=y

# Use HSI (16MHz) to feed into PLL
CONFIG_CLOCK_STM32_PLL_SRC_HSI=y

# PLL configuration
CONFIG_CLOCK_STM32_PLL_M_DIVISOR=4
CONFIG_CLOCK_STM32_PLL_P_DIVISOR=2
CONFIG_CLOCK_STM32_PLL_Q_DIVISOR=2
CONFIG_CLOCK_STM32_PLL_R_DIVISOR=2

# Produce 80MHz clock at PLLCLK output
CONFIG_CLOCK_STM32_PLL_N_MULTIPLIER=40

# Produce Max (80MHz) HCLK
CONFIG_CLOCK_STM32_AHB_PRESCALER=1

# Produce Max (80MHz) APB1 clocks and APB2 clocks
CONFIG_CLOCK_STM32_APB1_PRESCALER=1
CONFIG_CLOCK_STM32_APB2_PRESCALER=1

# console
CONFIG_CONSOLE=y
CONFIG_UART_CONSOLE=y
```

## boards/arm/b_u585i_iot02a/Kconfig.b_u585i_iot02a_ns
```kconfig
# Copyright (c) 2022 Zephyr Project members and individual contributors
# SPDX-License-Identifier: Apache-2.0

config BOARD_B_U585I_IOT02A_NS
	bool
	default y
	select SOC_SERIES_STM32U5X
	select SOC_STM32U585XX
```

## boards/arm/b_u585i_iot02a/Kconfig.board
```kconfig
# B_U585I_IOT02A discovery kit configuration

# Copyright (c) 2021 STMicroelectronics
# SPDX-License-Identifier: Apache-2.0

config BOARD_B_U585I_IOT02A
	bool "STM32U585I IOT Discovery kit"
	depends on SOC_STM32U585XX
```

## boards/arm/b_u585i_iot02a/Kconfig.defconfig
```kconfig
# B_U585I_IOT02A discovery kit board configuration

# Copyright (c) 2021 STMicroelectronics
# SPDX-License-Identifier: Apache-2.0

if BOARD_B_U585I_IOT02A

config BOARD
	default "b_u585i_iot02a"

config SPI_STM32_INTERRUPT
	default y
	depends on SPI

# Get flash configuration for NS image from dts flash partition
config USE_DT_CODE_PARTITION
	default y if TRUSTED_EXECUTION_NONSECURE

endif # BOARD_B_U585I_IOT02A
```

## boards/arm/b_u585i_iot02a/b_u585i_iot02a_defconfig
```kconfig
# SPDX-License-Identifier: Apache-2.0

CONFIG_SOC_SERIES_STM32U5X=y
CONFIG_SOC_STM32U585XX=y

# enable uart driver
CONFIG_SERIAL=y

# enable GPIO
CONFIG_GPIO=y

# Enable Clocks
CONFIG_CLOCK_CONTROL=y

# console
CONFIG_CONSOLE=y
CONFIG_UART_CONSOLE=y

# enable pin controller
CONFIG_PINCTRL=y
```

## boards/arm/bbc_microbit/Kconfig.board
```kconfig
# nRF51 BBC_MICROBIT board configuration

# Copyright (c) 2016 Nordic Semiconductor ASA.
# SPDX-License-Identifier: Apache-2.0

config BOARD_BBC_MICROBIT
	def_bool "$(BOARD)" = "bbc_microbit"
	depends on SOC_NRF51822_QFAA
```

## boards/arm/bbc_microbit/Kconfig.defconfig
```kconfig
# nRF51 BBC_MICROBIT board configuration

# Copyright (c) 2016 Nordic Semiconductor ASA
# SPDX-License-Identifier: Apache-2.0

if BOARD_BBC_MICROBIT

config BOARD
	default "bbc_microbit"

config BT_CTLR
	default BT

if FXOS8700

choice FXOS8700_MODE
	default FXOS8700_MODE_ACCEL
endchoice

endif # FXOS8700

endif # BOARD_BBC_MICROBIT
```

## boards/arm/bbc_microbit/bbc_microbit_defconfig
```kconfig
CONFIG_ARM=y
CONFIG_SOC_FAMILY_NRF=y
CONFIG_SOC_SERIES_NRF51X=y
CONFIG_SOC_NRF51822_QFAA=y
CONFIG_BOARD_BBC_MICROBIT=y

# clock control
CONFIG_CLOCK_CONTROL_NRF5_K32SRC_RC=y
CONFIG_CLOCK_CONTROL_NRF5_K32SRC_250PPM=y

# enable uart driver
CONFIG_SERIAL=y
CONFIG_UART_NRFX=y
CONFIG_UART_0_NRF_UART=y

# enable console
CONFIG_CONSOLE=y
CONFIG_UART_CONSOLE=y

# bluetooth
CONFIG_BT=y
CONFIG_BT_CTLR=y

# logging
CONFIG_LOG_BUFFER_SIZE=128
```

## boards/arm/bbc_microbit_v2/Kconfig.board
```kconfig
# nRF52 BBC_MICROBIT_V2 board configuration

# Copyright (c) 2020 Lingao Meng
# SPDX-License-Identifier: Apache-2.0

config BOARD_BBC_MICROBIT_V2
	bool "BBC MICRO:BIT_V2"
	depends on SOC_NRF52833_QIAA
```

## boards/arm/bbc_microbit_v2/Kconfig.defconfig
```kconfig
# nRF52 BBC_MICROBIT_V2 board configuration

# Copyright (c) 2020 Lingao Meng
# SPDX-License-Identifier: Apache-2.0

config BT_CTLR
	default BT
```

## boards/arm/bbc_microbit_v2/bbc_microbit_v2_defconfig
```kconfig
# SPDX-License-Identifier: Apache-2.0

CONFIG_SOC_SERIES_NRF52X=y
CONFIG_SOC_NRF52833_QIAA=y
CONFIG_BOARD_BBC_MICROBIT_V2=y

# enable GPIO
CONFIG_GPIO=y

# clock control
CONFIG_CLOCK_CONTROL_NRF_K32SRC_RC=y
CONFIG_CLOCK_CONTROL_NRF_K32SRC_250PPM=y

# enable uart driver
CONFIG_SERIAL=y

# enable console
CONFIG_CONSOLE=y
CONFIG_UART_CONSOLE=y
```

## boards/arm/bcm958401m2/Kconfig.bcm958401m2
```kconfig
# Copyright (c) 2022 Zephyr Project members and individual contributors
# SPDX-License-Identifier: Apache-2.0

config BOARD_BCM958401M2
	bool
	default y
	select SOC_SERIES_VALKYRIE
	select SOC_BCM58400
```
