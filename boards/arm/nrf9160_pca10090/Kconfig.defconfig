## boards/arm/nrf9160_pca10090/Kconfig.defconfig
```kconfig
# Kconfig - nRF91 PCA10090 board configuration
#
# Copyright (c) 2018 Nordic Semiconductor ASA
#
# SPDX-License-Identifier: Apache-2.0

if BOARD_NRF9160_PCA10090 || BOARD_NRF9160_PCA10090NS

config BOARD
	default "nrf9160_pca10090"

if ADC

config ADC_0
	default y

endif # ADC

if I2C

config I2C_2
	default y

endif # I2C

if PWM

config PWM_0
	default y

endif # PWM

if SPI

config SPI_3
	default y

endif # SPI

# For the secure version of the board the firmware is linked at the beginning
# of the flash, or into the code-partition defined in DT if it is intended to
# be loaded by MCUboot. If the secure firmware is to be combined with a non-
# secure image (TRUSTED_EXECUTION_SECURE=y), the secure FW image shall always
# be restricted to the size of its code partition.
# For the non-secure version of the board, the firmware
# must be linked into the code-partition (non-secure) defined in DT, regardless.
# Apply this configuration below by setting the Kconfig symbols used by
# the linker according to the information extracted from DT partitions.

# Workaround for not being able to have commas in macro arguments
DT_CHOSEN_Z_CODE_PARTITION := zephyr,code-partition

if BOARD_NRF9160_PCA10090 && TRUSTED_EXECUTION_SECURE

config FLASH_LOAD_SIZE
	default $(dt_chosen_reg_size_hex,$(DT_CHOSEN_Z_CODE_PARTITION))

endif # BOARD_NRF9160_PCA10090 && TRUSTED_EXECUTION_SECURE

if BOARD_NRF9160_PCA10090NS

config FLASH_LOAD_OFFSET
	default $(dt_chosen_reg_addr_hex,$(DT_CHOSEN_Z_CODE_PARTITION))

config FLASH_LOAD_SIZE
	default $(dt_chosen_reg_size_hex,$(DT_CHOSEN_Z_CODE_PARTITION))

endif # BOARD_NRF9160_PCA10090NS

endif # BOARD_NRF9160_PCA10090 || BOARD_NRF9160_PCA10090NS
```

## boards/arm/nrf9160_pca10090/nrf9160_pca10090ns_defconfig
```kconfig
# SPDX-License-Identifier: Apache-2.0

CONFIG_ARM=y
CONFIG_SOC_FAMILY_NRF=y
CONFIG_SOC_SERIES_NRF91X=y
CONFIG_SOC_NRF9160_SICA=y
CONFIG_BOARD_NRF9160_PCA10090NS=y

# Enable MPU
CONFIG_ARM_MPU=y

# Enable TrustZone-M
CONFIG_ARM_TRUSTZONE_M=y

# This Board implies building Non-Secure firmware
CONFIG_TRUSTED_EXECUTION_NONSECURE=y

# enable GPIO
CONFIG_GPIO=y

# Enable uart driver
CONFIG_SERIAL=y
CONFIG_UART_0_NRF_UARTE=y

# enable console
CONFIG_CONSOLE=y
CONFIG_UART_CONSOLE=y
```

## boards/arm/nrf9160dk_nrf52840/Kconfig
```kconfig
# nRF9160 DK NRF52840 board configuration

# Copyright (c) 2018-2020 Nordic Semiconductor ASA
# SPDX-License-Identifier: Apache-2.0

if BOARD_NRF9160DK_NRF52840

config BOARD_ENABLE_DCDC
	bool "Enable DCDC mode"
	select SOC_DCDC_NRF52X
	default y

module = BOARD_NRF9160DK
module-str = Board Control
source "subsys/logging/Kconfig.template.log_config"

endif # BOARD_NRF52840_NRF9160DK
```

## boards/arm/nrf9160dk_nrf52840/Kconfig.board
```kconfig
# nRF9160 DK NRF52840 board configuration

# Copyright (c) 2018-2020 Nordic Semiconductor ASA
# SPDX-License-Identifier: Apache-2.0

config BOARD_NRF9160DK_NRF52840
	bool "NRF9160 DK NRF52840"
	depends on SOC_NRF52840_QIAA
	# The GPIO driver is required by this board's initialization code
	# (board.c), so it is forced here to be enabled always, not only
	# enabled by default (in defconfig).
	select GPIO
```

## boards/arm/nrf9160dk_nrf52840/Kconfig.defconfig
```kconfig
# nRF9160 DK NRF52840 board configuration

# Copyright (c) 2018 Nordic Semiconductor ASA
# SPDX-License-Identifier: Apache-2.0

config BT_CTLR
	default BT

config BT_WAIT_NOP
	default BT && $(dt_nodelabel_enabled,reset_input)
```

## boards/arm/nrf9160dk_nrf52840/dts/bindings/nordic,nrf9160dk-optional-routing.yaml
```yaml
# Copyright 2021 Nordic Semiconductor ASA
# SPDX-License-Identifier: Apache-2.0

description: nRF9160 DK optional routing provided by analog switch

compatible: "nordic,nrf9160dk-optional-routing"

include: base.yaml

properties:
  status:
    required: true

  control-gpios:
    type: phandle-array
    required: true
    description: |
      GPIO to use to control the analog switch.
```

## boards/arm/nrf9160dk_nrf52840/nrf9160dk_nrf52840_defconfig
```kconfig
# SPDX-License-Identifier: Apache-2.0

CONFIG_SOC_SERIES_NRF52X=y
CONFIG_SOC_NRF52840_QIAA=y
CONFIG_BOARD_NRF9160DK_NRF52840=y

# Enable MPU
CONFIG_ARM_MPU=y

# Enable hardware stack protection
CONFIG_HW_STACK_PROTECTION=y

# enable uart driver
CONFIG_SERIAL=y
CONFIG_UART_NRFX=y

# enable console
CONFIG_CONSOLE=y
CONFIG_UART_CONSOLE=y

# additional board options
CONFIG_GPIO_AS_PINRESET=y

CONFIG_PINCTRL=y
```

## boards/arm/nrf9160dk_nrf9160/Kconfig
```kconfig
# nRF9160 DK board configuration

# Copyright (c) 2018 Nordic Semiconductor ASA
# SPDX-License-Identifier: Apache-2.0

config BOARD_NRF52840_GPIO_RESET
	bool "Use nRF52840 GPIO reset pin"
	default y if BT_H4
	depends on BOARD_NRF9160DK_NRF9160 || BOARD_NRF9160DK_NRF9160NS
	help
	  Use a GPIO pin to reset the nRF52840 controller and let it wait until all
	  bytes traveling to the H4 device have been received and drained, thus
	  ensuring communication can begin correctly.

config BOARD_NRF52840_GPIO_RESET_PIN
	int "Reset pin"
	range 17 23
	default 23
	depends on BOARD_NRF52840_GPIO_RESET
	help
	  GPIO pin on the nRF9160 used to reset the nRF52840.
```

## boards/arm/nrf9160dk_nrf9160/Kconfig.board
```kconfig
# nRF9160 DK NRF9160 board configuration

# Copyright (c) 2018-2020 Nordic Semiconductor ASA
# SPDX-License-Identifier: Apache-2.0

if SOC_NRF9160_SICA

config BOARD_NRF9160DK_NRF9160
	bool "nRF9160 DK NRF9160"

config BOARD_NRF9160DK_NRF9160_NS
	bool "nRF9160 DK NRF9160 non-secure"

endif # SOC_NRF9160_SICA
```

## boards/arm/nrf9160dk_nrf9160/Kconfig.defconfig
```kconfig
# nRF9160 DK NRF9160 board configuration

# Copyright (c) 2018-2020 Nordic Semiconductor ASA
# SPDX-License-Identifier: Apache-2.0

if BOARD_NRF9160DK_NRF9160 || BOARD_NRF9160DK_NRF9160_NS

config BOARD
	default "nrf9160dk_nrf9160"

# By default, if we build for a Non-Secure version of the board,
# enable building with TF-M as the Secure Execution Environment.
config BUILD_WITH_TFM
	default y if BOARD_NRF9160DK_NRF9160_NS

if BUILD_WITH_TFM

# By default, if we build with TF-M, instruct build system to
# flash the combined TF-M (Secure) & Zephyr (Non Secure) image
config TFM_FLASH_MERGED_BINARY
	bool
	default y

endif # BUILD_WITH_TFM

# For the secure version of the board the firmware is linked at the beginning
# of the flash, or into the code-partition defined in DT if it is intended to
# be loaded by MCUboot. If the secure firmware is to be combined with a non-
# secure image (TRUSTED_EXECUTION_SECURE=y), the secure FW image shall always
# be restricted to the size of its code partition.
# For the non-secure version of the board, the firmware
# must be linked into the code-partition (non-secure) defined in DT, regardless.
# Apply this configuration below by setting the Kconfig symbols used by
# the linker according to the information extracted from DT partitions.

# Workaround for not being able to have commas in macro arguments
DT_CHOSEN_Z_CODE_PARTITION := zephyr,code-partition

config FLASH_LOAD_SIZE
	default $(dt_chosen_reg_size_hex,$(DT_CHOSEN_Z_CODE_PARTITION))
	depends on BOARD_NRF9160DK_NRF9160 && TRUSTED_EXECUTION_SECURE

if BOARD_NRF9160DK_NRF9160_NS

config FLASH_LOAD_OFFSET
	default $(dt_chosen_reg_addr_hex,$(DT_CHOSEN_Z_CODE_PARTITION))

config FLASH_LOAD_SIZE
	default $(dt_chosen_reg_size_hex,$(DT_CHOSEN_Z_CODE_PARTITION))

endif # BOARD_NRF9160DK_NRF9160_NS

config BT_HCI_VS
	default y if BT

config BT_WAIT_NOP
	default BT && $(dt_nodelabel_enabled,nrf52840_reset)

# Workaround for not being able to have commas in macro arguments
DT_COMPAT_NXP_PCAL6408A := nxp,pcal6408a

config I2C
	default $(dt_compat_on_bus,$(DT_COMPAT_NXP_PCAL6408A),i2c)

endif # BOARD_NRF9160DK_NRF9160 || BOARD_NRF9160DK_NRF9160_NS
```

## boards/arm/nrf9160dk_nrf9160/Kconfig.nrf9160dk_nrf9160_ns
```kconfig
# Copyright (c) 2022 Zephyr Project members and individual contributors
# SPDX-License-Identifier: Apache-2.0

config BOARD_NRF9160DK_NRF9160_NS
	bool
	default y
	select SOC_NRF9160_SICA
	select SOC_SERIES_NRF91X
	select SOC_NRF9160_SICA
```

## boards/arm/nrf9160dk_nrf9160/nrf9160dk_nrf9160_defconfig
```kconfig
# SPDX-License-Identifier: Apache-2.0

CONFIG_SOC_SERIES_NRF91X=y
CONFIG_SOC_NRF9160_SICA=y
CONFIG_BOARD_NRF9160DK_NRF9160=y

# Enable MPU
CONFIG_ARM_MPU=y

# Enable TrustZone-M
CONFIG_ARM_TRUSTZONE_M=y

# enable GPIO
CONFIG_GPIO=y

# Enable uart driver
CONFIG_SERIAL=y
CONFIG_UART_0_NRF_UARTE=y

# enable console
CONFIG_CONSOLE=y
CONFIG_UART_CONSOLE=y
```

## boards/arm/nrf9161dk_nrf9161/Kconfig.board
```kconfig
# nRF9161 DK NRF9161 board configuration

# Copyright (c) 2023 Nordic Semiconductor ASA
# SPDX-License-Identifier: Apache-2.0

if SOC_NRF9161_SICA

config BOARD_NRF9161DK_NRF9161
	bool "nRF9161 DK NRF9161"

config BOARD_NRF9161DK_NRF9161_NS
	bool "nRF9161 DK NRF9161 non-secure"

endif # SOC_NRF9161_SICA
```

## boards/arm/nucleo_f030r8/Kconfig.board
```kconfig
# STM32 Nucleo-64 development board with STM32F030R8 MCU configuration

# Copyright (c) 2017 RnDity Sp. z o.o.
# SPDX-License-Identifier: Apache-2.0

config BOARD_NUCLEO_F030R8
	bool "NUCLEO-64 F030R8 Development Board"
	depends on SOC_STM32F030X8
```

## boards/arm/nucleo_f030r8/Kconfig.defconfig
```kconfig
# STM32 Nucleo-64 development board with STM32F030R8 MCU

# Copyright (c) 2017 RnDity Sp. z o.o.
# SPDX-License-Identifier: Apache-2.0

if BOARD_NUCLEO_F030R8

config BOARD
	default "nucleo_f030r8"

endif # BOARD_NUCLEO_F030R8
```

## boards/arm/nucleo_f030r8/Kconfig.nucleo_f030r8
```kconfig
# Copyright (c) 2022 Zephyr Project members and individual contributors
# SPDX-License-Identifier: Apache-2.0

config BOARD_NUCLEO_F030R8
	bool
	default y
	select SOC_SERIES_STM32F0X
	select SOC_STM32F030X8
```

## boards/arm/nucleo_f030r8/nucleo_f030r8_defconfig
```kconfig
# Zephyr Kernel Configuration
CONFIG_ARM=y
CONFIG_SOC_SERIES_STM32F0X=y

# Platform Configuration
CONFIG_SOC_STM32F030X8=y
CONFIG_BOARD_NUCLEO_F030R8=y

# General Kernel Options
CONFIG_CORTEX_M_SYSTICK=y
CONFIG_SYS_CLOCK_HW_CYCLES_PER_SEC=48000000

# Kernel Options due to Low Memory (8k)
CONFIG_MAIN_STACK_SIZE=640
CONFIG_IDLE_STACK_SIZE=200
CONFIG_ISR_STACK_SIZE=512
# Prevent Interrupt Vector Table in RAM
CONFIG_IS_BOOTLOADER=y
CONFIG_BOOTLOADER_SRAM_SIZE=8

# Serial Drivers
CONFIG_SERIAL=y
CONFIG_UART_INTERRUPT_DRIVEN=y
# enable console
CONFIG_CONSOLE=y
CONFIG_UART_CONSOLE=y

# Pinmux Driver
CONFIG_PINMUX=y

# GPIO Controller
CONFIG_GPIO=y

# Clock configuration
CONFIG_CLOCK_CONTROL=y
# SYSCLK selection
CONFIG_CLOCK_STM32_SYSCLK_SRC_PLL=y
# HSE configuration
CONFIG_CLOCK_STM32_HSE_CLOCK=8000000
# however, the board does not have an external oscillator, so just use
# the 8MHz clock signal coming from integrated STLink
CONFIG_CLOCK_STM32_HSE_BYPASS=y
# PLL configuration
CONFIG_CLOCK_STM32_PLL_SRC_HSE=y
# produce 48MHz clock at PLL output
CONFIG_CLOCK_STM32_PLL_PREDIV=1
CONFIG_CLOCK_STM32_PLL_MULTIPLIER=6
CONFIG_CLOCK_STM32_AHB_PRESCALER=1
CONFIG_CLOCK_STM32_APB1_PRESCALER=1
```

## boards/arm/nucleo_f031k6/Kconfig.board
```kconfig
# STM32 Nucleo-32 development board with STM32F031K6 MCU configuration

# Copyright (c) 2021 Sebastian Schwabe <sebastian.schwabe@mailbox.tu-dresden.de>
# SPDX -License-Identifier: Apache-2.0

config BOARD_NUCLEO_F031K6
	bool "NUCLEO-32 F031K6 Development Board"
	depends on SOC_STM32F031X6
```

## boards/arm/nucleo_f031k6/Kconfig.defconfig
```kconfig
# STM32 Nucleo-32 development board with STM32F031K6 MCU

# Copyright (c) 2021 Sebastian Schwabe <sebastian.schwabe@mailbox.tu-dresden.de>
# SPDX-License-Identifier: Apache-2.0

if BOARD_NUCLEO_F031K6

config BOARD
	default "nucleo_f031k6"

endif # BOARD_NUCLEO_F031K6
```

## boards/arm/nucleo_f031k6/Kconfig.nucleo_f031k6
```kconfig
# Copyright (c) 2022 Zephyr Project members and individual contributors
# SPDX-License-Identifier: Apache-2.0

config BOARD_NUCLEO_F031K6
	bool
	default y
	select SOC_SERIES_STM32F0X
	select SOC_STM32F031X6
```

## boards/arm/nucleo_f031k6/nucleo_f031k6_defconfig
```kconfig
# SPDX-License-Identifier: Apache-2.0

# Platform Configuration
CONFIG_SOC_SERIES_STM32F0X=y
CONFIG_SOC_STM32F031X6=y

# Kernel Options due to Low Memory (4k)
CONFIG_MAIN_STACK_SIZE=512
CONFIG_IDLE_STACK_SIZE=150
CONFIG_ISR_STACK_SIZE=512
CONFIG_LOG_BUFFER_SIZE=256
# Prevent Interrupt Vector Table in RAM
CONFIG_SRAM_VECTOR_TABLE=n

# Serial Drivers
CONFIG_SERIAL=y
CONFIG_UART_INTERRUPT_DRIVEN=y
# enable console
CONFIG_CONSOLE=y
CONFIG_UART_CONSOLE=y

# GPIO Controller
CONFIG_GPIO=y

# Enable Clocks
CONFIG_CLOCK_CONTROL=y

# enable pin controller
CONFIG_PINCTRL=y
```

## boards/arm/nucleo_f042k6/Kconfig.board
```kconfig
# STM32 Nucleo-32 development board with STM32F031K6 MCU configuration

# Copyright (c) 2023 STMicroelectronics

# SPDX -License-Identifier: Apache-2.0

config BOARD_NUCLEO_F042K6
	bool "NUCLEO-32 F042K6 Development Board"
	depends on SOC_STM32F042X6
```

## boards/arm/nucleo_f042k6/Kconfig.defconfig
```kconfig
# STM32 Nucleo-32 development board with STM32F042K6 MCU

# Copyright (c) 2023 STMicroelectronics

# SPDX-License-Identifier: Apache-2.0

if BOARD_NUCLEO_F042K6

config BOARD
	default "nucleo_f042k6"

endif # BOARD_NUCLEO_F042K6
```

## boards/arm/nucleo_f070rb/Kconfig.board
```kconfig
# NUCLEO_F070RB board configuration

# Copyright (c) 2018 qianfan Zhao
# SPDX-License-Identifier: Apache-2.0

config BOARD_NUCLEO_F070RB
	bool "NUCLEO-64 F070RB Development Board"
	depends on SOC_STM32F070XB
```

## boards/arm/nucleo_f070rb/Kconfig.defconfig
```kconfig
# NUCLEO_F070RB board configuration

# Copyright (c) 2018 qianfan Zhao
# SPDX-License-Identifier: Apache-2.0

if BOARD_NUCLEO_F070RB

config BOARD
	default "nucleo_f070rb"

config SPI_STM32_INTERRUPT
	default y
	depends on SPI

endif # BOARD_NUCLEO_F070RB
```
