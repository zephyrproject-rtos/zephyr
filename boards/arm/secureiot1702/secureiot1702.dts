/*
 * Copyright (c) 2017 Crypta Labs Ltd
 *
 * SPDX-License-Identifier: Apache-2.0
 */

/dts-v1/;

#include "microchip/cec1702.dtsi"

/ {
	model = "Microchip SecureIoT1702 board";
	compatible = "microchip,secureiot1702", "microchip,cec1702";

	chosen {
		zephyr,sram = &sram0;
		zephyr,console = &uart1;
		zephyr,flash = &flash0;
	};
};

&uart0 {
	status = "ok";
	current-speed = <115200>;
};

