/*
 * Copyright (c) 2022, Gerson Fernando Budke <nandojve@gmail.com>
 * SPDX-License-Identifier: Apache-2.0
 */

#include <dt-bindings/pinctrl/samd21-da1gXabcd-pinctrl.h>

&pinctrl {
	sercom4_uart_default: sercom4_uart_default {
		group1 {
			pinmux = <PB9D_SERCOM4_PAD1>,
				 <PB8D_SERCOM4_PAD0>;
		};
	};
};
