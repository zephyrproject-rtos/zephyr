## boards/arm/cc3220sf_launchxl/Kconfig.board
```kconfig
# TI SimpleLink CC3220SF LaunchXL Board

# SPDX-License-Identifier: Apache-2.0

config BOARD_CC3220SF_LAUNCHXL
	def_bool "$(BOARD)" = "cc3220sf_launchxl"
	depends on SOC_CC3220SF
```

## boards/arm/cc3220sf_launchxl/Kconfig.cc3220sf_launchxl
```kconfig
# Copyright (c) 2022 Zephyr Project members and individual contributors
# SPDX-License-Identifier: Apache-2.0

config BOARD_CC3220SF_LAUNCHXL
	bool
	default y
	select SOC_SERIES_CC32XX
	select SOC_CC3220SF
```

## boards/arm/cc3220sf_launchxl/Kconfig.defconfig
```kconfig
# TI CC3220SF LaunchXL board configuration

# SPDX-License-Identifier: Apache-2.0

if BOARD_CC3220SF_LAUNCHXL

config BOARD
	default "cc3220sf_launchxl"

endif # BOARD_CC3220SF_LAUNCHXL
```

## boards/arm/cc3220sf_launchxl/cc3220sf_launchxl_defconfig
```kconfig
# SPDX-License-Identifier: Apache-2.0

CONFIG_BOARD_CC3220SF_LAUNCHXL=y
CONFIG_SOC_SERIES_CC32XX=y
CONFIG_SOC_CC3220SF=y
CONFIG_BUILD_OUTPUT_HEX=y


#enable GPIO driver
CONFIG_GPIO=y

# enable uart driver
CONFIG_SERIAL=y

# enable console
CONFIG_CONSOLE=y
CONFIG_UART_CONSOLE=y
```

## boards/arm/cc3235s_launchxl/Kconfig.board
```kconfig
# TI SimpleLink CC3235S LaunchXL Board

# Copyright (c) 2021 ithinx GmbH
# SPDX-License-Identifier: Apache-2.0

config BOARD_CC3235S_LAUNCHXL
	bool "TI CC3235S LAUNCHXL"
	depends on SOC_CC3235S
```

## boards/arm/cc3235s_launchxl/Kconfig.defconfig
```kconfig
# TI CC3235S LaunchXL board configuration

# Copyright (c) 2021 ithinx GmbH
# SPDX-License-Identifier: Apache-2.0

if BOARD_CC3235S_LAUNCHXL

config BOARD
	default "cc3235s_launchxl"

config I2C_CC32XX
	default y
	depends on I2C

endif # BOARD_CC3235S_LAUNCHXL
```

## boards/arm/cc3235s_launchxl/cc3235s_launchxl_defconfig
```kconfig
# SPDX-License-Identifier: Apache-2.0

CONFIG_BOARD_CC3235S_LAUNCHXL=y
CONFIG_SOC_SERIES_CC32XX=y
CONFIG_SOC_CC3235S=y
CONFIG_BUILD_OUTPUT_HEX=y
CONFIG_CORTEX_M_SYSTICK=y
CONFIG_XIP=n


#enable GPIO driver
CONFIG_GPIO=y

# enable uart driver
CONFIG_SERIAL=y
CONFIG_UART_CC32XX=y

# enable console
CONFIG_CONSOLE=y
CONFIG_UART_CONSOLE=y
```

## boards/arm/cc3235sf_launchxl/Kconfig.board
```kconfig
# TI SimpleLink CC3235SF LaunchXL Board

# Copyright (c) 2019, Texas Instruments Incorporated
# SPDX-License-Identifier: Apache-2.0

config BOARD_CC3235SF_LAUNCHXL
	bool "TI CC3235SF LAUNCHXL"
	depends on SOC_CC3235SF
```

## boards/arm/cc3235sf_launchxl/Kconfig.cc3235sf_launchxl
```kconfig
# Copyright (c) 2022 Zephyr Project members and individual contributors
# SPDX-License-Identifier: Apache-2.0

config BOARD_CC3235SF_LAUNCHXL
	bool
	default y
	select SOC_SERIES_CC32XX
	select SOC_CC3235SF
```

## boards/arm/cc3235sf_launchxl/Kconfig.defconfig
```kconfig
# TI CC3235SF LaunchXL board configuration

# Copyright (c) 2019, Texas Instruments Incorporated
# SPDX-License-Identifier: Apache-2.0

if BOARD_CC3235SF_LAUNCHXL

config BOARD
	default "cc3235sf_launchxl"

config I2C_CC32XX
	default y
	depends on I2C

endif # BOARD_CC3235SF_LAUNCHXL
```

## boards/arm/cc8mnano_dvk/Kconfig.board
```kconfig
# CC8MNANO DVK board

# Copyright (c) 2021, Waseem Hassan
# SPDX-License-Identifier: Apache-2.0

config BOARD_CC8MNANO_DVK
	bool "Digi CC8M Nano DVK"
	depends on SOC_SERIES_IMX8MN_M7
	select SOC_PART_NUMBER_MIMX8MN6DVTJZ
```

## boards/arm/cc8mnano_dvk/Kconfig.defconfig
```kconfig
# CC8MNANO DVK board defconfig

# Copyright (c) 2021, Waseem Hassan
# SPDX-License-Identifier: Apache-2.0

if BOARD_CC8MNANO_DVK

config BOARD
	default "cc8mnano_dvk"

if !XIP
config FLASH_SIZE
	default 0
config FLASH_BASE_ADDRESS
	default 0	
endif

endif # BOARD_CC8MNANO_DVK
```

## boards/arm/cc8mnano_dvk/cc8mnano_dvk_defconfig
```kconfig
#
# Copyright (c) 2021, Waseem Hassan
#
# SPDX-License-Identifier: Apache-2.0
#

CONFIG_SOC_SERIES_IMX8MN_M7=y
CONFIG_SOC_MIMX8MN6=y
CONFIG_BOARD_CC8MNANO_DVK=y
CONFIG_CORTEX_M_SYSTICK=y
CONFIG_CLOCK_CONTROL=y
CONFIG_UART_CONSOLE=y
CONFIG_SERIAL=y
CONFIG_UART_INTERRUPT_DRIVEN=y
CONFIG_CONSOLE=y
CONFIG_XIP=y
```

## boards/arm/circuitdojo_feather_nrf9160/Kconfig.board
```kconfig
# Circuit Dojo nRF9160 Feather configuration

# Copyright (c) 2018-2020 Nordic Semiconductor ASA
# Copyright (c) 2020 Circuit Dojo LLC
# SPDX-License-Identifier: Apache-2.0

if SOC_NRF9160_SICA

config BOARD_CIRCUITDOJO_FEATHER_NRF9160
	bool "Circuit Dojo nRF9160 Feather"

config BOARD_CIRCUITDOJO_FEATHER_NRF9160_NS
	bool "Circuit Dojo nRF9160 Feather non-secure"

endif # SOC_NRF9160_SICA
```

## boards/arm/circuitdojo_feather_nrf9160/circuitdojo_feather_nrf9160_ns_defconfig
```kconfig
# SPDX-License-Identifier: Apache-2.0

CONFIG_SOC_SERIES_NRF91X=y
CONFIG_SOC_NRF9160_SICA=y
CONFIG_BOARD_CIRCUITDOJO_FEATHER_NRF9160_NS=y

# Enable MPU
CONFIG_ARM_MPU=y

# Enable TrustZone-M
CONFIG_ARM_TRUSTZONE_M=y

# This Board implies building Non-Secure firmware
CONFIG_TRUSTED_EXECUTION_NONSECURE=y

# Hardware stack protection
CONFIG_HW_STACK_PROTECTION=y

# enable GPIO
CONFIG_GPIO=y

# Enable uart driver
CONFIG_SERIAL=y

# enable console
CONFIG_CONSOLE=y
CONFIG_UART_CONSOLE=y

# required to enable 3V3 power rail
CONFIG_REGULATOR=y

CONFIG_PINCTRL=y
```

## boards/arm/colibri_imx7d_m4/Kconfig.board
```kconfig
# Colibri iMX7D M4 board

# Copyright (c) 2017, NXP
# SPDX-License-Identifier: Apache-2.0

config BOARD_COLIBRI_IMX7D_M4
	def_bool "$(BOARD)" = "colibri_imx7d_m4"
	depends on SOC_SERIES_IMX7_M4
	select SOC_PART_NUMBER_MCIMX7D5EVM10SC
```

## boards/arm/colibri_imx7d_m4/Kconfig.colibri_imx7d_m4
```kconfig
# Copyright (c) 2022 Zephyr Project members and individual contributors
# SPDX-License-Identifier: Apache-2.0

config BOARD_COLIBRI_IMX7D_M4
	bool
	default y
	select SOC_SERIES_IMX7_M4
	select SOC_MCIMX7_M4
	select SOC_PART_NUMBER_MCIMX7D5EVM10SC
```

## boards/arm/colibri_imx7d_m4/Kconfig.defconfig
```kconfig
# Colibri iMX7D M4 board

# Copyright (c) 2017, NXP
# SPDX-License-Identifier: Apache-2.0

if !XIP
config FLASH_SIZE
	default 0
config FLASH_BASE_ADDRESS
	default 0
endif
```

## boards/arm/colibri_imx7d_m4/colibri_imx7d_m4_defconfig
```kconfig
#
# Copyright (c) 2017, NXP
#
# SPDX-License-Identifier: Apache-2.0
#

CONFIG_UART_CONSOLE=y
CONFIG_SERIAL=y
CONFIG_UART_INTERRUPT_DRIVEN=y
CONFIG_CONSOLE=y
CONFIG_XIP=y
CONFIG_PINCTRL=y
```

## boards/arm/conexio_stratus/Kconfig.board
```kconfig
# Conexio Stratus configuration

# Copyright (c) 2022 Conexio Technologies, Inc
# SPDX-License-Identifier: Apache-2.0

if SOC_NRF9160_SICA

config BOARD_CONEXIO_STRATUS
	bool "Conexio Stratus"

config BOARD_CONEXIO_STRATUS_NS
	bool "Conexio Stratus non-secure"

endif # SOC_NRF9160_SICA
```

## boards/arm/contextualelectronics_abc/Kconfig
```kconfig
# ABC board configuration

# Copyright (c) 2020 Analog Life LLC
# SPDX-License-Identifier: Apache-2.0

config BOARD_ENABLE_DCDC
	bool "DCDC mode"
	select SOC_DCDC_NRF52X
	default y
	depends on BOARD_CONTEXTELEC_ABC
```

## boards/arm/contextualelectronics_abc/Kconfig.board
```kconfig
# ABC board configuration

# Copyright (c) 2020 Analog Life LLC
# SPDX-License-Identifier: Apache-2.0

config BOARD_CONTEXTELEC_ABC
	bool "nRF52840 based Advanced BLE Cell"
	depends on SOC_NRF52840_QIAA
```

## boards/arm/contextualelectronics_abc/Kconfig.defconfig
```kconfig
# nRF52840 BLE Cell board configuration

# Copyright (c) 2020 Bilal Wasim
# SPDX-License-Identifier: Apache-2.0

config BT_CTLR
	default BT
```
