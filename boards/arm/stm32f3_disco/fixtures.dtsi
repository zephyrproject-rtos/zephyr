/*
 * Copyright (c) 2020 Nordic Semiconductor ASA
 *
 * SPDX-License-Identifier: Apache-2.0
 */

/ {
	zephyr,fixture {
		gpio-loopback {
			compatible = "zephyr,fixture,gpio-loopback";
			out-gpios = <&gpioc 6 0>;
			in-gpios = <&gpioc 7 0>;
		};
	};
};
