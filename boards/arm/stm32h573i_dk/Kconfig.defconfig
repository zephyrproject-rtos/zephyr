## boards/arm/stm32h573i_dk/Kconfig.defconfig
```kconfig
# STM32H573I DISCOVERY KIT board configuration
#
# Copyright (c) 2023 STMicroelectronics
#
# SPDX-License-Identifier: Apache-2.0
#

if BOARD_STM32H573I_DK

config BOARD
	default "stm32h573i_dk"

endif # BOARD_STM32H573I_DK
```

## boards/arm/stm32h735g_disco/Kconfig.board
```kconfig
# STM32H735G Discovery board configuration

# Copyright (c) 2021 SILA Embedded Solutions GmbH
# SPDX-License-Identifier: Apache-2.0

config BOARD_STM32H735G_DISCO
	bool "STM32H735G Discovery Development Board"
	depends on SOC_STM32H735XX
```

## boards/arm/stm32h735g_disco/Kconfig.defconfig
```kconfig
# STM32H735G DISCOVERY board configuration

# Copyright (c) 2021 SILA Embedded Solutions GmbH
# SPDX-License-Identifier: Apache-2.0

config SPI_STM32_INTERRUPT
	default y
	depends on SPI
```

## boards/arm/stm32h735g_disco/stm32h735g_disco_defconfig
```kconfig
# SPDX-License-Identifier: Apache-2.0

CONFIG_SOC_SERIES_STM32H7X=y
CONFIG_SOC_STM32H735XX=y

# Enable the internal SMPS regulator
CONFIG_POWER_SUPPLY_DIRECT_SMPS=y

# Enable MPU
CONFIG_ARM_MPU=y

# Enable HW stack protection
CONFIG_HW_STACK_PROTECTION=y

CONFIG_SERIAL=y

# console
CONFIG_CONSOLE=y
CONFIG_UART_CONSOLE=y

# enable GPIO
CONFIG_GPIO=y

# Enable Clocks
CONFIG_CLOCK_CONTROL=y

# enable pin controller
CONFIG_PINCTRL=y
```

## boards/arm/stm32h745i_disco/Kconfig.board
```kconfig
# STM32H745I-Disco board configuration
# Copyright (c) 2022 Systerel (https://www.systerel.fr)
# SPDX-License-Identifier: Apache-2.0

config BOARD_STM32H745I_DISCO_M7
	bool "STM32H745I Discovery Development Board"
	depends on SOC_STM32H745XX
	select CPU_CORTEX_M7

config BOARD_STM32H745I_DISCO_M4
	bool "STM32H745I Discovery Development Board"
	depends on SOC_STM32H745XX
	select CPU_CORTEX_M4
```

## boards/arm/stm32h745i_disco/Kconfig.defconfig
```kconfig
# STM32H745I-Disco board configuration
# Copyright (c) 2022 Systerel (https://www.systerel.fr)
# SPDX-License-Identifier: Apache-2.0

if BOARD_STM32H745I_DISCO_M7 || BOARD_STM32H745I_DISCO_M4

config BOARD
	default "stm32h745i_disco_m7" if BOARD_STM32H745I_DISCO_M7
	default "stm32h745i_disco_m4" if BOARD_STM32H745I_DISCO_M4

config STM32H7_DUAL_CORE
	default y

if NETWORKING

config NET_L2_ETHERNET
	default y

endif # NETWORKING

endif # BOARD_STM32H745I_DISCO_M7 or BOARD_STM32H745I_DISCO_M4
```

## boards/arm/stm32h747i_disco/Kconfig.board
```kconfig
# STM32H747I Discovery development board

# Copyright (c) 2019 Linaro Limited
# SPDX-License-Identifier: Apache-2.0

config BOARD_STM32H747I_DISCO_M7
	def_bool "$(BOARD)" = "stm32h747i_disco_m7"
	depends on SOC_STM32H747XX
	select CPU_CORTEX_M7

config BOARD_STM32H747I_DISCO_M4
	def_bool "$(BOARD)" = "stm32h747i_disco_m4"
	depends on SOC_STM32H747XX
	select CPU_CORTEX_M4
```

## boards/arm/stm32h747i_disco/Kconfig.defconfig
```kconfig
# STM32H747I DISCOVERY board configuration

# Copyright (c) 2019 Linaro Limited
# SPDX-License-Identifier: Apache-2.0

config STM32H7_DUAL_CORE
	default y

if NETWORKING

config NET_L2_ETHERNET
	default y

endif # NETWORKING

config DISK_DRIVER_SDMMC
	default y if DISK_DRIVERS
```

## boards/arm/stm32h747i_disco/stm32h747i_disco_m4_defconfig
```kconfig
# SPDX-License-Identifier: Apache-2.0


# Board config should be specified since there are 2 possible targets

# enable GPIO
CONFIG_GPIO=y

# clock configuration
CONFIG_CLOCK_CONTROL=y

# Enable MPU
CONFIG_ARM_MPU=y

# Enable HW stack protection
CONFIG_HW_STACK_PROTECTION=y

# enable uart driver
CONFIG_SERIAL=y

# By default CONSOLE is assigned to m7
#CONFIG_CONSOLE=y
#CONFIG_UART_CONSOLE=y

# enable pin controller
CONFIG_PINCTRL=y
```

## boards/arm/stm32h747i_disco/stm32h747i_disco_m7_defconfig
```kconfig
# SPDX-License-Identifier: Apache-2.0


# Board config should be specified since there are 2 possible targets

# Enable the internal SMPS regulator
CONFIG_POWER_SUPPLY_DIRECT_SMPS=y

# enable GPIO
CONFIG_GPIO=y

# Enable clocks
CONFIG_CLOCK_CONTROL=y

# Enable MPU
CONFIG_ARM_MPU=y

# Enable HW stack protection
CONFIG_HW_STACK_PROTECTION=y

# Disable following to assign serial ports to m4 core

# enable uart driver
CONFIG_SERIAL=y
# console
CONFIG_CONSOLE=y
CONFIG_UART_CONSOLE=y

# enable pin controller
CONFIG_PINCTRL=y
```

## boards/arm/stm32h750b_dk/Kconfig.board
```kconfig
# STM32H735G Discovery board configuration

# Copyright (c) 2023 STMicroelectronics
# SPDX-License-Identifier: Apache-2.0

config BOARD_STM32H750B_DK
	bool "STM32H750B Discovery Kit"
	depends on SOC_STM32H750XX
```

## boards/arm/stm32h750b_dk/Kconfig.defconfig
```kconfig
# STM32H750B DK board configuration

# Copyright (c) 2023 STMicroelectronics
# SPDX-License-Identifier: Apache-2.0

if BOARD_STM32H750B_DK

config BOARD
	default "stm32h750b_dk"

if DISPLAY

# MEMC needs to be enabled in order to store
# display buffer to external SDRAM connected to FMC
config MEMC
	default y

endif # DISPLAY

endif # BOARD_STM32H750B_DK
```

## boards/arm/stm32h7b3i_dk/Kconfig.board
```kconfig
# STM32H7B3I Discovery kit board configuration

# Copyright (c) 2022 Byte-Lab d.o.o. <dev@byte-lab.com>
# SPDX-License-Identifier: Apache-2.0

config BOARD_STM32H7B3I_DK
	bool "STM32H7B3I Discovery Kit Development Board"
	depends on SOC_STM32H7B3XXQ
```

## boards/arm/stm32h7b3i_dk/Kconfig.defconfig
```kconfig
# STM32H7B3I DISCOVERY KIT board configuration

# Copyright (c) 2022 Byte-Lab d.o.o. <dev@byte-lab.com>
# SPDX-License-Identifier: Apache-2.0

if BOARD_STM32H7B3I_DK

config BOARD
	default "stm32h7b3i_dk"

config INPUT
	default y if LVGL

config INPUT_FT5336_INTERRUPT
	default y if INPUT_FT5336

# MEMC needs to be enabled in order to store
# display buffer to external SDRAM connected to FMC
config MEMC
	default y if DISPLAY

endif # BOARD_STM32H7B3I_DK
```

## boards/arm/stm32h7b3i_dk/Kconfig.stm32h7b3i_dk
```kconfig
# Copyright (c) 2022 Zephyr Project members and individual contributors
# SPDX-License-Identifier: Apache-2.0

config BOARD_STM32H7B3I_DK
	bool
	default y
	select SOC_SERIES_STM32H7X
	select SOC_STM32H7B3XXQ
```

## boards/arm/stm32h7b3i_dk/stm32h7b3i_dk_defconfig
```kconfig
# Copyright (c) 2022 Byte-Lab d.o.o. <dev@byte-lab.com>
# SPDX-License-Identifier: Apache-2.0

# Set SoC present on the board
CONFIG_SOC_SERIES_STM32H7X=y
CONFIG_SOC_STM32H7B3XXQ=y

# Enable MPU
CONFIG_ARM_MPU=y

# Enable HW stack protection
CONFIG_HW_STACK_PROTECTION=y

# Enable serial
CONFIG_SERIAL=y

# Enable console
CONFIG_CONSOLE=y
CONFIG_UART_CONSOLE=y

# Enable GPIO
CONFIG_GPIO=y

# Enable clocks
CONFIG_CLOCK_CONTROL=y

# Enable pinctrl
CONFIG_PINCTRL=y

# Enable SMPS
CONFIG_POWER_SUPPLY_DIRECT_SMPS=y
```

## boards/arm/stm32l1_disco/Kconfig.board
```kconfig
# STM32L1DISCOVERY development board

# Copyright (c) 2019 eTactica ehf
# SPDX-License-Identifier: Apache-2.0

config BOARD_STM32L1_DISCO
	def_bool "$(BOARD)" = "stm32l1_disco"
	depends on SOC_STM32L151XB
```

## boards/arm/stm32l1_disco/Kconfig.defconfig
```kconfig
# Board configuration

# Copyright (c) 2019 eTactica ehf
# SPDX-License-Identifier: Apache-2.0

if BOARD_STM32L1_DISCO

config BOARD
	default "stm32l1_disco"

choice STM32_RTC_TIMER_SRC
	default STM32_RTC_TIMER_LSE
	depends on STM32_RTC_TIMER
endchoice

endif # BOARD_STM32L1_DISCO
```

## boards/arm/stm32l1_disco/stm32l1_disco_defconfig
```kconfig
# SPDX-License-Identifier: Apache-2.0

CONFIG_SOC_SERIES_STM32L1X=y
CONFIG_SOC_STM32L151XB=y

# enable uart driver
CONFIG_SERIAL=y

# enable console
CONFIG_CONSOLE=y
CONFIG_UART_CONSOLE=y

# enable GPIO
CONFIG_GPIO=y

# Enable Clocks
CONFIG_CLOCK_CONTROL=y

# enable pin controller
CONFIG_PINCTRL=y
```

## boards/arm/stm32l476g_disco/Kconfig.board
```kconfig
# STM32L476G Discovery development board

# Copyright (c) 2017 Arthur Sfez
# SPDX-License-Identifier: Apache-2.0

config BOARD_STM32L476G_DISCO
	def_bool "$(BOARD)" = "stm32l476g_disco"
	depends on SOC_STM32L476XX
```

## boards/arm/stm32l476g_disco/Kconfig.defconfig
```kconfig
# STM32L476G DISCOVERY board configuration

# Copyright (c) 2017 Arthur Sfez
# SPDX-License-Identifier: Apache-2.0

if BOARD_STM32L476G_DISCO

config BOARD
	default "stm32l476g_disco"

endif # BOARD_STM32L476G_DISCO
```

## boards/arm/stm32l476g_disco/Kconfig.stm32l476g_disco
```kconfig
# Copyright (c) 2022 Zephyr Project members and individual contributors
# SPDX-License-Identifier: Apache-2.0

config BOARD_STM32L476G_DISCO
	bool
	default y
	select SOC_SERIES_STM32L4X
	select SOC_STM32L476XX
```

## boards/arm/stm32l496g_disco/Kconfig
```kconfig
#  Copyright (c) 2021 STMicroelectronics
#  SPDX-License-Identifier: Apache-2.0

if BOARD_STM32L496G_DISCO

module = BOARD_STM32L496G_DISCO
module-str = Board Control
source "subsys/logging/Kconfig.template.log_config"

endif # BOARD_STM32L496G_DISCO
```

## boards/arm/stm32l496g_disco/Kconfig.board
```kconfig
# STM32L496G Discovery development board

# Copyright (c) 2016 Open-RnD Sp. z o.o.
# Copyright (c) 2016 BayLibre, SAS
# Copyright (c) 2019 Centaur Analytics, Inc
# SPDX-License-Identifier: Apache-2.0

config BOARD_STM32L496G_DISCO
	def_bool "$(BOARD)" = "stm32l496g_disco"
	depends on SOC_STM32L496XX
```

## boards/arm/stm32l496g_disco/Kconfig.defconfig
```kconfig
# STM32L476G Nucleo board configuration

# Copyright (c) 2016 Open-RnD Sp. z o.o.
# Copyright (c) 2016 BayLibre, SAS
# SPDX-License-Identifier: Apache-2.0

if BOARD_STM32L496G_DISCO

config BOARD
	default "stm32l496g_disco"

config SPI_STM32_INTERRUPT
	default y
	depends on SPI

config DISK_DRIVER_SDMMC
	default y if DISK_DRIVERS

endif # BOARD_STM32L496G_DISCO
```
