## boards/arm/cyclonev_socdk/Kconfig.cyclonev_socdk
```kconfig
# Copyright (c) 2022 Zephyr Project members and individual contributors
# SPDX-License-Identifier: Apache-2.0

config BOARD_CYCLONEV_SOCDK
	bool
	default y
	select SOC_SERIES_CYCLONE5
	select SOC_CYCLONE5
```

## boards/arm/cyclonev_socdk/Kconfig.defconfig
```kconfig
# Copyright (c) 2022 Intel Corporation
# SPDX-License-Identifier: Apache-2.0
# Description:
# Adding support for Cyclone V SoC DevKit

if BOARD_CVSXDEVKIT

config BOARD
	default "cyclonev_socdk"
depends on BOARD_CVSXDEVKIT

if I2C_DW
config I2C_DW_CLOCK_SPEED
	default 200
endif # I2C_DW

if USB_DEVICE_STACK
config USB_DW_USB_2_0
	default y
config USB_DEVICE_DRIVER
	default y
endif # USB_DEVICE_STACK

if SPI_DW
config SPI_DW_FIFO_DEPTH
	default 256
endif # SPI_DW

if NETWORKING

config NET_L2_ETHERNET
	default y
config TEST_RANDOM_GENERATOR
	default y

endif # NETWORKING

endif # BOARD_CVSXDEVKIT
```

## boards/arm/cyclonev_socdk/cyclonev_socdk_defconfig
```kconfig
# Copyright (c) 2022 Intel Corporation
# SPDX-License-Identifier: Apache-2.0
# Description:
# Cyclone V SoC Development Kit Board configuration file

CONFIG_SOC_SERIES_CYCLONE5=y
CONFIG_SOC_CYCLONE5=y
CONFIG_BOARD_CVSXDEVKIT=y
CONFIG_ARM_ARCH_TIMER=y

CONFIG_SYSCON=y

# Serial Drivers
CONFIG_SERIAL=y
CONFIG_UART_NS16550_VARIANT_NS16950=y

#Config Console
CONFIG_CONSOLE=y
CONFIG_UART_CONSOLE=y

#Flash not used.
CONFIG_FLASH_SIZE=0
CONFIG_FLASH_BASE_ADDRESS=0x0

# GPIOs
CONFIG_GPIO=y
```

## boards/arm/d605n/Kconfig.board
```kconfig
# nRF52840 DK NRF52840 board configuration

# Copyright (c) 2016 Nordic Semiconductor ASA
# SPDX-License-Identifier: Apache-2.0

config BOARD_D605N
	bool "D605N"
	depends on SOC_NRF52840_QIAA
```

## boards/arm/d605n/Kconfig.defconfig
```kconfig
# D605N board configuration

# Copyright (c) 2016 Nordic Semiconductor ASA
# SPDX-License-Identifier: Apache-2.0

if BOARD_D605N

config BOARD
	default "d605n"

if USB

config USB_NRFX
	default y

config USB_DEVICE_STACK
	default y

endif # USB

config BT_CTLR
	default BT

endif # BOARD_D605N
```

## boards/arm/d605n_spot/Kconfig.board
```kconfig
# nRF52840 DK NRF52840 board configuration

# Copyright (c) 2016 Nordic Semiconductor ASA
# SPDX-License-Identifier: Apache-2.0

config BOARD_D605N_SPOT
	bool "D605N_SPOT"
	depends on SOC_NRF52840_QIAA
```

## boards/arm/da14695_dk_usb/Kconfig.defconfig
```kconfig
# DA14695 Development Kit USB board configuration

# Copyright (c) 2023 Renesas Electronics Corporation and/or its affiliates
# SPDX-License-Identifier: Apache-2.0

if BOARD_DA14695_DK_USB

config BOARD
	default "da14695_dk_usb"

endif # BOARD_DA14695_DK_USB
```

## boards/arm/da14695_dk_usb/da14695_dk_usb_defconfig
```kconfig
#
# Copyright (c) 2023 Renesas Electronics Corporation and/or its affiliates
#
# SPDX-License-Identifier: Apache-2.0
#

CONFIG_SOC_SERIES_DA1469X=y
CONFIG_SOC_DA14695=y
CONFIG_BOARD_DA14695_DK_USB=y

CONFIG_HW_STACK_PROTECTION=y

CONFIG_GPIO=y

CONFIG_CONSOLE=y
CONFIG_UART_CONSOLE=y
CONFIG_SERIAL=y

CONFIG_BUILD_OUTPUT_HEX=n

CONFIG_I2C=y
CONFIG_I2C_CALLBACK=y
```

## boards/arm/da1469x_dk_pro/Kconfig.da1469x_dk_pro
```kconfig
# Copyright (c) 2022 Zephyr Project members and individual contributors
# SPDX-License-Identifier: Apache-2.0

config BOARD_DA1469X_DK_PRO
	bool
	default y
	select SOC_SERIES_DA1469X
	select SOC_DA14699
```

## boards/arm/decawave_dwm1001_dev/Kconfig.board
```kconfig
# DecaWave DWM1001 board configuration

# Copyright (c) 2019 Stéphane D'Alu
# SPDX-License-Identifier: Apache-2.0

config BOARD_DECAWAVE_DWM1001_DEV
	bool "Decawave DWM1001-DEV"
	depends on SOC_NRF52832_QFAA
```

## boards/arm/decawave_dwm1001_dev/Kconfig.defconfig
```kconfig
# DecaWave DWM1001 board configuration

# Copyright (c) 2019 Stéphane D'Alu
# SPDX-License-Identifier: Apache-2.0

config BT_CTLR
	default BT

config I2C
	default SENSOR

config SPI
	default y
	depends on IEEE802154
```

## boards/arm/degu_evk/Kconfig
```kconfig
# Kconfig - Degu Evaluation Kit configuration
#
# Copyright (c) 2019 Atmark Techno, Inc.
#
# SPDX-License-Identifier: Apache-2.0

if BOARD_DEGU_EVK

config BOARD_ENABLE_DCDC
	bool "Enable DCDC mode"
	select SOC_DCDC_NRF52X
	default y

endif # BOARD_DEGU_EVK
```

## boards/arm/degu_evk/Kconfig.board
```kconfig
# Kconfig - Degu Evaluation Kit configuration
#
# Copyright (c) 2019 Atmark Techno, Inc.
#
# SPDX-License-Identifier: Apache-2.0

config  BOARD_DEGU_EVK
	bool "DEGU_EVK"
	depends on SOC_NRF52840_QIAA
```

## boards/arm/degu_evk/Kconfig.defconfig
```kconfig
# Degu Evaluation Kit configuration

# Copyright (c) 2019 Atmark Techno, Inc.
# SPDX-License-Identifier: Apache-2.0

if BOARD_DEGU_EVK

config BOARD
	default "degu_evk"

if USB_DEVICE_STACK

config USB_DEVICE_PRODUCT
	default "Degu Evaluation Kit"

config UART_INTERRUPT_DRIVEN
	default y

config UART_LINE_CTRL
	default y

endif # USB_DEVICE_STACK

endif # BOARD_DEGU_EVK
```

## boards/arm/degu_evk/degu_evk_defconfig
```kconfig
CONFIG_SOC_SERIES_NRF52X=y
CONFIG_SOC_NRF52840_QIAA=y
CONFIG_BOARD_DEGU_EVK=y

# Enable MPU
CONFIG_ARM_MPU=y

# enable uart driver
CONFIG_SERIAL=y

# enable console
CONFIG_CONSOLE=y
CONFIG_UART_CONSOLE=y

# enable USB (for CDC ACM console)
CONFIG_USB_DEVICE_STACK=y

# additional board options
CONFIG_GPIO=y
CONFIG_GPIO_AS_PINRESET=y

# required to enable 3V3 power rail and Vin1 monitor
CONFIG_REGULATOR=y

CONFIG_PINCTRL=y
```

## boards/arm/disco_l475_iot1/Kconfig.board
```kconfig
# Discovery IoT L475 board configuration

# Copyright (c) 2017 Linaro Limited
# SPDX-License-Identifier: Apache-2.0

config BOARD_DISCO_L475_IOT1
	def_bool "$(BOARD)" = "disco_l475_iot1"
	depends on SOC_STM32L475XX
```

## boards/arm/disco_l475_iot1/Kconfig.defconfig
```kconfig
# Discovery IoT L475 board configuration

# Copyright (c) 2017 Linaro Limited
# SPDX-License-Identifier: Apache-2.0

if BOARD_DISCO_L475_IOT1

config BOARD
	default "disco_l475_iot1"

# LPTIM clocked by LSE, force tick freq to 4096 for tick accuracy
config SYS_CLOCK_TICKS_PER_SEC
	default 4096 if STM32_LPTIM_TIMER

config SPI_STM32_INTERRUPT
	default y
	depends on SPI

choice LIS3MDL_TRIGGER_MODE
	default LIS3MDL_TRIGGER_NONE
endchoice

choice HTS221_TRIGGER_MODE
	default HTS221_TRIGGER_NONE
endchoice

choice LSM6DSL_TRIGGER_MODE
	default LSM6DSL_TRIGGER_GLOBAL_THREAD
	depends on LSM6DSL
endchoice

if BT

config SPI
	default y

choice BT_HCI_BUS_TYPE
	default BT_SPI
endchoice

config BT_SPI_BLUENRG
	default y

config BT_BLUENRG_ACI
	default y
# Disable Flow control
config BT_HCI_ACL_FLOW_CONTROL
	default n
config BT_HCI_VS_EXT
	default n

endif # BT

endif # BOARD_DISCO_L475_IOT1
```

## boards/arm/disco_l475_iot1/Kconfig.disco_l475_iot1
```kconfig
# Copyright (c) 2022 Zephyr Project members and individual contributors
# SPDX-License-Identifier: Apache-2.0

config BOARD_DISCO_L475_IOT1
	bool
	default y
	select SOC_SERIES_STM32L4X
	select SOC_STM32L475XX
```

## boards/arm/disco_l475_iot1/disco_l475_iot1_defconfig
```kconfig
# SPDX-License-Identifier: Apache-2.0

CONFIG_BOARD_DISCO_L475_IOT1=y
CONFIG_SOC_SERIES_STM32L4X=y
CONFIG_SOC_STM32L475XX=y

# enable uart driver
CONFIG_SERIAL=y
CONFIG_UART_INTERRUPT_DRIVEN=y

# enable GPIO
CONFIG_GPIO=y

# enable clock
CONFIG_CLOCK_CONTROL=y

# console
CONFIG_CONSOLE=y
CONFIG_UART_CONSOLE=y

# enable MPU
CONFIG_ARM_MPU=y

# Enable HW stack protection
CONFIG_HW_STACK_PROTECTION=y

# enable pin controller
CONFIG_PINCTRL=y
```

## boards/arm/dragino_lsn50/Kconfig.board
```kconfig
# Dragino LSN50 LoRA Sensor Node board configuration

# Copyright (c) 2018 Endre Karlson <endre.karlson@gmail.com>
# SPDX-License-Identifier: Apache-2.0

config BOARD_DRAGINO_LSN50
	bool "Dragino LSN50 Sensor Node"
	depends on SOC_STM32L072XX
```

## boards/arm/dragino_lsn50/Kconfig.defconfig
```kconfig
# Dragino LSN50 LoRA Sensor Node board configuration

# Copyright (c) 2018 Endre Karlson <endre.karlson@gmail.com>
# SPDX-License-Identifier: Apache-2.0

if BOARD_DRAGINO_LSN50

config BOARD
	default "dragino_lsn50"

endif # BOARD_DRAGINO_LSN50
```

## boards/arm/dragino_lsn50/dragino_lsn50_defconfig
```kconfig
# SPDX-License-Identifier: Apache-2.0

# Zephyr Kernel Configuration
CONFIG_SOC_SERIES_STM32L0X=y

# Platform Configuration
CONFIG_SOC_STM32L072XX=y
CONFIG_BOARD_DRAGINO_LSN50=y

# Serial Drivers
CONFIG_SERIAL=y
CONFIG_UART_INTERRUPT_DRIVEN=y
# enable console
CONFIG_CONSOLE=y
CONFIG_UART_CONSOLE=y

# GPIO Controller
CONFIG_GPIO=y

# Enable Clocks
CONFIG_CLOCK_CONTROL=y

# enable pin controller
CONFIG_PINCTRL=y
```

## boards/arm/dragino_nbsn95/Kconfig.board
```kconfig
# Dragino NBSN95 NB-IoT Sensor Node board configuration

# Copyright (c) 2021 Next Big Thing AG
# SPDX-License-Identifier: Apache-2.0

config BOARD_DRAGINO_NBSN95
	bool "Dragino NBSN95 Sensor Node"
	depends on SOC_STM32L072XX
```

## boards/arm/ebyte_e73_tbb_nrf52832/ebyte_e73_tbb_nrf52832_defconfig
```kconfig
# SPDX-License-Identifier: Apache-2.0

CONFIG_SOC_SERIES_NRF52X=y
CONFIG_SOC_NRF52832_QFAA=y
CONFIG_BOARD_EBYTE_E73_TBB_NRF52832=y

# Enable MPU
CONFIG_ARM_MPU=y

# Enable hardware stack protection
CONFIG_HW_STACK_PROTECTION=y

# Enable RTT
CONFIG_USE_SEGGER_RTT=y

# Enable GPIO
CONFIG_GPIO=y

# Enable uart driver
CONFIG_SERIAL=y

# Enable console
CONFIG_CONSOLE=y
CONFIG_UART_CONSOLE=y

# Additional board options
CONFIG_GPIO_AS_PINRESET=y

CONFIG_PINCTRL=y
```
