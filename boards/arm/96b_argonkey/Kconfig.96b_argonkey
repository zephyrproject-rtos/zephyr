## boards/arm/96b_argonkey/Kconfig.96b_argonkey
```kconfig
# Copyright (c) 2022 Zephyr Project members and individual contributors
# SPDX-License-Identifier: Apache-2.0

config BOARD_96B_ARGONKEY
	bool
	default y
	select SOC_SERIES_STM32F4X
	select SOC_STM32F412CX
```

## boards/arm/96b_argonkey/Kconfig.board
```kconfig
# 96Boards Argonkey Board Configuration

# Copyright (c) 2018 STMicroelectronics
# SPDX-License-Identifier: Apache-2.0

config BOARD_96B_ARGONKEY
	def_bool "$(BOARD)" = "96b_argonkey"
	depends on SOC_STM32F412CG
```

## boards/arm/96b_argonkey/Kconfig.defconfig
```kconfig
# 96Boards Argonkey Board Configuration

# Copyright (c) 2018 STMicroelectronics
# SPDX-License-Identifier: Apache-2.0

if BOARD_96B_ARGONKEY

config BOARD
	default "96b_argonkey"

if LSM6DSL

choice LSM6DSL_TRIGGER_MODE
	default LSM6DSL_TRIGGER_GLOBAL_THREAD
endchoice

config LSM6DSL_SENSORHUB
	default y

choice LSM6DSL_EXTERNAL_SENSOR_0
	default LSM6DSL_EXT0_LIS2MDL
endchoice

endif # LSM6DSL

endif # BOARD_96B_ARGONKEY
```

## boards/arm/96b_avenger96/Kconfig.96b_avenger96
```kconfig
# Copyright (c) 2022 Zephyr Project members and individual contributors
# SPDX-License-Identifier: Apache-2.0

config BOARD_96B_AVENGER96
	bool
	default y
	select SOC_SERIES_STM32MP1X
	select SOC_STM32MP15_M4
```

## boards/arm/96b_avenger96/Kconfig.board
```kconfig
# 96Boards Avenger96 board configuration

# Copyright (c) 2019 Linaro Ltd.
# SPDX-License-Identifier: Apache-2.0

config BOARD_96B_AVENGER96
	bool "96Boards Avenger96 Board"
	depends on SOC_STM32MP15_M4
```

## boards/arm/96b_avenger96/Kconfig.defconfig
```kconfig
# 96Boards Avenger96 board configuration

# Copyright (c) 2019 Linaro Ltd.
# SPDX-License-Identifier: Apache-2.0

if BOARD_96B_AVENGER96

config BOARD
	default "96b_avenger96"

endif # BOARD_96B_AVENGER96
```

## boards/arm/96b_bluesky/96b_bluesky_defconfig
```kconfig
CONFIG_ARM=y
CONFIG_BOARD_96B_BLUESKY=y
CONFIG_SOC_SERIES_RDA5981=y
CONFIG_SOC_5981A=y
CONFIG_SOC_RDA_DEBUG=y
CONFIG_CORTEX_M_SYSTICK=y
CONFIG_WDT_RDA5981A=y
CONFIG_RUNTIME_NMI=y
CONFIG_PINMUX=y
CONFIG_PINMUX_INIT_PRIORITY=45
CONFIG_PINMUX_RDA5981A=y
CONFIG_PINMUX_DEV=y
CONFIG_PINMUX_DEV_RDA5981A=y
CONFIG_GPIO=y
CONFIG_GPIO_RDA5981A=y
CONFIG_UART_RDA5981A=y
CONFIG_UART_RDA5981A_PORT_0=y
CONFIG_UART_RDA5981A_PORT_N=0
CONFIG_UART_RDA5981A_PORT_0_BAUD_RATE=115200
# enable console on this port by default
CONFIG_UART_CONSOLE_ON_DEV_NAME="UART_0"

CONFIG_HAS_RDA5981A_HAL=y
CONFIG_HAS_RDA5981A_SDMMC=y

CONFIG_HAS_DTS=y
CONFIG_COMPILER_OPT="-O1"
```

## boards/arm/96b_bluesky/Kconfig.board
```kconfig
#
# Copyright (c) 2017 RDA
# Copyright (c) 2016-2017 Linaro Limited
#
# SPDX-License-Identifier: Apache-2.0
#

config BOARD_96B_BLUESKY
	bool "96Boards BLUESKY"
	depends on SOC_5981A
```

## boards/arm/96b_bluesky/Kconfig.defconfig
```kconfig
#
# Copyright (c) 2017 RDA
# Copyright (c) 2016-2017 Linaro Limited
#
# SPDX-License-Identifier: Apache-2.0
#

if BOARD_96B_BLUESKY

config BOARD
	default 96b_bluesky

endif # BOARD_96B_BLUESKY
```

## boards/arm/96b_carbon/96b_carbon_defconfig
```kconfig
CONFIG_ARM=y
CONFIG_BOARD_96B_CARBON=y
CONFIG_SOC_SERIES_STM32F4X=y
CONFIG_SOC_STM32F401XE=y
# 84MHz system clock
CONFIG_SYS_CLOCK_HW_CYCLES_PER_SEC=84000000
CONFIG_SYS_CLOCK_TICKS_PER_SEC=1000

# Enable MPU
CONFIG_STM32_ARM_MPU_ENABLE=y

# enable USART1 - passthrough to FT230XQ
CONFIG_UART_STM32_PORT_1=y

# enable I2C1
CONFIG_I2C=y
CONFIG_I2C_STM32_V1=y

# enable pinmux
CONFIG_PINMUX=y

# enable GPIO ports A, B, C, D
CONFIG_GPIO=y

# clock configuration
CONFIG_CLOCK_CONTROL=y

# Clock configuration for Cube Clock control driver
CONFIG_CLOCK_STM32_HSE_CLOCK=16000000
CONFIG_CLOCK_STM32_SYSCLK_SRC_PLL=y
# use HSE as PLL input
CONFIG_CLOCK_STM32_PLL_SRC_HSE=y
# CONFIG_CLOCK_STM32_HSE_BYPASS=y
# produce 84MHz clock at PLL output
CONFIG_CLOCK_STM32_PLL_M_DIVISOR=16
CONFIG_CLOCK_STM32_PLL_N_MULTIPLIER=336
CONFIG_CLOCK_STM32_PLL_P_DIVISOR=4
CONFIG_CLOCK_STM32_PLL_Q_DIVISOR=7
CONFIG_CLOCK_STM32_AHB_PRESCALER=1
CONFIG_CLOCK_STM32_APB1_PRESCALER=2
CONFIG_CLOCK_STM32_APB2_PRESCALER=1

# BT SPI configuration when BT is selected
CONFIG_BT_SPI=y
CONFIG_BT_SPI_DEV_NAME="SPI_1"
CONFIG_BT_SPI_IRQ_DEV_NAME="GPIOB"
CONFIG_BT_SPI_IRQ_PIN=1
CONFIG_BT_SPI_RESET_DEV_NAME="GPIOB"
CONFIG_BT_SPI_RESET_PIN=4
CONFIG_BT_SPI_MAX_CLK_FREQ=2000000
```

## boards/arm/96b_carbon/Kconfig.board
```kconfig
# 96boards Carbon STMF401RE board configuration

# Copyright (c) 2016 Linaro Limited.
# SPDX-License-Identifier: Apache-2.0

config BOARD_96B_CARBON
	bool "96Boards Carbon (STM32F401)"
	depends on SOC_STM32F401XE
```

## boards/arm/96b_carbon/Kconfig.defconfig
```kconfig
# Kconfig - 96boards Carbon board configuration
#
# Copyright (c) 2016 Linaro Limited.
#
# SPDX-License-Identifier: Apache-2.0
#

if BOARD_96B_CARBON

config BOARD
	default "96b_carbon"

if UART_CONSOLE

config UART_1
	default y

endif # UART_CONSOLE

if SERIAL

config UART_2
	default y

config UART_6
	default y

endif # SERIAL

if I2C

config I2C_1
	default y

config I2C_2
	default y

endif # I2C

if SPI

config SPI_1
	default y

config SPI_2
	default y

config SPI_STM32_INTERRUPT
	default y

endif # SPI

if BT

config SPI
	default y

choice BT_HCI_BUS_TYPE
	default BT_SPI
endchoice

endif # BT

if NETWORKING

# Re-create the NET_L2_BT dependencies here
config BT
	default y

config BT_PERIPHERAL
	default BT

config BT_CENTRAL
	default BT

config BT_SMP
	default BT

config BT_L2CAP_DYNAMIC_CHANNEL
	default BT

# BT is the only onboard network iface, so use it for IP networking
# if it's enabled

config NET_L2_BT
	depends on NET_IPV6
	default BT

config NET_L2_BT_ZEP1656
	depends on NET_IPV6
	default BT

endif # NETWORKING

endif # BOARD_96B_CARBON
```

## boards/arm/96b_carbon_nrf51/96b_carbon_nrf51_defconfig
```kconfig
# SPDX-License-Identifier: Apache-2.0

CONFIG_SOC_SERIES_NRF51X=y
CONFIG_SOC_NRF51822_QFAC=y

# enable GPIO
CONFIG_GPIO=y

# enable uart driver
CONFIG_SERIAL=y

# enable console
CONFIG_CONSOLE=y
CONFIG_UART_CONSOLE=y

# spi
CONFIG_SPI=y
CONFIG_SPI_SLAVE=y

CONFIG_PINCTRL=y
```

## boards/arm/96b_carbon_nrf51/Kconfig.board
```kconfig
# Kconfig - 96Boards Carbon nRF51 board configuration
#
# Copyright (c) 2016, 2017 Linaro Limited.
#
# SPDX-License-Identifier: Apache-2.0

config BOARD_96B_CARBON_NRF51
	bool "96Boards Carbon (nRF51)"
	depends on SOC_NRF51822_QFAC
```

## boards/arm/96b_carbon_nrf51/Kconfig.defconfig
```kconfig
# 96Boards Carbon nRF51 board default configuration

# Copyright (c) 2016, 2017 Linaro Limited.
# SPDX-License-Identifier: Apache-2.0

config BT_CTLR
	default BT
```

## boards/arm/96b_ivy5661/96b_ivy5661_defconfig
```kconfig
# SPDX-License-Identifier: Apache-2.0

CONFIG_SOC_SERIES_UWP566X=y
CONFIG_SOC_UWP5661=y
CONFIG_BOARD_96B_IVY5661=y
CONFIG_CORTEX_M_SYSTICK=y

# enable uart driver
CONFIG_SERIAL=y
CONFIG_UART_INTERRUPT_DRIVEN=y

# enable console
CONFIG_CONSOLE=y
CONFIG_UART_CONSOLE=y

CONFIG_MULTI_LEVEL_INTERRUPTS=y
CONFIG_2ND_LEVEL_INTERRUPTS=y
CONFIG_UWP_ICTL=y
CONFIG_UWP_ICTL_0=y
CONFIG_UWP_ICTL_1=y
CONFIG_UWP_ICTL_2=y
```

## boards/arm/96b_ivy5661/Kconfig.board
```kconfig
# 96Boards IVY5661 board configuration

# Copyright (c) 2018, UNISOC Incorporated
# Copyright (c) 2019, Manivannan Sadhasivam
# SPDX-License-Identifier: Apache-2.0

config BOARD_96B_IVY5661
	bool "96Boards IVY5661"
	depends on SOC_UWP5661
```

## boards/arm/96b_ivy5661/Kconfig.defconfig
```kconfig
# 96boards IVY5661 board default configuration

# Copyright (c) 2018, UNISOC Incorporated
# Copyright (c) 2019, Manivannan Sadhasivam
# SPDX-License-Identifier: Apache-2.0

if BOARD_96B_IVY5661

config BOARD
	string
	default "96b_ivy5661"

endif # BOARD_96B_IVY5661
```

## boards/arm/96b_meerkat96/96b_meerkat96_defconfig
```kconfig
#
# Copyright (c) 2019, Linaro Ltd.
#
# SPDX-License-Identifier: Apache-2.0
#

CONFIG_SOC_SERIES_IMX7_M4=y
CONFIG_SOC_MCIMX7_M4=y
CONFIG_BOARD_96B_MEERKAT96=y
CONFIG_CORTEX_M_SYSTICK=y

# enable uart driver
CONFIG_SERIAL=y
CONFIG_UART_INTERRUPT_DRIVEN=y

# console
CONFIG_CONSOLE=y
CONFIG_UART_CONSOLE=y

# pinctrl
CONFIG_PINCTRL=y

CONFIG_XIP=y
```

## boards/arm/96b_meerkat96/Kconfig.board
```kconfig
# 96Boards Meerkat96 board

# Copyright (c) 2019, Linaro Ltd.
# SPDX-License-Identifier: Apache-2.0

config BOARD_96B_MEERKAT96
	def_bool "$(BOARD)" = "96b_meerkat96"
	depends on SOC_SERIES_IMX7_M4
	select SOC_PART_NUMBER_MCIMX7D5EVM10SC
```

## boards/arm/96b_meerkat96/Kconfig.defconfig
```kconfig
# 96Boards Meerkat96 board

# Copyright (c) 2019, Linaro Ltd.
# SPDX-License-Identifier: Apache-2.0

if !XIP
config FLASH_SIZE
	default 0
config FLASH_BASE_ADDRESS
	default 0
endif
```

## boards/arm/96b_neonkey/96b_neonkey_defconfig
```kconfig
# SPDX-License-Identifier: Apache-2.0

CONFIG_ARM=y
CONFIG_SOC_SERIES_STM32F4X=y
CONFIG_SOC_STM32F411XE=y

# 84MHz system clock
CONFIG_SYS_CLOCK_HW_CYCLES_PER_SEC=84000000

# enable uart driver
CONFIG_SERIAL=y

# enable pinmux
CONFIG_PINMUX=y

# enable GPIO
CONFIG_GPIO=y

# clock configuration
CONFIG_CLOCK_CONTROL=y

# SYSCLK selection
CONFIG_CLOCK_STM32_SYSCLK_SRC_PLL=y

# PLL configuration
CONFIG_CLOCK_STM32_PLL_SRC_HSI=y

# produce 84MHz clock at PLL output
CONFIG_CLOCK_STM32_PLL_M_DIVISOR=16
CONFIG_CLOCK_STM32_PLL_N_MULTIPLIER=336
CONFIG_CLOCK_STM32_PLL_P_DIVISOR=4
CONFIG_CLOCK_STM32_AHB_PRESCALER=1

# APB1 clock must not exceed 50MHz limit
CONFIG_CLOCK_STM32_APB1_PRESCALER=2
CONFIG_CLOCK_STM32_APB2_PRESCALER=1

# console
CONFIG_CONSOLE=y
CONFIG_UART_CONSOLE=y
```

## boards/arm/96b_neonkey/Kconfig.board
```kconfig
# 96Boards Neonkey Board Configuration

# Copyright (c) 2017 Linaro Limited
# SPDX-License-Identifier: Apache-2.0

config BOARD_96B_NEONKEY
	def_bool "$(BOARD)" = "96b_neonkey"
	depends on SOC_STM32F411XE
```

## boards/arm/96b_neonkey/Kconfig.defconfig
```kconfig
# 96Boards Neonkey Board Configuration

# Copyright (c) 2017 Linaro Limited
# SPDX-License-Identifier: Apache-2.0

config SPI_STM32_INTERRUPT
	default y
	depends on SPI
```

## boards/arm/96b_nitrogen/96b_nitrogen_defconfig
```kconfig
# SPDX-License-Identifier: Apache-2.0

CONFIG_ARM=y
CONFIG_SOC_FAMILY_NRF=y
CONFIG_SOC_SERIES_NRF52X=y
CONFIG_SOC_NRF52832_QFAA=y

# Enable MPU
CONFIG_ARM_MPU=y

# enable GPIO
CONFIG_GPIO=y

# enable uart driver
CONFIG_SERIAL=y
CONFIG_UART_0_NRF_UART=y

# enable console
CONFIG_CONSOLE=y
CONFIG_UART_CONSOLE=y

# additional board options
CONFIG_GPIO_AS_PINRESET=y
```
