## boards/arm/mec1501modular_assy6885/mec1501modular_assy6885_defconfig
```kconfig
#
# Copyright (c) 2019, Intel Corporation
#
# SPDX-License-Identifier: Apache-2.0
#

CONFIG_SOC_MEC1501_HSZ=y
CONFIG_SOC_SERIES_MEC1501X=y
# Make sure external power management setup is as indicated in documentation
CONFIG_SOC_MEC1501_VTR3_1_8V=y
CONFIG_SOC_MEC1501_VCI_PINS_AS_GPIOS=n
CONFIG_BOARD_MEC1501MODULAR_ASSY6885=y
CONFIG_RTOS_TIMER=y

CONFIG_CONSOLE=y
CONFIG_UART_CONSOLE=y
CONFIG_SERIAL=y
CONFIG_GPIO=y
CONFIG_PINCTRL=y

CONFIG_PM=y
```

## boards/arm/mec15xxevb_assy6853/Kconfig.board
```kconfig
# Microchip MEC15XX EVB ASSY 6853 Development board

# Copyright (c) 2019, Intel Corporation
# SPDX-License-Identifier: Apache-2.0

config BOARD_MEC15XXEVB_ASSY6853
	def_bool "$(BOARD)" = "mec15xxevb_assy6853"
	depends on SOC_MEC1501_HSZ
```

## boards/arm/mec15xxevb_assy6853/Kconfig.defconfig
```kconfig
# Copyright (c) 2019 Intel Corporation
# SPDX-License-Identifier: Apache-2.0

if BOARD_MEC15XXEVB_ASSY6853

config BOARD
	default "mec15xxevb_assy6853"

config ESPI_XEC
	default y
	depends on ESPI

if RTOS_TIMER

# XEC RTOS timer HW frequency is fixed at 32768
# The driver requires tickless mode and ticks per
# second to be 32768 for accurate operation.

config SYS_CLOCK_HW_CYCLES_PER_SEC
	default 32768

config SYS_CLOCK_TICKS_PER_SEC
	default 32768

endif # RTOS_TIMER

if !RTOS_TIMER

# If RTOS timer is not enabled we use ARM Cortex-M
# SYSTICK. SYSTICK frequency is 48MHz divided by
# SOC_MEC1501_PROC_CLK_DIV.
#

config SYS_CLOCK_HW_CYCLES_PER_SEC
	default 48000000

config SYS_CLOCK_TICKS_PER_SEC
	default 1000

endif # RTOS_TIMER

if PS2

config PS2_XEC_0
	default y

config PS2_XEC_1
	default y

endif # PS2

if SPI

config SPI_XEC_QMSPI
	default y

endif # SPI

config TACH_XEC
	default y
	depends on SENSOR

endif # BOARD_MEC15XXEVB_ASSY6853
```

## boards/arm/mec15xxevb_assy6853/Kconfig.mec15xxevb_assy6853
```kconfig
# Copyright (c) 2022 Zephyr Project members and individual contributors
# SPDX-License-Identifier: Apache-2.0

config BOARD_MEC15XXEVB_ASSY6853
	bool
	default y
	select SOC_MEC1501_HSZ
	select SOC_SERIES_MEC1501X
```

## boards/arm/mec15xxevb_assy6853/mec15xxevb_assy6853_defconfig
```kconfig
#
# Copyright (c) 2019, Intel Corporation
#
# SPDX-License-Identifier: Apache-2.0
#

CONFIG_SOC_MEC1501_HSZ=y
CONFIG_SOC_SERIES_MEC1501X=y
CONFIG_SOC_MEC1501_VTR3_1_8V=y
CONFIG_BOARD_MEC15XXEVB_ASSY6853=y
CONFIG_RTOS_TIMER=y

CONFIG_CLOCK_CONTROL=y
CONFIG_CONSOLE=y
CONFIG_PINCTRL=y
CONFIG_UART_CONSOLE=y
CONFIG_SERIAL=y
CONFIG_GPIO=y
CONFIG_PINCTRL=y

# power management stuff
CONFIG_PM=y
```

## boards/arm/mec172xevb_assy6906/Kconfig.board
```kconfig
# Copyright (c) 2021, Microchip Technology Inc.
# SPDX-License-Identifier: Apache-2.0

config BOARD_MEC172XEVB_ASSY6906
	bool "Microchip MEC172X EVB ASSY 6906 Development board"
	depends on SOC_MEC172X_NSZ
```

## boards/arm/mec172xevb_assy6906/Kconfig.defconfig
```kconfig
# Copyright (c) 2021 Microchip Technology Inc.
# SPDX-License-Identifier: Apache-2.0

if BOARD_MEC172XEVB_ASSY6906

config BOARD
	default "mec172xevb_assy6906"

endif # BOARD_MEC172XEVB_ASSY6906
```

## boards/arm/mec172xevb_assy6906/Kconfig.mec172xevb_assy6906
```kconfig
# Copyright (c) 2022 Zephyr Project members and individual contributors
# SPDX-License-Identifier: Apache-2.0

config BOARD_MEC172XEVB_ASSY6906
	bool
	default y
	select SOC_MEC172X_NSZ
	select SOC_SERIES_MEC172X
```

## boards/arm/mec172xevb_assy6906/mec172xevb_assy6906_defconfig
```kconfig
#
# Copyright (c) 2021, Microchip Technology Inc.
#
# SPDX-License-Identifier: Apache-2.0
#

CONFIG_SOC_MEC172X_NSZ=y
CONFIG_SOC_SERIES_MEC172X=y
CONFIG_BOARD_MEC172XEVB_ASSY6906=y
CONFIG_RTOS_TIMER=y

CONFIG_CLOCK_CONTROL=y
CONFIG_GPIO=y
CONFIG_PINMUX=y
CONFIG_SERIAL=y
CONFIG_CONSOLE=y
CONFIG_UART_CONSOLE=y
CONFIG_ADC=y
CONFIG_I2C=y
CONFIG_ESPI=y
CONFIG_SPI=y
CONFIG_SPI_ASYNC=y
```

## boards/arm/mec172xmodular_assy6930/Kconfig.board
```kconfig
# Copyright (c) 2022, Microchip Technology Inc.
# SPDX-License-Identifier: Apache-2.0

config BOARD_MEC172XMODULAR_ASSY6930
	bool "Microchip MEC172X MODULAR ASSY 6930 Development board"
	depends on SOC_MEC172X_NSZ
```

## boards/arm/mec172xmodular_assy6930/mec172xmodular_assy6930_defconfig
```kconfig
#
# Copyright (c) 2022, Microchip Technology Inc.
#
# SPDX-License-Identifier: Apache-2.0
#

CONFIG_SOC_MEC172X_NSZ=y
CONFIG_SOC_SERIES_MEC172X=y
CONFIG_BOARD_MEC172XMODULAR_ASSY6930=y
CONFIG_RTOS_TIMER=y

CONFIG_CLOCK_CONTROL=y
CONFIG_GPIO=y
CONFIG_PINCTRL=y
CONFIG_SERIAL=y
CONFIG_CONSOLE=y
CONFIG_UART_CONSOLE=y
CONFIG_ADC=y
CONFIG_I2C=y
CONFIG_ESPI=y
CONFIG_SPI=y
CONFIG_SPI_ASYNC=y
```

## boards/arm/mec2016evb_assy6797/Kconfig.board
```kconfig
# Copyright (c) 2019, Intel Corporation
# SPDX-License-Identifier: Apache-2.0

config BOARD_MEC2016EVB_ASSY6797
	bool "Microchip MEC2016 EVB ASSY 6797 Development board"
	depends on SOC_MEC1701_QSZ
```

## boards/arm/mec2016evb_assy6797/Kconfig.defconfig
```kconfig
# Copyright (c) 2019 Intel Corporation
# SPDX-License-Identifier: Apache-2.0

if BOARD_MEC2016EVB_ASSY6797

config BOARD
	default "mec2016evb_assy6797"

endif # BOARD_MEC2016EVB_ASSY6797
```

## boards/arm/mec2016evb_assy6797/Kconfig.mec2016evb_assy6797
```kconfig
# Copyright (c) 2022 Zephyr Project members and individual contributors
# SPDX-License-Identifier: Apache-2.0

config BOARD_MEC2016EVB_ASSY6797
	bool
	default y
	select SOC_MEC1701_QSZ
	select SOC_SERIES_MEC1701X
```

## boards/arm/mec2016evb_assy6797/mec2016evb_assy6797_defconfig
```kconfig
#
# Copyright (c) 2019, Intel Corporation
#
# SPDX-License-Identifier: Apache-2.0
#

CONFIG_SOC_MEC1701_QSZ=y
CONFIG_SOC_SERIES_MEC1701X=y
CONFIG_BOARD_MEC2016EVB_ASSY6797=y
CONFIG_SYS_CLOCK_HW_CYCLES_PER_SEC=48000000

CONFIG_CONSOLE=y
CONFIG_UART_CONSOLE=y
CONFIG_SERIAL=y
```

## boards/arm/mercury_xu/Kconfig.board
```kconfig
# Copyright (c) 2020, Antmicro
# SPDX-License-Identifier: Apache-2.0
config BOARD_MERCURY_XU
	bool "Mercury XU Board"
	depends on SOC_XILINX_ZYNQMP_RPU
```

## boards/arm/mercury_xu/Kconfig.defconfig
```kconfig
# Copyright (c) 2020, Antmicro
# SPDX-License-Identifier: Apache-2.0

config FLASH_SIZE
	int
	default 64

config FLASH_BASE_ADDRESS
	default 0x08000000
```

## boards/arm/mercury_xu/Kconfig.mercury_xu
```kconfig
# Copyright (c) 2022 Zephyr Project members and individual contributors
# SPDX-License-Identifier: Apache-2.0

config BOARD_MERCURY_XU
	bool
	default y
	select SOC_XILINX_ZYNQMP_RPU
```

## boards/arm/mercury_xu/mercury_xu_defconfig
```kconfig
# Copyright (c) 2020, Antmicro

# enable uart driver
CONFIG_SERIAL=y

# enable console
CONFIG_CONSOLE=y
CONFIG_UART_CONSOLE=y

# enable timer
CONFIG_SYS_CLOCK_TICKS_PER_SEC=100
```

## boards/arm/mg100/Kconfig.board
```kconfig
# Copyright (c) 2022 Laird Connectivity
# SPDX-License-Identifier: Apache-2.0

config  BOARD_MG100
	bool "MG100"
	depends on SOC_NRF52840_QIAA
```

## boards/arm/mg100/Kconfig.defconfig
```kconfig
# Copyright (c) 2022 Laird Connectivity
# SPDX-License-Identifier: Apache-2.0

if BOARD_MG100

config BOARD
	default "mg100"

config MODEM
	default NETWORKING

config MODEM_HL7800
	default NETWORKING

config NORDIC_QSPI_NOR
	default BOOTLOADER_MCUBOOT

config NORDIC_QSPI_NOR_FLASH_LAYOUT_PAGE_SIZE
	default 4096 if NORDIC_QSPI_NOR

config REGULATOR
	default DISK_DRIVER_SDMMC

config BT_CTLR
	default BT

endif # BOARD_MG100
```

## boards/arm/mg100/mg100_defconfig
```kconfig
# Copyright (c) 2022 Laird Connectivity
# SPDX-License-Identifier: Apache-2.0

CONFIG_SOC_SERIES_NRF52X=y
CONFIG_SOC_NRF52840_QIAA=y
CONFIG_BOARD_MG100=y

# Enable MPU
CONFIG_ARM_MPU=y

# Enable GPIO
CONFIG_GPIO=y

# Enable uart driver
CONFIG_SERIAL=y

# Enable console
CONFIG_CONSOLE=y
CONFIG_UART_CONSOLE=y

# Additional board options
CONFIG_GPIO_AS_PINRESET=y

# 32KHz clock source
CONFIG_CLOCK_CONTROL_NRF_K32SRC_XTAL=y
CONFIG_CLOCK_CONTROL_NRF_K32SRC_150PPM=y

CONFIG_PINCTRL=y
```

## boards/arm/microzed/Kconfig.board
```kconfig
# Microzed board configuration

# Copyright (c) 2023 Marek Vedral <vedrama5@fel.cvut.cz>
# SPDX-License-Identifier: Apache-2.0

config BOARD_MICROZED
	bool "MicroZed board"
	depends on SOC_XILINX_XC7Z010 || SOC_XILINX_XC7Z020
```

## boards/arm/microzed/Kconfig.defconfig
```kconfig
# Avnet Microzed board

# Copyright (c) 2023 Marek Vedral <vedrama5@fel.cvut.cz>
# SPDX-License-Identifier: Apache-2.0

if BOARD_MICROZED

config BOARD
	default "microzed"

endif # BOARD_MICROZED
```

## boards/arm/microzed/microzed_defconfig
```kconfig
CONFIG_SOC_SERIES_XILINX_XC7ZXXX=y
CONFIG_SOC_XILINX_XC7Z020=y
CONFIG_BOARD_MICROZED=y

# Clock settings
CONFIG_ARM_ARCH_TIMER=y
CONFIG_SYS_CLOCK_HW_CYCLES_PER_SEC=333333333
# do not use the TTC as a kernel timer
CONFIG_XLNX_PSTTC_TIMER=n

CONFIG_PINCTRL=y
CONFIG_SERIAL=y
CONFIG_CONSOLE=y
CONFIG_UART_CONSOLE=y
```
