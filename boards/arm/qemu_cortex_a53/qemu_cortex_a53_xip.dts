/*
 * Copyright (c) 2019 Carlo Caione <ccaione@baylibre.com>
 *
 * SPDX-License-Identifier: Apache-2.0
 *
 */

/dts-v1/;
#include <arm/qemu-virt/qemu-virt-a53.dtsi>

/ {
	model = "QEMU Cortex-A53";
	compatible = "qemu,arm-cortex-a53";

	chosen {
		zephyr,sram = &sram0;
		zephyr,console = &uart0;
		zephyr,shell-uart = &uart0;
		zephyr,flash = &flash0;
	};
};

&uart0 {
	status = "okay";
	current-speed = <115200>;
};
