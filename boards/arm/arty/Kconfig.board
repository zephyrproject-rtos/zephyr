## boards/arm/arty/Kconfig.board
```kconfig
# Digilent Arty board configuration

# Copyright (c) 2020 Henrik Brix Andersen <henrik@brixandersen.dk>
# SPDX-License-Identifier: Apache-2.0

config BOARD_ARTY_A7_ARM_DESIGNSTART_M1
	bool "Digilent Arty A7 ARM DesignStart Cortex-M1"
	depends on SOC_SERIES_ARM_DESIGNSTART

config BOARD_ARTY_A7_ARM_DESIGNSTART_M3
	bool "Digilent Arty A7 ARM DesignStart Cortex-M3"
	depends on SOC_SERIES_ARM_DESIGNSTART
```

## boards/arm/arty/Kconfig.defconfig
```kconfig
# Digilent Arty board configuration

# Copyright (c) 2020 Henrik Brix Andersen <henrik@brixandersen.dk>
# SPDX-License-Identifier: Apache-2.0

if BOARD_ARTY_A7_ARM_DESIGNSTART_M1 || BOARD_ARTY_A7_ARM_DESIGNSTART_M3

config BOARD
	default "arty_a7_arm_designstart_m1" if BOARD_ARTY_A7_ARM_DESIGNSTART_M1
	default "arty_a7_arm_designstart_m3" if BOARD_ARTY_A7_ARM_DESIGNSTART_M3

config CPU_CORTEX_M_HAS_SYSTICK
	default y

config CPU_HAS_ARM_MPU
	default y if BOARD_ARTY_A7_ARM_DESIGNSTART_M3

config NUM_IRQS
	default 7

if SERIAL

config UART_XLNX_UARTLITE
	default y

endif # SERIAL

config GPIO
	default y if "$(dt_nodelabel_enabled,daplink_qspi_mux)"

if GPIO

config GPIO_XLNX_AXI
	default y

endif # GPIO

if SPI

config SPI_XLNX_AXI_QUADSPI
	default y

endif # SPI

if FLASH

config SPI
	default y

config SPI_NOR
	default y if SPI_XLNX_AXI_QUADSPI

endif # FLASH

endif # BOARD_ARTY_A7_ARM_DESIGNSTART_M1 || BOARD_ARTY_A7_ARM_DESIGNSTART_M3
```

## boards/arm/arty/arty_a7_arm_designstart_m1_defconfig
```kconfig
# SPDX-License-Identifier: Apache-2.0

CONFIG_CORTEX_M_SYSTICK=y
CONFIG_SOC_SERIES_ARM_DESIGNSTART=y
CONFIG_SOC_ARM_DESIGNSTART_FPGA_CORTEX_M1=y
CONFIG_BOARD_ARTY_A7_ARM_DESIGNSTART_M1=y
CONFIG_SYS_CLOCK_HW_CYCLES_PER_SEC=100000000

CONFIG_SERIAL=y
CONFIG_UART_INTERRUPT_DRIVEN=y
CONFIG_CONSOLE=y
CONFIG_UART_CONSOLE=y
```

## boards/arm/arty/arty_a7_arm_designstart_m3_defconfig
```kconfig
# SPDX-License-Identifier: Apache-2.0

CONFIG_CORTEX_M_SYSTICK=y
CONFIG_SOC_SERIES_ARM_DESIGNSTART=y
CONFIG_SOC_ARM_DESIGNSTART_FPGA_CORTEX_M3=y
CONFIG_BOARD_ARTY_A7_ARM_DESIGNSTART_M3=y
CONFIG_SYS_CLOCK_HW_CYCLES_PER_SEC=50000000
CONFIG_ARM_MPU=y

CONFIG_SERIAL=y
CONFIG_UART_INTERRUPT_DRIVEN=y
CONFIG_CONSOLE=y
CONFIG_UART_CONSOLE=y
```

## boards/arm/ast1030_evb/Kconfig.ast1030_evb
```kconfig
# Copyright (c) 2022 Zephyr Project members and individual contributors
# SPDX-License-Identifier: Apache-2.0

config BOARD_AST1030_EVB
	bool
	default y
	select SOC_SERIES_AST10X0
	select SOC_AST1030
```

## boards/arm/ast1030_evb/Kconfig.defconfig
```kconfig
# SPDX-License-Identifier: Apache-2.0
#
# Aspeed AST1030 evaluation board configuration
#
# Copyright (c) 2021 Aspeed Technology Inc.

if BOARD_AST1030_EVB
config BOARD
	default "ast1030_evb"
endif # BOARD_AST1030_EVB
```

## boards/arm/ast1030_evb/ast1030_evb_defconfig
```kconfig
# SPDX-License-Identifier: Apache-2.0
#
# Copyright (c) 2021 Aspeed Technology Inc.
#
CONFIG_SOC_SERIES_AST10X0=y
CONFIG_SYS_CLOCK_HW_CYCLES_PER_SEC=200000000
CONFIG_MAIN_STACK_SIZE=4096
CONFIG_BOOTLOADER_SRAM_SIZE=0
CONFIG_FLASH_SIZE=0
CONFIG_FLASH_BASE_ADDRESS=0x0
CONFIG_XIP=n
CONFIG_CONSOLE=y
CONFIG_UART_CONSOLE=y
CONFIG_SERIAL=y
CONFIG_UART_NS16550=y
CONFIG_HEAP_MEM_POOL_SIZE=50000
```

## boards/arm/atb1103_golden/Kconfig.board
```kconfig
# Copyright (c) 2019 Actions (Zhuhai) Technology Co., Ltd
#
# SPDX-License-Identifier: Apache-2.0

config BOARD_ATB1103_GOLDEN
	bool "ATB1103 Golden Board"
	depends on SOC_ATB1103
```

## boards/arm/atb1103_golden/Kconfig.defconfig
```kconfig
# Copyright (c) 2019 Actions (Zhuhai) Technology Co., Ltd
#
# SPDX-License-Identifier: Apache-2.0

if BOARD_ATB1103_GOLDEN

config BOARD
	default "atb1103_golden"

if UART_ACTS

config UART_ACTS_UART_0
	default y

endif # UART_ACTS

endif # BOARD_ATB1103_GOLDEN
```

## boards/arm/atb1103_golden/atb1103_golden_defconfig
```kconfig
CONFIG_SOC_ATB1103=y
CONFIG_BOARD_ATB1103_GOLDEN=y
CONFIG_CORTEX_M_SYSTICK=y

# clock configuration
CONFIG_CLOCK_CONTROL=y

# enable console
CONFIG_CONSOLE=y
CONFIG_UART_CONSOLE=y

# enable uart driver
CONFIG_SERIAL=y
CONFIG_UART_INTERRUPT_DRIVEN=y
```

## boards/arm/atm33evk/Kconfig.board
```kconfig
# Copyright (c) 2021-2023 Atmosic
#
# SPDX-License-Identifier: Apache-2.0

config BOARD_ATM33_EVK
	bool "ATM33xx Evaluation Kit Board"

config BOARD_ATM33_EVK_NS
	bool "ATM33xx Evaluation Kit Board Non-Secure"
```

## boards/arm/atm33evk/Kconfig.defconfig
```kconfig
# Copyright (c) 2021-2024 Atmosic
#
# SPDX-License-Identifier: Apache-2.0

if BOARD_ATM33_EVK || BOARD_ATM33_EVK_NS

config BOARD
	default "atm33_evk"

if BT

choice BT_HCI_BUS_TYPE
	default BT_ATMOSIC_HCI
endchoice

config HEAP_MEM_POOL_SIZE
	default 32768

config ENTROPY_GENERATOR
	default y

config BT_HCI_ACL_FLOW_CONTROL
	default n

config BT_AUTO_PHY_UPDATE
	default n
	# To avoid procedure collision.

endif # BT

if SERIAL

config UART_INTERRUPT_DRIVEN
	default y

endif # SERIAL

if BATTERY_UPD

choice BATTERY_TYPE
	prompt "Battery type"
	default BATTERY_TYPE_COIN

config BATTERY_TYPE_COIN
	bool "Battery is coin"

config BATTERY_TYPE_HSC_LIION
	bool "Battery is hsc liion"
endchoice

endif # BATTERY_UPD

endif # BOARD_ATM33_EVK || BOARD_ATM33_EVK_NS
```

## boards/arm/atm34evk/ATMEVK-3425-PQK-5_ns_defconfig
```kconfig
# Copyright (c) 2021-2023 Atmosic
#
# SPDX-License-Identifier: Apache-2.0

CONFIG_SOC_SERIES_ATM34=y
CONFIG_SOC_ATM34xx_5=y
CONFIG_BOARD_ATM34_EVK_NS=y
CONFIG_CORTEX_M_SYSTICK=y
CONFIG_CORTEX_M_SYSTICK_EXTERNAL_REF=y
CONFIG_RUNTIME_NMI=y
CONFIG_USE_DT_CODE_PARTITION=y

# Enable MPU
CONFIG_ARM_MPU=y

# Enable hardware stack protection
CONFIG_HW_STACK_PROTECTION=y

# Enable TrustZone-M
CONFIG_ARM_TRUSTZONE_M=y

# This Board implies building Non-Secure firmware
CONFIG_TRUSTED_EXECUTION_NONSECURE=y

# enable uart driver
CONFIG_SERIAL=y

# enable console
CONFIG_CONSOLE=y
CONFIG_UART_CONSOLE=y

# GPIOs
CONFIG_GPIO=y

# Watchdog
CONFIG_WATCHDOG=y
```

## boards/arm/atm34evk/Kconfig.board
```kconfig
# Copyright (c) 2021-2023 Atmosic
#
# SPDX-License-Identifier: Apache-2.0

config BOARD_ATM34_EVK
	bool "ATM34xx Evaluation Kit Board"

config BOARD_ATM34_EVK_NS
	bool "ATM34xx Evaluation Kit Board Non-Secure"
```

## boards/arm/atmevk-02/Kconfig.board
```kconfig
# Copyright (c) 2021 Atmosic
#
# SPDX-License-Identifier: Apache-2.0

config BOARD_ATMx2_EVK23
	bool "ATMx2xx-x1x Evaluation Kit Board"
```

## boards/arm/atmevk-02/Kconfig.defconfig
```kconfig
# Copyright (c) 2021-2023 Atmosic
#
# SPDX-License-Identifier: Apache-2.0

if BOARD_ATMx2_EVK23

config BOARD
	default "atmx2_evk23"

if BT

choice BT_HCI_BUS_TYPE
	default BT_ATMOSIC_HCI
endchoice

config BT_HCI_ACL_FLOW_CONTROL
	default n

config BT_AUTO_PHY_UPDATE
	default n
	# To avoid procedure collision.

endif # BT

if SERIAL

config UART_INTERRUPT_DRIVEN
	default y

endif # SERIAL

if BATTERY_UPD

choice BATTERY_TYPE
	prompt "Battery type"
	default BATTERY_TYPE_COIN

config BATTERY_TYPE_COIN
	bool "Battery is coin"
endchoice

endif # BATTERY_UPD

endif # BOARD_ATMx2_EVK23
```

## boards/arm/atsamc21n_xpro/Kconfig.board
```kconfig
# SAM C21N Xplained Pro Board configuration

# Copyright (c) 2022 Kamil Serwus
# SPDX-License-Identifier: Apache-2.0

config BOARD_ATSAMC21N_XPRO
	bool "SAM C21N Xplained Pro"
	depends on SOC_PART_NUMBER_SAMC21N18A
```

## boards/arm/atsamc21n_xpro/Kconfig.defconfig
```kconfig
# SAM C21N Xplained Pro board configuration

# Copyright (c) 2022 Kamil Serwus
# SPDX-License-Identifier: Apache-2.0

config BOARD
	default "atsamc21n_xpro"
	depends on BOARD_ATSAMC21N_XPRO
```

## boards/arm/atsamc21n_xpro/atsamc21n_xpro_defconfig
```kconfig
# Copyright (c) 2022 Kamil Serwus
# SPDX-License-Identifier: Apache-2.0
CONFIG_SOC_SERIES_SAMC21=y
CONFIG_SOC_PART_NUMBER_SAMC21N18A=y
CONFIG_BOARD_ATSAMC21N_XPRO=y
CONFIG_BUILD_OUTPUT_HEX=y
CONFIG_CONSOLE=y
CONFIG_UART_CONSOLE=y
CONFIG_SERIAL=y
CONFIG_UART_INTERRUPT_DRIVEN=y
CONFIG_GPIO=y
```

## boards/arm/atsamd20_xpro/Kconfig.atsamd20_xpro
```kconfig
# Copyright (c) 2022 Zephyr Project members and individual contributors
# SPDX-License-Identifier: Apache-2.0

config BOARD_ATSAMD20_XPRO
	bool
	default y
	select SOC_SERIES_SAMD20
	select SOC_PART_NUMBER_SAMD20J18
```

## boards/arm/atsamd20_xpro/Kconfig.board
```kconfig
# SAM D20 Xplained Pro Board configuration

# Copyright (c) 2018 Sean Nyekjaer
# SPDX-License-Identifier: Apache-2.0

config BOARD_ATSAMD20_XPRO
	def_bool "$(BOARD)" = "atsamd20_xpro"
	depends on SOC_PART_NUMBER_SAMD20J18
```

## boards/arm/atsamd20_xpro/Kconfig.defconfig
```kconfig
# SAM D20 Xplained Pro board configuration

# Copyright (c) 2018 Sean Nyekjaer
# SPDX-License-Identifier: Apache-2.0

config BOARD
	default "atsamd20_xpro"
	depends on BOARD_ATSAMD20_XPRO
```

## boards/arm/atsamd20_xpro/atsamd20_xpro_defconfig
```kconfig
# SPDX-License-Identifier: Apache-2.0

CONFIG_SOC_SERIES_SAMD20=y
CONFIG_SOC_PART_NUMBER_SAMD20J18=y
CONFIG_BOARD_ATSAMD20_XPRO=y
CONFIG_BUILD_OUTPUT_HEX=y
CONFIG_CORTEX_M_SYSTICK=y
CONFIG_CONSOLE=y
CONFIG_UART_CONSOLE=y
CONFIG_SERIAL=y
CONFIG_UART_SAM0=y
CONFIG_UART_INTERRUPT_DRIVEN=y
CONFIG_GPIO=y
CONFIG_GPIO_SAM0=y
CONFIG_WATCHDOG=y
CONFIG_WDT_SAM0=y
CONFIG_SOC_ATMEL_SAMD_XOSC32K=y
CONFIG_SOC_ATMEL_SAMD_XOSC32K_AS_MAIN=y
CONFIG_SPI=y
CONFIG_SPI_SAM0=y
CONFIG_PINMUX=y
CONFIG_PINMUX_SAM0=y
```

## boards/arm/atsamd21_custom/Kconfig.atsamd21_custom
```kconfig
# ATSAMD21 Custom board configuration

# Copyright (c) 2020 Google LLC.
# SPDX-License-Identifier: Apache-2.0

config BOARD_ATSAMD21_CUSTOM
	select SOC_SAMD21J18A
```

## boards/arm/atsamd21_custom/board.yml
```yaml
board:
  name: atsamd21_custom
  full_name: ATSAMD21 Custom
  vendor: atmel
  socs:
    - name: samd21j18a
```
