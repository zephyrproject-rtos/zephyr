/*
 * Copyright (c) 2019 Carlo Caione <ccaione@baylibre.com>
 *
 * SPDX-License-Identifier: Apache-2.0
 *
 */

/dts-v1/;
#include <arm/xilinx/zynqmp_apu.dtsi>

/ {
	model = "QEMU Xilinx ZynqMP APU";
	compatible = "xlnx,zynqmp-qemu";

	chosen {
		zephyr,sram = &sram0;
		zephyr,flash = &flash0;
		zephyr,console = &uart0;
		zephyr,shell-uart = &uart0;
	};
};

&uart0 {
	status = "okay";
	current-speed = <115200>;
	clock-frequency = <99999901>;
};

&ttc0 {
	status = "okay";
	clock-frequency = <100000000>;
};
