## boards/arm/qemu_cortex_a53_zynqmp/Kconfig.board
```kconfig
# Copyright (c) 2020 Carlo Caione <ccaione@baylibre.com>
# SPDX-License-Identifier: Apache-2.0

config BOARD_QEMU_CORTEX_A53_ZYNQMP
	bool "Xilinx ZynqMP APU (QEMU)"
	depends on SOC_XILINX_ZYNQMP_APU
	select ARM64
	select QEMU_TARGET
```

## boards/arm/qemu_cortex_a53_zynqmp/Kconfig.defconfig
```kconfig
# Copyright (c) 2020 Carlo Caione <ccaione@baylibre.com>
# SPDX-License-Identifier: Apache-2.0

if BOARD_QEMU_CORTEX_A53_ZYNQMP

config BUILD_OUTPUT_BIN
	default n

config BOARD
	default "qemu_cortex_a53_zynqmp"

endif # BOARD_QEMU_CORTEX_A53_ZYNQMP
```

## boards/arm/qemu_cortex_a53_zynqmp/qemu_cortex_a53_zynqmp_defconfig
```kconfig
CONFIG_ARM=y
CONFIG_SOC_XILINX_ZYNQMP_APU=y
CONFIG_BOARD_QEMU_CORTEX_A53_ZYNQMP=y
CONFIG_ARM_ARCH_TIMER=y
CONFIG_XIP=n

# enable uart driver
CONFIG_SERIAL=y

# enable console
CONFIG_CONSOLE=y
CONFIG_UART_CONSOLE=y

# enable serial port
CONFIG_UART_XLNX_PS=y
```

## boards/arm/qemu_cortex_a9/Kconfig.qemu_cortex_a9
```kconfig
# Copyright (c) 2022 Zephyr Project members and individual contributors
# SPDX-License-Identifier: Apache-2.0

config BOARD_QEMU_CORTEX_A9
	bool
	default y
	select SOC_SERIES_XILINX_XC7ZXXXS
	select SOC_XILINX_XC7Z007S
	select QEMU_TARGET
```

## boards/arm/qemu_cortex_m0/Kconfig
```kconfig
# Copyright (c) 2021 Nordic Semiconductor ASA
# SPDX-License-Identifier: Apache-2.0

config NRF_TIMER_TIMER
	bool "nRF Timer Counter (NRF_TIMER0) Timer"
	depends on CLOCK_CONTROL
	depends on SOC_COMPATIBLE_NRF
	depends on SYS_CLOCK_EXISTS
	select TICKLESS_CAPABLE
	default y
	help
	  This module implements a kernel device driver for the nRF Timer
	  Counter NRF_TIMER0 and provides the standard "system clock driver"
	  interfaces.
```

## boards/arm/qemu_cortex_m0/Kconfig.board
```kconfig
# QEMU Cortex-M0 board configuration

# Copyright (c) 2019 Nordic Semiconductor ASA.
# SPDX-License-Identifier: Apache-2.0

config BOARD_QEMU_CORTEX_M0
	bool "Cortex-M0 Emulation (QEMU)"
	depends on SOC_NRF51822_QFAA
	select QEMU_TARGET
```

## boards/arm/qemu_cortex_m0/Kconfig.defconfig
```kconfig
# QEMU Cortex-M0 board configuration

# Copyright (c) 2019 Nordic Semiconductor ASA.
# SPDX-License-Identifier: Apache-2.0

if BOARD_QEMU_CORTEX_M0

config BOARD
	default "qemu_cortex_m0"

config NRF_RTC_TIMER
	default n if SYS_CLOCK_EXISTS

config SYS_CLOCK_HW_CYCLES_PER_SEC
	default 1000000

config SYS_CLOCK_TICKS_PER_SEC
	default 100

config LOG_BUFFER_SIZE
	default 128 if LOG

endif # BOARD_QEMU_CORTEX_M0
```

## boards/arm/qemu_cortex_m0/Kconfig.qemu_cortex_m0
```kconfig
# Copyright (c) 2022 Zephyr Project members and individual contributors
# SPDX-License-Identifier: Apache-2.0

config BOARD_QEMU_CORTEX_M0
	bool
	default y
	select SOC_SERIES_NRF51X
	select SOC_NRF51822_QFAA
	select QEMU_TARGET
```

## boards/arm/qemu_cortex_m0/qemu_cortex_m0_defconfig
```kconfig
# SPDX-License-Identifier: Apache-2.0

CONFIG_QEMU_ICOUNT_SHIFT=6

# enable GPIO
CONFIG_GPIO=y

# clock control
CONFIG_CLOCK_CONTROL_NRF_K32SRC_XTAL=y

# enable uart driver
CONFIG_SERIAL=y

# enable console
CONFIG_CONSOLE=y
CONFIG_UART_CONSOLE=y

CONFIG_PINCTRL=y
```

## boards/arm/qemu_cortex_m3/Kconfig.board
```kconfig
# SPDX-License-Identifier: Apache-2.0

config BOARD_QEMU_CORTEX_M3
	bool "Cortex-M3 Emulation (QEMU)"
	depends on SOC_TI_LM3S6965
	select QEMU_TARGET
```

## boards/arm/qemu_cortex_m3/Kconfig.defconfig
```kconfig
# SPDX-License-Identifier: Apache-2.0

config BUILD_OUTPUT_BIN
	default n

# DWT is not properly emulated in QEMU
choice NULL_POINTER_EXCEPTION_DETECTION
	bool
	default NULL_POINTER_EXCEPTION_DETECTION_NONE
endchoice
```

## boards/arm/qemu_cortex_m3/Kconfig.qemu_cortex_m3
```kconfig
# Copyright (c) 2022 Zephyr Project members and individual contributors
# SPDX-License-Identifier: Apache-2.0

config BOARD_QEMU_CORTEX_M3
	bool
	default y
	select SOC_TI_LM3S6965
	select QEMU_TARGET
```

## boards/arm/qemu_cortex_m3/qemu_cortex_m3_defconfig
```kconfig
CONFIG_ARM=y
CONFIG_SYS_CLOCK_HW_CYCLES_PER_SEC=12000000
CONFIG_SOC_TI_LM3S6965=y
CONFIG_BOARD_QEMU_CORTEX_M3=y
CONFIG_CONSOLE=y
CONFIG_UART_CONSOLE=y
CONFIG_SERIAL=y
CONFIG_CORTEX_M_SYSTICK=y
CONFIG_UART_STELLARIS=y
CONFIG_SCHED_MULTIQ=y
```

## boards/arm/qemu_cortex_m4f/Kconfig.board
```kconfig
# Copyright (c) 2020 Stephanos Ioannidis <root@stephanos.io>
# SPDX-License-Identifier: Apache-2.0

config BOARD_QEMU_CORTEX_M4F
	bool "Cortex-M4F Emulation (QEMU)"
	depends on SOC_STM32F405XG
	select QEMU_TARGET
```

## boards/arm/qemu_cortex_m4f/Kconfig.defconfig
```kconfig
# Copyright (c) 2020 Stephanos Ioannidis <root@stephanos.io>
# SPDX-License-Identifier: Apache-2.0

if BOARD_QEMU_CORTEX_M4F

config BOARD
	default "qemu_cortex_m4f"

config BUILD_OUTPUT_BIN
	default n

endif # BOARD_QEMU_CORTEX_M4
```

## boards/arm/qemu_cortex_m4f/qemu_cortex_m4f_defconfig
```kconfig
# SPDX-License-Identifier: Apache-2.0

CONFIG_SOC_SERIES_STM32F4X=y
CONFIG_SOC_STM32F405XG=y
CONFIG_QEMU_ICOUNT_SHIFT=8

# 8MHz system clock
CONFIG_SYS_CLOCK_HW_CYCLES_PER_SEC=8000000

# Enable clock configuration
CONFIG_CLOCK_CONTROL=y

# Enable FPU
CONFIG_FPU=y

# Enable MPU
CONFIG_ARM_MPU=y

# Enable GPIO
CONFIG_GPIO=y

# Enable serial
CONFIG_SERIAL=y

# Enable console
CONFIG_CONSOLE=y
CONFIG_UART_CONSOLE=y
```

## boards/arm/qemu_cortex_r5/Kconfig.board
```kconfig
# Copyright (c) 2019 Lexmark International, Inc.
# SPDX-License-Identifier: Apache-2.0

config BOARD_QEMU_CORTEX_R5
	bool "Cortex-R5 Emulation (QEMU)"
	depends on SOC_XILINX_ZYNQMP_RPU
	select QEMU_TARGET
```

## boards/arm/qemu_cortex_r5/Kconfig.defconfig
```kconfig
# Copyright (c) 2019 Lexmark International, Inc.
# SPDX-License-Identifier: Apache-2.0

if BOARD_QEMU_CORTEX_R5

config BUILD_OUTPUT_BIN
	default n

config BOARD
	default "qemu_cortex_r5"

if USERSPACE

config COMPILER_ISA_THUMB2
	default n

endif

endif # BOARD_QEMU_CORTEX_R5
```

## boards/arm/qemu_cortex_r5/Kconfig.qemu_cortex_r5
```kconfig
# Copyright (c) 2022 Zephyr Project members and individual contributors
# SPDX-License-Identifier: Apache-2.0

config BOARD_QEMU_CORTEX_R5
	bool
	default y
	select SOC_XILINX_ZYNQMP_RPU
	select QEMU_TARGET
```

## boards/arm/qemu_mps2/Kconfig.board
```kconfig
#
# Copyright (c) 2017 Linaro Limited
#
# SPDX-License-Identifier: Apache-2.0
#

config BOARD_QEMU_MPS2
	bool "Qemu variant of ARM Cortex-M3 SMM on V2M-MPS2"
	depends on SOC_MPS2_AN385
	select QEMU_TARGET
```

## boards/arm/qomu/Kconfig.defconfig
```kconfig
# QuickLogic Qomu board

# Copyright (c) 2022 Antmicro <www.antmicro.com>
# SPDX-License-Identifier: Apache-2.0

if BOARD_QOMU

config BOARD
	default "qomu"

endif # BOARD_QOMU
```

## boards/arm/qorvo_dwm3001cdk/Kconfig
```kconfig
# Qorvo DWM3001CDK board configuration

# Copyright (c) 2023 Sahas Chitlange, Zephyr Project
# SPDX-License-Identifier: Apache-2.0

config BOARD_ENABLE_DCDC
	bool "DCDC mode"
	select SOC_DCDC_NRF52X
	default y
	depends on BOARD_QORVO_DWM3001CDK
```

## boards/arm/qorvo_dwm3001cdk/Kconfig.board
```kconfig
# Qorvo DWM3001CDK board configuration

# Copyright (c) 2023 Sahas Chitlange, Zephyr Project
# SPDX-License-Identifier: Apache-2.0

config BOARD_QORVO_DWM3001CDK
	bool "Qorvo DWM3001CDK"
	depends on SOC_NRF52833_QIAA
```

## boards/arm/qorvo_dwm3001cdk/Kconfig.defconfig
```kconfig
# Qorvo DWM3001CDK board configuration

# Copyright (c) 2023 Sahas Chitlange, Zephyr Project
# SPDX-License-Identifier: Apache-2.0

if BOARD_QORVO_DWM3001CDK

config BOARD
	default "qorvo_dwm3001cdk"

config BT_CTLR
	default BT

config I2C
	default SENSOR

config SPI
	default y
	depends on IEEE802154

endif # BOARD_QORVO_DWM3001CDK
```

## boards/arm/quark_se_c1000_ble/Kconfig.board
```kconfig
# Kconfig - Quark SE C1000 BLE (nRF51822) configuration
#
# Copyright (c) 2016 Intel Corporation
#
# SPDX-License-Identifier: Apache-2.0

config BOARD_QUARK_SE_C1000_BLE
	bool "Quark SE C1000 Devboard - BLE Core"
	depends on SOC_NRF51822_QFAA
```
