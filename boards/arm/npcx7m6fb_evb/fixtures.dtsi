/*
 * Copyright (c) 2020 Nordic Semiconductor ASA
 *
 * SPDX-License-Identifier: Apache-2.0
 */

/ {
	zephyr,fixture {
		gpio-loopback {
			compatible = "zephyr,fixture,gpio-loopback";
			out-gpios = <&gpioc 5 0>; /* GPIO header 2 */
			in-gpios = <&gpioc 6 0>;  /* GPIO header 3 */
		};
	};
};
