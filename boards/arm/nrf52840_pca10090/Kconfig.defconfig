## boards/arm/nrf52840_pca10090/Kconfig.defconfig
```kconfig
# nRF52840 PCA10090 board configuration

# Copyright (c) 2018 Nordic Semiconductor ASA
# SPDX-License-Identifier: Apache-2.0

if BOARD_NRF52840_PCA10090

config BOARD
	default "nrf52840_pca10090"

config IEEE802154_NRF5
	default y
	depends on IEEE802154

config BT_CTLR
	default BT

endif # BOARD_NRF52840_PCA10090
```

## boards/arm/nrf52840dk_nrf52811/Kconfig
```kconfig
# nRF52840 DK NRF52811 board configuration

# Copyright (c) 2019 Nordic Semiconductor ASA
# SPDX-License-Identifier: Apache-2.0

config BOARD_ENABLE_DCDC
	bool "DCDC mode"
	select SOC_DCDC_NRF52X
	default y
	depends on BOARD_NRF52840DK_NRF52811
```

## boards/arm/nrf52840dk_nrf52811/Kconfig.board
```kconfig
# nRF52840 DK NRF52811 board configuration

# Copyright (c) 2019 Nordic Semiconductor ASA
# SPDX-License-Identifier: Apache-2.0

config BOARD_NRF52840DK_NRF52811
	bool "nRF52840 DK NRF52811"
	depends on SOC_NRF52811_QFAA
```

## boards/arm/nrf52840dk_nrf52811/Kconfig.defconfig
```kconfig
# nRF52840 DK NRF52811 board configuration

# Copyright (c) 2019 Nordic Semiconductor ASA
# SPDX-License-Identifier: Apache-2.0

if BOARD_NRF52840DK_NRF52811

config BOARD
	default "nrf52840dk_nrf52811"

config BT_CTLR
	default BT

config ADC_0
	default y
	depends on ADC

config I2C_0
	default y
	depends on I2C

config SPI_0
	default y
	depends on SPI

config PWM_0
	default y
	depends on PWM

config IEEE802154_NRF5
	default y
	depends on IEEE802154

endif # BOARD_NRF52840DK_NRF52811
```

## boards/arm/nrf52840dk_nrf52811/Kconfig.v2.nrf52840dk_nrf52811
```kconfig
# nRF52840 DK NRF52811 board configuration

# Copyright (c) 2019 Nordic Semiconductor ASA
# SPDX-License-Identifier: Apache-2.0

config BOARD_NRF52840DK_NRF52811
	bool
	default y
	select SOC_NRF52811_QFAA
	select SOC_SERIES_NRF52X
```

## boards/arm/nrf52840dk_nrf52811/nrf52840dk_nrf52811_defconfig
```kconfig
# Copyright (c) 2016 Nordic Semiconductor ASA

# SPDX-License-Identifier: Apache-2.0

CONFIG_SOC_SERIES_NRF52X=y
CONFIG_SOC_NRF52811_QFAA=y
CONFIG_BOARD_NRF52840DK_NRF52811=y

# Enable MPU
CONFIG_ARM_MPU=y

# Enable hardware stack protection
CONFIG_HW_STACK_PROTECTION=y

# Enable UART
CONFIG_SERIAL=y

# enable console
CONFIG_CONSOLE=y
CONFIG_UART_CONSOLE=y

# enable GPIO
CONFIG_GPIO=y

# Bluetooth not enabled by default on nRF52811 due to RAM limitations when
# running the default set of kernel tests.
# Enable this on your prj.conf to include Bluetooth support
```

## boards/arm/nrf52840dk_nrf52840/Kconfig
```kconfig
# nRF52840 DK NRF52840 board configuration

# Copyright (c) 2016 Nordic Semiconductor ASA
# SPDX-License-Identifier: Apache-2.0

config BOARD_ENABLE_DCDC
	bool "Enable DCDC mode"
	select SOC_DCDC_NRF52X
	default y
	depends on BOARD_NRF52840DK_NRF52840
```

## boards/arm/nrf52840dk_nrf52840/Kconfig.board
```kconfig
# nRF52840 DK NRF52840 board configuration

# Copyright (c) 2016 Nordic Semiconductor ASA
# SPDX-License-Identifier: Apache-2.0

config BOARD_NRF52840DK_NRF52840
	bool "nRF52840 DK NRF52840"
	depends on SOC_NRF52840_QIAA
```

## boards/arm/nrf52840dk_nrf52840/Kconfig.defconfig
```kconfig
# nRF52840 DK NRF52840 board configuration

# Copyright (c) 2016 Nordic Semiconductor ASA
# SPDX-License-Identifier: Apache-2.0

if BOARD_NRF52840DK_NRF52840

config BOARD
	default "nrf52840dk_nrf52840"

config BT_CTLR
	default BT

endif # BOARD_NRF52840DK_NRF52840
```

## boards/arm/nrf52840dk_nrf52840/Kconfig.v2.nrf52840dk_nrf52840
```kconfig
# Copyright (c) 2022 Zephyr Project members and individual contributors
# SPDX-License-Identifier: Apache-2.0

config BOARD_NRF52840DK_NRF52840
	bool
	default y
	select SOC_SERIES_NRF52X
	select SOC_NRF52840_QIAA
```

## boards/arm/nrf52840dk_nrf52840/nrf52840dk_nrf52840_defconfig
```kconfig
# SPDX-License-Identifier: Apache-2.0

CONFIG_SOC_SERIES_NRF52X=y
CONFIG_SOC_NRF52840_QIAA=y
CONFIG_BOARD_NRF52840DK_NRF52840=y

# Enable MPU
CONFIG_ARM_MPU=y

# Enable hardware stack protection
CONFIG_HW_STACK_PROTECTION=y

# Enable RTT
CONFIG_USE_SEGGER_RTT=y

# enable GPIO
CONFIG_GPIO=y

# enable uart driver
CONFIG_SERIAL=y

# enable console
CONFIG_CONSOLE=y
CONFIG_UART_CONSOLE=y

# additional board options
CONFIG_GPIO_AS_PINRESET=y

# Specific to beadedstream Spot Logger and D605N
# (might want to make a separate board file at some point)

# LFCLK/SYSTEM CLOCK/32.768Khz clock source
CONFIG_CLOCK_CONTROL_NRF_K32SRC_EXT_FULL_SWING=y
```

## boards/arm/nrf52840dongle_nrf52840/nrf52840dongle_nrf52840_defconfig
```kconfig
# SPDX-License-Identifier: Apache-2.0

CONFIG_SOC_SERIES_NRF52X=y
CONFIG_SOC_NRF52840_QIAA=y
CONFIG_BOARD_NRF52840DONGLE_NRF52840=y

# Enable MPU
CONFIG_ARM_MPU=y

# Enable hardware stack protection
CONFIG_HW_STACK_PROTECTION=y

# enable GPIO
CONFIG_GPIO=y

# additional board options
CONFIG_GPIO_AS_PINRESET=y
CONFIG_NFCT_PINS_AS_GPIOS=y

CONFIG_PINCTRL=y

# Board Kconfig.defconfig enables USB CDC ACM and should disable USB remote
# wakeup by default. It needs to be disabled here, because the USB nrfx
# driver always overwrites option from Kconfig mentioned above with the
# imply from CONFIG_USB_NRFX.
CONFIG_USB_DEVICE_REMOTE_WAKEUP=n
```

## boards/arm/nrf52_adafruit_feather/Kconfig
```kconfig
# nRF52 Adafruit Feather board configuration

# Copyright (c) 2018 LEDCity AG
# SPDX-License-Identifier: Apache-2.0

config BOARD_ENABLE_DCDC
	bool "DCDC mode"
	select SOC_DCDC_NRF52X
	default y
	depends on BOARD_NRF52_ADAFRUIT_FEATHER
```

## boards/arm/nrf52_adafruit_feather/Kconfig.board
```kconfig
# Kconfig - nRF52 ADAFRUIT FEATHER board configuration
#
# Copyright (c) 2018 LEDCity AG.
#
# SPDX-License-Identifier: Apache-2.0


config BOARD_NRF52_ADAFRUIT_FEATHER
	bool "nRF52 ADAFRUIT FEATHER"
	depends on SOC_NRF52832_QFAA
```

## boards/arm/nrf52_adafruit_feather/Kconfig.defconfig
```kconfig
# nRF52 ADAFRUIT FEATHER board configuration

# Copyright (c) 2018 LEDCity AG
# SPDX-License-Identifier: Apache-2.0

config BT_CTLR
	default BT
```

## boards/arm/nrf52_blenano2/Kconfig.board
```kconfig
# nRF52 BLENANO 2 board configuration

# Copyright (c) 2016 Linaro Limited.
# SPDX-License-Identifier: Apache-2.0

config BOARD_NRF52_BLENANO2
	def_bool "$(BOARD)" = "nrf52_blenano2"
	depends on SOC_NRF52832_QFAA
```

## boards/arm/nrf52_blenano2/Kconfig.defconfig
```kconfig
# nRF52 BLENANO 2 board configuration

# Copyright (c) 2016 Nordic Semiconductor ASA
# SPDX-License-Identifier: Apache-2.0

config BT_CTLR
	default BT
```

## boards/arm/nrf52_pca10040/Kconfig
```kconfig
# Kconfig - nRF52 PCA10040 board configuration
#
# Copyright (c) 2016 Nordic Semiconductor ASA
#
# SPDX-License-Identifier: Apache-2.0

if BOARD_NRF52_PCA10040

config BOARD_ENABLE_DCDC
	bool "Enable DCDC mode"
	select SOC_DCDC_NRF52X
	default y

endif # BOARD_NRF52_PCA10040
```

## boards/arm/nrf52_pca10040/Kconfig.board
```kconfig
# Kconfig - nRF52 PCA10040 board configuration
#
# Copyright (c) 2016 Nordic Semiconductor ASA
#
# SPDX-License-Identifier: Apache-2.0

config  BOARD_NRF52_PCA10040
	bool "nRF52 PCA10040"
	depends on SOC_NRF52832_QFAA
```

## boards/arm/nrf52_pca10040/Kconfig.defconfig
```kconfig
# nRF52 PCA10040 board configuration

# Copyright (c) 2016 Nordic Semiconductor ASA
# SPDX-License-Identifier: Apache-2.0

if BOARD_NRF52_PCA10040

config BOARD
	default "nrf52_pca10040"

config ADC_0
	default y
	depends on ADC

config I2C_0
	default y
	depends on I2C

config PWM_0
	default y
	depends on PWM

if SPI

config SPI_1
	default y

config SPI_2
	default y

endif # SPI

config BT_CTLR
	default BT

endif # BOARD_NRF52_PCA10040
```

## boards/arm/nrf52_pca10040/nrf52_pca10040_defconfig
```kconfig
# SPDX-License-Identifier: Apache-2.0

CONFIG_ARM=y
CONFIG_SOC_FAMILY_NRF=y
CONFIG_SOC_SERIES_NRF52X=y
CONFIG_SOC_NRF52832_QFAA=y
CONFIG_BOARD_NRF52_PCA10040=y

# Enable MPU
CONFIG_ARM_MPU=y

# Enable RTT
CONFIG_HAS_SEGGER_RTT=y

# enable GPIO
CONFIG_GPIO=y

# enable uart driver
CONFIG_SERIAL=y
CONFIG_UART_0_NRF_UART=y

# enable console
CONFIG_CONSOLE=y
CONFIG_UART_CONSOLE=y

# additional board options
CONFIG_GPIO_AS_PINRESET=y

# use counter_timer
CONFIG_COUNTER=y
CONFIG_COUNTER_GENERIC=y
CONFIG_COUNTER_TIMER1=y
CONFIG_COUNTER_RTC1=y
CONFIG_NRF_RTC_TIMER=n
CONFIG_SYSTEM_CLOCK_INIT_PRIORITY=60
CONFIG_TIMESLICING=n
```

## boards/arm/nrf52_pca20020/Kconfig
```kconfig
# Kconfig - nRF52_PCA20020 board configuration
#
# Copyright (c) 2018 Aapo Vienamo
#
# SPDX-License-Identifier: Apache-2.0

if BOARD_NRF52_PCA20020

config BOARD_VDD_PWR_CTRL_INIT_PRIORITY
	int "VDD power rail init priority"
	default 50
	depends on GPIO
	help
	  Initialization priority for the VDD power rail. Has to be greater
	  than GPIO_NRF_INIT_PRIORITY.

config BOARD_CCS_VDD_PWR_CTRL_INIT_PRIORITY
	int "CCS_VDD power rail init priority"
	default 85
	depends on GPIO_SX1509B
	help
	  Initialization priority for the CCS_VDD power rail. This powers the
	  CCS811 gas sensor. The value has to be greater than
	  BOARD_VDD_PWR_CTRL_INIT_PRIORITY, but smaller than SENSOR_INIT_PRIORITY.

endif # BOARD_NRF52_PCA20020
```

## boards/arm/nrf52_pca20020/Kconfig.board
```kconfig
# Kconfig - nRF52 PCA20020 board configuration
#
# Copyright (c) 2018 Aapo Vienamo
#
# SPDX-License-Identifier: Apache-2.0

config  BOARD_NRF52_PCA20020
	bool "nRF52 PCA20020"
	select GPIO
	select HAS_DTS_I2C_DEVICE
	depends on SOC_NRF52832_QFAA
```

## boards/arm/nrf52_pca20020/Kconfig.defconfig
```kconfig
# nRF52 PCA20020 board configuration

# Copyright (c) 2018 Aapo Vienamo
# SPDX-License-Identifier: Apache-2.0

if BOARD_NRF52_PCA20020

config BOARD
	default "nrf52_pca20020"

config ADC_0
	default y
	depends on ADC

config I2C
	default y

config BT_CTLR
	default BT

endif # BOARD_NRF52_PCA20020
```

## boards/arm/nrf52_pca20020/nrf52_pca20020_defconfig
```kconfig
CONFIG_ARM=y
CONFIG_SOC_FAMILY_NRF=y
CONFIG_SOC_SERIES_NRF52X=y
CONFIG_SOC_NRF52832_QFAA=y
CONFIG_BOARD_NRF52_PCA20020=y

# Enable MPU
CONFIG_ARM_MPU_NRF52X=y

# enable uart driver
CONFIG_SERIAL=y
CONFIG_UART_NRFX=y
CONFIG_UART_0_NRF_UART=y

# enable console
CONFIG_CONSOLE=y
CONFIG_UART_CONSOLE=y

# bluetooth
CONFIG_BT=y
CONFIG_BT_CTLR=y
```
