## boards/arm/mikroe_clicker_2/Kconfig.board
```kconfig
# MikroE Clicker 2 board configuration

# Copyright (c) 2020 Trifork
# SPDX-License-Identifier: Apache-2.0

config BOARD_MIKROE_CLICKER_2
	bool "MikroE Clicker 2 for STM32 board"
	depends on SOC_STM32F407XG
```

## boards/arm/mikroe_clicker_2/Kconfig.defconfig
```kconfig
# MikroE Clicker 2 board configuration

# Copyright (c) 2020 Trifork
# SPDX-License-Identifier: Apache-2.0

config SPI_STM32_INTERRUPT
	default y
	depends on SPI
```

## boards/arm/mikroe_clicker_2/mikroe_clicker_2_defconfig
```kconfig
CONFIG_BOARD_MIKROE_CLICKER_2=y
CONFIG_SOC_SERIES_STM32F4X=y
CONFIG_SOC_STM32F407XG=y

# Enable MPU
CONFIG_ARM_MPU=y

CONFIG_SERIAL=y

# console
CONFIG_CONSOLE=y

# enable GPIO
CONFIG_GPIO=y

# Enable Clocks
CONFIG_CLOCK_CONTROL=y

# enable pin controller
CONFIG_PINCTRL=y
```

## boards/arm/mikroe_mini_m4_for_stm32/Kconfig.board
```kconfig
# Mikroe MINI-M4 for STM32 board

# Copyright (c) 2019, Kwon Tae-young <tykwon@m2i.co.kr>
# SPDX-License-Identifier: Apache-2.0

config BOARD_MIKROE_MINI_M4_FOR_STM32
	def_bool "$(BOARD)" = "mikroe_mini_m4_for_stm32"
	depends on SOC_STM32F415XX
```

## boards/arm/mikroe_mini_m4_for_stm32/Kconfig.defconfig
```kconfig
# Mikroe MINI-M4 for STM32 board configuration

# Copyright (c) 2019, Kwon Tae-young <tykwon@m2i.co.kr>
# SPDX-License-Identifier: Apache-2.0

config SPI_STM32_INTERRUPT
	default y
	depends on SPI
```

## boards/arm/mikroe_mini_m4_for_stm32/Kconfig.mikroe_mini_m4_for_stm32
```kconfig
# Copyright (c) 2022 Zephyr Project members and individual contributors
# SPDX-License-Identifier: Apache-2.0

config BOARD_MIKROE_MINI_M4_FOR_STM32
	bool
	default y
	select SOC_SERIES_STM32F4X
	select SOC_STM32F415XX
```

## boards/arm/mimx8mm_evk/Kconfig.defconfig
```kconfig
# MIMX8MM EVK board defconfig

# Copyright (c) 2020, Manivannan Sadhasivam <mani@kernel.org>
# SPDX-License-Identifier: Apache-2.0

if BOARD_MIMX8MM_EVK

config BOARD
	default "mimx8mm_evk"

if !XIP
config FLASH_SIZE
	default 0
config FLASH_BASE_ADDRESS
	default 0
endif

endif # BOARD_MIMX8MM_EVK
```

## boards/arm/mimx8mm_evk/Kconfig.mimx8mm_evk
```kconfig
# Copyright (c) 2022 Zephyr Project members and individual contributors
# SPDX-License-Identifier: Apache-2.0

config BOARD_MIMX8MM_EVK
	bool
	default y
	select SOC_SERIES_IMX8MM_M4
	select SOC_MIMX8MM6
	select SOC_PART_NUMBER_MIMX8MM6DVTLZ
```

## boards/arm/mimx8mm_evk/mimx8mm_evk_defconfig
```kconfig
#
# Copyright (c) 2020, Manivannan Sadhasivam <mani@kernel.org>
#
# SPDX-License-Identifier: Apache-2.0
#

CONFIG_SOC_SERIES_IMX8MM_M4=y
CONFIG_SOC_MIMX8MM6=y
CONFIG_BOARD_MIMX8MM_EVK=y
CONFIG_CORTEX_M_SYSTICK=y
CONFIG_CLOCK_CONTROL=y
CONFIG_UART_CONSOLE=y
CONFIG_SERIAL=y
CONFIG_UART_INTERRUPT_DRIVEN=y
CONFIG_CONSOLE=y
CONFIG_XIP=y
CONFIG_PINCTRL=y
```

## boards/arm/mimx8mm_phyboard_polis/mimx8mm_phyboard_polis_defconfig
```kconfig
#
# Copyright (c) 2022 PHYTEC Messtechnik GmbH
#
# SPDX-License-Identifier: Apache-2.0
#

CONFIG_SOC_SERIES_IMX8MM_M4=y
CONFIG_SOC_MIMX8MM6=y
CONFIG_BOARD_MIMX8MM_PHYBOARD_POLIS=y
CONFIG_CORTEX_M_SYSTICK=y
CONFIG_CLOCK_CONTROL=y
CONFIG_UART_CONSOLE=y
CONFIG_SERIAL=y
CONFIG_UART_INTERRUPT_DRIVEN=y
CONFIG_CONSOLE=y
CONFIG_PINCTRL=y
CONFIG_GPIO=y
```

## boards/arm/mimx8mp_evk/Kconfig.board
```kconfig
# MIMX8MP EVK board

# Copyright (c) 2021, Laird Connectivity
# SPDX-License-Identifier: Apache-2.0

config BOARD_MIMX8MP_EVK
	bool "NXP i.MX8M Plus EVK"
	depends on SOC_SERIES_IMX8ML_M7
	select SOC_PART_NUMBER_MIMX8ML8DVNLZ
```

## boards/arm/mimx8mp_evk/Kconfig.defconfig
```kconfig
# MIMX8MP EVK board defconfig

# Copyright (c) 2021, Laird Connectivity
# SPDX-License-Identifier: Apache-2.0

if BOARD_MIMX8MP_EVK

config BOARD
	default "mimx8mp_evk"

if !XIP
config FLASH_SIZE
	default 0
config FLASH_BASE_ADDRESS
	default 0
endif

endif # BOARD_MIMX8MP_EVK
```

## boards/arm/mimx8mp_evk/Kconfig.mimx8mp_evk_itcm
```kconfig
# Copyright (c) 2022 Zephyr Project members and individual contributors
# SPDX-License-Identifier: Apache-2.0

config BOARD_MIMX8MP_EVK_ITCM
	bool
	default y
	select SOC_SERIES_IMX8ML_M7
	select SOC_MIMX8ML8
	select SOC_PART_NUMBER_MIMX8ML8DVNLZ
```

## boards/arm/mimx8mp_evk/mimx8mp_evk_ddr_defconfig
```kconfig
#
# Copyright (c) 2021, Laird Connectivity
#
# SPDX-License-Identifier: Apache-2.0
#

CONFIG_SOC_SERIES_IMX8ML_M7=y
CONFIG_SOC_MIMX8ML8=y
CONFIG_BOARD_MIMX8MP_EVK=y
CONFIG_CLOCK_CONTROL=y
CONFIG_UART_CONSOLE=y
CONFIG_SERIAL=y
CONFIG_UART_INTERRUPT_DRIVEN=y
CONFIG_CONSOLE=y
CONFIG_XIP=y
CONFIG_CODE_DDR=y
CONFIG_PINCTRL=y
```

## boards/arm/mimx8mp_phyboard_pollux/Kconfig.board
```kconfig
# MIMX8MP PhyBOARD Pollux (i.MX8MP)

# Copyright (c) 2022 PHYTEC Messtechnik GmbH
# SPDX-License-Identifier: Apache-2.0

config BOARD_MIMX8MP_PHYBOARD_POLLUX
	bool "PhyBOARD Pollux (i.MX8MP)"
	depends on SOC_SERIES_IMX8ML_M7
	select SOC_PART_NUMBER_MIMX8ML8DVNLZ
```

## boards/arm/mimx8mp_phyboard_pollux/mimx8mp_phyboard_pollux_defconfig
```kconfig
#
# Copyright (c) 2022 PHYTEC Messtechnik GmbH
#
# SPDX-License-Identifier: Apache-2.0
#

CONFIG_SOC_SERIES_IMX8ML_M7=y
CONFIG_SOC_MIMX8ML8=y
CONFIG_BOARD_MIMX8MP_PHYBOARD_POLLUX=y
CONFIG_CORTEX_M_SYSTICK=y
CONFIG_CLOCK_CONTROL=y
CONFIG_UART_CONSOLE=y
CONFIG_SERIAL=y
CONFIG_UART_INTERRUPT_DRIVEN=y
CONFIG_CONSOLE=y

# y for TCM memory space
CONFIG_CODE_ITCM=y

# y for DDR memory space
CONFIG_CODE_DDR=n

CONFIG_PINCTRL=y
```

## boards/arm/mimx8mq_evk/Kconfig.board
```kconfig
# MIMX8MQ EVK board

# Copyright (c) 2021, Kwon Tae-young <tykwon@m2i.co.kr>
# SPDX-License-Identifier: Apache-2.0

config BOARD_MIMX8MQ_EVK_CM4
	bool "NXP i.MX8MQ EVK"
	depends on SOC_SERIES_IMX8MQ_M4
	select SOC_PART_NUMBER_MIMX8MQ6DVAJZ
```

## boards/arm/mimx8mq_evk/Kconfig.defconfig
```kconfig
# MIMX8MQ EVK board defconfig

# Copyright (c) 2021, Kwon Tae-young <tykwon@m2i.co.kr>
# SPDX-License-Identifier: Apache-2.0

if !XIP

config FLASH_SIZE
	default 0

config FLASH_BASE_ADDRESS
	default 0

endif
```

## boards/arm/mimx8mq_evk/Kconfig.mimx8mq_evk_cm4
```kconfig
# Copyright (c) 2022 Zephyr Project members and individual contributors
# SPDX-License-Identifier: Apache-2.0

config BOARD_MIMX8MQ_EVK_CM4
	bool
	default y
	select SOC_SERIES_IMX8MQ_M4
	select SOC_MIMX8MQ6
	select SOC_PART_NUMBER_MIMX8MQ6DVAJZ
```

## boards/arm/mimx8mq_evk/mimx8mq_evk_cm4_defconfig
```kconfig
#
# Copyright (c) 2021, Kwon Tae-young <tykwon@m2i.co.kr>
#
# SPDX-License-Identifier: Apache-2.0
#

CONFIG_SOC_SERIES_IMX8MQ_M4=y
CONFIG_SOC_MIMX8MQ6=y
CONFIG_BOARD_MIMX8MQ_EVK_CM4=y
CONFIG_CORTEX_M_SYSTICK=y
CONFIG_CLOCK_CONTROL=y
CONFIG_UART_CONSOLE=y
CONFIG_SERIAL=y
CONFIG_UART_INTERRUPT_DRIVEN=y
CONFIG_CONSOLE=y
CONFIG_XIP=y
CONFIG_PINCTRL=y
```

## boards/arm/mimxrt1010_evk/Kconfig.board
```kconfig
# NXP MIMXRT1010-EVK

# Copyright (c) 2019, NXP
# SPDX-License-Identifier: Apache-2.0

config BOARD_MIMXRT1010_EVK
	def_bool "$(BOARD)" = "mimxrt1010_evk"
	depends on SOC_SERIES_IMX_RT
	select SOC_PART_NUMBER_MIMXRT1011DAE5A
```

## boards/arm/mimxrt1010_evk/Kconfig.defconfig
```kconfig
# MIMXRT1010-EVK board

# Copyright (c) 2019, NXP
# SPDX-License-Identifier: Apache-2.0

choice CODE_LOCATION
	default CODE_FLEXSPI
endchoice
```

## boards/arm/mimxrt1010_evk/Kconfig.mimxrt1010_evk
```kconfig
# Copyright (c) 2022 Zephyr Project members and individual contributors
# SPDX-License-Identifier: Apache-2.0

config BOARD_MIMXRT1010_EVK
	bool
	default y
	select SOC_MIMXRT1011
	select SOC_SERIES_IMX_RT
	select SOC_PART_NUMBER_MIMXRT1011DAE5A
```

## boards/arm/mimxrt1010_evk/mimxrt1010_evk_defconfig
```kconfig
#
# Copyright (c) 2019, NXP
#
# SPDX-License-Identifier: Apache-2.0
#

CONFIG_SOC_MIMXRT1011=y
CONFIG_SOC_SERIES_IMX_RT=y
CONFIG_CONSOLE=y
CONFIG_UART_CONSOLE=y
CONFIG_SERIAL=y
CONFIG_CORTEX_M_SYSTICK=y
CONFIG_GPIO=y
CONFIG_SYS_CLOCK_HW_CYCLES_PER_SEC=500000000
CONFIG_ARM_MPU=y
CONFIG_HW_STACK_PROTECTION=y
```

## boards/arm/mimxrt1015_evk/Kconfig.board
```kconfig
# NXP MIMXRT1015-EVK

# Copyright (c) 2019, NXP
# SPDX-License-Identifier: Apache-2.0

config BOARD_MIMXRT1015_EVK
	def_bool "$(BOARD)" = "mimxrt1015_evk"
	depends on SOC_SERIES_IMX_RT
	select SOC_PART_NUMBER_MIMXRT1015DAF5A
```
