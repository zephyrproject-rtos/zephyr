/* SPDX-License-Identifier: Apache-2.0 */
/* Copyright (c) 2021 pipei.sandor@gmail.com */

/dts-v1/;

#include <ti/msp432e401y.dtsi>

/ {
	model = "TI MSP-EXP432E401Y DK";
	compatible = "ti,msp-exp432e401y-dk","ti,msp432e401y",
						"ti,msp432e4xx";

	chosen {
		zephyr,sram = &sram0;
		zephyr,flash = &flash0;
	};
};

&cpu0 {
	clock-frequency = <120000000>;
};
