## boards/arm/frdm_kw41z/Kconfig.board
```kconfig
# FRDM-KW41Z board

# Copyright (c) 2017, NXP
# SPDX-License-Identifier: Apache-2.0

config BOARD_FRDM_KW41Z
	bool "NXP FRDM-KW41Z"
	depends on SOC_SERIES_KINETIS_KWX
	select SOC_PART_NUMBER_MKW41Z512VHT4
```

## boards/arm/frdm_kw41z/Kconfig.defconfig
```kconfig
# FRDM-KW41Z board

# Copyright (c) 2017, NXP
# SPDX-License-Identifier: Apache-2.0

if BOARD_FRDM_KW41Z

config BOARD
	default "frdm_kw41z"

config OSC_XTAL0_FREQ
	default 32000000

config MCG_FRDIV
	default 5

config MCG_FCRDIV
	default 0

config I2C
	default y if SENSOR

config FXOS8700_DRDY_INT1
	default y
	depends on FXOS8700_TRIGGER

choice ADC_MCUX_ADC16_VREF
	default ADC_MCUX_ADC16_VREF_ALTERNATE
endchoice

endif # BOARD_FRDM_KW41Z
```

## boards/arm/frdm_kw41z/Kconfig.frdm_kw41z
```kconfig
# Copyright (c) 2022 Zephyr Project members and individual contributors
# SPDX-License-Identifier: Apache-2.0

config BOARD_FRDM_KW41Z
	bool
	default y
	select SOC_MKW41Z4
	select SOC_SERIES_KINETIS_KWX
	select SOC_PART_NUMBER_MKW41Z512VHT4
```

## boards/arm/frdm_kw41z/frdm_kw41z_defconfig
```kconfig
# SPDX-License-Identifier: Apache-2.0

CONFIG_ARM=y
CONFIG_SOC_MKW41Z4=y
CONFIG_SOC_SERIES_KINETIS_KWX=y
CONFIG_BOARD_FRDM_KW41Z=y
CONFIG_CONSOLE=y
CONFIG_UART_CONSOLE=y
CONFIG_SERIAL=y
CONFIG_CORTEX_M_SYSTICK=y
CONFIG_GPIO=y
CONFIG_PINMUX=y
CONFIG_SYS_CLOCK_HW_CYCLES_PER_SEC=40000000
CONFIG_OSC_EXTERNAL=y
CONFIG_XOROSHIRO_RANDOM_GENERATOR=y
CONFIG_ADC_MCUX_ADC16_VREF_ALTERNATE=y
```

## boards/arm/fvp_base_revc_2xaem/Kconfig.defconfig
```kconfig
# Copyright (c) 2021 Carlo Caione <ccaione@baylibre.com>
# SPDX-License-Identifier: Apache-2.0

if BOARD_FVP_BASE_REVC_2XAEM

config BUILD_OUTPUT_BIN
	default y

# Use arch-specific atomic operations workaround with DMB barriers for SMP
config ATOMIC_OPERATIONS_ARCH
	depends on SMP
	default y

endif # BOARD_FVP_BASE_REVC_2XAEM
```

## boards/arm/fvp_base_revc_2xaem/Kconfig.fvp_base_revc_2xaem
```kconfig
# Copyright (c) 2021 Carlo Caione <ccaione@baylibre.com>
# SPDX-License-Identifier: Apache-2.0

config BOARD_FVP_BASE_REVC_2XAEM
	select SOC_V8A
```

## boards/arm/fvp_base_revc_2xaem/board.yml
```yaml
board:
  name: fvp_base_revc_2xaem
  full_name: BASE RevC 2xAEM (Architectural Envelope Model) Fixed Virtual Platform
  vendor: arm
  socs:
  - name: v8a
    variants:
    - name: smp
      variants:
      - name: ns
  - name: v9a
    variants:
    - name: smp
      variants:
      - name: ns
  - name: a320
```

## boards/arm/fvp_base_revc_2xaem/fvp_base_revc_2xaem_v8a_aarch32_defconfig
```kconfig
# SPDX-FileCopyrightText: Copyright Alif Semiconductor
# SPDX-License-Identifier: Apache-2.0

CONFIG_ARM_AARCH32_MMU=y

CONFIG_XIP=n

CONFIG_THREAD_STACK_INFO=y

# Enable Timer and Sys clock
CONFIG_SYS_CLOCK_TICKS_PER_SEC=1000
CONFIG_ARM_ARCH_TIMER=y

# Enable UART driver
CONFIG_SERIAL=y

# Enable serial port
CONFIG_UART_INTERRUPT_DRIVEN=y

# Enable console
CONFIG_CONSOLE=y
CONFIG_UART_CONSOLE=y

# Enable Monitor mode initialization for GICv3 system register access
CONFIG_AARCH32_ARMV8_A_MONITOR_INIT=y
```

## boards/arm/fvp_base_revc_2xaem/fvp_base_revc_2xaem_v8a_aarch32_smp_defconfig
```kconfig
# SPDX-FileCopyrightText: Copyright Alif Semiconductor
# SPDX-License-Identifier: Apache-2.0

CONFIG_ARM_AARCH32_MMU=y

CONFIG_XIP=n

CONFIG_THREAD_STACK_INFO=y

# Enable Timer and Sys clock
CONFIG_SYS_CLOCK_TICKS_PER_SEC=1000
CONFIG_ARM_ARCH_TIMER=y

# Enable UART driver
CONFIG_SERIAL=y

# Enable serial port
CONFIG_UART_INTERRUPT_DRIVEN=y

# Enable console
CONFIG_CONSOLE=y
CONFIG_UART_CONSOLE=y

# Enable Monitor mode initialization for GICv3 system register access.
CONFIG_AARCH32_ARMV8_A_MONITOR_INIT=y

# Enable SMP. The switch-based context path is required for SMP.
CONFIG_USE_SWITCH=y
CONFIG_SMP=y
CONFIG_MP_MAX_NUM_CPUS=4
CONFIG_CACHE_MANAGEMENT=y

# Secondary cores are held powered-off at reset on the FVP Base model and
# must be powered on via the FVP power controller (no PSCI/secure firmware).
CONFIG_PM_CPU_OPS=y
CONFIG_PM_CPU_OPS_FVP=y
CONFIG_PM_CPU_OPS_PSCI=n
```

## boards/arm/fvp_base_revc_2xaem/fvp_base_revc_2xaem_v9a_smp_defconfig
```kconfig
# Copyright (c) 2025 BayLibre SAS
# SPDX-License-Identifier: Apache-2.0

CONFIG_THREAD_STACK_INFO=y

# Enable Timer and Sys clock
CONFIG_SYS_CLOCK_TICKS_PER_SEC=1000
CONFIG_ARM_ARCH_TIMER=y

# Enable UART driver
CONFIG_SERIAL=y

# Enable serial port
CONFIG_UART_INTERRUPT_DRIVEN=y

# Enable console
CONFIG_CONSOLE=y
CONFIG_UART_CONSOLE=y

# Enable SMP
CONFIG_SMP=y
CONFIG_MP_MAX_NUM_CPUS=4
CONFIG_CACHE_MANAGEMENT=y
CONFIG_TIMEOUT_64BIT=y
CONFIG_ARM64_SET_VMPIDR_EL2=y
CONFIG_MAX_THREAD_BYTES=3

# CPU control without PSCI
CONFIG_PM_CPU_OPS_PSCI=n
CONFIG_PM_CPU_OPS=y
CONFIG_PM_CPU_OPS_FVP=y
```

## boards/arm/fvp_base_revc_2xaemv8a/Kconfig.defconfig
```kconfig
# Copyright (c) 2021 Carlo Caione <ccaione@baylibre.com>
# SPDX-License-Identifier: Apache-2.0

if BOARD_FVP_BASE_REVC_2XAEMV8A

config BUILD_OUTPUT_BIN
	default y

endif # BOARD_FVP_BASE_REVC_2XAEMV8A
```

## boards/arm/fvp_base_revc_2xaemv8a/Kconfig.fvp_base_revc_2xaemv8a
```kconfig
# Copyright (c) 2021 Carlo Caione <ccaione@baylibre.com>
# SPDX-License-Identifier: Apache-2.0

config BOARD_FVP_BASE_REVC_2XAEMV8A
	select SOC_SERIES_FVP_AEMV8A
	select SOC_FVP_BASE_REVC_2XAEMV8A
```

## boards/arm/fvp_base_revc_2xaemv8a/board.yml
```yaml
board:
  name: fvp_base_revc_2xaemv8a
  full_name: BASE RevC AEMv8A Fixed Virtual Platforms
  vendor: arm
  socs:
  - name: v8a
    variants:
    - name: smp
      variants:
      - name: ns
```

## boards/arm/fvp_base_revc_2xaemv8a/fvp_base_revc_2xaemv8a_defconfig
```kconfig
# Copyright (c) 2021 Carlo Caione <ccaione@baylibre.com>
# SPDX-License-Identifier: Apache-2.0

CONFIG_XIP=n

CONFIG_THREAD_STACK_INFO=y

# Enable Timer and Sys clock
CONFIG_SYS_CLOCK_TICKS_PER_SEC=1000
CONFIG_ARM_ARCH_TIMER=y

# Enable UART driver
CONFIG_SERIAL=y

# Enable serial port
CONFIG_UART_INTERRUPT_DRIVEN=y

# Enable console
CONFIG_CONSOLE=y
CONFIG_UART_CONSOLE=y
```

## boards/arm/fvp_baser_aemv8r/Kconfig.fvp_baser_aemv8r
```kconfig
# Copyright (c) 2021 Arm Limited (or its affiliates). All rights reserved.
# SPDX-License-Identifier: Apache-2.0

config BOARD_FVP_BASER_AEMV8R
	select SOC_FVP_AEMV8R_AARCH64 if BOARD_FVP_BASER_AEMV8R_FVP_AEMV8R_AARCH64 || BOARD_FVP_BASER_AEMV8R_FVP_AEMV8R_AARCH64_SMP
	select SOC_FVP_AEMV8R_AARCH32 if BOARD_FVP_BASER_AEMV8R_FVP_AEMV8R_AARCH32 || BOARD_FVP_BASER_AEMV8R_FVP_AEMV8R_AARCH32_SMP
```

## boards/arm/fvp_baser_aemv8r/board.yml
```yaml
board:
  name: fvp_baser_aemv8r
  full_name: FVP BaseR AEMv8-R
  vendor: arm
  socs:
  - name: fvp_aemv8r_aarch64
    variants:
    - name: 'smp'
  - name: fvp_aemv8r_aarch32
    variants:
    - name: 'smp'
```

## boards/arm/fvp_baser_aemv8r/fvp_baser_aemv8r_fvp_aemv8r_aarch32_smp_defconfig
```kconfig
# Copyright (c) 2023 Arm Limited (or its affiliates). All rights reserved.
# SPDX-License-Identifier: Apache-2.0

CONFIG_ARM_MPU=y

CONFIG_ISR_STACK_SIZE=1024
CONFIG_THREAD_STACK_INFO=y

# Enable Timer and Sys clock
CONFIG_SYS_CLOCK_TICKS_PER_SEC=100
CONFIG_ARM_ARCH_TIMER=y

# Enable UART driver
CONFIG_SERIAL=y

# Enable serial port
CONFIG_UART_INTERRUPT_DRIVEN=y

# Enable console
CONFIG_CONSOLE=y
CONFIG_UART_CONSOLE=y

CONFIG_CACHE_MANAGEMENT=y
CONFIG_DCACHE=n

CONFIG_USE_SWITCH=y
CONFIG_SMP=y
CONFIG_MP_MAX_NUM_CPUS=4
```

## boards/arm/fvp_baser_aemv8r/fvp_baser_aemv8r_fvp_aemv8r_aarch64_smp_defconfig
```kconfig
# Copyright (c) 2021 Arm Limited (or its affiliates). All rights reserved.
# SPDX-License-Identifier: Apache-2.0

# Enable simulated CPU power management
CONFIG_SOC_FVP_AEMV8R_SIMULATE_CPU_PM=y
CONFIG_PM_CPU_OPS=y
CONFIG_PM_CPU_OPS_PSCI=n
CONFIG_ARM64_SET_VMPIDR_EL2=y

CONFIG_SMP=y
CONFIG_MP_MAX_NUM_CPUS=4

CONFIG_MAX_THREAD_BYTES=3
```

## boards/arm/fvp_baser_aemv8r_aarch32/Kconfig.board
```kconfig
# Copyright (c) 2021 Arm Limited (or its affiliates). All rights reserved.
# Copyright (c) 2022 IoT.bzh
# Copyright 2023 NXP
# SPDX-License-Identifier: Apache-2.0

config BOARD_FVP_BASER_AEMV8R_AARCH32
	bool "FVP BaseR AEMv8R AArch32 simulation board"
	depends on SOC_FVP_AEMV8R_AARCH32

config BOARD_FVP_BASER_AEMV8R_AARCH32_THUMB
	bool "FVP BaseR AEMv8R AArch32 in Thumb2 mode simulation board"
	depends on SOC_FVP_AEMV8R_AARCH32
```

## boards/arm/fvp_baser_aemv8r_aarch32/Kconfig.defconfig
```kconfig
# Copyright (c) 2021 Arm Limited (or its affiliates). All rights reserved.
# Copyright (c) 2022 IoT.bzh
# SPDX-License-Identifier: Apache-2.0

if BOARD_FVP_BASER_AEMV8R_AARCH32

config BUILD_OUTPUT_BIN
	default y

config BOARD
	default "fvp_baser_aemv8r_aarch32"

endif # BOARD_FVP_BASER_AEMV8R_AARCH32
```

## boards/arm/fvp_baser_aemv8r_aarch32/fvp_baser_aemv8r_aarch32_defconfig
```kconfig
# Copyright (c) 2021 Arm Limited (or its affiliates). All rights reserved.
# Copyright (c) 2022 IoT.bzh
# SPDX-License-Identifier: Apache-2.0

CONFIG_SOC_SERIES_FVP_AEMV8R_AARCH32=y
CONFIG_SOC_FVP_AEMV8R_AARCH32=y
CONFIG_BOARD_FVP_BASER_AEMV8R_AARCH32=y
CONFIG_ARM_MPU=y

CONFIG_ISR_STACK_SIZE=1024
CONFIG_THREAD_STACK_INFO=y

# Enable Timer and Sys clock
CONFIG_SYS_CLOCK_TICKS_PER_SEC=100
CONFIG_ARM_ARCH_TIMER=y

# Enable UART driver
CONFIG_SERIAL=y

# Enable serial port
CONFIG_UART_INTERRUPT_DRIVEN=y

# Enable console
CONFIG_CONSOLE=y
CONFIG_UART_CONSOLE=y
```

## boards/arm/fvp_corstone1000/Kconfig.fvp_corstone1000
```kconfig
# Copyright (c) 2026 BayLibre SAS
# SPDX-License-Identifier: Apache-2.0

config BOARD_FVP_CORSTONE1000
	select SOC_A320 if BOARD_FVP_CORSTONE1000_A320
	select SOC_A320 if BOARD_FVP_CORSTONE1000_A320_SMP
```

## boards/arm/fvp_corstone1000/Kconfig.sysbuild
```kconfig
# Copyright (c) 2026 BayLibre SAS
# SPDX-License-Identifier: Apache-2.0

if BOARD_FVP_CORSTONE1000

config CORSTONE1000_TFM_DEBUG
	bool "Build TF-M in debug mode"
	default y
	help
	  Build TF-M with debug configuration.

config CORSTONE1000_TFM_LOG_LEVEL
	int "TF-M log level (0=NONE, 1=ERROR, 2=WARNING, 3=INFO, 4=DEBUG)"
	default 3
	range 0 4
	help
	  Set the log level for TF-M BL1 and MCUboot BL2.
	  DEBUG is very verbose and significantly slows boot.

config CORSTONE1000_TFA_DEBUG
	bool "Build TF-A in debug mode"
	help
	  Build TF-A with debug configuration.

config CORSTONE1000_FIP_PARTITION_SIZE_MB
	int "FIP partition size in MB"
	default 8
	range 1 15
	help
	  Size of the FIP_A and FIP_B GPT partitions in the Secure Enclave
	  flash image (in megabytes).  The FIP contains TF-A BL2, BL31, and
	  the Zephyr application (BL33).  Increase this if the application
	  binary is large.

	  The 32 MB flash image must accommodate both FIP partitions plus
	  the TF-M partitions, so the maximum practical value is ~15 MB.

endif # BOARD_FVP_CORSTONE1000
```

## boards/arm/fvp_corstone1000/board.yml
```yaml
board:
  name: fvp_corstone1000
  full_name: Arm Corstone-1000-A320 Fixed Virtual Platform
  vendor: arm
  socs:
  - name: a320
```

## boards/arm/fvp_corstone1000/fvp_corstone1000_a320_defconfig
```kconfig
# Copyright (c) 2026 BayLibre SAS
# SPDX-License-Identifier: Apache-2.0

CONFIG_XIP=n

# Enable Timer and Sys clock
CONFIG_SYS_CLOCK_TICKS_PER_SEC=1000
CONFIG_ARM_ARCH_TIMER=y

# Enable UART driver
CONFIG_SERIAL=y

# Enable serial port
CONFIG_UART_INTERRUPT_DRIVEN=y

# Enable console
CONFIG_CONSOLE=y
CONFIG_UART_CONSOLE=y

# Run in Non-Secure mode (EL1NS) - TF-A handles secure boot
CONFIG_ARMV8_A_NS=y

# PSCI support for CPU power management
CONFIG_PM_CPU_OPS=y

# 64-bit timeout for long-running operations
CONFIG_TIMEOUT_64BIT=y

# Cache management
CONFIG_CACHE_MANAGEMENT=y
```
