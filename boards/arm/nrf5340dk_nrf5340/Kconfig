## boards/arm/nrf9160_innblue20/Kconfig.board
```kconfig
# Kconfig - nRF9160 PCA10090 board configuration
#
# Copyright (c) 2018 Nordic Semiconductor ASA
#
# SPDX-License-Identifier: Apache-2.0

if SOC_NRF9160_SICA

config BOARD_NRF9160_INNBLUE20
	bool "nRF9160 innblue v20"
	depends on !TRUSTED_EXECUTION_NONSECURE

config BOARD_NRF9160_INNBLUE20NS
	bool "nRF9160 innblue v20 non-secure"
	depends on TRUSTED_EXECUTION_NONSECURE

endif # SOC_NRF9160_SICA
```

## boards/arm/nrf9160_innblue21/Kconfig.board
```kconfig
# nRF9160 innblue V2.1 board configuration

# Copyright (c) 2020 InnBlue
# SPDX-License-Identifier: Apache-2.0

if SOC_NRF9160_SICA

config BOARD_NRF9160_INNBLUE21
	bool "nRF9160 innblue v2.1"

config BOARD_NRF9160_INNBLUE21NS
	bool "nRF9160 innblue v2.1 non-secure"

endif # SOC_NRF9160_SICA
```

## boards/arm/nrf9160_innblue21/Kconfig.defconfig
```kconfig
# nRF9160 innblue V2.1 board configuration

# Copyright (c) 2020 InnBlue
# SPDX-License-Identifier: Apache-2.0

if BOARD_NRF9160_INNBLUE21 || BOARD_NRF9160_INNBLUE21NS

config BOARD
	default "nrf9160_innblue21"

# For the secure version of the board the firmware is linked at the beginning
# of the flash, or into the code-partition defined in DT if it is intended to
# be loaded by MCUboot. If the secure firmware is to be combined with a non-
# secure image (TRUSTED_EXECUTION_SECURE=y), the secure FW image shall always
# be restricted to the size of its code partition.
# For the non-secure version of the board, the firmware
# must be linked into the code-partition (non-secure) defined in DT, regardless.
# Apply this configuration below by setting the Kconfig symbols used by
# the linker according to the information extracted from DT partitions.


# Workaround for not being able to have commas in macro arguments
DT_CHOSEN_Z_CODE_PARTITION := zephyr,code-partition

if BOARD_NRF9160_INNBLUE21 && TRUSTED_EXECUTION_SECURE

config FLASH_LOAD_SIZE
	default $(dt_chosen_reg_size_hex,$(DT_CHOSEN_Z_CODE_PARTITION))

endif # BOARD_NRF9160_INNBLUE21 && TRUSTED_EXECUTION_SECURE

if BOARD_NRF9160_INNBLUE21NS

config FLASH_LOAD_OFFSET
	default $(dt_chosen_reg_addr_hex,$(DT_CHOSEN_Z_CODE_PARTITION))

config FLASH_LOAD_SIZE
	default $(dt_chosen_reg_size_hex,$(DT_CHOSEN_Z_CODE_PARTITION))

endif # BOARD_NRF9160_INNBLUE21NS

endif # BOARD_NRF9160_INNBLUE21 || BOARD_NRF9160_INNBLUE21NS
```

## boards/arm/nrf9160_innblue22/Kconfig.board
```kconfig
# nRF9160 innblue V2.2 board configuration

# Copyright (c) 2020 InnBlue
# SPDX-License-Identifier: Apache-2.0

if SOC_NRF9160_SICA

config BOARD_NRF9160_INNBLUE22
	bool "nRF9160 innblue v2.2"

config BOARD_NRF9160_INNBLUE22NS
	bool "nRF9160 innblue V2.2 non-secure"

endif # SOC_NRF9160_SICA
```

## boards/arm/nrf9160_innblue22/Kconfig.nrf9160_innblue22_ns
```kconfig
# Copyright (c) 2022 Zephyr Project members and individual contributors
# SPDX-License-Identifier: Apache-2.0

config BOARD_NRF9160_INNBLUE22_NS
	bool
	default y
	select SOC_SERIES_NRF91X
	select SOC_NRF9160_SICA
```

## boards/arm/nrf9160_innblue22/nrf9160_innblue22ns_defconfig
```kconfig
# Copyright (c) 2020 InnBlue
# SPDX-License-Identifier: Apache-2.0

# SOC / Board
CONFIG_SOC_SERIES_NRF91X=y
CONFIG_SOC_NRF9160_SICA=y
CONFIG_BOARD_NRF9160_INNBLUE22NS=y

# Enable MPU
CONFIG_ARM_MPU=y

# Enable TrustZone-M
CONFIG_ARM_TRUSTZONE_M=y

# This Board implies building Non-Secure firmware
CONFIG_TRUSTED_EXECUTION_NONSECURE=y

# enable GPIO
CONFIG_GPIO=y

# Enable uart driver
CONFIG_SERIAL=y

# enable console
CONFIG_CONSOLE=y
CONFIG_UART_CONSOLE=y
```

## boards/arm/nrf9160_pca10090/Kconfig
```kconfig
# Kconfig - nRF9160 PCA10090 board configuration
#
# Copyright (c) 2018 Nordic Semiconductor ASA
#
# SPDX-License-Identifier: Apache-2.0

if BOARD_NRF9160_PCA10090 || BOARD_NRF9160_PCA10090NS

config BOARD_NRF52840_GPIO_RESET
        bool "Use nRF52840 PCA10090 GPIO reset pin"
	default y if BT_H4
        help
          Use a GPIO pin to reset the nRF52840 controller and let it wait
          until all bytes traveling to the H4 device have been received
          and drained, thus ensuring communication can begin correctly.

if BOARD_NRF52840_GPIO_RESET

config BOARD_NRF52840_GPIO_RESET_PIN
        int "Reset pin"
        range 17 23
        default 23
        help
          GPIO pin on the nRF9160 used to reset the nRF52840.

endif

endif # BOARD_NRF9160_PCA10090 || BOARD_NRF9160_PCA10090NS
```

## boards/arm/nrf9160_pca10090/Kconfig.board
```kconfig
# nRF9160 PCA10090 board configuration

# Copyright (c) 2018 Nordic Semiconductor ASA
# SPDX-License-Identifier: Apache-2.0

if SOC_NRF9160_SICA

config BOARD_NRF9160_PCA10090
	def_bool "$(BOARD)" = "nrf9160_pca10090"

# Non-secure
config BOARD_NRF9160_PCA10090NS
	def_bool "$(BOARD)" = "nrf9160_pca10090ns"

endif # SOC_NRF9160_SICA
```
