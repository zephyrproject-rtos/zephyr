/*
 * Copyright (c) 2019-2020 Nordic Semiconductor ASA
 *
 * SPDX-License-Identifier: Apache-2.0
 */

/dts-v1/;
#include <nordic/nrf5340_cpuapp_qkaa_eng_a.dtsi>
#include "nrf5340_cpuapp_common.dts"

/ {
	model = "Nordic NRF5340 PDK NRF5340 Application";
	compatible = "nordic,nrf5340-pdk-nrf5340-cpuapp";

	chosen {
		zephyr,sram = &sram0_image;
		zephyr,flash = &flash0;
		zephyr,code-partition = &slot0_partition;
		zephyr,single-image-code-partition = &code_partition;
		zephyr,code-s-partition = &slot0_s_partition;
		zephyr,single-image-code-s-partition = &code_s_partition;
		zephyr,sram-secure-partition = &sram0_s;
		zephyr,sram-non-secure-partition = &sram0_ns;
	};
};
