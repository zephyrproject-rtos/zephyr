## boards/arm/adafruit_feather_m0_basic_proto/Kconfig.adafruit_feather_m0_basic_proto
```kconfig
# Copyright (c) 2022 Zephyr Project members and individual contributors
# SPDX-License-Identifier: Apache-2.0

config BOARD_ADAFRUIT_FEATHER_M0_BASIC_PROTO
	bool
	default y
	select SOC_SERIES_SAMD21
	select SOC_PART_NUMBER_SAMD21G18A
```

## boards/arm/adafruit_feather_m0_basic_proto/Kconfig.board
```kconfig
# Adafruit Feather M0 Basic Proto board configuration

# Copyright (c) 2018 Henrik Brix Andersen <henrik@brixandersen.dk>
# SPDX-License-Identifier: Apache-2.0

config BOARD_ADAFRUIT_FEATHER_M0_BASIC_PROTO
	bool "Adafruit Feather M0 Basic Proto"
	depends on SOC_PART_NUMBER_SAMD21G18A
```

## boards/arm/adafruit_feather_m0_basic_proto/Kconfig.defconfig
```kconfig
# Kconfig - Adafruit Feather M0 Basic Proto board configuration
#
# Copyright (c) 2018 Henrik Brix Andersen <henrik@brixandersen.dk>
#
# SPDX-License-Identifier: Apache-2.0

if BOARD_ADAFRUIT_FEATHER_M0_BASIC_PROTO

config BOARD
	default "adafruit_feather_m0_basic_proto"

endif
```

## boards/arm/adafruit_feather_m0_basic_proto/adafruit_feather_m0_basic_proto_defconfig
```kconfig
# SPDX-License-Identifier: Apache-2.0

CONFIG_SOC_SERIES_SAMD21=y
CONFIG_SOC_PART_NUMBER_SAMD21G18A=y
CONFIG_BOARD_ADAFRUIT_FEATHER_M0_BASIC_PROTO=y
CONFIG_CORTEX_M_SYSTICK=y
CONFIG_CONSOLE=y
CONFIG_UART_CONSOLE=y
CONFIG_SERIAL=y
CONFIG_UART_SAM0=y
CONFIG_UART_INTERRUPT_DRIVEN=y
CONFIG_GPIO=y
CONFIG_GPIO_SAM0=y
CONFIG_WATCHDOG=y
CONFIG_WDT_SAM0=y
CONFIG_SOC_ATMEL_SAMD_XOSC32K=y
CONFIG_SOC_ATMEL_SAMD_XOSC32K_AS_MAIN=y
CONFIG_SPI=y
CONFIG_SPI_SAM0=y
CONFIG_PINMUX=y
CONFIG_PINMUX_SAM0=y
CONFIG_USB=y
CONFIG_USB_DC_SAM0=y
CONFIG_USE_DT_CODE_PARTITION=y
CONFIG_I2C=y
CONFIG_I2C_SAM0=y
```

## boards/arm/adafruit_feather_m0_lora/Kconfig.board
```kconfig
# Adafruit Feather M0 LoRa board configuration

# Copyright (c) 2022 Miguel Dardenne <miguel.dardenne@gmail.com>
# SPDX-License-Identifier: Apache-2.0

config BOARD_ADAFRUIT_FEATHER_M0_LORA
	bool "Adafruit Feather M0 LoRa"
	depends on SOC_PART_NUMBER_SAMD21G18A
```

## boards/arm/adafruit_feather_m4_express/Kconfig.board
```kconfig
# Adafruit ItsyBitsy M4 Express board configuration

# Copyright (c) 2020 Google LLC.
# SPDX-License-Identifier: Apache-2.0

config BOARD_ADAFRUIT_FEATHER_M4_EXPRESS
	bool "Adafruit Feather M4 Express"
	depends on SOC_PART_NUMBER_SAMD51G19A
```

## boards/arm/adafruit_feather_nrf52840/Kconfig
```kconfig
# Adafruit Feather nRF52840 board configuration

# Copyright (c) 2020 Tobias Svehagen
# SPDX-License-Identifier: Apache-2.0

config BOARD_ENABLE_DCDC
	bool "DCDC mode"
	select SOC_DCDC_NRF52X
	default y
	depends on BOARD_ADAFRUIT_FEATHER_NRF52840 \
		|| BOARD_ADAFRUIT_FEATHER_NRF52840_SENSE
```

## boards/arm/adafruit_feather_nrf52840/Kconfig.board
```kconfig
# Adafruit Feather nRF52840 board configuration

# Copyright (c) 2020 Tobias Svehagen
# SPDX-License-Identifier: Apache-2.0

config BOARD_ADAFRUIT_FEATHER_NRF52840
	bool "Adafruit Feather nRF52840 Express"
	depends on SOC_NRF52840_QIAA

config BOARD_ADAFRUIT_FEATHER_NRF52840_SENSE
	bool "Adafruit Feather nRF52840 Sense"
	depends on SOC_NRF52840_QIAA
```

## boards/arm/adafruit_feather_nrf52840/Kconfig.defconfig
```kconfig
# Adafruit Feather nRF52840 Express board configuration

# Copyright (c) 2020 Tobias Svehagen
# SPDX-License-Identifier: Apache-2.0

config BT_CTLR
	default BT
```

## boards/arm/adafruit_feather_nrf52840/adafruit_feather_nrf52840_defconfig
```kconfig
# SPDX-License-Identifier: Apache-2.0

CONFIG_SOC_SERIES_NRF52X=y
CONFIG_SOC_NRF52840_QIAA=y
CONFIG_BOARD_ADAFRUIT_FEATHER_NRF52840=y

# Enable MPU
CONFIG_ARM_MPU=y

# enable GPIO
CONFIG_GPIO=y

# enable uart driver
CONFIG_SERIAL=y

# enable console
CONFIG_CONSOLE=y
CONFIG_UART_CONSOLE=y

# additional board options
CONFIG_GPIO_AS_PINRESET=y

CONFIG_PINCTRL=y
```

## boards/arm/adafruit_feather_nrf52840_sense/Kconfig.board
```kconfig
# Adafruit Feather nRF52840 Sense board configuration

# SPDX-License-Identifier: Apache-2.0

config BOARD_ADAFRUIT_FEATHER_NRF52840_SENSE
	bool "Adafruit Feather nRF52840 Sense"
	depends on SOC_NRF52840_QIAA
```

## boards/arm/adafruit_feather_nrf52840_sense/Kconfig.defconfig
```kconfig
# Adafruit Feather nRF52840 Sense board configuration

# SPDX-License-Identifier: Apache-2.0

if BOARD_ADAFRUIT_FEATHER_NRF52840_SENSE

config BOARD
	default "adafruit_feather_nrf52840_sense"

config BT_CTLR
	default BT

endif # BOARD_ADAFRUIT_FEATHER_NRF52840_SENSE
```

## boards/arm/adafruit_feather_nrf52840_sense/adafruit_feather_nrf52840_sense_defconfig
```kconfig
# SPDX-License-Identifier: Apache-2.0

CONFIG_SOC_SERIES_NRF52X=y
CONFIG_SOC_NRF52840_QIAA=y
CONFIG_BOARD_ADAFRUIT_FEATHER_NRF52840_SENSE=y

# Enable MPU
CONFIG_ARM_MPU=y

# enable GPIO
CONFIG_GPIO=y

# enable uart driver
CONFIG_SERIAL=y

# enable console
CONFIG_CONSOLE=y
CONFIG_UART_CONSOLE=y

# 32kHz clock source
CONFIG_CLOCK_CONTROL_NRF_K32SRC_RC=y
CONFIG_CLOCK_CONTROL_NRF_K32SRC_500PPM=y

# enable bossac
CONFIG_BOOTLOADER_BOSSA=y
CONFIG_BOOTLOADER_BOSSA_ADAFRUIT_UF2=y
```

## boards/arm/adafruit_feather_stm32f405/Kconfig.adafruit_feather_stm32f405
```kconfig
# Copyright (c) 2022 Zephyr Project members and individual contributors
# SPDX-License-Identifier: Apache-2.0

config BOARD_ADAFRUIT_FEATHER_STM32F405
	bool
	default y
	select SOC_SERIES_STM32F4X
	select SOC_STM32F405XG
```

## boards/arm/adafruit_feather_stm32f405/Kconfig.defconfig
```kconfig
# Adafruit Feather STM32F405 Express board configuration

# Copyright (c) 2020 Lucian Copeland for Adafruit Industries.
# SPDX-License-Identifier: Apache-2.0

if BOARD_ADAFRUIT_FEATHER_STM32F405

config BOARD
	default "adafruit_feather_stm32f405"

config UART_3
	default y
	depends on UART_CONSOLE

config I2C_1
	default y
	depends on I2C

config SPI_1
	default y
	depends on SPI

config SPI_2
	default y
	depends on SPI

endif # BOARD_ADAFRUIT_FEATHER_STM32F405
```

## boards/arm/adafruit_grand_central_m4_express/Kconfig.board
```kconfig
# Adafruit Grand Central M4 Express board configuration

# Copyright (c) 2023 Lukas Jung <lukas.jung@mailbox.org>
# SPDX-License-Identifier: Apache-2.0

config BOARD_ADAFRUIT_GRAND_CENTRAL_M4_EXPRESS
	bool "Adafruit Grand Central M4 Express"
	depends on SOC_PART_NUMBER_SAMD51P20A
```

## boards/arm/adafruit_grand_central_m4_express/adafruit_grand_central_m4_express_defconfig
```kconfig
# SPDX-License-Identifier: Apache-2.0

CONFIG_SOC_SERIES_SAMD51=y
CONFIG_SOC_PART_NUMBER_SAMD51P20A=y
CONFIG_BOARD_ADAFRUIT_GRAND_CENTRAL_M4_EXPRESS=y
CONFIG_SOC_ATMEL_SAMD5X_XOSC32K=y
CONFIG_SOC_ATMEL_SAMD5X_XOSC32K_AS_MAIN=y
CONFIG_ARM_MPU=y
CONFIG_HW_STACK_PROTECTION=y
CONFIG_CONSOLE=y
CONFIG_UART_CONSOLE=y
CONFIG_UART_INTERRUPT_DRIVEN=y
CONFIG_SERIAL=y
CONFIG_GPIO=y

CONFIG_BOOTLOADER_BOSSA=y
CONFIG_BOOTLOADER_BOSSA_ADAFRUIT_UF2=y
CONFIG_BUILD_OUTPUT_UF2=y
CONFIG_BUILD_OUTPUT_HEX=y
```

## boards/arm/adafruit_itsybitsy_m4_express/Kconfig.adafruit_itsybitsy_m4_express
```kconfig
# Copyright (c) 2022 Zephyr Project members and individual contributors
# SPDX-License-Identifier: Apache-2.0

config BOARD_ADAFRUIT_ITSYBITSY_M4_EXPRESS
	bool
	default y
	select SOC_SERIES_SAMD51
	select SOC_PART_NUMBER_SAMD51G19A
```

## boards/arm/adafruit_itsybitsy_m4_express/Kconfig.defconfig
```kconfig
# Adafruit ItsyBitsy M4 Express board configuration

# Copyright (c) 2020 Google LLC.
# SPDX-License-Identifier: Apache-2.0

config BOARD
	default "adafruit_itsybitsy_m4_express"
	depends on BOARD_ADAFRUIT_ITSYBITSY_M4_EXPRESS
```

## boards/arm/adafruit_itsybitsy_m4_express/adafruit_itsybitsy_m4_express_defconfig
```kconfig
# SPDX-License-Identifier: Apache-2.0

CONFIG_SOC_SERIES_SAMD51=y
CONFIG_SOC_PART_NUMBER_SAMD51G19A=y
CONFIG_BOARD_ADAFRUIT_ITSYBITSY_M4_EXPRESS=y
CONFIG_SOC_ATMEL_SAMD5X_OSCULP32K_AS_MAIN=y
CONFIG_ARM_MPU=y
CONFIG_CONSOLE=y
CONFIG_UART_CONSOLE=y
CONFIG_UART_INTERRUPT_DRIVEN=y
CONFIG_SERIAL=y
CONFIG_BOOTLOADER_BOSSA=y
CONFIG_BOOTLOADER_BOSSA_ADAFRUIT_UF2=y
```

## boards/arm/adafruit_itsybitsy_nrf52840/Kconfig
```kconfig
# Adafruit ItsyBitsy nRF52840 Express board configuration

# Copyright (c) 2022 Embla Flatlandsmo <embla.flatlandsmo@gmail.com>
# SPDX-License-Identifier: Apache-2.0

config BOARD_ENABLE_DCDC
	bool "DCDC mode"
	select SOC_DCDC_NRF52X
	default y
	depends on BOARD_ADAFRUIT_ITSYBITSY_NRF52840

config BOARD_SERIAL_BACKEND_CDC_ACM
	bool "USB CDC"
	default y
```

## boards/arm/adafruit_kb2040/Kconfig.board
```kconfig
# Copyright (c) 2022 Pete Johanson
# SPDX-License-Identifier: Apache-2.0

config BOARD_ADAFRUIT_KB2040
	bool "Adafruit KB2040 Board"
	depends on SOC_RP2040
```

## boards/arm/adafruit_kb2040/Kconfig.defconfig
```kconfig
# Copyright (c) 2022 Peter Johanson
# SPDX-License-Identifier: Apache-2.0

if BOARD_ADAFRUIT_KB2040

config BOARD
	default "adafruit_kb2040"

config RP2_FLASH_W25Q080
	default y

if I2C_DW

config I2C_DW_CLOCK_SPEED
	default 125

endif #I2C_DW

config USB_SELF_POWERED
	default n

endif # BOARD_ADAFRUIT_KB2040
```

## boards/arm/adafruit_kb2040/adafruit_kb2040_defconfig
```kconfig
# SPDX-License-Identifier: Apache-2.0

CONFIG_SOC_SERIES_RP2XXX=y
CONFIG_SOC_RP2040=y
CONFIG_BOARD_ADAFRUIT_KB2040=y

CONFIG_SYS_CLOCK_HW_CYCLES_PER_SEC=125000000

# enable uart driver
CONFIG_SERIAL=y
CONFIG_UART_INTERRUPT_DRIVEN=y

# enable console
CONFIG_CONSOLE=y
CONFIG_UART_CONSOLE=y

# Enable reset by default
CONFIG_RESET=y

# Code partition needed to target the correct flash range
CONFIG_USE_DT_CODE_PARTITION=y

# Output UF2 by default, native bootloader supports it.
CONFIG_BUILD_OUTPUT_UF2=y
```

## boards/arm/adafruit_qt_py_rp2040/Kconfig.board
```kconfig
# Copyright (c) 2022 Kelly Lord
# SPDX-License-Identifier: Apache-2.0

config BOARD_ADAFRUIT_QT_PY_RP2040
	bool "Adafruit QT Py RP2040 Board"
	depends on SOC_RP2040
```
