## boards/arm/stm3210c_eval/Kconfig.defconfig
```kconfig
# STM3210C-EVAL board configuration

# Copyright (c) 2016 RnDity Sp. z o.o.
# SPDX-License-Identifier: Apache-2.0

if BOARD_STM3210C_EVAL

config BOARD
	default "stm3210c_eval"

endif # BOARD_STM3210C_EVAL
```

## boards/arm/stm3210c_eval/Kconfig.stm3210c_eval
```kconfig
# Copyright (c) 2022 Zephyr Project members and individual contributors
# SPDX-License-Identifier: Apache-2.0

config BOARD_STM3210C_EVAL
	bool
	default y
	select SOC_SERIES_STM32F1X
	select SOC_STM32F107XC
```

## boards/arm/stm3210c_eval/stm3210c_eval_defconfig
```kconfig
# SPDX-License-Identifier: Apache-2.0

# Zephyr Kernel Configuration
CONFIG_SOC_SERIES_STM32F1X=y

# Platform Configuration
CONFIG_SOC_STM32F107XC=y

# Serial Drivers
CONFIG_SERIAL=y
CONFIG_UART_INTERRUPT_DRIVEN=y
# enable console
CONFIG_CONSOLE=y
CONFIG_UART_CONSOLE=y

# GPIO Controller
CONFIG_GPIO=y

# RCC Controller
CONFIG_CLOCK_CONTROL=y

# enable pin controller
CONFIG_PINCTRL=y
```

## boards/arm/stm3210e_eval/Kconfig.board
```kconfig
# Kconfig - STM3210E-EVAL board configuration
#
# Copyright (c) 2017 Linaro Limited
#
# SPDX-License-Identifier: Apache-2.0
#

config BOARD_STM3210E_EVAL
	bool "STM3210E-EVAL Evaluation Board"
	depends on SOC_STM32F103XG
```

## boards/arm/stm3210e_eval/Kconfig.defconfig
```kconfig
# Kconfig - STM3210E-EVAL board configuration
#
# Copyright (c) 2017 Linaro Limited
#
# SPDX-License-Identifier: Apache-2.0
#

if BOARD_STM3210E_EVAL

config BOARD
	default stm3210e_eval

endif # BOARD_STM3210E_EVAL
```

## boards/arm/stm3210e_eval/stm3210e_eval_defconfig
```kconfig
# Zephyr Kernel Configuration
CONFIG_ARM=y
CONFIG_BOARD_STM3210E_EVAL=y
CONFIG_SOC_SERIES_STM32F1X=y
CONFIG_SOC_FAMILY_STM32=y
CONFIG_SOC_STM32F103XG=y

# General Kernel Options
CONFIG_CORTEX_M_SYSTICK=y
# 72MHz system clock
CONFIG_SYS_CLOCK_HW_CYCLES_PER_SEC=72000000
CONFIG_SYS_CLOCK_TICKS_PER_SEC=1000

# Serial Drivers
CONFIG_SERIAL=y
CONFIG_SERIAL_HAS_DRIVER=y
CONFIG_UART_STM32=y
# enable USART2
CONFIG_UART_STM32_PORT_2=y
# enable console on this port by default
CONFIG_CONSOLE=y
CONFIG_UART_CONSOLE=y

# Pinmux Driver
CONFIG_PINMUX=y
CONFIG_PINMUX_STM32=y

# GPIO Controller
CONFIG_GPIO=y
CONFIG_GPIO_STM32=y
CONFIG_GPIO_STM32_PORTA=y
CONFIG_GPIO_STM32_PORTB=y
CONFIG_GPIO_STM32_PORTC=y
CONFIG_GPIO_STM32_PORTD=y
CONFIG_GPIO_STM32_PORTE=y
CONFIG_GPIO_STM32_PORTF=y
CONFIG_GPIO_STM32_PORTG=y

# RCC configuration
CONFIG_CLOCK_CONTROL=y
# Clock configuration for Cube Clock control driver
CONFIG_CLOCK_STM32_HSE_CLOCK=8000000
CONFIG_CLOCK_STM32_SYSCLK_SRC_PLL=y
# use HSE as PLL input
CONFIG_CLOCK_STM32_PLL_SRC_HSE=y
CONFIG_CLOCK_STM32_PLL_SRC_PLL2=n
# produce 72MHz clock at PLL output
CONFIG_CLOCK_STM32_PLL_MULTIPLIER=9
CONFIG_CLOCK_STM32_AHB_PRESCALER=1
# APB1 clock must not to exceed 36MHz limit
CONFIG_CLOCK_STM32_APB1_PRESCALER=2
CONFIG_CLOCK_STM32_APB2_PRESCALER=1
```

## boards/arm/stm32373c_eval/Kconfig.board
```kconfig
# STM32373C_EVAL evaluation board

# Copyright (c) 2016 Open-RnD Sp. z o.o.
# SPDX-License-Identifier: Apache-2.0

config BOARD_STM32373C_EVAL
	def_bool "$(BOARD)" = "stm32373c_eval"
	depends on SOC_STM32F373XC
```

## boards/arm/stm32373c_eval/Kconfig.defconfig
```kconfig
# STM32373C-EVAL evaluation board configuration

# Copyright (c) 2016 Open-RnD Sp. z o.o.
# SPDX-License-Identifier: Apache-2.0

if BOARD_STM32373C_EVAL

config BOARD
	default "stm32373c_eval"

config UART_2
	default y
	depends on UART_CONSOLE

endif # BOARD_STM32373C_EVAL
```

## boards/arm/stm32373c_eval/Kconfig.stm32373c_eval
```kconfig
# Copyright (c) 2022 Zephyr Project members and individual contributors
# SPDX-License-Identifier: Apache-2.0

config BOARD_STM32373C_EVAL
	bool
	default y
	select SOC_SERIES_STM32F3X
	select SOC_STM32F373XC
```

## boards/arm/stm32373c_eval/stm32373c_eval_defconfig
```kconfig
# SPDX-License-Identifier: Apache-2.0

# Zephyr Kernel Configuration
CONFIG_SOC_SERIES_STM32F3X=y

# Platform Configuration
CONFIG_SOC_STM32F373XC=y

# Enable MPU
CONFIG_ARM_MPU=y

# Enable HW stack protection
CONFIG_HW_STACK_PROTECTION=y

# Serial Drivers
CONFIG_SERIAL=y
CONFIG_UART_INTERRUPT_DRIVEN=y
# enable console
CONFIG_CONSOLE=y
CONFIG_UART_CONSOLE=y

# GPIO Controller
CONFIG_GPIO=y

# Enable Clocks
CONFIG_CLOCK_CONTROL=y

# enable pin controller
CONFIG_PINCTRL=y
```

## boards/arm/stm32_min_dev/Kconfig.board
```kconfig
# STM32 Minimum Development Board

# Copyright (c) 2017, embedjournal.com
# SPDX-License-Identifier: Apache-2.0

config BOARD_STM32_MIN_DEV_BLUE
	def_bool "$(BOARD)" = "stm32_min_dev_blue"
	depends on SOC_STM32F103X8

config BOARD_STM32_MIN_DEV_BLACK
	def_bool "$(BOARD)" = "stm32_min_dev_black"
	depends on SOC_STM32F103X8
```

## boards/arm/stm32_min_dev/Kconfig.defconfig
```kconfig
# STM32 Minimum Development Board Configuration

# Copyright (c) 2017, embedjournal.com
# SPDX-License-Identifier: Apache-2.0

if BOARD_STM32_MIN_DEV_BLUE || BOARD_STM32_MIN_DEV_BLACK

config BOARD
	default "stm32_min_dev_blue" if BOARD_STM32_MIN_DEV_BLUE
	default "stm32_min_dev_black" if BOARD_STM32_MIN_DEV_BLACK

endif # BOARD_STM32_MIN_DEV_BLUE || BOARD_STM32_MIN_DEV_BLACK
```

## boards/arm/stm32_min_dev/Kconfig.stm32_min_dev_blue
```kconfig
# Copyright (c) 2022 Zephyr Project members and individual contributors
# SPDX-License-Identifier: Apache-2.0

config BOARD_STM32_MIN_DEV_BLUE
	bool
	default y
	select SOC_SERIES_STM32F1X
	select SOC_STM32F103X8
```

## boards/arm/stm32_min_dev/stm32_min_dev_blue_defconfig
```kconfig
# SPDX-License-Identifier: Apache-2.0

CONFIG_SOC_SERIES_STM32F1X=y
CONFIG_SOC_STM32F103X8=y

# enable uart driver
CONFIG_SERIAL=y

# enable console
CONFIG_CONSOLE=y
CONFIG_UART_CONSOLE=y

# enable GPIO
CONFIG_GPIO=y

# enable clock control
CONFIG_CLOCK_CONTROL=y

# enable pin controller
CONFIG_PINCTRL=y
```

## boards/arm/stm32_min_dev/stm32_min_dev_defconfig
```kconfig
CONFIG_ARM=y
CONFIG_BOARD_STM32_MIN_DEV=y
CONFIG_SOC_FAMILY_STM32=y
CONFIG_SOC_SERIES_STM32F1X=y
CONFIG_SOC_STM32F103X8=y
CONFIG_CORTEX_M_SYSTICK=y

# 72MHz system clock
CONFIG_SYS_CLOCK_HW_CYCLES_PER_SEC=72000000

# enable uart driver
CONFIG_SERIAL=y
CONFIG_UART_STM32=y

# enable USART1
CONFIG_UART_STM32_PORT_1=y

# enable console on this port by default
CONFIG_CONSOLE=y
CONFIG_UART_CONSOLE=y

# enable pinmux
CONFIG_PINMUX=y
CONFIG_PINMUX_STM32=y

# enable GPIO ports A, B
CONFIG_GPIO=y
CONFIG_GPIO_STM32=y
CONFIG_GPIO_STM32_PORTA=y
CONFIG_GPIO_STM32_PORTB=y
CONFIG_GPIO_STM32_PORTC=n
CONFIG_GPIO_STM32_PORTD=n

# clock configuration
CONFIG_CLOCK_CONTROL=y
CONFIG_CLOCK_STM32_HSE_CLOCK=8000000
CONFIG_CLOCK_STM32_SYSCLK_SRC_PLL=y

# use HSE as PLL input
CONFIG_CLOCK_STM32_PLL_SRC_HSE=y
# produce 72MHz clock at PLL output
CONFIG_CLOCK_STM32_PLL_XTPRE=n
CONFIG_CLOCK_STM32_PLL_MULTIPLIER=9
CONFIG_CLOCK_STM32_AHB_PRESCALER=1

# APB1 clock must not exceed 36MHz limit
CONFIG_CLOCK_STM32_APB1_PRESCALER=2
CONFIG_CLOCK_STM32_APB2_PRESCALER=0
```

## boards/arm/stm32_mini_a15/Kconfig.board
```kconfig
# Kconfig - STM32 MINI A15 board configuration
#
# Copyright (c) 2016 Open-RnD Sp. z o.o.
#
# SPDX-License-Identifier: Apache-2.0
#

config BOARD_STM32_MINI_A15
	bool "STM32 MINI A15 Development Board"
	depends on SOC_STM32F103XE
```

## boards/arm/stm32_mini_a15/Kconfig.defconfig
```kconfig
# Kconfig - STM32 MINI A15 board configuration
#
# Copyright (c) 2016 Open-RnD Sp. z o.o.
#
# SPDX-License-Identifier: Apache-2.0
#

if BOARD_STM32_MINI_A15

config BOARD
	default "stm32_mini_a15"

config BOARD_DEPRECATED
	default "1.11"

if UART_CONSOLE

config UART_STM32_PORT_1
	default y

endif # UART_CONSOLE

endif # BOARD_STM32_MINI_A15
```

## boards/arm/stm32_mini_a15/stm32_mini_a15_defconfig
```kconfig
CONFIG_ARM=y
CONFIG_BOARD_STM32_MINI_A15=y
CONFIG_SOC_SERIES_STM32F1X=y
CONFIG_SOC_STM32F103XE=y
CONFIG_CORTEX_M_SYSTICK=y
# 72MHz system clock
CONFIG_SYS_CLOCK_HW_CYCLES_PER_SEC=72000000

# enable uart driver
CONFIG_SERIAL=y

# enable pinmux
CONFIG_PINMUX=y

# enable GPIOs
CONFIG_GPIO=y

# clock configuration
CONFIG_CLOCK_CONTROL=y
# Clock configuration for Cube Clock control driver
CONFIG_CLOCK_STM32_HSE_CLOCK=8000000
CONFIG_CLOCK_STM32_SYSCLK_SRC_PLL=y
# use HSE as PLL input
CONFIG_CLOCK_STM32_PLL_SRC_HSE=y
# produce 72MHz clock at PLL output
CONFIG_CLOCK_STM32_PLL_XTPRE=n
CONFIG_CLOCK_STM32_PLL_MULTIPLIER=9
CONFIG_CLOCK_STM32_AHB_PRESCALER=1
# APB1 clock must not to exceed 36MHz limit
CONFIG_CLOCK_STM32_APB1_PRESCALER=2
CONFIG_CLOCK_STM32_APB2_PRESCALER=1

# console
CONFIG_CONSOLE=y
CONFIG_UART_CONSOLE=y
```

## boards/arm/stm32f030_demo/Kconfig.board
```kconfig
# STM32F030 DEMO Board

# Copyright (c) 2019 Antony Pavlov <antonynpavlov@gmail.com>
# SPDX-License-Identifier: Apache-2.0

config BOARD_STM32F030_DEMO
	def_bool "$(BOARD)" = "stm32f030_demo"
	depends on SOC_STM32F030X4
```

## boards/arm/stm32f030_demo/Kconfig.defconfig
```kconfig
# Copyright (c) 2019 Antony Pavlov <antonynpavlov@gmail.com>
# SPDX-License-Identifier: Apache-2.0

if BOARD_STM32F030_DEMO

config BOARD
	default "stm32f030_demo"

endif # BOARD_STM32F030_DEMO
```

## boards/arm/stm32f030_demo/stm32f030_demo_defconfig
```kconfig
# SPDX-License-Identifier: Apache-2.0

# Zephyr Kernel Configuration
CONFIG_ARM=y
CONFIG_SOC_SERIES_STM32F0X=y

# Platform Configuration
CONFIG_SOC_STM32F030X4=y
CONFIG_BOARD_STM32F030_DEMO=y

# General Kernel Options
CONFIG_SYS_CLOCK_HW_CYCLES_PER_SEC=48000000

# Kernel Options due to Low Memory (4k)
CONFIG_MAIN_STACK_SIZE=640
CONFIG_IDLE_STACK_SIZE=200
CONFIG_ISR_STACK_SIZE=512

# Serial Drivers
CONFIG_SERIAL=y
CONFIG_UART_INTERRUPT_DRIVEN=y
# enable console
CONFIG_CONSOLE=y
CONFIG_UART_CONSOLE=y

# Pinmux Driver
CONFIG_PINMUX=y

# GPIO Controller
CONFIG_GPIO=y
CONFIG_GPIO_STM32_PORTC=n
CONFIG_GPIO_STM32_PORTD=n
CONFIG_GPIO_STM32_PORTE=n
CONFIG_GPIO_STM32_PORTF=n

# Clock configuration
CONFIG_CLOCK_CONTROL=y
# SYSCLK selection
CONFIG_CLOCK_STM32_SYSCLK_SRC_PLL=y
# HSE configuration
CONFIG_CLOCK_STM32_HSE_CLOCK=8000000

# PLL configuration
CONFIG_CLOCK_STM32_PLL_SRC_HSE=y
# produce 48MHz clock at PLL output
CONFIG_CLOCK_STM32_PLL_PREDIV=1
CONFIG_CLOCK_STM32_PLL_MULTIPLIER=6
CONFIG_CLOCK_STM32_AHB_PRESCALER=1
CONFIG_CLOCK_STM32_APB1_PRESCALER=1
```

## boards/arm/stm32f072_eval/Kconfig.board
```kconfig
# STM32F072-EVAL board configuration

# Copyright (c) 2017 BayLibre, SAS
# SPDX-License-Identifier: Apache-2.0

config BOARD_STM32F072_EVAL
	bool "STM32F072-EVAL Development Board"
	depends on SOC_STM32F072XB
```

## boards/arm/stm32f072_eval/Kconfig.defconfig
```kconfig
# STM32F072-EVAL board configuration

# Copyright (c) 2017 BayLibre, SAS
# SPDX-License-Identifier: Apache-2.0

if BOARD_STM32F072_EVAL

config BOARD
	default "stm32f072_eval"

endif # BOARD_STM32F072_EVAL
```

## boards/arm/stm32f072_eval/stm32f072_eval_defconfig
```kconfig
# SPDX-License-Identifier: Apache-2.0

# Zephyr Kernel Configuration
CONFIG_ARM=y
CONFIG_SOC_SERIES_STM32F0X=y

# Platform Configuration
CONFIG_SOC_FAMILY_STM32=y
CONFIG_SOC_STM32F072XB=y
CONFIG_BOARD_STM32F072_EVAL=y

# General Kernel Options
CONFIG_SYS_CLOCK_HW_CYCLES_PER_SEC=48000000

# Serial Drivers
CONFIG_SERIAL=y
CONFIG_UART_INTERRUPT_DRIVEN=y
# enable console
CONFIG_CONSOLE=y
CONFIG_UART_CONSOLE=y

# Pinmux Driver
CONFIG_PINMUX=y

# GPIO Controller
CONFIG_GPIO=y

# Clock configuration
CONFIG_CLOCK_CONTROL=y
# SYSCLK selection
CONFIG_CLOCK_STM32_SYSCLK_SRC_PLL=y
# HSE configuration
CONFIG_CLOCK_STM32_HSE_CLOCK=8000000
# PLL configuration
CONFIG_CLOCK_STM32_PLL_SRC_HSE=y
# produce 48MHz clock at PLL output
CONFIG_CLOCK_STM32_PLL_PREDIV1=1
CONFIG_CLOCK_STM32_PLL_MULTIPLIER=6
CONFIG_CLOCK_STM32_AHB_PRESCALER=1
CONFIG_CLOCK_STM32_APB1_PRESCALER=1
```

## boards/arm/stm32f072b_disco/Kconfig.board
```kconfig
# STM32F072B-DISCO development board

# Copyright (c) 2017 Clage GmbH
# SPDX-License-Identifier: Apache-2.0

config BOARD_STM32F072B_DISCO
	def_bool "$(BOARD)" = "stm32f072b_disco"
	depends on SOC_STM32F072XB
```
