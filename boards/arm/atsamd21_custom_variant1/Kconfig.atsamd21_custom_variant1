## boards/arm/atsamd21_custom_variant1/Kconfig.atsamd21_custom_variant1
```kconfig
# ATSAMD21 Custom board configuration

# Copyright (c) 2020 Google LLC.
# SPDX-License-Identifier: Apache-2.0

config BOARD_ATSAMD21_CUSTOM_VARIANT1
	select SOC_SAMD21J18A
```

## boards/arm/atsamd21_custom_variant1/Kconfig.defconfig
```kconfig
# ATSAMD21 Custom board configuration

# Copyright (c) 2020 Google LLC.
# SPDX-License-Identifier: Apache-2.0

config BOARD
	default "atsamd21_custom_variant1"
	depends on BOARD_ATSAMD21_CUSTOM_VARIANT1
```

## boards/arm/atsamd21_custom_variant1/board.yml
```yaml
board:
  name: atsamd21_custom_variant1
  full_name: ATSAMD21 Custom Variant1
  vendor: atmel
  socs:
    - name: samd21j18a
```

## boards/arm/atsamd21_custom_variant1/dts/bindings/gpio-generic.yaml
```yaml
description: Generic GPIO pins (IN / OUT)
compatible: "gpio-generic"
child-binding:
  description: Generic IO
  properties:
    debounce-interval-ms:
      type: int
      default: 30
      description: |
        Debouncing interval time in milliseconds.
        If not specified defaults to 30.
    polling-mode:
      type: boolean
      description: |
        Poll the pin periodically at the specified debounce-interval-ms.
    direction:
      type: string
      enum: ["input", "output", "inout"]
      description: "Specifies whether the pin is an input, output, or both."
    gpios:
      type: phandle-array
      required: true
    label:
      type: string
      description: |
        Human readable string describing the IO pin. It can be used by an
        application to identify this pin or to retrieve its number/index
        (i.e. child node number) on the parent device.
```

## boards/arm/atsamd21_custom_variant1/dts/bindings/gpio-rs485-en.yaml
```yaml
description: GPIO pins to control DE/nRE of the RS485 Drivers
compatible: "gpio-rs485-en"
child-binding:
  description: The GPIOs controlling the pins for DE/nRE
  properties:
    gpios:
     type: phandle-array
     required: true
    label:
      type: string
      description: |
        Human readable string describing the DE/nRE pin. It can be used by an
        application to identify this pin or to retrieve its number/index
        (i.e. child node number) on the parent device.
```

## boards/arm/atsamd21_xpro/Kconfig.atsamd21_xpro
```kconfig
# Copyright (c) 2022 Zephyr Project members and individual contributors
# SPDX-License-Identifier: Apache-2.0

config BOARD_ATSAMD21_XPRO
	bool
	default y
	select SOC_SERIES_SAMD21
	select SOC_PART_NUMBER_SAMD21J18A
```

## boards/arm/atsamd21_xpro/Kconfig.board
```kconfig
# SAM D21 Xplained Pro Board configuration

# Copyright (c) 2018 Bryan O'Donoghue
# SPDX-License-Identifier: Apache-2.0

config BOARD_ATSAMD21_XPRO
	def_bool "$(BOARD)" = "atsamd21_xpro"
	depends on SOC_PART_NUMBER_SAMD21J18A
```

## boards/arm/atsamd21_xpro/Kconfig.defconfig
```kconfig
# SAM D21 Xplained Pro board configuration

# Copyright (c) 2018 Bryan O'Donoghue
# SPDX-License-Identifier: Apache-2.0

config BOARD
	default "atsamd21_xpro"
	depends on BOARD_ATSAMD21_XPRO
```

## boards/arm/atsame51_cnano/Kconfig.board
```kconfig
# SAM E51 Curiosity Nano Board configuration
#
# Copyright (c) 2019 Benjamin Valentin
# Copyright (c) 2023 Sebastian Schlupp
# SPDX-License-Identifier: Apache-2.0

config BOARD_ATSAME51_CNANO
	bool "SAM E51 Curiosity Nano"
	depends on SOC_PART_NUMBER_SAME51J20A
```

## boards/arm/atsame51_cnano/Kconfig.defconfig
```kconfig
# SAM E51 Curiosity Nano board configuration
#
# Copyright (c) 2019 Benjamin Valentin
# Copyright (c) 2023 Sebastian Schlupp
# SPDX-License-Identifier: Apache-2.0

if BOARD_ATSAME51_CNANO

config BOARD
	default "atsame51_cnano"

if CAN

config CAN_SAM0
	default y

endif #CAN

endif # BOARD_ATSAME51_CNANO
```

## boards/arm/atsame51_cnano/atsame51_cnano_defconfig
```kconfig
# Copyright (c) 2019 Benjamin Valentin
# Copyright (c) 2023 Sebastian Schlupp
# SPDX-License-Identifier: Apache-2.0

CONFIG_SOC_SERIES_SAME51=y
CONFIG_SOC_PART_NUMBER_SAME51J20A=y
CONFIG_FPU=y
CONFIG_BOARD_ATSAME51_CNANO=y
CONFIG_SOC_ATMEL_SAMD5X_XOSC32K=y
CONFIG_SOC_ATMEL_SAMD5X_XOSC32K_AS_MAIN=y
CONFIG_BUILD_OUTPUT_HEX=y

CONFIG_ARM_MPU=y
CONFIG_HW_STACK_PROTECTION=y

CONFIG_CONSOLE=y
CONFIG_UART_CONSOLE=y
CONFIG_UART_INTERRUPT_DRIVEN=y
CONFIG_GPIO=y
CONFIG_SERIAL=y
```

## boards/arm/atsame54_xpro/Kconfig.atsame54_xpro
```kconfig
# Copyright (c) 2022 Zephyr Project members and individual contributors
# SPDX-License-Identifier: Apache-2.0

config BOARD_ATSAME54_XPRO
	bool
	default y
	select SOC_SERIES_SAME54
	select SOC_PART_NUMBER_SAME54P20A
```

## boards/arm/atsame54_xpro/Kconfig.board
```kconfig
# SAM E54 Xplained Pro Board configuration
#
# Copyright (c) 2019 Benjamin Valentin
# SPDX-License-Identifier: Apache-2.0

config BOARD_ATSAME54_XPRO
	bool "SAM E54 Xplained Pro"
	depends on SOC_PART_NUMBER_SAME54P20A
```

## boards/arm/atsame54_xpro/Kconfig.defconfig
```kconfig
# SAM E54 Xplained Pro board configuration
#
# Copyright (c) 2019 Benjamin Valentin
# SPDX-License-Identifier: Apache-2.0

if BOARD_ATSAME54_XPRO

config BOARD
	default "atsame54_xpro"

if ETH_SAM_GMAC

# Read MAC address from AT24MAC402 EEPROM

config ETH_SAM_GMAC_MAC_I2C_INT_ADDRESS
	default 0x9A

config ETH_SAM_GMAC_MAC_I2C_INT_ADDRESS_SIZE
	default 1

config ETH_SAM_GMAC_MAC_I2C_EEPROM
	default y
	select I2C

endif # ETH_SAM_GMAC

if NETWORKING

config NET_L2_ETHERNET
	default y

endif # NETWORKING

endif # BOARD_ATSAME54_XPRO
```

## boards/arm/atsame54_xpro/atsame54_xpro_defconfig
```kconfig
# Copyright (c) 2019 Benjamin Valentin
# SPDX-License-Identifier: Apache-2.0
CONFIG_SOC_SERIES_SAME54=y
CONFIG_SOC_PART_NUMBER_SAME54P20A=y
CONFIG_BOARD_ATSAME54_XPRO=y
CONFIG_BUILD_OUTPUT_HEX=y
CONFIG_ARM_MPU=y
CONFIG_SOC_ATMEL_SAMD5X_XOSC32K=y
CONFIG_SOC_ATMEL_SAMD5X_XOSC32K_AS_MAIN=y
CONFIG_CONSOLE=y
CONFIG_UART_CONSOLE=y
CONFIG_SERIAL=y
CONFIG_UART_INTERRUPT_DRIVEN=y
CONFIG_GPIO=y

# Enable HW stack protection
CONFIG_HW_STACK_PROTECTION=y
```

## boards/arm/atsaml21_xpro/Kconfig.atsaml21_xpro
```kconfig
# Copyright (c) 2022 Zephyr Project members and individual contributors
# SPDX-License-Identifier: Apache-2.0

config BOARD_ATSAML21_XPRO
	bool
	default y
	select SOC_SERIES_SAML21
	select SOC_PART_NUMBER_SAML21J18B
```

## boards/arm/atsaml21_xpro/Kconfig.board
```kconfig
# SAM L21 Xplained Pro board configuration

# Copyright (c) 2021 Argentum Systems Ltd.
# SPDX-License-Identifier: Apache-2.0

config BOARD_ATSAML21_XPRO
	bool "SAM L21 Xplained Pro"
	depends on SOC_PART_NUMBER_SAML21J18B
```

## boards/arm/atsaml21_xpro/Kconfig.defconfig
```kconfig
# SAM L21 Xplained Pro board configuration

# Copyright (c) 2021 Argentum Systems Ltd.
# SPDX-License-Identifier: Apache-2.0

config BOARD
	default "atsaml21_xpro"
	depends on BOARD_ATSAML21_XPRO
```

## boards/arm/atsaml21_xpro/atsaml21_xpro_defconfig
```kconfig
# Copyright (c) 2021 Argentum Systems Ltd.
# SPDX-License-Identifier: Apache-2.0
CONFIG_SOC_SERIES_SAML21=y
CONFIG_SOC_PART_NUMBER_SAML21J18B=y
CONFIG_BOARD_ATSAML21_XPRO=y
CONFIG_BUILD_OUTPUT_HEX=y
CONFIG_CONSOLE=y
CONFIG_UART_CONSOLE=y
CONFIG_SERIAL=y
CONFIG_UART_INTERRUPT_DRIVEN=y
CONFIG_GPIO=y
CONFIG_SOC_ATMEL_SAML_XOSC32K=y
CONFIG_SOC_ATMEL_SAML_XOSC32K_AS_MAIN=y
```

## boards/arm/atsamr21_xpro/Kconfig.atsamr21_xpro
```kconfig
# Copyright (c) 2022 Zephyr Project members and individual contributors
# SPDX-License-Identifier: Apache-2.0

config BOARD_ATSAMR21_XPRO
	bool
	default y
	select SOC_SERIES_SAMR21
	select SOC_PART_NUMBER_SAMR21G18A
```

## boards/arm/atsamr21_xpro/Kconfig.defconfig
```kconfig
# SAM R21 Xplained Pro board configuration

# Copyright (c) 2019 Benjamin Valentin
# SPDX-License-Identifier: Apache-2.0

if BOARD_ATSAMR21_XPRO

config BOARD
	default "atsamr21_xpro"

config IEEE802154_RF2XX
	default IEEE802154

endif # BOARD_ATSAMR21_XPRO
```

## boards/arm/atsamr21_xpro/atsamr21_xpro_defconfig
```kconfig
# Copyright (c) 2019 Benjamin Valentin
# Copyright (c) 2019 Gerson Fernando Budke
# SPDX-License-Identifier: Apache-2.0

CONFIG_SOC_SERIES_SAMR21=y
CONFIG_SOC_PART_NUMBER_SAMR21G18A=y
CONFIG_SOC_ATMEL_SAMD_XOSC32K=y
CONFIG_SOC_ATMEL_SAMD_XOSC32K_AS_MAIN=y
CONFIG_BOARD_ATSAMR21_XPRO=y
CONFIG_BUILD_OUTPUT_HEX=y

CONFIG_CONSOLE=y
CONFIG_GPIO=y
CONFIG_SERIAL=y
CONFIG_UART_CONSOLE=y
CONFIG_UART_INTERRUPT_DRIVEN=y
```

## boards/arm/atsamr34_xpro/Kconfig.atsamr34_xpro
```kconfig
# Copyright (c) 2022 Zephyr Project members and individual contributors
# SPDX-License-Identifier: Apache-2.0

config BOARD_ATSAMR34_XPRO
	bool
	default y
	select SOC_SERIES_SAMR34
	select SOC_PART_NUMBER_SAMR34J18B
```

## boards/arm/atsamr34_xpro/Kconfig.board
```kconfig
# SAM R34 Xplained Pro board configuration

# Copyright (c) 2021 Argentum Systems Ltd.
# SPDX-License-Identifier: Apache-2.0

config BOARD_ATSAMR34_XPRO
	bool "SAM R34 Xplained Pro"
	depends on SOC_PART_NUMBER_SAMR34J18B
```

## boards/arm/atsamr34_xpro/Kconfig.defconfig
```kconfig
# SAM R34 Xplained Pro board configuration

# Copyright (c) 2021 Argentum Systems Ltd.
# SPDX-License-Identifier: Apache-2.0

config BOARD
	default "atsamr34_xpro"
	depends on BOARD_ATSAMR34_XPRO
```
