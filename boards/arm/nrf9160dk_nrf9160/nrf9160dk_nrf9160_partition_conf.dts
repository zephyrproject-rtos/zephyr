/*
 * Copyright (c) 2018-2020 Nordic Semiconductor ASA
 *
 * SPDX-License-Identifier: Apache-2.0
 */

/*
 * Default Flash planning for nRF9160dk_nrf9160.
 *
 * Zephyr build for nRF9160 with ARM TrustZone-M support, and either
 * CONFIG_TRUSTED_EXECUTION_SECURE=y or CONFIG_TRUSTED_EXECUTION_NONSECURE=y
 * implies building Secure and Non-Secure images.
 *
 * Secure image will be placed in the following code partition:
 * - slot0_s_partition, when building with MCUboot support
 * - code_s_partition, when building without MCUboot support
 *
 * Secure image will use sram0 for system memory.
 *
 * Non-Secure image will be placed in the following code partition:
 * - slot0_ns_partition, when building with MCUboot support
 * - code_ns_partition, when building without MCUboot support
 *
 * Non-Secure image will use sram0_ns for system memory.
 *
 * Note that the Secure image only requires knowledge of
 * the beginning of the Non-Secure image (not its size).
 */


/* Default SRAM planning when building for nRF9160 with
 * ARM TrustZone-M support
 * - Lowest 64 kB SRAM allocated to Secure image (sram0_s).
 * - 64 kB SRAM reserved for and used by the BSD socket
 *   library (sram0_bsd).
 * - Upper 128 kB allocated to Non-Secure image (sram0_ns).
 */

&sram0_s {
	reg = <0x20000000 DT_SIZE_K(64)>;
};

&sram0_bsd {
	reg = <0x20010000 DT_SIZE_K(64)>;
};

&sram0_ns {
	reg = <0x20020000 DT_SIZE_K(128)>;
};
