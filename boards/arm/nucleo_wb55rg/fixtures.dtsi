/*
 * Copyright (c) 2020 Nordic Semiconductor ASA
 *
 * SPDX-License-Identifier: Apache-2.0
 */

/ {
	zephyr,fixture {
		gpio-loopback {
			compatible = "zephyr,fixture,gpio-loopback";
			out-gpios = <&arduino_header 0 0>; /* Arduino A0 */
			in-gpios = <&arduino_header 1 0>;  /* Arduino A1 */
		};
	};
};
