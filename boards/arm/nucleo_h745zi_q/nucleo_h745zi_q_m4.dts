/*
 * Copyright (c) 2020 Alexander Kozhinov
 * AlexanderKozhinov@yandex.com
 *
 * SPDX-License-Identifier: Apache-2.0
 */

/dts-v1/;
#include <st/h7/stm32h745Xi_m4.dtsi>
#include "nucleo_h745zi_q.dtsi"

/ {
	model = "STMicroelectronics STM32H745ZI-Q-NUCLEO board";
	compatible = "st,stm32h745zi-q-nucleo", "st,stm32h745";

	/* HW resources belonging to CM4 */
	chosen {
		zephyr,console = &uart8;
		zephyr,shell-uart = &uart8;
		zephyr,sram = &sram1;
		zephyr,flash = &flash1;
	};

	aliases {
		led0 = &yellow_led;
	};
};

&uart8 {
	current-speed = <115200>;
	status = "okay";
};
