/*
 * Copyright (c) 2020 Linaro Limited
 *
 * SPDX-License-Identifier: Apache-2.0
 */

/dts-v1/;
#include "nucleo_l552ze_q-common.dtsi"

/ {
	model = "STMicroelectronics STM32L552ZE-NUCLEO-Q board";
	compatible = "st,stm32l552ze-nucleo-q";

	#address-cells = <1>;
	#size-cells = <1>;

	chosen {
		zephyr,console = &lpuart1;
		zephyr,shell-uart = &lpuart1;
		zephyr,sram = &sram0;
		zephyr,flash = &flash0;
	};

	aliases {
		led0 = &blue_led_1;
		sw0 = &user_button;
	};
};

&lpuart1 {
	pinctrl-0 = <&lpuart1_tx_pg7 &lpuart1_rx_pg8>;
	current-speed = <115200>;
	status = "okay";
};
