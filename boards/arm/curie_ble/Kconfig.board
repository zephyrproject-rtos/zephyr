## boards/arm/curie_ble/Kconfig.board
```kconfig
# Kconfig - Curie BLE (nRF51822) configuration
#
# Copyright (c) 2017 Intel Corporation
#
# SPDX-License-Identifier: Apache-2.0

config BOARD_CURIE_BLE
	bool "Curie BLE"
	depends on SOC_NRF51822_QFAA
```

## boards/arm/curie_ble/Kconfig.defconfig
```kconfig
# Kconfig - Curie BLE (nRF51822) configuration
#
# Copyright (c) 2016 Intel Corporation
#
# SPDX-License-Identifier: Apache-2.0

if BOARD_CURIE_BLE

config BOARD
	default "curie_ble"

endif # BOARD_CURIE_BLE
```

## boards/arm/curie_ble/curie_ble_defconfig
```kconfig
CONFIG_ARM=y
CONFIG_SOC_FAMILY_NRF=y
CONFIG_SOC_SERIES_NRF51X=y
CONFIG_SOC_NRF51822_QFAA=y
CONFIG_BOARD_CURIE_BLE=y

# enable uart driver
CONFIG_SERIAL=y
CONFIG_UART_NRFX=y
CONFIG_UART_0_NRF_UART=y

# bluetooth
CONFIG_BT=y
CONFIG_BT_CTLR=y
```

## boards/arm/cy8ceval_062s2/Kconfig.board
```kconfig
# CY8CEVAL-062S2-MUR-43439M2 PSoC™ 62S2 Evaluation Kit

# Copyright (c) 2021 Cypress Semiconductor Corporation.
# SPDX-License-Identifier: Apache-2.0

config BOARD_CY8CKIT_062S2_MUR_43439M2
	bool "CY8CEVAL-062S2-MUR-43439M2 PSoC™ 62S2 Evaluation Kit"
```

## boards/arm/cy8ceval_062s2/Kconfig.defconfig
```kconfig
# CY8CEVAL-062S2-MUR-43439M2 PSoC™ 62S2 Evaluation Kit

# Copyright (c) 2021 Cypress Semiconductor Corporation.
# SPDX-License-Identifier: Apache-2.0

if BOARD_CY8CKIT_062S2_MUR_43439M2

config BOARD
	default "cy8ckit_062s2_mur_43439m2"

if WIFI || BT

endif # WIFI || BT

if WIFI

config WIFI_CYW43XXX
	default y

# Enable L2 Ethernet
config NET_L2_ETHERNET
	default y

endif # WIFI

if BT

# Select HCI components
config UART
	bool
	default y

config BT_UART
	default y

choice BT_HCI_BUS_TYPE
	default BT_H4
endchoice

config BT_CYW43XXX
	default y

# Disable ATT_ENFORCE_FLOW feature, CYW4343 informs about
# frees buffer (HCL Number Of Completed Packets event) after
# second packet. Refer to SWINTEGRATION-627.
config BT_ATT_ENFORCE_FLOW
	default n

endif # BT

endif   # BOARD_CY8CKIT_062S2_43012
```

## boards/arm/cy8ckit_062_ble/Kconfig.board
```kconfig
# PSoC6 BLE Pioneer Kit configuration

# Copyright (c) 2018 Cypress
# Copyright (c) 2020 ATL Electronics
# SPDX-License-Identifier: Apache-2.0

config BOARD_CY8CKIT_062_BLE_M0
	bool "PSoC6 BLE Pioneer Kit [M0 CPU0]"
	depends on SOC_PART_NUMBER_CY8C6347BZI_BLD53

config BOARD_CY8CKIT_062_BLE_M4
	bool "PSoC6 BLE Pioneer Kit [M4 CPU1]"
	depends on SOC_PART_NUMBER_CY8C6347BZI_BLD53
```

## boards/arm/cy8ckit_062_ble/Kconfig.cy8ckit_062_ble_m0
```kconfig
# Copyright (c) 2022 Zephyr Project members and individual contributors
# SPDX-License-Identifier: Apache-2.0

config BOARD_CY8CKIT_062_BLE_M0
	bool
	default y
	select SOC_SERIES_PSOC63
	select SOC_PSOC6_M0
	select SOC_PART_NUMBER_CY8C6347BZI_BLD53
```

## boards/arm/cy8ckit_062_ble/Kconfig.defconfig
```kconfig
# PSoC6 BLE Pioneer Kit configuration

# Copyright (c) 2018 Cypress
# Copyright (c) 2020 ATL Electronics
# SPDX-License-Identifier: Apache-2.0

if BOARD_CY8CKIT_062_BLE_M0 || \
	BOARD_CY8CKIT_062_BLE_M4

config BOARD
	default "cy8ckit_062_ble_m0" if BOARD_CY8CKIT_062_BLE_M0
	default "cy8ckit_062_ble_m4" if BOARD_CY8CKIT_062_BLE_M4

endif   # BOARD_CY8CKIT_062_BLE_M0 || \
	# BOARD_CY8CKIT_062_BLE_M4
```

## boards/arm/cy8ckit_062_ble/cy8ckit_062_ble_m0_defconfig
```kconfig
#
# Copyright (c) 2018, Cypress
# Copyright (c) 2020, ATL Electronics
#
# SPDX-License-Identifier: Apache-2.0
#

CONFIG_SOC_SERIES_PSOC63=y
CONFIG_SOC_PSOC6_M0=y
CONFIG_SOC_PART_NUMBER_CY8C6347BZI_BLD53=y
CONFIG_BOARD_CY8CKIT_062_BLE_M0=y
CONFIG_CORTEX_M_SYSTICK=y
CONFIG_CONSOLE=y
CONFIG_UART_CONSOLE=y
CONFIG_BUILD_OUTPUT_HEX=y

# UART driver
CONFIG_SERIAL=y
```

## boards/arm/cy8ckit_062_wifi_bt/Kconfig.board
```kconfig
# PSoC6 WiFi-BT Pioneer Kit configuration

# Copyright (c) 2018 Cypress
# Copyright (c) 2020 ATL Electronics
# SPDX-License-Identifier: Apache-2.0

config BOARD_CY8CKIT_062_WIFI_BT_M0
	bool "PSoC6 WiFi-BT Pioneer Kit M0"
	depends on SOC_PART_NUMBER_CY8C6247BZI_D54

config BOARD_CY8CKIT_062_WIFI_BT_M4
	bool "PSoC6 WiFi-BT Pioneer Kit M4"
	depends on SOC_PART_NUMBER_CY8C6247BZI_D54
```

## boards/arm/cy8ckit_062_wifi_bt/Kconfig.cy8ckit_062_wifi_bt_m0
```kconfig
# Copyright (c) 2022 Zephyr Project members and individual contributors
# SPDX-License-Identifier: Apache-2.0

config BOARD_CY8CKIT_062_WIFI_BT_M0
	bool
	default y
	select SOC_SERIES_PSOC62
	select SOC_PSOC6_M0
	select SOC_PART_NUMBER_CY8C6247BZI_D54
```

## boards/arm/cy8ckit_062_wifi_bt/Kconfig.defconfig
```kconfig
# PSoC6 WiFi-BT Pioneer Kit configuration

# Copyright (c) 2020 ATL Electronics
# SPDX-License-Identifier: Apache-2.0

if BOARD_CY8CKIT_062_WIFI_BT_M0 || \
	BOARD_CY8CKIT_062_WIFI_BT_M4

config BOARD
	default "cy8ckit_062_wifi_bt_m0" if BOARD_CY8CKIT_062_WIFI_BT_M0
	default "cy8ckit_062_wifi_bt_m4" if BOARD_CY8CKIT_062_WIFI_BT_M4

config UART_PSOC6_UART_5
	default y
	depends on UART_PSOC6

config UART_PSOC6_UART_6
	default y
	depends on UART_PSOC6

endif   # BOARD_CY8CKIT_062_WIFI_BT_M0 || \
	# BOARD_CY8CKIT_062_WIFI_BT_M4
```

## boards/arm/cy8ckit_062_wifi_bt/cy8ckit_062_wifi_bt_m4_defconfig
```kconfig
#
# Copyright (c) 2018, Cypress
#
# SPDX-License-Identifier: Apache-2.0
#

CONFIG_SOC_SERIES_PSOC62=y
CONFIG_SOC_PSOC6_M4=y
CONFIG_SOC_PART_NUMBER_CY8C6247BZI_D54=y
CONFIG_BOARD_CY8CKIT_062_WIFI_BT_M4=y
CONFIG_CORTEX_M_SYSTICK=y
CONFIG_CONSOLE=y
CONFIG_UART_CONSOLE=y
CONFIG_BUILD_OUTPUT_HEX=y

# UART driver
CONFIG_SERIAL=y
```

## boards/arm/cy8ckit_062_wifi_bt_m0/Kconfig.board
```kconfig
# Kconfig - PSoC6 WiFi-BT Pioneer Kit configuration
#
# Copyright (c) 2018 Cypress
# SPDX-License-Identifier: Apache-2.0
#

config BOARD_CY8CKIT_062_WIFI_BT_M0
	bool "PSoC6 WiFi-BT Pioneer Kit M0"
	depends on SOC_PART_NUMBER_CY8C6247BZI_D54
```

## boards/arm/cy8ckit_062_wifi_bt_m0/Kconfig.defconfig
```kconfig
# Kconfig - PSoC6 WiFi-BT Pioneer Kit configuration
#
# Copyright (c) 2018 Cypress
# SPDX-License-Identifier: Apache-2.0
#

if BOARD_CY8CKIT_062_WIFI_BT_M0

config BOARD
	default "cy8ckit_062_wifi_bt_m0"

if GPIO

endif # GPIO

if UART_PSOC6

config UART_PSOC6_UART_6
	default y

endif # UART_PSOC6

endif # BOARD_CY8CKIT_062_WIFI_BT_M0
```

## boards/arm/cy8ckit_062_wifi_bt_m4/Kconfig.defconfig
```kconfig
# Kconfig - PSoC6 WiFi-BT Pioneer Kit configuration
#
# Copyright (c) 2018 Cypress
# SPDX-License-Identifier: Apache-2.0
#

if BOARD_CY8CKIT_062_WIFI_BT_M4

config BOARD
	default "cy8ckit_062_wifi_bt_m4"

if GPIO

endif # GPIO

if UART_PSOC6

config UART_PSOC6_UART_5
	default y

endif # UART_PSOC6

endif # BOARD_CY8CKIT_062_WIFI_BT_M4
```

## boards/arm/cy8ckit_062_wifi_bt_m4/cy8ckit_062_wifi_bt_m4_defconfig
```kconfig
#
# Copyright (c) 2018, Cypress
#
# SPDX-License-Identifier: Apache-2.0
#

CONFIG_ARM=y
CONFIG_SOC_FAMILY_PSOC6=y
CONFIG_SOC_SERIES_PSOC62=y
CONFIG_SOC_PSOC6_M4=y
CONFIG_SOC_PART_NUMBER_CY8C6247BZI_D54=y
CONFIG_BOARD_CY8CKIT_062_WIFI_BT_M4=y
CONFIG_CORTEX_M_SYSTICK=y
CONFIG_PINMUX=y
CONFIG_CONSOLE=y
CONFIG_UART_CONSOLE=y
CONFIG_PRINTK=y

# UART driver
CONFIG_SERIAL=y
CONFIG_SERIAL_HAS_DRIVER=y
```

## boards/arm/cy8ckit_062s2_43012/Kconfig.defconfig
```kconfig
# CY8CKIT-062S2-43012 PSoC™ 6S2 Wi-Fi BT Pioneer Kit configuration

# Copyright (c) 2021 Cypress Semiconductor Corporation.
# SPDX-License-Identifier: Apache-2.0

if BOARD_CY8CKIT_062S2_43012

config BOARD
	default "cy8ckit_062s2_43012"

if WIFI || BT

# Select CYW43XXX part and module
choice CYW43XXX_PART
	default CYW43012
endchoice

choice CYW43012_MODULE
	default CYW43012_MURATA_1LV
endchoice

endif # WIFI || BT

if WIFI

config WIFI_CYW43XXX
	default y

# Enable L2 Ethernet
config NET_L2_ETHERNET
	default y

endif # WIFI

if BT

# Select HCI components
config UART
	bool
	default y

config BT_UART
	default y

choice BT_HCI_BUS_TYPE
	default BT_H4
endchoice

config BT_CYW43XXX
	default y

# Disable ATT_ENFORCE_FLOW feature, CYW4343 informs about
# frees buffer (HCL Number Of Completed Packets event) after
# second packet. Refer to SWINTEGRATION-627.
config BT_ATT_ENFORCE_FLOW
	default n

endif # BT

endif   # BOARD_CY8CKIT_062S2_43012
```

## boards/arm/cy8ckit_062s4/cy8ckit_062s4_m4_defconfig
```kconfig
# Copyright (c) 2023 David Ullmann
# SPDX-License-Identifier: Apache-2.0

CONFIG_SOC_SERIES_PSOC_62=y
CONFIG_BOARD_CY8CKIT_062S4_M4=y
CONFIG_SOC_CY8C6244LQI_S4D92=y
CONFIG_CONSOLE=y
CONFIG_UART_CONSOLE=y
CONFIG_SERIAL=y

CONFIG_PINCTRL=y
CONFIG_SOC_PSOC6_CM0P_IMAGE_SLEEP=y

CONFIG_BUILD_OUTPUT_HEX=y
CONFIG_CORTEX_M_SYSTICK=y
CONFIG_XIP=y
```

## boards/arm/cy8ckit_064s0s2_4343w/Kconfig.board
```kconfig
# CY8CPROTO-062-4343W PSoC™ 6 Wi-Fi BT Prototyping Kit

# Copyright (c) 2021 Cypress Semiconductor Corporation.
# SPDX-License-Identifier: Apache-2.0

config BOARD_CY8CKIT_064S0S2_4343W
	bool "CY8CKIT_064S0S2_4343W PSoC™ 6 Wi-Fi BT Prototyping Kit"
```

## boards/arm/cy8cproto_062_4343w/Kconfig.board
```kconfig
# CY8CPROTO-062-4343W PSoC™ 6 Wi-Fi BT Prototyping Kit

# Copyright (c) 2021 Cypress Semiconductor Corporation.
# SPDX-License-Identifier: Apache-2.0

config BOARD_CY8CPROTO_062_4343W
	bool "CY8CPROTO-062-4343W PSoC™ 6 Wi-Fi BT Prototyping Kit"
```

## boards/arm/cy8cproto_062_4343w/Kconfig.defconfig
```kconfig
# CY8CPROTO-062-4343W PSoC™ 6 Wi-Fi BT Prototyping Kit configuration

# Copyright (c) 2021 Cypress Semiconductor Corporation.
# SPDX-License-Identifier: Apache-2.0

if BOARD_CY8CPROTO_062_4343W

config BOARD
	default "cy8cproto_062_4343w"

if WIFI || BT

# Select CYW43XXX part and module
choice CYW43XXX_PART
	default CYW4343W
endchoice

choice CYW4343W_MODULE
	default CYW4343W_MURATA_1DX
endchoice

endif # WIFI || BT


if BT

# Select HCI components
config UART
	bool
	default y

config BT_UART
	default y

choice BT_HCI_BUS_TYPE
	default BT_H4
endchoice

endif # BT

endif   # BOARD_CY8CPROTO_062_4343W
```

## boards/arm/cy8cproto_062_4343w/cy8cproto_062_4343w_defconfig
```kconfig
#
# Copyright (c) 2021 Cypress Semiconductor Corporation.
# SPDX-License-Identifier: Apache-2.0
#

# Choice PSoC 6 Series and MPN
CONFIG_SOC_SERIES_PSOC_62=y
CONFIG_SOC_CY8C624ABZI_S2D44=y

# General configuration
CONFIG_CORTEX_M_SYSTICK=y
CONFIG_BUILD_OUTPUT_HEX=y

CONFIG_ARM_MPU=y
CONFIG_HW_STACK_PROTECTION=y

# Enable console
CONFIG_CONSOLE=y
CONFIG_UART_CONSOLE=y

# Enable UART driver
CONFIG_SERIAL=y

# Enable pin controller
CONFIG_PINCTRL=y

# Enable GPIO driver
CONFIG_GPIO=y

# Enable clock controller
CONFIG_CLOCK_CONTROL=y
```

## boards/arm/cy8cproto_063_ble/Kconfig.defconfig
```kconfig
# CY8CPROTO-063-BLE PSoC™ 6 BLE Prototyping Kit

# Copyright (c) 2023 Cypress Semiconductor Corporation (an Infineon company) or
# an affiliate of Cypress Semiconductor Corporation
# SPDX-License-Identifier: Apache-2.0

if BOARD_CY8CPROTO_063_BLE

config BOARD
	default "cy8cproto_063_ble"

endif # BOARD_CY8CPROTO_063_BLE
```

## boards/arm/cyclonev_socdk/Kconfig.board
```kconfig
# Copyright (c) 2022 Intel Corporation
# SPDX-License-Identifier: Apache-2.0
# Description:
# Cyclone V SoC development kit configuration option

config BOARD_CVSXDEVKIT
	bool "Intel Cyclone V Development Kit"
	depends on SOC_CYCLONE5
```
