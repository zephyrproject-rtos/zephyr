## boards/arm/twr_kv58f220m/Kconfig.twr_kv58f220m
```kconfig
# Copyright (c) 2022 Zephyr Project members and individual contributors
# SPDX-License-Identifier: Apache-2.0

config BOARD_TWR_KV58F220M
	bool
	default y
	select SOC_SERIES_KINETIS_KV5X
	select SOC_MKV58F24
	select SOC_PART_NUMBER_MKV58F1M0VLQ24
```

## boards/arm/twr_kv58f220m/twr_kv58f220m_defconfig
```kconfig
# SPDX-License-Identifier: Apache-2.0

CONFIG_CORTEX_M_SYSTICK=y
CONFIG_SOC_SERIES_KINETIS_KV5X=y
CONFIG_SOC_MKV58F24=y
CONFIG_BOARD_TWR_KV58F220M=y
CONFIG_SERIAL=y
CONFIG_CONSOLE=y
CONFIG_UART_CONSOLE=y
CONFIG_UART_INTERRUPT_DRIVEN=y
CONFIG_PINCTRL=y
CONFIG_GPIO=y
CONFIG_SYS_CLOCK_HW_CYCLES_PER_SEC=237500000

# Enable MPU
CONFIG_ARM_MPU=y
CONFIG_HW_STACK_PROTECTION=y
```

## boards/arm/ubx_bmd300eval_nrf52832/Kconfig.defconfig
```kconfig
# BMD-300-EVAL, BMD-301-EVAL, and BMD-350-EVAL board configuration

# Copyright (c) 2021 u-blox AG
# SPDX-License-Identifier: Apache-2.0

config BT_CTLR
	default BT
```

## boards/arm/ubx_bmd345eval_nrf52840/Kconfig.defconfig
```kconfig
# BMD-345-EVAL board configuration

# Copyright (c) 2021 u-blox AG
# Copyright (c) 2021 Linumiz
# SPDX-License-Identifier: Apache-2.0

config BT_CTLR
	default BT
```

## boards/arm/ubx_bmd345eval_nrf52840/ubx_bmd345eval_nrf52840_defconfig
```kconfig
# BMD-345-EVAL board configuration

# Copyright (c) 2021 u-blox AG
# SPDX-License-Identifier: Apache-2.0

CONFIG_SOC_SERIES_NRF52X=y
CONFIG_SOC_NRF52840_QIAA=y
CONFIG_BOARD_UBX_BMD345EVAL_NRF52840=y

# Enable MPU
CONFIG_ARM_MPU=y

# Enable hardware stack protection
CONFIG_HW_STACK_PROTECTION=y

# Enable RTT
CONFIG_USE_SEGGER_RTT=y

# enable GPIO
CONFIG_GPIO=y

# enable uart driver
CONFIG_SERIAL=y

# enable console
CONFIG_CONSOLE=y
CONFIG_UART_CONSOLE=y

# additional board options
CONFIG_GPIO_AS_PINRESET=y

# PA GPIO Pin
CONFIG_BT_CTLR_GPIO_PA=y
CONFIG_BT_CTLR_GPIO_PA_PIN=37

# LNA GPIO Pin
CONFIG_BT_CTLR_GPIO_LNA=y
CONFIG_BT_CTLR_GPIO_LNA_PIN=38
```

## boards/arm/ubx_bmd360eval_nrf52811/Kconfig
```kconfig
# BMD-360-EVAL board configuration

# Copyright (c) 2021 u-blox AG
# SPDX-License-Identifier: Apache-2.0

config BOARD_ENABLE_DCDC
	bool "DCDC mode"
	select SOC_DCDC_NRF52X
	default y
	depends on BOARD_UBX_BMD360EVAL_NRF52811
# BT_CTLR depends on BT. When BT is enabled we should default to also
# enabling the controller.
config BT_CTLR
	default y if BT
```

## boards/arm/ubx_bmd360eval_nrf52811/Kconfig.board
```kconfig
# BMD-360-EVAL board configuration

# Copyright (c) 2021 u-blox AG
# SPDX-License-Identifier: Apache-2.0

config BOARD_UBX_BMD360EVAL_NRF52811
	bool "u-blox BMD-360-EVAL"
	depends on SOC_NRF52811_QFAA
```

## boards/arm/ubx_bmd360eval_nrf52811/Kconfig.defconfig
```kconfig
# BMD-360-EVAL board configuration

# Copyright (c) 2021 u-blox AG
# SPDX-License-Identifier: Apache-2.0

if BOARD_UBX_BMD360EVAL_NRF52811

config BOARD
	default "ubx_bmd360eval_nrf52811"

endif # BOARD_UBX_BMD360EVAL_NRF52811
```

## boards/arm/ubx_bmd380eval_nrf52840/Kconfig
```kconfig
# BMD-380-EVAL board configuration

# Copyright (c) 2021 u-blox AG
# SPDX-License-Identifier: Apache-2.0

config BOARD_ENABLE_DCDC
bool "DCDC mode"
select SOC_DCDC_NRF52X
default y
depends on BOARD_UBX_BMD380EVAL_NRF52840
```

## boards/arm/ubx_bmd380eval_nrf52840/Kconfig.board
```kconfig
# BMD-380-EVAL board configuration

# Copyright (c) 2021 u-blox AG
# SPDX-License-Identifier: Apache-2.0

config BOARD_UBX_BMD380EVAL_NRF52840
	bool "u-blox BMD-380-EVAL"
	depends on SOC_NRF52840_QIAA

# should be CKAA,
# but SOC file not yet available from Nordic Semiconductor
```

## boards/arm/ubx_bmd380eval_nrf52840/Kconfig.defconfig
```kconfig
# BMD-380-EVAL board configuration

# Copyright (c) 2021 u-blox AG
# SPDX-License-Identifier: Apache-2.0

if BOARD_UBX_BMD380EVAL_NRF52840

config BOARD
	default "ubx_bmd380eval_nrf52840"

config BT_CTLR
	default BT

endif # BOARD_UBX_BMD380EVAL_NRF52840
```

## boards/arm/ubx_bmd380eval_nrf52840/ubx_bmd380eval_nrf52840_defconfig
```kconfig
# BMD-380-EVAL board configuration

# Copyright (c) 2021 u-blox AG
# SPDX-License-Identifier: Apache-2.0

CONFIG_SOC_SERIES_NRF52X=y
# should be CKAA, but not available yet from Nordic Semiconductor
CONFIG_SOC_NRF52840_QIAA=y
CONFIG_BOARD_UBX_BMD380EVAL_NRF52840=y

# Enable hardware stack protection
CONFIG_HW_STACK_PROTECTION=y

# Enable MPU
CONFIG_ARM_MPU=y

# Enable RTT
CONFIG_USE_SEGGER_RTT=y

# enable GPIO
CONFIG_GPIO=y

# enable uart driver
CONFIG_SERIAL=y

# enable console
CONFIG_CONSOLE=y
CONFIG_UART_CONSOLE=y

# additional board options
CONFIG_GPIO_AS_PINRESET=y
```

## boards/arm/ubx_evkannab1_nrf52832/Kconfig.defconfig
```kconfig
# u-blox EVK-ANNA-B1 board configuration
#
# Copyright (c) 2021 u-blox AG
# SPDX-License-Identifier: Apache-2.0

config BT_CTLR
	default BT
```

## boards/arm/ubx_evkannab1_nrf52832/Kconfig.ubx_evkannab1_nrf52832
```kconfig
# Copyright (c) 2022 Zephyr Project members and individual contributors
# SPDX-License-Identifier: Apache-2.0

config BOARD_UBX_EVKANNAB1_NRF52832
	bool
	default y
	select SOC_SERIES_NRF52X
	select SOC_NRF52832_QFAA
```

## boards/arm/ubx_evkannab1_nrf52832/ubx_evkannab1_nrf52832_defconfig
```kconfig
# u-blox EVK-ANNA-B1 board configuration

# Copyright (c) 2021 u-blox AG
# SPDX-License-Identifier: Apache-2.0

CONFIG_SOC_SERIES_NRF52X=y
CONFIG_SOC_NRF52832_QFAA=y
CONFIG_BOARD_UBX_EVKANNAB1_NRF52832=y

# Enable MPU
CONFIG_ARM_MPU=y

# Enable hardware stack protection
CONFIG_HW_STACK_PROTECTION=y

# Enable RTT
CONFIG_USE_SEGGER_RTT=y

# enable GPIO
CONFIG_GPIO=y

# enable uart driver
CONFIG_SERIAL=y

# enable console
CONFIG_CONSOLE=y
CONFIG_UART_CONSOLE=y

# additional board options
CONFIG_GPIO_AS_PINRESET=y
```

## boards/arm/ubx_evkannab4_nrf52833/Kconfig.board
```kconfig
# ANNA-B4 EVK board configuration
#
# Copyright (c) 2021 u-blox AG
# SPDX-License-Identifier: Apache-2.0

config BOARD_UBX_EVKANNAB4_NRF52833
	bool "u-blox EVK-ANNA-B4"
	depends on SOC_NRF52833_QIAA
```

## boards/arm/ubx_evkninab1_nrf52832/Kconfig.board
```kconfig
# u-blox EVK-NINA-B1 board configuration

# Copyright (c) 2021 u-blox AG
# SPDX-License-Identifier: Apache-2.0

config BOARD_UBX_EVKNINAB1_NRF52832
	bool "u-blox EVK-NINA-B1"
	depends on SOC_NRF52832_QFAA
```

## boards/arm/ubx_evkninab3_nrf52840/Kconfig.defconfig
```kconfig
# EVK-NINA-B3 board configuration

# Copyright (c) 2021 u-blox AG
# SPDX-License-Identifier: Apache-2.0

if BOARD_UBX_EVKNINAB3_NRF52840

config BOARD
	default "ubx_evkninab3_nrf52840"

config IEEE802154_NRF5
	default y
	depends on IEEE802154

config BT_CTLR
	default BT

endif # BOARD_UBX_EVKNINAB3_NRF52840
```

## boards/arm/ubx_evkninab3_nrf52840/ubx_evkninab3_nrf52840_defconfig
```kconfig
# EVK-NINA-B3 board configuration

# Copyright (c) 2021 u-blox AG
# SPDX-License-Identifier: Apache-2.0

CONFIG_SOC_SERIES_NRF52X=y
CONFIG_SOC_NRF52840_QIAA=y
CONFIG_BOARD_UBX_EVKNINAB3_NRF52840=y

# Enable MPU
CONFIG_ARM_MPU=y

# Enable hardware stack protection
CONFIG_HW_STACK_PROTECTION=y

# Enable RTT
CONFIG_USE_SEGGER_RTT=y

# enable GPIO
CONFIG_GPIO=y

# enable uart driver
CONFIG_SERIAL=y

# enable console
CONFIG_CONSOLE=y
CONFIG_UART_CONSOLE=y
```

## boards/arm/ubx_evkninab4_nrf52833/Kconfig.board
```kconfig
# NINA-B4 EVK board configuration
#
# Copyright (c) 2021 u-blox AG
# SPDX-License-Identifier: Apache-2.0

config BOARD_UBX_EVKNINAB4_NRF52833
	bool "u-blox EVK-NINA-B4"
	depends on SOC_NRF52833_QIAA
```

## boards/arm/ubx_evkninab4_nrf52833/Kconfig.defconfig
```kconfig
# EVK-NINA-B4 board configuration
#
# Copyright (c) 2021 u-blox AG
# SPDX-License-Identifier: Apache-2.0

if BOARD_UBX_EVKNINAB4_NRF52833

config BOARD
	default "ubx_evkninab4_nrf52833"

if USB

config USB_NRFX
	default y

config USB_DEVICE_STACK
	default y

endif # USB

config BT_CTLR
	default BT

endif # BOARD_UBX_EVKNINAB4_NRF52833
```

## boards/arm/ubx_evkninab4_nrf52833/Kconfig.ubx_evkninab4_nrf52833
```kconfig
# Copyright (c) 2022 Zephyr Project members and individual contributors
# SPDX-License-Identifier: Apache-2.0

config BOARD_UBX_EVKNINAB4_NRF52833
	bool
	default y
	select SOC_SERIES_NRF52X
	select SOC_NRF52833_QIAA
```

## boards/arm/ubx_evknorab10_nrf5340/Kconfig.board
```kconfig
# u-blox EVK-NORA-B10 board configuration

# Copyright (c) 2021 u-blox AG
# SPDX-License-Identifier: Apache-2.0

if SOC_NRF5340_CPUAPP_QKAA

config BOARD_UBX_EVKNORAB10_NRF5340_CPUAPP
	bool "EVK-NORA-B10 nRF5340 Application MCU"

config BOARD_UBX_EVKNORAB10_NRF5340_CPUAPPNS
	bool "EVK-NORA-B10 nRF5340 Application MCU non-secure"

endif # SOC_NRF5340_CPUAPP_QKAA

config BOARD_UBX_EVKNORAB10_NRF5340_CPUNET
	bool "EVK-NORA-B10 NRF5340 Network MCU"
	depends on SOC_NRF5340_CPUNET_QKAA
```

## boards/arm/ubx_evknorab10_nrf5340/Kconfig.defconfig
```kconfig
# u-blox EVK-NORA-B10 board configuration

# Copyright (c) 2021 u-blox AG
# SPDX-License-Identifier: Apache-2.0

if  BOARD_UBX_EVKNORAB10_NRF5340_CPUAPP || BOARD_UBX_EVKNORAB10_NRF5340_CPUAPP_NS

config BOARD
	default "ubx_evknorab10_nrf5340_cpuapp" if BOARD_UBX_EVKNORAB10_NRF5340_CPUAPP || BOARD_UBX_EVKNORAB10_NRF5340_CPUAPP_NS

# By default, if we build for a Non-Secure version of the board,
# force building with TF-M as the Secure Execution Environment.

config BUILD_WITH_TFM
	# Temporarily disable building Non-Secure images with
	# TF-M support by default. EVK-NORA-B10 is capable of
	# TF-M, but not yet added to TrustedFirmware.org as a
	# supported platform.
	#
	# default y if BOARD_UBX_EVKNORAB10_NRF5340_CPUAPP_NS
	default n

if BUILD_WITH_TFM

# By default, if we build with TF-M, instruct build system to
# flash the combined TF-M (Secure) & Zephyr (Non Secure) image
# (when building in-tree tests).
config TFM_FLASH_MERGED_BINARY
	bool
	default y if TEST_ARM_CORTEX_M

endif # BUILD_WITH_TFM

# Code Partition:
#
# For the secure version of the board the firmware is linked at the
# beginning of the flash, or into the code-partition defined in DT if it
# is intended to be loaded by MCUboot. If the secure firmware is to be
# combined with a non-secure image (TRUSTED_EXECUTION_SECURE=y), the
# secure FW image shall always be restricted to the size of its code
# partition.
#
# For the non-secure version of the board, the firmware must be linked
# into the code-partition (non-secure) defined in DT, regardless.
# Apply this configuration below by setting the Kconfig symbols used by
# the linker according to the information extracted from DT partitions.

# SRAM Partition:
#
# If the secure firmware is to be combined with a non-secure image
# (TRUSTED_EXECUTION_SECURE=y), the secure FW image SRAM shall always
# be restricted to the secure image SRAM partition
# (sram-secure-partition).
# Otherwise (if TRUSTED_EXECUTION_SECURE is not set) the whole zephyr,
# sram may be used by the image.
#
# For the non-secure version of the board, the firmware image SRAM is
# always restricted to the allocated non-secure SRAM partition.
#
# Workaround for not being able to have commas in macro arguments
DT_CHOSEN_Z_CODE_PARTITION := zephyr,code-partition
DT_CHOSEN_Z_SRAM_PARTITION := zephyr,sram-secure-partition

if BOARD_UBX_EVKNORAB10_NRF5340_CPUAPP && TRUSTED_EXECUTION_SECURE

config FLASH_LOAD_SIZE
	default $(dt_chosen_reg_size_hex,$(DT_CHOSEN_Z_CODE_PARTITION))

config SRAM_SIZE
	default $(dt_chosen_reg_size_int,$(DT_CHOSEN_Z_SRAM_PARTITION),0,K)

endif # BOARD_UBX_EVKNORAB10_NRF5340_CPUAPP && TRUSTED_EXECUTION_SECURE

if BOARD_UBX_EVKNORAB10_NRF5340_CPUAPP_NS

config FLASH_LOAD_OFFSET
	default $(dt_chosen_reg_addr_hex,$(DT_CHOSEN_Z_CODE_PARTITION))

config FLASH_LOAD_SIZE
	default $(dt_chosen_reg_size_hex,$(DT_CHOSEN_Z_CODE_PARTITION))

endif # BOARD_UBX_EVKNORAB10_NRF5340_CPUAPP_NS

endif # BOARD_UBX_EVKNORAB10_NRF5340_CPUAPP || BOARD_UBX_EVKNORAB10_NRF5340_CPUAPP_NS

config BOARD
	default "ubx_evknorab10_nrf5340_cpunet" if BOARD_UBX_EVKNORAB10_NRF5340_CPUNET
```

## boards/arm/ubx_evknorab10_nrf5340/ubx_evknorab10_nrf5340_cpunet_defconfig
```kconfig
# u-blox EVK-NORA-B10 board configuration

# Copyright (c) 2021 u-blox AG
# SPDX-License-Identifier: Apache-2.0

CONFIG_SOC_SERIES_NRF53X=y
CONFIG_SOC_NRF5340_CPUNET_QKAA=y
CONFIG_BOARD_UBX_EVKNORAB10_NRF5340_CPUNET=y

# Enable MPU
CONFIG_ARM_MPU=y

# Enable hardware stack protection
CONFIG_HW_STACK_PROTECTION=y

# enable GPIO
CONFIG_GPIO=y

# Enable uart driver
CONFIG_SERIAL=y

# enable console
CONFIG_CONSOLE=y
CONFIG_UART_CONSOLE=y
```
