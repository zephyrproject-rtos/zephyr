## boards/arm/efm32gg_sltb009a/Kconfig.defconfig
```kconfig
# EFM32GG SLTB009A default board configuration
# Copyright (c) 2023 Antmicro <www.antmicro.com>
# SPDX-License-Identifier: Apache-2.0

if BOARD_EFM32GG_SLTB009A

config BOARD
	string
	default "efm32gg_sltb009a"

config CMU_HFXO_FREQ
	default 50000000

config CMU_HFRCO_FREQ
	default 72000000

config CMU_LFXO_FREQ
	default 32768

config LOG_BACKEND_SWO_FREQ_HZ
	default 875000
	depends on LOG_BACKEND_SWO

endif # BOARD_EFM32GG_SLTB009A
```

## boards/arm/efm32gg_slwstk6121a/Kconfig.board
```kconfig
# EFM32GG SLWSTK6121A board configuration
# Copyright (c) 2019 Interay Solutions B.V.
# Copyright (c) 2019 Oane Kingma
# Copyright (c) 2020 Thorvald Natvig
# SPDX-License-Identifier: Apache-2.0

config BOARD_EFM32GG_SLWSTK6121A
	bool "SiLabs EFM32GG-SLWSTK6121A (WGM160P)"
	depends on SOC_SERIES_EFM32GG11B
	select SOC_PART_NUMBER_EFM32GG11B820F2048GM64
```

## boards/arm/efm32gg_slwstk6121a/Kconfig.defconfig
```kconfig
# EFM32GG SLWSTK6121A default board configuration
# Copyright (c) 2019 Interay Solutions B.V.
# Copyright (c) 2019 Oane Kingma
# Copyright (c) 2020 Thorvald Natvig
# SPDX-License-Identifier: Apache-2.0

if BOARD_EFM32GG_SLWSTK6121A

config BOARD
	string
	default "efm32gg_slwstk6121a"

config CMU_HFXO_FREQ
	default 50000000

config CMU_HFRCO_FREQ
	default 72000000

config CMU_LFXO_FREQ
	default 32768

config LOG_BACKEND_SWO_FREQ_HZ
	default 875000
	depends on LOG_BACKEND_SWO

if NETWORKING

config NET_L2_ETHERNET
	default y

endif # NETWORKING

endif # BOARD_EFM32GG_SLWSTK6121A
```

## boards/arm/efm32gg_slwstk6121a/Kconfig.efm32gg_slwstk6121a
```kconfig
# Copyright (c) 2022 Zephyr Project members and individual contributors
# SPDX-License-Identifier: Apache-2.0

config BOARD_EFM32GG_SLWSTK6121A
	bool
	default y
	select SOC_SERIES_EFM32GG11B
	select SOC_PART_NUMBER_EFM32GG11B820F2048GM64
```

## boards/arm/efm32gg_stk3701a/Kconfig
```kconfig
# EFM32GG STK3701A board configuration
# Copyright (c) 2019 Interay Solutions B.V.
# Copyright (c) 2019 Oane Kingma
# SPDX-License-Identifier: Apache-2.0

config BOARD_INIT_PRIORITY
	int
	default KERNEL_INIT_PRIORITY_DEFAULT
	depends on BOARD_EFM32GG_STK3701A
	depends on GPIO
	help
	  Board initialization priority. This must be bigger than
	  GPIO_GECKO_COMMON_INIT_PRIORITY.
```

## boards/arm/efm32gg_stk3701a/Kconfig.board
```kconfig
# SiLabs EFM32GG-STK3701A (Giant Gecko 11)
# Copyright (c) 2019 Interay Solutions B.V.
# Copyright (c) 2019 Oane Kingma
# SPDX-License-Identifier: Apache-2.0

config BOARD_EFM32GG_STK3701A
	def_bool "$(BOARD)" = "efm32gg_stk3701a"
	depends on SOC_SERIES_EFM32GG11B
	select SOC_PART_NUMBER_EFM32GG11B820F2048GL192
	select HAS_DTS_I2C
```

## boards/arm/efm32gg_stk3701a/Kconfig.efm32gg_stk3701a
```kconfig
# Copyright (c) 2022 Zephyr Project members and individual contributors
# SPDX-License-Identifier: Apache-2.0

config BOARD_EFM32GG_STK3701A
	bool
	default y
	select SOC_SERIES_EFM32GG11B
	select SOC_PART_NUMBER_EFM32GG11B820F2048GL192
```

## boards/arm/efm32gg_stk3701a/efm32gg_stk3701a_defconfig
```kconfig
# Copyright (c) 2019 Interay Solutions B.V.
# Copyright (c) 2019 Oane Kingma
# SPDX-License-Identifier: Apache-2.0

CONFIG_SOC_SERIES_EFM32GG11B=y
CONFIG_BOARD_EFM32GG_STK3701A=y
CONFIG_ARM_MPU=y
CONFIG_CONSOLE=y
CONFIG_UART_CONSOLE=y
CONFIG_SERIAL=y
CONFIG_CORTEX_M_SYSTICK=y
CONFIG_GPIO=y
CONFIG_SYS_CLOCK_HW_CYCLES_PER_SEC=72000000
CONFIG_CMU_HFCLK_HFRCO=y
```

## boards/arm/efm32hg_slstk3400a/Kconfig
```kconfig
# EFM32WG SLSTK3400A board configuration

# Copyright (c) 2017 Christian Taedcke
# Copyright (c) 2018 Marcio Montenegro
# SPDX-License-Identifier: Apache-2.0

config BOARD_INIT_PRIORITY
	int
	default KERNEL_INIT_PRIORITY_DEFAULT
	depends on BOARD_EFM32HG_SLSTK3400A
	depends on GPIO
	help
	  Board initialization priority. This must be bigger than
	  GPIO_GECKO_COMMON_INIT_PRIORITY.
```

## boards/arm/efm32hg_slstk3400a/Kconfig.board
```kconfig
# SiLabs EFM32HG-SLSTK3400A (Happy Gecko)

# Copyright (c) 2018, Marcio Montenegro
# SPDX-License-Identifier: Apache-2.0

config BOARD_EFM32HG_SLSTK3400A
	def_bool "$(BOARD)" = "efm32hg_slstk3400a"
	depends on SOC_SERIES_EFM32HG
	select SOC_PART_NUMBER_EFM32HG322F64
```

## boards/arm/efm32hg_slstk3400a/Kconfig.defconfig
```kconfig
# EFM32HG SLSTK3400A board

# Copyright (c) 2018, Marcio Montenegro
# SPDX-License-Identifier: Apache-2.0

if BOARD_EFM32HG_SLSTK3400A

config BOARD
	default "efm32hg_slstk3400a"

config CMU_HFXO_FREQ
	default 24000000

config CMU_LFXO_FREQ
	default 32768

endif # BOARD_EFM32HG_SLSTK3400A
```

## boards/arm/efm32hg_slstk3400a/Kconfig.efm32hg_slstk3400a
```kconfig
# Copyright (c) 2022 Zephyr Project members and individual contributors
# SPDX-License-Identifier: Apache-2.0

config BOARD_EFM32HG_SLSTK3400A
	bool
	default y
	select SOC_SERIES_EFM32HG
	select SOC_PART_NUMBER_EFM32HG322F64
```

## boards/arm/efm32hg_slstk3400a/efm32hg_slstk3400a_defconfig
```kconfig
# SPDX-License-Identifier: Apache-2.0

CONFIG_ARM=y
CONFIG_SOC_FAMILY_EXX32=y
CONFIG_SOC_SERIES_EFM32HG=y
CONFIG_BOARD_EFM32HG_SLSTK3400A=y
CONFIG_CONSOLE=y
CONFIG_UART_CONSOLE=y
CONFIG_SERIAL=y
CONFIG_CORTEX_M_SYSTICK=y
CONFIG_GPIO=y
CONFIG_SYS_CLOCK_HW_CYCLES_PER_SEC=24000000
CONFIG_CMU_HFCLK_HFXO=y

# Kernel Options due to Low Memory (8k)
CONFIG_MAIN_STACK_SIZE=640
CONFIG_IDLE_STACK_SIZE=200
CONFIG_ISR_STACK_SIZE=512
```

## boards/arm/efm32pg_stk3401a/Kconfig
```kconfig
# EFM32PG STK3401A board configuration

# Copyright (c) 2020 Rafael Dias Menezes <rdmeneze@gmail.com>
# SPDX-License-Identifier: Apache-2.0

config BOARD_INIT_PRIORITY
	int
	default KERNEL_INIT_PRIORITY_DEFAULT
	depends on BOARD_EFM32PG_STK3401A
	depends on GPIO
	help
	  Board initialization priority. This must be bigger than
	  GPIO_GECKO_COMMON_INIT_PRIORITY.
```

## boards/arm/efm32pg_stk3401a/Kconfig.defconfig
```kconfig
# EFM32PG STK3401A board

# Copyright (c) 2020, Rafael Dias Menezes <rdmeneze@gmail.com>
# SPDX-License-Identifier: Apache-2.0

config CMU_HFXO_FREQ
	default 40000000

config CMU_LFXO_FREQ
	default 32768
```

## boards/arm/efm32pg_stk3401a/Kconfig.efm32pg_stk3401a
```kconfig
# Copyright (c) 2022 Zephyr Project members and individual contributors
# SPDX-License-Identifier: Apache-2.0

config BOARD_EFM32PG_STK3401A
	bool
	default y
	select SOC_SERIES_EFM32PG1B
	select SOC_PART_NUMBER_EFM32PG1B200F256GM48
```

## boards/arm/efm32pg_stk3402a/Kconfig
```kconfig
# EFM32PG STK3402A board configuration

# Copyright (c) 2018 Christian Taedcke
# SPDX-License-Identifier: Apache-2.0

config BOARD_INIT_PRIORITY
	int
	default KERNEL_INIT_PRIORITY_DEFAULT
	depends on BOARD_EFM32PG_STK3402A || BOARD_EFM32PG_STK3402A_JG
	depends on GPIO
	help
	  Board initialization priority. This must be bigger than
	  GPIO_GECKO_COMMON_INIT_PRIORITY.
```

## boards/arm/efm32pg_stk3402a/Kconfig.board
```kconfig
# EFM32PG STK3402A board

# Copyright (c) 2018, Christian Taedcke
# Copyright (c) 2019  Lemonbeat GmbH
# SPDX-License-Identifier: Apache-2.0

config BOARD_EFM32PG_STK3402A
	bool "SiLabs EFM32PG-STK3402A (Pearl Gecko)"
	depends on SOC_SERIES_EFM32PG12B
	select SOC_PART_NUMBER_EFM32PG12B500F1024GL125

config BOARD_EFM32PG_STK3402A_JG
	bool "SiLabs EFM32PG-STK3402A (Jade Gecko)"
	depends on SOC_SERIES_EFM32JG12B
	select SOC_PART_NUMBER_EFM32JG12B500F1024GL125
```

## boards/arm/efm32pg_stk3402a/Kconfig.defconfig
```kconfig
# EFM32PG STK3402A board

# Copyright (c) 2018, Christian Taedcke
# Copyright (c) 2019  Lemonbeat GmbH
# SPDX-License-Identifier: Apache-2.0

if BOARD_EFM32PG_STK3402A || BOARD_EFM32PG_STK3402A_JG

config BOARD
	default "efm32pg_stk3402a" if BOARD_EFM32PG_STK3402A
	default "efm32pg_stk3402a_jg" if BOARD_EFM32PG_STK3402A_JG

config CMU_HFXO_FREQ
	default 40000000

config CMU_LFXO_FREQ
	default 32768

if GPIO_GECKO

config GPIO_GECKO_PORTA
	default y

config GPIO_GECKO_PORTB
	default y

config GPIO_GECKO_PORTC
	default n

config GPIO_GECKO_PORTD
	default y

config GPIO_GECKO_PORTE
	default n

config GPIO_GECKO_PORTF
	default y

endif # GPIO_GECKO

config COUNTER_GECKO_RTCC
	default y
	depends on COUNTER

endif # BOARD_EFM32PG_STK3402A || BOARD_EFM32PG_STK3402A_JG
```

## boards/arm/efm32pg_stk3402a/Kconfig.efm32pg_stk3402a
```kconfig
# Copyright (c) 2022 Zephyr Project members and individual contributors
# SPDX-License-Identifier: Apache-2.0

config BOARD_EFM32PG_STK3402A
	bool
	default y
	select SOC_SERIES_EFM32PG12B
	select SOC_PART_NUMBER_EFM32PG12B500F1024GL125
```

## boards/arm/efm32pg_stk3402a/Kconfig.efm32pg_stk3402a_jg
```kconfig
# Copyright (c) 2022 Zephyr Project members and individual contributors
# SPDX-License-Identifier: Apache-2.0

config BOARD_EFM32PG_STK3402A_JG
	bool
	default y
	select SOC_SERIES_EFM32JG12B
	select SOC_PART_NUMBER_EFM32JG12B500F1024GL125
```

## boards/arm/efm32pg_stk3402a/efm32pg_stk3402a_defconfig
```kconfig
# SPDX-License-Identifier: Apache-2.0

CONFIG_ARM=y
CONFIG_SOC_FAMILY_EXX32=y
CONFIG_SOC_SERIES_EFM32PG12B=y
CONFIG_BOARD_EFM32PG_STK3402A=y
CONFIG_CONSOLE=y
CONFIG_UART_CONSOLE=y
CONFIG_SERIAL=y
CONFIG_CORTEX_M_SYSTICK=y
CONFIG_GPIO=y
CONFIG_SYS_CLOCK_HW_CYCLES_PER_SEC=40000000
CONFIG_CMU_HFCLK_HFXO=y
```

## boards/arm/efm32pg_stk3402a/efm32pg_stk3402a_jg_defconfig
```kconfig
# SPDX-License-Identifier: Apache-2.0

CONFIG_SOC_SERIES_EFM32JG12B=y
CONFIG_BOARD_EFM32PG_STK3402A_JG=y
CONFIG_ARM_MPU=y
CONFIG_CONSOLE=y
CONFIG_UART_CONSOLE=y
CONFIG_SERIAL=y
CONFIG_GPIO=y
CONFIG_SYS_CLOCK_HW_CYCLES_PER_SEC=40000000
CONFIG_CMU_HFCLK_HFXO=y
```

## boards/arm/efm32wg_stk3800/Kconfig
```kconfig
# Kconfig - EFM32WG STK3800 board configuration
#
# Copyright (c) 2017 Christian Taedcke
#
# SPDX-License-Identifier: Apache-2.0

if BOARD_EFM32WG_STK3800

config BOARD_INIT_PRIORITY
	int
	default KERNEL_INIT_PRIORITY_DEFAULT
	depends on GPIO
	help
	  Board initialization priority. This must be bigger than
	  GPIO_GECKO_COMMON_INIT_PRIORITY.

endif # BOARD_EFM32WG_STK3800
```

## boards/arm/efm32wg_stk3800/Kconfig.board
```kconfig
# SiLabs EFM32WG STK3800 (Wonder Gecko) board

# Copyright (c) 2017, Christian Taedcke
# SPDX-License-Identifier: Apache-2.0

config BOARD_EFM32WG_STK3800
	def_bool "$(BOARD)" = "efm32wg_stk3800"
	depends on SOC_SERIES_EFM32WG
	select SOC_PART_NUMBER_EFM32WG990F256
```
