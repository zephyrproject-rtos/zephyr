## boards/arm/teensy_explorer/Kconfig.defconfig
```kconfig
# Teensy 3.5/3.6 board

# Copyright (c) 2016, Freescale Semiconductor, Inc.
# SPDX-License-Identifier: Apache-2.0

if BOARD_TEENSY_EXPLORER

config SAS_UART_MCUX_3
	bool "SASUART 3"
	default y
	help
	  Enable SASUART 3.

if TEENSY_3_6

config BOARD
	default "Teensy 3.6 Explorer"

choice K6x_SOC
	default SOC_MK66F18
endchoice

config TEENSY
	bool
	default y

config SYS_CLOCK_HW_CYCLES_PER_SEC
	default 180000000

config OSC_XTAL0_FREQ
	default 16000000

config MCG_PRDIV0
	default 0x01

config MCG_VDIV0
	default 0x1D

config MCG_FCRDIV
	default 1

config K6X_CORE_CLOCK_DIVIDER
	default 1
config K6X_BUS_CLOCK_DIVIDER
	default 3
config K6X_FLEXBUS_CLOCK_DIVIDER
	default 3
config K6X_FLASH_CLOCK_DIVIDER
	default 7

endif #TEENSY_3_6

if TEENSY_3_5

choice K6x_SOC
	default SOC_MK64F12
endchoice

config BOARD
	default "Teensy 3.5 Explorer"

config TEENSY
	bool
	default y

config SYS_CLOCK_HW_CYCLES_PER_SEC
	default 120000000

config OSC_XTAL0_FREQ
	default 16000000

config MCG_PRDIV0
	default 0x03

config MCG_VDIV0
	default 0x06

config MCG_FCRDIV
	default 1

config K6X_CORE_CLOCK_DIVIDER
	default 1
config K6X_BUS_CLOCK_DIVIDER
	default 2
config K6X_FLEXBUS_CLOCK_DIVIDER
	default 3
config K6X_FLASH_CLOCK_DIVIDER
	default 5

endif #TEENSY_3_5

if UART_MCUX

config UART_MCUX_0
	default y if UART_CONSOLE

config UART_MCUX_3
	default y if BT_UART

config SAS_UART_MCUX_3
	default n

endif # UART_MCUX

if PINMUX_MCUX

config PINMUX_MCUX_PORTA
	default y

config PINMUX_MCUX_PORTB
	default y

config PINMUX_MCUX_PORTC
	default y

config PINMUX_MCUX_PORTD
	default y

config PINMUX_MCUX_PORTE
	default y

endif # PINMUX_MCUX

if GPIO_MCUX

config GPIO_MCUX_PORTA
	default y

config GPIO_MCUX_PORTB
	default y

config GPIO_MCUX_PORTC
	default y

config GPIO_MCUX_PORTD
	default y

config GPIO_MCUX_PORTE
	default y

endif # GPIO_MCUX

config I2C_0
	default y
	depends on I2C

config ADC_1
	default y
	depends on ADC

config TEMP_KINETIS
	default y
	depends on SENSOR

config PWM_3
	default y
	depends on PWM_MCUX_FTM

config SPI_0
	default y
	depends on SPI

if NETWORKING

config NET_L2_ETHERNET
	default y if !MODEM

config ETH_MCUX_0
	default y if NET_L2_ETHERNET

endif # NETWORKING

config CAN_0
	default y
	depends on CAN

endif # BOARD_TEENSY_EXPLORER
```

## boards/arm/teensy_explorer/teensy_explorer_defconfig
```kconfig
# SPDX-License-Identifier: Apache-2.0

CONFIG_SOC_SERIES_KINETIS_K6X=y

CONFIG_CONSOLE=y
CONFIG_UART_CONSOLE=y
CONFIG_SERIAL=y
CONFIG_CORTEX_M_SYSTICK=y
CONFIG_GPIO=y
CONFIG_PINMUX=y
CONFIG_ARM_MPU=y
```

## boards/arm/test_mdbt_nrf52833/Kconfig.board
```kconfig
# Copyright (c) 2022 Nordic Semiconductor ASA
# SPDX-License-Identifier: Apache-2.0

config BOARD_TEST_MDBT_NRF52833
	bool "Test_MDBT_nRF52833"
	depends on SOC_NRF52833_QIAA
```

## boards/arm/test_mdbt_nrf52833/Kconfig.defconfig
```kconfig
# Copyright (c) 2022 Nordic Semiconductor ASA
# SPDX-License-Identifier: Apache-2.0

if BOARD_TEST_MDBT_NRF52833

config BOARD
	default "test_mdbt_nrf52833"

config BT_CTLR
   default BT

endif
```

## boards/arm/test_mdbt_nrf52833/test_mdbt_nrf52833_defconfig
```kconfig
# Copyright (c) 2022 Nordic Semiconductor ASA
# SPDX-License-Identifier: Apache-2.0

CONFIG_SOC_SERIES_NRF52X=y
CONFIG_SOC_NRF52833_QIAA=y
CONFIG_BOARD_TEST_MDBT_NRF52833=y

# Enable MPU
CONFIG_ARM_MPU=y

# Enable hardware stack protection
CONFIG_HW_STACK_PROTECTION=y
```

## boards/arm/thingy52_nrf52832/Kconfig
```kconfig
# Thingy52 NRF52832 board configuration

# Copyright (c) 2018 Aapo Vienamo
# SPDX-License-Identifier: Apache-2.0

if BOARD_THINGY52_NRF52832

config BOARD_VDD_PWR_CTRL_INIT_PRIORITY
	int "VDD power rail init priority"
	default 50
	depends on GPIO
	help
	  Initialization priority for the VDD power rail. Has to be greater
	  than GPIO_INIT_PRIORITY.

config BOARD_CCS_VDD_PWR_CTRL_INIT_PRIORITY
	int "CCS_VDD power rail init priority"
	default 85
	depends on GPIO_SX1509B
	help
	  Initialization priority for the CCS_VDD power rail. This powers the
	  CCS811 gas sensor. The value has to be greater than
	  BOARD_VDD_PWR_CTRL_INIT_PRIORITY, but smaller than SENSOR_INIT_PRIORITY.

endif # BOARD_THINGY52_NRF52832
```

## boards/arm/thingy52_nrf52832/Kconfig.defconfig
```kconfig
# Thingy52 NRF52832 board configuration

# Copyright (c) 2018 Aapo Vienamo
# SPDX-License-Identifier: Apache-2.0

config BT_CTLR
	default BT
```

## boards/arm/thingy53_nrf5340/Kconfig
```kconfig
# Thingy53 NRF5340 board configuration

# Copyright (c) 2021 Nordic Semiconductor ASA
# SPDX-License-Identifier: Apache-2.0

config THINGY53_INIT_PRIORITY
	int "Init priority"
	default 79
	help
	  Initialization priority of the Thingy:53.

config IPM_NRFX
	default IPM

config MBOX_NRFX_IPC
	default MBOX

config RPMSG_SERVICE_DUAL_IPM_SUPPORT
	default RPMSG_SERVICE

if RPMSG_SERVICE_DUAL_IPM_SUPPORT

config IPM_MSG_CH_0_ENABLE
	default y

config IPM_MSG_CH_1_ENABLE
	default y

config RPMSG_SERVICE_IPM_TX_NAME
	default "IPM_0" if RPMSG_SERVICE_MODE_MASTER
	default "IPM_1" if RPMSG_SERVICE_MODE_REMOTE

config RPMSG_SERVICE_IPM_RX_NAME
	default "IPM_1" if RPMSG_SERVICE_MODE_MASTER
	default "IPM_0" if RPMSG_SERVICE_MODE_REMOTE

config IPM_MSG_CH_0_TX
	default RPMSG_SERVICE_MODE_MASTER

config IPM_MSG_CH_0_RX
	default RPMSG_SERVICE_MODE_REMOTE

config IPM_MSG_CH_1_TX
	default RPMSG_SERVICE_MODE_REMOTE

config IPM_MSG_CH_1_RX
	default RPMSG_SERVICE_MODE_MASTER

endif # RPMSG_SERVICE_DUAL_IPM_SUPPORT

if BOARD_THINGY53_NRF5340_CPUAPP || BOARD_THINGY53_NRF5340_CPUAPP_NS

config BOARD_ENABLE_DCDC_APP
	bool "Application MCU DCDC converter"
	select SOC_DCDC_NRF53X_APP
	default y

config BOARD_ENABLE_DCDC_NET
	bool "Network MCU DCDC converter"
	select SOC_DCDC_NRF53X_NET
	default y

config BOARD_ENABLE_DCDC_HV
	bool "High Voltage DCDC converter"
	select SOC_DCDC_NRF53X_HV
	default y

config BOARD_ENABLE_CPUNET
	bool "NRF53 Network MCU"
	help
	  This option enables releasing the Network 'force off' signal, which
	  as a consequence will power up the Network MCU during system boot.
	  Additionally, the option allocates GPIO pins that will be used by UARTE
	  of the Network MCU.
	  Note: GPIO pin allocation can only be configured by the secure Application
	  MCU firmware, so when this option is used with the non-secure version of
	  the board, the application needs to take into consideration, that the
	  secure firmware image must already have configured GPIO allocation for the
	  Network MCU.
	default y if (BT || NRF_802154_SER_HOST)

config DOMAIN_CPUNET_BOARD
	string
	default "thingy53_nrf5340_cpunet"
	depends on BOARD_ENABLE_CPUNET
	help
	  The board which will be used for CPUNET domain when creating a multi
	  image application where one or more images should be located on
	  another board. For example hci_rpmsg on the nRF5340_cpunet for
	  Bluetooth applications.

endif # BOARD_THINGY53_NRF5340_CPUAPP || BOARD_THINGY53_NRF5340_CPUAPP_NS

if BOARD_THINGY53_NRF5340_CPUNET

config DOMAIN_CPUAPP_BOARD
	string
	default "thingy53_nrf5340_cpuapp"
	help
	  The board which will be used for CPUAPP domain when creating a multi
	  image application where one or more images should be located on
	  another board.

endif # BOARD_THINGY53_NRF5340_CPUNET
```

## boards/arm/thingy53_nrf5340/Kconfig.board
```kconfig
# Thingy53 NRF5340 board configuration

# Copyright (c) 2021 Nordic Semiconductor ASA
# SPDX-License-Identifier: Apache-2.0

if SOC_NRF5340_CPUAPP_QKAA

config BOARD_THINGY53_NRF5340_CPUAPP
	bool "Thingy53 nRF5340 Application MCU"

config BOARD_THINGY53_NRF5340_CPUAPP_NS
	bool "Thingy53 nRF5340 Application MCU non-secure"

endif # SOC_NRF5340_CPUAPP_QKAA

if SOC_NRF5340_CPUNET_QKAA

config BOARD_THINGY53_NRF5340_CPUNET
	bool "Thingy53 nRF5340 Network MCU"

endif # SOC_NRF5340_CPUNET_QKAA
```

## boards/arm/thingy53_nrf5340/Kconfig.thingy53_nrf5340_cpuapp_ns
```kconfig
# Copyright (c) 2022 Zephyr Project members and individual contributors
# SPDX-License-Identifier: Apache-2.0

config BOARD_THINGY53_NRF5340_CPUAPP_NS
	bool
	default y
	select SOC_SERIES_NRF53X
	select SOC_NRF5340_CPUAPP_QKAA
```

## boards/arm/thingy53_nrf5340/thingy53_nrf5340_cpuapp_defconfig
```kconfig
# SPDX-License-Identifier: Apache-2.0

CONFIG_SOC_SERIES_NRF53X=y
CONFIG_SOC_NRF5340_CPUAPP_QKAA=y
CONFIG_BOARD_THINGY53_NRF5340_CPUAPP=y

# Enable MPU
CONFIG_ARM_MPU=y

# Enable hardware stack protection
CONFIG_HW_STACK_PROTECTION=y

# Enable TrustZone-M
CONFIG_ARM_TRUSTZONE_M=y

# Enable GPIO
CONFIG_GPIO=y

# Enable console
CONFIG_CONSOLE=y
CONFIG_UART_CONSOLE=y

# Enable uart driver
CONFIG_SERIAL=y

CONFIG_PINCTRL=y

# Board Kconfig.defconfig enables USB CDC ACM and should disable USB remote
# wakeup by default. It needs to be disabled here, because the USB nrfx
# driver always overwrites option from Kconfig mentioned above with the
# imply from CONFIG_USB_NRFX.
CONFIG_USB_DEVICE_REMOTE_WAKEUP=n
```

## boards/arm/thingy53_nrf5340/thingy53_nrf5340_cpunet_defconfig
```kconfig
# SPDX-License-Identifier: Apache-2.0

CONFIG_SOC_SERIES_NRF53X=y
CONFIG_SOC_NRF5340_CPUNET_QKAA=y
CONFIG_BOARD_THINGY53_NRF5340_CPUNET=y

# Enable MPU
CONFIG_ARM_MPU=y

# Enable hardware stack protection
CONFIG_HW_STACK_PROTECTION=y

# Enable GPIO
CONFIG_GPIO=y

CONFIG_PINCTRL=y
```

## boards/arm/ti_am62x_sk_m4/Kconfig.board
```kconfig
# Texas Instruments Sitara AM62x-SK-M4 EVM
#
# Copyright (c) 2023 Texas Instruments Incorporated
# Copyright (c) 2023 L Lakshmanan
#
# SPDX-License-Identifier: Apache-2.0

config BOARD_TI_AM62X_SK_M4
	bool "TI_AM62X_SK_M4"
	depends on SOC_SERIES_AM62X_M4
```

## boards/arm/ti_am62x_sk_m4/Kconfig.defconfig
```kconfig
# Texas Instruments Sitara AM62x-SK-M4 EVM
#
# Copyright (c) 2023 Texas Instruments Incorporated
# Copyright (c) 2023 L Lakshmanan
#
# SPDX-License-Identifier: Apache-2.0

if BOARD_TI_AM62X_SK_M4

config BOARD
	default "ti_am62x_sk_m4"

endif # BOARD_TI_AM62X_SK_M4
```

## boards/arm/tmo_dev_edge/Kconfig.board
```kconfig
# T-Mobile DevEdge Development Board

# Copyright (c) 2018, Christian Taedcke
# Copyright (c) 2019  Lemonbeat GmbH
# Copyright (c) 2022 T-Mobile USA, Inc.
# SPDX-License-Identifier: Apache-2.0

config BOARD_TMO_DEV_EDGE
	bool "T-Mobile Development Edge Board"
	depends on SOC_SERIES_EFM32PG12B
	select SOC_PART_NUMBER_EFM32PG12B500F1024GL125
```

## boards/arm/tmo_dev_edge/Kconfig.defconfig
```kconfig
# EFM32PG STK3402A board

# Copyright (c) 2018, Christian Taedcke
# Copyright (c) 2019  Lemonbeat GmbH
# Copyright (c) 2022 T-Mobile USA, Inc.

# SPDX-License-Identifier: Apache-2.0

if BOARD_TMO_DEV_EDGE

config BOARD
	default "tmo_dev_edge"

config CMU_HFXO_FREQ
	default 38400000

config CMU_LFXO_FREQ
	default 32768

config COUNTER_GECKO_RTCC
	bool
	default y
	depends on COUNTER

endif # BOARD_TMO_DEV_EDGE
```

## boards/arm/tmo_dev_edge/tmo_dev_edge_defconfig
```kconfig
#
# Copyright (c) 2023 T-Mobile USA, Inc.
#
# SPDX-License-Identifier: Apache-2.0
#

CONFIG_SOC_SERIES_EFM32PG12B=y
CONFIG_BOARD_TMO_DEV_EDGE=y
CONFIG_ARM_MPU=y
CONFIG_CONSOLE=y
CONFIG_UART_CONSOLE=y
CONFIG_SERIAL=y
CONFIG_CORTEX_M_SYSTICK=y
CONFIG_SYS_CLOCK_HW_CYCLES_PER_SEC=38400000
CONFIG_GPIO=y
CONFIG_CMU_HFCLK_HFXO=y
CONFIG_COUNTER=y
CONFIG_NOTIFY=y
CONFIG_PERSISTENT_GECKO_RTCC=y
CONFIG_PINCTRL=y
CONFIG_POSIX_CLOCK=y
```

## boards/arm/twr_ke18f/Kconfig
```kconfig
# Kconfig - TWR-KE18F board configuration
#
# Copyright (c) 2019 Vestas Wind Systems A/S
#
# SPDX-License-Identifier: Apache-2.0

if BOARD_TWR_KE18F

config BOARD_TWR_KE18F_FLEXIO_CLKOUT
	bool "Enable CLKOUT signal on FlexIO header"
	depends on PINMUX_MCUX_PORTE
	help
	  Enable the CLKOUT signal on FlexIO header pin 7 (PTE10).

config BOARD_TWR_KE18F_SPI_0_PCS2
	bool "Use PTE6 as dedicated SPI_0 PCS2 chip select"
	depends on SPI_0
	default y

config BOARD_TWR_KE18F_SPI_1_PCS0
	bool "Use PTD3 as dedicated SPI_1 PCS0 chip select"
	depends on SPI_1
	default y

config BOARD_TWR_KE18F_SPI_1_PCS2
	bool "Use PTA16 as dedicated SPI_1 PCS2 chip select"
	depends on SPI_1
	default y

endif #BOARD_TWR_KE18F
```

## boards/arm/twr_ke18f/Kconfig.board
```kconfig
# NXP TWR-KE18F

# Copyright (c) 2019 Vestas Wind Systems A/S
# SPDX-License-Identifier: Apache-2.0

config BOARD_TWR_KE18F
	def_bool "$(BOARD)" = "twr_ke18f"
	depends on SOC_SERIES_KINETIS_KE1XF
	select SOC_PART_NUMBER_MKE18F512VLL16
```

## boards/arm/twr_ke18f/Kconfig.defconfig
```kconfig
# TWR-KE18F board

# Copyright (c) 2019 Vestas Wind Systems A/S
# SPDX-License-Identifier: Apache-2.0

if BOARD_TWR_KE18F

config BOARD
	default "twr_ke18f"

config TEMP_KINETIS
	default y if "$(dt_nodelabel_enabled,adc0)"
	depends on SENSOR && ADC

config I2C_MCUX_LPI2C_BUS_RECOVERY
	default y
	depends on I2C_MCUX_LPI2C && PINCTRL

# The KE1xF has 8 MPU regions, which is not enough for both HW stack protection
# and userspace. Only enable HW stack protection if userspace is not enabled.
config HW_STACK_PROTECTION
	default y if !USERSPACE

endif # BOARD_TWR_KE18F
```

## boards/arm/twr_ke18f/Kconfig.twr_ke18f
```kconfig
# Copyright (c) 2022 Zephyr Project members and individual contributors
# SPDX-License-Identifier: Apache-2.0

config BOARD_TWR_KE18F
	bool
	default y
	select SOC_SERIES_KINETIS_KE1XF
	select SOC_MKE18F16
	select SOC_PART_NUMBER_MKE18F512VLL16
```

## boards/arm/twr_ke18f/dts/bindings/nxp,flexio.yaml
```yaml
# Copyright (c) 2022, NXP
# SPDX-License-Identifier: Apache-2.0

description: |
  NXP FlexIO binding. This binding does not represent a full FlexIO driver, but
  declares pinctrl properties, so that the user can MUX pins at the board level
  for the FlexIO.

compatible: "nxp,flexio"

include: [base.yaml, pinctrl-device.yaml]

properties:
  pinctrl-0:
    required: true
  pinctrl-names:
    required: true
```

## boards/arm/twr_ke18f/twr_ke18f_defconfig
```kconfig
# SPDX-License-Identifier: Apache-2.0

CONFIG_SOC_SERIES_KINETIS_KE1XF=y
CONFIG_SOC_MKE18F16=y
CONFIG_BOARD_TWR_KE18F=y
CONFIG_SERIAL=y
CONFIG_CONSOLE=y
CONFIG_UART_CONSOLE=y
CONFIG_UART_INTERRUPT_DRIVEN=y
CONFIG_PINCTRL=y
CONFIG_GPIO=y

# Enable MPU
CONFIG_ARM_MPU=y
```

## boards/arm/twr_kv58f220m/Kconfig.board
```kconfig
# TWR-KV58F220M board configuration

# Copyright (c) 2019 SEAL AG
# SPDX-License-Identifier: Apache-2.0

config BOARD_TWR_KV58F220M
	bool "NXP TWR-KV58F220M"
	depends on SOC_SERIES_KINETIS_KV5X
	select SOC_PART_NUMBER_MKV58F1M0VLQ24
```

## boards/arm/twr_kv58f220m/Kconfig.defconfig
```kconfig
# TWR-KV58F220M board

# Copyright (c) 2019 SEAL AG
# SPDX-License-Identifier: Apache-2.0

config OSC_XTAL0_FREQ
	default 50000000

config MCG_PRDIV0
	default 0x3

config MCG_VDIV0
	default 0x16

config MCG_FCRDIV
	default 1
```
