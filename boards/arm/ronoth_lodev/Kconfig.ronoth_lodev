## boards/arm/ronoth_lodev/Kconfig.ronoth_lodev
```kconfig
# Copyright (c) 2022 Zephyr Project members and individual contributors
# SPDX-License-Identifier: Apache-2.0

config BOARD_RONOTH_LODEV
	bool
	default y
	select SOC_SERIES_STM32L0X
	select SOC_STM32L073XX
```

## boards/arm/ronoth_lodev/ronoth_lodev_defconfig
```kconfig
# Ronoth LoDev board configuration
# Copyright (c) 2021 Dean Weiten <dmw@weiten.com>
# SPDX-License-Identifier: Apache-2.0

# Zephyr Kernel Configuration
CONFIG_SOC_SERIES_STM32L0X=y

# Platform Configuration
CONFIG_SOC_STM32L073XX=y

# Enable MPU
CONFIG_ARM_MPU=y

# Serial Drivers
CONFIG_SERIAL=y
CONFIG_UART_INTERRUPT_DRIVEN=y
# enable console
CONFIG_CONSOLE=y
CONFIG_UART_CONSOLE=y

# GPIO Controller
CONFIG_GPIO=y

# Enable Clocks
CONFIG_CLOCK_CONTROL=y

# enable pin controller
CONFIG_PINCTRL=y
```

## boards/arm/rpi_pico/Kconfig.board
```kconfig
# Copyright (c) 2021 Yonatan Schachter
# SPDX-License-Identifier: Apache-2.0

config BOARD_RPI_PICO
	bool "Raspberry Pi Pico Board"
	depends on SOC_RP2040

config BOARD_RPI_PICO_W
	bool "Raspberry Pi Pico W Board"
	depends on SOC_RP2040
```

## boards/arm/rpi_pico/Kconfig.defconfig
```kconfig
# Copyright (c) 2021 Yonatan Schachter
# SPDX-License-Identifier: Apache-2.0

config RP2_FLASH_W25Q080
	default y

if I2C_DW

config I2C_DW_CLOCK_SPEED
	default 100

endif # I2C_DW
```

## boards/arm/rpi_pico/Kconfig.rpi_pico
```kconfig
# Copyright (c) 2022 Zephyr Project members and individual contributors
# SPDX-License-Identifier: Apache-2.0

config BOARD_RPI_PICO
	bool
	default y
	select SOC_SERIES_RP2XXX
	select SOC_RP2040
```

## boards/arm/rpi_pico/rpi_pico_defconfig
```kconfig
CONFIG_SOC_SERIES_RP2XXX=y
CONFIG_SOC_RP2040=y
CONFIG_SYS_CLOCK_HW_CYCLES_PER_SEC=125000000
CONFIG_SERIAL=y
CONFIG_CONSOLE=y
CONFIG_UART_CONSOLE=y
CONFIG_GPIO=y
CONFIG_USE_DT_CODE_PARTITION=y
CONFIG_BUILD_OUTPUT_UF2=y
CONFIG_UART_INTERRUPT_DRIVEN=y
CONFIG_RESET=y
```

## boards/arm/ruuvi_ruuvitag/Kconfig
```kconfig
# Ruuvi-RuuviTag board configuration

# Copyright (c) 2020 Ruuvi Innovations Ltd (Oy)
# SPDX-License-Identifier: Apache-2.0

config BOARD_ENABLE_DCDC
	bool "Enable DCDC mode"
	select SOC_DCDC_NRF52X
	default y
	depends on BOARD_RUUVI_RUUVITAG
```

## boards/arm/ruuvi_ruuvitag/Kconfig.board
```kconfig
# Copyright (c) 2020 Ruuvi Innovations Ltd (Oy)
# SPDX-License-Identifier: Apache-2.0

config BOARD_RUUVI_RUUVITAG
	bool "Ruuvi-RuuviTag"
	depends on SOC_NRF52832_QFAA
```

## boards/arm/ruuvi_ruuvitag/Kconfig.defconfig
```kconfig
# Ruuvi RuuviTag configuration

# Copyright (c) 2020 Ruuvi Innovations Ltd (Oy)
# SPDX-License-Identifier: Apache-2.0

config SPI
	default y

config BT_CTLR
	default BT
```

## boards/arm/ruuvi_ruuvitag/ruuvi_ruuvitag_defconfig
```kconfig
# Copyright (c) 2020 Ruuvi Innovations Ltd (Oy)
# SPDX-License-Identifier: Apache-2.0

CONFIG_SOC_SERIES_NRF52X=y
CONFIG_SOC_NRF52832_QFAA=y
CONFIG_BOARD_RUUVI_RUUVITAG=y

# Enable MPU
CONFIG_ARM_MPU=y

# Enable RTT
CONFIG_USE_SEGGER_RTT=y

# Enable GPIO
CONFIG_GPIO=y

CONFIG_PINCTRL=y
```

## boards/arm/rv32m1_vega_cortex/Kconfig.board
```kconfig
# Copyright (c) 2020 Karsten Koenig
# SPDX-License-Identifier: Apache-2.0

config BOARD_RV32M1_VEGA_CORTEX
	bool "RV32M1 ARM cores"
	depends on SOC_OPENISA_RV32M1_ARM
```

## boards/arm/rv32m1_vega_cortex/Kconfig.defconfig
```kconfig
# Copyright (c) 2020 Karsten Koenig
# SPDX-License-Identifier: Apache-2.0

if BOARD_RV32M1_VEGA_CORTEX

config BOARD
	default "rv32m1_vega_cortex_m4" if SOC_OPENISA_RV32M1_M4

config UART_RV32M1_LPUART
	default y
	depends on SERIAL

endif # BOARD_RV32M1_VEGA
```

## boards/arm/rv32m1_vega_cortex/rv32m1_vega_cortex_m4_defconfig
```kconfig
# Copyright (c) 2020 Karsten Koenig
# SPDX-License-Identifier: Apache-2.0

CONFIG_SOC_OPENISA_RV32M1_ARM=y
CONFIG_SOC_OPENISA_RV32M1_M4=y
CONFIG_BOARD_RV32M1_VEGA_CORTEX=y
CONFIG_CLOCK_CONTROL_RV32M1_PCC=y
CONFIG_GPIO=y
CONFIG_PINMUX=y
CONFIG_SERIAL=y
CONFIG_CONSOLE=y
CONFIG_UART_CONSOLE=y
CONFIG_UART_INTERRUPT_DRIVEN=y
```

## boards/arm/rzt2m_starterkit/Kconfig.board
```kconfig
# Copyright (c) 2023 Antmicro <www.antmicro.com>
# SPDX-License-Identifier: Apache-2.0

config BOARD_RZT2M_STARTER_KIT
	bool "RZ/T2M Starter Kit Board"
	depends on SOC_RENESAS_RZT2M
```

## boards/arm/rzt2m_starterkit/Kconfig.defconfig
```kconfig
# Copyright (c) 2023 Antmicro <www.antmicro.com>
# SPDX-License-Identifier: Apache-2.0

if BOARD_RZT2M_STARTER_KIT

config BOARD
	default "rzt2m_starter_kit"

endif
```

## boards/arm/rzt2m_starterkit/rzt2m_starter_kit_defconfig
```kconfig
# Copyright (c) 2023 Antmicro <www.antmicro.com>
# SPDX-License-Identifier: Apache-2.0

CONFIG_SOC_RENESAS_RZT2M=y
CONFIG_BOARD_RZT2M_STARTER_KIT=y

CONFIG_SERIAL=y
CONFIG_CONSOLE=y
CONFIG_UART_CONSOLE=y
CONFIG_UART_INTERRUPT_DRIVEN=y
```

## boards/arm/s32k144_evb/Kconfig.board
```kconfig
# S32K144EVB board

# Copyright (c) 2020, Dung Tran
# SPDX-License-Identifier: Apache-2.0

config BOARD_S32K144EVB
	bool "NXP S32K144EVB"
	depends on SOC_SERIES_S32K14X
	select SOC_PART_NUMBER_S32K144
```

## boards/arm/s32k144_evb/Kconfig.defconfig
```kconfig
# S32K144EVB board

# Copyright (c) 2020, Dung Tran
# SPDX-License-Identifier: Apache-2.0

if BOARD_S32K144EVB

config BOARD
	default "s32k144evb"

endif # BOARD_S32K144EVB
```

## boards/arm/s32k144_evb/s32k144_evb_defconfig
```kconfig
CONFIG_BOARD_S32K144EVB=y
CONFIG_SOC_SERIES_S32K14X=y
CONFIG_SYS_CLOCK_HW_CYCLES_PER_SEC=48000000
CONFIG_GPIO=y

# so that the application has more RAM for itself.
CONFIG_MAIN_STACK_SIZE=512

CONFIG_CONSOLE=y
CONFIG_UART_CONSOLE=y
CONFIG_SERIAL=y
```

## boards/arm/s32z270dc2_r52/Kconfig.defconfig
```kconfig
# Copyright 2022 NXP
# SPDX-License-Identifier: Apache-2.0

if BOARD_S32Z270DC2_RTU0_R52 || BOARD_S32Z270DC2_RTU1_R52

config BUILD_OUTPUT_BIN
	default n

config BOARD
	default "s32z270dc2_rtu0_r52" if BOARD_S32Z270DC2_RTU0_R52
	default "s32z270dc2_rtu1_r52" if BOARD_S32Z270DC2_RTU1_R52

config NXP_S32_RTU_INDEX
	default 0 if BOARD_S32Z270DC2_RTU0_R52
	default 1 if BOARD_S32Z270DC2_RTU1_R52

if SERIAL

config UART_INTERRUPT_DRIVEN
	default y

config UART_CONSOLE
	default y

endif # SERIAL

if SHELL

config SHELL_STACK_SIZE
	default 4096

endif # SHELL

endif # BOARD_S32Z270DC2_RTU0_R52 || BOARD_S32Z270DC2_RTU1_R52
```

## boards/arm/sam3u_ek/Kconfig.board
```kconfig
# Atmel SAM3U-EK selection

# Copyright (c) 2023 Chen Xingyu <hi@xingrz.me>
# SPDX-License-Identifier: Apache-2.0

config BOARD_SAM3U_EK
	bool "Atmel SAM3U-EK"
	depends on SOC_PART_NUMBER_SAM3U4E
```

## boards/arm/sam3u_ek/Kconfig.defconfig
```kconfig
# Atmel SAM3U-EK Board configuration

# Copyright (c) 2023 Chen Xingyu <hi@xingrz.me>
# SPDX-License-Identifier: Apache-2.0

if BOARD_SAM3U_EK

config BOARD
	default "sam3u_ek"

endif # BOARD_SAM3U_EK
```

## boards/arm/sam3u_ek/sam3u_ek_defconfig
```kconfig
# SPDX-License-Identifier: Apache-2.0

CONFIG_SOC_SERIES_SAM3U=y
CONFIG_SOC_PART_NUMBER_SAM3U4E=y
CONFIG_BOARD_SAM3U_EK=y
CONFIG_ARM_MPU=y
CONFIG_CONSOLE=y
CONFIG_UART_CONSOLE=y
CONFIG_SERIAL=y
CONFIG_GPIO=y

# Enable HW stack protection
CONFIG_HW_STACK_PROTECTION=y
```

## boards/arm/sam4e_xpro/Kconfig.board
```kconfig
# Atmel SAM4E Xplained Pro Board selection

# Copyright (c) 2019 Gerson Fernando Budke
# SPDX-License-Identifier: Apache-2.0

config BOARD_SAM4E_XPRO
	bool "Atmel SAM4E Xplained Pro"
	depends on SOC_PART_NUMBER_SAM4E16E
```

## boards/arm/sam4e_xpro/Kconfig.defconfig
```kconfig
# Atmel SAM4E Xplained Pro Board configuration

# Copyright (c) 2019 Gerson Fernando Budke
# SPDX-License-Identifier: Apache-2.0

if BOARD_SAM4E_XPRO

config BOARD
	default "sam4e_xpro"

endif # BOARD_SAM4E_XPRO
```
