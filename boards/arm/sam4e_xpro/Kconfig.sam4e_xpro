## boards/arm/sam4e_xpro/Kconfig.sam4e_xpro
```kconfig
# Copyright (c) 2022 Zephyr Project members and individual contributors
# SPDX-License-Identifier: Apache-2.0

config BOARD_SAM4E_XPRO
	bool
	default y
	select SOC_SERIES_SAM4E
	select SOC_PART_NUMBER_SAM4E16E
```

## boards/arm/sam4e_xpro/sam4e_xpro_defconfig
```kconfig
# SPDX-License-Identifier: Apache-2.0

CONFIG_SOC_SERIES_SAM4E=y
CONFIG_SOC_PART_NUMBER_SAM4E16E=y
CONFIG_ARM_MPU=y
CONFIG_CONSOLE=y
CONFIG_UART_CONSOLE=y
CONFIG_SERIAL=y
CONFIG_BOARD_SAM4E_XPRO=y
CONFIG_BUILD_OUTPUT_HEX=y
CONFIG_SOC_ATMEL_SAM4E_EXT_MAINCK=y
CONFIG_GPIO=y
CONFIG_WDT_DISABLE_AT_BOOT=y

# Enable HW stack protection
CONFIG_HW_STACK_PROTECTION=y
```

## boards/arm/sam4l_ek/Kconfig.board
```kconfig
# Atmel SAM4L-EK selection

# Copyright (c) 2020 Gerson Fernando Budke <nandojve@gmail.com>
# SPDX-License-Identifier: Apache-2.0

config BOARD_SAM4L_EK
	bool "Atmel SAM4L-EK"
	depends on SOC_PART_NUMBER_SAM4LC4C
```

## boards/arm/sam4l_ek/Kconfig.defconfig
```kconfig
# Atmel SAM4L-EK Board configuration

# Copyright (c) 2020 Gerson Fernando Budke <nandojve@gmail.com>
# SPDX-License-Identifier: Apache-2.0

if BOARD_SAM4L_EK

config BOARD
	default "sam4l_ek"

endif # BOARD_SAM4L_EK
```

## boards/arm/sam4l_ek/Kconfig.sam4l_ek
```kconfig
# Copyright (c) 2022 Zephyr Project members and individual contributors
# SPDX-License-Identifier: Apache-2.0

config BOARD_SAM4L_EK
	bool
	default y
	select SOC_SERIES_SAM4L
	select SOC_PART_NUMBER_SAM4LC4C
```

## boards/arm/sam4l_ek/sam4l_ek_defconfig
```kconfig
# SPDX-License-Identifier: Apache-2.0

CONFIG_SOC_SERIES_SAM4L=y
CONFIG_SOC_PART_NUMBER_SAM4LC4C=y
CONFIG_ARM_MPU=y
CONFIG_CORTEX_M_SYSTICK=y
CONFIG_CONSOLE=y
CONFIG_UART_CONSOLE=y
CONFIG_SERIAL=y
CONFIG_BOARD_SAM4L_EK=y
CONFIG_WATCHDOG=n
CONFIG_SPI=y
```

## boards/arm/sam4s_xplained/Kconfig.board
```kconfig
# Atmel SAM4S Xplained board

# Copyright (c) 2017 Justin Watson
# SPDX-License-Identifier: Apache-2.0

config BOARD_SAM4S_XPLAINED
	def_bool "$(BOARD)" = "sam4s_xplained"
	depends on SOC_PART_NUMBER_SAM4S16C
```

## boards/arm/sam4s_xplained/Kconfig.defconfig
```kconfig
# Kconfig - Atmel SAM4S Xplained Board configuration
#
# Copyright (c) 2017 Justin Watson
# SPDX-License-Identifier: Apache-2.0
#

if BOARD_SAM4S_XPLAINED

config BOARD
	default "sam4s_xplained"

if I2C

config I2C_SAM_TWI
	default y

config I2C_0
	default y

endif # I2C

endif # BOARD_SAM4S_XPLAINED
```

## boards/arm/sam4s_xplained/Kconfig.sam4s_xplained
```kconfig
# Copyright (c) 2022 Zephyr Project members and individual contributors
# SPDX-License-Identifier: Apache-2.0

config BOARD_SAM4S_XPLAINED
	bool
	default y
	select SOC_SERIES_SAM4S
	select SOC_PART_NUMBER_SAM4S16C
```

## boards/arm/sam4s_xplained/sam4s_xplained_defconfig
```kconfig
# SPDX-License-Identifier: Apache-2.0

CONFIG_SOC_SERIES_SAM4S=y
CONFIG_SOC_PART_NUMBER_SAM4S16C=y
CONFIG_SOC_ATMEL_SAM4S_EXT_MAINCK=y
CONFIG_BOARD_SAM4S_XPLAINED=y

CONFIG_ARM_MPU=y
CONFIG_HW_STACK_PROTECTION=y
CONFIG_WDT_DISABLE_AT_BOOT=y

CONFIG_CONSOLE=y
CONFIG_GPIO=y
CONFIG_MEMC=y
CONFIG_SERIAL=y
CONFIG_UART_CONSOLE=y
```

## boards/arm/sam_e70_xplained/Kconfig.board
```kconfig
# Atmel SMART SAM E70 Xplained board

# Copyright (c) 2016 Piotr Mienkowski
# SPDX-License-Identifier: Apache-2.0

config BOARD_SAM_E70_XPLAINED
	def_bool "$(BOARD)" = "sam_e70_xplained"
	depends on SOC_PART_NUMBER_SAME70Q21 || SOC_PART_NUMBER_SAME70Q21B
```

## boards/arm/sam_e70_xplained/Kconfig.defconfig
```kconfig
# Atmel SMART SAM E70 Xplained Board configuration

# Copyright (c) 2016 Piotr Mienkowski
# SPDX-License-Identifier: Apache-2.0

if BOARD_SAM_E70_XPLAINED

config BOARD
	default "sam_e70_xplained"

if ETH_SAM_GMAC

# Read MAC address from AT24MAC402 EEPROM

config ETH_SAM_GMAC_MAC_I2C_INT_ADDRESS
	default 0x9A

config ETH_SAM_GMAC_MAC_I2C_INT_ADDRESS_SIZE
	default 1

config ETH_SAM_GMAC_MAC_I2C_EEPROM
	default y
	select I2C

endif # ETH_SAM_GMAC

if NETWORKING

config NET_L2_ETHERNET
	default y

endif # NETWORKING

endif # BOARD_SAM_E70_XPLAINED
```

## boards/arm/sam_e70_xplained/Kconfig.sam_e70_xplained
```kconfig
# Copyright (c) 2022 Zephyr Project members and individual contributors
# SPDX-License-Identifier: Apache-2.0

config BOARD_SAM_E70_XPLAINED
	bool
	default y
	select SOC_SERIES_SAME70
	select SOC_PART_NUMBER_SAME70Q21
```

## boards/arm/sam_e70_xplained/sam_e70_xplained_defconfig
```kconfig
# SPDX-License-Identifier: Apache-2.0

CONFIG_SOC_SERIES_SAME70=y
CONFIG_SOC_PART_NUMBER_SAME70Q21=y
CONFIG_SOC_ATMEL_SAME70_EXT_MAINCK=y
CONFIG_SOC_ATMEL_SAME70_PLLA_MULA=24
CONFIG_SOC_ATMEL_SAME70_PLLA_DIVA=1
CONFIG_SYS_CLOCK_HW_CYCLES_PER_SEC=300000000
CONFIG_ARM_MPU=y
CONFIG_CORTEX_M_SYSTICK=y
CONFIG_CONSOLE=y
CONFIG_UART_CONSOLE=y
CONFIG_SERIAL=y
CONFIG_USART_SAM=y
CONFIG_BOARD_SAM_E70_XPLAINED=y
CONFIG_WDT_DISABLE_AT_BOOT=y
CONFIG_BUILD_OUTPUT_HEX=y

# Enable HW stack protection
CONFIG_HW_STACK_PROTECTION=y
```

## boards/arm/sam_v71_xult/Kconfig.defconfig
```kconfig
# Atmel SMART SAM V71 Xplained Board configuration

# Copyright (c) 2019 Gerson Fernando Budke
# Copyright (c) 2016 Piotr Mienkowski
# SPDX-License-Identifier: Apache-2.0

if BOARD_SAM_V71_XULT

config BOARD
	default "sam_v71_xult"

if ETH_SAM_GMAC

# Read MAC address from AT24MAC402 EEPROM

config ETH_SAM_GMAC_MAC_I2C_EEPROM
	default y
	select I2C

config ETH_SAM_GMAC_MAC_I2C_INT_ADDRESS
	default 0x9A

config ETH_SAM_GMAC_MAC_I2C_INT_ADDRESS_SIZE
	default 1

endif # ETH_SAM_GMAC

if NETWORKING

config NET_L2_ETHERNET
	default y

endif # NETWORKING

endif # BOARD_SAM_V71_XULT
```

## boards/arm/sam_v71_xult/Kconfig.sam_v71_xult
```kconfig
# Copyright (c) 2022 Zephyr Project members and individual contributors
# SPDX-License-Identifier: Apache-2.0

config BOARD_SAM_V71_XULT
	bool
	default y
	select SOC_SERIES_SAMV71
	select SOC_PART_NUMBER_SAMV71Q21
```

## boards/arm/sam_v71_xult/sam_v71_xult_defconfig
```kconfig
# SPDX-License-Identifier: Apache-2.0

CONFIG_SOC_SERIES_SAMV71=y
CONFIG_SOC_PART_NUMBER_SAMV71Q21=y
CONFIG_SOC_ATMEL_SAMV71_EXT_MAINCK=y
CONFIG_SOC_ATMEL_SAMV71_PLLA_MULA=24
CONFIG_SOC_ATMEL_SAMV71_PLLA_DIVA=1
CONFIG_ARM_MPU=y
CONFIG_CONSOLE=y
CONFIG_UART_CONSOLE=y
CONFIG_SERIAL=y
CONFIG_USART_SAM=y
CONFIG_BOARD_SAM_V71_XULT=y
CONFIG_WDT_DISABLE_AT_BOOT=y
CONFIG_BUILD_OUTPUT_HEX=y

# Enable HW stack protection
CONFIG_HW_STACK_PROTECTION=y
```

## boards/arm/scobc_module1/Kconfig.defconfig
```kconfig
# Space Cubics OBC module 1

# Copyright (c) 2021 Space Cubics <yashi@spacecubics.com>
# SPDX-License-Identifier: Apache-2.0

if BOARD_SCOBC_MODULE1

config BOARD
	default "scobc_module1"

config CPU_CORTEX_M_HAS_SYSTICK
	default y

config CPU_HAS_ARM_MPU
	default y

config NUM_IRQS
	default 7

config UART_XLNX_UARTLITE
	depends on SERIAL
	default y

endif # BOARD_SCOBC_MODULE1
```

## boards/arm/scobc_module1/Kconfig.scobc_module1
```kconfig
# Copyright (c) 2022 Zephyr Project members and individual contributors
# SPDX-License-Identifier: Apache-2.0

config BOARD_SCOBC_MODULE1
	bool
	default y
	select SOC_SERIES_ARM_DESIGNSTART
	select SOC_ARM_DESIGNSTART_FPGA_CORTEX_M3
```

## boards/arm/scobc_module1/dts/bindings/sc,hrmem.yaml
```yaml
# SPDX-License-Identifier: Apache-2.0

description: Space Cubics HRMEM (High-reliability Memory)

compatible: "sc,hrmem"

include: base.yaml

properties:
    reg:
      required: true
```

## boards/arm/scobc_module1/scobc_module1_defconfig
```kconfig
# SPDX-License-Identifier: Apache-2.0

CONFIG_CORTEX_M_SYSTICK=y
CONFIG_SOC_SERIES_ARM_DESIGNSTART=y
CONFIG_SOC_ARM_DESIGNSTART_FPGA_CORTEX_M3=y
CONFIG_BOARD_SCOBC_MODULE1=y
CONFIG_SYS_CLOCK_HW_CYCLES_PER_SEC=48000000
CONFIG_ARM_MPU=n

CONFIG_SERIAL=y
CONFIG_UART_INTERRUPT_DRIVEN=y
CONFIG_CONSOLE=y
CONFIG_UART_CONSOLE=y

CONFIG_XIP=n
CONFIG_FLASH_SIZE=0
CONFIG_FLASH_BASE_ADDRESS=0x0
CONFIG_BOOTLOADER_SRAM_SIZE=0
```

## boards/arm/secureiot1702/Kconfig.board
```kconfig
#
# Copyright (c) 2019 Crypta Labs Ltd.
#
# SPDX-License-Identifier: Apache-2.0
#

config BOARD_SECUREIOT1702
	bool "Microchip SecureIoT1702"
	depends on SOC_SERIES_CEC1702
	select HAS_DTS
```

## boards/arm/secureiot1702/secureiot1702_defconfig
```kconfig
#
# Copyright (c) 2019 Crypta Labs Ltd.
#
# SPDX-License-Identifier: Apache-2.0
#

CONFIG_SOC_SERIES_CEC1702=y
CONFIG_BOARD_SECUREIOT1702=y
CONFIG_SYS_CLOCK_HW_CYCLES_PER_SEC=48000000

CONFIG_SERIAL=y
CONFIG_CONSOLE=y
CONFIG_UART_CONSOLE=y
```

## boards/arm/segger_trb_stm32f407/Kconfig.board
```kconfig
# SEGGER-TRB-STM32F407 board configuration

# Copyright (c) 2020, Erwin Rol <erwin@erwinrol.com>
# SPDX-License-Identifier: Apache-2.0

config BOARD_SEGGER_TRB_STM32F407
	bool "SEGGER STM32F407 Trace Reference Board"
	depends on SOC_STM32F407XE
```
