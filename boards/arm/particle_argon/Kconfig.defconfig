## boards/arm/particle_argon/Kconfig.defconfig
```kconfig
# Particle Argon board configuration

# Copyright (c) 2018 Matthias Boesl
# SPDX-License-Identifier: Apache-2.0

config BT_CTLR
	default BT
```

## boards/arm/particle_argon/particle_argon_defconfig
```kconfig
#
# Copyright (c) 2018 Matthias Boesl
# Copyright (c) 2018 Peter Bigot Consulting, LLC
#
# SPDX-License-Identifier: Apache-2.0

CONFIG_ARM=y
CONFIG_SOC_FAMILY_NRF=y
CONFIG_SOC_SERIES_NRF52X=y
CONFIG_SOC_NRF52840_QIAA=y
CONFIG_BOARD_PARTICLE_ARGON=y

# Enable MPU
CONFIG_ARM_MPU=y

# enable GPIO
CONFIG_GPIO=y

# enable uart driver
CONFIG_SERIAL=y
CONFIG_UART_0_NRF_UARTE=y
CONFIG_UART_1_NRF_UARTE=y

# enable console
CONFIG_CONSOLE=y
CONFIG_UART_CONSOLE=y

# additional board options
CONFIG_GPIO_AS_PINRESET=y
```

## boards/arm/particle_argon_nrf52/Kconfig.board
```kconfig
# Kconfig - Particle Argon configuration
#
# Copyright (c) 2018 Matthias Boesl
#
# SPDX-License-Identifier: Apache-2.0

config  BOARD_PARTICLE_ARGON_NRF52
	bool "Particle Argon Board NRF52840 controller"
	depends on SOC_NRF52840_QIAA
```

## boards/arm/particle_argon_nrf52/Kconfig.defconfig
```kconfig
# Kconfig - Particle Agron board configuration
#
# Copyright (c) 2018 Matthias Boesl
#
# SPDX-License-Identifier: Apache-2.0

if BOARD_PARTICLE_ARGON_NRF52

config BOARD
	default "particle_argon_nrf52"

if USB

config USB_NRF52840
	default y

config USB_DEVICE_STACK
	default y

endif # USB

config I2C
	default y

if I2C

config I2C_NRFX
	default y

if I2C_NRFX

config I2C_0
	default y

endif #I2C_NRFX

if I2C_0

choice I2C_0_NRF_TYPE
	default I2C_0_NRF_TWIM

endchoice

endif # I2C_0

endif # I2C

if SPI

config SPI_NRFX
	default y

if SPI_NRFX

config SPI_0
	default n

config SPI_1
	default y

config SPI_2
	default n

endif # SPI_NRFX
endif # SPI

if IEEE802154

config IEEE802154_NRF5
	default y

endif # IEEE802154

endif # BOARD_PARTICLE_ARGON
```

## boards/arm/particle_boron/Kconfig
```kconfig
# Kconfig - Particle Boron configuration
#
# Copyright (c) 2018 Peter Bigot Consulting, LLC
#
# SPDX-License-Identifier: Apache-2.0

if BOARD_PARTICLE_BORON

config BOARD_ENABLE_DCDC
	bool "Enable DCDC mode"
	select SOC_DCDC_NRF52X
	default y

endif # BOARD_PARTICLE_BORON
```

## boards/arm/particle_boron/Kconfig.board
```kconfig
# Particle Boron board

# Copyright (c) 2018 Peter Bigot Consulting, LLC
# SPDX-License-Identifier: Apache-2.0

config BOARD_PARTICLE_BORON
	def_bool "$(BOARD)" = "particle_boron"
	depends on SOC_NRF52840_QIAA
```

## boards/arm/particle_boron/Kconfig.defconfig
```kconfig
# Particle Boron board configuration

# Copyright (c) 2018 Peter Bigot Consulting, LLC
# SPDX-License-Identifier: Apache-2.0

if BOARD_PARTICLE_BORON

config BOARD
	default "particle_boron"

if USB

config USB_NRFX
	default y

config USB_DEVICE_STACK
	default y

endif # USB

config BT_CTLR
	default BT

if MODEM

config MODEM_UBLOX_SARA
	default y

choice MODEM_UBLOX_SARA_VARIANT
	default MODEM_UBLOX_SARA_R4
endchoice

config UART_INTERRUPT_DRIVEN
	default y

endif # MODEM

endif # BOARD_PARTICLE_BORON
```

## boards/arm/particle_boron/particle_boron_defconfig
```kconfig
#
# Copyright (c) 2018 Peter Bigot Consulting, LLC
#
# SPDX-License-Identifier: Apache-2.0

CONFIG_SOC_SERIES_NRF52X=y
CONFIG_SOC_NRF52840_QIAA=y
CONFIG_BOARD_PARTICLE_BORON=y

# Enable MPU
CONFIG_ARM_MPU=y

# enable GPIO
CONFIG_GPIO=y

# enable uart driver
CONFIG_SERIAL=y

# enable power I2C interface
CONFIG_I2C=y

# enable console
CONFIG_CONSOLE=y
CONFIG_UART_CONSOLE=y

# additional board options
CONFIG_GPIO_AS_PINRESET=y

CONFIG_PINCTRL=y
```

## boards/arm/particle_xenon/Kconfig
```kconfig
# Kconfig - Particle Xenon configuration
#
# Copyright (c) 2018 Endre Karlson
#
# SPDX-License-Identifier: Apache-2.0

if BOARD_PARTICLE_XENON

config BOARD_ENABLE_DCDC
	bool "Enable DCDC mode"
	select SOC_DCDC_NRF52X
	default y

endif # BOARD_PARTICLE_XENON
```

## boards/arm/particle_xenon/Kconfig.board
```kconfig
# Particle Xenon configuration

# Copyright (c) 2018 Endre Karlson
# SPDX-License-Identifier: Apache-2.0

config BOARD_PARTICLE_XENON
	bool "Particle Xenon Board"
	depends on SOC_NRF52840_QIAA
```

## boards/arm/particle_xenon/Kconfig.defconfig
```kconfig
# Particle Xenon board configuration

# Copyright (c) 2018 Endre Karlson
# Copyright (c) 2018 Peter Bigot Consulting, LLC
# SPDX-License-Identifier: Apache-2.0

config BT_CTLR
	default BT
```

## boards/arm/pico_pi_m4/Kconfig.board
```kconfig
# Pico-Pi iMX7D Dual M4 board

# Copyright (c) 2019, Joris Offouga
# SPDX-License-Identifier: Apache-2.0

config BOARD_PICO_PI_M4
	def_bool "$(BOARD)" = "pico_pi_m4"
	depends on SOC_SERIES_IMX7_M4
```

## boards/arm/pico_pi_m4/Kconfig.defconfig
```kconfig
# Pico-Pi iMX7D M4 board

# Copyright (c) 2019, Joris Offouga
# SPDX-License-Identifier: Apache-2.0

if BOARD_PICO_PI_M4

config BOARD
	default "pico_pi_m4"

if !XIP
config FLASH_SIZE
	default 0
config FLASH_BASE_ADDRESS
	default 0
endif

endif # BOARD_PICO_PI_M4
```

## boards/arm/pico_pi_m4/Kconfig.pico_pi_m4
```kconfig
# Copyright (c) 2022 Zephyr Project members and individual contributors
# SPDX-License-Identifier: Apache-2.0

config BOARD_PICO_PI_M4
	bool
	default y
	select SOC_SERIES_IMX7_M4
	select SOC_MCIMX7_M4
```

## boards/arm/pico_pi_m4/pico_pi_m4_defconfig
```kconfig
#
# Copyright (c) 2019, Joris Offouga
#
# SPDX-License-Identifier: Apache-2.0
#

CONFIG_SOC_SERIES_IMX7_M4=y
CONFIG_SOC_MCIMX7_M4=y
CONFIG_BOARD_PICO_PI_M4=y
CONFIG_CORTEX_M_SYSTICK=y
CONFIG_UART_CONSOLE=y
CONFIG_SERIAL=y
CONFIG_UART_INTERRUPT_DRIVEN=y
CONFIG_CONSOLE=y
CONFIG_XIP=y
CONFIG_GPIO=n
CONFIG_PINCTRL=y
```

## boards/arm/pinetime_devkit0/Kconfig.board
```kconfig
# PineTime DevKit0 board configuration

# Copyright (c) 2020 Stephane Dorre <stephane.dorre@gmail.com>
# SPDX-License-Identifier: Apache-2.0

config BOARD_PINETIME_DEVKIT0
	bool "PineTime DevKit0"
	depends on SOC_NRF52832_QFAA
```

## boards/arm/pinetime_devkit0/Kconfig.defconfig
```kconfig
# PineTime DevKit0 board configuration

# Copyright (c) 2020 Stephane Dorre <stephane.dorre@gmail.com>
# SPDX-License-Identifier: Apache-2.0

if BOARD_PINETIME_DEVKIT0

config BOARD
	default "pinetime_devkit0"

config BT_CTLR
	default BT

if FLASH

config SPI_NOR_FLASH_LAYOUT_PAGE_SIZE
	default 4096

endif # FLASH

endif # BOARD_PINETIME_DEVKIT0
```

## boards/arm/pinetime_devkit0/dts/bindings/misc/pine64,pinetime-key-out.yaml
```yaml
# Copyright (c) 2021 Casper Meijn <casper@meijn.net>
# SPDX-License-Identifier: Apache-2.0

description: |
  Key out definition for PineTime. This pin needs to be high before the button (key_in) becomes
  available.

compatible: "pine64,pinetime-key-out"

include: base.yaml

properties:
  gpios:
    type: phandle-array
    required: true
```

## boards/arm/pinetime_devkit0/pinetime_devkit0_defconfig
```kconfig
# SPDX-License-Identifier: Apache-2.0


CONFIG_ARM_MPU=y

CONFIG_GPIO=y

CONFIG_SERIAL=y

CONFIG_CONSOLE=y
CONFIG_UART_CONSOLE=y

# use P0.09 and P0.10 as GPIOs
CONFIG_NFCT_PINS_AS_GPIOS=y

# use P0.21 as RST
CONFIG_GPIO_AS_PINRESET=y

CONFIG_PINCTRL=y
```

## boards/arm/pinnacle_100_dvk/Kconfig.board
```kconfig
# Pinnacle(TM) 100 DVK board configuration
#
# Copyright (c) 2020 Laird Connectivity
# SPDX-License-Identifier: Apache-2.0

config  BOARD_PINNACLE_100_DVK
	bool "Pinnacle 100 DVK"
	depends on SOC_NRF52840_QIAA
```

## boards/arm/pinnacle_100_dvk/Kconfig.defconfig
```kconfig
# Pinnacle(TM) 100 DVK board configuration

# Copyright (c) 2019 Laird Connectivity
# SPDX-License-Identifier: Apache-2.0

if BOARD_PINNACLE_100_DVK

config BOARD
	default "pinnacle_100_dvk"

config MODEM_HL7800
	default NETWORKING

config BT_CTLR
	default BT

endif # BOARD_PINNACLE_100_DVK
```

## boards/arm/pinnacle_100_dvk/pinnacle_100_dvk_defconfig
```kconfig
# Copyright (c) 2020-2021 Laird Connectivity

# SPDX-License-Identifier: Apache-2.0

CONFIG_SOC_SERIES_NRF52X=y
CONFIG_SOC_NRF52840_QIAA=y
CONFIG_BOARD_PINNACLE_100_DVK=y

# Enable MPU
CONFIG_ARM_MPU=y

# Enable RTT
CONFIG_USE_SEGGER_RTT=y

# Enable GPIO
CONFIG_GPIO=y

# Enable uart driver
CONFIG_SERIAL=y

# Enable console
CONFIG_CONSOLE=y
CONFIG_UART_CONSOLE=y

# Additional board options
CONFIG_GPIO_AS_PINRESET=y

# 32KHz clock source
CONFIG_CLOCK_CONTROL_NRF_K32SRC_XTAL=y
CONFIG_CLOCK_CONTROL_NRF_K32SRC_150PPM=y

CONFIG_PINCTRL=y
```

## boards/arm/qemu_cortex_a53/Kconfig.board
```kconfig
# Copyright (c) 2019 Carlo Caione <ccaione@baylibre.com>
# SPDX-License-Identifier: Apache-2.0

config BOARD_QEMU_CORTEX_A53
	bool "Cortex-A53 Emulation (QEMU)"
	depends on SOC_QEMU_CORTEX_A53
	select ARM64
	select QEMU_TARGET
```

## boards/arm/qemu_cortex_a53/qemu_cortex_a53_defconfig
```kconfig
CONFIG_SOC_QEMU_CORTEX_A53=y
CONFIG_BOARD_QEMU_CORTEX_A53=y
CONFIG_ARM_ARCH_TIMER=y
CONFIG_XIP=n
CONFIG_QEMU_ICOUNT=n

# Enable UART driver
CONFIG_SERIAL=y

# Enable console
CONFIG_CONSOLE=y
CONFIG_UART_CONSOLE=y

# PSCI is supported
CONFIG_PM_CPU_OPS=y

# Enable serial port
CONFIG_UART_PL011=y
CONFIG_UART_PL011_PORT0=y
CONFIG_UART_INTERRUPT_DRIVEN=y
```

## boards/arm/qemu_cortex_a53/qemu_cortex_a53_xip_defconfig
```kconfig
CONFIG_SOC_QEMU_CORTEX_A53=y
CONFIG_BOARD_QEMU_CORTEX_A53=y
CONFIG_ARM_ARCH_TIMER=y
CONFIG_QEMU_ICOUNT_SHIFT=4

# Enable UART driver
CONFIG_SERIAL=y

# Enable XIP
CONFIG_XIP=y

# Enable console
CONFIG_CONSOLE=y
CONFIG_UART_CONSOLE=y

# Enable serial port
CONFIG_UART_PL011=y
CONFIG_UART_PL011_PORT0=y
CONFIG_UART_INTERRUPT_DRIVEN=y
```
