## boards/arm/nucleo_f401re/Kconfig.defconfig
```kconfig
# NUCLEO-64 F401RE board configuration

# Copyright (c) 2016 Linaro Limited.
# Copyright (c) 2019 Centaur Analytics, Inc
# SPDX-License-Identifier: Apache-2.0

if BOARD_NUCLEO_F401RE

config BOARD
	default "nucleo_f401re"

config SPI_STM32_INTERRUPT
	default y
	depends on SPI

if WATCHDOG

config WWDG_STM32
	default y

config IWDG_STM32
	default n

endif # WATCHDOG

endif # BOARD_NUCLEO_F401RE
```

## boards/arm/nucleo_f401re/Kconfig.nucleo_f401re
```kconfig
# Copyright (c) 2022 Zephyr Project members and individual contributors
# SPDX-License-Identifier: Apache-2.0

config BOARD_NUCLEO_F401RE
	bool
	default y
	select SOC_SERIES_STM32F4X
	select SOC_STM32F401XE
```

## boards/arm/nucleo_f401re/nucleo_f401re_defconfig
```kconfig
CONFIG_ARM=y
CONFIG_BOARD_NUCLEO_F401RE=y
CONFIG_SOC_SERIES_STM32F4X=y
CONFIG_SOC_STM32F401XE=y
# 84MHz system clock
CONFIG_SYS_CLOCK_HW_CYCLES_PER_SEC=84000000
CONFIG_SYS_CLOCK_TICKS_PER_SEC=1000

# enable USART2 - passthrough to STLINK v2 connector
CONFIG_UART_STM32_PORT_1=y
CONFIG_UART_STM32_PORT_1_BAUD_RATE=115200
# enable console on this port by default
CONFIG_UART_CONSOLE_ON_DEV_NAME="UART_1"

# enable pinmux
CONFIG_PINMUX=y

# enable GPIO ports A, B, C
CONFIG_GPIO=y

# clock configuration
CONFIG_CLOCK_CONTROL=y
CONFIG_CLOCK_STM32F4X_SYSCLK_SRC_PLL=y
# use HSE as PLL input
CONFIG_CLOCK_STM32F4X_PLL_SRC_HSE=y
# however, the board does not have an external oscillator, so just use
# the 8MHz clock signal coming from integrated STLink
CONFIG_CLOCK_STM32F4X_HSE_BYPASS=y
# produce 84MHz clock at PLL output
CONFIG_CLOCK_STM32F4X_PLLM_DIV_FACTOR=8
CONFIG_CLOCK_STM32F4X_PLLN_MULTIPLIER=336
CONFIG_CLOCK_STM32F4X_PLLP_DIV_FACTOR=4
CONFIG_CLOCK_STM32F4X_PLLQ_DIV_FACTOR=7
CONFIG_CLOCK_STM32F4X_AHB_PRESCALER=0
CONFIG_CLOCK_STM32F4X_APB1_PRESCALER=2
CONFIG_CLOCK_STM32F4X_APB2_PRESCALER=0
```

## boards/arm/nucleo_f407ve/Kconfig.board
```kconfig
# Kconfig - NUCLEO-64 F411RE board configuration
#
# Copyright (c) 2016 Matthias Boesl
#
# SPDX-License-Identifier: Apache-2.0
#

config BOARD_NUCLEO_F407VE
	bool "NUCLEO-64 F407VE Development Board"
	depends on SOC_STM32F407XE
```

## boards/arm/nucleo_f407ve/Kconfig.defconfig
```kconfig
# Kconfig - NUCLEO-64 F411RE board configuration
#
# Copyright (c) 2016 Matthias Boesl
#
# SPDX-License-Identifier: Apache-2.0
#

if BOARD_NUCLEO_F407VE

config BOARD
	default nucleo_f407ve

endif # BOARD_NUCLEO_F407VE
```

## boards/arm/nucleo_f407ve/nucleo_f407ve_defconfig
```kconfig
CONFIG_ARM=y
CONFIG_BOARD_NUCLEO_F407VE=y
CONFIG_SOC_SERIES_STM32F4X=y
CONFIG_SOC_STM32F407XE=y
# 96MHz system clock (highest value to get a precise USB clock)
CONFIG_SYS_CLOCK_HW_CYCLES_PER_SEC=168000000
CONFIG_SYS_CLOCK_TICKS_PER_SEC=1000

# Enable MPU
CONFIG_STM32_ARM_MPU_ENABLE=y

# enable USART2 - passthrough to STLINK v2 connector
CONFIG_UART_STM32_PORT_2=y

# enable pinmux
CONFIG_PINMUX=y

# enable GPIO ports A, B, C
CONFIG_GPIO=y
CONFIG_GPIO_STM32_PORTA=y
CONFIG_GPIO_STM32_PORTB=y
CONFIG_GPIO_STM32_PORTC=y
CONFIG_GPIO_STM32_PORTD=y
CONFIG_GPIO_STM32_PORTE=y
CONFIG_GPIO_STM32_PORTF=y
CONFIG_GPIO_STM32_PORTG=y

CONFIG_PWM=y
CONFIG_SYS_LOG_PWM_LEVEL=4
# CONFIG_PWM_0 is not set
# CONFIG_PWM_1 is not set
# CONFIG_PWM_2 is not set
# CONFIG_PWM_3 is not set
# CONFIG_PWM_DW is not set
CONFIG_PWM_STM32=y
CONFIG_PWM_STM32_1=y
CONFIG_PWM_STM32_1_DEV_NAME="PWM_1"
CONFIG_PWM_STM32_2=y
CONFIG_PWM_STM32_2_DEV_NAME="PWM_2"

# clock configuration
CONFIG_CLOCK_CONTROL=y

# Clock configuration for Cube Clock control driver
CONFIG_CLOCK_STM32_HSE_CLOCK=8000000
CONFIG_CLOCK_STM32_SYSCLK_SRC_PLL=y
# use HSE as PLL input
CONFIG_CLOCK_STM32_PLL_SRC_HSE=y
# however, the board does have an external oscillator, so just use
# the 8MHz clock signal coming from external oscillator
CONFIG_CLOCK_STM32_HSE_BYPASS=y
# produce 84MHz clock at PLL output
CONFIG_CLOCK_STM32_PLL_M_DIVISOR=8
CONFIG_CLOCK_STM32_PLL_N_MULTIPLIER=168
CONFIG_CLOCK_STM32_PLL_P_DIVISOR=2
CONFIG_CLOCK_STM32_PLL_Q_DIVISOR=7
CONFIG_CLOCK_STM32_AHB_PRESCALER=1
CONFIG_CLOCK_STM32_APB1_PRESCALER=4
CONFIG_CLOCK_STM32_APB2_PRESCALER=2
```

## boards/arm/nucleo_f410rb/Kconfig.board
```kconfig
# STM32F410RB Nucleo board configuration

# Copyright (c) 2020 Hans Unzner
# SPDX-License-Identifier: Apache-2.0

config BOARD_NUCLEO_F410RB
	bool "Nucleo F410RB Development Board"
	depends on SOC_STM32F410RX
```

## boards/arm/nucleo_f410rb/Kconfig.defconfig
```kconfig
# STM32F410RB Nucleo board configuration

# Copyright (c) 2020 Hans Unzner
# SPDX-License-Identifier: Apache-2.0

config SPI_STM32_INTERRUPT
	default y
	depends on SPI
```

## boards/arm/nucleo_f411re/Kconfig.board
```kconfig
# NUCLEO-64 F411RE Development Board

# Copyright (c) 2016 Matthias Boesl
# SPDX-License-Identifier: Apache-2.0

config BOARD_NUCLEO_F411RE
	def_bool "$(BOARD)" = "nucleo_f411re"
	depends on SOC_STM32F411XE
```

## boards/arm/nucleo_f411re/Kconfig.defconfig
```kconfig
# NUCLEO-64 F411RE board configuration

# Copyright (c) 2016 Matthias Boesl
# SPDX-License-Identifier: Apache-2.0

config SPI_STM32_INTERRUPT
	default y
	depends on SPI
```

## boards/arm/nucleo_f411re/Kconfig.nucleo_f411re
```kconfig
# Copyright (c) 2022 Zephyr Project members and individual contributors
# SPDX-License-Identifier: Apache-2.0

config BOARD_NUCLEO_F411RE
	bool
	default y
	select SOC_SERIES_STM32F4X
	select SOC_STM32F411XE
```

## boards/arm/nucleo_f411re/nucleo_f411re_defconfig
```kconfig
CONFIG_ARM=y
CONFIG_BOARD_NUCLEO_F411RE=y
CONFIG_SOC_SERIES_STM32F4X=y
CONFIG_SOC_STM32F411XE=y
# 96MHz system clock (highest value to get a precise USB clock)
CONFIG_SYS_CLOCK_HW_CYCLES_PER_SEC=96000000
CONFIG_SYS_CLOCK_TICKS_PER_SEC=1000

# enable USART2 - passthrough to STLINK v2 connector
CONFIG_UART_STM32_PORT_2=y
CONFIG_UART_STM32_PORT_2_BAUD_RATE=115200
# enable console on this port by default
CONFIG_UART_CONSOLE_ON_DEV_NAME="UART_2"

# enable pinmux
CONFIG_PINMUX=y

# enable GPIO ports A, B, C
CONFIG_GPIO=y

# clock configuration
CONFIG_CLOCK_CONTROL=y
CONFIG_CLOCK_STM32F4X_SYSCLK_SRC_PLL=y
# use HSE as PLL input
CONFIG_CLOCK_STM32F4X_PLL_SRC_HSE=y
# however, the board does not have an external oscillator, so just use
# the 8MHz clock signal coming from integrated STLink
CONFIG_CLOCK_STM32F4X_HSE_BYPASS=y
# produce 96MHz clock at PLL output
CONFIG_CLOCK_STM32F4X_PLLM_DIV_FACTOR=8
CONFIG_CLOCK_STM32F4X_PLLN_MULTIPLIER=384
CONFIG_CLOCK_STM32F4X_PLLP_DIV_FACTOR=4
CONFIG_CLOCK_STM32F4X_PLLQ_DIV_FACTOR=8
CONFIG_CLOCK_STM32F4X_AHB_PRESCALER=0
CONFIG_CLOCK_STM32F4X_APB1_PRESCALER=2
CONFIG_CLOCK_STM32F4X_APB2_PRESCALER=0
```

## boards/arm/nucleo_f412zg/Kconfig.board
```kconfig
# NUCLEO-144 F412ZG Development Board

# Copyright (c) 2017 Florian Vaussard, HEIG-VD
# SPDX-License-Identifier: Apache-2.0

config BOARD_NUCLEO_F412ZG
	def_bool "$(BOARD)" = "nucleo_f412zg"
	depends on SOC_STM32F412ZG
```

## boards/arm/nucleo_f412zg/Kconfig.defconfig
```kconfig
# NUCLEO-144 F412ZG board configuration

# Copyright (c) 2017 Florian Vaussard, HEIG-VD
# SPDX-License-Identifier: Apache-2.0

if NETWORKING

config USB_DEVICE_STACK
	default y

config USB_DEVICE_NETWORK_ECM
	default y

endif # NETWORKING
```

## boards/arm/nucleo_f412zg/nucleo_f412zg_defconfig
```kconfig
# SPDX-License-Identifier: Apache-2.0

CONFIG_SOC_SERIES_STM32F4X=y
CONFIG_SOC_STM32F412ZX=y

# Enable MPU
CONFIG_ARM_MPU=y

# Enable HW stack protection
CONFIG_HW_STACK_PROTECTION=y
CONFIG_SERIAL=y

# Console
CONFIG_CONSOLE=y
CONFIG_UART_CONSOLE=y

# Enable GPIO
CONFIG_GPIO=y

# Enable Clocks
CONFIG_CLOCK_CONTROL=y

# Enable pin controller
CONFIG_PINCTRL=y

# Enable CAN
CONFIG_CAN=y
```

## boards/arm/nucleo_f413zh/Kconfig.board
```kconfig
# NUCLEO-144 F413ZH development board

# Copyright (c) 2017 Florian Vaussard, HEIG-VD
# SPDX-License-Identifier: Apache-2.0

config BOARD_NUCLEO_F413ZH
	def_bool "$(BOARD)" = "nucleo_f413zh"
	depends on SOC_STM32F413XX
```

## boards/arm/nucleo_f413zh/Kconfig.defconfig
```kconfig
# NUCLEO-144 F413ZH board configuration

# Copyright (c) 2017 Florian Vaussard, HEIG-VD
# SPDX-License-Identifier: Apache-2.0

if BOARD_NUCLEO_F413ZH

config BOARD
	default "nucleo_f413zh"

if NETWORKING

config USB
	default y

config USB_DEVICE_STACK
	default y

config USB_DEVICE_NETWORK_ECM
	default y

endif # NETWORKING

endif # BOARD_NUCLEO_F413ZH
```

## boards/arm/nucleo_f413zh/nucleo_f413zh_defconfig
```kconfig
# SPDX-License-Identifier: Apache-2.0

CONFIG_SOC_SERIES_STM32F4X=y
CONFIG_SOC_STM32F413XX=y
# 96MHz system clock (highest value to get a precise USB clock)
CONFIG_SYS_CLOCK_HW_CYCLES_PER_SEC=96000000

# Enable MPU
CONFIG_ARM_MPU=y

# Enable HW stack protection
CONFIG_HW_STACK_PROTECTION=y

CONFIG_SERIAL=y

# console
CONFIG_CONSOLE=y
CONFIG_UART_CONSOLE=y

# enable pinmux
CONFIG_PINMUX=y

# enable GPIO
CONFIG_GPIO=y

# clock configuration
CONFIG_CLOCK_CONTROL=y

# Clock configuration for Cube Clock control driver
CONFIG_CLOCK_STM32_HSE_CLOCK=8000000
CONFIG_CLOCK_STM32_SYSCLK_SRC_PLL=y
# use HSE as PLL input
CONFIG_CLOCK_STM32_PLL_SRC_HSE=y
# however, the board does not have an external oscillator, so just use
# the 8MHz clock signal coming from integrated STLink
CONFIG_CLOCK_STM32_HSE_BYPASS=y
# produce 96MHz clock at PLL output
CONFIG_CLOCK_STM32_PLL_M_DIVISOR=8
CONFIG_CLOCK_STM32_PLL_N_MULTIPLIER=384
CONFIG_CLOCK_STM32_PLL_P_DIVISOR=4
CONFIG_CLOCK_STM32_PLL_Q_DIVISOR=8
CONFIG_CLOCK_STM32_AHB_PRESCALER=1
CONFIG_CLOCK_STM32_APB1_PRESCALER=2
CONFIG_CLOCK_STM32_APB2_PRESCALER=1
```

## boards/arm/nucleo_f429zi/Kconfig.board
```kconfig
# NUCLEO-144 F429ZI development board

# Copyright (c) 2017 Linaro Limited
# SPDX-License-Identifier: Apache-2.0

config BOARD_NUCLEO_F429ZI
	def_bool "$(BOARD)" = "nucleo_f429zi"
	depends on SOC_STM32F429XX
```

## boards/arm/nucleo_f429zi/Kconfig.defconfig
```kconfig
# NUCLEO-144 F429ZI board configuration

# Copyright (c) 2017 Linaro Limited
# SPDX-License-Identifier: Apache-2.0

if NETWORKING

config NET_L2_ETHERNET
	default y

endif # NETWORKING
```

## boards/arm/nucleo_f429zi/Kconfig.nucleo_f429zi
```kconfig
# Copyright (c) 2022 Zephyr Project members and individual contributors
# SPDX-License-Identifier: Apache-2.0

config BOARD_NUCLEO_F429ZI
	bool
	default y
	select SOC_SERIES_STM32F4X
	select SOC_STM32F429XX
```

## boards/arm/nucleo_f446re/Kconfig.board
```kconfig
# Nucleo F446RE development board

# Copyright (c) 2018 Philémon Jaermann
# SPDX-License-Identifier: Apache-2.0

config BOARD_NUCLEO_F446RE
	def_bool "$(BOARD)" = "nucleo_f446re"
	depends on SOC_STM32F446XX
```

## boards/arm/nucleo_f446re/Kconfig.defconfig
```kconfig
# STM32F446RE Nucleo board configuration

# Copyright (c) 2018 Philémon Jaermann
# SPDX-License-Identifier: Apache-2.0

config SPI_STM32_INTERRUPT
	default y
	depends on SPI
```

## boards/arm/nucleo_f446ze/Kconfig.board
```kconfig
# Kconfig - STM32F446ZE Nucleo board configuration
#
# Copyright (c) 2018 Philémon Jaermann
# Copyright (c) 2019 Peter Nimac
#
# SPDX-License-Identifier: Apache-2.0
#

config BOARD_NUCLEO_F446ZE
	bool "Nucleo F446ZE Development Board"
	depends on SOC_STM32F446XX
```

## boards/arm/nucleo_f446ze/Kconfig.defconfig
```kconfig
# STM32F446ZE Nucleo board configuration

# Copyright (c) 2021 Tom Owen
# SPDX-License-Identifier: Apache-2.0

config SPI_STM32_INTERRUPT
	default y
	depends on SPI
```
