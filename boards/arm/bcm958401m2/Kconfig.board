## boards/arm/bcm958401m2/Kconfig.board
```kconfig
# SPDX-License-Identifier: Apache-2.0
#
# Copyright 2020 Broadcom.
#

config BOARD_VALKYRIE_BCM958401M2
	def_bool "$(BOARD)" = "bcm958401m2"
	depends on SOC_BCM58400
```

## boards/arm/bcm958401m2/Kconfig.defconfig
```kconfig
# SPDX-License-Identifier: Apache-2.0
#
# Copyright 2020 Broadcom.

config BOARD
	default "bcm958401m2"
	depends on BOARD_VALKYRIE_BCM958401M2
```

## boards/arm/bcm958401m2/bcm958401m2_defconfig
```kconfig
# SPDX-License-Identifier: Apache-2.0

CONFIG_SOC_SERIES_VALKYRIE=y
CONFIG_SOC_BCM58400=y
CONFIG_BOARD_VALKYRIE_BCM958401M2=y
CONFIG_XIP=n
CONFIG_SERIAL=y
CONFIG_UART_INTERRUPT_DRIVEN=y
CONFIG_CONSOLE=y
CONFIG_UART_CONSOLE=y
CONFIG_CORTEX_M_SYSTICK=y
CONFIG_FLASH_SIZE=0
CONFIG_FLASH_BASE_ADDRESS=0x0
```

## boards/arm/bcm958402m2_a72/Kconfig.board
```kconfig
# Copyright 2020 Broadcom
# SPDX-License-Identifier: Apache-2.0

config BOARD_BCM958402M2_A72
	bool "Broadcom Viper BCM958402M2_A72"
	depends on SOC_BCM58402_A72
```

## boards/arm/bcm958402m2_a72/bcm958402m2_a72_defconfig
```kconfig
# SPDX-License-Identifier: Apache-2.0

# Platform Configuration
CONFIG_SOC_SERIES_VIPER=y
CONFIG_SOC_BCM58402_A72=y
CONFIG_BOARD_BCM958402M2_A72=y
CONFIG_ARM64_VA_BITS_36=y
CONFIG_ARM64_PA_BITS_36=y

# Zephyr Kernel Configuration
CONFIG_XIP=n
CONFIG_FLASH_SIZE=0
CONFIG_FLASH_BASE_ADDRESS=0x0

# Serial Drivers
CONFIG_SERIAL=y
CONFIG_UART_INTERRUPT_DRIVEN=y
CONFIG_UART_NS16550=y

# Enable Console
CONFIG_CONSOLE=y
CONFIG_UART_CONSOLE=y

# Enable PCIe EP
CONFIG_PCIE_ENDPOINT=y
CONFIG_PCIE_EP_BCM_IPROC=y
CONFIG_PCIE_EP_BCM_IPROC_V2=y
```

## boards/arm/bcm958402m2_m7/Kconfig.bcm958402m2_m7
```kconfig
# Copyright (c) 2022 Zephyr Project members and individual contributors
# SPDX-License-Identifier: Apache-2.0

config BOARD_BCM958402M2_M7
	bool
	default y
	select SOC_SERIES_VIPER
	select SOC_BCM58402_M7
```

## boards/arm/bcm958402m2_m7/Kconfig.board
```kconfig
# Copyright 2020 Broadcom
# SPDX-License-Identifier: Apache-2.0

config BOARD_BCM958402M2_M7
	bool "Broadcom Viper BCM958402M2_M7"
	depends on SOC_BCM58402_M7
```

## boards/arm/bcm958402m2_m7/Kconfig.defconfig
```kconfig
# Copyright 2020 Broadcom
# SPDX-License-Identifier: Apache-2.0

config BOARD
	default "bcm958402m2_m7"
	depends on BOARD_BCM958402M2_M7
```

## boards/arm/bcm958402m2_m7/bcm958402m2_m7_defconfig
```kconfig
# SPDX-License-Identifier: Apache-2.0

# Platform Configuration
CONFIG_SOC_SERIES_VIPER=y
CONFIG_SOC_BCM58402_M7=y
CONFIG_BOARD_BCM958402M2_M7=y

# Zephyr Kernel Configuration
CONFIG_XIP=n
CONFIG_FLASH_SIZE=0
CONFIG_FLASH_BASE_ADDRESS=0x0

# Serial Drivers
CONFIG_SERIAL=y
CONFIG_UART_INTERRUPT_DRIVEN=y

# Enable Console
CONFIG_CONSOLE=y
CONFIG_UART_CONSOLE=y

# Enable PCIe EP
CONFIG_PCIE_ENDPOINT=y
CONFIG_PCIE_EP_IPROC=y
CONFIG_PCIE_EP_IPROC_V2=y

# Enable DMA
CONFIG_DMA=y
CONFIG_DMA_64BIT=y

# Enable PL330 driver
CONFIG_DMA_PL330=y

# Enable PAXDMA
CONFIG_DMA_IPROC_PAX_V2=y
```

## boards/arm/beagle_bbai64_r5/Kconfig.board
```kconfig
# Copyright (C) 2023 BeagleBoard.org Foundation
# Copyright (C) 2023 S Prashanth
#
# SPDX-License-Identifier: Apache-2.0

config BOARD_BBAI64_R5
	bool "BeagleBone AI-64"
	depends on SOC_TI_J721E_R5
	select CPU_CORTEX_R5
```

## boards/arm/beagle_bbai64_r5/Kconfig.defconfig
```kconfig
# Copyright (C) 2023 BeagleBoard.org Foundation
# Copyright (C) 2023 S Prashanth
#
# SPDX-License-Identifier: Apache-2.0

if BOARD_BBAI64_R5

config BOARD
	default "beagle_bbai64_r5"

endif # BOARD_BBAI64_R5
```

## boards/arm/beagle_bbai64_r5/beagle_bbai64_r5_defconfig
```kconfig
# Copyright (C) 2023 BeagleBoard.org Foundation
# Copyright (C) 2023 S Prashanth
#
# SPDX-License-Identifier: Apache-2.0

CONFIG_SOC_SERIES_TI_J721E=y
CONFIG_SOC_TI_J721E_R5=y

# enable uart
CONFIG_SERIAL=y

# enable console
CONFIG_CONSOLE=y
CONFIG_UART_CONSOLE=y

CONFIG_BUILD_OUTPUT_UF2=n

CONFIG_XIP=n

CONFIG_OPENAMP_RSC_TABLE=y
```

## boards/arm/beagle_bcf/Kconfig.board
```kconfig
# BeagleConnect Freedom board configuration

# Copyright (c) 2020 Erik Larson
# Copyright (c) 2021 Jason Kridner, BeagleBoard.org Foundation
# SPDX-License-Identifier: Apache-2.0

config BOARD_BEAGLECONNECT_FREEDOM
	bool "BeagleConnect Freedom"
	depends on SOC_CC1352P7

if BOARD_BEAGLECONNECT_FREEDOM

config BOARD_ANTENNA_INIT_PRIO
	int "Board antenna switch initialization priority"
	default 70
	help
	  Set the priority for board init, must be greater than
	  KERNEL_INIT_PRIORITY_DEVICE but smaller than
	  IEEE802154_CC13XX_CC26XX_SUB_GHZ_INIT_PRIO.

endif # BOARD_BEAGLECONNECT_FREEDOM
```

## boards/arm/beagle_bcf/Kconfig.defconfig
```kconfig
# BeagleConnect Freedom board configuration

# Copyright (c) 2020 Erik Larson
# Copyright (c) 2020 Jason Kridner, BeagleBoard.org Foundation
# SPDX-License-Identifier: Apache-2.0

if BOARD_BEAGLECONNECT_FREEDOM

config BOARD
	default "beagleconnect_freedom"

endif # BOARD_BEAGLECONNECT_FREEDOM
```

## boards/arm/beagle_bcf/beagleconnect_freedom_defconfig
```kconfig
#
# Copyright (c) 2020 Erik Larson
# Copyright (c) 2020 Jason Kridner, BeagleBoard.org Foundation
#
# SPDX-License-Identifier: Apache-2.0
#

CONFIG_SOC_SERIES_CC13X2_CC26X2=y
CONFIG_SOC_CC1352R=y
CONFIG_BOARD_BEAGLECONNECT_FREEDOM=y

CONFIG_CC13X2_CC26X2_BOOTLOADER_ENABLE=y
CONFIG_CC13X2_CC26X2_BOOTLOADER_BACKDOOR_ENABLE=y
CONFIG_CC13X2_CC26X2_BOOTLOADER_BACKDOOR_PIN=15

CONFIG_PINMUX=y
CONFIG_GPIO=y
CONFIG_SERIAL=y
CONFIG_I2C=y
CONFIG_SPI=y

CONFIG_CONSOLE=y
CONFIG_UART_CONSOLE=y

CONFIG_LIS2DH_OPER_MODE_LOW_POWER=y

CONFIG_BUILD_OUTPUT_HEX=y

# CONFIG_FLASH=y
# CONFIG_SPI_NOR=y
# CONFIG_FLASH_PAGE_LAYOUT=y
```

## boards/arm/beagle_play_cc1352/Kconfig.defconfig
```kconfig
# BeaglePlay CC1352 board configuration

# Copyright (c) 2022 Jason Kridner, BeagleBoard.org Foundation
# SPDX-License-Identifier: Apache-2.0

if BOARD_BEAGLEPLAY_CC1352

config BOARD
	default "beagleplay_cc1352"

endif # BOARD_BEAGLEPLAY_CC1352
```

## boards/arm/beagle_play_cc1352/beagleplay_cc1352_defconfig
```kconfig
#
# Copyright (c) 2022 Jason Kridner, BeagleBoard.org Foundation
#
# SPDX-License-Identifier: Apache-2.0
#

CONFIG_SOC_SERIES_CC13X2X7_CC26X2X7=y
CONFIG_SOC_CC1352P7=y
CONFIG_BOARD_BEAGLEPLAY_CC1352=y
CONFIG_BUILD_OUTPUT_HEX=y
CONFIG_CC13X2_CC26X2_HAS_CUSTOM_RF_HWATTRS=y
CONFIG_CC13X2_CC26X2_BOOTLOADER_ENABLE=y
CONFIG_CC13X2_CC26X2_BOOTLOADER_BACKDOOR_ENABLE=y
CONFIG_CC13X2_CC26X2_BOOTLOADER_BACKDOOR_PIN=15
CONFIG_ARM_MPU=y
CONFIG_HW_STACK_PROTECTION=y
CONFIG_PINCTRL=y
CONFIG_GPIO=y
CONFIG_SERIAL=y

# Per Seeed recommendation
CONFIG_CC13X2_CC26X2_XOSC_CAPARRAY_DELTA=0xD5
```

## boards/arm/beagleconnect_freedom_cc1352r/Kconfig.board
```kconfig
# TI CC1352R LaunchXL board

# Copyright (c) 2021 Yadnik Bendale
# Copyright (c) 2019 Brett Witherspoon
# SPDX-License-Identifier: Apache-2.0

config BOARD_BEAGLECONNECT_FREEDOM_CC1352R
	bool "BeagleBoard BeagleConnect Freedom"
	depends on SOC_CC1352R
```

## boards/arm/beagleconnect_freedom_cc1352r/Kconfig.defconfig
```kconfig
# BeagleBoard BeagleConnect Freedom

# Copyright (c) 2021 Yadnik Bendale
# Copyright (c) 2019 Brett Witherspoon
# SPDX-License-Identifier: Apache-2.0

if BOARD_BEAGLECONNECT_FREEDOM_CC1352R

config BOARD
	default "beagleconnect_freedom_cc1352r"

endif # BOARD_BEAGLECONNECT_FREEDOM_CC1352R
```

## boards/arm/beagleconnect_freedom_cc1352r/beagleconnect_freedom_cc1352r_defconfig
```kconfig
# Copyright (c) 2019 Brett Witherspoon
#
# SPDX-License-Identifier: Apache-2.0
#

CONFIG_SOC_SERIES_CC13X2_CC26X2=y
CONFIG_SOC_CC1352R=y
CONFIG_BOARD_CC1352R1_LAUNCHXL=y
CONFIG_BUILD_OUTPUT_HEX=y

# enable hardware stack protection 
CONFIG_HW_STACK_PROTECTION=y

# enable bootloader
CONFIG_CC13X2_CC26X2_BOOTLOADER_ENABLE=y
CONFIG_CC13X2_CC26X2_BOOTLOADER_BACKDOOR_ENABLE=y
CONFIG_CC13X2_CC26X2_BOOTLOADER_BACKDOOR_PIN=15

#  enable pinmux
CONFIG_PINMUX=y

# enable GPIO
CONFIG_GPIO=y

# enable uart driver
CONFIG_SERIAL=y

# enable console
CONFIG_CONSOLE=y

# enble uart console
CONFIG_UART_CONSOLE=y
```

## boards/arm/bl5340_dvk/Kconfig
```kconfig
# BL5340-DVK board configuration

# Copyright (c) 2019-2021 Nordic Semiconductor ASA
# Copyright (c) 2021-2023 Laird Connectivity
# SPDX-License-Identifier: Apache-2.0

if BOARD_BL5340_DVK_CPUAPP || BOARD_BL5340_DVK_CPUAPP_NS

config BOARD_ENABLE_DCDC_APP
	bool "Application MCU DCDC converter"
	select SOC_DCDC_NRF53X_APP
	default y

config BOARD_ENABLE_DCDC_NET
	bool "Network MCU DCDC converter"
	select SOC_DCDC_NRF53X_NET
	default y

config BOARD_ENABLE_DCDC_HV
	bool "High Voltage DCDC converter"
	select SOC_DCDC_NRF53X_HV
	default y

config BOARD_ENABLE_CPUNET
	bool "NRF53 Network MCU"
	select SOC_NRF_GPIO_FORWARDER_FOR_NRF5340 if \
		$(dt_compat_enabled,$(DT_COMPAT_NORDIC_NRF_GPIO_FORWARDER))
	help
	  This option enables releasing the Network 'force off' signal, which
	  as a consequence will power up the Network MCU during system boot.
	  Additionally, the option allocates GPIO pins that will be used by UARTE
	  of the Network MCU.
	  Note: GPIO pin allocation can only be configured by the secure Application
	  MCU firmware, so when this option is used with the non-secure version of
	  the board, the application needs to take into consideration, that the
	  secure firmware image must already have configured GPIO allocation for the
	  Network MCU.
	default y if (BT || NRF_802154_SER_HOST)

config DOMAIN_CPUNET_BOARD
	string
	default "bl5340_dvk_cpunet" if BOARD_BL5340_DVK_CPUAPP || BOARD_BL5340_DVK_CPUAPP_NS
	depends on BOARD_ENABLE_CPUNET
	help
	  The board which will be used for CPUNET domain when creating a multi
	  image application where one or more images should be located on
	  another board. For example hci_rpmsg on the bl5340_dvk_cpunet for
	  Bluetooth applications.

endif # BOARD_BL5340_DVK_CPUAPP || BOARD_BL5340_DVK_CPUAPP_NS

if BOARD_BL5340_DVK_CPUNET

config DOMAIN_CPUAPP_BOARD
	string
	default "bl5340_dvk_cpuapp" if BOARD_BL5340_DVK_CPUNET
	help
	  The board which will be used for CPUAPP domain when creating a multi
	  image application where one or more images should be located on
	  another board.

endif # BOARD_BL5340_DVK_CPUNET
```

## boards/arm/bl5340_dvk/Kconfig.bl5340_dvk_cpuapp_ns
```kconfig
# Copyright (c) 2022 Zephyr Project members and individual contributors
# SPDX-License-Identifier: Apache-2.0

config BOARD_BL5340_DVK_CPUAPP_NS
	bool
	default y
	select SOC_SERIES_NRF53X
	select SOC_NRF5340_CPUAPP_QKAA
```

## boards/arm/bl5340_dvk/Kconfig.bl5340_dvk_cpunet
```kconfig
# Copyright (c) 2022 Zephyr Project members and individual contributors
# SPDX-License-Identifier: Apache-2.0

config BOARD_BL5340_DVK_CPUNET
	bool
	default y
	select SOC_SERIES_NRF53X
	select SOC_NRF5340_CPUNET_QKAA
```

## boards/arm/bl5340_dvk/Kconfig.defconfig
```kconfig
# BL5340-DVK board configuration

# Copyright (c) 2019-2020 Nordic Semiconductor ASA
# Copyright (c) 2021-2023 Laird Connectivity
# SPDX-License-Identifier: Apache-2.0

if BOARD_BL5340_DVK_CPUAPP || BOARD_BL5340_DVK_CPUAPP_NS

config BOARD
	default "bl5340_dvk_cpuapp" if BOARD_BL5340_DVK_CPUAPP || BOARD_BL5340_DVK_CPUAPP_NS


config I2C
	default GPIO || DAC

# By default, if we build for a Non-Secure version of the board,
# enable building with TF-M as the Secure Execution Environment.
config BUILD_WITH_TFM
	default y if BOARD_BL5340_DVK_CPUAPP_NS

if BUILD_WITH_TFM

# By default, if we build with TF-M, instruct build system to
# flash the combined TF-M (Secure) & Zephyr (Non Secure) image
config TFM_FLASH_MERGED_BINARY
	bool
	default y

endif # BUILD_WITH_TFM

# Code Partition:
#
# For the secure version of the board the firmware is linked at the beginning
# of the flash, or into the code-partition defined in DT if it is intended to
# be loaded by MCUboot. If the secure firmware is to be combined with a non-
# secure image (TRUSTED_EXECUTION_SECURE=y), the secure FW image shall always
# be restricted to the size of its code partition.
#
# For the non-secure version of the board, the firmware
# must be linked into the code-partition (non-secure) defined in DT, regardless.
# Apply this configuration below by setting the Kconfig symbols used by
# the linker according to the information extracted from DT partitions.

# SRAM Partition:
#
# If the secure firmware is to be combined with a non-secure image
# (TRUSTED_EXECUTION_SECURE=y), the secure FW image SRAM shall always
# be restricted to the secure image SRAM partition (sram-secure-partition).
# Otherwise (if TRUSTED_EXECUTION_SECURE is not set) the whole zephyr,sram
# may be used by the image.
#
# For the non-secure version of the board, the firmware image SRAM is
# always restricted to the allocated non-secure SRAM partition.
#
# Workaround for not being able to have commas in macro arguments
DT_CHOSEN_Z_CODE_PARTITION := zephyr,code-partition
DT_CHOSEN_Z_SRAM_PARTITION := zephyr,sram-secure-partition

if BOARD_BL5340_DVK_CPUAPP && TRUSTED_EXECUTION_SECURE

config FLASH_LOAD_SIZE
	default $(dt_chosen_reg_size_hex,$(DT_CHOSEN_Z_CODE_PARTITION))

config SRAM_SIZE
	default $(dt_chosen_reg_size_int,$(DT_CHOSEN_Z_SRAM_PARTITION),0,K)

endif # BOARD_BL5340_DVK_CPUAPP && TRUSTED_EXECUTION_SECURE

if BOARD_BL5340_DVK_CPUAPP_NS

config FLASH_LOAD_OFFSET
	default $(dt_chosen_reg_addr_hex,$(DT_CHOSEN_Z_CODE_PARTITION))

config FLASH_LOAD_SIZE
	default $(dt_chosen_reg_size_hex,$(DT_CHOSEN_Z_CODE_PARTITION))

endif # BOARD_BL5340_DVK_CPUAPP_NS

endif # BOARD_BL5340_DVK_CPUAPP || BOARD_BL5340_DVK_CPUAPP_NS

config BOARD
	default "bl5340_dvk_cpunet" if BOARD_BL5340_DVK_CPUNET

config IPM_NRFX
	default IPM

config MBOX_NRFX_IPC
	default MBOX

if BOARD_BL5340_DVK_CPUAPP || BOARD_BL5340_DVK_CPUAPP_NS

choice BT_HCI_BUS_TYPE
	default BT_RPMSG if BT
endchoice

config HEAP_MEM_POOL_SIZE
	default 4096 if BT_RPMSG

config BT_HCI_VS
	default y if BT

# 2.8" TFT Touch Shield for Arduino w/Capacitive Touch Screen Module
# is mounted to the DVK using standoffs.
# https://www.buydisplay.com/2-8-inch-tft-touch-shield-for-arduino-w-capacitive-touch-screen-module
if DISPLAY

config INPUT_FT5336_INTERRUPT
	default y


if LVGL

config LV_Z_VDB_SIZE
	default 64

config LV_Z_BITS_PER_PIXEL
	default 16

choice LV_COLOR_DEPTH
	default LV_COLOR_DEPTH_16
endchoice

config LV_COLOR_16_SWAP
	default y

config INPUT
	default y

endif # LVGL

endif # DISPLAY

endif # BOARD_BL5340_DVK_CPUAPP || BOARD_BL5340_DVK_CPUAPP_NS

if BOARD_BL5340_DVK_CPUNET

# BT_CTLR depends on BT. When BT is enabled we should default to also
# enabling the controller.
config BT_CTLR
	default y if BT

config BT_ECC
	default y if BT

endif # BOARD_BL5340_DVK_CPUNET
```

## boards/arm/bl5340_dvk/bl5340_dvk_cpuapp_defconfig
```kconfig
# SPDX-License-Identifier: Apache-2.0

CONFIG_SOC_SERIES_NRF53X=y
CONFIG_SOC_NRF5340_CPUAPP_QKAA=y
CONFIG_BOARD_BL5340_DVK_CPUAPP=y

# Enable MPU
CONFIG_ARM_MPU=y

# Enable hardware stack protection
CONFIG_HW_STACK_PROTECTION=y

# Enable TrustZone-M
CONFIG_ARM_TRUSTZONE_M=y

# Enable GPIO
CONFIG_GPIO=y

# Enable uart driver
CONFIG_SERIAL=y

# Enable console
CONFIG_CONSOLE=y
CONFIG_UART_CONSOLE=y

# Setup clocks
CONFIG_CLOCK_CONTROL_NRF_K32SRC_250PPM=y
CONFIG_SOC_LFXO_CAP_INT_7PF=y
CONFIG_SOC_HFXO_CAP_INTERNAL=y
CONFIG_SOC_HFXO_CAP_INT_VALUE_X2=27

CONFIG_PINCTRL=y
```
