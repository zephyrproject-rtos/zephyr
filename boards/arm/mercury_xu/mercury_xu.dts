/*
 * Copyright (c) 2020, Antmicro
 *
 * SPDX-License-Identifier: Apache-2.0
 */

/dts-v1/;
#include <arm/xilinx/zynqmp_rpu.dtsi>

/ {
	model = "Mercury XU";
	compatible = "xlnx,zynqmp";

	chosen {
		zephyr,console = &uart0;
		zephyr,sram = &sram0;
		zephyr,flash = &flash0;
	};
};

&uart0 {
	status = "okay";
	current-speed = <115200>;
	clock-frequency = <99999901>;
};

&ttc0 {
	status = "okay";
	clock-frequency = <5000000>;
};
