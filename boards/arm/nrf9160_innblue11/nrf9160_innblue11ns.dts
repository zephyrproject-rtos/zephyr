/*
 * Copyright (c) 2018 innblue
 */

/dts-v1/;
#include <nordic/nrf9160ns_sica.dtsi>
#include "nrf9160_innblue11_common.dts"

/ {
	chosen {
		zephyr,flash = &flash0;
		zephyr,sram = &sram0_ns;
		zephyr,code-partition = &slot0_ns_partition;
	};
};
