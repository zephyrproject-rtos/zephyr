/*
 * Copyright (c) 2018 innblue
 */

/dts-v1/;
#include <nordic/nrf9160_sica.dtsi>
#include "nrf9160_innblue11_common.dts"

/ {
	chosen {
		zephyr,sram = &sram0;
		zephyr,flash = &flash0;
		zephyr,code-partition = &slot0_partition;
	};
};
