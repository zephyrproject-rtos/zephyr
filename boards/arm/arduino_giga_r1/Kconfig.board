## boards/arm/arduino_giga_r1/Kconfig.board
```kconfig
# Copyright 2023 Google LLC
# SPDX-License-Identifier: Apache-2.0

config BOARD_ARDUINO_GIGA_R1_M7
	bool "Arduino GIGA R1 WiFi Board (M7)"
	depends on SOC_STM32H747XX
	select CPU_CORTEX_M7

config BOARD_ARDUINO_GIGA_R1_M4
	bool "Arduino GIGA R1 WiFi Board (M4)"
	depends on SOC_STM32H747XX
	select CPU_CORTEX_M4
```

## boards/arm/arduino_giga_r1/Kconfig.defconfig
```kconfig
# Copyright 2023 Google LLC
# SPDX-License-Identifier: Apache-2.0

if BOARD_ARDUINO_GIGA_R1_M7 || BOARD_ARDUINO_GIGA_R1_M4

config BOARD
	default "arduino_giga_r1_m7" if BOARD_ARDUINO_GIGA_R1_M7
	default "arduino_giga_r1_m4" if BOARD_ARDUINO_GIGA_R1_M4

config STM32H7_DUAL_CORE
	default y

if BT

choice CYW43XXX_PART
	default CYW4343W
endchoice

choice CYW4343W_MODULE
	default CYW4343W_MURATA_1DX
endchoice

endif # BT

endif # BOARD_ARDUINO_GIGA_R1_M7 || BOARD_ARDUINO_GIGA_R1_M4
```

## boards/arm/arduino_giga_r1/arduino_giga_r1_m4_defconfig
```kconfig
# Copyright 2023 Google LLC
# SPDX-License-Identifier: Apache-2.0

CONFIG_SOC_SERIES_STM32H7X=y
CONFIG_SOC_STM32H747XX=y

# Board config should be specified since there are 2 possible targets
CONFIG_BOARD_ARDUINO_GIGA_R1_M4=y

# Enable GPIO
CONFIG_GPIO=y

# Clock configuration
CONFIG_CLOCK_CONTROL=y

# Enable MPU
CONFIG_ARM_MPU=y

# Enable HW stack protection
CONFIG_HW_STACK_PROTECTION=y

# Enable uart driver
CONFIG_SERIAL=y

# Console
CONFIG_CONSOLE=y
CONFIG_UART_CONSOLE=y

# Enable pin controller
CONFIG_PINCTRL=y
```

## boards/arm/arduino_mkrzero/Kconfig.arduino_mkrzero
```kconfig
# Copyright (c) 2022 Zephyr Project members and individual contributors
# SPDX-License-Identifier: Apache-2.0

config BOARD_ARDUINO_MKRZERO
	bool
	default y
	select SOC_SERIES_SAMD21
	select SOC_PART_NUMBER_SAMD21G18A
```

## boards/arm/arduino_mkrzero/Kconfig.board
```kconfig
# Arduino MKR Zero Board configuration

# Copyright (c) 2022 TOKITA Hiroshi <tokita.hiroshi@fujitsu.com>
# SPDX-License-Identifier: Apache-2.0

config BOARD_ARDUINO_MKRZERO
	bool "Arduino MKR Zero"
	depends on SOC_PART_NUMBER_SAMD21G18A
```

## boards/arm/arduino_mkrzero/Kconfig.defconfig
```kconfig
# Arduino MKR Zero board configuration

# Copyright (c) 2022 TOKITA Hiroshi <tokita.hiroshi@fujitsu.com>
# SPDX-License-Identifier: Apache-2.0

config BOARD
	default "arduino_mkrzero"
	depends on BOARD_ARDUINO_MKRZERO

if DISK_DRIVERS

config DISK_DRIVER_SDMMC
	default y

config SPI
	default y

config GPIO
	default y

endif # DISK_DRIVERS
```

## boards/arm/arduino_mkrzero/arduino_mkrzero_defconfig
```kconfig
# SPDX-License-Identifier: Apache-2.0

CONFIG_SOC_SERIES_SAMD21=y
CONFIG_SOC_PART_NUMBER_SAMD21G18A=y
CONFIG_BOARD_ARDUINO_MKRZERO=y
CONFIG_SOC_ATMEL_SAMD_XOSC32K=y
CONFIG_SOC_ATMEL_SAMD_XOSC32K_AS_MAIN=y
CONFIG_CONSOLE=y
CONFIG_UART_CONSOLE=y
CONFIG_UART_INTERRUPT_DRIVEN=y
CONFIG_SERIAL=y
CONFIG_BOOTLOADER_BOSSA=y
CONFIG_BOOTLOADER_BOSSA_ARDUINO=y
CONFIG_GPIO=y
```

## boards/arm/arduino_nano_33_ble/Kconfig.board
```kconfig
# Copyright (c) 2020 Jefferson Lee.
# SPDX-License-Identifier: Apache-2.0

config BOARD_ARDUINO_NANO_33_BLE
	bool "Arduino Nano 33 BLE board"
	depends on SOC_NRF52840_QIAA

config BOARD_ARDUINO_NANO_33_BLE_SENSE
	bool "Arduino Nano 33 BLE Sense board"
	depends on SOC_NRF52840_QIAA
```

## boards/arm/arduino_nano_33_ble/Kconfig.defconfig
```kconfig
# Copyright (c) 2020 Jefferson Lee.
# SPDX-License-Identifier: Apache-2.0

config BT_CTLR
	default BT

config REGULATOR
	default y if SENSOR
```

## boards/arm/arduino_nano_33_ble/arduino_nano_33_ble_defconfig
```kconfig
# SPDX-License-Identifier: Apache-2.0

CONFIG_SOC_SERIES_NRF52X=y
CONFIG_SOC_NRF52840_QIAA=y
CONFIG_BOARD_ARDUINO_NANO_33_BLE=y

# Enable MPU
CONFIG_ARM_MPU=y
CONFIG_HW_STACK_PROTECTION=y

# enable peripherals
CONFIG_GPIO=y
CONFIG_SERIAL=y
CONFIG_CONSOLE=y

# enable flashing and linker options
CONFIG_USE_DT_CODE_PARTITION=y

# additional board options
CONFIG_GPIO_AS_PINRESET=y
```

## boards/arm/arduino_nano_33_iot/Kconfig.arduino_nano_33_iot
```kconfig
# Copyright (c) 2022 Zephyr Project members and individual contributors
# SPDX-License-Identifier: Apache-2.0

config BOARD_ARDUINO_NANO_33_IOT
	bool
	default y
	select SOC_SERIES_SAMD21
	select SOC_PART_NUMBER_SAMD21G18A
```

## boards/arm/arduino_nano_33_iot/arduino_nano_33_iot_defconfig
```kconfig
# SPDX-License-Identifier: Apache-2.0

CONFIG_SOC_SERIES_SAMD21=y
CONFIG_SOC_PART_NUMBER_SAMD21G18A=y
CONFIG_BOARD_ARDUINO_NANO_33_IOT=y
CONFIG_SOC_ATMEL_SAMD_OSC8M_AS_MAIN=y
CONFIG_CONSOLE=y
CONFIG_UART_CONSOLE=y
CONFIG_UART_INTERRUPT_DRIVEN=y
CONFIG_SERIAL=y
CONFIG_BOOTLOADER_BOSSA=y
CONFIG_BOOTLOADER_BOSSA_ARDUINO=y
```

## boards/arm/arduino_nicla_sense_me/Kconfig.arduino_nicla_sense_me
```kconfig
# Copyright (c) 2022 Zephyr Project members and individual contributors
# SPDX-License-Identifier: Apache-2.0

config BOARD_ARDUINO_NICLA_SENSE_ME
	bool
	default y
	select SOC_SERIES_NRF52X
	select SOC_NRF52832_QFAA
```

## boards/arm/arduino_nicla_sense_me/Kconfig.board
```kconfig
# Arduino Nicla Sense ME board configuration

# Copyright (c) 2022 Benjamin Björnsson <benjamin.bjornsson@gmail.com>.
# SPDX-License-Identifier: Apache-2.0

config BOARD_ARDUINO_NICLA_SENSE_ME
	bool "Arduino Nicla Sense ME"
	depends on SOC_NRF52832_QFAA
```

## boards/arm/arduino_nicla_sense_me/Kconfig.defconfig
```kconfig
# Arduino Nicla Sense ME board configuration

# Copyright (c) 2022 Benjamin Björnsson <benjamin.bjornsson@gmail.com>.
# SPDX-License-Identifier: Apache-2.0

config BT_CTLR
	default BT
```

## boards/arm/arduino_nicla_sense_me/arduino_nicla_sense_me_defconfig
```kconfig
# SPDX-License-Identifier: Apache-2.0

CONFIG_SOC_SERIES_NRF52X=y
CONFIG_SOC_NRF52832_QFAA=y
CONFIG_BOARD_ARDUINO_NICLA_SENSE_ME=y

# Enable MPU
CONFIG_ARM_MPU=y
CONFIG_HW_STACK_PROTECTION=y

# enable GPIO
CONFIG_GPIO=y

# enable uart driver
CONFIG_SERIAL=y

# enable console
CONFIG_CONSOLE=y
CONFIG_UART_CONSOLE=y

# additional board options
CONFIG_GPIO_AS_PINRESET=y

# enable pin controller
CONFIG_PINCTRL=y
```

## boards/arm/arduino_opta_m4/Kconfig.defconfig
```kconfig
# Copyright (c) 2023 Felipe Neves
# SPDX-License-Identifier: Apache-2.0

if BOARD_ARDUINO_OPTA_M4

config BOARD
	default "arduino_opta_m4"

endif # BOARD_ARDUINO_OPTA_M4
```

## boards/arm/arduino_portenta_h7/Kconfig.board
```kconfig
# Arduino Portenta H7 board configuration

# Copyright (c) 2022 Benjamin Björnsson <benjamin.bjornsson@gmail.com>.
# SPDX-License-Identifier: Apache-2.0

config BOARD_ARDUINO_PORTENTA_H7_M7
	bool "Arduino Portenta H7 Board"
	depends on SOC_STM32H747XX
	select CPU_CORTEX_M7

config BOARD_ARDUINO_PORTENTA_H7_M4
	bool "Arduino Portenta H7 Board"
	depends on SOC_STM32H747XX
	select CPU_CORTEX_M4
```

## boards/arm/arduino_portenta_h7/Kconfig.defconfig
```kconfig
# Arduino Portenta H7 board configuration

# Copyright (c) 2022 Benjamin Björnsson <benjamin.bjornsson@gmail.com>.
# SPDX-License-Identifier: Apache-2.0

if BOARD_ARDUINO_PORTENTA_H7_M7 || BOARD_ARDUINO_PORTENTA_H7_M4

config BOARD
	default "arduino_portenta_h7_m7" if BOARD_ARDUINO_PORTENTA_H7_M7
	default "arduino_portenta_h7_m4" if BOARD_ARDUINO_PORTENTA_H7_M4

config STM32H7_DUAL_CORE
	default y

endif # BOARD_ARDUINO_PORTENTA_H7_M7 || BOARD_ARDUINO_PORTENTA_H7_M4
```

## boards/arm/arduino_portenta_h7/arduino_portenta_h7_m4_defconfig
```kconfig
# Copyright (c) 2022 Benjamin Björnsson <benjamin.bjornsson@gmail.com>.
# SPDX-License-Identifier: Apache-2.0

CONFIG_SOC_SERIES_STM32H7X=y
CONFIG_SOC_STM32H747XX=y

# Board config should be specified since there are 2 possible targets
CONFIG_BOARD_ARDUINO_PORTENTA_H7_M4=y

# Enable GPIO
CONFIG_GPIO=y

# Clock configuration
CONFIG_CLOCK_CONTROL=y

# Enable MPU
CONFIG_ARM_MPU=y

# Enable HW stack protection
CONFIG_HW_STACK_PROTECTION=y

# Enable pin controller
CONFIG_PINCTRL=y

# Enable uart driver
# CONFIG_SERIAL=y

# By default CONSOLE is assigned to m7
# CONFIG_CONSOLE=y
# CONFIG_UART_CONSOLE=y
```

## boards/arm/arduino_uno_r4/arduino_uno_r4_minima_defconfig
```kconfig
# Copyright (c) 2023 TOKITA Hiroshi <tokita.hiroshi@fujitsu.com>
# SPDX-License-Identifier: Apache-2.0

CONFIG_SOC_SERIES_RA4M1=y
CONFIG_SOC_R7FA4M1AB3CFM=y

CONFIG_SYS_CLOCK_HW_CYCLES_PER_SEC=48000000

CONFIG_BUILD_OUTPUT_HEX=y

# enable uart driver
CONFIG_SERIAL=y
CONFIG_UART_INTERRUPT_DRIVEN=y

# enable console
CONFIG_CONSOLE=y
CONFIG_UART_CONSOLE=y

# enable GPIO
CONFIG_GPIO=y

CONFIG_PINCTRL=y

CONFIG_CLOCK_CONTROL=y

CONFIG_USE_DT_CODE_PARTITION=y
```

## boards/arm/arduino_zero/Kconfig.defconfig
```kconfig
# Kconfig - Arduino Zero board configuration
#
# Copyright (c) 2017 Google LLC.
# SPDX-License-Identifier: Apache-2.0

if BOARD_ARDUINO_ZERO

config BOARD
	default "arduino_zero"

endif # BOARD_ARDUINO_ZERO
```

## boards/arm/arduino_zero/arduino_zero_defconfig
```kconfig
# SPDX-License-Identifier: Apache-2.0

CONFIG_SOC_SERIES_SAMD21=y
CONFIG_SOC_PART_NUMBER_SAMD21G18A=y
CONFIG_BOARD_ARDUINO_ZERO=y
CONFIG_CORTEX_M_SYSTICK=y
CONFIG_CONSOLE=y
CONFIG_UART_CONSOLE=y
CONFIG_UART_INTERRUPT_DRIVEN=y
CONFIG_SERIAL=y
CONFIG_PINMUX=y
CONFIG_SOC_ATMEL_SAMD_XOSC32K=y
CONFIG_SOC_ATMEL_SAMD_XOSC32K_AS_MAIN=y
```

## boards/arm/arty/Kconfig
```kconfig
# Digilent Arty board configuration

# Copyright (c) 2020 Henrik Brix Andersen <henrik@brixandersen.dk>
# SPDX-License-Identifier: Apache-2.0

config BOARD_INIT_PRIORITY
	int "Board initialization priority"
	default 50
	depends on BOARD_ARTY_A7_ARM_DESIGNSTART_M1 || BOARD_ARTY_A7_ARM_DESIGNSTART_M3
	depends on "$(dt_nodelabel_enabled,daplink_qspi_mux)"
	help
	  Board initialization priority. The board initialization must take
	  place after the GPIO driver is initialized.
```

## boards/arm/arty/Kconfig.arty_a7_arm_designstart_m3
```kconfig
# Copyright (c) 2022 Zephyr Project members and individual contributors
# SPDX-License-Identifier: Apache-2.0

config BOARD_ARTY_A7_ARM_DESIGNSTART_M3
	bool
	default y
	select SOC_SERIES_ARM_DESIGNSTART
	select SOC_ARM_DESIGNSTART_FPGA_CORTEX_M3
```
