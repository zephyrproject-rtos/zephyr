## boards/arm/nrf52_ruuvi/Kconfig.board
```kconfig
# Kconfig - nRF52 PCA10040 board configuration
#
# Copyright (c) 2016 Nordic Semiconductor ASA
#
# SPDX-License-Identifier: Apache-2.0

config  BOARD_NRF52_RUUVI
	bool "nRF52 ruuvi"
	select HAS_DTS_GPIO
	depends on SOC_NRF52832_QFAA
```

## boards/arm/nrf52_sparkfun/Kconfig.board
```kconfig
# Sparkfun nRF52832 breakout board configuration

# Copyright (c) 2017 Shawn Nock <shawn@monadnock.ca>
# Copyright (c) 2016 Linaro Limited.
# SPDX-License-Identifier: Apache-2.0

config BOARD_NRF52_SPARKFUN
	bool "nRF52 SPARKFUN"
	depends on SOC_NRF52832_QFAA
```

## boards/arm/nrf52_sparkfun/Kconfig.defconfig
```kconfig
# Sparkfun nRF52832 breakout  board configuration

# Copyright (c) 2017 Shawn Nock <shawn@monadnock.ca>
# Copyright (c) 2016 Nordic Semiconductor ASA
# SPDX-License-Identifier: Apache-2.0

config BT_CTLR
	default BT
```

## boards/arm/nrf52_sparkfun/nrf52_sparkfun_defconfig
```kconfig
# SPDX-License-Identifier: Apache-2.0


# Enable MPU
CONFIG_ARM_MPU=y

# enable GPIO
CONFIG_GPIO=y

# enable uart driver
CONFIG_SERIAL=y

# enable console
CONFIG_CONSOLE=y
CONFIG_UART_CONSOLE=y

# Enable P0_21 as RST
CONFIG_GPIO_AS_PINRESET=y

CONFIG_PINCTRL=y
```

## boards/arm/nrf52_vbluno52/Kconfig
```kconfig
# Kconfig - nRF52 VBLUno52 board configuration
#
# Copyright (c) 2017 VNG IoT Lab
#
# SPDX-License-Identifier: Apache-2.0

if BOARD_NRF52_VBLUNO52

config  GPIO_AS_PINRESET
	bool "GPIO as pin reset (reset button)"
	default y

endif # BOARD_NRF52_VBLUNO52
```

## boards/arm/nrf52_vbluno52/Kconfig.board
```kconfig
# nRF52 VBLUno52 board configuration
# Copyright (c) 2017 VNG IoT Lab

# SPDX-License-Identifier: Apache-2.0

config BOARD_NRF52_VBLUNO52
	bool "nRF52 VBLUno52"
	depends on SOC_NRF52832_QFAA
```

## boards/arm/nrf52_vbluno52/Kconfig.defconfig
```kconfig
# nRF52 VBLUno52 board configuration

# Copyright (c) 2017 VNG IoT Lab
# SPDX-License-Identifier: Apache-2.0

config BT_CTLR
	default BT
```

## boards/arm/nrf52_vbluno52/nrf52_vbluno52_defconfig
```kconfig
# SPDX-License-Identifier: Apache-2.0

CONFIG_SOC_SERIES_NRF52X=y
CONFIG_SOC_NRF52832_QFAA=y
CONFIG_BOARD_NRF52_VBLUNO52=y

# Enable MPU
CONFIG_ARM_MPU=y

# enable GPIO
CONFIG_GPIO=y

# enable uart driver
CONFIG_SERIAL=y

# enable console
CONFIG_CONSOLE=y
CONFIG_UART_CONSOLE=y

# additional board options
CONFIG_GPIO_AS_PINRESET=y

CONFIG_PINCTRL=y
```

## boards/arm/nrf52dk_nrf52805/Kconfig
```kconfig
# nRF52 DK nRF52805 board configuration

# Copyright (c) 2020 Nordic Semiconductor ASA
# SPDX-License-Identifier: Apache-2.0

config BOARD_ENABLE_DCDC
	bool "DCDC mode"
	select SOC_DCDC_NRF52X
	default y
	depends on BOARD_NRF52DK_NRF52805
```

## boards/arm/nrf52dk_nrf52805/Kconfig.defconfig
```kconfig
# nRF52 DK nRF52805 board configuration

# Copyright (c) 2020 Nordic Semiconductor ASA
# SPDX-License-Identifier: Apache-2.0

if BOARD_NRF52DK_NRF52805

config BOARD
	default "nrf52dk_nrf52805"

config BT_CTLR
	default BT

endif # BOARD_NRF52DK_NRF52805
```

## boards/arm/nrf52dk_nrf52805/nrf52dk_nrf52805_defconfig
```kconfig
# SPDX-License-Identifier: Apache-2.0

CONFIG_SOC_SERIES_NRF52X=y
CONFIG_SOC_NRF52805_CAAA=y
CONFIG_BOARD_NRF52DK_NRF52805=y

# Enable MPU
CONFIG_ARM_MPU=y

# Enable GPIO
CONFIG_GPIO=y

# Enable UART driver
CONFIG_SERIAL=y

# Enable console
CONFIG_CONSOLE=y
CONFIG_UART_CONSOLE=y

# Additional board options
CONFIG_GPIO_AS_PINRESET=y

# Bluetooth not enabled by default on nRF52805 due to RAM limitations when
# running the default set of kernel tests.
```

## boards/arm/nrf52dk_nrf52810/Kconfig.board
```kconfig
# nRF52 DK nRF52810 board configuration

# Copyright (c) 2018 Nordic Semiconductor ASA
# SPDX-License-Identifier: Apache-2.0

config BOARD_NRF52DK_NRF52810
	bool "nRF52 DK NRF52810"
	depends on SOC_NRF52810_QFAA
```

## boards/arm/nrf52dk_nrf52810/Kconfig.defconfig
```kconfig
# nRF52 DK nRF52810 board configuration

# Copyright (c) 2018 Nordic Semiconductor ASA
# SPDX-License-Identifier: Apache-2.0

if BOARD_NRF52DK_NRF52810

config BOARD
	default "nrf52dk_nrf52810"

endif # BOARD_NRF52DK_NRF52810
```

## boards/arm/nrf52dk_nrf52810/nrf52dk_nrf52810_defconfig
```kconfig
# SPDX-License-Identifier: Apache-2.0

CONFIG_SOC_SERIES_NRF52X=y
CONFIG_SOC_NRF52810_QFAA=y
CONFIG_BOARD_NRF52DK_NRF52810=y

# Enable MPU
CONFIG_ARM_MPU=y

# Enable hardware stack protection
CONFIG_HW_STACK_PROTECTION=y

# enable GPIO
CONFIG_GPIO=y

# Enable UARTE
CONFIG_SERIAL=y

# enable console
CONFIG_CONSOLE=y
CONFIG_UART_CONSOLE=y

# additional board options
CONFIG_GPIO_AS_PINRESET=y

# Bluetooth not enabled by default on nRF52810 due to RAM limitations when
# running the default set of kernel tests.
# Enable this on your prj.conf to include Bluetooth support

CONFIG_PINCTRL=y
```

## boards/arm/nrf52dk_nrf52832/Kconfig.defconfig
```kconfig
# nRF52 DK NRF52832 board configuration

# Copyright (c) 2016 Nordic Semiconductor ASA
# SPDX-License-Identifier: Apache-2.0

if BOARD_NRF52DK_NRF52832

config BOARD
	default "nrf52dk_nrf52832"

config BT_CTLR
	default BT

endif # BOARD_NRF52DK_NRF52832
```

## boards/arm/nrf5340_audio_dk_nrf5340/Kconfig.board
```kconfig
# nRF5340 Audio DK board configuration

# Copyright (c) 2019 Nordic Semiconductor ASA
# SPDX-License-Identifier: Apache-2.0

if SOC_NRF5340_CPUAPP_QKAA

config BOARD_NRF5340_AUDIO_DK_NRF5340_CPUAPP
	bool "nrf5340 Audio DK nRF5340 Application MCU"

config BOARD_NRF5340_AUDIO_DK_NRF5340_CPUAPP_NS
	bool "nrf5340 Audio DK nRF5340 Application MCU non-secure"

endif # SOC_NRF5340_CPUAPP_QKAA

config BOARD_NRF5340_AUDIO_DK_NRF5340_CPUNET
	bool "nrf5340 Audio DK NRF5340 Network MCU"
	depends on SOC_NRF5340_CPUNET_QKAA
```

## boards/arm/nrf5340_audio_dk_nrf5340/dts/bindings/nrf5340_audio_dk.yaml
```yaml
# Copyright (c) 2022 Nordic Semiconductor ASA
# SPDX-License-Identifier: Apache-2.0

description: |
  This file contains specific pin mappings for the nRF5340 Audio DK.

compatible: "nrf5340_audio_dk"

include: base.yaml

properties:
    pmic-iset-out-gpios:
      type: phandle-array
      required: true
      description: PMIC ISET
```

## boards/arm/nrf5340_audio_dk_nrf5340/nrf5340_audio_dk_nrf5340_cpuapp_defconfig
```kconfig
# Copyright (c) 2020 Nordic Semiconductor ASA
# SPDX-License-Identifier: Apache-2.0

CONFIG_SOC_SERIES_NRF53X=y
CONFIG_SOC_NRF5340_CPUAPP_QKAA=y
CONFIG_BOARD_NRF5340_AUDIO_DK_NRF5340_CPUAPP=y

CONFIG_BOARD_ENABLE_DCDC_APP=y
CONFIG_BOARD_ENABLE_DCDC_NET=y
CONFIG_BOARD_ENABLE_CPUNET=y

CONFIG_ARM_MPU=y

CONFIG_HW_STACK_PROTECTION=y

CONFIG_ARM_TRUSTZONE_M=y

CONFIG_PINCTRL=y
CONFIG_GPIO=y
CONFIG_NFCT_PINS_AS_GPIOS=y

CONFIG_BT=y

# Custom solution used instead of Zephyr I2S driver
CONFIG_I2S=n
CONFIG_NRFX_I2S=y

CONFIG_I2C=y
CONFIG_SPI=y
CONFIG_ADC=y

# Enable NRFX_CLOCK for ACLK control
CONFIG_NRFX_CLOCK=y

# Minimal libc is not used. Note that this will impact error codes
CONFIG_NEWLIB_LIBC=y

# Audio codec LC3 related defines
# FPU_SHARING enables preservation of the hardware floating point registers
# across context switches to allow multiple threads to perform concurrent
# floating point operations.
CONFIG_FPU=y
CONFIG_FPU_SHARING=y

# Enable SDHC interface
CONFIG_DISK_DRIVERS=y
CONFIG_DISK_DRIVER_SDMMC=y

# Allocate RAM buffer for transferring chunck of data from Flash to SPI
CONFIG_SPI_NRFX_RAM_BUFFER_SIZE=8

# Config the file system
CONFIG_FILE_SYSTEM=y
CONFIG_FAT_FILESYSTEM_ELM=y
CONFIG_FS_FATFS_LFN=y
# Using stack for LFN work queue
CONFIG_FS_FATFS_LFN_MODE_STACK=y
# exFAT enabled to support longer file names and higher transfer speed
CONFIG_FS_FATFS_EXFAT=y
CONFIG_FS_FATFS_MAX_LFN=255
```

## boards/arm/nrf5340_audio_dk_nrf5340/nrf5340_audio_dk_nrf5340_cpunet_defconfig
```kconfig
# SPDX-License-Identifier: Apache-2.0

CONFIG_SOC_SERIES_NRF53X=y
CONFIG_SOC_NRF5340_CPUNET_QKAA=y
CONFIG_BOARD_NRF5340_AUDIO_DK_NRF5340_CPUNET=y

# Enable MPU
CONFIG_ARM_MPU=y

# Enable hardware stack protection
CONFIG_HW_STACK_PROTECTION=y

# Enable PINCTRL
CONFIG_PINCTRL=y

# enable GPIO
CONFIG_GPIO=y

# IPM
# HCI_RPMSG
CONFIG_RPMSG_SERVICE=y
CONFIG_RPMSG_SERVICE_MODE_REMOTE=y

CONFIG_HEAP_MEM_POOL_SIZE=8192

CONFIG_BT=y
```

## boards/arm/nrf5340_dk_nrf5340/Kconfig
```kconfig
# nRF5340 DK NRF5340 board configuration

# Copyright (c) 2019 Nordic Semiconductor ASA
# SPDX-License-Identifier: Apache-2.0

if BOARD_NRF5340_DK_NRF5340_CPUAPP || BOARD_NRF5340_DK_NRF5340_CPUAPPNS

config BOARD_ENABLE_DCDC_APP
	bool "Enable Application MCU DCDC converter"
	select SOC_DCDC_NRF53X_APP
	default y

config BOARD_ENABLE_DCDC_NET
	bool "Enable Network MCU DCDC converter"
	select SOC_DCDC_NRF53X_NET
	default y

config BOARD_ENABLE_DCDC_HV
	bool "Enable High Voltage DCDC converter"
	select SOC_DCDC_NRF53X_HV
	default y

choice BT_HCI_BUS_TYPE
	default BT_RPMSG if BT
endchoice

config HEAP_MEM_POOL_SIZE
	default 4096 if BT_RPMSG

config BT_HAS_HCI_VS
	default y if BT

endif # BOARD_NRF5340_DK_NRF5340_CPUAPP || BOARD_NRF5340_DK_NRF5340_CPUAPPNS

if BOARD_NRF5340_DK_NRF5340_CPUNET

# BT_CTLR depends on BT. When BT is enabled we should default to also
# enabling the controller.
config BT_CTLR
	default y if BT

config BT_ECC
	default y if BT

endif # BOARD_NRF5340_DK_NRF5340_CPUNET
```

## boards/arm/nrf5340_dk_nrf5340/Kconfig.board
```kconfig
# nRF5340 DK NRF5340 board configuration

# Copyright (c) 2019 Nordic Semiconductor ASA
# SPDX-License-Identifier: Apache-2.0

if SOC_NRF5340_CPUAPP_QKAA

# nRF5340 DK nRF5340 Application MCU
config BOARD_NRF5340_DK_NRF5340_CPUAPP
	def_bool "$(BOARD)" = "nrf5340_dk_nrf5340_cpuapp"

# nRF5340 DK nRF5340 Application MCU non-secure
config BOARD_NRF5340_DK_NRF5340_CPUAPPNS
	def_bool "$(BOARD)" = "nrf5340_dk_nrf5340_cpuappns"

endif # SOC_NRF5340_CPUAPP_QKAA


if SOC_NRF5340_CPUNET_QKAA

# nRF5340 DK NRF5340 Network MCU
config BOARD_NRF5340_DK_NRF5340_CPUNET
	def_bool "$(BOARD)" = "nrf5340_dk_nrf5340_cpunet"

endif # SOC_NRF5340_CPUNET_QKAA
```

## boards/arm/nrf5340_dk_nrf5340/nrf5340_dk_nrf5340_cpuapp_defconfig
```kconfig
# SPDX-License-Identifier: Apache-2.0

CONFIG_ARM=y
CONFIG_SOC_FAMILY_NRF=y
CONFIG_SOC_SERIES_NRF53X=y
CONFIG_SOC_NRF5340_CPUAPP_QKAA=y
CONFIG_BOARD_NRF5340_DK_NRF5340_CPUAPP=y

# Enable MPU
CONFIG_ARM_MPU=y

# Enable TrustZone-M
CONFIG_ARM_TRUSTZONE_M=y

# enable GPIO
CONFIG_GPIO=y

# Enable uart driver
CONFIG_SERIAL=y
CONFIG_UART_0_NRF_UARTE=y

# enable console
CONFIG_CONSOLE=y
CONFIG_UART_CONSOLE=y
```

## boards/arm/nrf5340_dk_nrf5340/nrf5340_dk_nrf5340_cpuappns_defconfig
```kconfig
# SPDX-License-Identifier: Apache-2.0

CONFIG_ARM=y
CONFIG_SOC_FAMILY_NRF=y
CONFIG_SOC_SERIES_NRF53X=y
CONFIG_SOC_NRF5340_CPUAPP_QKAA=y
CONFIG_BOARD_NRF5340_DK_NRF5340_CPUAPPNS=y

# Enable MPU
CONFIG_ARM_MPU=y

# Enable TrustZone-M
CONFIG_ARM_TRUSTZONE_M=y

# This Board implies building Non-Secure firmware
CONFIG_TRUSTED_EXECUTION_NONSECURE=y

# enable GPIO
CONFIG_GPIO=y

# Enable uart driver
CONFIG_SERIAL=y
CONFIG_UART_0_NRF_UARTE=y

# enable console
CONFIG_CONSOLE=y
CONFIG_UART_CONSOLE=y
```

## boards/arm/nrf5340_dk_nrf5340/nrf5340_dk_nrf5340_cpunet_defconfig
```kconfig
# SPDX-License-Identifier: Apache-2.0

CONFIG_ARM=y
CONFIG_SOC_FAMILY_NRF=y
CONFIG_SOC_SERIES_NRF53X=y
CONFIG_SOC_NRF5340_CPUNET_QKAA=y
CONFIG_BOARD_NRF5340_DK_NRF5340_CPUNET=y

# Enable MPU
CONFIG_ARM_MPU=y

# enable GPIO
CONFIG_GPIO=y

# Enable uart driver
CONFIG_SERIAL=y
CONFIG_UART_0_NRF_UARTE=y

# enable console
CONFIG_CONSOLE=y
CONFIG_UART_CONSOLE=y
```
