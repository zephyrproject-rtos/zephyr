## boards/arm/bt6x0/bt6x0_defconfig
```kconfig
# SPDX-License-Identifier: Apache-2.0

CONFIG_SOC_SERIES_NRF52X=y
CONFIG_SOC_NRF52840_QIAA=y
CONFIG_BOARD_BT6X0=y

# Enable MPU
CONFIG_ARM_MPU=y

# enable GPIO
CONFIG_GPIO=y
CONFIG_NFCT_PINS_AS_GPIOS=y

# enable uart driver
CONFIG_SERIAL=y

# enable console
CONFIG_CONSOLE=y
CONFIG_UART_CONSOLE=y

# additional board options
CONFIG_GPIO_AS_PINRESET=y

# 32kHz clock source
CONFIG_CLOCK_CONTROL_NRF_K32SRC_XTAL=y
CONFIG_CLOCK_CONTROL_NRF_K32SRC_20PPM=y

# Enable hardware stack protection
CONFIG_HW_STACK_PROTECTION=y
```

## boards/arm/buildtest_ks22/Kconfig.board
```kconfig
# BOARD_BUILDTEST_KS22 board

# Copyright (c) 2018, Prevas A/S
# SPDX-License-Identifier: Apache-2.0

config BOARD_BUILDTEST_KS22
	bool "BUILDTEST KS22"
	depends on SOC_SERIES_KINETIS_KS2X
	select SOC_PART_NUMBER_MKS22FN256VLH12
```

## boards/arm/buildtest_ks22/Kconfig.defconfig
```kconfig
# Kconfig
#
#
# SPDX-License-Identifier: Apache-2.0
#

if BOARD_BUILDTEST_KS22

config BOARD
	default "buildtest_ks22"

if PINMUX_MCUX

config PINMUX_MCUX_PORTA
	default y

config PINMUX_MCUX_PORTB
	default y

config PINMUX_MCUX_PORTC
	default y

config PINMUX_MCUX_PORTD
	default y

endif # PINMUX_MCUX

config I2C_0
	default y
	depends on I2C

config SPI_0
	default y
	depends on SPI

config UART_MCUX_LPUART
	default y
	depends on SERIAL

config SERIAL_HAS_DRIVER
	default y
	depends on UART_MCUX_LPUART

endif # BOARD_BUILDTEST_KS22
```

## boards/arm/buildtest_ks22/buildtest_ks22_defconfig
```kconfig
#
# Copyright (c) 2018 Prevas A/S
# Copyright (c) 2019 Thomas Burdick <thomas.burdick@gmail.com>

#
# SPDX-License-Identifier: Apache-2.0
#

CONFIG_SOC_MKS22F12=y
CONFIG_SOC_SERIES_KINETIS_KS2X=y
CONFIG_CONSOLE=y
CONFIG_UART_CONSOLE=y
CONFIG_SERIAL=y
CONFIG_CORTEX_M_SYSTICK=y
CONFIG_GPIO=y
CONFIG_PINMUX=y
CONFIG_SYS_CLOCK_HW_CYCLES_PER_SEC=48000000
CONFIG_OSC_LOW_POWER=y
CONFIG_OSC_XTAL0_FREQ=48000000
```

## boards/arm/cc1352p1_launchxl/Kconfig.board
```kconfig
# TI CC1352R LaunchXL board

# Copyright (c) 2021 Florin Stancu
# SPDX-License-Identifier: Apache-2.0

config BOARD_CC1352P1_LAUNCHXL
	bool "TI CC1352P1 LaunchXL"
	depends on SOC_CC1352P

if BOARD_CC1352P1_LAUNCHXL

config BOARD_ANTENNA_INIT_PRIO
	int "Board antenna switch initialization priority"
	default 70
	help
	  Set the priority for board init, must be greater than
	  KERNEL_INIT_PRIORITY_DEVICE but smaller than
	  IEEE802154_CC13XX_CC26XX_SUB_GHZ_INIT_PRIO.

endif # BOARD_CC1352P1_LAUNCHXL
```

## boards/arm/cc1352p1_launchxl/Kconfig.defconfig
```kconfig
# TI CC1352P1 LaunchXL board

# Copyright (c) 2021 Florin Stancu
# SPDX-License-Identifier: Apache-2.0

if BOARD_CC1352P1_LAUNCHXL

config BOARD
	default "cc1352p1_launchxl"

endif # BOARD_CC1352P1_LAUNCHXL
```

## boards/arm/cc1352p1_launchxl/cc1352p1_launchxl_defconfig
```kconfig
#
# Copyright (c) 2021 Florin Stancu
#
# SPDX-License-Identifier: Apache-2.0
#

CONFIG_SOC_SERIES_CC13X2_CC26X2=y
CONFIG_SOC_CC1352P=y
CONFIG_BOARD_CC1352P1_LAUNCHXL=y
CONFIG_BUILD_OUTPUT_HEX=y
# custom callback for the antenna switch
CONFIG_CC13X2_CC26X2_HAS_CUSTOM_RF_HWATTRS=y

CONFIG_CC13X2_CC26X2_BOOTLOADER_ENABLE=y
CONFIG_CC13X2_CC26X2_BOOTLOADER_BACKDOOR_ENABLE=y
CONFIG_CC13X2_CC26X2_BOOTLOADER_BACKDOOR_PIN=15

# Enable MPU and hardware stack protection
CONFIG_ARM_MPU=y
CONFIG_HW_STACK_PROTECTION=y

CONFIG_PINCTRL=y
CONFIG_GPIO=y
CONFIG_SERIAL=y

CONFIG_CONSOLE=y
CONFIG_UART_CONSOLE=y
```

## boards/arm/cc1352r1_launchxl/Kconfig.board
```kconfig
# TI CC1352R LaunchXL board

# Copyright (c) 2019 Brett Witherspoon
# SPDX-License-Identifier: Apache-2.0

config BOARD_CC1352R1_LAUNCHXL
	def_bool "$(BOARD)" = "cc1352r1_launchxl"
	depends on SOC_CC1352R
```

## boards/arm/cc1352r1_launchxl/Kconfig.defconfig
```kconfig
# TI CC1352R LaunchXL board

# Copyright (c) 2019 Brett Witherspoon
# SPDX-License-Identifier: Apache-2.0

if BOARD_CC1352R1_LAUNCHXL

config BOARD
	default "cc1352r1_launchxl"

config SPI_0
	default y
	depends on SPI

if SYS_POWER_MANAGEMENT

# Ideally this value could be made to less than 1 ms, as there is
# essentially no delay to come out of IDLE mode. However Zephyr only
# supports millisecond precision here, so 1 ms is the best approximation.
config SYS_PM_MIN_RESIDENCY_SLEEP_1
	default 1

# The default here is deliberately made higher to be less agressive, to
# accommodate for systems that may wish to do some extra work on resume,
# which is possible given some power domains without retention are turned
# out while in STANDBY mode.
#
# It is important to set this value to one that is appropriate for a
# given application, weighing tradeoffs between a lower value that leads to
# higher power savings vs. a higher value that would accommodate for a higher
# wakeup latency.
config SYS_PM_MIN_RESIDENCY_SLEEP_2
	default 5

endif # SYS_POWER_MANAGEMENT

if BT

config BT_CTLR
	default y
	select BLE_VENDOR_LLL_TI
	select BLE_CC13XX_CC26XX
	select ENTROPY_CC13XX_CC26XX_RNG

# To debug the BLE radio using GPIO, uncomment the line below
# See the file subsys/bluetooth/controller/ll_sw/ti/hal/cc13xx_cc26xx/debug.h
# for details
	select BT_CTLR_DEBUG_PINS

endif # BT

endif # BOARD_CC1352R1_LAUNCHXL
```

## boards/arm/cc1352r1_launchxl/cc1352r1_launchxl_defconfig
```kconfig
#
# Copyright (c) 2019 Brett Witherspoon
#
# SPDX-License-Identifier: Apache-2.0
#

CONFIG_ARM=y
CONFIG_SOC_SERIES_CC13X2_CC26X2=y
CONFIG_SOC_CC1352R=y
CONFIG_BOARD_CC1352R1_LAUNCHXL=y

CONFIG_CC13X2_CC26X2_BOOTLOADER_ENABLE=y
CONFIG_CC13X2_CC26X2_BOOTLOADER_BACKDOOR_ENABLE=y
CONFIG_CC13X2_CC26X2_BOOTLOADER_BACKDOOR_PIN=15

CONFIG_PINMUX=y
CONFIG_GPIO=y
CONFIG_SERIAL=y

CONFIG_CONSOLE=y
CONFIG_UART_CONSOLE=y
```

## boards/arm/cc1352r_sensortag/Kconfig.board
```kconfig
# TI CC1352R SensorTag board

# Copyright (c) 2019 Brett Witherspoon
# Copyright (c) 2020 Friedt Professional Engineering Services, Inc
# SPDX-License-Identifier: Apache-2.0

config BOARD_CC1352R_SENSORTAG
	bool "TI CC1352R SensorTag"
	depends on SOC_CC1352R
```

## boards/arm/cc1352r_sensortag/Kconfig.defconfig
```kconfig
# TI CC1352R SensorTag board

# Copyright (c) 2019 Brett Witherspoon
# Copyright (c) 2020 Friedt Professional Engineering Services, Inc
# SPDX-License-Identifier: Apache-2.0

config SPI
	default SENSOR
```

## boards/arm/cc1352r_sensortag/cc1352r_sensortag_defconfig
```kconfig
#
# Copyright (c) 2019 Brett Witherspoon
# Copyright (c) 2020 Friedt Professional Engineering Services, Inc
#
# SPDX-License-Identifier: Apache-2.0
#

CONFIG_SOC_SERIES_CC13X2_CC26X2=y
CONFIG_SOC_CC1352R=y
CONFIG_BOARD_CC1352R_SENSORTAG=y

CONFIG_CC13X2_CC26X2_BOOTLOADER_ENABLE=y
CONFIG_CC13X2_CC26X2_BOOTLOADER_BACKDOOR_ENABLE=y
CONFIG_CC13X2_CC26X2_BOOTLOADER_BACKDOOR_PIN=15

# Enable MPU and hardware stack protection
CONFIG_ARM_MPU=y
CONFIG_HW_STACK_PROTECTION=y

CONFIG_PINCTRL=y
CONFIG_GPIO=y
CONFIG_SERIAL=y

CONFIG_CONSOLE=y
CONFIG_UART_CONSOLE=y
CONFIG_BUILD_OUTPUT_HEX=y
```

## boards/arm/cc2650_sensortag/Kconfig.board
```kconfig
# TI SimpleLink CC2650 SensorTag Board

# SPDX-License-Identifier: Apache-2.0

config BOARD_CC2650_SENSORTAG
	bool "TI CC2650 SensorTag"
	depends on SOC_CC2650
```

## boards/arm/cc2650_sensortag/Kconfig.defconfig
```kconfig
# TI CC2650 SensorTag board configuration

# SPDX-License-Identifier: Apache-2.0

if BOARD_CC2650_SENSORTAG

config BOARD
	default "cc2650_sensortag"

config BOARD_DEPRECATED_RELEASE
	default "2.2.0"

endif # BOARD_CC2650_SENSORTAG
```

## boards/arm/cc2650_sensortag/cc2650_sensortag_defconfig
```kconfig
# SPDX-License-Identifier: Apache-2.0

# General options

CONFIG_SYS_CLOCK_HW_CYCLES_PER_SEC=48000000
CONFIG_FLASH=y
CONFIG_FLASH_BASE_ADDRESS=0x00000000
CONFIG_SRAM_BASE_ADDRESS=0x20000000
CONFIG_BOOTLOADER_SRAM_SIZE=0
CONFIG_XIP=y
CONFIG_PRINTK=y

# Platform-specific options

CONFIG_ARM=y
CONFIG_CORTEX_M_SYSTICK=y
CONFIG_BOARD_CC2650_SENSORTAG=y
CONFIG_SOC_FAMILY_TISIMPLELINK=y
CONFIG_SOC_SERIES_CC2650=y
CONFIG_SOC_CC2650=y

# Pinmux driver
CONFIG_PINMUX=y
CONFIG_PINMUX_CC2650=y
CONFIG_PINMUX_CC2650_INIT_PRIO=1

# GPIO driver
CONFIG_GPIO=y
CONFIG_GPIO_CC2650=y
CONFIG_GPIO_CC2650_INIT_PRIO=0

# UART driver
CONFIG_SERIAL=y
CONFIG_SERIAL_HAS_DRIVER=y
CONFIG_UART_STELLARIS=y
CONFIG_UART_STELLARIS_PORT_0=y

# Console driver
CONFIG_CONSOLE=y
CONFIG_UART_CONSOLE=y

# Random number generator driver
CONFIG_ENTROPY_GENERATOR=y
CONFIG_CC2650_TRNG_ENTROPY_GENERATOR=y
CONFIG_CC2650_TRNG_IRQ_PRIO=0
```

## boards/arm/cc26x2r1_launchxl/Kconfig.board
```kconfig
# TI CC26x2R1 LaunchXL board

# Copyright (c) 2019 Brett Witherspoon
# SPDX-License-Identifier: Apache-2.0

config BOARD_CC26X2R1_LAUNCHXL
	def_bool "$(BOARD)" = "cc26x2r1_launchxl"
	depends on SOC_CC2652R
```

## boards/arm/cc26x2r1_launchxl/Kconfig.cc26x2r1_launchxl
```kconfig
# Copyright (c) 2022 Zephyr Project members and individual contributors
# SPDX-License-Identifier: Apache-2.0

config BOARD_CC26X2R1_LAUNCHXL
	bool
	default y
	select SOC_SERIES_CC13X2_CC26X2
	select SOC_CC2652R
```

## boards/arm/cc26x2r1_launchxl/Kconfig.defconfig
```kconfig
# TI CC26x2R1 LaunchXL board

# Copyright (c) 2019 Brett Witherspoon
# SPDX-License-Identifier: Apache-2.0

if BOARD_CC26X2R1_LAUNCHXL

config BOARD
	default "cc26x2r1_launchxl"

endif # BOARD_CC26X2R1_LAUNCHXL
```

## boards/arm/cc26x2r1_launchxl/cc26x2r1_launchxl_defconfig
```kconfig
#
# Copyright (c) 2019 Brett Witherspoon
#
# SPDX-License-Identifier: Apache-2.0
#

CONFIG_SOC_SERIES_CC13X2_CC26X2=y
CONFIG_SOC_CC2652R=y
CONFIG_BOARD_CC26X2R1_LAUNCHXL=y
CONFIG_BUILD_OUTPUT_HEX=y

CONFIG_CC13X2_CC26X2_BOOTLOADER_ENABLE=y
CONFIG_CC13X2_CC26X2_BOOTLOADER_BACKDOOR_ENABLE=y
CONFIG_CC13X2_CC26X2_BOOTLOADER_BACKDOOR_PIN=13

CONFIG_PINMUX=y
CONFIG_GPIO=y
CONFIG_SERIAL=y

CONFIG_CONSOLE=y
CONFIG_UART_CONSOLE=y
```

## boards/arm/cc3200_launchxl/Kconfig.board
```kconfig
# Kconfig - TI SimpleLink CC3200 LaunchXL Board
#

config  BOARD_CC3200_LAUNCHXL
	bool "TI CC3200 LAUNCHXL"
	depends on SOC_CC3200
```

## boards/arm/cc3200_launchxl/Kconfig.defconfig
```kconfig
# Kconfig - TI CC3200 LaunchXL board configuration
#

if BOARD_CC3200_LAUNCHXL

config BOARD
	default cc3200_launchxl

config BOARD_DEPRECATED
	default "1.8"

endif # BOARD_CC3200_LAUNCHXL
```

## boards/arm/cc3200_launchxl/cc3200_launchxl_defconfig
```kconfig
CONFIG_ARM=y
CONFIG_BOARD_CC3200_LAUNCHXL=y
CONFIG_SOC_FAMILY_TISIMPLELINK=y
CONFIG_SOC_SERIES_CC32XX=y
CONFIG_SOC_CC3200=y
CONFIG_CORTEX_M_SYSTICK=y
CONFIG_FLASH=n
CONFIG_FLASH_BASE_ADDRESS=0x00000000
CONFIG_XIP=n
CONFIG_PRINTK=y

#enable GPIO driver
CONFIG_GPIO=y

# enable uart driver
CONFIG_SERIAL=y
CONFIG_SERIAL_HAS_DRIVER=y
CONFIG_UART_CC32XX=y

# enable console
CONFIG_CONSOLE=y
CONFIG_UART_CONSOLE=y

# Enable CC3200 SDK driver files
CONFIG_CC3200SDK_ROM_DRIVERLIB=y

# Enable DTS parsing
CONFIG_HAS_DTS=y
```
