/*
 * Copyright (c) 2019 Actions (Zhuhai) Technology Co., Ltd
 *
 * SPDX-License-Identifier: Apache-2.0
 */

/dts-v1/;
#include <actions/atb110x.dtsi>

/ {
	model = "Actions ATB1103 Golden Board";
	compatible = "actions,atb1103_golden", "actions,atb110x";

	chosen {
		zephyr,console = &uart0;
		zephyr,sram = &sram0;
		zephyr,flash = &flash0;
	};
};

&uart0 {
	current-speed = <115200>;
	status = "okay";
};
