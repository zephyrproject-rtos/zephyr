## boards/arm/mps3/mps3_an536_cpu0_defconfig
```kconfig
# Copyright (c) 2026 Andrei-Edward Popa
# SPDX-License-Identifier: Apache-2.0

CONFIG_ARM_MPU=y
CONFIG_QEMU_ICOUNT_SHIFT=7

CONFIG_GPIO=y

CONFIG_SERIAL=y
CONFIG_CONSOLE=y
CONFIG_UART_CONSOLE=y
CONFIG_UART_INTERRUPT_DRIVEN=y
```

## boards/arm/mps3/mps3_corstone300_an547_defconfig
```kconfig
#
# Copyright (c) 2018-2021 Linaro Limited
# Copyright 2024 Arm Limited and/or its affiliates <open-source-office@arm.com>
#
# SPDX-License-Identifier: Apache-2.0
#

CONFIG_RUNTIME_NMI=y
CONFIG_ARM_TRUSTZONE_M=y
CONFIG_ARM_MPU=y
CONFIG_QEMU_ICOUNT_SHIFT=7

# GPIOs
CONFIG_GPIO=y

# Serial
CONFIG_CONSOLE=y
CONFIG_UART_CONSOLE=y
CONFIG_SERIAL=y

# Build a Secure firmware image
CONFIG_TRUSTED_EXECUTION_SECURE=y
```

## boards/arm/mps3/mps3_corstone300_an547_ns_defconfig
```kconfig
#
# Copyright (c) 2018-2021 Linaro Limited
# Copyright 2024 Arm Limited and/or its affiliates <open-source-office@arm.com>
#
# SPDX-License-Identifier: Apache-2.0
#

CONFIG_ARM_TRUSTZONE_M=y
CONFIG_RUNTIME_NMI=y
CONFIG_ARM_MPU=y
CONFIG_QEMU_ICOUNT_SHIFT=6

# GPIOs
CONFIG_GPIO=y

# Serial
CONFIG_CONSOLE=y
CONFIG_UART_CONSOLE=y
CONFIG_SERIAL=y

# Build a Non-secure firmware image
CONFIG_TRUSTED_EXECUTION_SECURE=n
CONFIG_TRUSTED_EXECUTION_NONSECURE=y
```

## boards/arm/mps3/mps3_corstone310_an555_defconfig
```kconfig
# Copyright 2024-2025 Arm Limited and/or its affiliates <open-source-office@arm.com>
# SPDX-License-Identifier: Apache-2.0

CONFIG_RUNTIME_NMI=y
CONFIG_ARM_TRUSTZONE_M=y
CONFIG_ARM_MPU=y

# GPIOs
CONFIG_GPIO=y

# Serial
CONFIG_CONSOLE=y
CONFIG_UART_CONSOLE=y
CONFIG_SERIAL=y

# Build a Secure firmware image
CONFIG_TRUSTED_EXECUTION_SECURE=y
# ROMSTART_REGION address and size are defined in Kconfig.defconfig
CONFIG_ROMSTART_RELOCATION_ROM=y
```

## boards/arm/mps3_an547/Kconfig.board
```kconfig
# Copyright (c) 2021 Linaro Limited
# SPDX-License-Identifier: Apache-2.0

config BOARD_MPS3_AN547
	bool "Arm Cortex-M55 (Corstone-300, SSE-300 w/Ethos-U55) on MPS3 (AN547)"
	depends on SOC_MPS3_AN547
```

## boards/arm/mps3_an547/Kconfig.defconfig
```kconfig
# Copyright (c) 2018-2021 Linaro Limited
# SPDX-License-Identifier: Apache-2.0

if BOARD_MPS3_AN547

config BOARD
	default "mps3_an547"

if GPIO

config GPIO_CMSDK_AHB
	default y

endif # GPIO

if SERIAL

config UART_CMSDK_APB
	default y

config UART_INTERRUPT_DRIVEN
	default y

endif # SERIAL

config I2C_SBCON
	default y
	depends on I2C

endif
```

## boards/arm/mps3_an547/Kconfig.mps3_an547_ns
```kconfig
# Copyright (c) 2022 Zephyr Project members and individual contributors
# SPDX-License-Identifier: Apache-2.0

config BOARD_MPS3_AN547_NS
	bool
	default y
	select SOC_SERIES_MPS3
	select SOC_MPS3_AN547
	select QEMU_TARGET
```

## boards/arm/mps4/Kconfig
```kconfig
# Copyright (c) 2025 Nordic Semiconductor ASA
# SPDX-License-Identifier: Apache-2.0

config BOARD_MPS4
	select BUILD_WITH_TFM if BOARD_MPS4_CORSTONE315_FVP_NS || BOARD_MPS4_CORSTONE320_FVP_NS
	select TRUSTED_EXECUTION_NONSECURE if BOARD_MPS4_CORSTONE315_FVP_NS || BOARD_MPS4_CORSTONE320_FVP_NS
```

## boards/arm/mps4/Kconfig.mps4
```kconfig
# Copyright 2025 Arm Limited and/or its affiliates <open-source-office@arm.com>
# SPDX-License-Identifier: Apache-2.0

config BOARD_MPS4
	select SOC_SERIES_MPS4
	select SOC_MPS4_CORSTONE315 if BOARD_MPS4_CORSTONE315_FVP || BOARD_MPS4_CORSTONE315_FVP_NS
	select SOC_MPS4_CORSTONE320 if BOARD_MPS4_CORSTONE320_FVP || BOARD_MPS4_CORSTONE320_FVP_NS
```

## boards/arm/mps4/board.yml
```yaml
board:
  name: mps4
  full_name: MPS4 Corstone FVP
  vendor: arm
  socs:
  - name: 'corstone315'
    variants:
    - name: 'fvp'
      variants:
      - name: 'ns'
  - name: 'corstone320'
    variants:
    - name: 'fvp'
      variants:
      - name: 'ns'
```

## boards/arm/mr_canhubk3/Kconfig.board
```kconfig
# Copyright 2023 NXP
# SPDX-License-Identifier: Apache-2.0

config BOARD_MR_CANHUBK3
	bool "mr_canhubk3"
	depends on SOC_SERIES_S32K3_M7
	select SOC_PART_NUMBER_S32K344
```

## boards/arm/mr_canhubk3/Kconfig.defconfig
```kconfig
# Copyright 2023 NXP
# SPDX-License-Identifier: Apache-2.0

if BOARD_MR_CANHUBK3

config BOARD
	default "mr_canhubk3"

if SERIAL

config UART_CONSOLE
	default y

endif # SERIAL

if CAN

config GPIO
	default y

endif # CAN

if NETWORKING

config NET_L2_ETHERNET
	default y if !NET_LOOPBACK && !NET_TEST

endif # NETWORKING

endif # BOARD_MR_CANHUBK3
```

## boards/arm/mr_canhubk3/mr_canhubk3_defconfig
```kconfig
# Copyright 2023 NXP
# SPDX-License-Identifier: Apache-2.0

CONFIG_BOARD_MR_CANHUBK3=y
CONFIG_SOC_S32K344_M7=y
CONFIG_SOC_SERIES_S32K3_M7=y
CONFIG_BUILD_OUTPUT_HEX=y

# Use Systick as system clock
CONFIG_SYS_CLOCK_HW_CYCLES_PER_SEC=160000000

# Run from internal Flash
CONFIG_XIP=y

# Enable MPU
CONFIG_ARM_MPU=y

# Use no-cached memory for HAL
CONFIG_NOCACHE_MEMORY=y

# Drivers
CONFIG_PINCTRL=y
CONFIG_SERIAL=y
CONFIG_WATCHDOG=y

# Serial console
CONFIG_CONSOLE=y
```

## boards/arm/msp_exp432e401y_dk/Kconfig.board
```kconfig
# TI SimpleLink MSP-EXP432P401R LaunchXL Development Board

# Copyright (c) 2021 pipei.sandor@gmail.com
# SPDX-License-Identifier: Apache-2.0

config BOARD_MSP_EXP432E401Y_DK
	bool "TI MSP-EXP432E401Y DK"
	depends on SOC_MSP432E401Y
```

## boards/arm/msp_exp432e401y_dk/Kconfig.defconfig
```kconfig
# TI MSP-EXP432P401R LaunchXL development board configuration
# Copyright (c) 2021 pipei.sandor@gmail.com

# SPDX-License-Identifier: Apache-2.0

config BOARD
	default "msp_exp432e401y_dk"
	depends on BOARD_MSP_EXP432E401Y_DK
```

## boards/arm/msp_exp432e401y_dk/msp_exp432e401y_dk_defconfig
```kconfig
# SPDX-License-Identifier: Apache-2.0
# Copyright (c) 2021 pipei.sandor@gmail.com

CONFIG_BOARD_MSP_EXP432E401Y_DK=y
CONFIG_SOC_SERIES_MSP432E4XX=y
CONFIG_SOC_MSP432E401Y=y
CONFIG_CORTEX_M_SYSTICK=y
CONFIG_ARM_MPU=y
CONFIG_HW_STACK_PROTECTION=y
CONFIG_HW_STACK
```

## boards/arm/msp_exp432p401r_launchxl/Kconfig.board
```kconfig
# TI SimpleLink MSP-EXP432P401R LaunchXL Development Board

# SPDX-License-Identifier: Apache-2.0

config BOARD_MSP_EXP432P401R_LAUNCHXL
	bool "TI MSP-EXP432P401R LAUNCHXL"
	depends on SOC_MSP432P401R
```

## boards/arm/msp_exp432p401r_launchxl/Kconfig.defconfig
```kconfig
# SPDX-License-Identifier: Apache-2.0

# Kconfig - TI MSP-EXP432P401R LaunchXL development board configuration
#

if BOARD_MSP_EXP432P401R_LAUNCHXL

config BOARD
	default "msp_exp432p401r_launchxl"

endif # BOARD_MSP_EXP432P401R_LAUNCHXL
```

## boards/arm/msp_exp432p401r_launchxl/Kconfig.msp_exp432p401r_launchxl
```kconfig
# Copyright (c) 2022 Zephyr Project members and individual contributors
# SPDX-License-Identifier: Apache-2.0

config BOARD_MSP_EXP432P401R_LAUNCHXL
	bool
	default y
	select SOC_SERIES_MSP432P4XX
	select SOC_MSP432P401R
```

## boards/arm/msp_exp432p401r_launchxl/msp_exp432p401r_launchxl_defconfig
```kconfig
# SPDX-License-Identifier: Apache-2.0

CONFIG_BOARD_MSP_EXP432P401R_LAUNCHXL=y
CONFIG_SOC_SERIES_MSP432P4XX=y
CONFIG_SOC_MSP432P401R=y
CONFIG_CORTEX_M_SYSTICK=y

# Floating point options
CONFIG_FPU=y

# enable uart driver
CONFIG_SERIAL=y
CONFIG_UART_MSP432P4XX=y

# enable console
CONFIG_CONSOLE=y
CONFIG_UART_CONSOLE=y
```

## boards/arm/mystm32f4/Kconfig.board
```kconfig
# Kconfig - STM32F4DISCOVERY board configuration
#
# Copyright (c) 2016 Linaro Limited.
#
# SPDX-License-Identifier: Apache-2.0
#

config BOARD_MYSTM32F4
	bool "mystm32f4 Development Board"
	depends on SOC_STM32F407XG
```

## boards/arm/mystm32f4/Kconfig.defconfig
```kconfig
# Kconfig - STM32F4DISCOVERY board configuration
#
# Copyright (c) 2016 Linaro Limited.
#
# SPDX-License-Identifier: Apache-2.0
#

if BOARD_MYSTM32F4

config BOARD
	default mystm32f4

endif # BOARD_STM32F4_DISCO
```

## boards/arm/ngultra_devkit/Kconfig.board
```kconfig
# Copyright (c) 2022 NanoXplore
# SPDX-License-Identifier: Apache-2.0

config BOARD_NGULTRA_DEVKIT
	bool "Devkit board for NG-Ultra"
	depends on SOC_NGULTRA
```
