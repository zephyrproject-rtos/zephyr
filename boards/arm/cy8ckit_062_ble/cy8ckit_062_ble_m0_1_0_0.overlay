/*
 * Copyright (c) 2021, ATL Electronics
 *
 * SPDX-License-Identifier: Apache-2.0
 */

/ {
	aliases {
		uart-2 = &uart2;
	};

	chosen {
		zephyr,console = &uart2;
		zephyr,shell-uart = &uart2;
	};
};

&uart2 {
	status = "okay";
	current-speed = <115200>;

	interrupt-parent = <&intmux_ch21>;

	pinctrl-0 = <&p9_0_uart2_rx &p9_1_uart2_tx>;
};
