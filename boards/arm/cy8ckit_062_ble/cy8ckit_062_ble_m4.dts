/*
 * Copyright (c) 2018, Cypress
 * Copyright (c) 2020, ATL Electronics
 *
 * SPDX-License-Identifier: Apache-2.0
 */

/dts-v1/;

#include <cypress/psoc6_cm4.dtsi>

/ {
	model = "Cypress PSoC6 BLE Pioneer Kit";
	compatible = "cypress,cy8c6xx7_cm4", "cypress,psoc6";

	aliases {
		uart-6 = &uart6;
	};

	chosen {
		zephyr,sram = &sram2;
		zephyr,flash = &flash1;
		zephyr,console = &uart6;
		zephyr,shell-uart = &uart6;
	};
};

&uart6 {
	status = "okay";
	current-speed = <115200>;
};
