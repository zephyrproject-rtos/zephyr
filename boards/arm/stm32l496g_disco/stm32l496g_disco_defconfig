## boards/arm/stm32l496g_disco/stm32l496g_disco_defconfig
```kconfig
CONFIG_ARM=y
CONFIG_BOARD_STM32L496G_DISCO=y
CONFIG_SOC_FAMILY_STM32=y
CONFIG_SOC_SERIES_STM32L4X=y
CONFIG_SOC_STM32L496XG=y
CONFIG_CORTEX_M_SYSTICK=y
# 80MHz system clock
CONFIG_SYS_CLOCK_HW_CYCLES_PER_SEC=80000000

# enable uart driver
CONFIG_SERIAL=y
CONFIG_UART_STM32=y
CONFIG_UART_STM32_PORT_2=y

# enable pinmux
CONFIG_PINMUX=y
CONFIG_PINMUX_STM32=y

# enable GPIOs
CONFIG_GPIO=y
CONFIG_GPIO_STM32=y
CONFIG_GPIO_STM32_PORTA=y
CONFIG_GPIO_STM32_PORTB=y
CONFIG_GPIO_STM32_PORTC=y
CONFIG_GPIO_STM32_PORTD=y
CONFIG_GPIO_STM32_PORTE=y
CONFIG_GPIO_STM32_PORTF=y
CONFIG_GPIO_STM32_PORTG=y
CONFIG_GPIO_STM32_PORTH=y

# clock configuration
CONFIG_CLOCK_CONTROL=y
# SYSCLK selection
CONFIG_CLOCK_STM32_SYSCLK_SRC_PLL=y
# PLL configuration
CONFIG_CLOCK_STM32_PLL_SRC_HSI
# produce 80MHz clock at PLL output
CONFIG_CLOCK_STM32_PLL_M_DIVISOR=1
CONFIG_CLOCK_STM32_PLL_N_MULTIPLIER=20
CONFIG_CLOCK_STM32_PLL_P_DIVISOR=7
CONFIG_CLOCK_STM32_PLL_Q_DIVISOR=2
CONFIG_CLOCK_STM32_PLL_R_DIVISOR=4
CONFIG_CLOCK_STM32_AHB_PRESCALER=1
CONFIG_CLOCK_STM32_APB1_PRESCALER=1
CONFIG_CLOCK_STM32_APB2_PRESCALER=1

# console
CONFIG_CONSOLE=y
CONFIG_UART_CONSOLE=y
CONFIG_UART_CONSOLE_ON_DEV_NAME="UART_2"

#enable pwm
CONFIG_PWM=y
CONFIG_PWM_STM32=y
CONFIG_PWM_STM32_2=y
```

## boards/arm/stm32l4p5g_dk/Kconfig.board
```kconfig
# STM32L4P5G discovery kit configuration

# Copyright (c) 2023 STMicroelectronics
# SPDX-License-Identifier: Apache-2.0

config BOARD_STM32L4P5G_DK
	bool "STM32L4P5G IOT Discovery kit"
	depends on SOC_STM32L4P5XX
```

## boards/arm/stm32l4p5g_dk/Kconfig.defconfig
```kconfig
# STM32L4P5G discovery kit board configuration

# Copyright (c) 2023 STMicroelectronics
# SPDX-License-Identifier: Apache-2.0

if BOARD_STM32L4P5G_DK

config BOARD
	default "stm32l4p5g_dk"

config SPI_STM32_INTERRUPT
	default y
	depends on SPI

choice LIS3MDL_TRIGGER_MODE
	default LIS3MDL_TRIGGER_NONE
endchoice

choice HTS221_TRIGGER_MODE
	default HTS221_TRIGGER_NONE
endchoice

choice LSM6DSL_TRIGGER_MODE
	default LSM6DSL_TRIGGER_GLOBAL_THREAD
	depends on LSM6DSL
endchoice

if BT

config SPI
	default y

choice BT_HCI_BUS_TYPE
	default BT_SPI
endchoice

config BT_SPI_BLUENRG
	default y

config BT_BLUENRG_ACI
	default y
# Disable Flow control
config BT_HCI_ACL_FLOW_CONTROL
	default n
config BT_HCI_VS_EXT
	default n

endif # BT

endif # BOARD_STM32L4P5G_DK
```

## boards/arm/stm32l4r9i_disco/stm32l4r9i_disco_defconfig
```kconfig
# SPDX-License-Identifier: Apache-2.0

CONFIG_SOC_SERIES_STM32L4X=y
CONFIG_SOC_STM32L4R9XX=y

# Enable MPU
CONFIG_ARM_MPU=y

# Enable HW stack protection
CONFIG_HW_STACK_PROTECTION=y

# Enable UART
CONFIG_SERIAL=y

# Enable console
CONFIG_CONSOLE=y
CONFIG_UART_CONSOLE=y

# Enable GPIO
CONFIG_GPIO=y

# Enable clocks
CONFIG_CLOCK_CONTROL=y

# Enable pin controller
CONFIG_PINCTRL=y
```

## boards/arm/stm32l562e_dk/Kconfig.board
```kconfig
# STM32L562E-DK Discovery board configuration

# Copyright (c) 2020 Yestin Sun
# SPDX-License-Identifier: Apache-2.0

config BOARD_STM32L562E_DK
	bool "STM32L562E-DK Discovery Development Board"
	depends on SOC_STM32L562XX
```

## boards/arm/stm32l562e_dk/Kconfig.defconfig
```kconfig
# STM32L562E-DK Discovery board configuration

# Copyright (c) 2020 Yestin Sun
# SPDX-License-Identifier: Apache-2.0

if BOARD_STM32L562E_DK

config BOARD
	default "stm32l562e_dk"

# LPTIM clocked by LSE, force tick freq to 4096 for tick accuracy
config SYS_CLOCK_TICKS_PER_SEC
	default 4096 if STM32_LPTIM_TIMER

if BT

config SPI
	default y

choice BT_HCI_BUS_TYPE
	default BT_SPI
endchoice

config BT_SPI_BLUENRG
	default y

config BT_BLUENRG_ACI
	default y

# Disable Flow control
config BT_HCI_ACL_FLOW_CONTROL
	default n

config BT_HCI_VS_EXT
	default n

endif # BT

if TRUSTED_EXECUTION_NONSECURE

# Get flash configuration for NS image from dts flash partition
config USE_DT_CODE_PARTITION
	default y

endif # TRUSTED_EXECUTION_NONSECURE

endif # BOARD_STM32L562E_DK
```

## boards/arm/stm32l562e_dk/Kconfig.stm32l562e_dk
```kconfig
# Copyright (c) 2022 Zephyr Project members and individual contributors
# SPDX-License-Identifier: Apache-2.0

config BOARD_STM32L562E_DK
	bool
	default y
	select SOC_SERIES_STM32L5X
	select SOC_STM32L562XX
```

## boards/arm/stm32mp157c_dk2/Kconfig.board
```kconfig
# STM32MP157C Discovery development 2 board

# Copyright (c) 2019 STMicroelectronics
# SPDX-License-Identifier: Apache-2.0

config BOARD_STM32MP157C_DK2
	def_bool "$(BOARD)" = "stm32mp157c_dk2"
	depends on SOC_STM32MP15_M4
```

## boards/arm/stm32mp157c_dk2/Kconfig.defconfig
```kconfig
# STM32MP157 discovery board configuration

# Copyright (c) 2019 STMicroelectronics
# SPDX-License-Identifier: Apache-2.0

if BOARD_STM32MP157C_DK2

config BOARD
	default "stm32mp157c_dk2"

config SPI_STM32_INTERRUPT
	default y
	depends on SPI

endif # BOARD_STM32MP157_Dk2
```

## boards/arm/stm32mp157c_dk2/Kconfig.stm32mp157c_dk2
```kconfig
# Copyright (c) 2022 Zephyr Project members and individual contributors
# SPDX-License-Identifier: Apache-2.0

config BOARD_STM32MP157C_DK2
	bool
	default y
	select SOC_SERIES_STM32MP1X
	select SOC_STM32MP15_M4
```

## boards/arm/stm32mp157c_dk2/stm32mp157c_dk2_defconfig
```kconfig
CONFIG_SOC_SERIES_STM32MP1X=y
CONFIG_SOC_STM32MP15_M4=y
# 209 MHz system clock (mlhclk_ck)
CONFIG_SYS_CLOCK_HW_CYCLES_PER_SEC=209000000

# enable GPIO
CONFIG_GPIO=y

# Enable MPU
CONFIG_ARM_MPU=y

# enable uart driver
CONFIG_SERIAL=y
CONFIG_UART_INTERRUPT_DRIVEN=y

# pin mux configuration
CONFIG_PINMUX=y

# clock configuration
CONFIG_CLOCK_CONTROL=y

# console (remote proc console by default)
CONFIG_CONSOLE=y
CONFIG_RAM_CONSOLE=y
CONFIG_RAM_CONSOLE_BUFFER_SIZE=1024

# uart console (overrides remote proc console)
CONFIG_UART_CONSOLE=n
```

## boards/arm/stm32u5a9j_dk/Kconfig.defconfig
```kconfig
# STM32U5A9J DISCOVERY KIT board configuration

# Copyright (c) 2023 STMicroelectronics
# SPDX-License-Identifier: Apache-2.0

if BOARD_STM32U5A9J_DK

config BOARD
	default "stm32u5a9j_dk"

endif # BOARD_STM32U5A9J_DK
```

## boards/arm/stm32vl_disco/Kconfig.board
```kconfig
# Board configuration

# Copyright (c) 2020 Jonas Eriksson, Up to Code AB
# SPDX-License-Identifier: Apache-2.0

config BOARD_STM32VL_DISCO
	bool "STM32VLDISCOVERY Development Board"
	depends on SOC_STM32F100XB
```

## boards/arm/stm32vl_disco/Kconfig.defconfig
```kconfig
# Board configuration

# Copyright (c) 2020 Jonas Eriksson, Up to Code AB
# SPDX-License-Identifier: Apache-2.0

if BOARD_STM32VL_DISCO

config BOARD
	default "stm32vl_disco"

endif # BOARD_STM32VL_DISCO
```

## boards/arm/stm32vl_disco/stm32vl_disco_defconfig
```kconfig
# SPDX-License-Identifier: Apache-2.0

# Platform Configuration
CONFIG_SOC_SERIES_STM32F1X=y
CONFIG_SOC_STM32F100XB=y

# Enable MPU
CONFIG_ARM_MPU=y

# Enable HW stack protection
CONFIG_HW_STACK_PROTECTION=y

# enable uart driver
CONFIG_SERIAL=y

# enable console
CONFIG_CONSOLE=y
CONFIG_UART_CONSOLE=y

# enable GPIO
CONFIG_GPIO=y

# enable clocks
CONFIG_CLOCK_CONTROL=y

# enable pin controller
CONFIG_PINCTRL=y
```

## boards/arm/stm32wb5mmg/Kconfig.board
```kconfig
# STM32WB5MMG Bluetooth module board configuration

# Copyright (c) 2024 Javad Rahimipetroudi <javad.rahimipetroudi@mind.be>
# SPDX-License-Identifier: Apache-2.0

config BOARD_STM32WB5MMG
	bool "stm32wb5mmg ultra low power Bluetooth module"
	depends on SOC_STM32WB55XX
```

## boards/arm/swan_r5/Kconfig.board
```kconfig
# Blues Wireless Swan board configuration

# Copyright (c) 2022 Blues Inc.
# SPDX-License-Identifier: Apache-2.0

config BOARD_SWAN_R5
	bool "Blues Wireless Swan Development Board"
	depends on SOC_STM32L4R5XX
```

## boards/arm/swan_r5/Kconfig.defconfig
```kconfig
# Blues Wireless Swan board configuration

# Copyright (c) 2022 Blues Inc.
# SPDX-License-Identifier: Apache-2.0

if BOARD_SWAN_R5

config BOARD
	default "swan_r5"

config SPI_STM32_INTERRUPT
	default y
	depends on SPI

if NETWORKING

config USB_DEVICE_STACK
	default y

config USB_DEVICE_NETWORK_EEM
	default y

endif # NETWORKING

endif # BOARD_SWAN_R5
```

## boards/arm/swan_r5/Kconfig.swan_r5
```kconfig
# Copyright (c) 2022 Zephyr Project members and individual contributors
# SPDX-License-Identifier: Apache-2.0

config BOARD_SWAN_R5
	bool
	default y
	select SOC_SERIES_STM32L4X
	select SOC_STM32L4R5XX
```

## boards/arm/tdk_robokit1/Kconfig.tdk_robokit1
```kconfig
# Copyright (c) 2022 Zephyr Project members and individual contributors
# SPDX-License-Identifier: Apache-2.0

config BOARD_TDK_ROBOKIT1
	bool
	default y
	select SOC_SERIES_SAME70
	select SOC_PART_NUMBER_SAME70Q21
```

## boards/arm/tdk_robokit1/tdk_robokit1_defconfig
```kconfig
# SPDX-License-Identifier: Apache-2.0

CONFIG_SOC_SERIES_SAME70=y
CONFIG_SOC_PART_NUMBER_SAME70Q21=y
CONFIG_SOC_ATMEL_SAME70_EXT_MAINCK=y
CONFIG_SOC_ATMEL_SAME70_PLLA_MULA=24
CONFIG_SOC_ATMEL_SAME70_PLLA_DIVA=1
CONFIG_ARM_MPU=y
CONFIG_CONSOLE=y
CONFIG_UART_CONSOLE=y
CONFIG_SERIAL=y
CONFIG_BOARD_TDK_ROBOKIT1=y
CONFIG_WDT_DISABLE_AT_BOOT=y
CONFIG_BUILD_OUTPUT_HEX=y

# Enable HW stack protection
CONFIG_HW_STACK_PROTECTION=y
```

## boards/arm/teensy4/Kconfig.board
```kconfig
#
# Copyright (c) 2020, Bernhard Kraemer
#
# SPDX-License-Identifier: Apache-2.0
#

config BOARD_TEENSY40
	bool "PJRC TEENSY40"
	depends on SOC_SERIES_IMX_RT
	select SOC_PART_NUMBER_MIMXRT1062DVL6A

config BOARD_TEENSY41
	bool "PJRC TEENSY41"
	depends on SOC_SERIES_IMX_RT
	select SOC_PART_NUMBER_MIMXRT1062DVJ6A
```

## boards/arm/teensy4/Kconfig.defconfig
```kconfig
#
# Copyright (c) 2020, Bernhard Kraemer
#
# SPDX-License-Identifier: Apache-2.0
#

if BOARD_TEENSY40 || BOARD_TEENSY41

config BUILD_OUTPUT_HEX
	bool
	default y

config BOARD
	default "teensy40" if BOARD_TEENSY40
	default "teensy41" if BOARD_TEENSY41

choice CODE_LOCATION
	default CODE_FLEXSPI
endchoice

config DISK_DRIVER_SDMMC
	default y if DISK_DRIVERS

endif # BOARD_TEENSY40 || BOARD_TEENSY41
```

## boards/arm/teensy4/teensy40_defconfig
```kconfig
#
# Copyright (c) 2020, Bernhard Kraemer
#
# SPDX-License-Identifier: Apache-2.0
#

CONFIG_SOC_MIMXRT1062=y
CONFIG_SOC_SERIES_IMX_RT=y
CONFIG_DEVICE_CONFIGURATION_DATA=n
CONFIG_BOARD_TEENSY40=y
CONFIG_CONSOLE=y
CONFIG_UART_CONSOLE=y
CONFIG_SERIAL=y
CONFIG_GPIO=y
CONFIG_SYS_CLOCK_HW_CYCLES_PER_SEC=600000000
CONFIG_ARM_MPU=y
CONFIG_HW_STACK_PROTECTION=y
CONFIG_PINCTRL=y
```

## boards/arm/teensy_explorer/Kconfig.board
```kconfig
# SPDX-License-Identifier: Apache-2.0

choice
	prompt "Installed Teensy"

config TEENSY_3_6
	bool "TEENSY 3.6"
	select SOC_PART_NUMBER_MK66FX1M0VMD18

config TEENSY_3_5
	bool "TEENSY 3.5"
	select SOC_PART_NUMBER_MK64FX512VMD12

endchoice

config BOARD_TEENSY_EXPLORER
	bool "Teensy Explorer"
	depends on SOC_SERIES_KINETIS_K6X
```
