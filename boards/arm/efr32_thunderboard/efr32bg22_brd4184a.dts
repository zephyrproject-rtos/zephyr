/*
 * Copyright (c) 2021 Sateesh Kotapati
 *
 * SPDX-License-Identifier: Apache-2.0
 */

/dts-v1/;
#include <silabs/efr32bg22.dtsi>
#include <silabs/efr32bg2x-pinctrl.dtsi>
#include "efr32bg22_brd4184.dtsi"

/ {
	model = "Silicon Labs EFR32BG BRD4184A (aka Thunderboard BG22)";
	compatible = "silabs,efr32bg22c224f512im40", "silabs,efr32bg_brd4184a",
		"silabs,efr32bg22";
};

&sw_sensor_enable {
	enable-gpios = <&gpioa GECKO_PIN(4) GPIO_ACTIVE_HIGH>;
};

&sw_mic_enable {
	enable-gpios = <&gpioa GECKO_PIN(0) GPIO_ACTIVE_HIGH>;
};
