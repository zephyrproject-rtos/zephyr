## boards/arm/weact_stm32g431_core/Kconfig.board
```kconfig
#
# Copyright (c) 2023 Andreas Sandberg
#
# SPDX-License-Identifier: Apache-2.0
#

config BOARD_WEACT_STM32G431_CORE
	bool "WeAct Studio STM32G431 Core Board"
	depends on SOC_STM32G431XX
```

## boards/arm/weact_stm32g431_core/Kconfig.defconfig
```kconfig
#
# Copyright (c) 2023 Andreas Sandberg
#
# SPDX-License-Identifier: Apache-2.0
#

if BOARD_WEACT_STM32G431_CORE

config BOARD
	default "weact_stm32g431_core"

endif
```

## boards/arm/weact_stm32g431_core/weact_stm32g431_core_defconfig
```kconfig
#
# Copyright (c) 2023 Andreas Sandberg
#
# SPDX-License-Identifier: Apache-2.0
#

CONFIG_SOC_SERIES_STM32G4X=y
CONFIG_SOC_STM32G431XX=y

CONFIG_CLOCK_CONTROL=y
CONFIG_PINCTRL=y

# LSE defined as LPTIM clock source by the DTS
CONFIG_STM32_LPTIM_CLOCK_LSE=y

CONFIG_ARM_MPU=y
CONFIG_HW_STACK_PROTECTION=y

CONFIG_GPIO=y

CONFIG_SERIAL=y
CONFIG_UART_INTERRUPT_DRIVEN=y
CONFIG_CONSOLE=y
CONFIG_UART_CONSOLE=y
```

## boards/arm/wio_lte_cat_1/Kconfig.board
```kconfig
# seeed Wio LTE Cat.1 board configuration

# Copyright (c) 2020, Kieran Bingham <kbingham@kernel.org>
# SPDX-License-Identifier: Apache-2.0

config BOARD_WIO_LTE_CAT_1
	bool "Seeed Wio LTE Cat.1 board"
	depends on SOC_STM32F405XG
```

## boards/arm/wio_lte_cat_1/Kconfig.defconfig
```kconfig
# Seeed Wio LTE Cat.1 board configuration

# Copyright (c) 2020, Kieran Bingham <kbingham@kernel.org>
# SPDX-License-Identifier: Apache-2.0

if BOARD_WIO_LTE_CAT_1

config BOARD
	default "wio_lte_cat_1"

if UART_CONSOLE || SERIAL

config UART_1
	default y

endif # UART_CONSOLE || SERIAL

if SERIAL

# QUACTEL Modem is attached to USART_2
config UART_2
	default y

endif # SERIAL

if I2C

config I2C_1
	default y

endif # I2C

endif # BOARD_WIO_LTE_CAT_1
```

## boards/arm/wio_terminal/Kconfig.board
```kconfig
# Copyright (c) 2023 Joel Guittet
# Wio Terminal board configuration

# SPDX-License-Identifier: Apache-2.0

config BOARD_WIO_TERMINAL
	bool "Wio Terminal"
	depends on SOC_PART_NUMBER_SAMD51P19A
```

## boards/arm/wio_terminal/Kconfig.defconfig
```kconfig
# Copyright (c) 2023 Joel Guittet
# Wio Terminal  board configuration

# SPDX-License-Identifier: Apache-2.0

config BOARD
	default "wio_terminal"
	depends on BOARD_WIO_TERMINAL
```

## boards/arm/wio_terminal/wio_terminal_defconfig
```kconfig
# Copyright (c) 2023 Joel Guittet
# SPDX-License-Identifier: Apache-2.0

CONFIG_SOC_SERIES_SAMD51=y
CONFIG_SOC_PART_NUMBER_SAMD51P19A=y
CONFIG_SOC_ATMEL_SAMD5X_XOSC32K=y
CONFIG_SOC_ATMEL_SAMD5X_XOSC32K_AS_MAIN=y
CONFIG_BOARD_WIO_TERMINAL=y
CONFIG_ARM_MPU=y
CONFIG_CORTEX_M_SYSTICK=y
CONFIG_HW_STACK_PROTECTION=y
CONFIG_REGULATOR=y
CONFIG_GPIO=y

# BOSSA bootloader
CONFIG_BOOTLOADER_BOSSA=y
CONFIG_BOOTLOADER_BOSSA_ADAFRUIT_UF2=y
CONFIG_BUILD_OUTPUT_UF2=y

# Console over USB CDC-ACM
CONFIG_SERIAL=y
CONFIG_CONSOLE=y
CONFIG_UART_CONSOLE=y
CONFIG_UART_INTERRUPT_DRIVEN=y
CONFIG_USB_DEVICE_STACK=y
CONFIG_USB_DEVICE_INITIALIZE_AT_BOOT=y
CONFIG_USB_DEVICE_VID=0x2886
CONFIG_USB_DEVICE_PID=0x802D
CONFIG_USB_DEVICE_MANUFACTURER="Seeed Studio"
CONFIG_USB_DEVICE_PRODUCT="Wio Terminal"
CONFIG_USB_CDC_ACM_LOG_LEVEL_OFF=y
```

## boards/arm/xiao_ble/Kconfig.defconfig
```kconfig
# XIAO BLE board configuration

# Copyright (c) 2022 Marcin Niestroj
# SPDX-License-Identifier: Apache-2.0

if BOARD_XIAO_BLE

config BOARD
	default "xiao_ble"

config BT_CTLR
	default BT

endif # BOARD_XIAO_BLE

if USB_DEVICE_STACK

config UART_CONSOLE
	default CONSOLE

config USB_DEVICE_INITIALIZE_AT_BOOT
	default y

endif # USB_DEVICE_STACK
```

## boards/arm/xmc14_arduino_kit/Kconfig.board
```kconfig
# SPDX-License-Identifier: Apache-2.0
#
# Copyright (c) 2021 Linumiz
# Author: Parthiban Nallathambi <parthiban@linumiz.com>

config BOARD_XMC14_ARDUINO_KIT
	bool "Infineon xmc14 Arduino Kit"
	depends on SOC_SERIES_XMC_1XXX
	select SOC_PART_NUMBER_F100X0200
```

## boards/arm/xmc14_arduino_kit/Kconfig.defconfig
```kconfig
# SPDX-License-Identifier: Apache-2.0
#
# Copyright (c) 2021 Linumiz
# Author: Parthiban Nallathambi <parthiban@linumiz.com>

if BOARD_XMC14_ARDUINO_KIT

config BOARD
	default "xmc14_arduino_kit"

endif # BOARD_XMC14_ARDUINO_KIT
```

## boards/arm/xmc14_arduino_kit/xmc14_arduino_kit_defconfig
```kconfig
# SPDX-License-Identifier: Apache-2.0
#
# Copyright (c) 2021 Linumiz
# Author: Parthiban Nallathambi <parthiban@linumiz.com>

CONFIG_BOARD_XMC14_ARDUINO_KIT=y
CONFIG_SOC_SERIES_XMC_1XXX=y
CONFIG_SOC_XMC1400=y

# enable uart driver
CONFIG_SERIAL=y
CONFIG_UART_XMC=y

# enable console
CONFIG_CONSOLE=y
CONFIG_UART_CONSOLE=y
```

## boards/arm/xmc45_relax_kit/Kconfig.board
```kconfig
# SPDX-License-Identifier: Apache-2.0
#
# Copyright (c) 2020 Linumiz
# Author: Parthiban Nallathambi <parthiban@linumiz.com>

config BOARD_XMC45_RELAX_KIT
	bool "Infineon Relax Kit"
	depends on SOC_SERIES_XMC_4XXX
	select SOC_PART_NUMBER_F100X1024
```

## boards/arm/xmc45_relax_kit/Kconfig.defconfig
```kconfig
# SPDX-License-Identifier: Apache-2.0
#
# Copyright (c) 2020 Linumiz
# Author: Parthiban Nallathambi <parthiban@linumiz.com>

if BOARD_XMC45_RELAX_KIT

config BOARD
	default "xmc45_relax_kit"

endif # BOARD_XMC45_RELAX_KIT
```

## boards/arm/xmc45_relax_kit/Kconfig.xmc45_relax_kit
```kconfig
# Copyright (c) 2022 Zephyr Project members and individual contributors
# SPDX-License-Identifier: Apache-2.0

config BOARD_XMC45_RELAX_KIT
	bool
	default y
	select SOC_SERIES_XMC_4XXX
	select SOC_XMC4500
	select SOC_PART_NUMBER_F100X1024
```

## boards/arm/xmc45_relax_kit/xmc45_relax_kit_defconfig
```kconfig
# SPDX-License-Identifier: Apache-2.0
#
# Copyright (c) 2020 Linumiz
# Author: Parthiban Nallathambi <parthiban@linumiz.com>

CONFIG_BOARD_XMC45_RELAX_KIT=y
CONFIG_SOC_SERIES_XMC_4XXX=y
CONFIG_SOC_XMC4500=y
CONFIG_ARM_MPU=y

# enable uart driver
CONFIG_SERIAL=y

# enable console
CONFIG_CONSOLE=y
CONFIG_UART_CONSOLE=y
CONFIG_USE_DT_CODE_PARTITION=y
```

## boards/arm/xmc47_relax_kit/Kconfig.defconfig
```kconfig
# SPDX-License-Identifier: Apache-2.0
#
# Copyright (c) 2023 Schlumberger

if BOARD_XMC47_RELAX_KIT

config BOARD
	default "xmc47_relax_kit"

endif
```

## boards/arm/xmc47_relax_kit/xmc47_relax_kit_defconfig
```kconfig
# SPDX-License-Identifier: Apache-2.0
#
# Copyright (c) 2023 Schlumberger

CONFIG_BOARD_XMC47_RELAX_KIT=y
CONFIG_SOC_SERIES_XMC_4XXX=y
CONFIG_SOC_XMC4700=y

# enable uart driver
CONFIG_SERIAL=y

# enable console
CONFIG_CONSOLE=y
CONFIG_UART_CONSOLE=y
CONFIG_USE_DT_CODE_PARTITION=y
```

## boards/arm/xmc4800_automation_board_v2/Kconfig.board
```kconfig
# SPDX-License-Identifier: Apache-2.0
#
# Copyright (c) 2023 Andriy Gelman

config BOARD_XMC4800_AUTOMATION_V2
	bool "XMC4800 Automation board"
	depends on SOC_SERIES_XMC_4XXX
	select SOC_PART_NUMBER_E196X2048
```

## boards/arm/xmc4800_automation_board_v2/Kconfig.defconfig
```kconfig
# SPDX-License-Identifier: Apache-2.0
#
# Copyright (c) 2023 Andriy Gelman

if BOARD_XMC4800_AUTOMATION_V2

config BOARD
	default "xmc4800_automation_board_v2"

endif
```

## boards/arm/xmc4800_automation_board_v2/xmc4800_automation_board_v2_defconfig
```kconfig
# SPDX-License-Identifier: Apache-2.0
#
# Copyright (c) 2023 Andriy Gelman

CONFIG_BOARD_XMC4800_AUTOMATION_V2=y
CONFIG_SOC_SERIES_XMC_4XXX=y
CONFIG_SOC_XMC4800=y
CONFIG_ARM_MPU=y

# enable uart driver
CONFIG_SERIAL=y

# enable console
CONFIG_CONSOLE=y
CONFIG_UART_CONSOLE=y
CONFIG_USE_DT_CODE_PARTITION=y
```

## boards/arm/zb_acrux_vp1_0_revb/Kconfig
```kconfig
# Kconfig - ZB_ACRUX_VP1_0_REVB board configuration
#
# Copyright (c) 2019 ZedBlox Logitech Pvt Ltd
#
# SPDX-License-Identifier: Apache-2.0

config BOARD_ENABLE_DCDC
    bool "Enable DCDC mode"
    select SOC_DCDC_NRF52X
    default y
    depends on BOARD_ZB_ACRUX_VP1_0_REVB
```

## boards/arm/zb_acrux_vp1_0_revb/Kconfig.board
```kconfig
# Kconfig - nRF52840 PCA10056 board configuration
#
# Copyright (c) 2016 Nordic Semiconductor ASA
#
# SPDX-License-Identifier: Apache-2.0

config  BOARD_ZB_ACRUX_VP1_0_REVB
	bool "ZB ACRUX vP1.0 REVB"
	depends on SOC_NRF52840_QIAA
```

## boards/arm/zb_acrux_vp1_0_revb/Kconfig.defconfig
```kconfig
# Kconfig - ZB_ACRUX_VP1_0_REVB board configuration
#
# SPDX-License-Identifier: Apache-2.0

if BOARD_ZB_ACRUX_VP1_0_REVB

config BOARD
	default "zb_acrux_vp1_0_revb"

if USB

config USB_NRFX
	default y

config USB_DEVICE_STACK
	default y

endif # USB

config IEEE802154_NRF5
	default y
	depends on IEEE802154

config BT_CTLR
	default BT

endif
```

## boards/arm/zb_acrux_vp1_0_revb/zb_acrux_vp1_0_revb_defconfig
```kconfig
# SPDX-License-Identifier: Apache-2.0

CONFIG_SOC_SERIES_NRF52X=y
CONFIG_SOC_NRF52840_QIAA=y
CONFIG_BOARD_ZB_ACRUX_VP1_0_REVB=y

# Enable MPU
CONFIG_ARM_MPU=y

# additional board options
CONFIG_GPIO=y
CONFIG_GPIO_AS_PINRESET=n

# enable uart driver
CONFIG_SERIAL=y
```
