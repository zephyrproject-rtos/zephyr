## boards/arm/stm32f072b_disco/Kconfig.defconfig
```kconfig
# STM32F072B-DISCO board configuration

# Copyright (c) 2017 Clage GmbH
# SPDX-License-Identifier: Apache-2.0

if BOARD_STM32F072B_DISCO

config BOARD
	default "stm32f072b_disco"

config SPI_STM32_INTERRUPT
	default y
	depends on SPI

endif # BOARD_STM32F072B_DISCO
```

## boards/arm/stm32f0_disco/Kconfig.board
```kconfig
# STM32F0DISCOVERY development board with STM32F051R8 MCU

# Copyright (c) 2018 Nathan Tsoi <nathan@vertile.com>
# SPDX-License-Identifier: Apache-2.0

config BOARD_STM32F0_DISCO
	def_bool "$(BOARD)" = "stm32f0_disco"
	depends on SOC_STM32F051X8
```

## boards/arm/stm32f0_disco/Kconfig.defconfig
```kconfig
# STM32F0 development board with STM32F051R8T6 MCU

# Copyright (c) 2018 Nathan Tsoi <nathan@vertile.com>
# SPDX-License-Identifier: Apache-2.0

if BOARD_STM32F0_DISCO

config BOARD
	default "stm32f0_disco"

endif # BOARD_STM32F0_DISCO
```

## boards/arm/stm32f103_mini/Kconfig.board
```kconfig
# STM32F103RCT6 Mini board configuration

# Copyright (c) 2020 WuhanStudio
# SPDX-License-Identifier: Apache-2.0

config BOARD_STM32F103_MINI
	bool "STM32F103RCT6 Mini Board"
	depends on SOC_STM32F103XE
```

## boards/arm/stm32f103_mini/Kconfig.defconfig
```kconfig
# STM32F103RCT6 Mini board configuration

# Copyright (c) 2020 WuhanStudio
# SPDX-License-Identifier: Apache-2.0

if BOARD_STM32F103_MINI

config BOARD
	default "stm32f103_mini"

endif # BOARD_STM32F103_mini
```

## boards/arm/stm32f103_mini/Kconfig.stm32f103_mini
```kconfig
# Copyright (c) 2022 Zephyr Project members and individual contributors
# SPDX-License-Identifier: Apache-2.0

config BOARD_STM32F103_MINI
	bool
	default y
	select SOC_SERIES_STM32F1X
	select SOC_STM32F103XE
```

## boards/arm/stm32f103_mini/stm32f103_mini_defconfig
```kconfig
# SPDX-License-Identifier: Apache-2.0

CONFIG_SOC_SERIES_STM32F1X=y
CONFIG_SOC_STM32F103XE=y
# 72MHz system clock
CONFIG_SYS_CLOCK_HW_CYCLES_PER_SEC=72000000

# enable uart driver
CONFIG_SERIAL=y
# enable console
CONFIG_CONSOLE=y
CONFIG_UART_CONSOLE=y

# enable pinmux
CONFIG_PINMUX=y

# enable GPIO
CONFIG_GPIO=y

# clock configuration
CONFIG_CLOCK_CONTROL=y
CONFIG_CLOCK_STM32_SYSCLK_SRC_PLL=y
# Use the internal 8MHz clock
CONFIG_CLOCK_STM32_PLL_SRC_HSI=y
# produce 72MHz clock at PLL output
CONFIG_CLOCK_STM32_PLL_MULTIPLIER=9
CONFIG_CLOCK_STM32_AHB_PRESCALER=1
# APB1 clock must not to exceed 36MHz limit
CONFIG_CLOCK_STM32_APB1_PRESCALER=2
CONFIG_CLOCK_STM32_APB2_PRESCALER=1
```

## boards/arm/stm32f334_disco/Kconfig.board
```kconfig
# STM32F3DISCOVERY board configuration

# Copyright (c) 2017 I-SENSE group of ICCS
# SPDX-License-Identifier: Apache-2.0

config BOARD_STM32F334_DISCO
	bool "STM32F334DISCOVERY Development Board"
	depends on SOC_STM32F334X8
```

## boards/arm/stm32f334_disco/Kconfig.defconfig
```kconfig
# STM32F334DISCOVERY board configuration

# Copyright (c) 2017 I-SENSE group of ICCS
# SPDX-License-Identifier: Apache-2.0

if BOARD_STM32F334_DISCO

config BOARD
	default "stm32f334_disco"

config UART_2
	default y
	depends on UART_CONSOLE

if I2C

config I2C_1
	default y

endif # I2C

if SPI

config SPI_1
	default y

endif # SPI

endif # BOARD_STM32F334_DISCO
```

## boards/arm/stm32f3_disco/Kconfig.board
```kconfig
# STM32F3DISCOVERY board configuration

# Copyright (c) 2017 I-SENSE group of ICCS
# SPDX-License-Identifier: Apache-2.0

config BOARD_STM32F3_DISCO
	bool "STM32F3DISCOVERY Development Board"
	depends on SOC_STM32F303XC
```

## boards/arm/stm32f3_disco/Kconfig.defconfig
```kconfig
# STM32F3DISCOVERY board configuration

# Copyright (c) 2017 I-SENSE group of ICCS
# SPDX-License-Identifier: Apache-2.0

if BOARD_STM32F3_DISCO

config BOARD
	default "stm32f3_disco"

config I2C
	default y if SENSOR

endif # BOARD_STM32F3_DISCO
```

## boards/arm/stm32f3_disco/Kconfig.stm32f3_disco
```kconfig
# Copyright (c) 2022 Zephyr Project members and individual contributors
# SPDX-License-Identifier: Apache-2.0

config BOARD_STM32F3_DISCO
	bool
	default y
	select SOC_SERIES_STM32F3X
	select SOC_STM32F303XC
```

## boards/arm/stm32f3_disco/stm32f3_disco_defconfig
```kconfig
# SPDX-License-Identifier: Apache-2.0

CONFIG_SOC_SERIES_STM32F3X=y
CONFIG_SOC_STM32F303XC=y
# 72MHz system clock
CONFIG_SYS_CLOCK_HW_CYCLES_PER_SEC=72000000

# Floating Point Options
CONFIG_FPU=y

# Enable MPU
CONFIG_ARM_MPU=y

# enable uart driver
CONFIG_SERIAL=y

# enable console
CONFIG_CONSOLE=y
CONFIG_UART_CONSOLE=y

# enable pinmux
CONFIG_PINMUX=y

# enable GPIO
CONFIG_GPIO=y

# clock configuration
CONFIG_CLOCK_CONTROL=y

# Clock configuration for Cube Clock control driver
CONFIG_CLOCK_STM32_HSE_CLOCK=8000000
CONFIG_CLOCK_STM32_SYSCLK_SRC_PLL=y
# use HSE as PLL input
CONFIG_CLOCK_STM32_PLL_SRC_HSE=y
# however, the board does not have an external oscillator, so just use
# the 8MHz clock signal coming from integrated STLink
CONFIG_CLOCK_STM32_HSE_BYPASS=y
# produce 72MHz clock at PLL output
CONFIG_CLOCK_STM32_PLL_PREDIV=1
CONFIG_CLOCK_STM32_PLL_MULTIPLIER=9
CONFIG_CLOCK_STM32_AHB_PRESCALER=1
CONFIG_CLOCK_STM32_APB1_PRESCALER=2
CONFIG_CLOCK_STM32_APB2_PRESCALER=1
```

## boards/arm/stm32f3_seco_d23/Kconfig.board
```kconfig
# SECO SBC-D23 board configuration

# Copyright (c) 2022, SECO Spa
# SPDX-License-Identifier: Apache-2.0

config BOARD_STM32F3_SECO_D23
	bool "SECO JUNO SBC-D23 (STM32F302VC) Board"
	depends on SOC_STM32F302XC
```

## boards/arm/stm32f3_seco_d23/Kconfig.defconfig
```kconfig
# SECO SBC-D23 board configuration

# Copyright (c) 2022, SECO Spa
# SPDX-License-Identifier: Apache-2.0

if BOARD_STM32F3_SECO_D23

config BOARD
	default "stm32f3_seco_d23"

endif # BOARD_STM32F3_SECO_D23
```

## boards/arm/stm32f3_seco_d23/stm32f3_seco_d23_defconfig
```kconfig
# SPDX-License-Identifier: Apache-2.0
# SECO SBC-D23 board defconfig
#
# Copyright (c) 2022, SECO Spa

CONFIG_SOC_SERIES_STM32F3X=y
CONFIG_SOC_STM32F302XC=y

# Enable MPU
CONFIG_ARM_MPU=y

# Enable HW stack protection
CONFIG_HW_STACK_PROTECTION=y

# enable uart driver
CONFIG_SERIAL=y

# enable console
CONFIG_CONSOLE=y
CONFIG_UART_CONSOLE=y

# enable GPIO
CONFIG_GPIO=y

# clock configuration
CONFIG_CLOCK_CONTROL=y

# enable regulators
CONFIG_REGULATOR=y

# enable pin controller
CONFIG_PINCTRL=y
```

## boards/arm/stm32f401_mini/Kconfig.board
```kconfig
# Copyright (c) 2022 Brian Bradley
# SPDX-License-Identifier: Apache-2.0

# STM32 Mini F401 Board

config BOARD_STM32F401_MINI
	bool "STM32 Mini F401 Board"
	depends on SOC_STM32F401XC
```

## boards/arm/stm32f401_mini/Kconfig.defconfig
```kconfig
# Copyright (c) 2022 Brian Bradley
# SPDX-License-Identifier: Apache-2.0

# STM32 Mini F401 board definitions

config SPI_STM32_INTERRUPT
	default y
	depends on SPI
```

## boards/arm/stm32f407g_disc1/Kconfig.board
```kconfig
# Kconfig - STM32F407G-DISC1 Discovery board configuration
#
# Copyright (c) 2018 Intel Corporation
#
# SPDX-License-Identifier: Apache-2.0
#

config BOARD_STM32F407G_DISC1
	bool "STM32F407G-DISC1 Discovery Development Board"
	depends on SOC_STM32F407XG
```

## boards/arm/stm32f407g_disc1/Kconfig.defconfig
```kconfig
# Kconfig - STM32F407G-DISC1 Discovery board configuration
#
# Copyright (c) 2018 Intel Corporation
#
# SPDX-License-Identifier: Apache-2.0
#

if BOARD_STM32F407G_DISC1

config BOARD
	default "stm32f407g_disc1"

if UART_CONSOLE

config UART_STM32_PORT_2
	default y

endif # UART_CONSOLE

if PWM

config PWM_STM32_2
	default y

endif # PWM

endif # BOARD_STM32F407G_DISC1
```

## boards/arm/stm32f411e_disco/Kconfig.board
```kconfig
# STM32F411E-DISCO development board

# Copyright (c) 2017 Fenix Engineering Solutions
# SPDX-License-Identifier: Apache-2.0

config BOARD_STM32F411E_DISCO
	def_bool "$(BOARD)" = "stm32f411e_disco"
	depends on SOC_STM32F411XE
```

## boards/arm/stm32f411e_disco/Kconfig.defconfig
```kconfig
# STM32F411E-DISCO board configuration

# Copyright (c) 2017 Fenix Engineering Solutions
# SPDX-License-Identifier: Apache-2.0

if BOARD_STM32F411E_DISCO

config BOARD
	default "stm32f411e_disco"

config PWM_STM32_4
	default y
	depends on PWM

endif # BOARD_STM32F411E_DISCO
```

## boards/arm/stm32f411e_disco/stm32f411e_disco_defconfig
```kconfig
# SPDX-License-Identifier: Apache-2.0

CONFIG_ARM=y
CONFIG_BOARD_STM32F411E_DISCO=y
CONFIG_SOC_SERIES_STM32F4X=y
CONFIG_SOC_STM32F411XE=y
# 100MHz system clock (highest value to get a precise USB clock should be 96MHz)
CONFIG_SYS_CLOCK_HW_CYCLES_PER_SEC=100000000

# Enable MPU
CONFIG_ARM_MPU=y

# Serial Drivers
CONFIG_SERIAL=y
CONFIG_UART_INTERRUPT_DRIVEN=y
CONFIG_CONSOLE=y
CONFIG_UART_CONSOLE=y

# enable pinmux
CONFIG_PINMUX=y

# enable GPIO
CONFIG_GPIO=y

# clock configuration
CONFIG_CLOCK_CONTROL=y
# SYSCLK selection
CONFIG_CLOCK_STM32_SYSCLK_SRC_PLL=y
# HSE configuration
CONFIG_CLOCK_STM32_HSE_CLOCK=8000000
# use HSE as PLL input
CONFIG_CLOCK_STM32_PLL_SRC_HSE=y
# produce 100MHz clock at PLL output
CONFIG_CLOCK_STM32_PLL_M_DIVISOR=4
CONFIG_CLOCK_STM32_PLL_N_MULTIPLIER=100
CONFIG_CLOCK_STM32_PLL_P_DIVISOR=2
CONFIG_CLOCK_STM32_PLL_Q_DIVISOR=8
CONFIG_CLOCK_STM32_AHB_PRESCALER=1
CONFIG_CLOCK_STM32_APB1_PRESCALER=2
CONFIG_CLOCK_STM32_APB2_PRESCALER=1
```

## boards/arm/stm32f412g_disco/Kconfig.board
```kconfig
# STM32F412G-DISCO development board

# SPDX-License-Identifier: Apache-2.0

config BOARD_STM32F412G_DISCO
	def_bool "$(BOARD)" = "stm32f412g_disco"
	depends on SOC_STM32F412ZG
```

## boards/arm/stm32f412g_disco/Kconfig.defconfig
```kconfig
# Kconfig - STM32F412G-DISCO board configuration
#
# SPDX-License-Identifier: Apache-2.0
#

if BOARD_STM32F412G_DISCO

config BOARD
	default "stm32f412g_disco"

if UART_CONSOLE

config UART_STM32_PORT_2
	default y

endif # UART_CONSOLE

endif # BOARD_STM32F412G_DISCO
```
