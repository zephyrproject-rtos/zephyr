/*
 * Copyright (c) 2022 Intel Corporation
 *
 * SPDX-License-Identifier: Apache-2.0
 */

/dts-v1/;

#include <atmel/same70q21.dtsi>

#include "tdk_robokit1-common.dtsi"

/ {
	model = "TDK RoboKit1";
	compatible = "tdk,robokit1", "atmel,same70q21", "atmel,same70";
};
