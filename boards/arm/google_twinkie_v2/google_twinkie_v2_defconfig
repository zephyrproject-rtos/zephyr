## boards/arm/google_twinkie_v2/google_twinkie_v2_defconfig
```kconfig
# Copyright 2022 The Chromium OS Authors
#
# SPDX-License-Identifier: Apache-2.0



CONFIG_SOC_SERIES_STM32G0X=y
CONFIG_SOC_STM32G0B1XX=y

# Serial Drivers
#CONFIG_SERIAL=y
#CONFIG_UART_INTERRUPT_DRIVEN=y

# enable console
#CONFIG_CONSOLE=y
#CONFIG_UART_CONSOLE=y

# GPIO Controller
CONFIG_GPIO=y

# Enable Clocks
CONFIG_CLOCK_CONTROL=y

# enable pin controller
CONFIG_PINCTRL=y

# Enable MPU
CONFIG_ARM_MPU=y

#CONFIG_USB_DEVICE_VID=18d1
#CONFIG_USB_DEVICE_PID=1234
#CONFIG_USB_DEVICE_SN="123456789"
#CONFIG_USB_DEVICE_MANUFACTURER="Google"
#CONFIG_USB_DEVICE_PRODUCT="TwinkieV2"

#CONFIG_BOOTLOADER_MCUBOOT=y
#CONFIG_USB_DEVICE_STACK=y
#CONFIG_USB_DFU_CLASS=y
#CONFIG_IMG_MANAGER=y
#CONFIG_FLASH=y
#CONFIG_FLASH_PAGE_LAYOUT=y
```

## boards/arm/hexiwear_k64/Kconfig
```kconfig
# Hexiwear K64 board

# Copyright (c) 2017, NXP
# SPDX-License-Identifier: Apache-2.0

config BATTERY_SENSE
	bool "Enable the battery sense circuit"
	depends on BOARD_HEXIWEAR_K64
```

## boards/arm/hexiwear_k64/Kconfig.board
```kconfig
# Hexiwear K64 board

# Copyright (c) 2016, Freescale Semiconductor, Inc.
# SPDX-License-Identifier: Apache-2.0

config BOARD_HEXIWEAR_K64
	bool "NXP Hexiwear K64"
	depends on SOC_SERIES_KINETIS_K6X
	select SOC_PART_NUMBER_MK64FN1M0VDC12
```

## boards/arm/hexiwear_k64/Kconfig.defconfig
```kconfig
# Hexiwear K64 board

# Copyright (c) 2016, Freescale Semiconductor, Inc.
# SPDX-License-Identifier: Apache-2.0

if BOARD_HEXIWEAR_K64

config BOARD
	default "hexiwear_k64"

config OSC_XTAL0_FREQ
	default 12000000

config MCG_PRDIV0
	default 0x02

config MCG_VDIV0
	default 0x06

config MCG_FCRDIV
	default 1

config REGULATOR
	default y if ADC || SENSOR

endif # BOARD_HEXIWEAR_K64
```

## boards/arm/hexiwear_k64/hexiwear_k64_defconfig
```kconfig
# SPDX-License-Identifier: Apache-2.0

CONFIG_SOC_MK64F12=y
CONFIG_SOC_SERIES_KINETIS_K6X=y
CONFIG_BOARD_HEXIWEAR_K64=y
CONFIG_CONSOLE=y
CONFIG_UART_CONSOLE=y
CONFIG_SERIAL=y
CONFIG_GPIO=y
CONFIG_PINCTRL=y
CONFIG_SYS_CLOCK_HW_CYCLES_PER_SEC=120000000
CONFIG_OSC_LOW_POWER=y
CONFIG_ARM_MPU=y
CONFIG_HW_STACK_PROTECTION=y
```

## boards/arm/hexiwear_kw40z/Kconfig.board
```kconfig
# Hexiwear KW40Z board

# Copyright (c) 2017, NXP
# SPDX-License-Identifier: Apache-2.0

config BOARD_HEXIWEAR_KW40Z
	def_bool "$(BOARD)" = "hexiwear_kw40z"
	depends on SOC_SERIES_KINETIS_KWX
	select SOC_PART_NUMBER_MKW40Z160VHT4
```

## boards/arm/hexiwear_kw40z/Kconfig.defconfig
```kconfig
# Hexiwear KW40Z board

# Copyright (c) 2017, NXP
# SPDX-License-Identifier: Apache-2.0

if BOARD_HEXIWEAR_KW40Z

config BOARD
	default "hexiwear_kw40z"

config OSC_XTAL0_FREQ
	default 32000000

config MCG_FRDIV
	default 5

config MCG_FCRDIV
	default 0

if PINMUX_MCUX

config PINMUX_MCUX_PORTA
	default y

config PINMUX_MCUX_PORTB
	default y if "$(dt_nodelabel_enabled,adc0)" && ADC

config PINMUX_MCUX_PORTC
	default y if "$(dt_nodelabel_enabled,lpuart0)" && SERIAL
	default y if "$(dt_nodelabel_enabled,i2c1)" && I2C

endif # PINMUX_MCUX

endif # BOARD_HEXIWEAR_KW40Z
```

## boards/arm/hexiwear_kw40z/Kconfig.hexiwear_kw40z
```kconfig
# Copyright (c) 2022 Zephyr Project members and individual contributors
# SPDX-License-Identifier: Apache-2.0

config BOARD_HEXIWEAR_KW40Z
	bool
	default y
	select SOC_MKW40Z4
	select SOC_SERIES_KINETIS_KWX
	select SOC_PART_NUMBER_MKW40Z160VHT4
```

## boards/arm/hexiwear_kw40z/hexiwear_kw40z_defconfig
```kconfig
# SPDX-License-Identifier: Apache-2.0

CONFIG_ARM=y
CONFIG_SOC_MKW40Z4=y
CONFIG_SOC_SERIES_KINETIS_KWX=y
CONFIG_BOARD_HEXIWEAR_KW40Z=y
CONFIG_CONSOLE=y
CONFIG_RTT_CONSOLE=y
CONFIG_USE_SEGGER_RTT=y
CONFIG_CORTEX_M_SYSTICK=y
CONFIG_PINMUX=y
CONFIG_GPIO=y
CONFIG_SYS_CLOCK_HW_CYCLES_PER_SEC=40000000
CONFIG_OSC_EXTERNAL=y
```

## boards/arm/holyiot_yj16019/Kconfig.board
```kconfig
# Holyiot YJ-16019 board configuration

# Copyright (c) 2019 Henrik Brix Andersen <henrik@brixandersen.dk>
# SPDX-License-Identifier: Apache-2.0

config BOARD_HOLYIOT_YJ16019
	def_bool "$(BOARD)" = "holyiot_yj16019"
	depends on SOC_NRF52832_QFAA
```

## boards/arm/holyiot_yj16019/Kconfig.defconfig
```kconfig
# Holyiot YJ-16019 board configuration

# Copyright (c) 2019 Henrik Brix Andersen <henrik@brixandersen.dk>
# SPDX-License-Identifier: Apache-2.0

config GPIO_AS_PINRESET
	default n

config BT_CTLR
	default BT
```

## boards/arm/holyiot_yj16019/holyiot_yj16019_defconfig
```kconfig
CONFIG_SOC_SERIES_NRF52X=y
CONFIG_SOC_NRF52832_QFAA=y
CONFIG_BOARD_HOLYIOT_YJ16019=y

# 32kHz clock source
CONFIG_CLOCK_CONTROL_NRF_K32SRC_RC=y

# Enable MPU
CONFIG_ARM_MPU=y

# Enable RTT
CONFIG_USE_SEGGER_RTT=y

# Enable GPIO
CONFIG_GPIO=y

CONFIG_PINCTRL=y
```

## boards/arm/ip_k66f/Kconfig.board
```kconfig
# Copyright (c) 2020 DENX Software Engineering GmbH
# SPDX-License-Identifier: Apache-2.0

config BOARD_IP_K66F
	bool "Segger IP-K66F"
	depends on SOC_SERIES_KINETIS_K6X
	select SOC_PART_NUMBER_MK66FN2M0VMD18
```

## boards/arm/ip_k66f/Kconfig.defconfig
```kconfig
# IP-K66F board

# Copyright (c) 2020 DENX Software Engineering GmbH
# SPDX-License-Identifier: Apache-2.0

if BOARD_IP_K66F

config BOARD
	default "ip_k66f"

config OSC_XTAL0_FREQ
	default 12000000

config MCG_PRDIV0
	default 0x0

config MCG_VDIV0
	default 0xe

config MCG_FCRDIV
	default 1

if NETWORKING

config NET_L2_ETHERNET
	default y

config ETH_MCUX
	default y if NET_L2_ETHERNET

config ETH_MCUX_RMII_EXT_CLK
	default y if ETH_MCUX

config ETH_MCUX_NO_PHY_SMI
	default y if ETH_MCUX

endif # NETWORKING

if NET_DSA

config DSA_KSZ8794
	default y if SPI

endif # NET_DSA

endif # BOARD_IP_K66F
```

## boards/arm/ip_k66f/Kconfig.ip_k66f
```kconfig
# Copyright (c) 2022 Zephyr Project members and individual contributors
# SPDX-License-Identifier: Apache-2.0

config BOARD_IP_K66F
	bool
	default y
	select SOC_MK66F18
	select SOC_SERIES_KINETIS_K6X
	select SOC_PART_NUMBER_MK66FN2M0VMD18
```

## boards/arm/ip_k66f/ip_k66f_defconfig
```kconfig
# SPDX-License-Identifier: Apache-2.0

CONFIG_SOC_MK66F18=y
CONFIG_SOC_SERIES_KINETIS_K6X=y
CONFIG_BOARD_IP_K66F=y
CONFIG_CORTEX_M_SYSTICK=y
CONFIG_GPIO=y
CONFIG_PINCTRL=y
CONFIG_SYS_CLOCK_HW_CYCLES_PER_SEC=180000000
CONFIG_OSC_LOW_POWER=y
CONFIG_USE_SEGGER_RTT=y

# Add RTT console support
CONFIG_CONSOLE=y
CONFIG_RTT_CONSOLE=y
CONFIG_SEGGER_RTT_BUFFER_SIZE_DOWN=64

# Enable MPU
CONFIG_ARM_MPU=y
CONFIG_HW_STACK_PROTECTION=y

# The KSZ8794 needs SPI to get MII registers data
CONFIG_SPI=y
```

## boards/arm/ks_zion/Kconfig.board
```kconfig
# Kernelspace Zion board configuration

# Copyright (c) 2024 - Kernelspace
# SPDX-License-Identifier: Apache-2.0

config BOARD_KS_ZION
	bool "Kernelspace Zion Development Board"
	depends on SOC_STM32F303X8
```

## boards/arm/ks_zion/Kconfig.defconfig
```kconfig
# Kernelspace Zion board configuration

# Copyright (c) 2024 - Kernelspace
# SPDX-License-Identifier: Apache-2.0

if BOARD_KS_ZION

config BOARD
	default "ks_zion"

endif # BOARD_KS_ZION
```

## boards/arm/kv260_r5/Kconfig.board
```kconfig
# Copyright (c) 2022 Linaro.
# SPDX-License-Identifier: Apache-2.0

config BOARD_KV260_R5
	bool "Xilinx KV260 development board R5-core"
	depends on SOC_XILINX_ZYNQMP_RPU
```

## boards/arm/kv260_r5/Kconfig.defconfig
```kconfig
# Copyright (c) 2022 Linaro.
# SPDX-License-Identifier: Apache-2.0

if BOARD_KV260_R5

config BUILD_OUTPUT_BIN
	default y

config BOARD
	default "board_kv260_r5"

if USERSPACE

config COMPILER_ISA_THUMB2
	default n

endif

endif # BOARD_KV260_R5
```

## boards/arm/legend/Kconfig.board
```kconfig
# Legend board family configuration

# Copyright (c) 2021 Seagate Technology
# SPDX-License-Identifier: Apache-2.0

config BOARD_LEGEND
	bool "Legend board"
	depends on SOC_STM32F070XB
```

## boards/arm/legend/Kconfig.defconfig
```kconfig
# Legend board family configuration

# Copyright (c) 2021, Seagate Technology LLC
# SPDX-License-Identifier: Apache-2.0

if BOARD_LEGEND

config BOARD
	default "legend"

config SPI_STM32_INTERRUPT
	default y
	depends on SPI

endif # BOARD_LEGEND
```

## boards/arm/legend/legend_defconfig
```kconfig
# SPDX-License-Identifier: Apache-2.0

# Zephyr Kernel Configuration
CONFIG_SOC_SERIES_STM32F0X=y

# Platform Configuration
CONFIG_SOC_STM32F070XB=y

# Serial Drivers
CONFIG_SERIAL=y
CONFIG_UART_INTERRUPT_DRIVEN=y
# enable console
CONFIG_CONSOLE=y
CONFIG_UART_CONSOLE=y

# GPIO Controller
CONFIG_GPIO=y

# Clock Control
CONFIG_CLOCK_CONTROL=y

# enable pin controller
CONFIG_PINCTRL=y
```

## boards/arm/legend25/Kconfig.board
```kconfig
# Legend 2.5" board family configuration

# Copyright (c) 2021 Seagate Technology
# SPDX-License-Identifier: Apache-2.0

config BOARD_LEGEND25_HDD
	bool "Legend 2.5 HDD board"
	depends on SOC_STM32F070XB

config BOARD_LEGEND25_SSD
	bool "Legend 2.5 SSD board"
	depends on SOC_STM32F070XB
```
