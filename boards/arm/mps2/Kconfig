## boards/arm/mps2/Kconfig
```kconfig
# Copyright (c) 2017 Linaro Limited
# Copyright 2024 Arm Limited and/or its affiliates <open-source-office@arm.com>
# SPDX-License-Identifier: Apache-2.0

config BOARD_MPS2
	select HAS_COVERAGE_SUPPORT
	select QEMU_TARGET if BOARD_MPS2_AN385 || BOARD_MPS2_AN521_CPU0 || BOARD_MPS2_AN521_CPU0_NS || BOARD_MPS2_AN521_CPU1
	select TRUSTED_EXECUTION_NONSECURE if BOARD_MPS2_AN521_CPU0_NS
```

## boards/arm/mps2/Kconfig.defconfig
```kconfig
# Copyright (c) 2017 Linaro Limited
# SPDX-License-Identifier: Apache-2.0

if BOARD_MPS2_AN385

if SERIAL

config UART_INTERRUPT_DRIVEN
	default y

endif # SERIAL

config ZTEST_STACK_SIZE
	default 4096 if ZTEST

if COVERAGE_GCOV

config MAIN_STACK_SIZE
	default 4096

config IDLE_STACK_SIZE
	default 4096

config PRIVILEGED_STACK_SIZE
	default 4096

config ISR_STACK_SIZE
	default 4096

config TEST_EXTRA_STACK_SIZE
	default 4096

endif # COVERAGE_GCOV

endif

if BOARD_MPS2_AN521_CPU0 || BOARD_MPS2_AN521_CPU0_NS || BOARD_MPS2_AN521_CPU1

# MPU-based null-pointer dereferencing detection cannot
# be applied as the (0x0 - 0x400) is unmapped but QEMU
# will still permit bus access.
choice NULL_POINTER_EXCEPTION_DETECTION
	bool
	default NULL_POINTER_EXCEPTION_DETECTION_NONE if QEMU_TARGET

endchoice

# By default, if we build for a Non-Secure version of the board,
# force building with TF-M as the Secure Execution Environment.
config BUILD_WITH_TFM
	default y if TRUSTED_EXECUTION_NONSECURE

if SERIAL

config UART_INTERRUPT_DRIVEN
	default y

endif # SERIAL

endif
```

## boards/arm/mps2/Kconfig.mps2
```kconfig
# Copyright (c) 2017 Linaro Limited
# Copyright 2024 Arm Limited and/or its affiliates <open-source-office@arm.com>
# SPDX-License-Identifier: Apache-2.0

config BOARD_MPS2
	select SOC_MPS2_AN383 if BOARD_MPS2_AN383
	select SOC_MPS2_AN385 if BOARD_MPS2_AN385
	select SOC_MPS2_AN386 if BOARD_MPS2_AN386
	select SOC_MPS2_AN500 if BOARD_MPS2_AN500
	select SOC_MPS2_AN521_CPU0 if BOARD_MPS2_AN521_CPU0
	select SOC_MPS2_AN521_CPU0 if BOARD_MPS2_AN521_CPU0_NS
	select SOC_MPS2_AN521_CPU1 if BOARD_MPS2_AN521_CPU1
```

## boards/arm/mps2/board.yml
```yaml
board:
  name: mps2
  full_name: V2M MPS2
  vendor: arm
  socs:
  - name: an383
  - name: an385
  - name: an386
  - name: an500
  - name: an521
    variants:
    - name: ns
      cpucluster: cpu0
```

## boards/arm/mps2/mps2_an383_defconfig
```kconfig
#
# Copyright 2024 Arm Limited and/or its affiliates <open-source-office@arm.com>
#
# SPDX-License-Identifier: Apache-2.0
#

CONFIG_RUNTIME_NMI=y

# GPIOs
CONFIG_GPIO=y

# Serial
CONFIG_CONSOLE=y
CONFIG_UART_CONSOLE=y
CONFIG_SERIAL=y

CONFIG_ARM_MPU=y

# 0x0 is a valid address, we cannot prevent access to that area
CONFIG_NULL_POINTER_EXCEPTION_DETECTION_NONE=y
```

## boards/arm/mps2/mps2_an385_defconfig
```kconfig
#
# Copyright (c) 2017 Linaro Limited
#
# SPDX-License-Identifier: Apache-2.0
#

CONFIG_RUNTIME_NMI=y
CONFIG_QEMU_ICOUNT_SHIFT=7

# GPIOs
CONFIG_GPIO=y

# Serial
CONFIG_CONSOLE=y
CONFIG_UART_CONSOLE=y
CONFIG_SERIAL=y

CONFIG_ARM_MPU=y
```

## boards/arm/mps2/mps2_an386_defconfig
```kconfig
#
# Copyright 2024 Arm Limited and/or its affiliates <open-source-office@arm.com>
#
# SPDX-License-Identifier: Apache-2.0
#

CONFIG_RUNTIME_NMI=y

# GPIOs
CONFIG_GPIO=y

# Serial
CONFIG_CONSOLE=y
CONFIG_UART_CONSOLE=y
CONFIG_SERIAL=y
```

## boards/arm/mps2/mps2_an521_cpu0_ns_defconfig
```kconfig
#
# Copyright (c) 2018-2019 Linaro Limited
#
# SPDX-License-Identifier: Apache-2.0
#

CONFIG_RUNTIME_NMI=y
CONFIG_ARM_TRUSTZONE_M=y
CONFIG_ARM_MPU=y
CONFIG_QEMU_ICOUNT_SHIFT=6

# GPIOs
CONFIG_GPIO=y

# Serial
CONFIG_CONSOLE=y
CONFIG_UART_CONSOLE=y
CONFIG_SERIAL=y
```

## boards/arm/mps2/mps2_an521_cpu1_defconfig
```kconfig
#
# Copyright (c) 2018-2019 Linaro Limited
# Copyright (c) 2021 Nordic Semiconductor ASA
#
# SPDX-License-Identifier: Apache-2.0
#

CONFIG_RUNTIME_NMI=y
CONFIG_ARM_MPU=y
CONFIG_QEMU_ICOUNT_SHIFT=7

# GPIOs
CONFIG_GPIO=y

# Serial
CONFIG_CONSOLE=y
CONFIG_UART_CONSOLE=y
CONFIG_SERIAL=y
```

## boards/arm/mps2_an385/Kconfig.board
```kconfig
# ARM Cortex-M3 SMM on V2M-MPS2 (Application Note AN385)

# Copyright (c) 2017 Linaro Limited
# SPDX-License-Identifier: Apache-2.0

config BOARD_MPS2_AN385
	def_bool "$(BOARD)" = "mps2_an385"
	depends on SOC_MPS2_AN385
	select QEMU_TARGET
	select HAS_COVERAGE_SUPPORT
```

## boards/arm/mps2_an385/Kconfig.defconfig
```kconfig
# Copyright (c) 2017 Linaro Limited
# SPDX-License-Identifier: Apache-2.0

if BOARD_MPS2_AN385

config BOARD
	default "mps2_an385"

if SERIAL

config UART_INTERRUPT_DRIVEN
	default y

endif # SERIAL

config ZTEST_STACK_SIZE
	default 4096 if ZTEST

if COVERAGE

config MAIN_STACK_SIZE
	default 4096

config IDLE_STACK_SIZE
	default 4096

config PRIVILEGED_STACK_SIZE
	default 4096

config ISR_STACK_SIZE
	default 4096

config TEST_EXTRA_STACK_SIZE
	default 4096

endif # COVERAGE

endif
```

## boards/arm/mps2_an385/mps2_an385_defconfig
```kconfig
#
# Copyright (c) 2017 Linaro Limited
#
# SPDX-License-Identifier: Apache-2.0
#

CONFIG_SOC_SERIES_MPS2=y
CONFIG_SOC_MPS2_AN385=y
CONFIG_BOARD_MPS2_AN385=y
CONFIG_CORTEX_M_SYSTICK=y
CONFIG_RUNTIME_NMI=y
CONFIG_QEMU_ICOUNT_SHIFT=7

# GPIOs
CONFIG_GPIO=y

# Serial
CONFIG_CONSOLE=y
CONFIG_UART_CONSOLE=y
CONFIG_SERIAL=y

# Watchdog
CONFIG_WATCHDOG=y

CONFIG_I2C=y

CONFIG_ARM_MPU=y
```

## boards/arm/mps2_an519/Kconfig.board
```kconfig
# Copyright (c) 2021 Linaro Limited
# SPDX-License-Identifier: Apache-2.0

config BOARD_MPS2_AN519
	bool "ARM Cortex-M23 SMM on V2M-MPS2 (AN519)"
	depends on SOC_MPS2_AN519
```

## boards/arm/mps2_an519/Kconfig.defconfig
```kconfig
# Copyright (c) 2018-2021 Linaro Limited
# SPDX-License-Identifier: Apache-2.0

if BOARD_MPS2_AN519

# MPU-based null-pointer dereferencing detection cannot
# be applied as the (0x0 - 0x400) is unmapped but QEMU
# will still permit bus access.
choice NULL_POINTER_EXCEPTION_DETECTION
	bool
	default NULL_POINTER_EXCEPTION_DETECTION_NONE if QEMU_TARGET
endchoice

config BOARD
	default "mps2_an519"

if GPIO

config GPIO_CMSDK_AHB
	default y

endif # GPIO

if SERIAL

config UART_CMSDK_APB
	default y

config UART_INTERRUPT_DRIVEN
	default y

endif # SERIAL

config WDOG_CMSDK_APB
	default y
	depends on WATCHDOG

config I2C_SBCON
	default y
	depends on I2C

endif
```

## boards/arm/mps2_an521/Kconfig.board
```kconfig
#
# Copyright (c) 2018-2019 Linaro Limited
#
# SPDX-License-Identifier: Apache-2.0
#

config BOARD_MPS2_AN521
	bool "ARM Cortex-M33 SMM on V2M-MPS2 (AN521)"
	depends on SOC_MPS2_AN521
	select QEMU_TARGET
	select HAS_COVERAGE_SUPPORT
```

## boards/arm/mps2_an521/Kconfig.defconfig
```kconfig
# Copyright (c) 2018-2019 Linaro Limited
# SPDX-License-Identifier: Apache-2.0

# MPU-based null-pointer dereferencing detection cannot
# be applied as the (0x0 - 0x400) is unmapped but QEMU
# will still permit bus access.
choice NULL_POINTER_EXCEPTION_DETECTION
	bool
	default NULL_POINTER_EXCEPTION_DETECTION_NONE if QEMU_TARGET
endchoice

# By default, if we build for a Non-Secure version of the board,
# force building with TF-M as the Secure Execution Environment.
config BUILD_WITH_TFM
	default y if TRUSTED_EXECUTION_NONSECURE

if SERIAL

config UART_INTERRUPT_DRIVEN
	default y

endif # SERIAL

if IPM

config IPM_MHU
	default y

endif # IPM
```

## boards/arm/mps2_an521/Kconfig.mps2_an521_ns
```kconfig
# Copyright (c) 2022 Zephyr Project members and individual contributors
# SPDX-License-Identifier: Apache-2.0

config BOARD_MPS2_AN521_NS
	bool
	default y
	select SOC_SERIES_MPS2
	select SOC_MPS2_AN521_CPU0
	select QEMU_TARGET
	select HAS_COVERAGE_SUPPORT
```

## boards/arm/mps2_an521/Kconfig.mps2_an521_remote
```kconfig
# Copyright (c) 2022 Zephyr Project members and individual contributors
# SPDX-License-Identifier: Apache-2.0

config BOARD_MPS2_AN521_REMOTE
	bool
	default y
	select SOC_SERIES_MPS2
	select SOC_MPS2_AN521_CPU1
	select QEMU_TARGET
	select HAS_COVERAGE_SUPPORT
```

## boards/arm/mps2_an521/mps2_an521_defconfig
```kconfig
#
# Copyright (c) 2018-2019 Linaro Limited
#
# SPDX-License-Identifier: Apache-2.0
#

CONFIG_SOC_SERIES_MPS2=y
CONFIG_SOC_MPS2_AN521_CPU0=y
CONFIG_BOARD_MPS2_AN521_CPU0=y
CONFIG_CORTEX_M_SYSTICK=y
CONFIG_RUNTIME_NMI=y
CONFIG_ARM_TRUSTZONE_M=y
CONFIG_ARM_MPU=y
CONFIG_QEMU_ICOUNT_SHIFT=7

# GPIOs
CONFIG_GPIO=y

# Serial
CONFIG_CONSOLE=y
CONFIG_UART_CONSOLE=y
CONFIG_SERIAL=y
CONFIG_UART_CMSDK_APB=y

# Watchdog
CONFIG_WATCHDOG=y

# Build a Secure firmware image
CONFIG_TRUSTED_EXECUTION_SECURE=y

CONFIG_I2C=y
```

## boards/arm/mps2_an521/mps2_an521_ns_defconfig
```kconfig
#
# Copyright (c) 2018-2019 Linaro Limited
#
# SPDX-License-Identifier: Apache-2.0
#

CONFIG_SOC_SERIES_MPS2=y
CONFIG_SOC_MPS2_AN521_CPU0=y
CONFIG_BOARD_MPS2_AN521_CPU0_NS=y
CONFIG_ARM_TRUSTZONE_M=y
CONFIG_RUNTIME_NMI=y
CONFIG_TRUSTED_EXECUTION_NONSECURE=y
CONFIG_ARM_MPU=y
CONFIG_QEMU_ICOUNT_SHIFT=6

# GPIOs
CONFIG_GPIO=y

# Serial
CONFIG_CONSOLE=y
CONFIG_UART_CONSOLE=y
CONFIG_SERIAL=y
```

## boards/arm/mps2_an521/mps2_an521_remote_defconfig
```kconfig
#
# Copyright (c) 2018-2019 Linaro Limited
# Copyright (c) 2021 Nordic Semiconductor ASA
#
# SPDX-License-Identifier: Apache-2.0
#

CONFIG_SOC_SERIES_MPS2=y
CONFIG_SOC_MPS2_AN521_CPU1=y
CONFIG_BOARD_MPS2_AN521_CPU1=y
CONFIG_RUNTIME_NMI=y
CONFIG_ARM_MPU=y
CONFIG_QEMU_ICOUNT_SHIFT=7

# GPIOs
CONFIG_GPIO=y

# Serial
CONFIG_CONSOLE=y
CONFIG_UART_CONSOLE=y
CONFIG_SERIAL=y
```

## boards/arm/mps3/Kconfig
```kconfig
# Copyright (c) 2021 Linaro Limited
# Copyright 2024 Arm Limited and/or its affiliates <open-source-office@arm.com>
# SPDX-License-Identifier: Apache-2.0

config BOARD_MPS3
	select QEMU_TARGET if BOARD_MPS3_CORSTONE300_AN547 || BOARD_MPS3_CORSTONE300_AN547_NS
	select TRUSTED_EXECUTION_NONSECURE if BOARD_MPS3_CORSTONE300_AN547_NS || \
		BOARD_MPS3_CORSTONE300_AN552_NS || BOARD_MPS3_CORSTONE300_FVP_NS || \
		BOARD_MPS3_CORSTONE310_AN555_NS || BOARD_MPS3_CORSTONE310_FVP_NS
	select BUILD_WITH_TFM if BOARD_MPS3_CORSTONE310_FVP_NS || BOARD_MPS3_CORSTONE300_FVP_NS
```

## boards/arm/mps3/Kconfig.defconfig
```kconfig
# Copyright (c) 2018-2021 Linaro Limited
# Copyright 2024-2025 Arm Limited and/or its affiliates <open-source-office@arm.com>
# SPDX-License-Identifier: Apache-2.0

if BOARD_MPS3_CORSTONE300_AN547 || BOARD_MPS3_CORSTONE300_AN552 || BOARD_MPS3_CORSTONE300_FVP || BOARD_MPS3_CORSTONE310_AN555 || BOARD_MPS3_CORSTONE310_FVP

# MPU-based null-pointer dereferencing detection cannot
# be applied as the (0x0 - 0x400) is unmapped but QEMU
# will still permit bus access.
choice NULL_POINTER_EXCEPTION_DETECTION
	bool
	default NULL_POINTER_EXCEPTION_DETECTION_NONE if QEMU_TARGET
endchoice

if SERIAL

config UART_INTERRUPT_DRIVEN
	default y

endif # SERIAL

if ROMSTART_RELOCATION_ROM && (BOARD_MPS3_CORSTONE310_AN555 || BOARD_MPS3_CORSTONE310_FVP)

config ROMSTART_REGION_ADDRESS
	default $(dt_nodelabel_reg_addr_hex,itcm)

config ROMSTART_REGION_SIZE
	default $(dt_nodelabel_reg_size_hex,itcm,0,k)

endif

endif
```

## boards/arm/mps3/Kconfig.mps3
```kconfig
# Copyright (c) 2023 Nordic Semiconductor
# Copyright 2024 Arm Limited and/or its affiliates <open-source-office@arm.com>
#
# SPDX-License-Identifier: Apache-2.0

config BOARD_MPS3
	select SOC_SERIES_MPS3
	select SOC_MPS3_CORSTONE300 if  BOARD_MPS3_CORSTONE300_AN547    || \
					BOARD_MPS3_CORSTONE300_AN547_NS || \
					BOARD_MPS3_CORSTONE300_AN552    || \
					BOARD_MPS3_CORSTONE300_AN552_NS || \
					BOARD_MPS3_CORSTONE300_FVP      || \
					BOARD_MPS3_CORSTONE300_FVP_NS
	select SOC_MPS3_CORSTONE310 if  BOARD_MPS3_CORSTONE310_AN555    || \
					BOARD_MPS3_CORSTONE310_AN555_NS || \
					BOARD_MPS3_CORSTONE310_FVP || \
					BOARD_MPS3_CORSTONE310_FVP_NS
```

## boards/arm/mps3/board.yml
```yaml
board:
  name: mps3
  full_name: MPS3 AN547
  vendor: arm
  socs:
  - name: 'corstone300'
    variants:
    - name: 'an547'
      variants:
      - name: 'ns'
    - name: 'an552'
      variants:
      - name: 'ns'
    - name: 'fvp'
      variants:
      - name: 'ns'
```
