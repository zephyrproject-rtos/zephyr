/*
 * SPDX-License-Identifier: Apache-2.0
 *
 * Copyright 2024 Arm Limited and/or its affiliates <open-source-office@arm.com>
 */

/dts-v1/;

#include <arm/armv7-m.dtsi>
#include <zephyr/dt-bindings/i2c/i2c.h>
#include <zephyr/dt-bindings/input/input-event-codes.h>
#include "mps2_base.dtsi"

/*
 * FVP does not support uart3 and uart4 whilst QEMU does.
 * So if using QEMU, you might want to comment out the following two lines
 */

/delete-node/ &uart3;
/delete-node/ &uart4;

/ {
	cpus {
		#address-cells = <1>;
		#size-cells = <0>;

		cpu@0 {
			compatible = "arm,cortex-m3";
			reg = <0>;
		};
	};
};
