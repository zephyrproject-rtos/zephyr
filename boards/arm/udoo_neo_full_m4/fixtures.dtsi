/*
 * Copyright (c) 2020 Nordic Semiconductor ASA
 *
 * SPDX-License-Identifier: Apache-2.0
 */

/ {
	zephyr,fixture {
		gpio-loopback {
			compatible = "zephyr,fixture,gpio-loopback";
			out-gpios = <&gpio5 14 0>; /* J4 pin 4 */
			in-gpios = <&gpio5 15 0>;  /* J4 pin 3 */
		};
	};
};
