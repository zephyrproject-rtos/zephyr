## boards/arm/udoo_neo_full_m4/Kconfig.board
```kconfig
# UDOO Neo Full

# Copyright (c) 2018, NXP
# SPDX-License-Identifier: Apache-2.0

config BOARD_UDOO_NEO_FULL_M4
	def_bool "$(BOARD)" = "udoo_neo_full_m4"
	depends on SOC_SERIES_IMX_6X_M4
	select SOC_PART_NUMBER_MCIMX6X4EVM10AB
```

## boards/arm/udoo_neo_full_m4/Kconfig.defconfig
```kconfig
# UDOO Neo Full board

# Copyright (c) 2018, NXP
# SPDX-License-Identifier: Apache-2.0

if BOARD_UDOO_NEO_FULL_M4

config BOARD
	default "udoo_neo_full_m4"

config COUNTER_IMX_EPIT_1
	default y
	depends on COUNTER_IMX_EPIT

endif # BOARD_UDOO_NEO_FULL_M4
```

## boards/arm/udoo_neo_full_m4/Kconfig.udoo_neo_full_m4
```kconfig
# Copyright (c) 2022 Zephyr Project members and individual contributors
# SPDX-License-Identifier: Apache-2.0

config BOARD_UDOO_NEO_FULL_M4
	bool
	default y
	select SOC_MCIMX6X_M4
	select SOC_SERIES_IMX_6X_M4
	select SOC_PART_NUMBER_MCIMX6X4EVM10AB
```

## boards/arm/udoo_neo_full_m4/udoo_neo_full_m4_defconfig
```kconfig
#
# Copyright (c) 2018, NXP
#
# SPDX-License-Identifier: Apache-2.0
#

CONFIG_ARM=y
CONFIG_SOC_MCIMX6X_M4=y
CONFIG_SOC_SERIES_IMX_6X_M4=y
CONFIG_BOARD_UDOO_NEO_FULL_M4=y
CONFIG_CONSOLE=y
CONFIG_CONSOLE_HAS_DRIVER=y
CONFIG_UART_CONSOLE=y
CONFIG_SERIAL=y
CONFIG_SERIAL_HAS_DRIVER=y
CONFIG_CORTEX_M_SYSTICK=y
CONFIG_GPIO=y
CONFIG_SYS_CLOCK_HW_CYCLES_PER_SEC=227000000
```

## boards/arm/usb_kw24d512/Kconfig.board
```kconfig
# NXP USB-KW24D512

# Copyright (c) 2017, Phytec Messtechnik GmbH
# SPDX-License-Identifier: Apache-2.0

config BOARD_USB_KW24D512
	def_bool "$(BOARD)" = "usb_kw24d512"
	depends on SOC_SERIES_KINETIS_KWX
	select SOC_PART_NUMBER_MKW24D512VHA5
```

## boards/arm/usb_kw24d512/Kconfig.defconfig
```kconfig
# USB-KW24D512 board

# Copyright (c) 2017, Phytec Messtechnik GmbH
# SPDX-License-Identifier: Apache-2.0

if BOARD_USB_KW24D512

config BOARD
	default "usb_kw24d512"

config OSC_XTAL0_FREQ
	# The MCU is configured to use 4 MHz external
	# clock from the transceiver provided at the CLK_OUT output.
	# CLK_OUT is internally connected to the input pin EXTAL0
	# of the MCU.
	default 4000000

config MCG_PRDIV0
	default 0x1

config MCG_VDIV0
	default 0x0

config MCG_FCRDIV
	default 2

if PINMUX_MCUX

config PINMUX_MCUX_PORTA
	default y if "$(dt_nodelabel_enabled,uart0)" && SERIAL

config PINMUX_MCUX_PORTB
	default y if SPI_1

config PINMUX_MCUX_PORTC
	default y

config PINMUX_MCUX_PORTD
	default y

endif # PINMUX_MCUX

config SPI_1
	default y
	depends on SPI

config MCR20A_IS_PART_OF_KW2XD_SIP
	default y
	depends on IEEE802154_MCR20A

endif # BOARD_USB_KW24D512
```

## boards/arm/usb_kw24d512/Kconfig.usb_kw24d512
```kconfig
# Copyright (c) 2022 Zephyr Project members and individual contributors
# SPDX-License-Identifier: Apache-2.0

config BOARD_USB_KW24D512
	bool
	default y
	select SOC_MKW24D5
	select SOC_SERIES_KINETIS_KWX
	select SOC_PART_NUMBER_MKW24D512VHA5
```

## boards/arm/usb_kw24d512/usb_kw24d512_defconfig
```kconfig
# SPDX-License-Identifier: Apache-2.0

CONFIG_ARM=y
CONFIG_SOC_MKW24D5=y
CONFIG_SOC_SERIES_KINETIS_KWX=y
CONFIG_BOARD_USB_KW24D512=y
CONFIG_CONSOLE=y
CONFIG_RTT_CONSOLE=y
CONFIG_USE_SEGGER_RTT=y
CONFIG_SERIAL=y
CONFIG_CORTEX_M_SYSTICK=y
CONFIG_GPIO=y
CONFIG_PINMUX=y
CONFIG_SYS_CLOCK_HW_CYCLES_PER_SEC=48000000
CONFIG_OSC_EXTERNAL=y
```

## boards/arm/v2m_beetle/Kconfig.board
```kconfig
# ARM V2M Beetle Board

# Copyright (c) 2016 Linaro Limited
# SPDX-License-Identifier: Apache-2.0

# V2M (V2 = Versatile Express, M = Motherboard)
config BOARD_V2M_BEETLE
	def_bool "$(BOARD)" = "v2m_beetle"
	depends on SOC_BEETLE_R0
```

## boards/arm/v2m_beetle/Kconfig.defconfig
```kconfig
# ARM V2M Beetle Board configuration options

# Copyright (c) 2016 Linaro Limited
# SPDX-License-Identifier: Apache-2.0

if SERIAL

config UART_INTERRUPT_DRIVEN
	default y

endif # SERIAL
```

## boards/arm/v2m_beetle/Kconfig.v2m_beetle
```kconfig
# Copyright (c) 2022 Zephyr Project members and individual contributors
# SPDX-License-Identifier: Apache-2.0

config BOARD_V2M_BEETLE
	bool
	default y
	select SOC_BEETLE_R0
	select SOC_SERIES_BEETLE
```

## boards/arm/v2m_beetle/board.yml
```yaml
board:
  name: v2m_beetle
  full_name: V2M Beetle
  vendor: arm
  socs:
  - name: beetle_r0
```

## boards/arm/v2m_musca/Kconfig.board
```kconfig
# ARM Cortex-M33 SMM on V2M-MUSCA

# Copyright (c) 2018 Linaro Limited
# SPDX-License-Identifier: Apache-2.0

config BOARD_MUSCA_A
	def_bool "$(BOARD)" = "v2m_musca"
	depends on SOC_SERIES_MUSCA
```

## boards/arm/v2m_musca/Kconfig.defconfig
```kconfig
# Copyright (c) 2018 Linaro Limited
# SPDX-License-Identifier: Apache-2.0

if BOARD_MUSCA_A

config BOARD
	default "musca_a" if TRUSTED_EXECUTION_SECURE || !TRUSTED_EXECUTION_NONSECURE
	default "musca_a_nonsecure"

config BOARD_DEPRECATED_RELEASE
	default "v2.6.0"

if GPIO

config GPIO_CMSDK_AHB
	default y

endif

if SERIAL

config UART_PL011
	default y

config UART_INTERRUPT_DRIVEN
	default y

config UART_PL011_PORT0
	default y

config UART_PL011_PORT1
	default y

endif # SERIAL

if COUNTER

config TIMER_TMR_CMSDK_APB
	default y

config TIMER_DTMR_CMSDK_APB
	default y

endif # COUNTER

if IPM

config IPM_MHU
	default y

endif # IPM

endif
```

## boards/arm/v2m_musca/v2m_musca_nonsecure_defconfig
```kconfig
#
# Copyright (c) 2018 Linaro Limited
#
# SPDX-License-Identifier: Apache-2.0
#

CONFIG_ARM=y
CONFIG_SOC_FAMILY_ARM=y
CONFIG_SOC_SERIES_MUSCA=y
CONFIG_SOC_V2M_MUSCA_A=y
CONFIG_ARM_TRUSTZONE_M=y
CONFIG_CORTEX_M_SYSTICK=y
CONFIG_RUNTIME_NMI=y
CONFIG_TRUSTED_EXECUTION_NONSECURE=y
CONFIG_ARM_MPU=y

# PinMuxing
CONFIG_PINMUX=y

# Serial
CONFIG_CONSOLE=y
CONFIG_UART_CONSOLE=y
CONFIG_SERIAL=y

# Watchdog
CONFIG_WATCHDOG=y
```

## boards/arm/v2m_musca_b1/Kconfig
```kconfig
# Copyright (c) 2025 Nordic Semiconductor ASA
# SPDX-License-Identifier: Apache-2.0

config BOARD_V2M_MUSCA_B1
	select TRUSTED_EXECUTION_NONSECURE if BOARD_V2M_MUSCA_B1_MUSCA_B1_NS
```

## boards/arm/v2m_musca_b1/Kconfig.board
```kconfig
# ARM Cortex-M33 SMM on V2M-MUSCA

# Copyright (c) 2019 Linaro Limited
# SPDX-License-Identifier: Apache-2.0

config BOARD_MUSCA_B1
	def_bool "$(BOARD)" = "v2m_musca_b1"
	depends on SOC_SERIES_MUSCA_B1
```

## boards/arm/v2m_musca_b1/Kconfig.defconfig
```kconfig
# Copyright (c) 2019 Linaro Limited
# SPDX-License-Identifier: Apache-2.0

if BOARD_V2M_MUSCA_B1

if SERIAL

config UART_INTERRUPT_DRIVEN
	default y

endif # SERIAL

endif # BOARD_V2M_MUSCA_B1
```

## boards/arm/v2m_musca_b1/Kconfig.v2m_musca_b1
```kconfig
# Copyright (c) 2019 Linaro Limited
# SPDX-License-Identifier: Apache-2.0

config BOARD_V2M_MUSCA_B1
	select SOC_V2M_MUSCA_B1
```

## boards/arm/v2m_musca_b1/board.yml
```yaml
board:
  name: v2m_musca_b1
  full_name: V2M Musca B1
  vendor: arm
  socs:
  - name: musca_b1
    variants:
    - name: 'ns'
```

## boards/arm/v2m_musca_b1/v2m_musca_b1_musca_b1_defconfig
```kconfig
#
# Copyright (c) 2019 Linaro Limited
#
# SPDX-License-Identifier: Apache-2.0
#

CONFIG_RUNTIME_NMI=y
CONFIG_ARM_TRUSTZONE_M=y
CONFIG_ARM_MPU=y

# Serial
CONFIG_CONSOLE=y
CONFIG_UART_CONSOLE=y
CONFIG_SERIAL=y
```

## boards/arm/v2m_musca_b1/v2m_musca_b1_nonsecure_defconfig
```kconfig
#
# Copyright (c) 2019 Linaro Limited
#
# SPDX-License-Identifier: Apache-2.0
#

CONFIG_ARM=y
CONFIG_SOC_FAMILY_ARM=y
CONFIG_SOC_SERIES_MUSCA_B1=y
CONFIG_SOC_V2M_MUSCA_B1=y
CONFIG_ARM_TRUSTZONE_M=y
CONFIG_CORTEX_M_SYSTICK=y
CONFIG_RUNTIME_NMI=y
CONFIG_TRUSTED_EXECUTION_NONSECURE=y
CONFIG_ARM_MPU=y

# PinMuxing
CONFIG_PINMUX=y

# Serial
CONFIG_CONSOLE=y
CONFIG_UART_CONSOLE=y
CONFIG_SERIAL=y
```

## boards/arm/v2m_musca_s1/Kconfig
```kconfig
# Copyright (c) 2025 Nordic Semiconductor ASA
# Copyright 2026 Arm Limited and/or its affiliates <open-source-office@arm.com>
# SPDX-License-Identifier: Apache-2.0

config BOARD_V2M_MUSCA_S1
	select DEPRECATED
```

## boards/arm/v2m_musca_s1/Kconfig.board
```kconfig
# Copyright (c) 2019-2020 Linaro Limited
# SPDX-License-Identifier: Apache-2.0

config BOARD_MUSCA_S1
	bool "ARM Cortex-M33 SMM on V2M-MUSCA-S1"
	depends on SOC_SERIES_MUSCA_S1
```

## boards/arm/v2m_musca_s1/Kconfig.defconfig
```kconfig
# Copyright (c) 2019-2020 Linaro Limited
# Copyright 2026 Arm Limited and/or its affiliates <open-source-office@arm.com>
# SPDX-License-Identifier: Apache-2.0

if BOARD_V2M_MUSCA_S1

configdefault BOARD_DEPRECATED_RELEASE
	default "5.0"

if SERIAL

config UART_INTERRUPT_DRIVEN
	default y

endif # SERIAL

endif # BOARD_V2M_MUSCA_S1
```
