/*
 * Copyright (c) 2022, NXP
 * SPDX-License-Identifier: Apache-2.0
 *
 * Note: File generated by imx_cfg_utils.py
 * from fsl-imx8mq-evk.mex
 */

#include <nxp/nxp_imx/mimx8mq6dvajz-pinctrl.dtsi>

&pinctrl {
	uart2_default: uart2_default {
		group0 {
			pinmux = <&iomuxc_uart2_rxd_uart_rx_uart2_rx>,
				<&iomuxc_uart2_txd_uart_tx_uart2_tx>;
			slew-rate = "fast";
			drive-strength = "45-ohm";
		};
	};

};
