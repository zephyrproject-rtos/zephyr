## boards/arm/legend25/Kconfig.defconfig
```kconfig
# Legend 2.5" board family configuration

# Copyright (c) 2021, Seagate Technology LLC
# SPDX-License-Identifier: Apache-2.0

if BOARD_LEGEND25_HDD || BOARD_LEGEND25_SSD

config BOARD
	default "legend25_hdd" if BOARD_LEGEND25_HDD
	default "legend25_ssd" if BOARD_LEGEND25_SSD

config SPI_STM32_INTERRUPT
	default y
	depends on SPI

endif # BOARD_LEGEND25_HDD || BOARD_LEGEND25_SSD
```

## boards/arm/legend25/legend25_hdd_defconfig
```kconfig
# SPDX-License-Identifier: Apache-2.0

# Zephyr Kernel Configuration
CONFIG_SOC_SERIES_STM32F0X=y

# Platform Configuration
CONFIG_SOC_STM32F070XB=y

# General Kernel Options
CONFIG_SYS_CLOCK_HW_CYCLES_PER_SEC=48000000

# Serial Drivers
CONFIG_SERIAL=y
CONFIG_UART_INTERRUPT_DRIVEN=y
# enable console
CONFIG_CONSOLE=y
CONFIG_UART_CONSOLE=y

# Pinmux Driver
CONFIG_PINMUX=y

# GPIO Controller
CONFIG_GPIO=y

# Clock Control
CONFIG_CLOCK_CONTROL=y

# LED strip related config
CONFIG_SPI=y
CONFIG_SPI_STM32_DMA=y
CONFIG_LED_STRIP=y
CONFIG_WS2812_STRIP=y

# PWM LED
CONFIG_LED=y
CONFIG_PWM=y
CONFIG_LED_PWM=y

# I2C
CONFIG_I2C=y
CONFIG_I2C_SLAVE=y

# SPI Flash
CONFIG_FLASH=y
CONFIG_SPI_NOR=y
CONFIG_SPI_NOR_SFDP_RUNTIME=y
```

## boards/arm/legend35/Kconfig.board
```kconfig
# Legend 3.5" board configuration

# Copyright (c) 2021 Seagate Technology
# SPDX-License-Identifier: Apache-2.0

config BOARD_LEGEND35
	bool "Legend 3.5 board"
	depends on SOC_STM32F070XB
```

## boards/arm/lora_e5_dev_board/Kconfig.board
```kconfig
# LoRa-E5 Dev board configuration

# Copyright (c) 2021 Thomas Stranger
# SPDX-License-Identifier: Apache-2.0

config BOARD_LORA_E5_DEV_BOARD
	bool "LoRa E5 Development Board"
	depends on SOC_STM32WLE5XX
```

## boards/arm/lora_e5_dev_board/Kconfig.lora_e5_dev_board
```kconfig
# Copyright (c) 2022 Zephyr Project members and individual contributors
# SPDX-License-Identifier: Apache-2.0

config BOARD_LORA_E5_DEV_BOARD
	bool
	default y
	select SOC_SERIES_STM32WLX
	select SOC_STM32WLE5XX
```

## boards/arm/lora_e5_mini/Kconfig.board
```kconfig
# LoRa-E5 mini configuration

# Copyright (c) 2023 Marcin Niestroj
# SPDX-License-Identifier: Apache-2.0

config BOARD_LORA_E5_MINI
	bool "LoRa E5 mini"
	depends on SOC_STM32WLE5XX
```

## boards/arm/lpcxpresso11u68/Kconfig.board
```kconfig
# LPCXpresso11U68 board

# Copyright (c) 2020, Seagate
# SPDX-License-Identifier: Apache-2.0

config BOARD_LPCXPRESSO11U68
	bool "NXP LPCXPRESSO-11U68"
	depends on SOC_SERIES_LPC11U6X
	select SOC_PART_NUMBER_LPC11U68JBD100
```

## boards/arm/lpcxpresso11u68/Kconfig.defconfig
```kconfig
# LPCXpresso11U68 board

# Copyright (c) 2020, Seagate
# SPDX-License-Identifier: Apache-2.0

if BOARD_LPCXPRESSO11U68

config BOARD
	default "lpcxpresso11u68"

endif # BOARD_LPCXPRESSO11U68
```

## boards/arm/lpcxpresso11u68/Kconfig.lpcxpresso11u68
```kconfig
# Copyright (c) 2022 Zephyr Project members and individual contributors
# SPDX-License-Identifier: Apache-2.0

config BOARD_LPCXPRESSO11U68
	bool
	default y
	select SOC_SERIES_LPC11U6X
	select SOC_LPC11U68
	select SOC_PART_NUMBER_LPC11U68JBD100
```

## boards/arm/lpcxpresso11u68/lpcxpresso11u68_defconfig
```kconfig
CONFIG_UART_INTERRUPT_DRIVEN=y
CONFIG_SYS_CLOCK_HW_CYCLES_PER_SEC=48000000
CONFIG_GPIO=y
CONFIG_BUILD_OUTPUT_HEX=y
CONFIG_SOC_SERIES_LPC11U6X=y
# Since the board has little memory (32k), stack sizes are lowered
# so that the application has more RAM for itself.
CONFIG_MAIN_STACK_SIZE=512
CONFIG_ISR_STACK_SIZE=768
CONFIG_CONSOLE=y
CONFIG_UART_CONSOLE=y
CONFIG_SERIAL=y
CONFIG_GPIO_LPC11U6X=y
CONFIG_CLOCK_CONTROL_LPC11U6X_ENABLE_SRAM1=y
CONFIG_CLOCK_CONTROL_LPC11U6X_ENABLE_USB_RAM=y
CONFIG_CLOCK_CONTROL_LPC11U6X_PLL_SRC_SYSOSC=y
CONFIG_EEPROM=y
```

## boards/arm/lpcxpresso51u68/Kconfig.board
```kconfig
# LPCXpresso51U68 board

# Copyright (c) 2021 metraTec GmbH
# SPDX-License-Identifier: Apache-2.0

config BOARD_LPCXPRESSO51U68
	bool "NXP LPCXPRESSO-51U68"
	depends on SOC_SERIES_LPC51U68
	select SOC_PART_NUMBER_LPC51U68JBD64
```

## boards/arm/lpcxpresso51u68/Kconfig.defconfig
```kconfig
# LPCXpresso51U68 board

# Copyright (c) 2021 metraTec GmbH
# SPDX-License-Identifier: Apache-2.0

if BOARD_LPCXPRESSO51U68

config BOARD
	default "lpcxpresso51u68"

endif # BOARD_LPCXPRESSO51U68
```

## boards/arm/lpcxpresso51u68/Kconfig.lpcxpresso51u68
```kconfig
# Copyright (c) 2022 Zephyr Project members and individual contributors
# SPDX-License-Identifier: Apache-2.0

config BOARD_LPCXPRESSO51U68
	bool
	default y
	select SOC_SERIES_LPC51U68
	select SOC_LPC51U68
	select SOC_PART_NUMBER_LPC51U68JBD64
```

## boards/arm/lpcxpresso51u68/lpcxpresso51u68_defconfig
```kconfig
CONFIG_SOC_SERIES_LPC51U68=y
CONFIG_SOC_LPC51U68=y
CONFIG_BOARD_LPCXPRESSO51U68=y
CONFIG_CONSOLE=y
CONFIG_UART_CONSOLE=y
CONFIG_SERIAL=y
CONFIG_UART_INTERRUPT_DRIVEN=y
CONFIG_GPIO=y
CONFIG_SYS_CLOCK_HW_CYCLES_PER_SEC=12000000
```

## boards/arm/lpcxpresso54114/Kconfig.board
```kconfig
# LPCXpresso54114 board

# Copyright (c) 2017, NXP
# SPDX-License-Identifier: Apache-2.0

config BOARD_LPCXPRESSO54114_M4
	def_bool "$(BOARD)" = "lpcxpresso54114_m4"
	depends on SOC_SERIES_LPC54XXX
	select SOC_PART_NUMBER_LPC54114J256BD64

config BOARD_LPCXPRESSO54114_M0
	def_bool "$(BOARD)" = "lpcxpresso54114_m0"
	depends on SOC_SERIES_LPC54XXX
	select SOC_PART_NUMBER_LPC54114J256BD64
```

## boards/arm/lpcxpresso54114/Kconfig.defconfig
```kconfig
# LPCXpresso54114 board

# Copyright (c) 2017, NXP
# SPDX-License-Identifier: Apache-2.0

if BOARD_LPCXPRESSO54114_M4 || BOARD_LPCXPRESSO54114_M0

config BOARD
	default "lpcxpresso54114_m4" if BOARD_LPCXPRESSO54114_M4
	default "lpcxpresso54114_m0" if BOARD_LPCXPRESSO54114_M0

# Place size restrictions on first image if dual core is enabled
if SECOND_CORE_MCUX && BOARD_LPCXPRESSO54114_M4

# Workaround for not being able to have commas in macro arguments
DT_CHOSEN_Z_CODE_PARTITION := zephyr,code-partition

config FLASH_LOAD_SIZE
	default $(dt_chosen_reg_size_hex,$(DT_CHOSEN_Z_CODE_PARTITION))

endif # SECOND_CORE_MCUX && BOARD_LPCXPRESSO54114_M4

endif # BOARD_LPCXPRESSO54114_M4 || BOARD_LPCXPRESSO54114_M0
```

## boards/arm/lpcxpresso54114/Kconfig.lpcxpresso54114_m0
```kconfig
# Copyright (c) 2022 Zephyr Project members and individual contributors
# SPDX-License-Identifier: Apache-2.0

config BOARD_LPCXPRESSO54114_M0
	bool
	default y
	select SOC_LPC54114_M0
	select SOC_SERIES_LPC54XXX
	select SOC_PART_NUMBER_LPC54114J256BD64
```

## boards/arm/lpcxpresso54114/lpcxpresso54114_defconfig
```kconfig
CONFIG_ARM=y
CONFIG_SOC_LPC54114=y
CONFIG_SOC_SERIES_LPC54XXX=y
CONFIG_BOARD_LPCXPRESSO54114=y
CONFIG_CONSOLE=y
CONFIG_UART_CONSOLE=y
CONFIG_SERIAL=y
CONFIG_CORTEX_M_SYSTICK=y
CONFIG_GPIO=y
CONFIG_SYS_CLOCK_HW_CYCLES_PER_SEC=48000000
```

## boards/arm/lpcxpresso54114/lpcxpresso54114_m0_defconfig
```kconfig
#
# Copyright (c) 2017, NXP
#
# SPDX-License-Identifier: Apache-2.0
#

CONFIG_ARM=y
CONFIG_SOC_LPC54114_M0=y
CONFIG_SOC_SERIES_LPC54XXX=y
CONFIG_BOARD_LPCXPRESSO54114_M0=y
CONFIG_CONSOLE=y
CONFIG_RTT_CONSOLE=y
CONFIG_SERIAL=n
CONFIG_CORTEX_M_SYSTICK=y
CONFIG_GPIO=n
CONFIG_SYS_CLOCK_HW_CYCLES_PER_SEC=48000000
```

## boards/arm/lpcxpresso54114/lpcxpresso54114_m4_defconfig
```kconfig
#
# Copyright (c) 2017, NXP
#
# SPDX-License-Identifier: Apache-2.0
#

CONFIG_SOC_LPC54114_M4=y
CONFIG_SOC_SERIES_LPC54XXX=y
CONFIG_BOARD_LPCXPRESSO54114_M4=y
CONFIG_CONSOLE=y
CONFIG_UART_CONSOLE=y
CONFIG_SERIAL=y
CONFIG_UART_INTERRUPT_DRIVEN=y
CONFIG_CORTEX_M_SYSTICK=y
CONFIG_GPIO=y
CONFIG_PINCTRL=y
CONFIG_SYS_CLOCK_HW_CYCLES_PER_SEC=48000000
CONFIG_ARM_MPU=y
CONFIG_HW_STACK_PROTECTION=y
```

## boards/arm/lpcxpresso54114_m0/Kconfig.board
```kconfig
# Kconfig - LPCXpresso54114 board
#
# Copyright (c) 2017, NXP
#
# SPDX-License-Identifier: Apache-2.0
#

config BOARD_LPCXPRESSO54114_M0
	bool "NXP LPCXPRESSO-54114 M0"
	depends on SOC_SERIES_LPC54XXX
	select SOC_PART_NUMBER_LPC54114J256BD64
```

## boards/arm/lpcxpresso54114_m0/Kconfig.defconfig
```kconfig
# Kconfig - LPCXpresso54114 board
#
# Copyright (c) 2017, NXP
#
# SPDX-License-Identifier: Apache-2.0
#

if BOARD_LPCXPRESSO54114_M0

config BOARD
	default "lpcxpresso54114_m0"

if USART_MCUX_LPC
config USART_MCUX_LPC_0
	def_bool n if UART_CONSOLE

endif # USART_MCUX_LPC

config PINMUX
	def_bool n

if PINMUX_MCUX_LPC

config PINMUX_MCUX_LPC_PORT0
	def_bool n

config PINMUX_MCUX_LPC_PORT1
	def_bool n
endif # PINMUX_MCUX_LPC

if GPIO_MCUX_LPC

config GPIO_MCUX_LPC_PORT0
	def_bool n

config GPIO_MCUX_LPC_PORT1
	def_bool n

endif # GPIO_MCUX_LPC

endif # BOARD_LPCXPRESSO54114_M0
```

## boards/arm/lpcxpresso54114_m4/Kconfig.defconfig
```kconfig
# Kconfig - LPCXpresso54114 board
#
# Copyright (c) 2017, NXP
#
# SPDX-License-Identifier: Apache-2.0
#

if BOARD_LPCXPRESSO54114_M4

config BOARD
	default "lpcxpresso54114_m4"

if USART_MCUX_LPC

config USART_MCUX_LPC_0
	def_bool y if UART_CONSOLE

endif # USART_MCUX_LPC

if PINMUX_MCUX_LPC

config PINMUX_MCUX_LPC_PORT0
	def_bool y

config PINMUX_MCUX_LPC_PORT1
	def_bool y

endif # PINMUX_MCUX_LPC

if GPIO_MCUX_LPC

config GPIO_MCUX_LPC_PORT0
	def_bool y

config GPIO_MCUX_LPC_PORT1
	def_bool y

endif # GPIO_MCUX_LPC

endif # BOARD_LPCXPRESSO54114_M4
```

## boards/arm/lpcxpresso54114_m4/lpcxpresso54114_m4_defconfig
```kconfig
#
# Copyright (c) 2017, NXP
#
# SPDX-License-Identifier: Apache-2.0
#

CONFIG_ARM=y
CONFIG_SOC_LPC54114_M4=y
CONFIG_SOC_SERIES_LPC54XXX=y
CONFIG_BOARD_LPCXPRESSO54114_M4=y
CONFIG_CONSOLE=y
CONFIG_UART_CONSOLE=y
CONFIG_SERIAL=y
CONFIG_CORTEX_M_SYSTICK=y
CONFIG_GPIO=y
CONFIG_PINMUX=y
CONFIG_SYS_CLOCK_HW_CYCLES_PER_SEC=48000000
```

## boards/arm/lpcxpresso55s06/Kconfig.board
```kconfig
# LPCXpresso55S06 board

# Copyright (c) 2022 metraTec
# SPDX-License-Identifier: Apache-2.0

config BOARD_LPCXPRESSO55S06
	bool "NXP LPCXPRESSO-55S06"
	depends on SOC_SERIES_LPC55XXX
	select SOC_PART_NUMBER_LPC55S06JBD64
```
