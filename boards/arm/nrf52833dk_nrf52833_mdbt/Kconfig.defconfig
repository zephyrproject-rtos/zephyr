## boards/arm/nrf52833dk_nrf52833_mdbt/Kconfig.defconfig
```kconfig
# Copyright (c) 2022 Nordic Semiconductor ASA
# SPDX-License-Identifier: Apache-2.0

if BOARD_NRF52833DK_NRF52833_MDBT

config BOARD
	default "nrf52833dk_nrf52833_mdbt"

config BT_CTLR
   default BT

endif
```

## boards/arm/nrf52840_blip/Kconfig
```kconfig
# Kconfig - Electronut Labs Blip board configuration
#
# Copyright (c) 2018 Electronut Labs
#
# SPDX-License-Identifier: Apache-2.0

if BOARD_NRF52840_BLIP

config BOARD_ENABLE_DCDC
        bool "Enable DCDC mode"
        select SOC_DCDC_NRF52X
        default y

endif # BOARD_NRF52840_BLIP
```

## boards/arm/nrf52840_blip/Kconfig.board
```kconfig
# Electronut Labs Blip board configuration

# Copyright (c) 2018 Electronut Labs
# SPDX-License-Identifier: Apache-2.0

config BOARD_NRF52840_BLIP
	def_bool "$(BOARD)" = "nrf52840_blip"
	depends on SOC_NRF52840_QIAA
```

## boards/arm/nrf52840_blip/Kconfig.defconfig
```kconfig
# Electronut Labs Blip board configuration

# Copyright (c) 2018 Electronut Labs
# SPDX-License-Identifier: Apache-2.0

if BOARD_NRF52840_BLIP

config BOARD
	default "nrf52840_blip"

if USB

config USB_NRFX
	default y

config USB_DEVICE_STACK
	default y

endif # USB

config BT_CTLR
	default BT

endif # BOARD_NRF52840_BLIP
```

## boards/arm/nrf52840_m2/Kconfig.board
```kconfig
# Copyright (c) 2022 Stavros Avramidis <stavros9899@gmail.com>
# SPDX-License-Identifier: Apache-2.0

config BOARD_NRF52840_M2
	bool "nrf52840_m2"
	depends on SOC_NRF52840_QIAA
```

## boards/arm/nrf52840_m2/nrf52840_m2_defconfig
```kconfig
# Copyright (c) 2022 Stavros Avramidis <stavros9899@gmail.com>
# SPDX-License-Identifier: Apache-2.0

CONFIG_SOC_SERIES_NRF52X=y
CONFIG_SOC_NRF52840_QIAA=y
CONFIG_BOARD_NRF52840_M2=y


# Enable MPU
CONFIG_ARM_MPU=y

# Enable hardware stack protection
CONFIG_HW_STACK_PROTECTION=y

# Enable RTT
CONFIG_USE_SEGGER_RTT=y

# enable GPIO
CONFIG_GPIO=y

# Enable UART driver
CONFIG_SERIAL=y

# enable console
CONFIG_CONSOLE=y
CONFIG_UART_CONSOLE=y

# additional board options
CONFIG_GPIO_AS_PINRESET=y

CONFIG_PINCTRL=y
```

## boards/arm/nrf52840_mdk/Kconfig
```kconfig
# nRF52840-MDK board configuration

# Copyright (c) 2018 makerdiary.com
# SPDX-License-Identifier: Apache-2.0

if BOARD_NRF52840_MDK

config BOARD_ENABLE_DCDC
	bool "Enable DCDC mode"
	select SOC_DCDC_NRF52X
	default y

config BOARD_HAS_NRF5_BOOTLOADER
	bool "Board has nRF5 bootloader"
	default y
	help
	 If selected, applications are linked so that they can be loaded by
	 Nordic nRF5 bootloader. Disable CONFIG_GPIO_AS_PINRESET if this is
	 is selected.

endif # BOARD_NRF52840_MDK
```

## boards/arm/nrf52840_mdk/Kconfig.board
```kconfig
# Kconfig - nRF52840-MDK board configuration
#
# Copyright (c) 2018 makerdiary.com
#
# SPDX-License-Identifier: Apache-2.0

config  BOARD_NRF52840_MDK
	bool "NRF52840-MDK"
	depends on SOC_NRF52840_QIAA
```

## boards/arm/nrf52840_mdk/Kconfig.defconfig
```kconfig
# nRF52840-MDK board configuration

# Copyright (c) 2018 makerdiary.com
# SPDX-License-Identifier: Apache-2.0

if BOARD_NRF52840_MDK

config BOARD
	default "nrf52840_mdk"

config BT_CTLR
	default BT

endif # BOARD_NRF52840_MDK
```

## boards/arm/nrf52840_mdk_dongle/Kconfig
```kconfig
# nRF52840-MDK board configuration

# Copyright (c) 2018 makerdiary.com
# SPDX-License-Identifier: Apache-2.0

config BOARD_ENABLE_DCDC
	bool "Enable DCDC mode"
	select SOC_DCDC_NRF52X
	default y
	depends on BOARD_NRF52840_MDK_DONGLE

config BOARD_HAS_NRF5_BOOTLOADER
	bool "Board has nRF5 bootloader"
	default y
	help
	  If selected, applications are linked so that they can be loaded by Nordic
	  nRF5 bootloader.
```

## boards/arm/nrf52840_mdk_dongle/Kconfig.board
```kconfig
# nRF52840-MDK Dongle board configuration

# Copyright (c) 2018 makerdiary.com
# SPDX-License-Identifier: Apache-2.0

config BOARD_NRF52840_MDK_DONGLE
	bool "NRF52840-MDK-DONGLE"
	depends on SOC_NRF52840_QIAA
```

## boards/arm/nrf52840_mdk_dongle/Kconfig.defconfig
```kconfig
# nRF52840-MDK Dongle board configuration

# Copyright (c) 2018 makerdiary.com
# SPDX-License-Identifier: Apache-2.0

if BOARD_NRF52840_MDK_DONGLE

config BOARD
	default "nrf52840_mdk_dongle"

config FLASH_LOAD_OFFSET
	default 0x1000
	depends on BOARD_HAS_NRF5_BOOTLOADER && !USE_DT_CODE_PARTITION

if USB

config USB_NRFX
	default y

config USB_DEVICE_STACK
	default y

endif # USB

config BT_CTLR
	default BT

endif # BOARD_NRF52840_MDK_DONGLE
```

## boards/arm/nrf52840_papyr/Kconfig
```kconfig
# Kconfig - Electronut Labs Papyr board configuration
#
# Copyright (c) 2018 Electronut Labs
#
# SPDX-License-Identifier: Apache-2.0

if BOARD_NRF52840_PAPYR

config BOARD_ENABLE_DCDC
        bool "Enable DCDC mode"
        select SOC_DCDC_NRF52X
        default y

endif # BOARD_NRF52840_PAPYR
```

## boards/arm/nrf52840_papyr/Kconfig.board
```kconfig
# Kconfig - Electronut Labs Papyr board configuration
#
# Copyright (c) 2018 Electronut Labs
#
# SPDX-License-Identifier: Apache-2.0

config  BOARD_NRF52840_PAPYR
	bool "NRF52840 PAPYR"
	depends on SOC_NRF52840_QIAA
```

## boards/arm/nrf52840_papyr/Kconfig.defconfig
```kconfig
# Electronut Labs Papyr board configuration

# Copyright (c) 2018 Electronut Labs
# SPDX-License-Identifier: Apache-2.0

config BT_CTLR
	default BT
```

## boards/arm/nrf52840_pca10056/Kconfig
```kconfig
# Kconfig - nRF52840 PCA10056 board configuration
#
# Copyright (c) 2016 Nordic Semiconductor ASA
#
# SPDX-License-Identifier: Apache-2.0

if BOARD_NRF52840_PCA10056

config BOARD_ENABLE_DCDC
        bool "Enable DCDC mode"
        select SOC_DCDC_NRF52X
        default y

endif # BOARD_NRF52840_PCA10056
```

## boards/arm/nrf52840_pca10056/Kconfig.board
```kconfig
# nRF52840 PCA10056 board configuration

# Copyright (c) 2016 Nordic Semiconductor ASA
# SPDX-License-Identifier: Apache-2.0

config BOARD_NRF52840_PCA10056
	def_bool "$(BOARD)" = "nrf52840_pca10056"
	depends on SOC_NRF52840_QIAA
```

## boards/arm/nrf52840_pca10056/Kconfig.defconfig
```kconfig
# Kconfig - nRF52840 PCA10056 board configuration
#
# Copyright (c) 2016 Nordic Semiconductor ASA
#
# SPDX-License-Identifier: Apache-2.0

if BOARD_NRF52840_PCA10056

config BOARD
	default "nrf52840_pca10056"

if ADC

config ADC_0
	default y

endif # ADC

if I2C

config I2C_0
	default y

endif # I2C

if PWM

config PWM_0
	default y

endif # PWM

if SPI

config SPI_1
	default y

config SPI_2
	default y

config SPI_3
	default y

endif # SPI

if USB

config USB_NRF52840
	default y

config USB_DEVICE_STACK
	default y

endif # USB

if IEEE802154

config IEEE802154_NRF5
	default y

endif # IEEE802154

config BT_CTLR
	default BT

endif # BOARD_NRF52840_PCA10056
```

## boards/arm/nrf52840_pca10056/nrf52840_pca10056_defconfig
```kconfig
CONFIG_ARM=y
CONFIG_SOC_FAMILY_NRF5=y
CONFIG_SOC_SERIES_NRF52X=y
CONFIG_SOC_NRF52840_QIAA=y
CONFIG_BOARD_NRF52840_PCA10056=y

# Enable MPU
CONFIG_ARM_MPU_NRF52X=y

# enable uart driver
CONFIG_SERIAL=y
CONFIG_UART_NRF5=y

# enable console
CONFIG_CONSOLE=y
CONFIG_UART_CONSOLE=y

# additional board options
CONFIG_GPIO_AS_PINRESET=y

# bluetooth
CONFIG_BT=y
CONFIG_BT_CTLR=y
```

## boards/arm/nrf52840_pca10059/Kconfig
```kconfig
# Kconfig - nRF52840 PCA10059 board configuration
#
# Copyright (c) 2018 Nordic Semiconductor ASA
#
# SPDX-License-Identifier: Apache-2.0

if BOARD_NRF52840_PCA10059

config BOARD_ENABLE_DCDC
        bool "Enable DCDC mode"
        select SOC_DCDC_NRF52X
        default y

config BOARD_HAS_NRF5_BOOTLOADER
	bool "Board has nRF5 bootloader"
	default y
	help
	 If selected, applications are linked so that they can be loaded by
	 Nordic nRF5 bootloader.

endif # BOARD_NRF52840_PCA10059
```

## boards/arm/nrf52840_pca10059/Kconfig.board
```kconfig
# nRF52840 PCA10059 board configuration

# Copyright (c) 2018 Nordic Semiconductor ASA
# SPDX-License-Identifier: Apache-2.0

config BOARD_NRF52840_PCA10059
	def_bool "$(BOARD)" = "nrf52840_pca10059"
	depends on SOC_NRF52840_QIAA
```

## boards/arm/nrf52840_pca10059/Kconfig.defconfig
```kconfig
# Kconfig - nRF52 PCA10059 board configuration
#
# Copyright (c) 2018 Nordic Semiconductor ASA
#
# SPDX-License-Identifier: Apache-2.0

if BOARD_NRF52840_PCA10059

config BOARD
	default "nrf52840_pca10059"

if BOARD_HAS_NRF5_BOOTLOADER && !USE_CODE_PARTITION

# To let the nRF5 bootloader load an application, the application
# must be linked after Nordic MBR, that is factory-programmed on the board.

# Nordic nRF5 booatloader exists outside of the partitions specified in the
# DTS file, so we manually override FLASH_LOAD_OFFEST to link the application
# correctly, after Nordic MBR.

# When building MCUBoot, MCUBoot itself will select USE_CODE_PARTITION
# which will make it link into the correct partition specified in DTS file,
# so no override is necessary.

config FLASH_LOAD_OFFSET
        default 0x1000

endif # BOARD_HAS_NRF5_BOOTLOADER && !USE_CODE_PARTITION

if ADC

config ADC_0
	default y

endif # ADC

if I2C

config I2C_0
	default y

endif # I2C

if SPI

config SPI_1
	default y

endif # SPI

if USB

config USB_NRF52840
	default y

config USB_DEVICE_STACK
	default y

endif # USB

if IEEE802154

config IEEE802154_NRF5
	default y

endif # IEEE802154

config BT_CTLR
	default BT

endif # BOARD_NRF52840_PCA10059
```

## boards/arm/nrf52840_pca10059/nrf52840_pca10059_defconfig
```kconfig
# SPDX-License-Identifier: Apache-2.0

CONFIG_SOC_SERIES_NRF52X=y
CONFIG_SOC_NRF52840_QIAA=y
CONFIG_BOARD_NRF52840_PCA10059=y

# Enable MPU
CONFIG_ARM_MPU=y

# enable GPIO
CONFIG_GPIO=y

# Enable UART driver, needed for CDC ACM
CONFIG_SERIAL=y
CONFIG_UART_INTERRUPT_DRIVEN=y

# enable console
CONFIG_CONSOLE=y

# additional board options
CONFIG_GPIO_AS_PINRESET=y
CONFIG_NFCT_PINS_AS_GPIOS=y
```

## boards/arm/nrf52840_pca10090/Kconfig
```kconfig
# Kconfig - nRF52840 PCA10090 board configuration
#
# Copyright (c) 2018 Nordic Semiconductor ASA
#
# SPDX-License-Identifier: Apache-2.0

if BOARD_NRF52840_PCA10090

config BOARD_ENABLE_DCDC
        bool "Enable DCDC mode"
        select SOC_DCDC_NRF52X
        default y

choice
	prompt "nRF9160 UART0 routing"
	default BOARD_PCA10090_UART0_VCOM

config BOARD_PCA10090_UART0_VCOM
	bool "Route to VCOM0"

config BOARD_PCA10090_UART0_ARDUINO
	bool "Route to Arduino pins"

endchoice

choice
	prompt "nRF9160 UART1 routing"
	default BOARD_PCA10090_UART1_VCOM

config BOARD_PCA10090_UART1_VCOM
	bool "Route to VCOM2"

config BOARD_PCA10090_UART1_ARDUINO
	bool "Route to Arduino pins"

endchoice

choice
	prompt "LED 1 routing"
	default BOARD_PCA10090_LED0_PHY

config BOARD_PCA10090_LED0_PHY
	bool "Route to LED on the kit"

config BOARD_PCA10090_LED0_ARDUINO
	bool "Route to Arduino pins"

endchoice

choice
	prompt "LED 2 routing"
	default BOARD_PCA10090_LED1_PHY

config BOARD_PCA10090_LED1_PHY
	bool "Route to LED on the kit"

config BOARD_PCA10090_LED1_ARDUINO
	bool "Route to Arduino pins"

endchoice

choice
	prompt "LED 3 routing"
	default BOARD_PCA10090_LED2_PHY

config BOARD_PCA10090_LED2_PHY
	bool "Route to LED on the kit"

config BOARD_PCA10090_LED2_ARDUINO
	bool "Route to Arduino pins"

endchoice

choice
	prompt "LED 4 routing"
	default BOARD_PCA10090_LED3_PHY

config BOARD_PCA10090_LED3_PHY
	bool "Route to LED on the kit"

config BOARD_PCA10090_LED3_ARDUINO
	bool "Route to Arduino pins"

endchoice

choice
	prompt "Button 1 routing"
	default BOARD_PCA10090_BUTTON0_PHY

config BOARD_PCA10090_BUTTON0_PHY
	bool "Route to buttons on the kit"

config BOARD_PCA10090_BUTTON0_ARDUINO
	bool "Route to Arduino pins"

endchoice

choice
	prompt "Button 2 routing"
	default BOARD_PCA10090_BUTTON1_PHY

config BOARD_PCA10090_BUTTON1_PHY
	bool "Route to buttons on the kit"

config BOARD_PCA10090_BUTTON1_ARDUINO
	bool "Route to Arduino pins"

endchoice

choice
	prompt "Switch 1 routing"
	default BOARD_PCA10090_SWITCH0_PHY

config BOARD_PCA10090_SWITCH0_PHY
	bool "Route to switches on the kit"

config BOARD_PCA10090_SWITCH0_ARDUINO
	bool "Route to Arduino pins"

endchoice

choice
	prompt "Switch 2 routing"
	default BOARD_PCA10090_SWITCH1_PHY

config BOARD_PCA10090_SWITCH1_PHY
	bool "Route to switches on the kit"

config BOARD_PCA10090_SWITCH1_ARDUINO
	bool "Route to Arduino pins"

endchoice

choice
	prompt "Interface pins 0-2"
	default BOARD_PCA10090_INTERFACE0_ARDUINO

config BOARD_PCA10090_INTERFACE0_ARDUINO
	bool "Route to Arduino pins"
	help
	 Pin 0: nRF9160 P0.17 connects to A3
	 Pin 1: nRF9160 P0.18 connects to A4
	 Pin 2: nRF9160 P0.19 connects to A5

config BOARD_PCA10090_INTERFACE0_MCU
	bool "Route to nRF52840"
	help
	 This connects the following pins on the nRF9160 to pins on the nRF52840:
	 Pin 0: nRF9160 P0.17 connects to nRF52840 P0.17
	 Pin 1: nRF9160 P0.18 connects to nRF52840 P0.20
	 Pin 2: nRF9160 P0.19 connects to nRF52840 P0.15

endchoice

choice
	prompt "Interface pins 3-5"
	default BOARD_PCA10090_INTERFACE1_TRACE

config BOARD_PCA10090_INTERFACE1_TRACE
	bool "Route to TRACE interface"
	help
	 Pin 3: nRF9160 P0.21 connects to TRACECLK
	 Pin 4: nRF9160 P0.22 connects to TRACEDATA0
	 Pin 5: nRF9160 P0.23 connects to TRACEDATA1

config BOARD_PCA10090_INTERFACE1_MCU
	bool "Route to nRF52840"
	help
	 Pin 3: nRF9160 P0.21 connects to nRF52840 P0.22
	 Pin 4: nRF9160 P0.22 connects to nRF52840 P1.04
	 Pin 5: nRF9160 P0.23 connects to nRF52840 P1.02

endchoice

choice
	prompt "Interface pins 6-8"
	default BOARD_PCA10090_INTERFACE2_COEX

config BOARD_PCA10090_INTERFACE2_COEX
	bool "Route to COEX interface"
	help
	 Pin 6: nRF9160 COEX0 connects to COEX0_PH
	 Pin 7: nRF9160 COEX1 connects to COEX1_PH
	 Pin 8: nRF9160 COEX2 connects to COEX2_PH

config BOARD_PCA10090_INTERFACE2_MCU
	bool "Route to nRF52840"
	help
	 Pin 6: nRF9160 COEX0 connects to nRF52840 P1.13
	 Pin 7: nRF9160 COEX1 connects to nRF52840 P1.11
	 Pin 8: nRF9160 COEX2 connects to nRF52840 P1.15

endchoice

config BOARD_PCA10090_NRF52840_RESET
	bool "Enable GPIO reset line"
	help
	 Let the nRF52840 be reset from the nRF9160 via a GPIO line.
	 The GPIO line may only be one of the first 6 MCU interface pins.
	 The line is active high.

if BOARD_PCA10090_NRF52840_RESET

choice
	prompt "Pin used for reset"

comment "nRF52840 pins"

config BOARD_PCA10090_NRF52840_RESET_P0_17
	bool "P0.17"
	depends on BOARD_PCA10090_INTERFACE0_MCU
	help
	 Pin P0.17 on nRF52840,
	 connected to P0.17 on the nRF9160.

config BOARD_PCA10090_NRF52840_RESET_P0_20
	bool "P0.20"
	depends on BOARD_PCA10090_INTERFACE0_MCU
	help
	 Pin P0.20 on nRF52840,
	 connected to P0.18 on the nRF9160.

config BOARD_PCA10090_NRF52840_RESET_P0_15
	bool "P0.15"
	depends on BOARD_PCA10090_INTERFACE0_MCU
	help
	 Pin P0.15 on nRF52840,
	 connected to P0.19 on the nRF9160.

config BOARD_PCA10090_NRF52840_RESET_P0_22
	bool "P0.22"
	depends on BOARD_PCA10090_INTERFACE1_MCU
	help
	 Pin P0.22 on nRF52840,
	 connected to P0.21 on the nRF9160.

config BOARD_PCA10090_NRF52840_RESET_P1_04
	bool "P1.04"
	depends on BOARD_PCA10090_INTERFACE1_MCU
	help
	 Pin P1.04 on nRF52840,
	 connected to P0.22 on the nRF9160.

config BOARD_PCA10090_NRF52840_RESET_P1_02
	bool "P1.02"
	depends on BOARD_PCA10090_INTERFACE1_MCU
	help
	 Pin P1.02 on nRF52840,
	 connected to P0.23 on the nRF9160.

endchoice

endif # BOARD_PCA10090_NRF52840_RESET

module = BOARD_PCA10090
module-str = Board Control
source "subsys/logging/Kconfig.template.log_config"

endif # BOARD_NRF52840_PCA10090
```

## boards/arm/nrf52840_pca10090/Kconfig.board
```kconfig
# Kconfig - nRF52840 PCA10090 board configuration
#
# Copyright (c) 2018 Nordic Semiconductor ASA
#
# SPDX-License-Identifier: Apache-2.0

config  BOARD_NRF52840_PCA10090
	bool "NRF52840 PCA10090"
	depends on SOC_NRF52840_QIAA
	# The GPIO driver is required by this board's initialization code
	# (board.c), so it is forced here to be enabled always, not only
	# enabled by default (in defconfig).
	select GPIO
```
