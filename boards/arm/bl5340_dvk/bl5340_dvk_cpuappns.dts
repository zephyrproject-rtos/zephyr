/*
 * Copyright (c) 2021 Laird Connectivity
 *
 * SPDX-License-Identifier: Apache-2.0
 */

/dts-v1/;
#include <nordic/nrf5340_cpuappns_qkaa.dtsi>
#include "bl5340_dvk_cpuapp_common.dts"

/ {
	model = "Laird Connectivity BL5340 (nRF5340) Application";
	compatible = "nordic,nrf5340-dk-nrf5340-cpuapp";

	chosen {
		zephyr,sram = &sram0_ns;
		zephyr,flash = &flash0;
		zephyr,code-partition = &slot0_ns_partition;
	};
};
