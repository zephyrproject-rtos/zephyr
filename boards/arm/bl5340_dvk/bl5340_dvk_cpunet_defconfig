## boards/arm/bl5340_dvk/bl5340_dvk_cpunet_defconfig
```kconfig
# SPDX-License-Identifier: Apache-2.0

CONFIG_SOC_SERIES_NRF53X=y
CONFIG_SOC_NRF5340_CPUNET_QKAA=y
CONFIG_BOARD_BL5340_DVK_CPUNET=y

# Enable MPU
CONFIG_ARM_MPU=y

# Enable hardware stack protection
CONFIG_HW_STACK_PROTECTION=y

# Enable GPIO
CONFIG_GPIO=y

# Enable UART driver
CONFIG_SERIAL=y

# Enable console
CONFIG_CONSOLE=y
CONFIG_UART_CONSOLE=y

CONFIG_PINCTRL=y
```

## boards/arm/bl5340_dvk/bl5340pa_dvk_cpunet_defconfig
```kconfig
# SPDX-License-Identifier: Apache-2.0

CONFIG_SOC_SERIES_NRF53X=y
CONFIG_SOC_NRF5340_CPUNET_QKAA=y
CONFIG_BOARD_BL5340PA_DVK_CPUNET=y

# Enable MPU
CONFIG_ARM_MPU=y

# Enable hardware stack protection
CONFIG_HW_STACK_PROTECTION=y

# enable GPIO
CONFIG_GPIO=y

# Disable logging as the serial instance is used by SPI for the FEM
CONFIG_LOG=n
```

## boards/arm/bl652_dvk/Kconfig
```kconfig
# Kconfig - BL652 DVK board configuration
#
# Copyright (c) 2019 Laird Connectivity
#
# SPDX-License-Identifier: Apache-2.0

if BOARD_BL652_DVK

config BOARD_ENABLE_DCDC
	bool "Enable DCDC mode"
	select SOC_DCDC_NRF52X
	default y

endif # BOARD_BL652_DVK
```

## boards/arm/bl652_dvk/Kconfig.board
```kconfig
# Kconfig - BL652 DVK board configuration
#
# Copyright (c) 2019 Laird Connectivity
#
# SPDX-License-Identifier: Apache-2.0

config  BOARD_BL652_DVK
	bool "BL652 DVK"
	depends on SOC_NRF52832_QFAA
```

## boards/arm/bl652_dvk/Kconfig.defconfig
```kconfig
# BL652 DVK board configuration

# Copyright (c) 2019 Laird Connectivity
# SPDX-License-Identifier: Apache-2.0

if BOARD_BL652_DVK

config BOARD
	default "bl652_dvk"

config BT_CTLR
	default BT

if DAC

config DAC_MCP4725
	default y

config DAC_INIT_PRIORITY
	default 80

config I2C
	default y

endif # DAC

endif # BOARD_BL652_DVK
```

## boards/arm/bl653_dvk/Kconfig.defconfig
```kconfig
# BL653 DVK board configuration

# Copyright (c) 2020 Laird Connectivity
# SPDX-License-Identifier: Apache-2.0

if BOARD_BL653_DVK

config BOARD
	default "bl653_dvk"

config BT_CTLR
	default BT

if DAC

config I2C
	default y

endif # DAC

endif # BOARD_BL653_DVK
```

## boards/arm/bl653_dvk/bl653_dvk_defconfig
```kconfig
# SPDX-License-Identifier: Apache-2.0

CONFIG_SOC_SERIES_NRF52X=y
CONFIG_SOC_NRF52833_QIAA=y
CONFIG_BOARD_BL653_DVK=y

# Enable MPU
CONFIG_ARM_MPU=y

# Enable RTT
CONFIG_USE_SEGGER_RTT=y

# enable GPIO
CONFIG_GPIO=y

# enable uart driver
CONFIG_SERIAL=y

# enable console
CONFIG_CONSOLE=y
CONFIG_UART_CONSOLE=y

# additional board options
CONFIG_GPIO_AS_PINRESET=y

# 32kHz clock source
CONFIG_CLOCK_CONTROL_NRF_K32SRC_RC=y
CONFIG_CLOCK_CONTROL_NRF_K32SRC_500PPM=y
```

## boards/arm/bl654_dvk/Kconfig
```kconfig
# Kconfig - BL654 DVK board configuration
#
# Copyright (c) 2019 Laird Connectivity
#
# SPDX-License-Identifier: Apache-2.0

if BOARD_BL654_DVK

config BOARD_ENABLE_DCDC
        bool "Enable DCDC mode"
        select SOC_DCDC_NRF52X
        default y

endif # BOARD_BL654_DVK
```

## boards/arm/bl654_dvk/Kconfig.board
```kconfig
# Kconfig - BL654 DVK board configuration
#
# Copyright (c) 2019 Laird Connectivity
#
# SPDX-License-Identifier: Apache-2.0

config  BOARD_BL654_DVK
	bool "BL654 DVK"
	depends on SOC_NRF52840_QIAA
```

## boards/arm/bl654_dvk/Kconfig.defconfig
```kconfig
# BL654 DVK board configuration

# Copyright (c) 2019 Laird Connectivity
# SPDX-License-Identifier: Apache-2.0

if BOARD_BL654_DVK

config BOARD
	default "bl654_dvk"

config BT_CTLR
	default BT

if DAC

config DAC_MCP4725
	default y

config DAC_INIT_PRIORITY
	default 80

config I2C
	default y

endif # DAC

endif # BOARD_BL654_DVK
```

## boards/arm/bl654_dvk/bl654_dvk_defconfig
```kconfig
# SPDX-License-Identifier: Apache-2.0

CONFIG_ARM=y
CONFIG_SOC_FAMILY_NRF=y
CONFIG_SOC_SERIES_NRF52X=y
CONFIG_SOC_NRF52840_QIAA=y
CONFIG_BOARD_BL654_DVK=y

# Enable MPU
CONFIG_ARM_MPU=y

# Enable RTT
CONFIG_HAS_SEGGER_RTT=y
CONFIG_USE_SEGGER_RTT=y

# enable GPIO
CONFIG_GPIO=y

# enable uart driver
CONFIG_SERIAL=y
CONFIG_UART_0_NRF_UART=y

# enable console
CONFIG_CONSOLE=y
CONFIG_UART_CONSOLE=y
CONFIG_RTT_CONSOLE=y

# additional board options
CONFIG_GPIO_AS_PINRESET=y

# 32kHz clock source
CONFIG_CLOCK_CONTROL_NRF_K32SRC_RC=y
CONFIG_CLOCK_CONTROL_NRF_K32SRC_500PPM=y
```

## boards/arm/bl654_sensor_board/Kconfig.board
```kconfig
# BL654 Sensor Board configuration

# Copyright (c) 2021 Laird Connectivity
# SPDX-License-Identifier: Apache-2.0

config BOARD_BL654_SENSOR_BOARD
	bool "BL654 Sensor Board"
	depends on SOC_NRF52840_QIAA
```

## boards/arm/bl654_sensor_board/Kconfig.defconfig
```kconfig
# BL654 Sensor Board configuration

# Copyright (c) 2021 Laird Connectivity
# SPDX-License-Identifier: Apache-2.0

config BT_CTLR
	default BT
```

## boards/arm/bl654_usb/Kconfig
```kconfig
# BL654 USB adapter board configuration

# Copyright (c) 2021 Laird Connectivity
# SPDX-License-Identifier: Apache-2.0

config BOARD_ENABLE_DCDC
	bool "Enable DCDC mode"
	select SOC_DCDC_NRF52X
	default y
	depends on BOARD_BL654_USB

config BOARD_ENABLE_USB_AUTOMATICALLY
	bool "Enable USB automatically"
	default y if USB_UART_CONSOLE
	depends on BOARD_BL654_USB
	help
	  Will automatically enable the USB peripheral upon boot if USB console
	  mode is selected, which means manually enabling USB from user-code is
	  not required

config BOARD_ENABLE_USB_AUTOMATICALLY_INIT_PRIORITY
	int "USB automatic init priority"
	default 96
	depends on BOARD_ENABLE_USB_AUTOMATICALLY
	help
	  Automatic USB peripheral enablement initialisation priority
```

## boards/arm/bl654_usb/Kconfig.board
```kconfig
# BL654 USB adapter board configuration

# Copyright (c) 2021 Laird Connectivity
# SPDX-License-Identifier: Apache-2.0

config  BOARD_BL654_USB
	bool "BL654 USB"
	depends on SOC_NRF52840_QIAA
```

## boards/arm/bl654_usb/Kconfig.defconfig
```kconfig
# BL654 USB adapter board configuration

# Copyright (c) 2021-2022 Laird Connectivity
# SPDX-License-Identifier: Apache-2.0

if BOARD_BL654_USB

config BOARD
	default "bl654_usb"

# To let the nRF5 bootloader load an application, the application
# must be linked after Nordic MBR, that is factory-programmed on the board.

# Nordic nRF5 bootloader exists outside of the partitions specified in the
# DTS file, so we manually override FLASH_LOAD_OFFSET to link the application
# correctly, after Nordic MBR, and limit the maximum size to not protude into
# the bootloader at the end of flash.

# When building MCUBoot, MCUBoot itself will select USE_DT_CODE_PARTITION
# which will make it link into the correct partition specified in DTS file,
# so no override or limit is necessary.

config FLASH_LOAD_OFFSET
	default 0x1000
	depends on !USE_DT_CODE_PARTITION

config FLASH_LOAD_SIZE
	default 0xdf000
	depends on !USE_DT_CODE_PARTITION

config USB_CDC_ACM
	default n if USB_DEVICE_BLUETOOTH

if BL654_USB_SERIAL_BACKEND_CDCACM

config UART_CONSOLE
	default CONSOLE

config USB_DEVICE_INITIALIZE_AT_BOOT
	default y if !MCUBOOT

config SHELL_BACKEND_SERIAL_CHECK_DTR
	default SHELL

# Logger cannot use itself to log
config USB_CDC_ACM_LOG_LEVEL
	default 0

# Set USB log level to error only
config USB_DEVICE_LOG_LEVEL
	default 1

endif #BL654_USB_SERIAL_BACKEND_CDCACM

config BT_CTLR
	default BT

endif # BOARD_BL654_USB
```

## boards/arm/bl654_usb/bl654_usb_defconfig
```kconfig
# SPDX-License-Identifier: Apache-2.0

CONFIG_SOC_SERIES_NRF52X=y
CONFIG_SOC_NRF52840_QIAA=y
CONFIG_BOARD_BL654_USB=y

# Enable MPU
CONFIG_ARM_MPU=y

# Enable uart driver
CONFIG_SERIAL=y

# Enable console
CONFIG_CONSOLE=y

# Enable GPIO
CONFIG_GPIO=y

# Enable USB
CONFIG_USB_DEVICE_STACK=y

# Additional board options
CONFIG_GPIO_AS_PINRESET=y

# 32KHz clock source
CONFIG_CLOCK_CONTROL_NRF_K32SRC_XTAL=y
CONFIG_CLOCK_CONTROL_NRF_K32SRC_150PPM=y

CONFIG_PINCTRL=y
```

## boards/arm/black_f407_generic/Kconfig.defconfig
```kconfig
# black_f407ve board configuration

# Copyright (c) 2020 Intel Corporation
# SPDX-License-Identifier: Apache-2.0

if BOARD_BLACK_F407VE

config BOARD
	default "black_f407ve"

config UART_2
	default y
	depends on UART_CONSOLE

config PWM_STM32_2
	default y
	depends on PWM

config CAN_2
	default y
	depends on CAN

config SPI_1
	default y
	depends on SPI

config SPI_2
	default y
	depends on SPI

config SPI_STM32_INTERRUPT
	default y
	depends on SPI

endif # BOARD_BLACK_F407VE
```

## boards/arm/black_f407ve/Kconfig.black_f407ve
```kconfig
# Copyright (c) 2022 Zephyr Project members and individual contributors
# SPDX-License-Identifier: Apache-2.0

config BOARD_BLACK_F407VE
	bool
	default y
	select SOC_SERIES_STM32F4X
	select SOC_STM32F407XE
```

## boards/arm/black_f407ve/Kconfig.board
```kconfig
# black_f407ve board configuration

# Copyright (c) 2020 Intel Corporation
# SPDX-License-Identifier: Apache-2.0

config BOARD_BLACK_F407VE
	bool "Black F407VE Development Board"
	depends on SOC_STM32F407XE
```

## boards/arm/black_f407ve/Kconfig.defconfig
```kconfig
# black_f407ve board configuration

# Copyright (c) 2020 Intel Corporation
# SPDX-License-Identifier: Apache-2.0

config SPI_STM32_INTERRUPT
	default y
	depends on SPI
```

## boards/arm/black_f407zg_pro/Kconfig.board
```kconfig
# black_f407zg board configuration

# Copyright (c) 2020 Intel Corporation
# SPDX-License-Identifier: Apache-2.0

config BOARD_BLACK_F407ZG_PRO
	bool "Black F407ZG Pro Development Board"
	depends on SOC_STM32F407XG
```

## boards/arm/black_f407zg_pro/Kconfig.defconfig
```kconfig
# black_f407zg board configuration

# Copyright (c) 2020 Intel Corporation
# SPDX-License-Identifier: Apache-2.0

config SPI_STM32_INTERRUPT
	default y
	depends on SPI
```

## boards/arm/blackpill_f401cc/Kconfig.board
```kconfig
# Copyright (c) 2022 Linaro Limited
# SPDX-License-Identifier: Apache-2.0

# STM32F401CC based Black Pill V3.0+ board configuration

config BOARD_BLACKPILL_F401CC
	bool "WeAct Studio Black Pill V3.0+ Board"
	depends on SOC_STM32F401XC
```

## boards/arm/blackpill_f401cc/Kconfig.defconfig
```kconfig
# Copyright (c) 2022 Linaro Limited
# SPDX-License-Identifier: Apache-2.0

# F401CE based Black Pill V3.0+ board board configuration

config SPI_STM32_INTERRUPT
	default y
	depends on SPI
```
