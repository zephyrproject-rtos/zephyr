/*
 * Copyright (c) 2020 Nordic Semiconductor ASA
 *
 * SPDX-License-Identifier: Apache-2.0
 */

/ {
	zephyr,fixture {
		gpio-loopback {
			compatible = "zephyr,fixture,gpio-loopback";
			out-gpios = <&sx1509b 0 0>; /* EXT0 */
			in-gpios = <&sx1509b 1 0>;  /* EXT1 */
		};
	};
};
