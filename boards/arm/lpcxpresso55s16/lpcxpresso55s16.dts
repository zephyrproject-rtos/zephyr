/*
 * Copyright (c) 2020 Henrik Brix Andersen <henrik@brixandersen.dk>
 *
 * SPDX-License-Identifier: Apache-2.0
 */

/dts-v1/;

#include <nxp/nxp_lpc55S16_ns.dtsi>
#include "lpcxpresso55s16_common.dtsi"

/ {
	model = "NXP LPCXpresso55S16 board";
	compatible = "nxp,lpc55xxx", "nxp,lpc";
};
