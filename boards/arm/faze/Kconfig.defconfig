## boards/arm/faze/Kconfig.defconfig
```kconfig
# Seagate FireCuda Gaming SSD (FaZe) board

# Copyright (c) 2020, Seagate Technology LLC
# SPDX-License-Identifier: Apache-2.0

if BOARD_FAZE

config BOARD
	default "faze"

endif # BOARD_FAZE
```

## boards/arm/faze/Kconfig.faze
```kconfig
# Copyright (c) 2022 Zephyr Project members and individual contributors
# SPDX-License-Identifier: Apache-2.0

config BOARD_FAZE
	bool
	default y
	select SOC_SERIES_LPC11U6X
	select SOC_LPC11U67
	select SOC_PART_NUMBER_LPC11U67JBD48
```

## boards/arm/faze/faze_defconfig
```kconfig
#
# Seagate FireCuda Gaming SSD (FaZe) board
#
# SPDX-License-Identifier: Apache-2.0
#

CONFIG_I2C=y
CONFIG_SYS_CLOCK_HW_CYCLES_PER_SEC=48000000
CONFIG_GPIO=y
CONFIG_BUILD_OUTPUT_HEX=y
CONFIG_SOC_SERIES_LPC11U6X=y
CONFIG_SOC_LPC11U67=y
CONFIG_MAIN_STACK_SIZE=512
CONFIG_ISR_STACK_SIZE=768
CONFIG_CLOCK_CONTROL_LPC11U6X_ENABLE_SRAM1=y
CONFIG_CLOCK_CONTROL_LPC11U6X_ENABLE_USB_RAM=y
CONFIG_CLOCK_CONTROL_LPC11U6X_PLL_SRC_SYSOSC=y
CONFIG_LED=y
CONFIG_LP503X=y
CONFIG_EEPROM=y
```

## boards/arm/fk7b0m1_vbt6/Kconfig.board
```kconfig
# STM32H7B0VBT FK7B0M1_VBT6 board

# Copyright (c) 2023 Charles Dias <charlesdias.cd@outlook.com>
# SPDX-License-Identifier: Apache-2.0

config BOARD_FK7B0M1_VBT6
	bool "FANKE FK7B0M1-VBT6 board"
	depends on SOC_STM32H7B0XX
```

## boards/arm/fk7b0m1_vbt6/Kconfig.defconfig
```kconfig
# STM32H7B0VBT board configuration

# Copyright (c) Charles Dias <charlesdias.cd@outlook.com>
# SPDX-License-Identifier: Apache-2.0

if BOARD_FK7B0M1_VBT6

config BOARD
	default "fk7b0m1_vbt6"

endif # BOARD_FK7B0M1_VBT6
```

## boards/arm/frdm_k22f/Kconfig.board
```kconfig
# FRDM-K22F board

# Copyright (c) 2018, Prevas A/S
# SPDX-License-Identifier: Apache-2.0

config BOARD_FRDM_K22F
	bool "NXP FRDM-K22F"
	depends on SOC_SERIES_KINETIS_K2X
	select SOC_PART_NUMBER_MK22FN512VLH12
```

## boards/arm/frdm_k22f/Kconfig.defconfig
```kconfig
# FRDM-K22F board

# Copyright (c) 2018 Prevas A/S
# SPDX-License-Identifier: Apache-2.0

if BOARD_FRDM_K22F

config BOARD
	default "frdm_k22f"

config OSC_XTAL0_FREQ
	default 8000000

config MCG_PRDIV0
	default 0x3

config MCG_VDIV0
	default 0xc

config MCG_FCRDIV
	default 0

config SPI_0
	default y
	depends on SPI

endif # BOARD_FRDM_K22F
```

## boards/arm/frdm_k22f/Kconfig.frdm_k22f
```kconfig
# Copyright (c) 2022 Zephyr Project members and individual contributors
# SPDX-License-Identifier: Apache-2.0

config BOARD_FRDM_K22F
	bool
	default y
	select SOC_MK22F51212
	select SOC_SERIES_KINETIS_K2X
	select SOC_PART_NUMBER_MK22FN512VLH12
```

## boards/arm/frdm_k22f/frdm_k22f_defconfig
```kconfig
#
# Copyright (c) 2018 Prevas A/S
# Copyright (c) 2019 Thomas Burdick <thomas.burdick@gmail.com>

#
# SPDX-License-Identifier: Apache-2.0
#

CONFIG_ARM=y
CONFIG_SOC_MK22F51212=y
CONFIG_SOC_SERIES_KINETIS_K2X=y
CONFIG_BOARD_FRDM_K22F=y
CONFIG_CONSOLE=y
CONFIG_UART_CONSOLE=y
CONFIG_SERIAL=y
CONFIG_CORTEX_M_SYSTICK=y
CONFIG_GPIO=y
CONFIG_PINMUX=y
CONFIG_SYS_CLOCK_HW_CYCLES_PER_SEC=72000000
CONFIG_OSC_LOW_POWER=y
```

## boards/arm/frdm_k32l2b3/Kconfig.board
```kconfig
# FRDM-K32L2B3 board

# Copyright (c) 2019, NXP
# SPDX-License-Identifier: Apache-2.0

config BOARD_FRDM_K32L2B3
	bool "NXP FRDM-K32L2B3"
	depends on SOC_SERIES_KINETIS_K32L2B
	select SOC_PART_NUMBER_K32L2B31VLH0A
```

## boards/arm/frdm_k32l2b3/Kconfig.defconfig
```kconfig
# FRDM-K32L2B3 board

# Copyright (c) 2019, NXP
# SPDX-License-Identifier: Apache-2.0

if BOARD_FRDM_K32L2B3

config BOARD
	default "frdm_k32l2b3"

if PINMUX_MCUX

config PINMUX_MCUX_PORTA
	default y

config PINMUX_MCUX_PORTB
	default y

config PINMUX_MCUX_PORTC
	default n

config PINMUX_MCUX_PORTD
	default y

config PINMUX_MCUX_PORTE
	default y

endif # PINMUX_MCUX

if GPIO_MCUX

config GPIO_MCUX_PORTA
	default y

config GPIO_MCUX_PORTB
	default n

config GPIO_MCUX_PORTC
	default n

config GPIO_MCUX_PORTD
	default y

config GPIO_MCUX_PORTE
	default y

endif # GPIO_MCUX

if UART_MCUX_LPUART

config UART_MCUX_LPUART_0
	default y if UART_CONSOLE

endif # UART_MCUX_LPUART_0

if I2C

config I2C_0
	default y

endif # I2C

if ADC

config ADC_0
	default y

endif # ADC

endif # BOARD_FRDM_K32L2B3
```

## boards/arm/frdm_k32l2b3/frdm_k32l2b3_defconfig
```kconfig
# SPDX-License-Identifier: Apache-2.0

CONFIG_ARM=y
CONFIG_SOC_SERIES_KINETIS_K32L2B=y
CONFIG_BOARD_FRDM_K32L2B3=y
CONFIG_CONSOLE=y
CONFIG_UART_CONSOLE=y
CONFIG_SERIAL=y
CONFIG_CORTEX_M_SYSTICK=y
CONFIG_GPIO=y
CONFIG_PINMUX=y
CONFIG_SYS_CLOCK_HW_CYCLES_PER_SEC=48000000
```

## boards/arm/frdm_k64f/Kconfig.board
```kconfig
# SPDX-License-Identifier: Apache-2.0

config BOARD_FRDM_K64F
	bool "Freescale FRDM-K64F"
	depends on SOC_SERIES_KINETIS_K6X
	select SOC_PART_NUMBER_MK64FN1M0VLL12
```

## boards/arm/frdm_k64f/Kconfig.defconfig
```kconfig
# FRDM-K64F board

# Copyright (c) 2016, Freescale Semiconductor, Inc.
# SPDX-License-Identifier: Apache-2.0

config OSC_XTAL0_FREQ
	default 50000000

config MCG_PRDIV0
	default 0x13

config MCG_VDIV0
	default 0x18

config MCG_FCRDIV
	default 1

if NETWORKING

config NET_L2_ETHERNET
	default y if !MODEM

endif # NETWORKING
```

## boards/arm/frdm_k64f/Kconfig.frdm_k64f
```kconfig
# Copyright (c) 2022 Zephyr Project members and individual contributors
# SPDX-License-Identifier: Apache-2.0

config BOARD_FRDM_K64F
	bool
	default y
	select SOC_MK64F12
	select SOC_SERIES_KINETIS_K6X
	select SOC_PART_NUMBER_MK64FN1M0VLL12
```

## boards/arm/frdm_k82f/Kconfig.board
```kconfig
# Kconfig - FRDM-K82F board configuration
#
# Copyright (c) 2019 SEAL AG
#
# SPDX-License-Identifier: Apache-2.0

config BOARD_FRDM_K82F
	bool "NXP FRDM-K82F"
	depends on SOC_SERIES_KINETIS_K8X
	select SOC_PART_NUMBER_MK82FN256VLL15
```

## boards/arm/frdm_k82f/Kconfig.defconfig
```kconfig
# FRDM-K82F board

# Copyright (c) 2019 SEAL AG
# SPDX-License-Identifier: Apache-2.0

if BOARD_FRDM_K82F

config BOARD
	default "frdm_k82f"

config OSC_XTAL0_FREQ
	default 12000000

config MCG_PRDIV0
	default 0x0

config MCG_VDIV0
	default 0x4

config MCG_FCRDIV
	default 1

config I2C
	default y if SENSOR

if FLASH

config SPI
	default y

config SPI_NOR
	default y

endif # FXOS8700

config FXOS8700_DRDY_INT1
	default y
	depends on FXOS8700_TRIGGER

endif # BOARD_FRDM_K82F
```

## boards/arm/frdm_k82f/Kconfig.frdm_k82f
```kconfig
# Copyright (c) 2022 Zephyr Project members and individual contributors
# SPDX-License-Identifier: Apache-2.0

config BOARD_FRDM_K82F
	bool
	default y
	select SOC_SERIES_KINETIS_K8X
	select SOC_MK82F25615
	select SOC_PART_NUMBER_MK82FN256VLL15
```

## boards/arm/frdm_k82f/frdm_k82f_defconfig
```kconfig
# SPDX-License-Identifier: Apache-2.0

CONFIG_CORTEX_M_SYSTICK=y
CONFIG_SOC_SERIES_KINETIS_K8X=y
CONFIG_SOC_MK82F25615=y
CONFIG_SERIAL=y
CONFIG_CONSOLE=y
CONFIG_UART_CONSOLE=y
CONFIG_UART_INTERRUPT_DRIVEN=y
CONFIG_PINCTRL=y
CONFIG_GPIO=y
CONFIG_SYS_CLOCK_HW_CYCLES_PER_SEC=120000000
CONFIG_OSC_LOW_POWER=y

# Enable MPU
CONFIG_ARM_MPU=y
CONFIG_HW_STACK_PROTECTION=y
```

## boards/arm/frdm_kl25z/Kconfig.board
```kconfig
# NXP FRDM-KL25Z board

# Copyright (c) 2017, NXP
# SPDX-License-Identifier: Apache-2.0

config BOARD_FRDM_KL25Z
	def_bool "$(BOARD)" = "frdm_kl25z"
	depends on SOC_SERIES_KINETIS_KL2X
	select SOC_PART_NUMBER_MKL25Z128VLK4
```

## boards/arm/frdm_kl25z/Kconfig.defconfig
```kconfig
# FRDM-KL25Z board

# Copyright (c) 2017, NXP
# SPDX-License-Identifier: Apache-2.0

if BOARD_FRDM_KL25Z

config BOARD
	default "frdm_kl25z"

config OSC_XTAL0_FREQ
	default 8000000

config MCG_PRDIV0
	default 0x01

config MCG_VDIV0
	default 0x00

config MCG_FRDIV
	default 5

config MCG_FCRDIV
	default 0

if FXOS8700

choice FXOS8700_MODE
	default FXOS8700_MODE_ACCEL
endchoice

endif # FXOS8700

endif # BOARD_FRDM_KL25Z
```

## boards/arm/frdm_kl25z/Kconfig.frdm_kl25z
```kconfig
# Copyright (c) 2022 Zephyr Project members and individual contributors
# SPDX-License-Identifier: Apache-2.0

config BOARD_FRDM_KL25Z
	bool
	default y
	select SOC_SERIES_KINETIS_KL2X
	select SOC_PART_NUMBER_MKL25Z128VLK4
	select SOC_MKL25Z4
```

## boards/arm/frdm_kl25z/frdm_kl25z_defconfig
```kconfig
# SPDX-License-Identifier: Apache-2.0

CONFIG_SOC_SERIES_KINETIS_KL2X=y
CONFIG_CONSOLE=y
CONFIG_UART_CONSOLE=y
CONFIG_SERIAL=y
CONFIG_CORTEX_M_SYSTICK=y
CONFIG_GPIO=y
CONFIG_PINCTRL=y
CONFIG_SYS_CLOCK_HW_CYCLES_PER_SEC=48000000
CONFIG_OSC_LOW_POWER=y
```

## boards/arm/frdm_kl46z/Kconfig.board
```kconfig
# FRDM-KL46Z board

# Copyright (c) 2017, NXP
# SPDX-License-Identifier: Apache-2.0

config BOARD_FRDM_KL46Z
	bool "NXP FRDM-KL46Z"
	depends on SOC_SERIES_KINETIS_KL4X
	select SOC_PART_NUMBER_MKL46Z256VLL4
```

## boards/arm/frdm_kl46z/Kconfig.defconfig
```kconfig
# FRDM-KL46Z board

# Copyright (c) 2017, NXP
# SPDX-License-Identifier: Apache-2.0
if BOARD_FRDM_KL46Z

config BOARD
	default "frdm_kl46z"

config OSC_XTAL0_FREQ
	default 8000000

config MCG_PRDIV0
	default 0x01

config MCG_VDIV0
	default 0x00

config MCG_FRDIV
	default 5

config MCG_FCRDIV
	default 0

if PINMUX_MCUX

config PINMUX_MCUX_PORTA
	default y

config PINMUX_MCUX_PORTB
	default y

config PINMUX_MCUX_PORTC
	default y

config PINMUX_MCUX_PORTD
	default y

config PINMUX_MCUX_PORTE
	default y

endif # PINMUX_MCUX

if GPIO_MCUX

config GPIO_MCUX_PORTA
	default y

config GPIO_MCUX_PORTB
	default y

config GPIO_MCUX_PORTC
	default y

config GPIO_MCUX_PORTD
	default y

config GPIO_MCUX_PORTE
	default y

endif # GPIO_MCUX

if UART_MCUX_LPSCI

config UART_MCUX_LPSCI_0
	default y if UART_CONSOLE

endif # UART_MCUX_LPSCI

if I2C

config I2C_0
	default y

endif # I2C

if ADC

config ADC_0
	default y

endif # ADC

endif # BOARD_FRDM_KL46Z
```
