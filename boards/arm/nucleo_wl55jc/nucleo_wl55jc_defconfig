## boards/arm/nucleo_wl55jc/nucleo_wl55jc_defconfig
```kconfig
CONFIG_SOC_SERIES_STM32WLX=y
CONFIG_SOC_STM32WL55XX=y

# enable uart driver
CONFIG_SERIAL=y

# enable GPIO
CONFIG_GPIO=y

# Enable Clocks
CONFIG_CLOCK_CONTROL=y

# console
CONFIG_CONSOLE=y
CONFIG_UART_CONSOLE=y

# Enable MPU
CONFIG_ARM_MPU=y

# Enable HW stack protection
CONFIG_HW_STACK_PROTECTION=y

# enable pin controller
CONFIG_PINCTRL=y
```

## boards/arm/nucleus_f103ze/Kconfig.board
```kconfig
# Kconfig - STM32 MINI A15 board configuration
#
# Copyright (c) 2016 Open-RnD Sp. z o.o.
#
# SPDX-License-Identifier: Apache-2.0
#

config BOARD_NUCLEUS_F103ZE
	bool "STM32F103ZET6 nucleus Development Board"
	depends on SOC_STM32F103XE
```

## boards/arm/nucleus_f103ze/Kconfig.defconfig
```kconfig
# Kconfig - STM32 MINI A15 board configuration
#
# Copyright (c) 2016 Open-RnD Sp. z o.o.
#
# SPDX-License-Identifier: Apache-2.0
#

if BOARD_NUCLEUS_F103ZE

config BOARD
	default nucleus_f103ze

endif # BOARD_NUCLEUS_F103ZE
```

## boards/arm/nucleus_f103ze/nucleus_f103ze_defconfig
```kconfig
CONFIG_ARM=y
CONFIG_BOARD_NUCLEUS_F103ZE=y
CONFIG_SOC_FAMILY_STM32=y
CONFIG_SOC_SERIES_STM32F1X=y
CONFIG_SOC_STM32F103XE=y
CONFIG_CORTEX_M_SYSTICK=y
# 72MHz system clock
CONFIG_SYS_CLOCK_HW_CYCLES_PER_SEC=72000000

CONFIG_HAS_DTS=y

# enable uart driver
CONFIG_SERIAL=y

#
# Capabilities
#
CONFIG_SERIAL_HAS_DRIVER=y
CONFIG_SERIAL_SUPPORT_INTERRUPT=y
CONFIG_UART_INTERRUPT_DRIVEN=y
CONFIG_UART_LINE_CTRL=y
CONFIG_UART_DRV_CMD=y

#
# Serial Drivers
#
CONFIG_UART_STM32=y
CONFIG_UART_STM32_PORT_1=y
CONFIG_UART_STM32_PORT_2=y


# enable pinmux
CONFIG_PINMUX=y
CONFIG_PINMUX_NAME="PINMUX"
CONFIG_PINMUX_INIT_PRIORITY=45
CONFIG_PINMUX_STM32=y
CONFIG_PINMUX_STM32_DEVICE_INITIALIZATION_PRIORITY=2


# enable GPIOs
CONFIG_GPIO=y
CONFIG_GPIO_STM32=y
CONFIG_GPIO_STM32_PORTA=y
CONFIG_GPIO_STM32_PORTB=y
CONFIG_GPIO_STM32_PORTC=y
CONFIG_GPIO_STM32_PORTD=y
CONFIG_GPIO_STM32_PORTE=y
CONFIG_GPIO_STM32_PORTF=y
CONFIG_GPIO_STM32_PORTG=y

# clock configuration
CONFIG_CLOCK_CONTROL=y
# Clock configuration for Cube Clock control driver
CONFIG_CLOCK_STM32_HSE_CLOCK=8000000
CONFIG_CLOCK_STM32_SYSCLK_SRC_PLL=y
# use HSE as PLL input
CONFIG_CLOCK_STM32F_PLL_SRC_HSE=y
# produce 72MHz clock at PLL output
CONFIG_CLOCK_STM32_PLL_XTPRE=n
CONFIG_CLOCK_STM32_PLL_MULTIPLIER=9
CONFIG_CLOCK_STM32_AHB_PRESCALER=1
# APB1 clock must not to exceed 36MHz limit
CONFIG_CLOCK_STM32_APB1_PRESCALER=2
CONFIG_CLOCK_STM32_APB2_PRESCALER=1

#enable SPI
CONFIG_SPI_LEGACY_API=y
CONFIG_SPI=y
CONFIG_SPI_INIT_PRIORITY=70
# CONFIG_SPI_CS_GPIO is not set
CONFIG_SPI_0=y
CONFIG_SPI_0_NAME="SPI_0"
CONFIG_SPI_0_IRQ_PRI=70
CONFIG_SPI_0_DEFAULT_CFG=0x80
CONFIG_SPI_0_DEFAULT_BAUD_RATE=500000
CONFIG_SPI_1=y
CONFIG_SPI_1_NAME="SPI_1"
CONFIG_SPI_1_IRQ_PRI=71
CONFIG_SPI_1_DEFAULT_CFG=0x80
CONFIG_SPI_1_DEFAULT_BAUD_RATE=500000

#enable I2C
CONFIG_I2C=y
CONFIG_I2C_INIT_PRIORITY=60
CONFIG_I2C_0=y
CONFIG_I2C_0_NAME="I2C_0"
CONFIG_I2C_0_DEFAULT_CFG=0x0
CONFIG_I2C_0_IRQ_PRI=60

#enable PWM
CONFIG_PWM=y
CONFIG_PWM_STM32=y
CONFIG_PWM_STM32_1=y
CONFIG_PWM_STM32_1_DEV_NAME="PWM_1"
CONFIG_PWM_STM32_2=y
CONFIG_PWM_STM32_2_DEV_NAME="PWM_2"

#enable ADC
CONFIG_ADC=y
CONFIG_ADC_INIT_PRIORITY=80
CONFIG_ADC_0=y
CONFIG_ADC_0_NAME="ADC_0"
CONFIG_ADC_0_IRQ_PRI=2
CONFIG_ADC_1=y
CONFIG_ADC_1_NAME="ADC_1"
CONFIG_ADC_1_IRQ_PRI=2

#enable RTC
CONFIG_RTC=y
CONFIG_RTC_0_NAME="RTC_0"

#enable WATCHDOG
CONFIG_WATCHDOG=y
CONFIG_IWDG_STM32=y
CONFIG_IWDG_STM32_PRESCALER=4
CONFIG_IWDG_STM32_RELOAD_COUNTER=2048
# CONFIG_IWDG_STM32_START_AT_BOOT is not set
CONFIG_IWDG_STM32_DEVICE_NAME="IWDG"

CONFIG_FLASH=y
CONFIG_SPI_FLASH_W25QXXDV=y
CONFIG_SPI_FLASH_W25QXXDV_SPI_NAME="SPI_0"
CONFIG_SPI_FLASH_W25QXXDV_DRV_NAME="W25QXXDV"
CONFIG_SPI_FLASH_W25QXXDV_INIT_PRIORITY=80
CONFIG_SPI_FLASH_W25QXXDV_SPI_FREQ_0=4
CONFIG_SPI_FLASH_W25QXXDV_SPI_SLAVE=1
CONFIG_SPI_FLASH_W25QXXDV_FLASH_SIZE=2097152
CONFIG_SPI_FLASH_W25QXXDV_MAX_DATA_LEN=256


CONFIG_SENSOR=y
CONFIG_SENSOR_INIT_PRIORITY=90
CONFIG_BME280=y
CONFIG_BME280_DEV_NAME="BME280"
CONFIG_BME280_DEV_TYPE_SPI=y
# CONFIG_BME280_DEV_TYPE_I2C is not set
CONFIG_BME280_SPI_DEV_NAME="SPI_0"
CONFIG_BME280_SPI_DEV_SLAVE=3

#
# Attributes
#
# CONFIG_BME280_TEMP_OVER_1X is not set
CONFIG_BME280_TEMP_OVER_2X=y
# CONFIG_BME280_TEMP_OVER_4X is not set
# CONFIG_BME280_TEMP_OVER_8X is not set
# CONFIG_BME280_TEMP_OVER_16X is not set
# CONFIG_BME280_PRESS_OVER_1X is not set
# CONFIG_BME280_PRESS_OVER_2X is not set
# CONFIG_BME280_PRESS_OVER_4X is not set
# CONFIG_BME280_PRESS_OVER_8X is not set
CONFIG_BME280_PRESS_OVER_16X=y
# CONFIG_BME280_HUMIDITY_OVER_1X is not set
# CONFIG_BME280_HUMIDITY_OVER_2X is not set
# CONFIG_BME280_HUMIDITY_OVER_4X is not set
# CONFIG_BME280_HUMIDITY_OVER_8X is not set
CONFIG_BME280_HUMIDITY_OVER_16X=y
# CONFIG_BME280_STANDBY_05MS is not set
# CONFIG_BME280_STANDBY_62MS is not set
# CONFIG_BME280_STANDBY_125MS is not set
# CONFIG_BME280_STANDBY_250MS is not set
# CONFIG_BME280_STANDBY_500MS is not set
CONFIG_BME280_STANDBY_1000MS=y
# CONFIG_BME280_STANDBY_2000MS is not set
# CONFIG_BME280_STANDBY_4000MS is not set
# CONFIG_BME280_FILTER_OFF is not set
# CONFIG_BME280_FILTER_2 is not set
CONFIG_BME280_FILTER_4=y
# CONFIG_BME280_FILTER_8 is not set
# CONFIG_BME280_FILTER_16 is not set
# CONFIG_BMG160 is not set
# CONFIG_BMI160 is not set
CONFIG_DHT=y
CONFIG_DHT_CHIP_DHT11=y
# CONFIG_DHT_CHIP_DHT22 is not set
CONFIG_DHT_NAME="DHT11"
CONFIG_DHT_GPIO_DEV_NAME="GPIO_0"
CONFIG_DHT_GPIO_PIN_NUM=0


#enable DMA
CONFIG_DMA=y
CONFIG_DMA_0_NAME="DMA_0"
CONFIG_DMA_0_IRQ_PRI=3
CONFIG_DMA_1_NAME="DMA_1"
CONFIG_DMA_1_IRQ_PRI=3
CONFIG_DMA_2_NAME="DMA_2"
CONFIG_DMA_2_IRQ_PRI=3

#enable CRYPTO
CONFIG_CRYPTO=y
CONFIG_CRYPTO_INIT_PRIORITY=90
CONFIG_CRYPTO_TINYCRYPT_SHIM=y
CONFIG_CRYPTO_TINYCRYPT_SHIM_MAX_SESSION=2
CONFIG_CRYPTO_TINYCRYPT_SHIM_DRV_NAME="CRYPTO_TC"

#
# C Library
#
CONFIG_NEWLIB_LIBC=y
CONFIG_NEWLIB_LIBC_FLOAT_PRINTF=y
CONFIG_NEWLIB_LIBC_FLOAT_SCANF=y

#
# HALs
#
CONFIG_HAS_CMSIS=y
CONFIG_HAS_STM32CUBE=y

#
# Cryptography
#
CONFIG_TINYCRYPT=y
CONFIG_TINYCRYPT_CTR_PRNG=y
CONFIG_TINYCRYPT_SHA256=y
CONFIG_TINYCRYPT_SHA256_HMAC=y
CONFIG_TINYCRYPT_SHA256_HMAC_PRNG=y
CONFIG_TINYCRYPT_ECC_DH=y
CONFIG_TINYCRYPT_ECC_DSA=y
CONFIG_TINYCRYPT_AES=y
CONFIG_TINYCRYPT_AES_CBC=y
CONFIG_TINYCRYPT_AES_CTR=y
CONFIG_TINYCRYPT_AES_CCM=y
CONFIG_TINYCRYPT_AES_CMAC=y
CONFIG_MBEDTLS=y

# console
CONFIG_CONSOLE=y
CONFIG_UART_CONSOLE=y
```

## boards/arm/numaker_pfm_m467/Kconfig.defconfig
```kconfig
# SPDX-License-Identifier: Apache-2.0
#
# Nuvoton PFM M467 board configuration
#
# Copyright (c) 2022 Nuvoton Technology Corporation.

if BOARD_NUMAKER_PFM_M467

config BOARD
	default "numaker_pfm_m467"

endif # BOARD_NUMAKER_PFM_M467
```

## boards/arm/numaker_pfm_m467/numaker_pfm_m467_defconfig
```kconfig
# SPDX-License-Identifier: Apache-2.0

CONFIG_SOC_SERIES_M46X=y
CONFIG_SOC_M467=y
CONFIG_BOARD_NUMAKER_PFM_M467=y
CONFIG_PINCTRL=y
CONFIG_GPIO=y
CONFIG_GPIO_NUMAKER=y

# Enable MPU
CONFIG_ARM_MPU=y
CONFIG_SYS_CLOCK_HW_CYCLES_PER_SEC=200000000

# enable uart driver
CONFIG_SERIAL=y
CONFIG_UART_NUMAKER=y
CONFIG_UART_INTERRUPT_DRIVEN=y

# console
CONFIG_CONSOLE=y
CONFIG_UART_CONSOLE=y
```

## boards/arm/nuvoton_pfm_m487/Kconfig.defconfig
```kconfig
# SPDX-License-Identifier: Apache-2.0
#
# Nuvoton PFM M487 board configuration
#
# Copyright (c) 2020 Linumiz
# Author: Saravanan Sekar <saravanan@linumiz.com>

if BOARD_NUVOTON_PFM_M487

config BOARD
	default "nuvoton_pfm_m487"

endif # BOARD_NUVOTON_PFM_M487
```

## boards/arm/nuvoton_pfm_m487/Kconfig.nuvoton_pfm_m487
```kconfig
# Copyright (c) 2022 Zephyr Project members and individual contributors
# SPDX-License-Identifier: Apache-2.0

config BOARD_NUVOTON_PFM_M487
	bool
	default y
	select SOC_SERIES_M48X
	select SOC_M487
```

## boards/arm/nuvoton_pfm_m487/nuvoton_pfm_m487_defconfig
```kconfig
# SPDX-License-Identifier: Apache-2.0


# Enable MPU
CONFIG_ARM_MPU=y
CONFIG_SYS_CLOCK_HW_CYCLES_PER_SEC=192000000

# enable uart driver
CONFIG_SERIAL=y

# console
CONFIG_CONSOLE=y
CONFIG_UART_CONSOLE=y
```

## boards/arm/olimex_lora_stm32wl_devkit/Kconfig.board
```kconfig
# Olimex LoRa STM32WL DevKit configuration

# Copyright (c) 2022 Martin Jäger <martin@libre.solar>
# SPDX-License-Identifier: Apache-2.0

config BOARD_OLIMEX_LORA_STM32WL_DEVKIT
	bool "Olimex LoRa STM32WL DevKit"
	depends on SOC_STM32WLE5XX
```

## boards/arm/olimex_lora_stm32wl_devkit/Kconfig.defconfig
```kconfig
# Olimex LoRa STM32WL DevKit configuration

# Copyright (c) 2022 Martin Jäger <martin@libre.solar>
# SPDX-License-Identifier: Apache-2.0

if BOARD_OLIMEX_LORA_STM32WL_DEVKIT

config BOARD
	default "olimex_lora_stm32wl_devkit"

endif # BOARD_OLIMEX_LORA_STM32WL_DEVKIT
```

## boards/arm/olimex_lora_stm32wl_devkit/Kconfig.olimex_lora_stm32wl_devkit
```kconfig
# Copyright (c) 2022 Zephyr Project members and individual contributors
# SPDX-License-Identifier: Apache-2.0

config BOARD_OLIMEX_LORA_STM32WL_DEVKIT
	bool
	default y
	select SOC_SERIES_STM32WLX
	select SOC_STM32WLE5XX
```

## boards/arm/olimex_lora_stm32wl_devkit/olimex_lora_stm32wl_devkit_defconfig
```kconfig
CONFIG_SOC_SERIES_STM32WLX=y
CONFIG_SOC_STM32WLE5XX=y

# enable uart driver
CONFIG_SERIAL=y

# enable GPIO
CONFIG_GPIO=y

# Enable Clocks
CONFIG_CLOCK_CONTROL=y

# console
CONFIG_CONSOLE=y
CONFIG_UART_CONSOLE=y

# PRELIMINARY: Don't enable MPU to prevent random MPU faults in Zephyr LoRa driver
#CONFIG_ARM_MPU=y

# PRELIMINARY: Don't enable HW stack protection (only available with MPU)
#CONFIG_HW_STACK_PROTECTION=y

# enable pin controller
CONFIG_PINCTRL=y
```

## boards/arm/olimex_stm32_e407/Kconfig.board
```kconfig
# OLIMEX-STM32-E407 board configuration

# Copyright (c) 2017, Erwin Rol <erwin@erwinrol.com>
# SPDX-License-Identifier: Apache-2.0

config BOARD_OLIMEX_STM32_E407
	bool "OLIMEX-STM32-E407 Development Board"
	depends on SOC_STM32F407XG
```

## boards/arm/olimex_stm32_e407/Kconfig.defconfig
```kconfig
# OLIMEX-STM32-E407 board configuration

# Copyright (c) 2017, Erwin Rol <erwin@erwinrol.com>
# SPDX-License-Identifier: Apache-2.0

if BOARD_OLIMEX_STM32_E407

config BOARD
	default "olimex_stm32_e407"

config UART_1
	default y
	depends on UART_CONSOLE

endif # BOARD_OLIMEX_STM32_E407
```

## boards/arm/olimex_stm32_e407/olimex_stm32_e407_defconfig
```kconfig
# SPDX-License-Identifier: Apache-2.0

CONFIG_ARM=y
CONFIG_BOARD_OLIMEX_STM32_E407=y
CONFIG_SOC_SERIES_STM32F4X=y
CONFIG_SOC_STM32F407XG=y
# 168MHz system clock
CONFIG_SYS_CLOCK_HW_CYCLES_PER_SEC=168000000

# Enable MPU
CONFIG_ARM_MPU=y

CONFIG_SERIAL=y

# console
CONFIG_CONSOLE=y
CONFIG_UART_CONSOLE=y

# enable pinmux
CONFIG_PINMUX=y

# enable GPIO
CONFIG_GPIO=y

# clock configuration
CONFIG_CLOCK_CONTROL=y

# Clock configuration for Cube Clock control driver
CONFIG_CLOCK_STM32_HSE_CLOCK=12000000
CONFIG_CLOCK_STM32_SYSCLK_SRC_PLL=y
# use HSE as PLL input
CONFIG_CLOCK_STM32_PLL_SRC_HSE=y
# produce 168MHz clock at PLL output
CONFIG_CLOCK_STM32_PLL_M_DIVISOR=6
CONFIG_CLOCK_STM32_PLL_N_MULTIPLIER=168
CONFIG_CLOCK_STM32_PLL_P_DIVISOR=2
CONFIG_CLOCK_STM32_PLL_Q_DIVISOR=7
CONFIG_CLOCK_STM32_AHB_PRESCALER=1
CONFIG_CLOCK_STM32_APB1_PRESCALER=4
CONFIG_CLOCK_STM32_APB2_PRESCALER=2

CONFIG_ENTROPY_GENERATOR=y
# CONFIG_ENTROPY_HAS_DRIVER is not set
CONFIG_ENTROPY_NAME="ENTROPY_0"
CONFIG_TEST_RANDOM_GENERATOR=y
CONFIG_TIMER_RANDOM_GENERATOR=y
```

## boards/arm/olimex_stm32_h103/Kconfig.board
```kconfig
# OLIMEX-STM32-H103 board configuration

# Copyright (c) 2020, Josep Puigdemont
# SPDX-License-Identifier: Apache-2.0

config BOARD_OLIMEX_STM32_H103
	bool "OLIMEX-STM32-H103 Development Board"
	depends on SOC_STM32F103XB
```

## boards/arm/olimex_stm32_h103/Kconfig.defconfig
```kconfig
# OLIMEX-STM32-H103 board configuration

# Copyright (c) 2020, Josep Puigdemont
# SPDX-License-Identifier: Apache-2.0

if BOARD_OLIMEX_STM32_H103

config BOARD
	default "olimex_stm32_h103"

endif # BOARD_OLIMEX_STM32_H103
```

## boards/arm/olimex_stm32_h103/Kconfig.olimex_stm32_h103
```kconfig
# Copyright (c) 2022 Zephyr Project members and individual contributors
# SPDX-License-Identifier: Apache-2.0

config BOARD_OLIMEX_STM32_H103
	bool
	default y
	select SOC_SERIES_STM32F1X
	select SOC_STM32F103XB
```

## boards/arm/olimex_stm32_h405/Kconfig.defconfig
```kconfig
# OLIMEX-STM32-H405 board configuration

# Copyright (c) 2020, Antony Pavlov <antonynpavlov@gmail.com>
# SPDX-License-Identifier: Apache-2.0

if BOARD_OLIMEX_STM32_H405

config BOARD
	default "olimex_stm32_h405"

endif # BOARD_OLIMEX_STM32_H405
```

## boards/arm/olimex_stm32_h407/Kconfig.board
```kconfig
# OLIMEX-STM32-H407 development board

# Copyright (c) 2018, Reto Schneider <code@reto-schneider.ch>
# SPDX-License-Identifier: Apache-2.0

config BOARD_OLIMEX_STM32_H407
	def_bool "$(BOARD)" = "olimex_stm32_h407"
	depends on SOC_STM32F407XG
```

## boards/arm/olimex_stm32_h407/Kconfig.defconfig
```kconfig
# Kconfig - OLIMEX-STM32-H407 board configuration
#
# Copyright (c) 2018, Reto Schneider <code@reto-schneider.ch>
#
# SPDX-License-Identifier: Apache-2.0
#

if BOARD_OLIMEX_STM32_H407

config BOARD
	default "olimex_stm32_h407"

if UART_CONSOLE

config UART_2
	default y

endif # UART_CONSOLE

endif # BOARD_OLIMEX_STM32_H407
```

## boards/arm/olimex_stm32_p103/Kconfig.board
```kconfig
# OLIMEX-STM32-P103 board configuration

# Copyright 2020, Sturla Lange
# SPDX-License-Identifier: Apache-2.0

config BOARD_OLIMEX_STM32_P103
	bool "OLIMEX-STM32-P103 Development Board"
	depends on SOC_STM32F103XB
```

## boards/arm/olimex_stm32_p103/Kconfig.defconfig
```kconfig
# OLIMEX-STM32-P103 board configuration

# Copyright 2020, Sturla Lange
# SPDX-License-Identifier: Apache-2.0

if BOARD_OLIMEX_STM32_P103

config BOARD
	default "olimex_stm32_p103"

endif # BOARD_OLIMEX_STM32_P103
```

## boards/arm/olimex_stm32_p405/Kconfig.board
```kconfig
# OLIMEX-STM32-P405 development board

# Copyright (c) 2017, Erwin Rol <erwin@erwinrol.com>
# SPDX-License-Identifier: Apache-2.0

config BOARD_OLIMEX_STM32_P405
	def_bool "$(BOARD)" = "olimex_stm32_p405"
	depends on SOC_STM32F405XG
```
