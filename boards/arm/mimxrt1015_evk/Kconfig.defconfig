## boards/arm/mimxrt1015_evk/Kconfig.defconfig
```kconfig
# MIMXRT1015-EVK board

# Copyright (c) 2019, NXP
# SPDX-License-Identifier: Apache-2.0

if BOARD_MIMXRT1015_EVK

config BOARD
	default "mimxrt1015_evk" if BOARD_MIMXRT1015_EVK

choice CODE_LOCATION
	default CODE_FLEXSPI
endchoice

endif # BOARD_MIMXRT1015_EVK
```

## boards/arm/mimxrt1015_evk/Kconfig.mimxrt1015_evk
```kconfig
# Copyright (c) 2022 Zephyr Project members and individual contributors
# SPDX-License-Identifier: Apache-2.0

config BOARD_MIMXRT1015_EVK
	bool
	default y
	select SOC_MIMXRT1015
	select SOC_SERIES_IMX_RT
	select SOC_PART_NUMBER_MIMXRT1015DAF5A
```

## boards/arm/mimxrt1020_evk/Kconfig
```kconfig
#
# Copyright (c) 2018, NXP
#
# SPDX-License-Identifier: Apache-2.0
#

if BOARD_MIMXRT1020_EVK

choice
	prompt "Code location selection"
	default CODE_QSPI

config CODE_ITCM
	bool "Link code into internal instruction tightly coupled memory (ITCM)"

config CODE_QSPI
	depends on BOARD_MIMXRT1020_EVK
	select NXP_IMX_RT_BOOT_HEADER
	bool "Link code into external QSPI memory"

endchoice

choice
	prompt "Data location selection"
	default DATA_SDRAM

config DATA_DTCM
	bool "Link data into internal data tightly coupled memory (DTCM)"

config DATA_SDRAM
	select DEVICE_CONFIGURATION_DATA if NXP_IMX_RT_BOOT_HEADER
	bool "Link data into external SDRAM memory"

endchoice

endif # BOARD_MIMXRT1020_EVK
```

## boards/arm/mimxrt1020_evk/Kconfig.board
```kconfig
#
# Copyright (c) 2018, NXP
#
# SPDX-License-Identifier: Apache-2.0
#

config BOARD_MIMXRT1020_EVK
	bool "NXP MIMXRT1020-EVK"
	depends on SOC_SERIES_IMX_RT
	select SOC_PART_NUMBER_MIMXRT1021DAG5A
```

## boards/arm/mimxrt1020_evk/Kconfig.defconfig
```kconfig
# MIMXRT1020-EVK board

# Copyright (c) 2018, NXP
# SPDX-License-Identifier: Apache-2.0

choice CODE_LOCATION
	default CODE_FLEXSPI
endchoice

config DISK_DRIVER_SDMMC
	default y if DISK_DRIVERS

if NETWORKING

config NET_L2_ETHERNET
	default y

config ETH_MCUX_PHY_RESET
	default y

endif # NETWORKING
```

## boards/arm/mimxrt1020_evk/Kconfig.mimxrt1020_evk
```kconfig
# Copyright (c) 2022 Zephyr Project members and individual contributors
# SPDX-License-Identifier: Apache-2.0

config BOARD_MIMXRT1020_EVK
	bool
	default y
	select SOC_MIMXRT1021
	select SOC_SERIES_IMX_RT
	select SOC_PART_NUMBER_MIMXRT1021DAG5A
```

## boards/arm/mimxrt1024_evk/Kconfig.board
```kconfig
# Copyright (c) 2020, NXP
# SPDX-License-Identifier: Apache-2.0

config BOARD_MIMXRT1024_EVK
	bool "NXP MIMXRT1024-EVK"
	depends on SOC_SERIES_IMX_RT
	select SOC_PART_NUMBER_MIMXRT1024DAG5A
```

## boards/arm/mimxrt1024_evk/Kconfig.defconfig
```kconfig
# MIMXRT1024-EVK board

# Copyright (c) 2020, NXP
# SPDX-License-Identifier: Apache-2.0

if BOARD_MIMXRT1024_EVK

config BOARD
	default "mimxrt1024_evk" if BOARD_MIMXRT1024_EVK

choice CODE_LOCATION
	default CODE_FLEXSPI
endchoice

config I2C_MCUX_LPI2C_BUS_RECOVERY
	default y
	depends on I2C_MCUX_LPI2C && PINCTRL

if NETWORKING

config NET_L2_ETHERNET
	default y

config ETH_MCUX_PHY_RESET
	default y

endif # NETWORKING

endif # BOARD_MIMXRT1024_EVK
```

## boards/arm/mimxrt1024_evk/Kconfig.mimxrt1024_evk
```kconfig
# Copyright (c) 2022 Zephyr Project members and individual contributors
# SPDX-License-Identifier: Apache-2.0

config BOARD_MIMXRT1024_EVK
	bool
	default y
	select SOC_MIMXRT1024
	select SOC_SERIES_IMX_RT
	select SOC_PART_NUMBER_MIMXRT1024DAG5A
```

## boards/arm/mimxrt1040_evk/Kconfig.defconfig
```kconfig
# Copyright 2023, NXP
# SPDX-License-Identifier: Apache-2.0

if BOARD_MIMXRT1040_EVK

config BOARD
	default "mimxrt1040_evk" if BOARD_MIMXRT1040_EVK

choice CODE_LOCATION
	default CODE_FLEXSPI
endchoice

endif # BOARD_MIMXRT1040_EVK
```

## boards/arm/mimxrt1040_evk/mimxrt1040_evk_defconfig
```kconfig
#
# Copyright 2023 NXP
#
# SPDX-License-Identifier: Apache-2.0
#

CONFIG_SOC_MIMXRT1042=y
CONFIG_SOC_SERIES_IMX_RT=y
CONFIG_BOARD_MIMXRT1040_EVK=y
CONFIG_CONSOLE=y
CONFIG_UART_CONSOLE=y
CONFIG_SERIAL=y
CONFIG_GPIO=y
CONFIG_ARM_MPU=y
CONFIG_HW_STACK_PROTECTION=y
CONFIG_PINCTRL=y
```

## boards/arm/mimxrt1050_evk/Kconfig
```kconfig
#
# Copyright (c) 2018, NXP
#
# SPDX-License-Identifier: Apache-2.0
#

if BOARD_MIMXRT1050_EVK

choice
	prompt "Code location selection"
	default CODE_ITCM

config CODE_ITCM
	bool "Link code into internal instruction tightly coupled memory (ITCM)"

config CODE_HYPERFLASH
	bool "Link code into external HyperFlash memory"

config CODE_QSPI
	bool "Link code into external QSPI memory"

endchoice

endif # BOARD_MIMXRT1050_EVK
```

## boards/arm/mimxrt1050_evk/Kconfig.board
```kconfig
# NXP MIMXRT1050-EVK

# Copyright (c) 2017, NXP
# SPDX-License-Identifier: Apache-2.0

config BOARD_MIMXRT1050_EVK
	def_bool "$(BOARD)" = "mimxrt1050_evk"
	depends on SOC_SERIES_IMX_RT
	select SOC_PART_NUMBER_MIMXRT1052DVL6A

config BOARD_MIMXRT1050_EVK_QSPI
	def_bool "$(BOARD)" = "mimxrt1050_evk_qspi"
	depends on SOC_SERIES_IMX_RT
	select SOC_PART_NUMBER_MIMXRT1052DVL6A
```

## boards/arm/mimxrt1050_evk/Kconfig.defconfig
```kconfig
# MIMXRT1050-EVK board

# Copyright (c) 2017, NXP
# SPDX-License-Identifier: Apache-2.0

if BOARD_MIMXRT1050_EVK || BOARD_MIMXRT1050_EVK_QSPI

config BOARD
	default "mimxrt1050_evk" if BOARD_MIMXRT1050_EVK
	default "mimxrt1050_evk_qspi" if BOARD_MIMXRT1050_EVK_QSPI

choice CODE_LOCATION
	default CODE_FLEXSPI
endchoice

if FLASH

config FLASH_MCUX_FLEXSPI_HYPERFLASH
	default y if BOARD_MIMXRT1050_EVK
	default n if BOARD_MIMXRT1050_EVK_QSPI

config FLASH_MCUX_FLEXSPI_NOR
	default y if BOARD_MIMXRT1050_EVK_QSPI
	default n if BOARD_MIMXRT1050_EVK

endif #FLASH

config KSCAN
	default y if LVGL

config INPUT
	default y if KSCAN

if INPUT

config INPUT_FT5336_INTERRUPT
	default y

endif # INPUT

if NETWORKING

config NET_L2_ETHERNET
	default y

config ETH_MCUX_PHY_RESET
	default y

endif # NETWORKING

if LVGL

config LV_Z_POINTER_KSCAN
	default y

config LV_Z_VDB_SIZE
	default 16

config LV_Z_DPI
	default 128

choice LV_COLOR_DEPTH
	default LV_COLOR_DEPTH_16
endchoice

endif # LVGL

endif # BOARD_MIMXRT1050_EVK || BOARD_MIMXRT1050_EVK_QSPI
```

## boards/arm/mimxrt1050_evk/Kconfig.mimxrt1050_evk_qspi
```kconfig
# Copyright (c) 2022 Zephyr Project members and individual contributors
# SPDX-License-Identifier: Apache-2.0

config BOARD_MIMXRT1050_EVK_QSPI
	bool
	default y
	select SOC_MIMXRT1052
	select SOC_SERIES_IMX_RT
	select SOC_PART_NUMBER_MIMXRT1052DVL6A
```

## boards/arm/mimxrt1050_evk/mimxrt1050_evk_defconfig
```kconfig
#
# Copyright (c) 2017, NXP
#
# SPDX-License-Identifier: Apache-2.0
#

CONFIG_ARM=y
CONFIG_SOC_MIMXRT1052=y
CONFIG_SOC_SERIES_IMX_RT=y
CONFIG_BOARD_MIMXRT1050_EVK=y
CONFIG_CONSOLE=y
CONFIG_UART_CONSOLE=y
CONFIG_SERIAL=y
CONFIG_CORTEX_M_SYSTICK=y
CONFIG_GPIO=y
CONFIG_SYS_CLOCK_HW_CYCLES_PER_SEC=600000000
CONFIG_OSC_EXTERNAL=y
CONFIG_ARM_MPU_IMX_RT=y
```

## boards/arm/mimxrt1050_evk/mimxrt1050_evk_qspi_defconfig
```kconfig
#
# Copyright (c) 2017, NXP
#
# SPDX-License-Identifier: Apache-2.0
#

CONFIG_SOC_MIMXRT1052=y
CONFIG_SOC_SERIES_IMX_RT=y
CONFIG_BOARD_MIMXRT1050_EVK_QSPI=y
CONFIG_CONSOLE=y
CONFIG_UART_CONSOLE=y
CONFIG_SERIAL=y
CONFIG_GPIO=y
CONFIG_ARM_MPU=y
CONFIG_HW_STACK_PROTECTION=y
CONFIG_PINCTRL=y
```

## boards/arm/mimxrt1050_evkb/Kconfig
```kconfig
#
# Copyright (c) 2018, NXP
#
# SPDX-License-Identifier: Apache-2.0
#

if BOARD_MIMXRT1050_EVKB || BOARD_MIMXRT1050_EVKB_QSPI

choice
	prompt "Code location selection"
	default CODE_ITCM

config CODE_ITCM
	bool "Link code into internal instruction tightly coupled memory (ITCM)"

config CODE_HYPERFLASH
	depends on BOARD_MIMXRT1050_EVKB
	select NXP_IMX_RT_BOOT_HEADER
	bool "Link code into external HyperFlash memory"

config CODE_QSPI
	depends on BOARD_MIMXRT1050_EVKB_QSPI
	select NXP_IMX_RT_BOOT_HEADER
	bool "Link code into external QSPI memory"

endchoice

endif # BOARD_MIMXRT1050_EVKB || BOARD_MIMXRT1050_EVKB_QSPI
```

## boards/arm/mimxrt1050_evkb/Kconfig.board
```kconfig
#
# Copyright (c) 2017, NXP
#
# SPDX-License-Identifier: Apache-2.0
#

config BOARD_MIMXRT1050_EVKB
	bool "NXP MIMXRT1050-EVKB"
	depends on SOC_SERIES_IMX_RT
	select SOC_PART_NUMBER_MIMXRT1052DVL6B

config BOARD_MIMXRT1050_EVKB_QSPI
	bool "NXP MIMXRT1050-EVKB-QSPI"
	depends on SOC_SERIES_IMX_RT
	select SOC_PART_NUMBER_MIMXRT1052DVL6B
```

## boards/arm/mimxrt1060_evk/Kconfig
```kconfig
#
# Copyright (c) 2018, NXP
#
# SPDX-License-Identifier: Apache-2.0
#

if BOARD_MIMXRT1060_EVK || BOARD_MIMXRT1060_EVK_HYPERFLASH

choice
	prompt "Code location selection"
	default CODE_HYPERFLASH if BOARD_MIMXRT1060_EVK_HYPERFLASH
	default CODE_QSPI if BOARD_MIMXRT1060_EVK

config CODE_ITCM
	bool "Link code into internal instruction tightly coupled memory (ITCM)"

config CODE_HYPERFLASH
	depends on BOARD_MIMXRT1060_EVK_HYPERFLASH
	select NXP_IMX_RT_BOOT_HEADER
	bool "Link code into external HyperFlash memory"

config CODE_QSPI
	depends on BOARD_MIMXRT1060_EVK
	select NXP_IMX_RT_BOOT_HEADER
	bool "Link code into external QSPI memory"

endchoice

choice
	prompt "Data location selection"
	default DATA_SDRAM

config DATA_DTCM
	bool "Link data into internal data tightly coupled memory (DTCM)"

config DATA_SDRAM
	select DEVICE_CONFIGURATION_DATA if NXP_IMX_RT_BOOT_HEADER
	bool "Link data into external SDRAM memory"

endchoice

endif # BOARD_MIMXRT1060_EVK || BOARD_MIMXRT1060_EVK_HYPERFLASH
```

## boards/arm/mimxrt1060_evk/Kconfig.board
```kconfig
#
# Copyright (c) 2018, NXP
#
# SPDX-License-Identifier: Apache-2.0
#

config BOARD_MIMXRT1060_EVK
	bool "NXP MIMXRT1060-EVK"
	depends on SOC_SERIES_IMX_RT
	select SOC_PART_NUMBER_MIMXRT1062DVL6A

config BOARD_MIMXRT1060_EVK_HYPERFLASH
	bool "NXP MIMXRT1060-EVK-HYPERFLASH"
	depends on SOC_SERIES_IMX_RT
	select SOC_PART_NUMBER_MIMXRT1062DVL6A
```

## boards/arm/mimxrt1060_evk/Kconfig.defconfig
```kconfig
# MIMXRT1060-EVK board

# Copyright 2018,2023 NXP
# SPDX-License-Identifier: Apache-2.0

if BOARD_MIMXRT1060_EVK || BOARD_MIMXRT1060_EVK_HYPERFLASH || BOARD_MIMXRT1060_EVKB

config BOARD
	default "mimxrt1060_evk" if BOARD_MIMXRT1060_EVK
	default "mimxrt1060_evk_hyperflash" if BOARD_MIMXRT1060_EVK_HYPERFLASH
	default "mimxrt1060_evkb" if BOARD_MIMXRT1060_EVKB

choice CODE_LOCATION
	default CODE_FLEXSPI
endchoice

config DEVICE_CONFIGURATION_DATA
	default y

config NXP_IMX_EXTERNAL_SDRAM
	default y

if FLASH

config FLASH_MCUX_FLEXSPI_NOR
	default y if BOARD_MIMXRT1060_EVK
	default y if BOARD_MIMXRT1060_EVKB
	default n if BOARD_MIMXRT1060_EVK_HYPERFLASH

config FLASH_MCUX_FLEXSPI_HYPERFLASH
	default y if BOARD_MIMXRT1060_EVK_HYPERFLASH
	default n if BOARD_MIMXRT1060_EVK
	default n if BOARD_MIMXRT1060_EVKB

endif #FLASH

config INPUT
	default y if LVGL

if INPUT

config INPUT_FT5336_INTERRUPT
	default y

endif # INPUT

if NETWORKING

config NET_L2_ETHERNET
	default y

config ETH_MCUX_PHY_RESET
	default y

endif # NETWORKING

if LVGL

# LVGL should allocate buffers equal to size of display
config LV_Z_VDB_SIZE
	default 100

# Enable double buffering
config LV_Z_DOUBLE_VDB
	default y

# Force full refresh. This prevents memory copy associated with partial
# display refreshes, which is not necessary for the eLCDIF driver
config LV_Z_FULL_REFRESH
	default y

config LV_DPI_DEF
	default 128

config LV_Z_BITS_PER_PIXEL
	default 16

# Force display buffers to be aligned to cache line size (32 bytes)
config LV_Z_VDB_ALIGN
	default 32

# Use offloaded render thread
config LV_Z_FLUSH_THREAD
	default y

choice LV_COLOR_DEPTH
	default LV_COLOR_DEPTH_16
endchoice

endif # LVGL

endif # BOARD_MIMXRT1060_EVK || BOARD_MIMXRT1060_EVK_HYPERFLASH || BOARD_MIMXRT1060_EVKB
```

## boards/arm/mimxrt1060_evk/Kconfig.mimxrt1060_evk_hyperflash
```kconfig
# Copyright (c) 2022 Zephyr Project members and individual contributors
# SPDX-License-Identifier: Apache-2.0

config BOARD_MIMXRT1060_EVK_HYPERFLASH
	bool
	default y
	select SOC_MIMXRT1062
	select SOC_SERIES_IMX_RT
	select SOC_PART_NUMBER_MIMXRT1062DVL6A
```

## boards/arm/mimxrt1060_evk/mimxrt1060_evk_defconfig
```kconfig
#
# Copyright (c) 2018, NXP
#
# SPDX-License-Identifier: Apache-2.0
#

CONFIG_SOC_MIMXRT1062=y
CONFIG_SOC_SERIES_IMX_RT=y
CONFIG_BOARD_MIMXRT1060_EVK=y
CONFIG_CONSOLE=y
CONFIG_UART_CONSOLE=y
CONFIG_SERIAL=y
CONFIG_GPIO=y
CONFIG_ARM_MPU=y
CONFIG_HW_STACK_PROTECTION=y
CONFIG_PINCTRL=y
```

## boards/arm/mimxrt1060_evk/mimxrt1060_evkb_defconfig
```kconfig
#
# Copyright (c) 2022, Whisper.ai
#
# SPDX-License-Identifier: Apache-2.0
#

CONFIG_SOC_MIMXRT1062=y
CONFIG_SOC_SERIES_IMX_RT=y
CONFIG_BOARD_MIMXRT1060_EVKB=y
CONFIG_CONSOLE=y
CONFIG_UART_CONSOLE=y
CONFIG_SERIAL=y
CONFIG_GPIO=y
CONFIG_ARM_MPU=y
CONFIG_HW_STACK_PROTECTION=y
CONFIG_PINCTRL=y
```
