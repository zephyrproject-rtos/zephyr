## boards/arm/rcar_h3_kingfisher/rcar_h3_kingfisher_cr7_defconfig
```kconfig
CONFIG_SOC_R8A77951=y
CONFIG_SOC_SERIES_RCAR_GEN3=y
CONFIG_BOARD_RCAR_H3_KINGFISHER_CR7=y
CONFIG_CLOCK_CONTROL=y
CONFIG_SYS_CLOCK_HW_CYCLES_PER_SEC=32000
CONFIG_RCAR_CMT_TIMER=y
CONFIG_CONSOLE=y
CONFIG_RAM_CONSOLE=y
CONFIG_FLASH_SIZE=0
CONFIG_FLASH_BASE_ADDRESS=0
CONFIG_GPIO=y
CONFIG_SERIAL=y
CONFIG_UART_CONSOLE=y
CONFIG_UART_INTERRUPT_DRIVEN=y
CONFIG_I2C_TCA954X_ROOT_INIT_PRIO=61
CONFIG_I2C_TCA954X_CHANNEL_INIT_PRIO=62
```

## boards/arm/rcar_h3_salvatorx/Kconfig.board
```kconfig
# Copyright (c) 2022 BayLibre, SAS
# SPDX-License-Identifier: Apache-2.0

config BOARD_RCAR_H3_SALVATORX_CR7
	bool "Cortex-R7 for Renesas H3 Salvator-X"
	depends on SOC_R8A77951
```

## boards/arm/rcar_h3_salvatorx/Kconfig.defconfig
```kconfig
# Copyright (c) 2022 BayLibre, SAS
# SPDX-License-Identifier: Apache-2.0

if BOARD_RCAR_H3_SALVATORX_CR7
config BOARD
	default "rcar_h3_salvatorx_cr7"
endif # BOARD_RCAR_H3_SALVATORX_CR7
```

## boards/arm/rcar_h3_salvatorx/Kconfig.rcar_h3_salvatorx_cr7
```kconfig
# Copyright (c) 2022 Zephyr Project members and individual contributors
# SPDX-License-Identifier: Apache-2.0

config BOARD_RCAR_H3_SALVATORX_CR7
	bool
	default y
	select SOC_R8A77951
	select SOC_SERIES_RCAR_GEN3
```

## boards/arm/rcar_h3ulcb/Kconfig.board
```kconfig
# Copyright (c) 2021 IoT.bzh
# SPDX-License-Identifier: Apache-2.0

config BOARD_RCAR_H3ULCB_CR7
	bool "Cortex-R7 for Renesas H3ULCB"
	depends on SOC_R8A77951
```

## boards/arm/rcar_h3ulcb/Kconfig.rcar_h3ulcb_cr7
```kconfig
# Copyright (c) 2022 Zephyr Project members and individual contributors
# SPDX-License-Identifier: Apache-2.0

config BOARD_RCAR_H3ULCB_CR7
	bool
	default y
	select SOC_R8A77951
	select SOC_SERIES_RCAR_GEN3
```

## boards/arm/rcar_h3ulcb/rcar_h3ulcb_cr7_defconfig
```kconfig
CONFIG_SOC_R8A77951=y
CONFIG_SOC_SERIES_RCAR_GEN3=y
CONFIG_BOARD_RCAR_H3ULCB_CR7=y
CONFIG_CLOCK_CONTROL=y
CONFIG_SYS_CLOCK_HW_CYCLES_PER_SEC=32000
CONFIG_RCAR_CMT_TIMER=y
CONFIG_CONSOLE=y
CONFIG_RAM_CONSOLE=y
CONFIG_FLASH_SIZE=0
CONFIG_FLASH_BASE_ADDRESS=0
CONFIG_GPIO=y
CONFIG_SERIAL=y
CONFIG_UART_CONSOLE=y
CONFIG_UART_INTERRUPT_DRIVEN=y
```

## boards/arm/rcar_m3ulcb/Kconfig.defconfig
```kconfig
# Copyright (c) 2021 IoT.bzh
# SPDX-License-Identifier: Apache-2.0

if BOARD_RCAR_M3ULCB_CR7
config BOARD
	default "rcar_m3ulcb_cr7"
endif # BOARD_RCAR_M3ULCB_CR7
```

## boards/arm/rcar_spider/Kconfig.board
```kconfig
# Copyright (c) 2023 IoT.bzh
# SPDX-License-Identifier: Apache-2.0

config BOARD_RCAR_SPIDER_CR52
	bool "Cortex-R52 for Renesas Spider"
	depends on SOC_R8A779F0
```

## boards/arm/rcar_spider/Kconfig.defconfig
```kconfig
# Copyright (c) 2023 IoT.bzh
# SPDX-License-Identifier: Apache-2.0

if BOARD_RCAR_SPIDER_CR52

config BOARD
	default "rcar_spider_cr52"

endif # BOARD_RCAR_SPIDER_CR52
```

## boards/arm/rcar_spider/rcar_spider_cr52_defconfig
```kconfig
CONFIG_SOC_R8A779F0=y
CONFIG_SOC_SERIES_RCAR_GEN4=y
CONFIG_BOARD_RCAR_SPIDER_CR52=y
CONFIG_CLOCK_CONTROL=y
CONFIG_SYS_CLOCK_HW_CYCLES_PER_SEC=12500000
CONFIG_CONSOLE=y
CONFIG_RAM_CONSOLE=y
CONFIG_FLASH_SIZE=0
CONFIG_FLASH_BASE_ADDRESS=0
CONFIG_SERIAL=y
CONFIG_UART_CONSOLE=y
CONFIG_UART_INTERRUPT_DRIVEN=y
CONFIG_GPIO=y
```

## boards/arm/rddrone_fmuk66/Kconfig.board
```kconfig
# Copyright (c) 2021, Electromaticus LLC, 2021 NXP
# SPDX-License-Identifier: Apache-2.0

config BOARD_RDDRONE_FMUK66
	bool "NXP RDDRONE-FMUK66"
	depends on SOC_SERIES_KINETIS_K6X
	select SOC_PART_NUMBER_MK66FN2M0VLQ18

config RDDRONE_FMUK66_INIT_PRIORITY
	int "Init priority"
	default 79
        depends on BOARD_RDDRONE_FMUK66
	help
	  Initialization priority of the rddrone_fmuk66
```

## boards/arm/rddrone_fmuk66/Kconfig.defconfig
```kconfig
# RDDRONE-FMUK66 board

# Copyright (c) 2021, Electromaticus LLC, 2021 NXP
# SPDX-License-Identifier: Apache-2.0

if BOARD_RDDRONE_FMUK66

config BOARD
	default "rddrone_fmuk66"

config OSC_XTAL0_FREQ
	default 16000000

config MCG_PRDIV0
	default 0x0

config MCG_VDIV0
	default 0x4

config MCG_FCRDIV
	default 1

config TEMP_KINETIS
	default y if "$(dt_nodelabel_enabled,adc1)"
	depends on SENSOR && ADC

if NETWORKING

config NET_L2_ETHERNET
	default y if !MODEM

endif # NETWORKING

endif # BOARD_RDDRONE_FMUK66
```

## boards/arm/rddrone_fmuk66/Kconfig.rddrone_fmuk66
```kconfig
# Copyright (c) 2022 Zephyr Project members and individual contributors
# SPDX-License-Identifier: Apache-2.0

config BOARD_RDDRONE_FMUK66
	bool
	default y
	select SOC_MK66F18
	select SOC_SERIES_KINETIS_K6X
	select SOC_PART_NUMBER_MK66FN2M0VLQ18
```

## boards/arm/rddrone_fmuk66/rddrone_fmuk66_defconfig
```kconfig
# SPDX-License-Identifier: Apache-2.0

CONFIG_SOC_MK66F18=y
CONFIG_SOC_SERIES_KINETIS_K6X=y
CONFIG_CONSOLE=y
CONFIG_UART_CONSOLE=y
CONFIG_SERIAL=y
CONFIG_GPIO=y
CONFIG_PINCTRL=y
CONFIG_SYS_CLOCK_HW_CYCLES_PER_SEC=160000000
CONFIG_OSC_EXTERNAL=y

# Enable MPU
CONFIG_ARM_MPU=y
CONFIG_HW_STACK_PROTECTION=y
```

## boards/arm/reel_board/Kconfig
```kconfig
# Kconfig - reel board configuration
#
# Copyright (c) 2018-2019 PHYTEC Messtechnik GmbH
#
# SPDX-License-Identifier: Apache-2.0

if BOARD_REEL_BOARD || BOARD_REEL_BOARD_V2

config BOARD_ENABLE_DCDC
	bool "Enable DCDC mode"
	select SOC_DCDC_NRF52X
	default y

endif # BOARD_REEL_BOARD || BOARD_REEL_BOARD_V2
```

## boards/arm/reel_board/Kconfig.board
```kconfig
# reel board configuration

# Copyright (c) 2018-2019 PHYTEC Messtechnik GmbH
# SPDX-License-Identifier: Apache-2.0

# reel board equipped with GDEH0213B1 display
config BOARD_REEL_BOARD
	def_bool "$(BOARD)" = "reel_board"
	depends on SOC_NRF52840_QIAA

# reel board equipped with GDEH0213B72 display
config BOARD_REEL_BOARD_V2
	def_bool "$(BOARD)" = "reel_board_v2"
	depends on SOC_NRF52840_QIAA
```

## boards/arm/reel_board/Kconfig.defconfig
```kconfig
# reel board configuration

# Copyright (c) 2018-2019 PHYTEC Messtechnik GmbH
# SPDX-License-Identifier: Apache-2.0

if BOARD_REEL_BOARD || BOARD_REEL_BOARD_V2

config BOARD
	default "reel_board" if BOARD_REEL_BOARD
	default "reel_board_v2" if BOARD_REEL_BOARD_V2

config I2C
	default y

config BT_CTLR
	default y
	depends on BT

if FXOS8700

choice FXOS8700_MODE
	default FXOS8700_MODE_ACCEL
endchoice

endif # FXOS8700

if LVGL

choice LV_COLOR_DEPTH
	default LV_COLOR_DEPTH_1
endchoice

config LV_Z_BITS_PER_PIXEL
	default 1

config LV_DPI_DEF
	default 130

config LV_Z_VDB_SIZE
	default 16

endif # LVGL

endif # BOARD_REEL_BOARD || BOARD_REEL_BOARD_V2
```

## boards/arm/reel_board/reel_board_defconfig
```kconfig
CONFIG_ARM=y
CONFIG_SOC_FAMILY_NRF=y
CONFIG_SOC_SERIES_NRF52X=y
CONFIG_SOC_NRF52840_QIAA=y
CONFIG_BOARD_REEL_BOARD=y

# Enable MPU
CONFIG_ARM_MPU_NRF52X=y

# enable uart driver
CONFIG_SERIAL=y
CONFIG_UART_NRFX=y
CONFIG_UART_0_NRF_UART=y

# enable console
CONFIG_CONSOLE=y
CONFIG_UART_CONSOLE=y

# additional board options
CONFIG_GPIO_AS_PINRESET=y

# bluetooth
CONFIG_BT=y
CONFIG_BT_CTLR=y
```

## boards/arm/rm1xx_dvk/Kconfig.board
```kconfig
# rm1xx_dvk board configuration

# Copyright (c) 2021 Laird Connectivity
# SPDX-License-Identifier: Apache-2.0

config BOARD_RM1XX_DVK
	bool "RM1XX_DVK"
	depends on SOC_NRF51822_QFAC
```

## boards/arm/ronoth_lodev/Kconfig.board
```kconfig
# Ronoth LoDev board configuration
# Copyright (c) 2020/2021 Dean Weiten <dmw@weiten.com>
# SPDX-License-Identifier: Apache-2.0

config BOARD_RONOTH_LODEV
	bool "Ronoth LoDev"
	depends on SOC_STM32L073XX
```

## boards/arm/ronoth_lodev/Kconfig.defconfig
```kconfig
# Ronoth LoDev board configuration
# Copyright (c) 2020/2021 Dean Weiten <dmw@weiten.com>
# SPDX-License-Identifier: Apache-2.0

config SPI_STM32_INTERRUPT
	default y
	depends on SPI
```
