## boards/arm/olimex_stm32_p405/Kconfig.defconfig
```kconfig
# OLIMEX-STM32-P405 board configuration

# Copyright (c) 2017, Erwin Rol <erwin@erwinrol.com>
# SPDX-License-Identifier: Apache-2.0

if BOARD_OLIMEX_STM32_P405

config BOARD
	default "olimex_stm32_p405"

config UART_2
	default y
	depends on UART_CONSOLE

config CAN_1
	default y
	depends on CAN

endif # BOARD_OLIMEX_STM32_P405
```

## boards/arm/olimex_stm32_p405/Kconfig.olimex_stm32_p405
```kconfig
# Copyright (c) 2022 Zephyr Project members and individual contributors
# SPDX-License-Identifier: Apache-2.0

config BOARD_OLIMEX_STM32_P405
	bool
	default y
	select SOC_SERIES_STM32F4X
	select SOC_STM32F405XG
```

## boards/arm/olimex_stm32_p405/olimex_stm32_p405_defconfig
```kconfig
# SPDX-License-Identifier: Apache-2.0

CONFIG_SOC_SERIES_STM32F4X=y
CONFIG_SOC_STM32F405XG=y
# 168MHz system clock
CONFIG_SYS_CLOCK_HW_CYCLES_PER_SEC=168000000

# Enable MPU
CONFIG_ARM_MPU=y

# Enable HW stack protection
CONFIG_HW_STACK_PROTECTION=y

CONFIG_SERIAL=y

# console
CONFIG_CONSOLE=y
CONFIG_UART_CONSOLE=y

# enable pinmux
CONFIG_PINMUX=y

# enable GPIO
CONFIG_GPIO=y

# clock configuration
CONFIG_CLOCK_CONTROL=y

# Clock configuration for Cube Clock control driver
CONFIG_CLOCK_STM32_HSE_CLOCK=8000000
CONFIG_CLOCK_STM32_SYSCLK_SRC_PLL=y
# use HSE as PLL input
CONFIG_CLOCK_STM32_PLL_SRC_HSE=y
# produce 168MHz clock at PLL output
CONFIG_CLOCK_STM32_PLL_M_DIVISOR=4
CONFIG_CLOCK_STM32_PLL_N_MULTIPLIER=168
CONFIG_CLOCK_STM32_PLL_P_DIVISOR=2
CONFIG_CLOCK_STM32_PLL_Q_DIVISOR=7
CONFIG_CLOCK_STM32_AHB_PRESCALER=1
CONFIG_CLOCK_STM32_APB1_PRESCALER=4
CONFIG_CLOCK_STM32_APB2_PRESCALER=2

CONFIG_ENTROPY_GENERATOR=y
```

## boards/arm/olimexino_stm32/Kconfig.board
```kconfig
# OLIMEXINO-STM32 development board

# Copyright (c) 2016, I-SENSE group of ICCS
# SPDX-License-Identifier: Apache-2.0

config BOARD_OLIMEXINO_STM32
	def_bool "$(BOARD)" = "olimexino_stm32"
	depends on SOC_STM32F103XB
	select USB_DC_STM32_DISCONN_ENABLE if USB
```

## boards/arm/olimexino_stm32/Kconfig.defconfig
```kconfig
# OLIMEXINO-STM32 board configuration

# Copyright (c) 2016, I-SENSE group of ICCS
# SPDX-License-Identifier: Apache-2.0

config SPI_STM32_INTERRUPT
	default y
	depends on SPI
```

## boards/arm/olimexino_stm32/Kconfig.olimexino_stm32
```kconfig
# Copyright (c) 2022 Zephyr Project members and individual contributors
# SPDX-License-Identifier: Apache-2.0

config BOARD_OLIMEXINO_STM32
	bool
	default y
	select SOC_SERIES_STM32F1X
	select SOC_STM32F103XB
```

## boards/arm/olimexino_stm32/olimexino_stm32_defconfig
```kconfig
# SPDX-License-Identifier: Apache-2.0

CONFIG_SOC_SERIES_STM32F1X=y
CONFIG_SOC_STM32F103XB=y
# 72MHz system clock
CONFIG_SYS_CLOCK_HW_CYCLES_PER_SEC=72000000

# Enable MPU
CONFIG_ARM_MPU=y

# enable uart driver
CONFIG_SERIAL=y

# enable console
CONFIG_CONSOLE=y
CONFIG_UART_CONSOLE=y

# enable pinmux
CONFIG_PINMUX=y

# enable GPIO
CONFIG_GPIO=y

# clock configuration
CONFIG_CLOCK_CONTROL=y
# Clock configuration for Cube Clock control driver
CONFIG_CLOCK_STM32_HSE_CLOCK=8000000
CONFIG_CLOCK_STM32_SYSCLK_SRC_PLL=y
# use HSE as PLL input
CONFIG_CLOCK_STM32_PLL_SRC_HSE=y
# produce 72MHz clock at PLL output
CONFIG_CLOCK_STM32_PLL_MULTIPLIER=9
CONFIG_CLOCK_STM32_AHB_PRESCALER=1
# APB1 clock must not to exceed 36MHz limit
CONFIG_CLOCK_STM32_APB1_PRESCALER=2
CONFIG_CLOCK_STM32_APB2_PRESCALER=1
```

## boards/arm/olimexino_stm32f303rc/Kconfig.board
```kconfig
# Olimexino STM32F303RC board configuration

# Copyright (c) 2022 David Jablonski
# SPDX-License-Identifier: Apache-2.0

config BOARD_OLIMEXINO_STM32F303RC
	bool "Olimexino STM32F303RC Development Board"
	depends on SOC_STM32F303XC
```

## boards/arm/olimexino_stm32f303rc/Kconfig.defconfig
```kconfig
# Olimexino STM32F303RC board configuration

# Copyright (c) 2022 David Jablonski
# SPDX-License-Identifier: Apache-2.0

if BOARD_OLIMEXINO_STM32F303RC

config BOARD
	default "olimexino_stm32f303rc"

endif # BOARD_OLIMEXINO_STM32F303RC
```

## boards/arm/otterpill/Kconfig.board
```kconfig
# Copyright (c) 2023 Jonas Otto
# SPDX-License-Identifier: Apache-2.0

config BOARD_OTTERPILL
	bool "OtterPill Board"
	depends on SOC_STM32F072X8
```

## boards/arm/otterpill/Kconfig.defconfig
```kconfig
# Copyright (c) 2023 Jonas Otto
# SPDX-License-Identifier: Apache-2.0

if BOARD_OTTERPILL

config BOARD
	default "otterpill"

endif # BOARD_OTTERPILL
```

## boards/arm/pan1770_evb/Kconfig.defconfig
```kconfig
# PAN1770 EVB configuration

# Copyright (c) 2022 Panasonic Industrial Devices Europe GmbH
# SPDX-License-Identifier: Apache-2.0

if BOARD_PAN1770_EVB

config BOARD
	default "pan1770_evb"

config BT_CTLR
	default BT

endif # BOARD_PAN1770_EVB
```

## boards/arm/pan1780_evb/Kconfig.board
```kconfig
# PAN1780 EVB configuration

# Copyright (c) 2022 Panasonic Industrial Devices Europe GmbH
# SPDX-License-Identifier: Apache-2.0

config BOARD_PAN1780_EVB
	bool "pan1780-evb"
	depends on SOC_NRF52840_QIAA
```

## boards/arm/pan1780_evb/Kconfig.defconfig
```kconfig
# PAN1780 EVB configuration

# Copyright (c) 2022 Panasonic Industrial Devices Europe GmbH
# SPDX-License-Identifier: Apache-2.0

if BOARD_PAN1780_EVB

config BOARD
	default "pan1780_evb"

config BT_CTLR
	default BT

endif # BOARD_PAN1780_EVB
```

## boards/arm/pan1780_evb/Kconfig.pan1780_evb
```kconfig
# Copyright (c) 2022 Zephyr Project members and individual contributors
# SPDX-License-Identifier: Apache-2.0

config BOARD_PAN1780_EVB
	bool
	default y
	select SOC_SERIES_NRF52X
	select SOC_NRF52840_QIAA
```

## boards/arm/pan1781_evb/Kconfig.board
```kconfig
# PAN1781 EVB configuration

# Copyright (c) 2022 Panasonic Industrial Devices Europe GmbH
# SPDX-License-Identifier: Apache-2.0

config BOARD_PAN1781_EVB
	bool "pan1781-evb"
	depends on SOC_NRF52820_QDAA
```

## boards/arm/pan1781_evb/Kconfig.defconfig
```kconfig
# PAN1781 EVB configuration

# Copyright (c) 2022 Panasonic Industrial Devices Europe GmbH
# SPDX-License-Identifier: Apache-2.0

if BOARD_PAN1781_EVB

config BOARD
	default "pan1781_evb"

config BT_CTLR
	default BT

endif # BOARD_PAN1781_EVB
```

## boards/arm/pan1782_evb/Kconfig.board
```kconfig
# PAN1782 EVB configuration

# Copyright (c) 2022 Panasonic Industrial Devices Europe GmbH
# SPDX-License-Identifier: Apache-2.0

config BOARD_PAN1782_EVB
	bool "pan1782-evb"
	depends on SOC_NRF52833_QIAA
```

## boards/arm/pan1782_evb/Kconfig.defconfig
```kconfig
# PAN1782 EVB configuration

# Copyright (c) 2022 Panasonic Industrial Devices Europe GmbH
# SPDX-License-Identifier: Apache-2.0

config BT_CTLR
	default BT
```

## boards/arm/pan1782_evb/pan1782_evb_defconfig
```kconfig
# PAN1782 EVB configuration

# Copyright (c) 2022 Panasonic Industrial Devices Europe GmbH
# SPDX-License-Identifier: Apache-2.0

CONFIG_SOC_SERIES_NRF52X=y
CONFIG_SOC_NRF52833_QIAA=y
CONFIG_BOARD_PAN1782_EVB=y

# Enable MPU
CONFIG_ARM_MPU=y

# Enable hardware stack protection
CONFIG_HW_STACK_PROTECTION=y

# Enable RTT
CONFIG_USE_SEGGER_RTT=y

# enable GPIO
CONFIG_GPIO=y

# enable uart driver
CONFIG_SERIAL=y

# enable console
CONFIG_CONSOLE=y
CONFIG_UART_CONSOLE=y

# additional board options
CONFIG_GPIO_AS_PINRESET=y

# using pinctrl
CONFIG_PINCTRL=y

# using rc for slow clock
CONFIG_CLOCK_CONTROL_NRF_K32SRC_RC=y
```

## boards/arm/pan1783/Kconfig.board
```kconfig
# PAN1783 EVB board configuration

# Copyright (c) 2023 Panasonic Industrial Devices Europe GmbH
# SPDX-License-Identifier: Apache-2.0

config BOARD_PAN1783_EVB_CPUAPP
	bool "PAN1783 EVB (nRF5340) Application MCU"
	depends on SOC_NRF5340_CPUAPP_QKAA

config BOARD_PAN1783A_EVB_CPUAPP
	bool "PAN1783A EVB (nRF5340) Application MCU"
	depends on SOC_NRF5340_CPUAPP_QKAA

config BOARD_PAN1783A_PA_EVB_CPUAPP
	bool "PAN1783A-PA EVB (nRF5340) Application MCU"
	depends on SOC_NRF5340_CPUAPP_QKAA

config BOARD_PAN1783_EVB_CPUNET
	bool "PAN1783 EVB (NRF5340) Network MCU"
	depends on SOC_NRF5340_CPUNET_QKAA

config BOARD_PAN1783A_EVB_CPUNET
	bool "PAN1783A EVB (NRF5340) Network MCU"
	depends on SOC_NRF5340_CPUNET_QKAA

config BOARD_PAN1783A_PA_EVB_CPUNET
	bool "PAN1783A-PA EVB (NRF5340) Network MCU"
	depends on SOC_NRF5340_CPUNET_QKAA
```

## boards/arm/pan1783/pan1783a_evb_cpunet_defconfig
```kconfig
# SPDX-License-Identifier: Apache-2.0

CONFIG_SOC_SERIES_NRF53X=y
CONFIG_SOC_NRF5340_CPUNET_QKAA=y
CONFIG_BOARD_PAN1783A_EVB_CPUNET=y

# Enable MPU
CONFIG_ARM_MPU=y

# Enable hardware stack protection
CONFIG_HW_STACK_PROTECTION=y

# enable GPIO
CONFIG_GPIO=y

# clock config
CONFIG_CLOCK_CONTROL_NRF_K32SRC_RC=y
CONFIG_CLOCK_CONTROL_NRF_K32SRC_XTAL=n
```

## boards/arm/pan1783_evb/Kconfig.defconfig
```kconfig
# PAN1783 EVB board configuration

# Copyright (c) 2023 Panasonic Industrial Devices Europe GmbH
# SPDX-License-Identifier: Apache-2.0

config BOARD
	default "pan1783_evb_cpuapp" if  BOARD_PAN1783_EVB_CPUAPP

config BOARD
	default "pan1783_evb_cpunet" if BOARD_PAN1783_EVB_CPUNET

config MBOX_NRFX_IPC
	default MBOX

if BOARD_PAN1783_EVB_CPUAPP

choice BT_HCI_BUS_TYPE
	default BT_HCI_IPC if BT
endchoice

config HEAP_MEM_POOL_SIZE
	default 4096 if BT_HCI_IPC

endif #  BOARD_PAN1783_EVB_CPUAPP

if BOARD_PAN1783_EVB_CPUNET

config BT_CTLR
	default y if BT

endif # BOARD_PAN1783_EVB_CPUNET
```

## boards/arm/particle_argon/Kconfig
```kconfig
# Kconfig - Particle Argon configuration
#
# Copyright (c) 2018 Matthias Boesl
#
# SPDX-License-Identifier: Apache-2.0

if BOARD_PARTICLE_ARGON

config BOARD_ENABLE_DCDC
	bool "Enable DCDC mode"
	select SOC_DCDC_NRF52X
	default y

endif # BOARD_PARTICLE_ARGON
```

## boards/arm/particle_argon/Kconfig.board
```kconfig
# Particle Argon board

# Copyright (c) 2018 Matthias Boesl
# SPDX-License-Identifier: Apache-2.0

config BOARD_PARTICLE_ARGON
	def_bool "$(BOARD)" = "particle_argon"
	depends on SOC_NRF52840_QIAA
```
