## boards/arm/stm32f412g_disco/stm32f412g_disco_defconfig
```kconfig
CONFIG_ARM=y
CONFIG_BOARD_STM32F412G_DISCO=y
CONFIG_SOC_SERIES_STM32F4X=y
CONFIG_SOC_STM32F412ZG=y
# 100MHz system clock (highest value to get a precise USB clock should be 96MHz)
CONFIG_SYS_CLOCK_HW_CYCLES_PER_SEC=100000000
CONFIG_SYS_CLOCK_TICKS_PER_SEC=1000

# Enable MPU
CONFIG_STM32_ARM_MPU_ENABLE=y

# enable USART2 - passthrough to STLINK v2 connector
CONFIG_UART_STM32_PORT_2=y

# enable pinmux
CONFIG_PINMUX=y

# enable GPIO ports A, B, C, D, E
CONFIG_GPIO=y
CONFIG_GPIO_STM32_PORTE=y

# clock configuration
CONFIG_CLOCK_CONTROL=y

# Clock configuration for Cube Clock control driver
CONFIG_CLOCK_STM32_HSE_CLOCK=8000000
CONFIG_CLOCK_STM32_SYSCLK_SRC_PLL=y
# use HSE as PLL input
CONFIG_CLOCK_STM32_PLL_SRC_HSE=y
# however, the board does not have an external oscillator, so just use
# the 8MHz clock signal coming from integrated STLink
CONFIG_CLOCK_STM32_HSE_BYPASS=y
# produce 100MHz clock at PLL output
CONFIG_CLOCK_STM32_PLL_M_DIVISOR=4
CONFIG_CLOCK_STM32_PLL_N_MULTIPLIER=100
CONFIG_CLOCK_STM32_PLL_P_DIVISOR=2
CONFIG_CLOCK_STM32_PLL_Q_DIVISOR=8
CONFIG_CLOCK_STM32_AHB_PRESCALER=1
CONFIG_CLOCK_STM32_APB1_PRESCALER=2
CONFIG_CLOCK_STM32_APB2_PRESCALER=1
```

## boards/arm/stm32f429i_disc1/Kconfig.board
```kconfig
# STM32F429I-DISC1 development board

# Copyright (c) 2016 Linaro Limited.
# SPDX-License-Identifier: Apache-2.0

config BOARD_STM32F429I_DISC1
	def_bool "$(BOARD)" = "stm32f429i_disc1"
	depends on SOC_STM32F429XX
```

## boards/arm/stm32f429i_disc1/Kconfig.defconfig
```kconfig
# STM32F4DISCOVERY board configuration

# Copyright (c) 2016 Linaro Limited.
# SPDX-License-Identifier: Apache-2.0

config MEMC
	default y if DISPLAY
```

## boards/arm/stm32f429i_disc1/stm32f429i_disc1_defconfig
```kconfig
CONFIG_ARM=y
CONFIG_BOARD_STM32F429I_DISC1=y
CONFIG_SOC_SERIES_STM32F4X=y
CONFIG_SOC_STM32F429XI=y
# 168MHz system clock
CONFIG_SYS_CLOCK_HW_CYCLES_PER_SEC=168000000
CONFIG_SYS_CLOCK_TICKS_PER_SEC=1000

# Enable MPU
CONFIG_STM32_ARM_MPU_ENABLE=y

# enable USART1 - passthrough to STLINK v2 connector
CONFIG_UART_STM32_PORT_1=y

# enable pinmux
CONFIG_PINMUX=y

# enable GPIO ports A, B, C, D, G
CONFIG_GPIO=y
CONFIG_GPIO_STM32_PORTG=y

# clock configuration
CONFIG_CLOCK_CONTROL=y

# Clock configuration for Cube Clock control driver
CONFIG_CLOCK_STM32_HSE_CLOCK=8000000
CONFIG_CLOCK_STM32_SYSCLK_SRC_PLL=y
# use HSE as PLL input
CONFIG_CLOCK_STM32_PLL_SRC_HSE=y
# produce 168MHz clock at PLL output
CONFIG_CLOCK_STM32_PLL_M_DIVISOR=8
CONFIG_CLOCK_STM32_PLL_N_MULTIPLIER=336
CONFIG_CLOCK_STM32_PLL_P_DIVISOR=2
CONFIG_CLOCK_STM32_PLL_Q_DIVISOR=7
CONFIG_CLOCK_STM32_AHB_PRESCALER=1
CONFIG_CLOCK_STM32_APB1_PRESCALER=4
CONFIG_CLOCK_STM32_APB2_PRESCALER=2
```

## boards/arm/stm32f469i_disco/Kconfig.board
```kconfig
# STM32F469I-DISCO development board

# Copyright (c) 2016 Linaro Limited.
# SPDX-License-Identifier: Apache-2.0

config BOARD_STM32F469I_DISCO
	def_bool "$(BOARD)" = "stm32f469i_disco"
	depends on SOC_STM32F469XX
```

## boards/arm/stm32f469i_disco/Kconfig.defconfig
```kconfig
# STM32F469I-DISCO board configuration

# Copyright (c) 2016 Linaro Limited.
# SPDX-License-Identifier: Apache-2.0

config SPI_STM32_INTERRUPT
	default y
	depends on SPI
```

## boards/arm/stm32f469i_disco/stm32f469i_disco_defconfig
```kconfig
CONFIG_ARM=y
CONFIG_BOARD_STM32F469I_DISCO=y
CONFIG_SOC_SERIES_STM32F4X=y
CONFIG_SOC_STM32F469XI=y
# 180MHz system clock
CONFIG_SYS_CLOCK_HW_CYCLES_PER_SEC=180000000
CONFIG_SYS_CLOCK_TICKS_PER_SEC=1000

# Enable MPU
CONFIG_STM32_ARM_MPU_ENABLE=y

# enable USART3 - passthrough to STLINK v2 connector
CONFIG_UART_STM32_PORT_3=y

# enable pinmux
CONFIG_PINMUX=y

# enable GPIO ports A, B, C, D
CONFIG_GPIO=y

# clock configuration
CONFIG_CLOCK_CONTROL=y

# Clock configuration for Cube Clock control driver
CONFIG_CLOCK_STM32_HSE_CLOCK=8000000
CONFIG_CLOCK_STM32_SYSCLK_SRC_PLL=y
# use HSE as PLL input
CONFIG_CLOCK_STM32_PLL_SRC_HSE=y
# produce 180MHz clock at PLL output
CONFIG_CLOCK_STM32_PLL_M_DIVISOR=8
CONFIG_CLOCK_STM32_PLL_N_MULTIPLIER=360
CONFIG_CLOCK_STM32_PLL_P_DIVISOR=2
CONFIG_CLOCK_STM32_PLL_Q_DIVISOR=7
CONFIG_CLOCK_STM32_AHB_PRESCALER=1
CONFIG_CLOCK_STM32_APB1_PRESCALER=4
CONFIG_CLOCK_STM32_APB2_PRESCALER=2
```

## boards/arm/stm32f4_disco/Kconfig.board
```kconfig
# STM32F4DISCOVERY development board

# Copyright (c) 2016 Linaro Limited.
# SPDX-License-Identifier: Apache-2.0

config BOARD_STM32F4_DISCO
	def_bool "$(BOARD)" = "stm32f4_disco"
	depends on SOC_STM32F407XG
```

## boards/arm/stm32f4_disco/Kconfig.defconfig
```kconfig
# STM32F4DISCOVERY board configuration

# Copyright (c) 2016 Linaro Limited.
# SPDX-License-Identifier: Apache-2.0

if BOARD_STM32F4_DISCO

config BOARD
	default "stm32f4_disco"

if UART_CONSOLE

config UART_2
	default y

endif # UART_CONSOLE

if PWM

config PWM_STM32_2
	default y

endif # PWM

if CAN

config CAN_2
	default y

endif # CAN

endif # BOARD_STM32F4_DISCO
```

## boards/arm/stm32f723e_disco/Kconfig.board
```kconfig
# STM32F723E Discovery board configuration

# Copyright (c) 2018 Aurelien Jarno
# SPDX-License-Identifier: Apache-2.0

config BOARD_STM32F723E_DISCO
	bool "STM32F723E Discovery Development Board"
	depends on SOC_STM32F723XX
```

## boards/arm/stm32f723e_disco/Kconfig.defconfig
```kconfig
# STM32F723E DISCOVERY board configuration

# Copyright (c) 2018 Aurelien Jarno
# SPDX-License-Identifier: Apache-2.0

config SPI_STM32_INTERRUPT
	default y
	depends on SPI
```

## boards/arm/stm32f723e_disco/stm32f723e_disco_defconfig
```kconfig
CONFIG_ARM=y
CONFIG_SOC_SERIES_STM32F7X=y
CONFIG_SYS_CLOCK_HW_CYCLES_PER_SEC=216000000
CONFIG_HAS_DTS=y
CONFIG_BOOT_BANNER=y
CONFIG_BUILD_TIMESTAMP=y
CONFIG_SYS_CLOCK_TICKS_PER_SEC=1000
CONFIG_UART_CONSOLE_ON_DEV_NAME="UART_6"
# CONFIG_UART_STM32_PORT_1 is not set
# CONFIG_UART_STM32_PORT_2 is not set
CONFIG_UART_STM32_PORT_6=y
CONFIG_GPIO=y
CONFIG_PINMUX=y
CONFIG_CLOCK_CONTROL=y
CONFIG_CLOCK_STM32_PLL_M_DIVISOR=5
CONFIG_CLOCK_STM32_PLL_N_MULTIPLIER=135
CONFIG_CLOCK_STM32_PLL_P_DIVISOR=2
CONFIG_CLOCK_STM32_PLL_Q_DIVISOR=2
CONFIG_CLOCK_STM32_AHB_PRESCALER=1
CONFIG_CLOCK_STM32_APB1_PRESCALER=4
CONFIG_CLOCK_STM32_APB2_PRESCALER=8
```

## boards/arm/stm32f746g_disco/Kconfig.board
```kconfig
# STM32F746G Discovery development board

# Copyright (c) 2018 Yurii Hamann
# SPDX-License-Identifier: Apache-2.0

config BOARD_STM32F746G_DISCO
	def_bool "$(BOARD)" = "stm32f746g_disco"
	depends on SOC_STM32F746XX
```

## boards/arm/stm32f746g_disco/Kconfig.defconfig
```kconfig
# STM32F746G DISCOVERY board configuration

# Copyright (c) 2018 Yurii Hamann
# SPDX-License-Identifier: Apache-2.0

if BOARD_STM32F746G_DISCO

config BOARD
	default "stm32f746g_disco"

if NETWORKING

config NET_L2_ETHERNET
	default y

endif # NETWORKING

if DISPLAY

config KSCAN
	default y

# MEMC needs to be enabled in order to store
# display buffer to external SDRAM connected to FMC
config MEMC
	default y

endif # DISPLAY

if KSCAN

config KSCAN_FT5336_INTERRUPT
	default y

endif # KSCAN

config DISK_DRIVER_SDMMC
	default y if DISK_DRIVERS

endif # BOARD_STM32F746G_DISCO
```

## boards/arm/stm32f7508_dk/Kconfig.defconfig
```kconfig
# STM32F7508-DK Discovery board configuration

# Copyright (c) 2022, Rtone.
# SPDX-License-Identifier: Apache-2.0

if BOARD_STM32F7508_DK

config BOARD
	default "stm32f7508_dk"

if NETWORKING

config NET_L2_ETHERNET
	default y

endif # NETWORKING

if DISPLAY

config KSCAN
	default y

# MEMC needs to be enabled in order to store
# display buffer to external SDRAM connected to FMC
config MEMC
	default y

endif # DISPLAY

if KSCAN

config KSCAN_FT5336_INTERRUPT
	default y

endif # KSCAN

config DISK_DRIVER_SDMMC
	default y if DISK_DRIVERS

endif # BOARD_STM32F7508_DK
```

## boards/arm/stm32f769i_disco/Kconfig.board
```kconfig
# STM32F769I Discovery development board

# Copyright (c) 2018 Yong Jin
# SPDX-License-Identifier: Apache-2.0

config BOARD_STM32F769I_DISCO
	def_bool "$(BOARD)" = "stm32f769i_disco"
	depends on SOC_STM32F769XX
```

## boards/arm/stm32f769i_disco/Kconfig.defconfig
```kconfig
# STM32F769I DISCOVERY board configuration

# Copyright (c) 2018 Yong Jin
# SPDX-License-Identifier: Apache-2.0

if BOARD_STM32F769I_DISCO

config BOARD
	default "stm32f769i_disco"

config SPI_STM32_INTERRUPT
	default y
	depends on SPI

config INPUT
	default y if LVGL

if NETWORKING

config NET_L2_ETHERNET
	default y

endif # NETWORKING

endif # BOARD_STM32F769I_DISCO
```

## boards/arm/stm32f769i_disco/Kconfig.stm32f769i_disco
```kconfig
# Copyright (c) 2022 Zephyr Project members and individual contributors
# SPDX-License-Identifier: Apache-2.0

config BOARD_STM32F769I_DISCO
	bool
	default y
	select SOC_SERIES_STM32F7X
	select SOC_STM32F769XX
```

## boards/arm/stm32f769i_disco/stm32f769i_disco_defconfig
```kconfig
# SPDX-License-Identifier: Apache-2.0

CONFIG_ARM=y
CONFIG_BOARD_STM32F769I_DISCO=y
CONFIG_SOC_SERIES_STM32F7X=y
CONFIG_SOC_STM32F769XX=y
# 216MHz system clock
CONFIG_SYS_CLOCK_HW_CYCLES_PER_SEC=216000000

CONFIG_SERIAL=y

# console
CONFIG_CONSOLE=y
CONFIG_UART_CONSOLE=y

# enable pinmux
CONFIG_PINMUX=y

# enable GPIO
CONFIG_GPIO=y

# clock configuration
CONFIG_CLOCK_CONTROL=y

# Clock configuration for Cube Clock control driver
CONFIG_CLOCK_STM32_HSE_CLOCK=25000000
CONFIG_CLOCK_STM32_SYSCLK_SRC_PLL=y
# use HSE as PLL input
CONFIG_CLOCK_STM32_PLL_SRC_HSE=y
# produce 216MHz clock at PLL output
CONFIG_CLOCK_STM32_PLL_M_DIVISOR=25
CONFIG_CLOCK_STM32_PLL_N_MULTIPLIER=432
CONFIG_CLOCK_STM32_PLL_P_DIVISOR=2
CONFIG_CLOCK_STM32_PLL_Q_DIVISOR=9
CONFIG_CLOCK_STM32_AHB_PRESCALER=1
CONFIG_CLOCK_STM32_APB1_PRESCALER=4
CONFIG_CLOCK_STM32_APB2_PRESCALER=2
```

## boards/arm/stm32g0316_disco/Kconfig.board
```kconfig
# STM32G0316 Discovery development board

# Copyright (c) 2019 SEAL AG
# SPDX-License-Identifier: Apache-2.0

config BOARD_STM32G0316_DISCO
	def_bool "$(BOARD)" = "stm32g0316_disco"
	depends on SOC_STM32G031XX
```

## boards/arm/stm32g0316_disco/stm32g0316_disco_defconfig
```kconfig
# Zephyr Kernel Configuration
CONFIG_SOC_SERIES_STM32G0X=y
CONFIG_SOC_STM32G031XX=y
CONFIG_CORTEX_M_SYSTICK=y

# 64MHz system clock
CONFIG_SYS_CLOCK_HW_CYCLES_PER_SEC=64000000

# Kernel Options due to Low Memory (8k)
CONFIG_MAIN_STACK_SIZE=640
CONFIG_IDLE_STACK_SIZE=200
CONFIG_ISR_STACK_SIZE=512

# Serial Drivers
CONFIG_SERIAL=y
CONFIG_UART_INTERRUPT_DRIVEN=y
# enable console
CONFIG_CONSOLE=y
CONFIG_UART_CONSOLE=y

# Pinmux Driver
CONFIG_PINMUX=y

# GPIO Controller
CONFIG_GPIO=y

# Clock configuration
CONFIG_CLOCK_CONTROL=y
# SYSCLK selection
CONFIG_CLOCK_STM32_SYSCLK_SRC_PLL=y
# PLL configuration
CONFIG_CLOCK_STM32_PLL_SRC_HSI=y
# produce 64MHz clock at PLL output
CONFIG_CLOCK_STM32_PLL_M_DIVISOR=1
CONFIG_CLOCK_STM32_PLL_N_MULTIPLIER=8
CONFIG_CLOCK_STM32_PLL_P_DIVISOR=2
CONFIG_CLOCK_STM32_PLL_Q_DIVISOR=2
CONFIG_CLOCK_STM32_PLL_R_DIVISOR=2
CONFIG_CLOCK_STM32_AHB_PRESCALER=1
CONFIG_CLOCK_STM32_APB1_PRESCALER=1
```

## boards/arm/stm32g071b_disco/Kconfig.board
```kconfig
# STM32G071B Discovery board configuration

# Copyright 2021 The Chromium OS Authors
# SPDX-License-Identifier: Apache-2.0

config BOARD_STM32G071B_DISCO
	bool "STM32G071B Discovery Board"
	depends on SOC_STM32G071XX
```

## boards/arm/stm32g071b_disco/stm32g071b_disco_defconfig
```kconfig
# Copyright 2021 The Chromium OS Authors
#
# SPDX-License-Identifier: Apache-2.0

CONFIG_SOC_SERIES_STM32G0X=y
CONFIG_SOC_STM32G071XX=y

# Serial Drivers
CONFIG_SERIAL=y
CONFIG_UART_INTERRUPT_DRIVEN=y

# enable console
CONFIG_CONSOLE=y
CONFIG_UART_CONSOLE=y

# Pinmux Driver
CONFIG_PINMUX=y

# GPIO Controller
CONFIG_GPIO=y

# Enable Clocks
CONFIG_CLOCK_CONTROL=y
```

## boards/arm/stm32g081b_eval/Kconfig.stm32g081b_eval
```kconfig
# Copyright (c) 2022 Zephyr Project members and individual contributors
# SPDX-License-Identifier: Apache-2.0

config BOARD_STM32G081B_EVAL
	bool
	default y
	select SOC_SERIES_STM32G0X
	select SOC_STM32G081XX
```

## boards/arm/stm32h573i_dk/Kconfig.board
```kconfig
# STM32H573I-DK Discovery kit board configuration
#
# Copyright (c) 2023 STMicroelectronics
#
# SPDX-License-Identifier: Apache-2.0
#

config BOARD_STM32H573I_DK
	bool "STM32H573I-DK Discovery Development Board"
	depends on SOC_STM32H573XX
```
