## boards/arm/adafruit_qt_py_rp2040/adafruit_qt_py_rp2040_defconfig
```kconfig
# SPDX-License-Identifier: Apache-2.0

CONFIG_SOC_SERIES_RP2XXX=y
CONFIG_SOC_RP2040=y
CONFIG_BOARD_ADAFRUIT_QT_PY_RP2040=y

CONFIG_SYS_CLOCK_HW_CYCLES_PER_SEC=125000000

# enable uart driver
CONFIG_SERIAL=y
CONFIG_UART_INTERRUPT_DRIVEN=y

# enable console
CONFIG_CONSOLE=y
CONFIG_UART_CONSOLE=y

# Enable reset by default
CONFIG_RESET=y

# Code partition needed to target the correct flash range
CONFIG_USE_DT_CODE_PARTITION=y

# Output UF2 by default, native bootloader supports it.
CONFIG_BUILD_OUTPUT_UF2=y

# Enable USB support
CONFIG_USB_DEVICE_STACK=y
CONFIG_USB_DEVICE_INITIALIZE_AT_BOOT=y
CONFIG_USB_DEVICE_VID=0x2e8a
CONFIG_USB_DEVICE_PID=0x0001
CONFIG_USB_DEVICE_PRODUCT="Adafruit QT Py RP2040"
CONFIG_USB_DEVICE_MANUFACTURER="Adafruit"

CONFIG_USB_CDC_ACM=y
```

## boards/arm/adafruit_trinket_m0/Kconfig.adafruit_trinket_m0
```kconfig
# Copyright (c) 2022 Zephyr Project members and individual contributors
# SPDX-License-Identifier: Apache-2.0

config BOARD_ADAFRUIT_TRINKET_M0
	bool
	default y
	select SOC_SERIES_SAMD21
	select SOC_PART_NUMBER_SAMD21E18A
```

## boards/arm/adafruit_trinket_m0/Kconfig.board
```kconfig
# Adafruit Trinket M0 board configuration

# Copyright (c) 2018 Google LLC.
# SPDX-License-Identifier: Apache-2.0

config BOARD_ADAFRUIT_TRINKET_M0
	def_bool "$(BOARD)" = "adafruit_trinket_m0"
	depends on SOC_PART_NUMBER_SAMD21E18A
```

## boards/arm/adafruit_trinket_m0/Kconfig.defconfig
```kconfig
# Adafruit Trinket M0 board configuration

# Copyright (c) 2018 Google LLC.
# SPDX-License-Identifier: Apache-2.0

config BOARD
	default "adafruit_trinket_m0"
	depends on BOARD_ADAFRUIT_TRINKET_M0
```

## boards/arm/adafruit_trinket_m0/adafruit_trinket_m0_defconfig
```kconfig
# SPDX-License-Identifier: Apache-2.0

CONFIG_SOC_SERIES_SAMD21=y
CONFIG_SOC_PART_NUMBER_SAMD21E18A=y
CONFIG_BOARD_ADAFRUIT_TRINKET_M0=y
CONFIG_SOC_ATMEL_SAMD_OSC8M_AS_MAIN=y
CONFIG_CORTEX_M_SYSTICK=y
CONFIG_CONSOLE=y
CONFIG_UART_CONSOLE=y
CONFIG_UART_INTERRUPT_DRIVEN=y
CONFIG_SERIAL=y
CONFIG_PINMUX=y
CONFIG_USE_DT_CODE_PARTITION=y
CONFIG_BOOTLOADER_BOSSA=y
CONFIG_BOOTLOADER_BOSSA_ADAFRUIT_UF2=y
```

## boards/arm/adi_eval_adin1110ebz/Kconfig.board
```kconfig
# ADI EVAL-ADIN1110EBZ board configuration

# Copyright (c) 2024 BayLibre
# SPDX-License-Identifier: Apache-2.0

config BOARD_ADI_EVAL_ADIN1110EBZ
	bool "ADI EVAL-ADIN1110EBZ evaulation board"
	depends on SOC_STM32L4S5XX
```

## boards/arm/adi_eval_adin1110ebz/adi_eval_adin1110ebz_defconfig
```kconfig
# SPDX-License-Identifier: Apache-2.0

CONFIG_BOARD_ADI_EVAL_ADIN1110EBZ=y
CONFIG_SOC_SERIES_STM32L4X=y
CONFIG_SOC_STM32L4S5XX=y

# enable uart driver
CONFIG_SERIAL=y

# console
CONFIG_CONSOLE=y
CONFIG_UART_CONSOLE=y

# enable GPIO
CONFIG_GPIO=y

# Enable Clocks
CONFIG_CLOCK_CONTROL=y

# enable pin controller
CONFIG_PINCTRL=y
```

## boards/arm/adi_eval_adin2111ebz/Kconfig.board
```kconfig
# ADI EVAL-ADIN2111EBZ board configuration

# Copyright (c) 2024 BayLibre
# SPDX-License-Identifier: Apache-2.0

config BOARD_ADI_EVAL_ADIN2111EBZ
	bool "ADI EVAL-ADIN2111EBZ evaulation board"
	depends on SOC_STM32L4S5XX
```

## boards/arm/adi_sdp_k1/Kconfig.board
```kconfig
# ADI SDP-K1 board configuration

# Copyright (c) 2024 BayLibre
# SPDX-License-Identifier: Apache-2.0

config BOARD_ADI_SDP_K1
	bool "ADI SDP-K1 Controller Board"
	depends on SOC_STM32F469XX
```

## boards/arm/am62x_m4/Kconfig.board
```kconfig
# Texas Instruments Sitara AM62x-SK-M4 EVM
#
# Copyright (c) 2023 Texas Instruments Incorporated
# Copyright (c) 2023 L Lakshmanan
#
# SPDX-License-Identifier: Apache-2.0

config BOARD_AM62X_M4_SK
	bool "TI AM62x M4 Starter Kit (SK) Evaluation Module (EVM)"
	depends on SOC_SERIES_AM62X_M4

config BOARD_AM62X_M4_PHYBOARD_LYRA
	bool "PHYTEC AM62x M4 phyBOARD-Lyra"
	depends on SOC_SERIES_AM62X_M4
```

## boards/arm/am62x_m4/Kconfig.defconfig
```kconfig
# Texas Instruments Sitara AM62x-SK-M4 EVM
#
# Copyright (c) 2023 Texas Instruments Incorporated
# Copyright (c) 2023 L Lakshmanan
#
# SPDX-License-Identifier: Apache-2.0

if BOARD_AM62X_M4_SK

config BOARD
	default "am62x_m4_sk"

endif # BOARD_AM62X_M4_SK

if BOARD_AM62X_M4_PHYBOARD_LYRA

config BOARD
	default "am62x_m4_phyboard_lyra"

endif # BOARD_AM62X_M4_PHYBOARD_LYRA

if BOARD_AM62X_M4_BEAGLEPLAY

config BOARD
	default "am62x_m4_beagleplay"

endif # BOARD_BEAGLEPLAY_M4
```

## boards/arm/am62x_m4/am62x_m4_phyboard_lyra_defconfig
```kconfig
# PHYTEC AM62x M4 phyBOARD-Lyra
#
# Copyright (C) 2023 PHYTEC Messtechnik GmbH
# Author: Daniel Schultz <d.schultz@phytec.de>
#
# SPDX-License-Identifier: Apache-2.0

# Platform Configuration
CONFIG_SOC_SERIES_AM62X_M4=y
CONFIG_SOC_AM62x_M4=y
CONFIG_BOARD_AM62X_M4_PHYBOARD_LYRA=y
CONFIG_CORTEX_M_SYSTICK=y

# Zephyr Kernel Configuration
CONFIG_XIP=n

# Enable Pinctrl
CONFIG_PINCTRL=y

# Serial Driver
CONFIG_SERIAL=y

# Enable Console
CONFIG_CONSOLE=y
CONFIG_UART_CONSOLE=y
```

## boards/arm/am62x_m4/am62x_m4_sk_defconfig
```kconfig
# Texas Instruments Sitara AM62x-SK-M4 EVM
#
# Copyright (c) 2023 Texas Instruments Incorporated
# Copyright (c) 2023 L Lakshmanan
#
# SPDX-License-Identifier: Apache-2.0

# Platform Configuration
CONFIG_SOC_SERIES_AM62X_M4=y
CONFIG_SOC_AM62x_M4=y
CONFIG_BOARD_AM62X_M4_SK=y
CONFIG_CORTEX_M_SYSTICK=y

# Zephyr Kernel Configuration
CONFIG_XIP=n

# Enable Pinctrl
CONFIG_PINCTRL=y

# Serial Driver
CONFIG_SERIAL=y

# Enable Console
CONFIG_CONSOLE=y
CONFIG_UART_CONSOLE=y
```

## boards/arm/apollo3p_blue_evb/Kconfig.board
```kconfig
# SPDX-License-Identifier: Apache-2.0
#
# Copyright (c) 2024 Semios Inc. <www.semios.com>

config BOARD_APOLLO3P_BLUE_EVB
	bool "Ambiq Apollo3 Blue Plus Evaluation Board"
	depends on SOC_APOLLO3P_BLUE
```

## boards/arm/apollo3p_blue_evb/Kconfig.defconfig
```kconfig
# SPDX-License-Identifier: Apache-2.0
#
# Copyright (c) 2024 Semios Inc. <www.semios.com>

config BOARD
	default "apollo3p_blue_evb"
	depends on BOARD_APOLLO3P_BLUE_EVB
```

## boards/arm/apollo3p_blue_evb/apollo3p_blue_evb_defconfig
```kconfig
# SPDX-License-Identifier: Apache-2.0
#
# Copyright (c) 2024 Semios Inc. <www.semios.com>

CONFIG_SOC_SERIES_APOLLO3X=y
CONFIG_CONSOLE=y
CONFIG_UART_CONSOLE=y
CONFIG_SERIAL=y
CONFIG_UART_INTERRUPT_DRIVEN=y
```

## boards/arm/apollo4p_blue_kxr_evb/Kconfig.board
```kconfig
# SPDX-License-Identifier: Apache-2.0
#
# Copyright (c) 2023 Ambiq Micro Inc. <www.ambiq.com>

config BOARD_APOLLO4P_BLUE_KXR_EVB
	bool "Ambiq Apollo4 Blue Plus KXR Evaluation Board"
	depends on SOC_APOLLO4P_BLUE
```

## boards/arm/apollo4p_blue_kxr_evb/Kconfig.defconfig
```kconfig
# SPDX-License-Identifier: Apache-2.0
#
# Copyright (c) 2023 Ambiq Micro Inc. <www.ambiq.com>

config BOARD
	default "apollo4p_blue_kxr_evb"
	depends on BOARD_APOLLO4P_BLUE_KXR_EVB
```

## boards/arm/arduino_101_ble/Kconfig.board
```kconfig
# Kconfig - Arduino 101 BLE (nRF51822) configuration
#
# Copyright (c) 2016 Intel Corporation
#
# SPDX-License-Identifier: Apache-2.0

config BOARD_ARDUINO_101_BLE
	bool "Arduino 101 BLE"
	depends on SOC_NRF51822_QFAA
```

## boards/arm/arduino_101_ble/Kconfig.defconfig
```kconfig
# Kconfig - Arduino 101 BLE (nRF51822) configuration
#
# Copyright (c) 2016 Intel Corporation
#
# SPDX-License-Identifier: Apache-2.0

if BOARD_ARDUINO_101_BLE

config BOARD
	default arduino_101_ble

if UART_NRF5

config GPIO
	default y

config GPIO_NRF5
	default y

config GPIO_NRF5_P0
	default y

config UART_NRF5_GPIO_TX_PIN
	default 9

config UART_NRF5_GPIO_RX_PIN
	default 11

config UART_NRF5_GPIO_RTS_PIN
	default 12

config UART_NRF5_GPIO_CTS_PIN
	default 10

endif # UART_NRF5

endif # BOARD_ARDUINO_101_BLE
```

## boards/arm/arduino_101_ble/arduino_101_ble_defconfig
```kconfig
CONFIG_ARM=y
CONFIG_SOC_FAMILY_NRF5=y
CONFIG_SOC_SERIES_NRF51X=y
CONFIG_SOC_NRF51822_QFAA=y
CONFIG_BOARD_ARDUINO_101_BLE=y

# enable uart driver
CONFIG_SERIAL=y
CONFIG_UART_NRF5=y

# bluetooth
CONFIG_BT=y
CONFIG_BT_CTLR=y
```

## boards/arm/arduino_due/Kconfig.arduino_due
```kconfig
# Copyright (c) 2022 Zephyr Project members and individual contributors
# SPDX-License-Identifier: Apache-2.0

config BOARD_ARDUINO_DUE
	bool
	default y
	select SOC_SERIES_SAM3X
	select SOC_PART_NUMBER_SAM3X8E
```

## boards/arm/arduino_due/Kconfig.board
```kconfig
# Arduino Due Board configuration

# Copyright (c) 2017 Justin Watson
# SPDX-License-Identifier: Apache-2.0

config BOARD_ARDUINO_DUE
	def_bool "$(BOARD)" = "arduino_due"
	depends on SOC_PART_NUMBER_SAM3X8E
```

## boards/arm/arduino_due/Kconfig.defconfig
```kconfig
# Arduino Due Board configuration

# Copyright (c) 2017 Justin Watson
# SPDX-License-Identifier: Apache-2.0

if BOARD_ARDUINO_DUE

config BOARD
	default "arduino_due"

endif # BOARD_ARDUINO_DUE
```

## boards/arm/arduino_due/arduino_due_defconfig
```kconfig
# SPDX-License-Identifier: Apache-2.0

CONFIG_SOC_SERIES_SAM3X=y
CONFIG_SOC_PART_NUMBER_SAM3X8E=y
CONFIG_BOARD_ARDUINO_DUE=y
CONFIG_ARM_MPU=y
CONFIG_CONSOLE=y
CONFIG_UART_CONSOLE=y
CONFIG_SERIAL=y
CONFIG_SOC_ATMEL_SAM3X_EXT_MAINCK=y
CONFIG_WDT_DISABLE_AT_BOOT=y

# Enable HW stack protection
CONFIG_HW_STACK_PROTECTION=y
```
