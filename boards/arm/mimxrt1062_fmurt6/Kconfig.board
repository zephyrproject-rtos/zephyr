## boards/arm/mimxrt1062_fmurt6/Kconfig.board
```kconfig
# SPDX-License-Identifier: Apache-2.0
# Copyright 2023 NXP

config BOARD_MIMXRT1062_FMURT6
	bool "NXP MIMXRT1062-FMURT6"
	depends on SOC_SERIES_IMX_RT
	select SOC_PART_NUMBER_MIMXRT1062DVL6A
```

## boards/arm/mimxrt1062_fmurt6/Kconfig.defconfig
```kconfig
# MIMXRT1062-FMURT6 board

# SPDX-License-Identifier: Apache-2.0
# Copyright 2023 NXP

if BOARD_MIMXRT1062_FMURT6

config BOARD
	default "mimxrt1062_fmurt6" if BOARD_MIMXRT1062_FMURT6

choice CODE_LOCATION
	default CODE_FLEXSPI
endchoice

if NETWORKING

config NET_L2_ETHERNET
	default y

endif # NETWORKING


endif # BOARD_MIMXRT1062_FMURT6
```

## boards/arm/mimxrt1064_evk/Kconfig
```kconfig
#
# Copyright (c) 2018, NXP
#
# SPDX-License-Identifier: Apache-2.0
#

if BOARD_MIMXRT1064_EVK

choice
	prompt "Code location selection"
	default CODE_ITCM

config CODE_ITCM
	bool "Link code into internal instruction tightly coupled memory (ITCM)"

config CODE_INTERNAL_QSPI
	select NXP_IMX_RT_BOOT_HEADER
	bool "Link code into internal QSPI memory"

endchoice

choice
	prompt "Data location selection"
	default DATA_DTCM

config DATA_DTCM
	bool "Link data into internal data tightly coupled memory (DTCM)"

config DATA_SDRAM
	select DEVICE_CONFIGURATION_DATA if NXP_IMX_RT_BOOT_HEADER
	bool "Link data into external SDRAM memory"

endchoice

endif # BOARD_MIMXRT1064_EVK
```

## boards/arm/mimxrt1064_evk/Kconfig.board
```kconfig
# NXP MIMXRT1064-EVK

# Copyright (c) 2018, NXP
# SPDX-License-Identifier: Apache-2.0

config BOARD_MIMXRT1064_EVK
	def_bool "$(BOARD)" = "mimxrt1064_evk"
	depends on SOC_SERIES_IMX_RT
	select SOC_PART_NUMBER_MIMXRT1064DVL6A
```

## boards/arm/mimxrt1064_evk/Kconfig.defconfig
```kconfig
# MIMXRT1064-EVK board

# Copyright 2018,2023 NXP
# SPDX-License-Identifier: Apache-2.0

if BOARD_MIMXRT1064_EVK

config BOARD
	default "mimxrt1064_evk"

choice CODE_LOCATION
	default CODE_FLEXSPI2
endchoice

config DEVICE_CONFIGURATION_DATA
	default y

config NXP_IMX_EXTERNAL_SDRAM
	default y

config INPUT
	default y if LVGL

if INPUT

config INPUT_FT5336_INTERRUPT
	default y

endif # INPUT

if NETWORKING

config NET_L2_ETHERNET
	default y

config ETH_MCUX_PHY_RESET
	default y

endif # NETWORKING

if LVGL

config LV_Z_VDB_SIZE
	default 16

config LV_DPI_DEF
	default 128

choice LV_COLOR_DEPTH
	default LV_COLOR_DEPTH_16
endchoice

endif # LVGL

endif # BOARD_MIMXRT1064_EVK
```

## boards/arm/mimxrt1064_evk/Kconfig.mimxrt1064_evk
```kconfig
# Copyright (c) 2022 Zephyr Project members and individual contributors
# SPDX-License-Identifier: Apache-2.0

config BOARD_MIMXRT1064_EVK
	bool
	default y
	select SOC_MIMXRT1064
	select SOC_SERIES_IMX_RT
	select SOC_PART_NUMBER_MIMXRT1064DVL6A
```

## boards/arm/mimxrt1064_evk/mimxrt1064_evk_defconfig
```kconfig
#
# Copyright (c) 2018, NXP
#
# SPDX-License-Identifier: Apache-2.0
#

CONFIG_ARM=y
CONFIG_SOC_MIMXRT1064=y
CONFIG_SOC_SERIES_IMX_RT=y
CONFIG_BOARD_MIMXRT1064_EVK=y
CONFIG_CONSOLE=y
CONFIG_UART_CONSOLE=y
CONFIG_SERIAL=y
CONFIG_CORTEX_M_SYSTICK=y
CONFIG_GPIO=y
CONFIG_SYS_CLOCK_HW_CYCLES_PER_SEC=600000000
CONFIG_ARM_MPU=y
```

## boards/arm/mimxrt1160_evk/Kconfig.board
```kconfig
# Copyright (c) 2021, NXP
# SPDX-License-Identifier: Apache-2.0

config BOARD_MIMXRT1160_EVK_CM7
	bool "NXP MIMXRT1160-EVK CM7"
	depends on SOC_MIMXRT1166_CM7
	select SOC_PART_NUMBER_MIMXRT1166DVM6A

config BOARD_MIMXRT1160_EVK_CM4
	bool "NXP MIMXRT1160-EVK CM4"
	depends on SOC_MIMXRT1166_CM4
	select SOC_PART_NUMBER_MIMXRT1166DVM6A
```

## boards/arm/mimxrt1160_evk/Kconfig.defconfig
```kconfig
# MIMXRT1160-EVK board

# Copyright (c) 2021, NXP
# SPDX-License-Identifier: Apache-2.0

if BOARD_MIMXRT1160_EVK_CM7 || BOARD_MIMXRT1160_EVK_CM4

config BOARD
	default "mimxrt1160_evk_cm7" if BOARD_MIMXRT1160_EVK_CM7
	default "mimxrt1160_evk_cm4" if BOARD_MIMXRT1160_EVK_CM4

choice CODE_LOCATION
	default CODE_FLEXSPI if BOARD_MIMXRT1160_EVK_CM7
	default CODE_SRAM0 if BOARD_MIMXRT1160_EVK_CM4
endchoice

config SYS_CLOCK_HW_CYCLES_PER_SEC
	default 240000000 if BOARD_MIMXRT1160_EVK_CM4 && CORTEX_M_SYSTICK
	default 600000000 if BOARD_MIMXRT1160_EVK_CM7 && CORTEX_M_SYSTICK

if FLASH

config FLASH_MCUX_FLEXSPI_NOR
	default y

choice FLASH_MCUX_FLEXSPI_XIP_MEM_TARGET
	default FLASH_MCUX_FLEXSPI_XIP_MEM_ITCM if CPU_CORTEX_M7
	default FLASH_MCUX_FLEXSPI_XIP_MEM_SRAM if CPU_CORTEX_M4
endchoice

endif #FLASH

if NETWORKING

config NET_L2_ETHERNET
	default y if CPU_CORTEX_M7 # No cache memory support is required for driver

config ETH_MCUX_PHY_RESET
	default y

endif # NETWORKING

endif # BOARD_MIMXRT1160_EVK_CM7 || BOARD_MIMXRT1160_EVK_CM4
```

## boards/arm/mimxrt1160_evk/Kconfig.mimxrt1160_evk_cm4
```kconfig
# Copyright (c) 2022 Zephyr Project members and individual contributors
# SPDX-License-Identifier: Apache-2.0

config BOARD_MIMXRT1160_EVK_CM4
	bool
	default y
	select SOC_MIMXRT1166_CM4
	select SOC_SERIES_IMX_RT
	select SOC_PART_NUMBER_MIMXRT1166DVM6A
```

## boards/arm/mimxrt1160_evk/mimxrt1160_evk_cm4_defconfig
```kconfig
#
# Copyright (c) 2021, NXP
#
# SPDX-License-Identifier: Apache-2.0
#

CONFIG_SOC_MIMXRT1166_CM4=y
CONFIG_SOC_SERIES_IMX_RT=y
CONFIG_CONSOLE=y
CONFIG_UART_CONSOLE=y
CONFIG_SERIAL=y
CONFIG_GPIO=y
CONFIG_ARM_MPU=y
CONFIG_HW_STACK_PROTECTION=y
CONFIG_PINCTRL=y
```

## boards/arm/mimxrt1170_evk/Kconfig.board
```kconfig
# Copyright (c) 2021, NXP
# SPDX-License-Identifier: Apache-2.0

config BOARD_MIMXRT1170_EVK_CM7
	bool "NXP MIMXRT1170-EVK CM7"
	depends on SOC_MIMXRT1176_CM7
	select SOC_PART_NUMBER_MIMXRT1176DVMAA

config BOARD_MIMXRT1170_EVK_CM4
	bool "NXP MIMXRT1170-EVK CM4"
	depends on SOC_MIMXRT1176_CM4
	select SOC_PART_NUMBER_MIMXRT1176DVMAA
```

## boards/arm/mimxrt1170_evk/Kconfig.defconfig
```kconfig
# MIMXRT1170-EVK board

# Copyright (c) 2021, NXP
# SPDX-License-Identifier: Apache-2.0

if BOARD_MIMXRT1170_EVK_CM7 || BOARD_MIMXRT1170_EVK_CM4

config BOARD
	default "mimxrt1170_evk_cm7" if BOARD_MIMXRT1170_EVK_CM7
	default "mimxrt1170_evk_cm4" if BOARD_MIMXRT1170_EVK_CM4

choice CODE_LOCATION
	default CODE_FLEXSPI if BOARD_MIMXRT1170_EVK_CM7
	default CODE_OCRAM if BOARD_MIMXRT1170_EVK_CM4 && SECOND_CORE_MCUX
	default CODE_SRAM0 if BOARD_MIMXRT1170_EVK_CM4
endchoice

if SECOND_CORE_MCUX && BOARD_MIMXRT1170_EVK_CM4

config BUILD_OUTPUT_INFO_HEADER
	default y

DT_CHOSEN_IMAGE_M4 = nxp,m4-partition

# Adjust the offset of the output image if building for RT11xx SOC
config BUILD_OUTPUT_ADJUST_LMA
	default "($(dt_chosen_reg_addr_hex,$(DT_CHOSEN_IMAGE_M4)) + \
	$(dt_node_reg_addr_hex,/soc/spi@400cc000,1)) - \
	$(dt_node_reg_addr_hex,/soc/ocram@20200000)"

endif

if DISK_DRIVERS

config IMX_USDHC_DAT3_PWR_TOGGLE
	default y

endif # DISK_DRIVERS

if FLASH

choice FLASH_MCUX_FLEXSPI_XIP_MEM_TARGET
	default FLASH_MCUX_FLEXSPI_XIP_MEM_ITCM if CPU_CORTEX_M7
	default FLASH_MCUX_FLEXSPI_XIP_MEM_SRAM if CPU_CORTEX_M4
endchoice

endif #FLASH

config KSCAN
	default y if LVGL

if KSCAN

config KSCAN_GT911_INTERRUPT
	default y

endif # KSCAN

if NETWORKING

config NET_L2_ETHERNET
	default y if CPU_CORTEX_M7 # No cache memory support is required for driver

config ETH_MCUX_PHY_RESET
	default y

endif # NETWORKING

if DISPLAY

config MIPI_DSI
	default y

config REGULATOR
	default y

endif # DISPLAY

if LVGL

config LV_Z_POINTER_KSCAN
	default y

config LV_Z_VDB_SIZE
	default 16

config LV_Z_DPI
	default 128

choice LV_COLOR_DEPTH
	default LV_COLOR_DEPTH_16
endchoice

endif # LVGL

endif # BOARD_MIMXRT1170_EVK_CM7 || BOARD_MIMXRT1170_EVK_CM4
```

## boards/arm/mimxrt1170_evk/Kconfig.mimxrt1170_evk_cm7
```kconfig
# Copyright (c) 2022 Zephyr Project members and individual contributors
# SPDX-License-Identifier: Apache-2.0

config BOARD_MIMXRT1170_EVK_CM7
	bool
	default y
	select SOC_MIMXRT1176_CM7
	select SOC_SERIES_IMX_RT
	select SOC_PART_NUMBER_MIMXRT1176DVMAA
```

## boards/arm/mimxrt1170_evk/mimxrt1170_evkb_cm7_defconfig
```kconfig
#
# Copyright 2023 NXP
#
# SPDX-License-Identifier: Apache-2.0
#

CONFIG_BOARD_MIMXRT1170_EVKB_CM7=y
CONFIG_SOC_MIMXRT1176_CM7=y
CONFIG_SOC_SERIES_IMX_RT=y
CONFIG_CONSOLE=y
CONFIG_UART_CONSOLE=y
CONFIG_SERIAL=y
CONFIG_GPIO=y
CONFIG_ARM_MPU=y
CONFIG_HW_STACK_PROTECTION=y
CONFIG_FLEXSPI_CONFIG_BLOCK_OFFSET=0x400
CONFIG_PINCTRL=y
```

## boards/arm/mimxrt595_evk/Kconfig.defconfig
```kconfig
# MIMXRT595-EVK board

# Copyright 2022-2023, NXP
# SPDX-License-Identifier: Apache-2.0

if BOARD_MIMXRT595_EVK

config BOARD
	default "mimxrt595_evk_cm33"

config FLASH_MCUX_FLEXSPI_MX25UM51345G
	default y if FLASH

choice FLASH_MCUX_FLEXSPI_XIP_MEM_TARGET
	default FLASH_MCUX_FLEXSPI_XIP_MEM_SRAM
endchoice

config FXOS8700_DRDY_INT1
	default y
	depends on FXOS8700_TRIGGER

if DMA_MCUX_LPC

# Memory from the heap pool is used to allocate DMA descriptors for
# channels that use multiple blocks for a DMA transfer.
# Adjust HEAP_MEM_POOL_SIZE in case you need more memory.
config HEAP_MEM_POOL_SIZE
	default 4096

endif # DMA_MCUX_LPC

# Turn on Device Level Power Management as we wish
# to reconfigure the FlexSPI pins for power savings
# when transitioning the SoC to Deep Low Power modes.
config PM_DEVICE
	default y if PM

config REGULATOR
	default y if PM || POWEROFF

endif # BOARD_MIMXRT595_EVK
```

## boards/arm/mimxrt595_evk/Kconfig.mimxrt595_evk_cm33
```kconfig
# Copyright (c) 2022 Zephyr Project members and individual contributors
# SPDX-License-Identifier: Apache-2.0

config BOARD_MIMXRT595_EVK_CM33
	bool
	default y
	select SOC_MIMXRT595S_CM33
	select SOC_SERIES_IMX_RT5XX
	select CODE_DATA_RELOCATION_SRAM
	select SOC_PART_NUMBER_MIMXRT595SFFOC
	select NXP_IMX_RT5XX_BOOT_HEADER if !BOOTLOADER_MCUBOOT
```

## boards/arm/mimxrt685_evk/Kconfig.defconfig
```kconfig
# MIMXRT685-EVK board

# Copyright (c) 2020, NXP
# SPDX-License-Identifier: Apache-2.0

if BOARD_MIMXRT685_EVK

config BOARD
	default "mimxrt685_evk_cm33"

config XTAL_SYS_CLK_HZ
	default 24000000

config SYSOSC_SETTLING_US
	default 260

choice FLASH_MCUX_FLEXSPI_MX25UM51345G_OPI_MODE
	default FLASH_MCUX_FLEXSPI_MX25UM51345G_OPI_STR
endchoice

choice FLASH_MCUX_FLEXSPI_XIP_MEM_TARGET
	default FLASH_MCUX_FLEXSPI_XIP_MEM_SRAM
endchoice

config FXOS8700_DRDY_INT1
	default y
	depends on FXOS8700_TRIGGER

if DMA_MCUX_LPC

# Memory from the heap pool is used to allocate DMA descriptors for
# channels that use multiple blocks for a DMA transfer.
# Adjust HEAP_MEM_POOL_SIZE in case you need more memory.
config HEAP_MEM_POOL_SIZE
	default 4096

endif # DMA_MCUX_LPC

endif # BOARD_MIMXRT685_EVK
```

## boards/arm/mimxrt685_evk/Kconfig.mimxrt685_evk_cm33
```kconfig
# Copyright (c) 2022 Zephyr Project members and individual contributors
# SPDX-License-Identifier: Apache-2.0

config BOARD_MIMXRT685_EVK_CM33
	bool
	default y
	select SOC_MIMXRT685S_CM33
	select SOC_SERIES_IMX_RT6XX
	select SOC_PART_NUMBER_MIMXRT685SFVKB
	select NXP_IMX_RT6XX_BOOT_HEADER if !BOOTLOADER_MCUBOOT
```

## boards/arm/mimxrt685_evk/mimxrt685_evk_cm33_defconfig
```kconfig
#
# Copyright (c) 2020, NXP
#
# SPDX-License-Identifier: Apache-2.0
#

CONFIG_SOC_MIMXRT685S_CM33=y
CONFIG_SOC_SERIES_IMX_RT6XX=y
CONFIG_BOARD_MIMXRT685_EVK=y
CONFIG_CONSOLE=y
CONFIG_UART_CONSOLE=y
CONFIG_SERIAL=y
CONFIG_PINCTRL=y
CONFIG_UART_INTERRUPT_DRIVEN=y
CONFIG_GPIO=y
# Enable TrustZone-M
CONFIG_TRUSTED_EXECUTION_SECURE=y

CONFIG_ARM_MPU=y
CONFIG_HW_STACK_PROTECTION=y
```

## boards/arm/mm_feather/Kconfig.board
```kconfig
#
# Copyright (c) 2021, MADMACHINE LIMITED
#
# SPDX-License-Identifier: Apache-2.0
#

config BOARD_MM_FEATHER
	bool "MM MM-FEATHER"
	depends on SOC_SERIES_IMX_RT
	select SOC_PART_NUMBER_MIMXRT1062DVL6A
```

## boards/arm/mm_feather/Kconfig.defconfig
```kconfig
# MM-FEATHER board

# Copyright (c) 2021, MADMACHINE LIMITED
# SPDX-License-Identifier: Apache-2.0

if BOARD_MM_FEATHER

config BOARD
	default "mm_feather"

choice CODE_LOCATION
	default CODE_FLEXSPI
endchoice

config DISK_DRIVER_SDMMC
	default y if DISK_DRIVERS

endif # BOARD_MM_FEATHER
```

## boards/arm/mm_swiftio/Kconfig.board
```kconfig
#
# Copyright (c) 2019, MADMACHINE LIMITED
#
# SPDX-License-Identifier: Apache-2.0
#

config BOARD_MM_SWIFTIO
	bool "MM MM-SWIFTIO"
	depends on SOC_SERIES_IMX_RT
	select SOC_PART_NUMBER_MIMXRT1052DVL6A
```

## boards/arm/mm_swiftio/Kconfig.defconfig
```kconfig
# MM-SWIFTIO board

# Copyright (c) 2019, MADMACHINE LIMITED
# SPDX-License-Identifier: Apache-2.0

choice CODE_LOCATION
	default CODE_FLEXSPI
endchoice

config DISK_DRIVER_SDMMC
	default y if DISK_DRIVERS
```

## boards/arm/mm_swiftio/mm_swiftio_defconfig
```kconfig
#
# Copyright (c) 2019, MADMACHINE LIMITED
#
# SPDX-License-Identifier: Apache-2.0
#

CONFIG_SOC_MIMXRT1052=y
CONFIG_SOC_SERIES_IMX_RT=y
CONFIG_CONSOLE=y
CONFIG_UART_CONSOLE=y
CONFIG_SERIAL=y
CONFIG_GPIO=y
CONFIG_SYS_CLOCK_HW_CYCLES_PER_SEC=600000000
CONFIG_ARM_MPU=y
CONFIG_HW_STACK_PROTECTION=y
CONFIG_PINCTRL=y
```
