## boards/arm/zb_bv_l151c8/Kconfig.board
```kconfig
#
# Copyright (c) 2021 ZedBlox
#
# SPDX-License-Identifier: Apache-2.0
#

config BOARD_ZB_BV_L151C8
	bool "ZedBlox ActiPod BV Board"
	depends on SOC_STM32L151XB
```

## boards/arm/zb_bv_l151c8/Kconfig.defconfig
```kconfig
#
# Copyright (c) 2021 ZedBlox
#
# SPDX-License-Identifier: Apache-2.0
#

if BOARD_ZB_BV_L151C8

config BOARD
	default "zb_bv_l151c8"

endif # BOARD_ZB_BV_L151C8
```

## boards/arm/zb_bv_l433rc/Kconfig.board
```kconfig
# STM32L433RC Nucleo board configuration

# Copyright (c) 2021 Matija Tudan
# SPDX-License-Identifier: Apache-2.0

config BOARD_ZB_BV_L433RC
	bool "ZB_BV_L433RC Development Board"
	depends on SOC_STM32L433XX
```

## boards/arm/zb_bv_l433rc/Kconfig.defconfig
```kconfig
# STM32L433RC Nucleo board configuration

# SPDX-License-Identifier: Apache-2.0

if BOARD_ZB_BV_L433RC

config BOARD
	default "zb_bv_l433rc"

config SPI_STM32_INTERRUPT
	default y
	depends on SPI

endif # BOARD_ZB_BV_L433RC_P
```

## boards/arm/zb_tv_h723zi/Kconfig.board
```kconfig
# STM32H743ZI ZB_TV board configuration

# Copyright (c) 
# SPDX-License-Identifier: Apache-2.0

config BOARD_ZB_TV_H743ZI
	bool "ZB_TV H743ZI Development Board"
	depends on SOC_STM32H743XX
```

## boards/arm/zb_tv_h723zi/Kconfig.defconfig
```kconfig
# STM32H743ZI ZB_TV board configuration

# Copyright (c) 
# SPDX-License-Identifier: Apache-2.0

if BOARD_ZB_TV_H743ZI

config BOARD
	default "zb_tv_h743zi"

endif # BOARD_ZB_TV_H743ZI
```

## boards/arm/zb_tv_h743zi/zb_tv_h743zi_defconfig
```kconfig
# SPDX-License-Identifier: Apache-2.0

CONFIG_SOC_SERIES_STM32H7X=y
CONFIG_SOC_STM32H743XX=y

CONFIG_SYS_CLOCK_HW_CYCLES_PER_SEC=80000000
#CONFIG_SYS_CLOCK_HW_CYCLES_PER_SEC=256000000

# Enable MPU
CONFIG_ARM_MPU=y

# Enable HW stack protection
CONFIG_HW_STACK_PROTECTION=y

# Enable UART
CONFIG_SERIAL=y

# Console
CONFIG_CONSOLE=y
CONFIG_UART_CONSOLE=y

# enable pin controller
CONFIG_PINCTRL=y

# Enable GPIO
CONFIG_GPIO=y
CONFIG_SPI=y
CONFIG_I2C=y

CONFIG_UART_STM32=y
CONFIG_SPI_STM32=y
CONFIG_I2C_STM32=y

# Enable clocks
CONFIG_CLOCK_CONTROL=y
```

## boards/arm/zybo/Kconfig.board
```kconfig
# Digilent Zybo board configuration

# Copyright (c) 2022 Henrik Brix Andersen <henrik@brixandersen.dk>
# SPDX-License-Identifier: Apache-2.0

config BOARD_ZYBO
	bool "Digilent Zybo"
	depends on SOC_XILINX_XC7Z010
```

## boards/arm/zybo/Kconfig.defconfig
```kconfig
# Digilent Zybo board

# Copyright (c) 2022 Henrik Brix Andersen <henrik@brixandersen.dk>
# SPDX-License-Identifier: Apache-2.0

if BOARD_ZYBO

config BOARD
	default "zybo"

config UART_XLNX_PS
	default y
	depends on SERIAL

endif # BOARD_ZYBO
```

## boards/arm/zybo/Kconfig.zybo
```kconfig
# Copyright (c) 2022 Zephyr Project members and individual contributors
# SPDX-License-Identifier: Apache-2.0

config BOARD_ZYBO
	bool
	default y
	select SOC_SERIES_XILINX_XC7ZXXX
	select SOC_XILINX_XC7Z010
```

## boards/arm/zybo/zybo_defconfig
```kconfig
# SPDX-License-Identifier: Apache-2.0

CONFIG_SOC_SERIES_XILINX_XC7ZXXX=y
CONFIG_SOC_XILINX_XC7Z010=y
CONFIG_BOARD_ZYBO=y

# The GTC is always clocked at 1/2 of the CPU frequency (CPU_3x2x)
CONFIG_ARM_ARCH_TIMER=y
CONFIG_SYS_CLOCK_HW_CYCLES_PER_SEC=325000000

CONFIG_PINCTRL=y
CONFIG_SERIAL=y
CONFIG_CONSOLE=y
CONFIG_UART_CONSOLE=y
```

## boards/arm64/bcm958402m2_a72/Kconfig.bcm958402m2_a72
```kconfig
# Copyright (c) 2022 Zephyr Project members and individual contributors
# SPDX-License-Identifier: Apache-2.0

config BOARD_BCM958402M2_A72
	bool
	default y
	select SOC_SERIES_VIPER
	select SOC_BCM58402_A72
```

## boards/arm64/bcm958402m2_a72/Kconfig.defconfig
```kconfig
# Copyright 2020 Broadcom
# SPDX-License-Identifier: Apache-2.0

config BOARD
	default "bcm958402m2_a72"
	depends on BOARD_BCM958402M2_A72
```

## boards/arm64/fvp_base_revc_2xaemv8a/Kconfig
```kconfig
# Copyright (c) 2021 BayLibre SAS
# SPDX-License-Identifier: Apache-2.0

# The GICv3 & ITS drivers allocation needs are:
# - LPI prop table: global 1x64K aligned on 64K
# - LPI pend table: for each redistributor/cpu 1x64K aligned on 64K
# - Devices table: 128x4K aligned on 4K
# - Interrupt Collections table: 1x4K aligned on 4K
#
# This makes 11x64K to permit all allocations to success.
#
# Note, will need 64K HEAP_MEM per CPUs added.
#
# This doesn't necessarily include the Interrupt Translation Table, which are
# 256bytes aligned tables, for reference a 32 ITEs table needs 256bytes.
# With 11x64K HEAP, up to 116 ITT tables of 32 ITEs can be allocated.
config HEAP_MEM_POOL_SIZE
	default 720896 if GIC_V3_ITS
```

## boards/arm64/fvp_base_revc_2xaemv8a/Kconfig.board
```kconfig
# Copyright (c) 2021 Carlo Caione <ccaione@baylibre.com>
# SPDX-License-Identifier: Apache-2.0

config BOARD_FVP_BASE_REVC_2XAEMV8A
	bool "FVP Base RevC AEMv8A simulation board"
	depends on SOC_FVP_BASE_REVC_2XAEMV8A
```

## boards/arm64/fvp_base_revc_2xaemv8a/Kconfig.defconfig
```kconfig
# Copyright (c) 2021 Carlo Caione <ccaione@baylibre.com>
# SPDX-License-Identifier: Apache-2.0

if BOARD_FVP_BASE_REVC_2XAEMV8A

config BUILD_OUTPUT_BIN
	default y

config BOARD
	default "fvp_base_revc_2xaemv8a"

endif # BOARD_FVP_BASE_REVC_2XAEMV8A
```

## boards/arm64/fvp_base_revc_2xaemv8a/Kconfig.fvp_base_revc_2xaemv8a_smp_ns
```kconfig
# Copyright (c) 2022 Zephyr Project members and individual contributors
# SPDX-License-Identifier: Apache-2.0

config BOARD_FVP_BASE_REVC_2XAEMV8A_SMP_NS
	bool
	default y
	select SOC_SERIES_FVP_AEMV8A
	select SOC_FVP_BASE_REVC_2XAEMV8A
```

## boards/arm64/fvp_base_revc_2xaemv8a/fvp_base_revc_2xaemv8a_defconfig
```kconfig
# Copyright (c) 2021 Carlo Caione <ccaione@baylibre.com>
# SPDX-License-Identifier: Apache-2.0

CONFIG_SOC_SERIES_FVP_AEMV8A=y
CONFIG_SOC_FVP_BASE_REVC_2XAEMV8A=y
CONFIG_BOARD_FVP_BASE_REVC_2XAEMV8A=y

CONFIG_XIP=n

CONFIG_THREAD_STACK_INFO=y

# Enable Timer and Sys clock
CONFIG_SYS_CLOCK_TICKS_PER_SEC=1000
CONFIG_ARM_ARCH_TIMER=y

# Enable UART driver
CONFIG_SERIAL=y

# Enable serial port
CONFIG_UART_INTERRUPT_DRIVEN=y

# Enable console
CONFIG_CONSOLE=y
CONFIG_UART_CONSOLE=y
```

## boards/arm64/fvp_base_revc_2xaemv8a/fvp_base_revc_2xaemv8a_smp_ns_defconfig
```kconfig
# Copyright (c) 2022 Arm Limited (or its affiliates). All rights reserved.
# SPDX-License-Identifier: Apache-2.0

CONFIG_SOC_SERIES_FVP_AEMV8A=y
CONFIG_SOC_FVP_BASE_REVC_2XAEMV8A=y
CONFIG_BOARD_FVP_BASE_REVC_2XAEMV8A=y

CONFIG_THREAD_STACK_INFO=y

# Enable Timer and Sys clock
CONFIG_SYS_CLOCK_TICKS_PER_SEC=1000
CONFIG_ARM_ARCH_TIMER=y

# Enable UART driver
CONFIG_SERIAL=y

# Enable serial port
CONFIG_UART_INTERRUPT_DRIVEN=y

# Enable console
CONFIG_CONSOLE=y
CONFIG_UART_CONSOLE=y

# Enable TFA
CONFIG_ARMV8_A_NS=y
CONFIG_BUILD_WITH_TFA=y

# Enable SMP
CONFIG_SMP=y
CONFIG_MP_MAX_NUM_CPUS=4
CONFIG_CACHE_MANAGEMENT=y
CONFIG_TIMEOUT_64BIT=y
CONFIG_ARM64_SET_VMPIDR_EL2=y
CONFIG_MAX_THREAD_BYTES=3

# PSCI is supported
CONFIG_PM_CPU_OPS=y
```

## boards/arm64/fvp_baser_aemv8r/Kconfig.board
```kconfig
# Copyright (c) 2021 Arm Limited (or its affiliates). All rights reserved.
# SPDX-License-Identifier: Apache-2.0

config BOARD_FVP_BASER_AEMV8R
	bool "FVP BaseR AEMv8R simulation board"
	depends on SOC_FVP_AEMV8R_AARCH64
```

## boards/arm64/fvp_baser_aemv8r/Kconfig.defconfig
```kconfig
# Copyright (c) 2021 Arm Limited (or its affiliates). All rights reserved.
# SPDX-License-Identifier: Apache-2.0

if BOARD_FVP_BASER_AEMV8R

config BUILD_OUTPUT_BIN
	default y

config BOARD
	default "fvp_baser_aemv8r"

endif # BOARD_FVP_BASER_AEMV8R
```

## boards/arm64/fvp_baser_aemv8r/Kconfig.fvp_baser_aemv8r
```kconfig
# Copyright (c) 2022 Zephyr Project members and individual contributors
# SPDX-License-Identifier: Apache-2.0

config BOARD_FVP_BASER_AEMV8R
	bool
	default y
	select SOC_SERIES_FVP_AEMV8R
	select SOC_FVP_AEMV8R_AARCH64
```

## boards/arm64/fvp_baser_aemv8r/fvp_baser_aemv8r_defconfig
```kconfig
# Copyright (c) 2021 Arm Limited (or its affiliates). All rights reserved.
# SPDX-License-Identifier: Apache-2.0

# Cache management
CONFIG_CACHE_MANAGEMENT=y

CONFIG_THREAD_STACK_INFO=y

# Enable Timer and Sys clock
CONFIG_SYS_CLOCK_TICKS_PER_SEC=100
CONFIG_ARM_ARCH_TIMER=y

# Enable UART driver
CONFIG_SERIAL=y

# Enable serial port
CONFIG_UART_INTERRUPT_DRIVEN=y

# Enable console
CONFIG_CONSOLE=y
CONFIG_UART_CONSOLE=y
```

## boards/arm64/fvp_baser_aemv8r/fvp_baser_aemv8r_smp_defconfig
```kconfig
# Copyright (c) 2021 Arm Limited (or its affiliates). All rights reserved.
# SPDX-License-Identifier: Apache-2.0

CONFIG_SOC_SERIES_FVP_AEMV8R=y
CONFIG_SOC_FVP_AEMV8R_AARCH64=y
CONFIG_BOARD_FVP_BASER_AEMV8R=y

# Cache management
CONFIG_CACHE_MANAGEMENT=y

CONFIG_THREAD_STACK_INFO=y

# Enable Timer and Sys clock
CONFIG_SYS_CLOCK_TICKS_PER_SEC=100
CONFIG_ARM_ARCH_TIMER=y

# Enable UART driver
CONFIG_SERIAL=y

# Enable serial port
CONFIG_UART_PL011=y
CONFIG_UART_INTERRUPT_DRIVEN=y

# Enable console
CONFIG_CONSOLE=y
CONFIG_UART_CONSOLE=y

# Enable simulate cpu power management
CONFIG_SOC_FVP_AEMV8R_SIMULATE_CPU_PM=y
CONFIG_PM_CPU_OPS=y
CONFIG_PM_CPU_OPS_PSCI=n
CONFIG_SOC_FVP_AEMV8R_EL2_INIT=y

CONFIG_SMP=y
CONFIG_MP_NUM_CPUS=4

CONFIG_MAX_THREAD_BYTES=3
```

## boards/arm64/imx8mm_evk/Kconfig.board
```kconfig
# Copyright 2021 NXP
# SPDX-License-Identifier: Apache-2.0

config BOARD_IMX8MM_EVK_A53
	bool "NXP i.MX8M Mini EVK A53"
	depends on SOC_SERIES_IMX8M_A53
	select SOC_PART_NUMBER_MIMX8MM6DVTLZ
	select ARM64
```
