/*
 * Copyright (c) 2020 Nordic Semiconductor ASA
 *
 * SPDX-License-Identifier: Apache-2.0
 */

/ {
	zephyr,fixture {
		gpio-loopback {
			compatible = "zephyr,fixture,gpio-loopback";
			out-gpios = <&arduino_header 11 0>; /* Arduino D5 */
			in-gpios = <&arduino_header 12 0>;  /* Arduino D6 */
		};
	};
};
