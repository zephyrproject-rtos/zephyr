## boards/arm/nrf51dk_nrf51422/Kconfig.nrf51dk_nrf51422
```kconfig
# Copyright (c) 2022 Zephyr Project members and individual contributors
# SPDX-License-Identifier: Apache-2.0

config BOARD_NRF51DK_NRF51422
	bool
	default y
	select SOC_SERIES_NRF51X
	select SOC_NRF51822_QFAC
```

## boards/arm/nrf51dk_nrf51422/nrf51dk_nrf51422_defconfig
```kconfig
# SPDX-License-Identifier: Apache-2.0

CONFIG_SOC_SERIES_NRF51X=y
CONFIG_SOC_NRF51822_QFAC=y
CONFIG_BOARD_NRF51DK_NRF51422=y

# enable GPIO
CONFIG_GPIO=y

# enable uart driver
CONFIG_SERIAL=y

# enable console
CONFIG_CONSOLE=y
CONFIG_UART_CONSOLE=y
```

## boards/arm/nrf51dongle_nrf51422/Kconfig.board
```kconfig
# nRF51 Dongle NRF51422 board configuration

# Copyright (c) 2018 Nordic Semiconductor ASA.
# SPDX-License-Identifier: Apache-2.0

config BOARD_NRF51DONGLE_NRF51422
	bool "nRF51 Dongle NRF51422"
	depends on SOC_NRF51822_QFAC
```

## boards/arm/nrf51dongle_nrf51422/Kconfig.defconfig
```kconfig
# nRF51 Dongle NRF51422 board configuration

# Copyright (c) 2018-2020 Nordic Semiconductor ASA.
# SPDX-License-Identifier: Apache-2.0

config BT_CTLR
	default BT
```

## boards/arm/nrf52810_pca10040/Kconfig
```kconfig
# Kconfig - nRF52810 PCA10040 board configuration
#
# Copyright (c) 2018 Nordic Semiconductor ASA
#
# SPDX-License-Identifier: Apache-2.0

if BOARD_NRF52810_PCA10040

# BT_CTLR depends on BT. When BT is enabled we should default to also
# enabling the controller.
config BT_CTLR
	default y if BT

endif # BOARD_NRF52810_PCA10040
```

## boards/arm/nrf52810_pca10040/Kconfig.board
```kconfig
# nRF52810 PCA10040 board configuration

# Copyright (c) 2018 Nordic Semiconductor ASA
# SPDX-License-Identifier: Apache-2.0

config BOARD_NRF52810_PCA10040
	def_bool "$(BOARD)" = "nrf52810_pca10040"
	depends on SOC_NRF52810_QFAA
```

## boards/arm/nrf52810_pca10040/Kconfig.defconfig
```kconfig
# Kconfig - nRF52810 PCA10040 board configuration
#
# Copyright (c) 2018 Nordic Semiconductor ASA
#
# SPDX-License-Identifier: Apache-2.0

if BOARD_NRF52810_PCA10040

config BOARD
	default "nrf52810_pca10040"

if ADC

config ADC_0
	default y

endif # ADC

if I2C

config I2C_0
	default y

endif # I2C

if SPI

config SPI_0
	default y

endif # SPI

endif # BOARD_NRF52810_PCA10040
```

## boards/arm/nrf52810_pca10040/nrf52810_pca10040_defconfig
```kconfig
# SPDX-License-Identifier: Apache-2.0

CONFIG_ARM=y
CONFIG_SOC_FAMILY_NRF=y
CONFIG_SOC_SERIES_NRF52X=y
CONFIG_SOC_NRF52810_QFAA=y
CONFIG_BOARD_NRF52810_PCA10040=y

# Enable MPU
CONFIG_ARM_MPU=y

# enable GPIO
CONFIG_GPIO=y

# Enable UARTE
CONFIG_SERIAL=y
CONFIG_UART_0_NRF_UARTE=y

# enable console
CONFIG_CONSOLE=y
CONFIG_UART_CONSOLE=y

# additional board options
CONFIG_GPIO_AS_PINRESET=y

# Bluetooth not enabled by default on nRF52810 due to RAM limitations when
# running the default set of kernel tests.
# Enable this on your prj.conf to include Bluetooth support
```

## boards/arm/nrf52811_pca10056/Kconfig
```kconfig
# Kconfig - nRF52811 PCA10056 board configuration
#
# Copyright (c) 2019 Nordic Semiconductor ASA
#
# SPDX-License-Identifier: Apache-2.0

if BOARD_NRF52811_PCA10056

config BOARD_ENABLE_DCDC
        bool "Enable DCDC mode"
        select SOC_DCDC_NRF52X
        default y

endif # BOARD_NRF52811_PCA10056
```

## boards/arm/nrf52811_pca10056/Kconfig.board
```kconfig
# Kconfig - nRF52811 PCA10056 board configuration
#
# Copyright (c) 2019 Nordic Semiconductor ASA
#
# SPDX-License-Identifier: Apache-2.0

config  BOARD_NRF52811_PCA10056
	bool "nRF52811 PCA10056"
	depends on SOC_NRF52811_QFAA
```

## boards/arm/nrf52811_pca10056/Kconfig.defconfig
```kconfig
# nRF52811 PCA10056 board configuration

# Copyright (c) 2019 Nordic Semiconductor ASA
# SPDX-License-Identifier: Apache-2.0

if BOARD_NRF52811_PCA10056

config BOARD
	default "nrf52811_pca10056"

config BT_CTLR
	default BT

config ADC_0
	default y
	depends on ADC

config I2C_0
	default y
	depends on I2C

config SPI_0
	default y
	depends on SPI

config PWM_0
	default y
	depends on PWM

config IEEE802154_NRF5
	default y
	depends on IEEE802154

endif # BOARD_NRF52811_PCA10056
```

## boards/arm/nrf52811_pca10056/nrf52811_pca10056_defconfig
```kconfig
# Copyright (c) 2016 Nordic Semiconductor ASA

# SPDX-License-Identifier: Apache-2.0

CONFIG_ARM=y
CONFIG_SOC_FAMILY_NRF=y
CONFIG_SOC_SERIES_NRF52X=y
CONFIG_SOC_NRF52811_QFAA=y
CONFIG_BOARD_NRF52811_PCA10056=y

# Enable MPU
CONFIG_ARM_MPU=y

# Enable UART
CONFIG_SERIAL=y
CONFIG_UART_0_NRF_UART=y

# enable console
CONFIG_CONSOLE=y
CONFIG_UART_CONSOLE=y

# enable GPIO
CONFIG_GPIO=y

# additional board options
CONFIG_GPIO_AS_PINRESET=y

# Bluetooth not enabled by default on nRF52811 due to RAM limitations when
# running the default set of kernel tests.
# Enable this on your prj.conf to include Bluetooth support
```

## boards/arm/nrf52832_mdk/Kconfig.defconfig
```kconfig
# nRF52832-MDK board configuration

# Copyright (c) 2018 makerdiary.com.
# SPDX-License-Identifier: Apache-2.0

config BT_CTLR
	default BT
```

## boards/arm/nrf52832_pinetime/Kconfig.board
```kconfig
# Kconfig - nRF52832 PineTime board configuration
#
# Copyright (c) 2016 Linaro Limited.
#
# SPDX-License-Identifier: Apache-2.0


config BOARD_NRF52832_PINETIME
	bool "nRF52832 PINETIME"
	depends on SOC_NRF52832_QFAA
```

## boards/arm/nrf52832_pinetime/Kconfig.defconfig
```kconfig
# Kconfig - nRF52832 PineTime board configuration
#
# Copyright (c) 2016 Nordic Semiconductor ASA
#
# SPDX-License-Identifier: Apache-2.0

if BOARD_NRF52832_PINETIME

config BOARD
	default "nrf52832_pinetime"

if I2C

config I2C_0
	default y

if I2C_0

choice I2C_0_NRF_TYPE
	default I2C_0_NRF_TWIM

endchoice

endif # I2C_0

endif # I2C

config BT_CTLR
	default BT

endif # BOARD_NRF52832_PINETIME
```

## boards/arm/nrf52833_pca10100/Kconfig
```kconfig
# nRF52833 PCA10100 board configuration

# Copyright (c) 2019 Nordic Semiconductor ASA
# SPDX-License-Identifier: Apache-2.0

if BOARD_NRF52833_PCA10100

config BOARD_ENABLE_DCDC
	bool "Enable DCDC mode"
	select SOC_DCDC_NRF52X
	default y

endif # BOARD_NRF52833_PCA10100
```

## boards/arm/nrf52833_pca10100/Kconfig.board
```kconfig
# nRF52833 PCA10100 board configuration

# Copyright (c) 2019 Nordic Semiconductor ASA
# SPDX-License-Identifier: Apache-2.0

config BOARD_NRF52833_PCA10100
	bool "NRF52833 PCA10100"
	depends on SOC_NRF52833_QIAA
```

## boards/arm/nrf52833_pca10100/Kconfig.defconfig
```kconfig
# nRF52833 PCA10100 board configuration

# Copyright (c) 2019 Nordic Semiconductor ASA
# SPDX-License-Identifier: Apache-2.0

if BOARD_NRF52833_PCA10100

config BOARD
	default "nrf52833_pca10100"

config ADC_0
	default y
	depends on ADC

config PWM_0
	default y
	depends on PWM

if USB

config USB_NRFX
	default y

config USB_DEVICE_STACK
	default y

endif # USB

config IEEE802154_NRF5
	default y
	depends on IEEE802154

config BT_CTLR
	default BT

endif # BOARD_NRF52833_PCA10100
```

## boards/arm/nrf52833dk_nrf52820/Kconfig
```kconfig
# nRF52833DK nRF52820 board configuration

# Copyright (c) 2020 Nordic Semiconductor ASA
# SPDX-License-Identifier: Apache-2.0

config BOARD_ENABLE_DCDC
	bool "Enable DCDC mode"
	select SOC_DCDC_NRF52X
	default y
	depends on BOARD_NRF52833DK_NRF52820
```

## boards/arm/nrf52833dk_nrf52820/Kconfig.defconfig
```kconfig
# nRF52833DK nRF52820 board configuration

# Copyright (c) 2020 Nordic Semiconductor ASA
# SPDX-License-Identifier: Apache-2.0

if BOARD_NRF52833DK_NRF52820

config BOARD
	default "nrf52833dk_nrf52820"

config BT_CTLR
	default BT

endif # BOARD_NRF52833DK_NRF52820
```

## boards/arm/nrf52833dk_nrf52820/nrf52833dk_nrf52820_defconfig
```kconfig
# SPDX-License-Identifier: Apache-2.0

CONFIG_SOC_SERIES_NRF52X=y
CONFIG_SOC_NRF52820_QDAA=y
CONFIG_BOARD_NRF52833DK_NRF52820=y

# Enable MPU
CONFIG_ARM_MPU=y

# Enable hardware stack protection
CONFIG_HW_STACK_PROTECTION=y

# Enable RTT
CONFIG_USE_SEGGER_RTT=y

# enable GPIO
CONFIG_GPIO=y

# enable uart driver
CONFIG_SERIAL=y

# enable console
CONFIG_CONSOLE=y
CONFIG_UART_CONSOLE=y
```

## boards/arm/nrf52833dk_nrf52833/Kconfig
```kconfig
# nRF52833 DK NRF52833 board configuration

# Copyright (c) 2019 Nordic Semiconductor ASA
# SPDX-License-Identifier: Apache-2.0

config BOARD_ENABLE_DCDC
	bool "DCDC mode"
	select SOC_DCDC_NRF52X
	default y
	depends on BOARD_NRF52833DK_NRF52833
```

## boards/arm/nrf52833dk_nrf52833/Kconfig.board
```kconfig
# nRF52833 DK NRF52833 board configuration

# Copyright (c) 2019 Nordic Semiconductor ASA
# SPDX-License-Identifier: Apache-2.0

config BOARD_NRF52833DK_NRF52833
	bool "NRF52833 DK NRF52833"
	depends on SOC_NRF52833_QIAA
```

## boards/arm/nrf52833dk_nrf52833/Kconfig.defconfig
```kconfig
# nRF52833 DK NRF52833 board configuration

# Copyright (c) 2019 Nordic Semiconductor ASA
# SPDX-License-Identifier: Apache-2.0

config BT_CTLR
	default BT
```

## boards/arm/nrf52833dk_nrf52833_mdbt/Kconfig.board
```kconfig
# Copyright (c) 2022 Nordic Semiconductor ASA
# SPDX-License-Identifier: Apache-2.0

config BOARD_NRF52833DK_NRF52833_MDBT
	bool "NRF52833DK_NRF52833_MDBT"
	depends on SOC_NRF52833_QIAA
```
