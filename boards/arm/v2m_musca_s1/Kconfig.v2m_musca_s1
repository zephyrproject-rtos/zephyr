## boards/arm/v2m_musca_s1/Kconfig.v2m_musca_s1
```kconfig
# Copyright (c) 2019-2020 Linaro Limited
# SPDX-License-Identifier: Apache-2.0

config BOARD_V2M_MUSCA_S1
	select SOC_V2M_MUSCA_S1
```

## boards/arm/v2m_musca_s1/board.yml
```yaml
board:
  name: v2m_musca_s1
  full_name: V2M Musca-S1
  vendor: arm
  socs:
  - name: musca_s1
    variants:
    - name: 'ns'
```

## boards/arm/v2m_musca_s1/v2m_musca_s1_musca_s1_ns_defconfig
```kconfig
#
# Copyright (c) 2019-2020 Linaro Limited
#
# SPDX-License-Identifier: Apache-2.0
#

CONFIG_RUNTIME_NMI=y
CONFIG_ARM_TRUSTZONE_M=y
CONFIG_ARM_MPU=y

# Serial
CONFIG_CONSOLE=y
CONFIG_UART_CONSOLE=y
CONFIG_SERIAL=y

CONFIG_TRUSTED_EXECUTION_NONSECURE=y
```

## boards/arm/v2m_musca_s1/v2m_musca_s1_ns_defconfig
```kconfig
#
# Copyright (c) 2019-2020 Linaro Limited
#
# SPDX-License-Identifier: Apache-2.0
#

CONFIG_SOC_SERIES_MUSCA_S1=y
CONFIG_SOC_V2M_MUSCA_S1=y
CONFIG_ARM_TRUSTZONE_M=y
CONFIG_CORTEX_M_SYSTICK=y
CONFIG_RUNTIME_NMI=y
CONFIG_TRUSTED_EXECUTION_NONSECURE=y
CONFIG_ARM_MPU=y

# PinMuxing
CONFIG_PINMUX=y

# Serial
CONFIG_CONSOLE=y
CONFIG_UART_CONSOLE=y
CONFIG_SERIAL=y
```

## boards/arm/verdin_imx8mm_m4/Kconfig.board
```kconfig
# VERDIN_IMX8MM_M4 board

# Copyright (c) 2023, Toradex
# SPDX-License-Identifier: Apache-2.0

config BOARD_VERDIN_IMX8MM_M4
	bool "Toradex Verdin i.MX8M Mini M4"
	depends on SOC_SERIES_IMX8MM_M4
	select SOC_PART_NUMBER_MIMX8MM6DVTLZ
```

## boards/arm/verdin_imx8mm_m4/Kconfig.defconfig
```kconfig
# VERDIN_IMX8MM_M4 board defconfig

# Copyright (c) 2023, Toradex
# SPDX-License-Identifier: Apache-2.0

if BOARD_VERDIN_IMX8MM_M4

config BOARD
	default "verdin_imx8mm_m4"

endif # VERDIN_IMX8MM_M4
```

## boards/arm/verdin_imx8mm_m4/verdin_imx8mm_m4_defconfig
```kconfig
#
# Copyright (c) 2023, Toradex
#
# SPDX-License-Identifier: Apache-2.0
#

CONFIG_SOC_SERIES_IMX8MM_M4=y
CONFIG_SOC_MIMX8MM6=y
CONFIG_BOARD_VERDIN_IMX8MM_M4=y
CONFIG_CLOCK_CONTROL=y
CONFIG_UART_CONSOLE=y
CONFIG_SERIAL=y
CONFIG_CONSOLE=y
CONFIG_XIP=y
CONFIG_PINCTRL=y
```

## boards/arm/vmu_rt1170/Kconfig.board
```kconfig
# Copyright 2023 NXP
# SPDX-License-Identifier: Apache-2.0

config BOARD_VMU_RT1170
	bool "NXP VMU_RT1170"
	depends on SOC_MIMXRT1176_CM7
	select SOC_PART_NUMBER_MIMXRT1176DVMAA
```

## boards/arm/vmu_rt1170/Kconfig.defconfig
```kconfig
# VMU_RT1170 board

# Copyright 2023 NXP
# SPDX-License-Identifier: Apache-2.0

if BOARD_VMU_RT1170

config BOARD
	default "vmu_rt1170" if BOARD_VMU_RT1170

choice CODE_LOCATION
	default CODE_FLEXSPI if BOARD_VMU_RT1170
endchoice

if DISK_DRIVERS

config IMX_USDHC_DAT3_PWR_TOGGLE
	default y

endif # DISK_DRIVERS

if FLASH

choice FLASH_MCUX_FLEXSPI_XIP_MEM_TARGET
	default FLASH_MCUX_FLEXSPI_XIP_MEM_ITCM if CPU_CORTEX_M7
	default FLASH_MCUX_FLEXSPI_XIP_MEM_SRAM if CPU_CORTEX_M4
endchoice

endif #FLASH

if NETWORKING

config NET_L2_ETHERNET
	default y if CPU_CORTEX_M7 # No cache memory support is required for driver

config ETH_MCUX_PHY_RESET
	default n

config ETH_MCUX_RMII_EXT_CLK
	default y

endif # NETWORKING


endif # BOARD_VMU_RT1170
```

## boards/arm/vmu_rt1170/vmu_rt1170_defconfig
```kconfig
#
# Copyright (c) 2021, NXP
#
# SPDX-License-Identifier: Apache-2.0
#

CONFIG_SOC_MIMXRT1176_CM7=y
CONFIG_SOC_SERIES_IMX_RT=y
CONFIG_CONSOLE=y
CONFIG_SHELL=y
CONFIG_UART_CONSOLE=y
CONFIG_SERIAL=y
CONFIG_GPIO=y
CONFIG_ARM_MPU=y
CONFIG_HW_STACK_PROTECTION=y
CONFIG_FLEXSPI_CONFIG_BLOCK_OFFSET=0x400
CONFIG_PINCTRL=y

# Enable Regulators
CONFIG_REGULATOR=y
CONFIG_REGULATOR_FIXED_INIT_PRIORITY=75

CONFIG_TICKLESS_KERNEL=n
```

## boards/arm/volteer/Kconfig.board
```kconfig
# Copyright (c) 2020 Intel Corporation
# SPDX-License-Identifier: Apache-2.0

config BOARD_VOLTEER
	bool "Volteer Google Chrome Reference Design"
	depends on SOC_NPCX7M6FB
```

## boards/arm/volteer/Kconfig.defconfig
```kconfig
# Copyright (c) 2020 Intel Corporation.
# SPDX-License-Identifier: Apache-2.0

config BOARD
	default "volteer"

config SYS_CLOCK_TICKS_PER_SEC
	default 1000
```

## boards/arm/w5500_evb_pico/Kconfig.board
```kconfig
# Copyright (c) 2021 Yonatan Schachter
# Copyright (c) 2023 Ian Wakely
# SPDX-License-Identifier: Apache-2.0

config BOARD_W5500_EVB_PICO
	bool "Wiznet W5500 Evaluation Board"
	depends on SOC_RP2040
```

## boards/arm/warp7_m4/Kconfig.defconfig
```kconfig
# WaRP7 iMX7S M4 board

# Copyright (c) 2018, Diego Sueiro
# SPDX-License-Identifier: Apache-2.0

if BOARD_WARP7_M4

config BOARD
	default "warp7_m4"

config FXOS8700_DRDY_INT1
	default y
	depends on FXOS8700_TRIGGER

config FXAS21002_DRDY_INT1
	default y
	depends on FXAS21002_TRIGGER

if !XIP
config FLASH_SIZE
	default 0
config FLASH_BASE_ADDRESS
	default 0
endif

endif # BOARD_WARP7_M4
```

## boards/arm/warp7_m4/warp7_m4_defconfig
```kconfig
#
# Copyright (c) 2018, Diego Sueiro
#
# SPDX-License-Identifier: Apache-2.0
#

CONFIG_SOC_SERIES_IMX7_M4=y
CONFIG_SOC_MCIMX7_M4=y
CONFIG_BOARD_WARP7_M4=y
CONFIG_CORTEX_M_SYSTICK=y
CONFIG_UART_CONSOLE=y
CONFIG_SERIAL=y
CONFIG_UART_INTERRUPT_DRIVEN=y
CONFIG_CONSOLE=y
CONFIG_XIP=y
CONFIG_PINCTRL=y
```

## boards/arm/waveshare_open103z/Kconfig.board
```kconfig
# Waveshare Open103Z board configuration

# Copyright (c) 2020 Stefano Manni
# SPDX-License-Identifier: Apache-2.0

config BOARD_WAVESHARE_OPEN103Z
	bool "Waveshare OPEN103Z Development Board"
	depends on SOC_STM32F103XE
```

## boards/arm/waveshare_open103z/Kconfig.defconfig
```kconfig
# Waveshare Open103Z board configuration

# Copyright (c) 2020 Stefano Manni
# SPDX-License-Identifier: Apache-2.0

if BOARD_WAVESHARE_OPEN103Z

config BOARD
	default "waveshare_open103z"

endif # BOARD_WAVESHARE_OPEN103Z
```

## boards/arm/waveshare_open103z/Kconfig.waveshare_open103z
```kconfig
# Copyright (c) 2022 Zephyr Project members and individual contributors
# SPDX-License-Identifier: Apache-2.0

config BOARD_WAVESHARE_OPEN103Z
	bool
	default y
	select SOC_SERIES_STM32F1X
	select SOC_STM32F103XE
```

## boards/arm/we_ophelia1ev_nrf52805/Kconfig
```kconfig
# Ophelia-I EV nRF52805 board configuration

# Copyright (c) 2020 Nordic Semiconductor ASA
# SPDX-License-Identifier: Apache-2.0

config BOARD_ENABLE_DCDC
	bool "DCDC mode"
	select SOC_DCDC_NRF52X
	default y
	depends on BOARD_WE_OPHELIA1EV_NRF52805
```

## boards/arm/we_ophelia1ev_nrf52805/Kconfig.board
```kconfig
# Copyright (c) 2022 Nordic Semiconductor ASA
# SPDX-License-Identifier: Apache-2.0

config BOARD_WE_OPHELIA1EV_NRF52805
	bool "we_ophelia1ev_nrf52805"
	depends on SOC_NRF52805_CAAA
```

## boards/arm/we_ophelia1ev_nrf52805/Kconfig.defconfig
```kconfig
# Copyright (c) 2022 Nordic Semiconductor ASA
# SPDX-License-Identifier: Apache-2.0

if BOARD_WE_OPHELIA1EV_NRF52805

config BOARD
	default "we_ophelia1ev_nrf52805"

config BT_CTLR
	default BT

endif
```

## boards/arm/we_proteus2ev_nrf52832/Kconfig
```kconfig
# Proteus-II-EV board configuration

# Copyright (c) 2016 Nordic Semiconductor ASA
# SPDX-License-Identifier: Apache-2.0

if BOARD_WE_PROTEUS2EV_NRF52832

config BOARD_ENABLE_DCDC
	bool "DCDC mode"
	select SOC_DCDC_NRF52X
	default y
	depends on BOARD_WE_PROTEUS2EV_NRF52832

endif # BOARD_WE_PROTEUS2EV_NRF52832
```

## boards/arm/we_proteus2ev_nrf52832/Kconfig.board
```kconfig
# Copyright (c) 2022 Nordic Semiconductor ASA
# SPDX-License-Identifier: Apache-2.0

config BOARD_WE_PROTEUS2EV_NRF52832
	bool "we_proteus2ev_nrf52832"
	depends on SOC_NRF52832_CIAA
```

## boards/arm/we_proteus3ev_nrf52840/Kconfig.board
```kconfig
# Copyright (c) 2022 Nordic Semiconductor ASA
# SPDX-License-Identifier: Apache-2.0

config BOARD_WE_PROTEUS3EV_NRF52840
	bool "we_proteus3ev_nrf52840"
	depends on SOC_NRF52840_QIAA
```

## boards/arm/we_proteus3ev_nrf52840/Kconfig.defconfig
```kconfig
# Copyright (c) 2022 Nordic Semiconductor ASA
# SPDX-License-Identifier: Apache-2.0

if BOARD_WE_PROTEUS3EV_NRF52840

config BOARD
	default "we_proteus3ev_nrf52840"

config BT_CTLR
	default BT

endif
```
