/*
 * Copyright (c) 2019 Gerson Fernando Budke
 * Copyright (c) 2017 Piotr Mienkowski
 * Copyright (c) 2017 Justin Watson
 *
 * SPDX-License-Identifier: Apache-2.0
 */

/dts-v1/;

#include <atmel/samv71q21.dtsi>

#include "sam_v71_xult-common.dtsi"
