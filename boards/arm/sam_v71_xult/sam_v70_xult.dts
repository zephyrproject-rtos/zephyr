/*
 * Copyright (c) 2017 Piotr Mienkowski
 * Copyright (c) 2017 Justin Watson
 * Copyright (c) 2019-2020 Gerson Fernando Budke <nandojve@gmail.com>
 *
 * SPDX-License-Identifier: Apache-2.0
 */

/dts-v1/;

#include <atmel/samv70x20.dtsi>
#include <dt-bindings/pinctrl/samv70q-pinctrl.h>
#include "sam_v7x_xult-pinctrl-common.dtsi"
#include "sam_v7x_xult-common.dtsi"

/ {
	model = "Atmel SAM V70 Xplained Ultra board";
	compatible = "atmel,sam_v70_xult", "atmel,samv70x19", "atmel,samv70";
};
