## boards/arm/fvp_corstone1000/fvp_corstone1000_a320_smp_defconfig
```kconfig
# Copyright (c) 2026 BayLibre SAS
# SPDX-License-Identifier: Apache-2.0

CONFIG_XIP=n

# Enable Timer and Sys clock
CONFIG_SYS_CLOCK_TICKS_PER_SEC=1000
CONFIG_ARM_ARCH_TIMER=y

# Enable UART driver
CONFIG_SERIAL=y

# Enable serial port
CONFIG_UART_INTERRUPT_DRIVEN=y

# Enable console
CONFIG_CONSOLE=y
CONFIG_UART_CONSOLE=y

# Run in Non-Secure mode (EL1NS) - TF-A handles secure boot
CONFIG_ARMV8_A_NS=y

# PSCI support for CPU power management
CONFIG_PM_CPU_OPS=y

# 64-bit timeout for long-running operations
CONFIG_TIMEOUT_64BIT=y

# Cache management
CONFIG_CACHE_MANAGEMENT=y

# SMP support - 4 Cortex-A320 cores
CONFIG_SMP=y
CONFIG_MP_MAX_NUM_CPUS=4
CONFIG_MAX_THREAD_BYTES=3

# TF-A warm boot does not set VMPIDR_EL2 for secondary CPUs.
# Without this, EL1 reads of MPIDR_EL1 return 0 on secondary cores.
CONFIG_ARM64_SET_VMPIDR_EL2=y
```

## boards/arm/gardena_rm_sim3u/Kconfig.board
```kconfig
# Copyright (c) 2023 GARDENA GmbH
#
# SPDX-License-Identifier: Apache-2.0

config BOARD_GARDENA_RM_SIM3U
	bool "GARDENA SIM3U radio module"
	depends on SOC_SERIES_SIM3U
	select SOC_PART_NUMBER_SIM3U167_B_GM
```

## boards/arm/gardena_rm_sim3u/Kconfig.defconfig
```kconfig
# Copyright (c) 2023 GARDENA GmbH
#
# SPDX-License-Identifier: Apache-2.0

if BOARD_GARDENA_RM_SIM3U

config BOARD
	default "gardena_rm_sim3u"

endif # BOARD_GARDENA_RM_SIM3U
```

## boards/arm/gardena_rm_sim3u/gardena_rm_sim3u_defconfig
```kconfig
CONFIG_SOC_SERIES_SIM3U=y

# enable uart driver
CONFIG_SERIAL=y

# enable console
CONFIG_CONSOLE=y
CONFIG_UART_CONSOLE=y

# enable GPIO
CONFIG_GPIO=y

CONFIG_SPI=y
```

## boards/arm/gd32a503v_eval/Kconfig.board
```kconfig
# Copyright (c) 2022 YuLong Yao <feilongphone@gmail.com>
# SPDX-License-Identifier: Apache-2.0

config BOARD_GD32A503V_EVAL
	bool "GigaDevice GD32A503V-EVAL"
	depends on SOC_GD32A503
```

## boards/arm/gd32a503v_eval/Kconfig.defconfig
```kconfig
# Copyright (c) 2022 YuLong Yao <feilongphone@gmail.com>
# SPDX-License-Identifier: Apache-2.0

if BOARD_GD32A503V_EVAL

config BOARD
	default "gd32a503v_eval"

endif # BOARD_GD32A503V_EVAL
```

## boards/arm/gd32a503v_eval/gd32a503v_eval_defconfig
```kconfig
# Copyright (c) 2022 YuLong Yao <feilongphone@gmail.com>
# SPDX-License-Identifier: Apache-2.0

CONFIG_SOC_SERIES_GD32A50X=y
CONFIG_SOC_GD32A503=y
CONFIG_BOARD_GD32A503V_EVAL=y

CONFIG_ARM_MPU=y
CONFIG_HW_STACK_PROTECTION=y

CONFIG_CONSOLE=y
CONFIG_UART_CONSOLE=y
CONFIG_SERIAL=y

CONFIG_GPIO=y
```

## boards/arm/gd32e103v_eval/Kconfig.board
```kconfig
# Copyright (c) 2021, YuLong Yao <feilongphone@gmail.com>
# SPDX-License-Identifier: Apache-2.0

config BOARD_GD32E103V_EVAL
	bool "GigaDevice GD32E103V Evaluation Kit"
	depends on SOC_GD32E103
```

## boards/arm/gd32e103v_eval/Kconfig.defconfig
```kconfig
# Copyright (c) 2021 YuLong Yao <feilongphone@gmail.com>
# SPDX-License-Identifier: Apache-2.0

if BOARD_GD32E103V_EVAL

config BOARD
	default "gd32e103v_eval"

endif   # BOARD_GD32E103V_EVAL
```

## boards/arm/gd32e103v_eval/Kconfig.gd32e103v_eval
```kconfig
# Copyright (c) 2022 Zephyr Project members and individual contributors
# SPDX-License-Identifier: Apache-2.0

config BOARD_GD32E103V_EVAL
	bool
	default y
	select SOC_SERIES_GD32E10X
	select SOC_GD32E103
```

## boards/arm/gd32e103v_eval/gd32e103v_eval_defconfig
```kconfig
# Copyright (c) 2021, YuLong Yao <feilongphone@gmail.com>
# SPDX-License-Identifier: Apache-2.0

CONFIG_SOC_SERIES_GD32E10X=y
CONFIG_SOC_GD32E103=y
CONFIG_BOARD_GD32E103V_EVAL=y

CONFIG_GD32_HXTAL_8MHZ=y

CONFIG_CONSOLE=y
CONFIG_UART_CONSOLE=y
CONFIG_SERIAL=y
```

## boards/arm/gd32e507v_start/Kconfig.board
```kconfig
# Copyright (c) 2022, Teslabs Engineering S.L.
# SPDX-License-Identifier: Apache-2.0

config BOARD_GD32E507V_START
	bool "GigaDevice GD32E507V-START"
	depends on SOC_GD32E507
```

## boards/arm/gd32e507v_start/Kconfig.defconfig
```kconfig
# Copyright (c) 2022 Teslabs Engineering S.L.
# SPDX-License-Identifier: Apache-2.0

if BOARD_GD32E507V_START

config BOARD
	default "gd32e507v_start"

endif # BOARD_GD32E507V_START
```

## boards/arm/gd32e507v_start/Kconfig.gd32e507v_start
```kconfig
# Copyright (c) 2022 Zephyr Project members and individual contributors
# SPDX-License-Identifier: Apache-2.0

config BOARD_GD32E507V_START
	bool
	default y
	select SOC_SERIES_GD32E50X
	select SOC_GD32E507
```

## boards/arm/gd32e507z_eval/Kconfig.board
```kconfig
# Copyright (c) 2022, Teslabs Engineering S.L.
# SPDX-License-Identifier: Apache-2.0

config BOARD_GD32E507Z_EVAL
	bool "GigaDevice GD32E507Z-EVAL"
	depends on SOC_GD32E507
```

## boards/arm/gd32e507z_eval/Kconfig.defconfig
```kconfig
# Copyright (c) 2022 Teslabs Engineering S.L.
# SPDX-License-Identifier: Apache-2.0

if BOARD_GD32E507Z_EVAL

config BOARD
	default "gd32e507z_eval"

endif # BOARD_GD32E507Z_EVAL
```

## boards/arm/gd32e507z_eval/gd32e507z_eval_defconfig
```kconfig
# Copyright (c) 2022, Teslabs Engineering S.L.
# SPDX-License-Identifier: Apache-2.0

CONFIG_SOC_SERIES_GD32E50X=y
CONFIG_SOC_GD32E507=y
CONFIG_BOARD_GD32E507Z_EVAL=y

CONFIG_ARM_MPU=y
CONFIG_HW_STACK_PROTECTION=y

CONFIG_CONSOLE=y
CONFIG_UART_CONSOLE=y
CONFIG_SERIAL=y

CONFIG_GPIO=y
```

## boards/arm/gd32f350r_eval/Kconfig.board
```kconfig
# Copyright (c) 2021 BrainCo Inc.
# SPDX-License-Identifier: Apache-2.0

config BOARD_GD32F350R_EVAL
	bool "GigaDevice GD32F350R Evaluation Kit"
	depends on SOC_GD32F350
```

## boards/arm/gd32f350r_eval/Kconfig.defconfig
```kconfig
# Copyright (c) 2021 BrainCo Inc.
# SPDX-License-Identifier: Apache-2.0

if BOARD_GD32F350R_EVAL

config BOARD
	default "gd32f350r_eval"

endif # BOARD_GD32F350R_EVAL
```

## boards/arm/gd32f350r_eval/Kconfig.gd32f350r_eval
```kconfig
# Copyright (c) 2022 Zephyr Project members and individual contributors
# SPDX-License-Identifier: Apache-2.0

config BOARD_GD32F350R_EVAL
	bool
	default y
	select SOC_SERIES_GD32F3X0
	select SOC_GD32F350
```

## boards/arm/gd32f350r_eval/gd32f350r_eval_defconfig
```kconfig
# Copyright (c) 2021 BrainCo Inc.
# SPDX-License-Identifier: Apache-2.0

CONFIG_SOC_SERIES_GD32F3X0=y
CONFIG_SOC_GD32F350=y
CONFIG_BOARD_GD32F350R_EVAL=y


CONFIG_CONSOLE=y
CONFIG_UART_CONSOLE=y
CONFIG_SERIAL=y
```

## boards/arm/gd32f403z_eval/Kconfig
```kconfig
# Copyright (c) 2021 ATL-Electronics
# SPDX-License-Identifier: Apache-2.0

config BOARD_INIT_PRIORITY
	int "Board initialization priority"
	default 50
	help
	  Board initialization priority.
```

## boards/arm/gd32f403z_eval/Kconfig.board
```kconfig
# Copyright (c) 2021, ATL Electronics
# SPDX-License-Identifier: Apache-2.0

config BOARD_GD32F403Z_EVAL
	bool "GigaDevice GD32F403Z Evaluation Kit"
	depends on SOC_GD32F403
```

## boards/arm/gd32f403z_eval/Kconfig.defconfig
```kconfig
# Copyright (c) 2021 ATL Electronics
# SPDX-License-Identifier: Apache-2.0

if BOARD_GD32F403Z_EVAL

config BOARD
	default "gd32f403z_eval"

endif   # BOARD_GD32F403Z_EVAL
```

## boards/arm/gd32f403z_eval/Kconfig.gd32f403z_eval
```kconfig
# Copyright (c) 2022 Zephyr Project members and individual contributors
# SPDX-License-Identifier: Apache-2.0

config BOARD_GD32F403Z_EVAL
	bool
	default y
	select SOC_SERIES_GD32F403
	select SOC_GD32F403
```
