## boards/arm/nucleo_l053r8/nucleo_l053r8_defconfig
```kconfig
# Zephyr Kernel Configuration
CONFIG_ARM=y
CONFIG_SOC_SERIES_STM32L0X=y

# Platform Configuration
CONFIG_SOC_FAMILY_STM32=y
CONFIG_SOC_STM32L053X8=y
CONFIG_BOARD_NUCLEO_L053R8=y

# General Kernel Options
CONFIG_CORTEX_M_SYSTICK=y
CONFIG_SYS_CLOCK_HW_CYCLES_PER_SEC=32000000

# Kernel Options due to Low Memory (8k)
CONFIG_MAIN_STACK_SIZE=640
CONFIG_IDLE_STACK_SIZE=200
CONFIG_ISR_STACK_SIZE=512
# Prevent Interrupt Vector Table in RAM
CONFIG_IS_BOOTLOADER=y
CONFIG_BOOTLOADER_SRAM_SIZE=8

# Serial Drivers
CONFIG_SERIAL=y
CONFIG_UART_INTERRUPT_DRIVEN=y
# enable console
CONFIG_CONSOLE=y
CONFIG_UART_CONSOLE=y

# Pinmux Driver
CONFIG_PINMUX=y

# GPIO Controller
CONFIG_GPIO=y

# Clock configuration
CONFIG_CLOCK_CONTROL=y
# SYSCLK selection
CONFIG_CLOCK_STM32_SYSCLK_SRC_PLL=y
# HSE configuration
CONFIG_CLOCK_STM32_HSE_CLOCK=8000000
# however, the board does not have an external oscillator, so just use
# the 8MHz clock signal coming from integrated STLink
CONFIG_CLOCK_STM32_HSE_BYPASS=y
# PLL configuration
CONFIG_CLOCK_STM32_PLL_SRC_HSE=y
# produce 32MHz clock at PLL output
CONFIG_CLOCK_STM32_PLL_MULTIPLIER=8
CONFIG_CLOCK_STM32_PLL_DIVISOR=2
CONFIG_CLOCK_STM32_AHB_PRESCALER=1
CONFIG_CLOCK_STM32_APB1_PRESCALER=1
CONFIG_CLOCK_STM32_APB2_PRESCALER=1
```

## boards/arm/nucleo_l073rz/Kconfig.board
```kconfig
# STM32 Nucleo-64 development board with STM32L073RZ MCU configuration

# Copyright (c) 2018 Ilya Tagunov <tagunil@gmail.com>
# SPDX-License-Identifier: Apache-2.0

config BOARD_NUCLEO_L073RZ
	def_bool "$(BOARD)" = "nucleo_l073rz"
	depends on SOC_STM32L073XX
```

## boards/arm/nucleo_l073rz/Kconfig.defconfig
```kconfig
# STM32 Nucleo-64 development board with STM32L073RZ MCU

# Copyright (c) 2018 Ilya Tagunov <tagunil@gmail.com>
# SPDX-License-Identifier: Apache-2.0

if BOARD_NUCLEO_L073RZ

config BOARD
	default "nucleo_l073rz"

config SPI_STM32_INTERRUPT
	default y
	depends on SPI

# LPTIM clocked by LSI, force tick freq to 4000 for tick accuracy
config SYS_CLOCK_TICKS_PER_SEC
	default 4000 if STM32_LPTIM_TIMER

endif # BOARD_NUCLEO_L073RZ
```

## boards/arm/nucleo_l073rz/Kconfig.nucleo_l073rz
```kconfig
# Copyright (c) 2022 Zephyr Project members and individual contributors
# SPDX-License-Identifier: Apache-2.0

config BOARD_NUCLEO_L073RZ
	bool
	default y
	select SOC_SERIES_STM32L0X
	select SOC_STM32L073XX
```

## boards/arm/nucleo_l073rz/nucleo_l073rz_defconfig
```kconfig
# SPDX-License-Identifier: Apache-2.0

# Zephyr Kernel Configuration
CONFIG_SOC_SERIES_STM32L0X=y

# Platform Configuration
CONFIG_SOC_STM32L073XX=y

# General Kernel Options
CONFIG_SYS_CLOCK_HW_CYCLES_PER_SEC=32000000

# Enable MPU
CONFIG_ARM_MPU=y

# Serial Drivers
CONFIG_SERIAL=y
CONFIG_UART_INTERRUPT_DRIVEN=y
# enable console
CONFIG_CONSOLE=y
CONFIG_UART_CONSOLE=y

# Pinmux Driver
CONFIG_PINMUX=y

# GPIO Controller
CONFIG_GPIO=y

# Clock configuration
CONFIG_CLOCK_CONTROL=y
# SYSCLK selection
CONFIG_CLOCK_STM32_SYSCLK_SRC_PLL=y
# HSE configuration
CONFIG_CLOCK_STM32_HSE_CLOCK=8000000
# however, the board does not have an external oscillator, so just use
# the 8MHz clock signal coming from integrated STLink
CONFIG_CLOCK_STM32_HSE_BYPASS=y
# PLL configuration
CONFIG_CLOCK_STM32_PLL_SRC_HSE=y
# produce 32MHz clock at PLL output
CONFIG_CLOCK_STM32_PLL_MULTIPLIER=8
CONFIG_CLOCK_STM32_PLL_DIVISOR=2
CONFIG_CLOCK_STM32_AHB_PRESCALER=1
CONFIG_CLOCK_STM32_APB1_PRESCALER=1
CONFIG_CLOCK_STM32_APB2_PRESCALER=1
```

## boards/arm/nucleo_l152re/Kconfig.board
```kconfig
# NUCLEO-64 L152RE development board

# Copyright (c) 2019 Antony Pavlov <antonynpavlov@gmail.com>
# SPDX-License-Identifier: Apache-2.0

config BOARD_NUCLEO_L152RE
	def_bool "$(BOARD)" = "nucleo_l152re"
	depends on SOC_STM32L152XE
```

## boards/arm/nucleo_l152re/Kconfig.defconfig
```kconfig
#
# Copyright (c) 2019 Antony Pavlov <antonynpavlov@gmail.com>
#
# SPDX-License-Identifier: Apache-2.0
#

if BOARD_NUCLEO_L152RE

config BOARD
	default "nucleo_l152re"

endif # BOARD_NUCLEO_L152RE
```

## boards/arm/nucleo_l152re/nucleo_l152re_defconfig
```kconfig
# SPDX-License-Identifier: Apache-2.0

CONFIG_SOC_SERIES_STM32L1X=y
CONFIG_SOC_STM32L152XE=y

# Enable MPU
CONFIG_ARM_MPU=y

# Enable HW stack protection
CONFIG_HW_STACK_PROTECTION=y

# enable uart driver
CONFIG_SERIAL=y
# enable console
CONFIG_CONSOLE=y
CONFIG_UART_CONSOLE=y

# enable GPIO
CONFIG_GPIO=y

# Enable Clocks
CONFIG_CLOCK_CONTROL=y

# enable pin controller
CONFIG_PINCTRL=y
```

## boards/arm/nucleo_l412rb_p/Kconfig.board
```kconfig
# STM32L412RB Nucleo board configuration

# Copyright (c) 2021 Guðni Már Gilbert
# SPDX-License-Identifier: Apache-2.0

config BOARD_NUCLEO_L412RB_P
	bool "Nucleo L412RB-P Development Board"
	depends on SOC_STM32L412XX
```

## boards/arm/nucleo_l412rb_p/Kconfig.defconfig
```kconfig
# STM32L412RB Nucleo board configuration

# Copyright (c) 2021 Guðni Már Gilbert
# SPDX-License-Identifier: Apache-2.0

config SPI_STM32_INTERRUPT
	default y
	depends on SPI
```

## boards/arm/nucleo_l412rb_p/Kconfig.nucleo_l412rb_p
```kconfig
# Copyright (c) 2022 Zephyr Project members and individual contributors
# SPDX-License-Identifier: Apache-2.0

config BOARD_NUCLEO_L412RB_P
	bool
	default y
	select SOC_SERIES_STM32L4X
	select SOC_STM32L412XX
```

## boards/arm/nucleo_l432kc/Kconfig.board
```kconfig
# Nucleo L432KC Development Board

# Copyright (c) 2016 Open-RnD Sp. z o.o.
# Copyright (c) 2016 BayLibre, SAS
# SPDX-License-Identifier: Apache-2.0

config BOARD_NUCLEO_L432KC
	def_bool "$(BOARD)" = "nucleo_l432kc"
	depends on SOC_STM32L432XX
```

## boards/arm/nucleo_l432kc/Kconfig.defconfig
```kconfig
# STM32L432KC Nucleo board configuration

# Copyright (c) 2016 Open-RnD Sp. z o.o.
# Copyright (c) 2016 BayLibre, SAS
# SPDX-License-Identifier: Apache-2.0

if BOARD_NUCLEO_L432KC

config BOARD
	default "nucleo_l432kc"

config PWM_STM32_2
	default y
	depends on PWM

config SPI_STM32_INTERRUPT
	default y
	depends on SPI

config CAN_1
	default y
	depends on CAN

endif # BOARD_NUCLEO_L432KC
```

## boards/arm/nucleo_l432kc/nucleo_l432kc_defconfig
```kconfig
# SPDX-License-Identifier: Apache-2.0

CONFIG_SOC_SERIES_STM32L4X=y
CONFIG_SOC_STM32L432XX=y
# 80MHz system clock
CONFIG_SYS_CLOCK_HW_CYCLES_PER_SEC=80000000

# Enable MPU
CONFIG_ARM_MPU=y

# Enable HW stack protection
CONFIG_HW_STACK_PROTECTION=y

# enable uart driver
CONFIG_SERIAL=y

# enable pinmux
CONFIG_PINMUX=y

# enable GPIO
CONFIG_GPIO=y

# clock configuration
CONFIG_CLOCK_CONTROL=y
# SYSCLK selection
CONFIG_CLOCK_STM32_SYSCLK_SRC_PLL=y
# PLL configuration
CONFIG_CLOCK_STM32_PLL_SRC_HSI=y
# produce 80MHz clock at PLL output
CONFIG_CLOCK_STM32_PLL_M_DIVISOR=1
CONFIG_CLOCK_STM32_PLL_N_MULTIPLIER=20
CONFIG_CLOCK_STM32_PLL_P_DIVISOR=7
CONFIG_CLOCK_STM32_PLL_Q_DIVISOR=2
CONFIG_CLOCK_STM32_PLL_R_DIVISOR=4
CONFIG_CLOCK_STM32_AHB_PRESCALER=1
CONFIG_CLOCK_STM32_APB1_PRESCALER=1
CONFIG_CLOCK_STM32_APB2_PRESCALER=1

# console
CONFIG_CONSOLE=y
CONFIG_UART_CONSOLE=y
```

## boards/arm/nucleo_l433rc_p/Kconfig.board
```kconfig
# STM32L433RC Nucleo board configuration

# Copyright (c) 2021 Matija Tudan
# SPDX-License-Identifier: Apache-2.0

config BOARD_NUCLEO_L433RC_P
	bool "Nucleo L433RC-P Development Board"
	depends on SOC_STM32L433XX
```

## boards/arm/nucleo_l433rc_p/Kconfig.defconfig
```kconfig
# STM32L433RC Nucleo board configuration

# Copyright (c) 2021 Matija Tudan
# SPDX-License-Identifier: Apache-2.0

config SPI_STM32_INTERRUPT
	default y
	depends on SPI
```

## boards/arm/nucleo_l452re/Kconfig.board
```kconfig
# Nucleo L452RE development board

# Copyright (c) 2019 Libre Solar Technologies GmbH
# SPDX-License-Identifier: Apache-2.0

config BOARD_NUCLEO_L452RE
	def_bool "$(BOARD)" = "nucleo_l452re"
	depends on SOC_STM32L452XX
```

## boards/arm/nucleo_l452re/Kconfig.defconfig
```kconfig
# STM32L452RE Nucleo board configuration
#
# Copyright (c) 2019 Libre Solar Technologies GmbH
#
# SPDX-License-Identifier: Apache-2.0

if BOARD_NUCLEO_L452RE || BOARD_NUCLEO_L452RE_P

config BOARD
	default "nucleo_l452re" if BOARD_NUCLEO_L452RE
	default "nucleo_l452re_p" if BOARD_NUCLEO_L452RE_P

config SPI_STM32_INTERRUPT
	default y
	depends on SPI

endif # BOARD_NUCLEO_L452RE || BOARD_NUCLEO_L452RE_P
```

## boards/arm/nucleo_l476rg/Kconfig.board
```kconfig
# Nucleo L476RG Development Board

# Copyright (c) 2016 Open-RnD Sp. z o.o.
# Copyright (c) 2016 BayLibre, SAS
# SPDX-License-Identifier: Apache-2.0

config BOARD_NUCLEO_L476RG
	def_bool "$(BOARD)" = "nucleo_l476rg"
	depends on SOC_STM32L476XX
```

## boards/arm/nucleo_l476rg/Kconfig.defconfig
```kconfig
# STM32L476RG Nucleo board configuration

# Copyright (c) 2016 Open-RnD Sp. z o.o.
# Copyright (c) 2016 BayLibre, SAS
# SPDX-License-Identifier: Apache-2.0

if BOARD_NUCLEO_L476RG

config BOARD
	default "nucleo_l476rg"

config UART_2
	default y
	depends on UART_CONSOLE

config SPI_STM32_INTERRUPT
	default y
	depends on SPI


config PWM_STM32_2
	default y
	depends on PWM

config ADC_1
	default y
	depends on ADC

endif # BOARD_NUCLEO_L476RG
```

## boards/arm/nucleo_l476rg/nucleo_l476rg_defconfig
```kconfig
CONFIG_ARM=y
CONFIG_BOARD_STM32_NUCLEO_L476RG=y
CONFIG_SOC_FAMILY_STM32=y
CONFIG_SOC_SERIES_STM32L4X=y
CONFIG_SOC_STM32L476XX=y
CONFIG_CORTEX_M_SYSTICK=y
# 80MHz system clock
CONFIG_SYS_CLOCK_HW_CYCLES_PER_SEC=80000000

# enable uart driver
CONFIG_SERIAL=y
CONFIG_UART_STM32=y
CONFIG_UART_STM32_PORT_2=y
CONFIG_UART_STM32_PORT_2_BAUD_RATE=115200

# enable pinmux
CONFIG_PINMUX=y
CONFIG_PINMUX_STM32=y

# enable GPIOs
CONFIG_GPIO=y
CONFIG_GPIO_STM32=y
CONFIG_GPIO_STM32_PORTA=y
CONFIG_GPIO_STM32_PORTB=y
CONFIG_GPIO_STM32_PORTC=y
CONFIG_GPIO_STM32_PORTD=y
CONFIG_GPIO_STM32_PORTE=y
CONFIG_GPIO_STM32_PORTF=y
CONFIG_GPIO_STM32_PORTG=y
CONFIG_GPIO_STM32_PORTH=y

# clock configuration
CONFIG_CLOCK_CONTROL=y
CONFIG_CLOCK_CONTROL_STM32L4X=y
CONFIG_CLOCK_STM32L4X_SYSCLK_SRC_PLL=y
# use 16MHz oscillator
CONFIG_CLOCK_STM32F10X_PLL_SRC_HSI=y
# produce 80MHz clock at PLL output
CONFIG_CLOCK_STM32L4X_PLL_DIVISOR=1
CONFIG_CLOCK_STM32L4X_PLL_MULTIPLIER=20
CONFIG_CLOCK_STM32L4X_PLL_P_DIVISOR=7
CONFIG_CLOCK_STM32L4X_PLL_Q_DIVISOR=2
CONFIG_CLOCK_STM32L4X_PLL_R_DIVISOR=4
CONFIG_CLOCK_STM32L4X_AHB_PRESCALER=0
CONFIG_CLOCK_STM32L4X_APB1_PRESCALER=0
CONFIG_CLOCK_STM32L4X_APB2_PRESCALER=0

# console
CONFIG_CONSOLE=y
CONFIG_UART_CONSOLE=y
CONFIG_UART_CONSOLE_ON_DEV_NAME="UART_2"

#enable pwm
CONFIG_PWM=y
CONFIG_PWM_STM32=y
CONFIG_PWM_STM32_2=y
```

## boards/arm/nucleo_l496zg/Kconfig.board
```kconfig
# STM32L496ZG Nucleo board configuration

# Copyright (c) 2018-2019 Centaur Analytics, Inc
# SPDX-License-Identifier: Apache-2.0

config BOARD_NUCLEO_L496ZG
	bool "Nucleo L496ZG Development Board"
	depends on SOC_STM32L496XX
```

## boards/arm/nucleo_l496zg/Kconfig.defconfig
```kconfig
# STM32L496ZG Nucleo board configuration

# Copyright (c) 2018 Centaur Analytics, Inc
# SPDX-License-Identifier: Apache-2.0

config SPI_STM32_INTERRUPT
	default y
	depends on SPI
```

## boards/arm/nucleo_l4a6zg/Kconfig.board
```kconfig
# STM32L4A6ZG Nucleo board configuration

# Copyright (c) 2022 Tomislav Milkovic
# SPDX-License-Identifier: Apache-2.0

config BOARD_NUCLEO_L4A6ZG
	bool "Nucleo L4A6ZG Development Board"
	depends on SOC_STM32L4A6XX
```

## boards/arm/nucleo_l4r5zi/Kconfig.board
```kconfig
# Nucleo L4R5ZI development board

# Copyright (c) 2018 Pushpal Sidhu
# SPDX-License-Identifier: Apache-2.0

config BOARD_NUCLEO_L4R5ZI
	def_bool "$(BOARD)" = "nucleo_l4r5zi"
	depends on SOC_STM32L4R5XX
```
