## boards/arm/nucleo_f722ze/Kconfig.board
```kconfig
# STM32F722ZE Nucleo board configuration

# Copyright (c) 2023 Evan Perry Grove
# SPDX-License-Identifier: Apache-2.0

config BOARD_NUCLEO_F722ZE
	bool "Nucleo F722ZE Development Board"
	depends on SOC_STM32F722XX
```

## boards/arm/nucleo_f722ze/Kconfig.defconfig
```kconfig
# STM32F722ZE Nucleo board configuration
#
# Copyright (c) 2023 Evan Perry Grove
# SPDX-License-Identifier: Apache-2.0

if BOARD_NUCLEO_F722ZE

config BOARD
	default "nucleo_f722ze"

config SPI_STM32_INTERRUPT
	default y
	depends on SPI

endif # BOARD_NUCLEO_F722ZE
```

## boards/arm/nucleo_f722ze/nucleo_f722ze_defconfig
```kconfig
# SPDX-License-Identifier: Apache-2.0

CONFIG_SOC_SERIES_STM32F7X=y
CONFIG_SOC_STM32F722XX=y

# Enable MPU
CONFIG_ARM_MPU=y

# Enable HW stack protection
CONFIG_HW_STACK_PROTECTION=y

# Enable UART
CONFIG_SERIAL=y

# Enable console (use UART by default)
CONFIG_CONSOLE=y
CONFIG_UART_CONSOLE=y

# Enable GPIO
CONFIG_GPIO=y

# Enable clocks
CONFIG_CLOCK_CONTROL=y

# Enable pinctrl
CONFIG_PINCTRL=y
```

## boards/arm/nucleo_f746zg/Kconfig.board
```kconfig
# Nucleo F746ZG development board

# Copyright (c) 2018 AJ Palmer
# SPDX-License-Identifier: Apache-2.0

config BOARD_NUCLEO_F746ZG
	def_bool "$(BOARD)" = "nucleo_f746zg"
	depends on SOC_STM32F746XX
```

## boards/arm/nucleo_f746zg/Kconfig.defconfig
```kconfig
# STM32F746ZG Nucleo board configuration

# Copyright (c) 2018 AJ Palmer
# SPDX-License-Identifier: Apache-2.0

if NETWORKING

config NET_L2_ETHERNET
	default y

endif # NETWORKING
```

## boards/arm/nucleo_f756zg/Kconfig.board
```kconfig
# STM32F756ZG Nucleo board configuration

# Copyright (c) 2018 AJ Palmer
# SPDX-License-Identifier: Apache-2.0

config BOARD_NUCLEO_F756ZG
	bool "Nucleo F756ZG Development Board"
	depends on SOC_STM32F756XX
```

## boards/arm/nucleo_f756zg/Kconfig.defconfig
```kconfig
# STM32F756ZG Nucleo board configuration

# Copyright (c) 2018 AJ Palmer
# SPDX-License-Identifier: Apache-2.0

if BOARD_NUCLEO_F756ZG

config BOARD
	default "nucleo_f756zg"

if NETWORKING

config NET_L2_ETHERNET
	default y

config ETH_STM32_HAL
	default y

endif # NETWORKING


config PWM_STM32_1
	default y
	depends on PWM

endif # BOARD_NUCLEO_F756ZG
```

## boards/arm/nucleo_f756zg/nucleo_f756zg_defconfig
```kconfig
# SPDX-License-Identifier: Apache-2.0

CONFIG_ARM=y
CONFIG_BOARD_NUCLEO_F756ZG=y
CONFIG_SOC_SERIES_STM32F7X=y
CONFIG_SOC_STM32F756XX=y
# 72MHz system clock (CubeMX Defaults)
CONFIG_SYS_CLOCK_HW_CYCLES_PER_SEC=72000000

# Enable MPU
CONFIG_ARM_MPU=y

# Enable UART
CONFIG_SERIAL=y

# Console
CONFIG_CONSOLE=y
CONFIG_UART_CONSOLE=y

# Enable Pinmux
CONFIG_PINMUX=y

# Enable GPIO
CONFIG_GPIO=y

# Clock Configuration
CONFIG_CLOCK_CONTROL=y

# STLINK provides 8MHz clock input
CONFIG_CLOCK_STM32_HSE_CLOCK=8000000
CONFIG_CLOCK_STM32_SYSCLK_SRC_PLL=y
# Use HSE as PLL input
CONFIG_CLOCK_STM32_PLL_SRC_HSE=y
# Nucleo-144 boards do not have an external oscillator, so just use
# the 8MHz clock signal coming from integrated STLink
CONFIG_CLOCK_STM32_HSE_BYPASS=y

# Produce 72MHz clock at PLL output
CONFIG_CLOCK_STM32_PLL_M_DIVISOR=4
CONFIG_CLOCK_STM32_PLL_N_MULTIPLIER=72
CONFIG_CLOCK_STM32_PLL_P_DIVISOR=2
CONFIG_CLOCK_STM32_PLL_Q_DIVISOR=3
CONFIG_CLOCK_STM32_AHB_PRESCALER=1
CONFIG_CLOCK_STM32_APB1_PRESCALER=2
CONFIG_CLOCK_STM32_APB2_PRESCALER=1
```

## boards/arm/nucleo_f767zi/Kconfig.board
```kconfig
# STM32F767ZI Nucleo board configuration

# Copyright (c) 2019 Roland Ma
# SPDX-License-Identifier: Apache-2.0

config BOARD_NUCLEO_F767ZI
	bool "Nucleo F767ZI Development Board"
	depends on SOC_STM32F767XX
```

## boards/arm/nucleo_f767zi/Kconfig.defconfig
```kconfig
# STM32F767ZI Nucleo board configuration

# Copyright (c) 2019 Roland Ma
# SPDX-License-Identifier: Apache-2.0

if BOARD_NUCLEO_F767ZI

config BOARD
	default "nucleo_f767zi"

if NETWORKING

config NET_L2_ETHERNET
	default y

endif # NETWORKING

endif # BOARD_NUCLEO_F767ZI
```

## boards/arm/nucleo_g031k8/Kconfig.defconfig
```kconfig
# STM32 Nucleo-32 development board with STM32G031K8 MCU

# Copyright (c) 2022 Joylab AG <team@joylab.ch>
# SPDX-License-Identifier: Apache-2.0

config SPI_STM32_INTERRUPT
	default y
	depends on SPI
```

## boards/arm/nucleo_g031k8/Kconfig.nucleo_g031k8
```kconfig
# Copyright (c) 2022 Zephyr Project members and individual contributors
# SPDX-License-Identifier: Apache-2.0

config BOARD_NUCLEO_G031K8
	bool
	default y
	select SOC_SERIES_STM32G0X
	select SOC_STM32G031XX
```

## boards/arm/nucleo_g071rb/Kconfig.board
```kconfig
# Kconfig - STM32 Nucleo-64 development board with STM32G071RB MCU configuration
#
# Copyright (c) 2019 Philippe Retornaz <philippe@shapescale.com>
# Copyright (c) 2019 STMicroelectronics
#
# SPDX-License-Identifier: Apache-2.0
#

config BOARD_NUCLEO_G071RB
	bool "NUCLEO-64 G071RB Development Board"
	depends on SOC_STM32G071XX
```

## boards/arm/nucleo_g071rb/Kconfig.defconfig
```kconfig
# Kconfig - STM32 Nucleo-64 development board with STM32G071RB MCU
#
# Copyright (c) 2019 Philippe Retornaz <philippe@shapescale.com>
# Copyright (c) 2019 STMicroelectronics
#
# SPDX-License-Identifier: Apache-2.0
#

if BOARD_NUCLEO_G071RB

config BOARD
	default "nucleo_g071rb"

if UART_CONSOLE

config UART_2
	default y

endif # UART_CONSOLE

endif # BOARD_NUCLEO_G071RB
```

## boards/arm/nucleo_g071rb/Kconfig.nucleo_g071rb
```kconfig
# Copyright (c) 2022 Zephyr Project members and individual contributors
# SPDX-License-Identifier: Apache-2.0

config BOARD_NUCLEO_G071RB
	bool
	default y
	select SOC_SERIES_STM32G0X
	select SOC_STM32G071XX
```

## boards/arm/nucleo_g071rb/nucleo_g071rb_defconfig
```kconfig
# Zephyr Kernel Configuration
CONFIG_SOC_SERIES_STM32G0X=y
CONFIG_SOC_STM32G071XX=y

# Enable MPU
CONFIG_ARM_MPU=y

# Serial Drivers
CONFIG_SERIAL=y
CONFIG_UART_INTERRUPT_DRIVEN=y
# enable console
CONFIG_CONSOLE=y
CONFIG_UART_CONSOLE=y

# Pinmux Driver
CONFIG_PINMUX=y

# GPIO Controller
CONFIG_GPIO=y

# Enables clocks
CONFIG_CLOCK_CONTROL=y
```

## boards/arm/nucleo_g0b1re/Kconfig.defconfig
```kconfig
# STM32 Nucleo-64 development board with STM32G0B1RE MCU

# Copyright (c) 2020 Thomas Stranger
# SPDX-License-Identifier: Apache-2.0

if BOARD_NUCLEO_G0B1RE

config BOARD
	default "nucleo_g0b1re"

endif # BOARD_NUCLEO_G0B1RE
```

## boards/arm/nucleo_g0b1re/Kconfig.nucleo_g0b1re
```kconfig
# Copyright (c) 2022 Zephyr Project members and individual contributors
# SPDX-License-Identifier: Apache-2.0

config BOARD_NUCLEO_G0B1RE
	bool
	default y
	select SOC_SERIES_STM32G0X
	select SOC_STM32G0B1XX
```

## boards/arm/nucleo_g431kb/Kconfig.board
```kconfig
# STM32G431KB Nucleo board configuration
# Copyright (c) 2022 Mariana Ucker <mariana@freedom.ind.br>
# SPDX-License-Identifier: Apache-2.0

config BOARD_NUCLEO_G431KB
	bool "Nucleo G431KB Development Board"
	depends on SOC_STM32G431XX
```

## boards/arm/nucleo_g431kb/Kconfig.defconfig
```kconfig
# STM32G431KB Nucleo board configuration
# Copyright (c) 2022 Mariana Ucker <mariana@freedom.ind.br>
# SPDX-License-Identifier: Apache-2.0

if BOARD_NUCLEO_G431KB

config BOARD
	default "nucleo_g431kb"

config SPI_STM32_INTERRUPT
	default y
	depends on SPI

endif # BOARD_NUCLEO_G431KB
```

## boards/arm/nucleo_g431rb/Kconfig.board
```kconfig
# Nucleo G431RB development board

# Copyright (c) 2019 Richard Osterloh <richard.osterloh@gmail.com>
# SPDX-License-Identifier: Apache-2.0

config BOARD_NUCLEO_G431RB
	def_bool "$(BOARD)" = "nucleo_g431rb"
	depends on SOC_STM32G431XX
```

## boards/arm/nucleo_g431rb/Kconfig.defconfig
```kconfig
# STM32G431RB Nucleo board configuration

# Copyright (c) 2019 Richard Osterloh <richard.osterloh@gmail.com>
# SPDX-License-Identifier: Apache-2.0

if BOARD_NUCLEO_G431RB

config BOARD
	default "nucleo_g431rb"

config SPI_STM32_INTERRUPT
	default y
	depends on SPI

# LPTIM clocked by LSE, force tick freq to 4096 for tick accuracy
config SYS_CLOCK_TICKS_PER_SEC
	default 4096 if STM32_LPTIM_TIMER

endif # BOARD_NUCLEO_G431RB
```

## boards/arm/nucleo_g431rb/nucleo_g431rb_defconfig
```kconfig
# SPDX-License-Identifier: Apache-2.0

CONFIG_SOC_SERIES_STM32G4X=y
CONFIG_SOC_STM32G431XX=y

# 170MHz system clock only in 'boost power' mode.
# RM0440, section 5.1.5 states that the R1MODE bit
# must be cleared before system can be 170MHz.
CONFIG_SYS_CLOCK_HW_CYCLES_PER_SEC=170000000

# 150MHz system clock in 'normal power' mode
# CONFIG_SYS_CLOCK_HW_CYCLES_PER_SEC=150000000

# enable uart driver
CONFIG_SERIAL=y

# enable pinmux
CONFIG_PINMUX=y

# enable GPIO
CONFIG_GPIO=y

# clock configuration
CONFIG_CLOCK_CONTROL=y

# Use PLLCLK for SYSCLK
CONFIG_CLOCK_STM32_SYSCLK_SRC_PLL=y

# Use HSE (24MHz) to feed into PLL
CONFIG_CLOCK_STM32_PLL_SRC_HSE=y
CONFIG_CLOCK_STM32_HSE_CLOCK=24000000

CONFIG_CLOCK_STM32_PLL_P_DIVISOR=7
CONFIG_CLOCK_STM32_PLL_Q_DIVISOR=2
CONFIG_CLOCK_STM32_PLL_R_DIVISOR=2

# Produce 150MHz clock at PLLCLK output
# CONFIG_CLOCK_STM32_PLL_M_DIVISOR=4
# CONFIG_CLOCK_STM32_PLL_N_MULTIPLIER=50

# Produce 170MHz clock at PLLCLK output
CONFIG_CLOCK_STM32_PLL_M_DIVISOR=6
CONFIG_CLOCK_STM32_PLL_N_MULTIPLIER=85

# Produce Max (150MHz or 170MHz) HCLK
CONFIG_CLOCK_STM32_AHB_PRESCALER=1

# Produce Max (150MHz or 170MHz) APB1 clocks and APB2 clocks
CONFIG_CLOCK_STM32_APB1_PRESCALER=1
CONFIG_CLOCK_STM32_APB2_PRESCALER=1

# Console
CONFIG_CONSOLE=y
CONFIG_UART_CONSOLE=y

# Enable MPU
CONFIG_ARM_MPU=y
```

## boards/arm/nucleo_g474re/Kconfig.board
```kconfig
# STM32G474RE Nucleo board configuration

# Copyright (c) 2019 STMicroelectronics.
# SPDX-License-Identifier: Apache-2.0

config BOARD_NUCLEO_G474RE
	bool "Nucleo G474RE Development Board"
	depends on SOC_STM32G474XX
```

## boards/arm/nucleo_g474re/Kconfig.defconfig
```kconfig
# STM32G474RE Nucleo board configuration

# Copyright (c) 2019 STMicroelectronics.
# SPDX-License-Identifier: Apache-2.0

config SPI_STM32_INTERRUPT
	default y
	depends on SPI
```
