/*
 * Copyright (c) 2021, Commonwealth Scientific and Industrial Research
 * Organisation (CSIRO) ABN 41 687 119 230.
 *
 * SPDX-License-Identifier: Apache-2.0
 */

#include <mcuboot_partitions.dtsi>

/ {
	chosen {
		zephyr,code-partition = &slot0_partition;
	};
};
