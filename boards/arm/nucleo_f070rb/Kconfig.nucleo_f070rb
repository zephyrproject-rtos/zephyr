## boards/arm/nucleo_f070rb/Kconfig.nucleo_f070rb
```kconfig
# Copyright (c) 2022 Zephyr Project members and individual contributors
# SPDX-License-Identifier: Apache-2.0

config BOARD_NUCLEO_F070RB
	bool
	default y
	select SOC_SERIES_STM32F0X
	select SOC_STM32F070XB
```

## boards/arm/nucleo_f070rb/nucleo_f070rb_defconfig
```kconfig
# SPDX-License-Identifier: Apache-2.0

# Zephyr Kernel Configuration

# Platform Configuration

# Serial Drivers
CONFIG_SERIAL=y
CONFIG_UART_INTERRUPT_DRIVEN=y
# enable console
CONFIG_CONSOLE=y
CONFIG_UART_CONSOLE=y

# GPIO Controller
CONFIG_GPIO=y

# Enable clocks
CONFIG_CLOCK_CONTROL=y

# enable pin controller
CONFIG_PINCTRL=y
```

## boards/arm/nucleo_f091rc/Kconfig.board
```kconfig
# STM32 Nucleo-64 development board with STM32F091RC MCU configuration

# Copyright (c) 2017 Bobby Noelte
# SPDX-License-Identifier: Apache-2.0

config BOARD_NUCLEO_F091RC
	def_bool "$(BOARD)" = "nucleo_f091rc"
	depends on SOC_STM32F091XC
```

## boards/arm/nucleo_f091rc/Kconfig.defconfig
```kconfig
# STM32 Nucleo-64 development board with STM32F091RC MCU

# Copyright (c) 2017 Bobby Noelte
# SPDX-License-Identifier: Apache-2.0

config SPI_STM32_INTERRUPT
	default y
	depends on SPI
```

## boards/arm/nucleo_f103rb/Kconfig.board
```kconfig
# NUCLEO-64 F103RB board configuration

# Copyright (c) 2016 Open-RnD Sp. z o.o.
# SPDX-License-Identifier: Apache-2.0

config BOARD_NUCLEO_F103RB
	bool "NUCLEO-64 F103RB Development Board"
	depends on SOC_STM32F103XB
```

## boards/arm/nucleo_f103rb/Kconfig.defconfig
```kconfig
# NUCLEO-64 F103RB board configuration

# Copyright (c) 2016 Open-RnD Sp. z o.o.
# SPDX-License-Identifier: Apache-2.0

if BOARD_NUCLEO_F103RB

config BOARD
	default "nucleo_f103rb"

endif # BOARD_NUCLEO_F103RB
```

## boards/arm/nucleo_f103rb/Kconfig.nucleo_f103rb
```kconfig
# Copyright (c) 2022 Zephyr Project members and individual contributors
# SPDX-License-Identifier: Apache-2.0

config BOARD_NUCLEO_F103RB
	bool
	default y
	select SOC_SERIES_STM32F1X
	select SOC_STM32F103XB
```

## boards/arm/nucleo_f103rb/nucleo_f103rb_defconfig
```kconfig
CONFIG_ARM=y
CONFIG_BOARD_NUCLEO_F103RB=y
CONFIG_SOC_FAMILY_STM32=y
CONFIG_SOC_SERIES_STM32F1X=y
CONFIG_SOC_STM32F103XB=y
CONFIG_CORTEX_M_SYSTICK=y
# 72MHz system clock
CONFIG_SYS_CLOCK_HW_CYCLES_PER_SEC=72000000

# enable uart driver
CONFIG_SERIAL=y
CONFIG_UART_STM32=y
# enable USART2 - passthrough to STLINK v2 connector
CONFIG_UART_STM32_PORT_2=y
# enable console on this port by default
CONFIG_CONSOLE=y
CONFIG_UART_CONSOLE=y
CONFIG_UART_CONSOLE_ON_DEV_NAME="UART_2"

# enable pinmux
CONFIG_PINMUX=y
CONFIG_PINMUX_STM32=y

# enable GPIO ports A, B, C
CONFIG_GPIO=y
CONFIG_GPIO_STM32=y
CONFIG_GPIO_STM32_PORTA=y
CONFIG_GPIO_STM32_PORTB=y
CONFIG_GPIO_STM32_PORTC=y

# clock configuration
CONFIG_CLOCK_CONTROL=y
# Clock configuration for Cube Clock control driver
CONFIG_CLOCK_STM32_HSE_CLOCK=8000000
CONFIG_CLOCK_STM32_SYSCLK_SRC_PLL=y
# use HSE as PLL input
CONFIG_CLOCK_STM32_PLL_SRC_HSE=y
# however, the board does not have an external oscillator, so just use
# the 8MHz clock signal coming from integrated STLink
CONFIG_CLOCK_STM32_HSE_BYPASS=y
# produce 72MHz clock at PLL output
CONFIG_CLOCK_STM32_PLL_XTPRE=n
CONFIG_CLOCK_STM32_PLL_MULTIPLIER=9
CONFIG_CLOCK_STM32_AHB_PRESCALER=1
# APB1 clock must not to exceed 36MHz limit
CONFIG_CLOCK_STM32_APB1_PRESCALER=2
CONFIG_CLOCK_STM32_APB2_PRESCALER=1


#enable pwm
CONFIG_PWM=y
CONFIG_PWM_STM32=y
CONFIG_PWM_STM32_1=y
```

## boards/arm/nucleo_f207zg/Kconfig.board
```kconfig
# NUCLEO-144 F207ZG Development Board

# Copyright (c) 2018 qianfan Zhao
# SPDX-License-Identifier: Apache-2.0

config BOARD_NUCLEO_F207ZG
	def_bool "$(BOARD)" = "nucleo_f207zg"
	depends on SOC_STM32F207XX
```

## boards/arm/nucleo_f207zg/Kconfig.defconfig
```kconfig
# NUCLEO-144 F207ZG board configuration

# Copyright (c) 2018 qianfan Zhao
# SPDX-License-Identifier: Apache-2.0

if BOARD_NUCLEO_F207ZG

config BOARD
	default "nucleo_f207zg"

if NETWORKING

config NET_L2_ETHERNET
	default y

endif # NETWORKING

endif # BOARD_NUCLEO_F207ZG
```

## boards/arm/nucleo_f207zg/Kconfig.nucleo_f207zg
```kconfig
# Copyright (c) 2022 Zephyr Project members and individual contributors
# SPDX-License-Identifier: Apache-2.0

config BOARD_NUCLEO_F207ZG
	bool
	default y
	select SOC_SERIES_STM32F2X
	select SOC_STM32F207XX
```

## boards/arm/nucleo_f207zg/nucleo_f207zg_defconfig
```kconfig
# SPDX-License-Identifier: Apache-2.0

CONFIG_ARM=y
CONFIG_BOARD_NUCLEO_F207ZG=y
CONFIG_SOC_SERIES_STM32F2X=y
CONFIG_SOC_STM32F207XX=y
CONFIG_SYS_CLOCK_HW_CYCLES_PER_SEC=120000000

CONFIG_SERIAL=y

# console
CONFIG_CONSOLE=y
CONFIG_UART_CONSOLE=y

# enable pinmux
CONFIG_PINMUX=y

# enable GPIO
CONFIG_GPIO=y

# clock configuration
CONFIG_CLOCK_CONTROL=y

# Clock configuration for Cube Clock control driver
CONFIG_CLOCK_STM32_HSE_CLOCK=8000000
CONFIG_CLOCK_STM32_SYSCLK_SRC_PLL=y
# use HSE as PLL input
CONFIG_CLOCK_STM32_PLL_SRC_HSE=y
# however, the board does not have an external oscillator, so just use
# the 8MHz clock signal coming from integrated STLink
CONFIG_CLOCK_STM32_HSE_BYPASS=y
# produce 120MHz clock at PLL output
CONFIG_CLOCK_STM32_PLL_M_DIVISOR=8
CONFIG_CLOCK_STM32_PLL_N_MULTIPLIER=240
CONFIG_CLOCK_STM32_PLL_P_DIVISOR=2
CONFIG_CLOCK_STM32_PLL_Q_DIVISOR=5
CONFIG_CLOCK_STM32_AHB_PRESCALER=1
CONFIG_CLOCK_STM32_APB1_PRESCALER=4
CONFIG_CLOCK_STM32_APB2_PRESCALER=2
```

## boards/arm/nucleo_f302r8/Kconfig.board
```kconfig
# NUCLEO-64 F302R8 board configuration

# Copyright (c) 2018 Seitz & Associates
# SPDX-License-Identifier: Apache-2.0

config BOARD_NUCLEO_F302R8
	def_bool "$(BOARD)" = "nucleo_f302r8"
	depends on SOC_STM32F302X8
```

## boards/arm/nucleo_f302r8/Kconfig.defconfig
```kconfig
# NUCLEO-64 F302R8 board configuration

# Copyright (c) 2018 Seitz & Associates
# SPDX-License-Identifier: Apache-2.0

if BOARD_NUCLEO_F302R8

config BOARD
	default "nucleo_f302r8"

endif # BOARD_NUCLEO_F302R8
```

## boards/arm/nucleo_f302r8/Kconfig.nucleo_f302r8
```kconfig
# Copyright (c) 2022 Zephyr Project members and individual contributors
# SPDX-License-Identifier: Apache-2.0

config BOARD_NUCLEO_F302R8
	bool
	default y
	select SOC_SERIES_STM32F3X
	select SOC_STM32F302X8
```

## boards/arm/nucleo_f302r8/nucleo_f302r8_defconfig
```kconfig
# SPDX-License-Identifier: Apache-2.0

CONFIG_SOC_SERIES_STM32F3X=y
CONFIG_SOC_STM32F302X8=y

CONFIG_SERIAL=y

# console
CONFIG_CONSOLE=y
CONFIG_UART_CONSOLE=y

# enable GPIO
CONFIG_GPIO=y

# Enable Clocks
CONFIG_CLOCK_CONTROL=y

# enable pin controller
CONFIG_PINCTRL=y
```

## boards/arm/nucleo_f303k8/Kconfig.board
```kconfig
# NUCLEO-32 F303k8 board configuration

# Copyright (c) 2020 Sebastian Schwabe <sebastian.schwabe@mailbox.tu-dresden.de>
#                    	Fabian Paschke <fabian.paschke@eas.iis.fraunhofer.de>
# SPDX-License-Identifier: Apache-2.0

config BOARD_NUCLEO_F303K8
	bool "NUCLEO-32 F303K8 Development Board"
	depends on SOC_STM32F303X8
```

## boards/arm/nucleo_f303k8/nucleo_f303k8_defconfig
```kconfig
# SPDX-License-Identifier: Apache-2.0

CONFIG_SOC_SERIES_STM32F3X=y
CONFIG_SOC_STM32F303X8=y
# 72 MHz system clock
CONFIG_SYS_CLOCK_HW_CYCLES_PER_SEC=72000000

CONFIG_SERIAL=y

# console
CONFIG_CONSOLE=y
CONFIG_UART_CONSOLE=y

# enable pinmux
CONFIG_PINMUX=y

# enable GPIO
CONFIG_GPIO=y

# clock configuration
CONFIG_CLOCK_CONTROL=y

# Clock configuration for Cube Clock control driver
CONFIG_CLOCK_STM32_SYSCLK_SRC_PLL=y
# use HSI as PLL input
CONFIG_CLOCK_STM32_PLL_SRC_HSI=y
# however, the board does not have an external oscillator, so just use
# the 8MHz clock signal coming from integrated STLink
# produce 72MHz clock at PLL output
CONFIG_CLOCK_STM32_PLL_PREDIV=1
CONFIG_CLOCK_STM32_PLL_MULTIPLIER=9
CONFIG_CLOCK_STM32_AHB_PRESCALER=1
CONFIG_CLOCK_STM32_APB1_PRESCALER=2
CONFIG_CLOCK_STM32_APB2_PRESCALER=1
```

## boards/arm/nucleo_f303re/Kconfig.board
```kconfig
# NUCLEO-64 F303RE board configuration

# Copyright (c) 2020 Paul M. Bendixen
# SPDX-License-Identifier: Apache-2.0

config BOARD_NUCLEO_F303RE
	bool "NUCLEO-64 F303RE Development Board"
	depends on SOC_STM32F303XE
```

## boards/arm/nucleo_f303re/Kconfig.defconfig
```kconfig
# NUCLEO-64 F302R8 board configuration

# Copyright (c) 2020 Paul M. Bendixen
# SPDX-License-Identifier: Apache-2.0

if BOARD_NUCLEO_F303RE

config BOARD
	default "nucleo_f303re"

endif # BOARD_NUCLEO_F303RE
```

## boards/arm/nucleo_f303re/nucleo_f303re_defconfig
```kconfig
# SPDX-License-Identifier: Apache-2.0

CONFIG_SOC_SERIES_STM32F3X=y
CONFIG_SOC_STM32F303XE=y
# 72 MHz system clock
CONFIG_SYS_CLOCK_HW_CYCLES_PER_SEC=72000000

CONFIG_SERIAL=y

# Enable MPU
CONFIG_ARM_MPU=y

# console
CONFIG_CONSOLE=y
CONFIG_UART_CONSOLE=y

# enable pinmux
CONFIG_PINMUX=y

# enable GPIO
CONFIG_GPIO=y

# clock configuration
CONFIG_CLOCK_CONTROL=y

# Clock configuration for Cube Clock control driver
CONFIG_CLOCK_STM32_HSE_CLOCK=8000000
CONFIG_CLOCK_STM32_SYSCLK_SRC_PLL=y
# use HSE as PLL input
CONFIG_CLOCK_STM32_PLL_SRC_HSE=y
# however, the board does not have an external oscillator, so just use
# the 8MHz clock signal coming from integrated STLink
CONFIG_CLOCK_STM32_HSE_BYPASS=y
# produce 72MHz clock at PLL output
CONFIG_CLOCK_STM32_PLL_PREDIV1=1
CONFIG_CLOCK_STM32_PLL_MULTIPLIER=9
CONFIG_CLOCK_STM32_AHB_PRESCALER=1
CONFIG_CLOCK_STM32_APB1_PRESCALER=2
CONFIG_CLOCK_STM32_APB2_PRESCALER=1
```

## boards/arm/nucleo_f334r8/Kconfig.defconfig
```kconfig
# STM32 Nucleo-64 development board with STM32F334R8 MCU

# Copyright (c) 2016 RnDity Sp. z o.o.
# SPDX-License-Identifier: Apache-2.0

if BOARD_NUCLEO_F334R8

config BOARD
	default "nucleo_f334r8"

config SPI_STM32_INTERRUPT
	default y
	depends on SPI

endif # BOARD_NUCLEO_F334R8
```

## boards/arm/nucleo_f334r8/Kconfig.nucleo_f334r8
```kconfig
# Copyright (c) 2022 Zephyr Project members and individual contributors
# SPDX-License-Identifier: Apache-2.0

config BOARD_NUCLEO_F334R8
	bool
	default y
	select SOC_SERIES_STM32F3X
	select SOC_STM32F334X8
```

## boards/arm/nucleo_f334r8/nucleo_f334r8_defconfig
```kconfig
# Zephyr Kernel Configuration
CONFIG_ARM=y
CONFIG_ARCH="arm"
CONFIG_SOC="stm32f334x8"
CONFIG_SOC_SERIES="stm32f3"
CONFIG_SOC_FAMILY="st_stm32"
CONFIG_BOARD="nucleo_f334r8"
CONFIG_SOC_SERIES_STM32F3X=y

# Platform Configuration
CONFIG_SOC_FAMILY_STM32=y
CONFIG_SOC_STM32F334X8=y
CONFIG_BOARD_NUCLEO_F334R8=y

# General Kernel Options
CONFIG_CORTEX_M_SYSTICK=y
CONFIG_SYS_CLOCK_HW_CYCLES_PER_SEC=72000000

# Serial Drivers
CONFIG_SERIAL=y
CONFIG_SERIAL_HAS_DRIVER=y
CONFIG_UART_INTERRUPT_DRIVEN=y
CONFIG_UART_STM32=y
# enable USART2 - passthrough to STLINK v2 connector
CONFIG_UART_STM32_PORT_2=y
# enable console on this port by default
CONFIG_CONSOLE=y
CONFIG_UART_CONSOLE=y

# Pinmux Driver
CONFIG_PINMUX=y
CONFIG_PINMUX_STM32=y

# GPIO Controller
CONFIG_GPIO=y
CONFIG_GPIO_STM32=y
CONFIG_GPIO_STM32_PORTA=y
CONFIG_GPIO_STM32_PORTB=y
CONFIG_GPIO_STM32_PORTC=y

# Clock configuration
CONFIG_CLOCK_CONTROL=y
# SYSCLK selection
CONFIG_CLOCK_STM32_SYSCLK_SRC_PLL=y
# HSE configuration
CONFIG_CLOCK_STM32_HSE_CLOCK=8000000
# PLL configuration
CONFIG_CLOCK_STM32_PLL_SRC_HSE=y
# produce 72MHz clock at PLL output
CONFIG_CLOCK_STM32_PLL_PREDIV=1
CONFIG_CLOCK_STM32_PLL_MULTIPLIER=9
CONFIG_CLOCK_STM32_AHB_PRESCALER=1
CONFIG_CLOCK_STM32_APB1_PRESCALER=2
CONFIG_CLOCK_STM32_APB2_PRESCALER=1
```

## boards/arm/nucleo_f401re/Kconfig.board
```kconfig
# NUCLEO-64 F401RE Development Board

# Copyright (c) 2016 Linaro Limited.
# SPDX-License-Identifier: Apache-2.0

config BOARD_NUCLEO_F401RE
	def_bool "$(BOARD)" = "nucleo_f401re"
	select I2C_1 if I2C
	depends on SOC_STM32F401XE
```
