/*
 * Copyright (c) 2026 Process Mission
 * SPDX-License-Identifier: Apache-2.0
 */

/dts-v1/;

#include <arm64/rockchip/rk3588.dtsi>
#include "../common/rk3588_rock_5b_common.dtsi"

/ {
	compatible = "radxa,rock-5b-plus", "rockchip,rk3588";
	model = "Radxa ROCK 5B+";

	chosen {
		zephyr,pcie-controller = &pcie2x1l2;
	};
};

&its0 {
	status = "okay";
};

&pcie2x1l2 {
	status = "okay";
};
