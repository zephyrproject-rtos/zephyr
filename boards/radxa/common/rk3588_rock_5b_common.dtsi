/*
 * Copyright (c) 2026 Process Mission
 * SPDX-License-Identifier: Apache-2.0
 */

#include <common/mem.h>

/ {
	chosen {
		zephyr,console = &uart2;
		zephyr,shell-uart = &uart2;
		zephyr,sram = &dram;
	};

	dram: memory@10000000 {
		compatible = "mmio-sram";
		reg = <0x10000000 DT_SIZE_M(128)>;
		device_type = "memory";
	};
};

&uart2 {
	current-speed = <1500000>;
	status = "okay";
};
