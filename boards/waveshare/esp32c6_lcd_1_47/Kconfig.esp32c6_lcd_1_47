## boards/waveshare/esp32c6_lcd_1_47/Kconfig.esp32c6_lcd_1_47
```kconfig
# Copyright (c) 2026 Shankar Sridhar
# SPDX-License-Identifier: Apache-2.0

config BOARD_ESP32C6_LCD_1_47
	select SOC_ESP32_C6_WROOM_1U_N4
	select SOC_ESP32C6_HPCORE if BOARD_ESP32C6_LCD_1_47_ESP32C6_HPCORE
	select SOC_ESP32C6_LPCORE if BOARD_ESP32C6_LCD_1_47_ESP32C6_LPCORE
```

## boards/waveshare/esp32c6_lcd_1_47/board.yml
```yaml
board:
  name: esp32c6_lcd_1_47
  full_name: ESP32-C6 LCD 1.47"
  vendor: waveshare
  socs:
    - name: esp32c6
```

## boards/waveshare/esp32p4_eth/Kconfig.defconfig
```kconfig
# ESP32-P4-ETH board configuration

# SPDX-FileCopyrightText: Copyright (c) 2026 Espressif Systems (Shanghai) Co., Ltd.
# SPDX-License-Identifier: Apache-2.0

if BOARD_ESP32P4_ETH_ESP32P4_HPCORE

configdefault NET_L2_ETHERNET
	default y

endif # BOARD_ESP32P4_ETH_ESP32P4_HPCORE
```

## boards/waveshare/esp32p4_module_dev_kit/board.yml
```yaml
board:
  name: esp32p4_module_dev_kit
  full_name: ESP32-P4-Module-DEV-KIT
  vendor: waveshare
  socs:
  - name: esp32p4
```

## boards/waveshare/esp32p4_wifi6/Kconfig
```kconfig
# Copyright (c) 2026 Hongquan Li
# SPDX-License-Identifier: Apache-2.0

config HEAP_MEM_POOL_ADD_SIZE_BOARD
	int
	default 4096 if BOARD_ESP32P4_WIFI6_ESP32P4_HPCORE
	default 256 if BOARD_ESP32P4_WIFI6_ESP32P4_LPCORE
```

## boards/waveshare/esp32p4_wifi6/Kconfig.esp32p4_wifi6
```kconfig
# Copyright (c) 2026 Hongquan Li
# SPDX-License-Identifier: Apache-2.0

config BOARD_ESP32P4_WIFI6
	select SOC_ESP32P4_HPCORE if BOARD_ESP32P4_WIFI6_ESP32P4_HPCORE
	select SOC_ESP32P4_LPCORE if BOARD_ESP32P4_WIFI6_ESP32P4_LPCORE
	select SOC_ESP32P4_REV_1_3
```

## boards/waveshare/esp32p4_wifi6/board.yml
```yaml
board:
  name: esp32p4_wifi6
  full_name: ESP32-P4-WIFI6
  vendor: waveshare
  socs:
  - name: esp32p4
```

## boards/waveshare/esp32p4_wifi6/esp32p4_wifi6_esp32p4_hpcore_defconfig
```kconfig
# Copyright (c) 2026 Hongquan Li
# SPDX-License-Identifier: Apache-2.0

CONFIG_CONSOLE=y
CONFIG_SERIAL=y
CONFIG_UART_CONSOLE=y
CONFIG_GPIO=y
CONFIG_REGULATOR=y
```

## boards/waveshare/esp32p4_wifi6/esp32p4_wifi6_esp32p4_lpcore_defconfig
```kconfig
# Copyright (c) 2026 Hongquan Li
# SPDX-License-Identifier: Apache-2.0

CONFIG_THREAD_STACK_INFO=n
CONFIG_THREAD_CUSTOM_DATA=n
CONFIG_BOOT_BANNER=n
CONFIG_SERIAL=y
CONFIG_CONSOLE=y
CONFIG_UART_CONSOLE=y
CONFIG_PRINTK=n
CONFIG_CBPRINTF_NANO=y
CONFIG_SIZE_OPTIMIZATIONS=y
CONFIG_BUSYWAIT_CPU_LOOPS_PER_USEC=4
```

## boards/waveshare/esp32p4_wifi6_dev_kit/Kconfig
```kconfig
# Copyright (c) 2026 Process Mission
#
# SPDX-License-Identifier: Apache-2.0

config HEAP_MEM_POOL_ADD_SIZE_BOARD
	int
	default 4096 if BOARD_ESP32P4_WIFI6_DEV_KIT_ESP32P4_HPCORE
```

## boards/waveshare/esp32p4_wifi6_dev_kit/Kconfig.esp32p4_wifi6_dev_kit
```kconfig
# Waveshare ESP32-P4-WIFI6-Dev-Kit configuration
#
# Copyright (c) 2026 Process Mission
#
# SPDX-License-Identifier: Apache-2.0

config BOARD_ESP32P4_WIFI6_DEV_KIT
	select SOC_ESP32P4_HPCORE if BOARD_ESP32P4_WIFI6_DEV_KIT_ESP32P4_HPCORE
	select SOC_ESP32P4_LPCORE if BOARD_ESP32P4_WIFI6_DEV_KIT_ESP32P4_LPCORE
	select SOC_ESP32P4_REV_3_1
```

## boards/waveshare/esp32p4_wifi6_dev_kit/board.yml
```yaml
board:
  name: esp32p4_wifi6_dev_kit
  full_name: ESP32-P4-WIFI6-Dev-Kit
  vendor: waveshare
  socs:
  - name: esp32p4
```

## boards/waveshare/esp32p4_wifi6_dev_kit/esp32p4_wifi6_dev_kit_esp32p4_hpcore_defconfig
```kconfig
# Copyright (c) 2026 Process Mission
#
# SPDX-License-Identifier: Apache-2.0

CONFIG_CONSOLE=y
CONFIG_SERIAL=y
CONFIG_UART_CONSOLE=y
CONFIG_GPIO=y
CONFIG_REGULATOR=y
CONFIG_MAIN_STACK_SIZE=4096
```

## boards/waveshare/esp32s3_eth_8di_8ro/Kconfig
```kconfig
# Copyright (c) 2025 - 2026 Benjamin Schilling <benjamin.schilling33@gmail.com>
# SPDX-License-Identifier: Apache-2.0

config HEAP_MEM_POOL_ADD_SIZE_BOARD
	int
	default 4096 if BOARD_ESP32S3_ETH_8DI_8RO_ESP32S3_PROCPU
	default 256 if BOARD_ESP32S3_ETH_8DI_8RO_ESP32S3_APPCPU
```

## boards/waveshare/esp32s3_eth_8di_8ro/Kconfig.esp32s3_eth_8di_8ro
```kconfig
# Copyright (c) 2025 Benjamin Schilling <benjamin.schilling33@gmail.com>
# SPDX-License-Identifier: Apache-2.0

config BOARD_ESP32S3_ETH_8DI_8RO
	select SOC_ESP32S3_WROOM_N16R8
	select SOC_ESP32S3_PROCPU if BOARD_ESP32S3_ETH_8DI_8RO_ESP32S3_PROCPU || BOARD_ESP32S3_ETH_8DI_8RO_ESP32S3_PROCPU_C
	select SOC_ESP32S3_APPCPU if BOARD_ESP32S3_ETH_8DI_8RO_ESP32S3_APPCPU || BOARD_ESP32S3_ETH_8DI_8RO_ESP32S3_APPCPU_C
```

## boards/waveshare/esp32s3_eth_8di_8ro/Kconfig.sysbuild
```kconfig
# Copyright (c) 2025 Benjamin Schilling <benjamin.schilling33@gmail.com>
# SPDX-License-Identifier: Apache-2.0

choice BOOTLOADER
	default BOOTLOADER_MCUBOOT
endchoice

choice BOOT_SIGNATURE_TYPE
	default BOOT_SIGNATURE_TYPE_NONE
endchoice
```

## boards/waveshare/esp32s3_eth_8di_8ro/board.yml
```yaml
board:
  name: esp32s3_eth_8di_8ro
  full_name: ESP32-S3-ETH-8DI-8RO
  vendor: waveshare
  socs:
  - name: esp32s3
  revision:
    format: "custom"
    default: "rs485"
    exact: true
    revisions:
    - name: "rs485"
    - name: "can"
```

## boards/waveshare/esp32s3_geek/board.yml
```yaml
board:
  name: esp32s3_geek
  full_name: ESP32-S3-GEEK
  vendor: waveshare
  socs:
  - name: esp32s3
```

## boards/waveshare/esp32s3_industrial_controller/Kconfig
```kconfig
# Copyright (c) 2025 Benjamin Schilling <benjamin.schilling33@gmail.com>
# SPDX-License-Identifier: Apache-2.0

config HEAP_MEM_POOL_ADD_SIZE_BOARD
	int
	default 4096 if BOARD_ESP32S3_POE_ETH_8DI_8RO_ESP32S3_PROCPU
	default 256 if BOARD_ESP32S3_POE_ETH_8DI_8RO_ESP32S3_APPCPU
```

## boards/waveshare/esp32s3_industrial_controller/Kconfig.esp32s3_poe_eth_8di_8ro
```kconfig
# Copyright (c) 2025 Benjamin Schilling <benjamin.schilling33@gmail.com>
# SPDX-License-Identifier: Apache-2.0

config BOARD_ESP32S3_POE_ETH_8DI_8RO
	select SOC_ESP32S3_R2
	select SOC_ESP32S3_PROCPU if BOARD_ESP32S3_POE_ETH_8DI_8RO_ESP32S3_PROCPU
	select SOC_ESP32S3_APPCPU if BOARD_ESP32S3_POE_ETH_8DI_8RO_ESP32S3_APPCPU
```

## boards/waveshare/esp32s3_industrial_controller/board.yml
```yaml
board:
  name: esp32s3_poe_eth_8di_8ro
  full_name: ESP32-S3-POE-ETH-8DI-8RO
  vendor: waveshare
  socs:
  - name: esp32s3
```

## boards/waveshare/esp32s3_matrix/Kconfig
```kconfig
# Copyright (c) 2024 Joel Guittet
# Copyright (c) 2025 Chen Xingyu <hi@xingrz.me>
# SPDX-License-Identifier: Apache-2.0

config HEAP_MEM_POOL_ADD_SIZE_BOARD
	int
	default 4096 if BOARD_ESP32S3_MATRIX_ESP32S3_PROCPU
	default 256 if BOARD_ESP32S3_MATRIX_ESP32S3_APPCPU
```

## boards/waveshare/esp32s3_matrix/Kconfig.defconfig
```kconfig
# Copyright (c) 2024 Joel Guittet
# Copyright (c) 2025 Chen Xingyu <hi@xingrz.me>
# SPDX-License-Identifier: Apache-2.0

if BOARD_ESP32S3_MATRIX_ESP32S3_PROCPU

config KERNEL_MEM_POOL
	default y

endif # BOARD_ESP32S3_MATRIX_ESP32S3_PROCPU
```

## boards/waveshare/esp32s3_matrix/Kconfig.esp32s3_matrix
```kconfig
# Copyright (c) 2024 Joel Guittet
# Copyright (c) 2025 Chen Xingyu <hi@xingrz.me>
# SPDX-License-Identifier: Apache-2.0

config BOARD_ESP32S3_MATRIX
	select SOC_ESP32S3_R2
	select SOC_ESP32S3_PROCPU if BOARD_ESP32S3_MATRIX_ESP32S3_PROCPU
	select SOC_ESP32S3_APPCPU if BOARD_ESP32S3_MATRIX_ESP32S3_APPCPU
```

## boards/waveshare/esp32s3_matrix/board.yml
```yaml
board:
  name: esp32s3_matrix
  full_name: ESP32-S3-Matrix
  vendor: waveshare
  socs:
  - name: esp32s3
```
