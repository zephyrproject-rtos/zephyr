/*
 * Copyright (c) 2024 Joel Guittet
 * Copyright (c) 2025 Chen Xingyu <hi@xingrz.me>
 * Copyright (c) 2025 marrowbuster <info@marrowbuster.com>
 * SPDX-License-Identifier: Apache-2.0
 */

/dts-v1/;
#include <espressif/esp32s3/esp32s3_fh4r2.dtsi>
#include <espressif/partitions_0x0_amp_4M.dtsi>

/ {
    model = "ESP32-S3-Zero APPCPU";
    compatible = "waveshare,esp32-s3-zero";

    chosen {
		zephyr,sram = &sram1;
		zephyr,ipc_shm = &shm0;
		zephyr,ipc = &ipm0;
		zephyr,flash = &flash0;
		zephyr,code-partition = &slot0_appcpu_partition;
	};
};

&trng0 {
	status = "okay";
};