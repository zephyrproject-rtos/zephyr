## boards/waveshare/esp32s3_audio/Kconfig.esp32s3_audio
```kconfig
# SPDX-FileCopyrightText: Copyright The Zephyr Project Contributors
# SPDX-License-Identifier: Apache-2.0

config BOARD_ESP32S3_AUDIO
	select SOC_ESP32S3
	select SOC_ESP32S3_PROCPU if BOARD_ESP32S3_AUDIO_ESP32S3_PROCPU
	select SOC_ESP32S3_APPCPU if BOARD_ESP32S3_AUDIO_ESP32S3_APPCPU
```

## boards/waveshare/esp32s3_audio/board.yml
```yaml
# SPDX-FileCopyrightText: Copyright The Zephyr Project Contributors
# SPDX-License-Identifier: Apache-2.0

board:
  name: esp32s3_audio
  full_name: ESP32-S3-AUDIO-Board
  vendor: waveshare
  socs:
    - name: esp32s3
```

## boards/waveshare/esp32s3_geek/Kconfig.defconfig
```kconfig
# Copyright (c) 2025 Chen Xingyu <hi@xingrz.me>
# SPDX-License-Identifier: Apache-2.0

if BOARD_ESP32S3_GEEK

if DISPLAY

if LVGL

choice LV_COLOR_FORMAT_DEFAULT
	default LV_COLOR_FORMAT_RGB565
endchoice

config LV_COLOR_16_SWAP
	default y

endif # LVGL

endif # DISPLAY

endif # BOARD_ESP32S3_GEEK
```

## boards/waveshare/esp32s3_touch_lcd_1_47/board.yml
```yaml
board:
  name: esp32s3_touch_lcd_1_47
  full_name: ESP32-S3-Touch-LCD-1.47
  vendor: waveshare
  socs:
  - name: esp32s3
```

## boards/waveshare/esp32s3_touch_lcd_2_8/Kconfig.defconfig
```kconfig
# Copyright (c) 2024 Dylan Rowe <dylanthomasrowe@gmail.com>
# SPDX-License-Identifier: Apache-2.0

if BOARD_ESP32S3_TOUCH_LCD_2_8_ESP32S3_PROCPU

config WIFI
	default n

config DISPLAY
	default y

config SENSOR
	default y

config RTC
	default y

config I2C
	default y

config SPI
	default y

config INPUT
	default y

endif # BOARD_ESP32S3_TOUCH_LCD_2_8_ESP32S3_PROCPU
```

## boards/waveshare/esp32s3_touch_lcd_2_8/Kconfig.esp32s3_touch_lcd_2_8
```kconfig
# Copyright (c) 2024 Dylan Rowe <dylanthomasrowe@gmail.com>
# SPDX-License-Identifier: Apache-2.0

config BOARD_ESP32S3_TOUCH_LCD_2_8
	select SOC_ESP32S3_WROOM_N16R8
	select SOC_ESP32S3_PROCPU if BOARD_ESP32S3_TOUCH_LCD_2_8_ESP32S3_PROCPU
	select SOC_ESP32S3_APPCPU if BOARD_ESP32S3_TOUCH_LCD_2_8_ESP32S3_APPCPU
```

## boards/waveshare/esp32s3_touch_lcd_2_8/board.yml
```yaml
board:
  name: esp32s3_touch_lcd_2_8
  full_name: Waveshare ESP32-S3-Touch-LCD-2.8
  vendor: waveshare
  socs:
  - name: esp32s3
```

## boards/waveshare/esp32s3_touch_lcd_2_8b/Kconfig.esp32s3_touch_lcd_2_8b
```kconfig
# SPDX-FileCopyrightText: Copyright The Zephyr Project Contributors
# SPDX-License-Identifier: Apache-2.0

config BOARD_ESP32S3_TOUCH_LCD_2_8B
	select SOC_ESP32S3
	select SOC_ESP32S3_PROCPU if BOARD_ESP32S3_TOUCH_LCD_2_8B_ESP32S3_PROCPU
	select SOC_ESP32S3_APPCPU if BOARD_ESP32S3_TOUCH_LCD_2_8B_ESP32S3_APPCPU
```

## boards/waveshare/esp32s3_touch_lcd_2_8b/board.yml
```yaml
board:
  name: esp32s3_touch_lcd_2_8b
  full_name: ESP32-S3-Touch-LCD-2.8B
  vendor: waveshare
  socs:
  - name: esp32s3
```

## boards/waveshare/esp32s3_touch_lcd_4_v4/Kconfig
```kconfig
# Copyright (c) 2026 Kim Bøndergaard
# SPDX-License-Identifier: Apache-2.0

config HEAP_MEM_POOL_ADD_SIZE_BOARD
	int
	default 4096 if BOARD_ESP32S3_TOUCH_LCD_4_V4_ESP32S3_PROCPU
	default 256 if BOARD_ESP32S3_TOUCH_LCD_4_V4_ESP32S3_APPCPU
```

## boards/waveshare/esp32s3_touch_lcd_4_v4/Kconfig.esp32s3_touch_lcd_4_v4
```kconfig
# Copyright (c) 2026 Kim Bøndergaard
# SPDX-License-Identifier: Apache-2.0

config BOARD_ESP32S3_TOUCH_LCD_4_V4
	select SOC_ESP32S3
	select SOC_ESP32S3_PROCPU if BOARD_ESP32S3_TOUCH_LCD_4_V4_ESP32S3_PROCPU
	select SOC_ESP32S3_APPCPU if BOARD_ESP32S3_TOUCH_LCD_4_V4_ESP32S3_APPCPU
```

## boards/waveshare/esp32s3_touch_lcd_4_v4/board.yml
```yaml
board:
  name: esp32s3_touch_lcd_4_v4
  full_name: ESP32-S3-Touch-LCD-4-V4
  vendor: waveshare
  socs:
  - name: esp32s3
```

## boards/waveshare/esp32s3_touch_lcd_4_v4/esp32s3_touch_lcd_4_v4_esp32s3_appcpu_defconfig
```kconfig
# Copyright (c) 2026 Kim Bøndergaard
# SPDX-License-Identifier: Apache-2.0

CONFIG_CLOCK_CONTROL=y
```

## boards/waveshare/esp32s3_touch_lcd_4_v4/esp32s3_touch_lcd_4_v4_esp32s3_procpu_defconfig
```kconfig
# Copyright (c) 2026 Kim Bøndergaard
# SPDX-License-Identifier: Apache-2.0

CONFIG_I2C=y
CONFIG_I2C_BUS_RECOVERY=y
CONFIG_GPIO=y
CONFIG_PWM=y
CONFIG_ADC=y
CONFIG_BUZZER=y
CONFIG_REGULATOR=y
CONFIG_CONSOLE=y
CONFIG_SERIAL=y
CONFIG_UART_CONSOLE=y
CONFIG_CLOCK_CONTROL=y
CONFIG_DISPLAY=y
CONFIG_DMA=y
CONFIG_DMA_ESP32_MAX_DESCRIPTOR_NUM=128
CONFIG_INPUT=y
CONFIG_SPIRAM_MODE_OCT=y
CONFIG_SPIRAM_SPEED_80M=y
CONFIG_ESP_SPIRAM=y
CONFIG_SHARED_MULTI_HEAP=y
CONFIG_ESP_SPIRAM_HEAP_SIZE=1048576
CONFIG_ESP32S3_DATA_CACHE_LINE_64B=y
```

## boards/waveshare/rp2350b_plus_w/Kconfig
```kconfig
# SPDX-FileCopyrightText: Copyright (c) 2026 Matheus de Alencar
# SPDX-License-Identifier: Apache-2.0

config HEAP_MEM_POOL_ADD_SIZE_BOARD
	int
	default 16384
```

## boards/waveshare/rp2350b_plus_w/Kconfig.defconfig
```kconfig
# SPDX-FileCopyrightText: Copyright (c) 2026 MASSDRIVER EI (massdriver.space)
# SPDX-FileCopyrightText: Copyright (c) 2026 Matheus de Alencar
# SPDX-License-Identifier: Apache-2.0

if BOARD_RP2350B_PLUS_W

config USB_SELF_POWERED
	default n

config MAIN_STACK_SIZE
	default 4096

if WIFI_AIROC

choice AIROC_PART
	default CYW43439
endchoice

config WHD_DISABLE_SDIO_PULLUP_DURING_SPI_SLEEP
	default y

endif # WIFI_AIROC

endif # BOARD_RP2350B_PLUS_W
```

## boards/waveshare/rp2350b_plus_w/Kconfig.rp2350b_plus_w
```kconfig
# SPDX-FileCopyrightText: Copyright (c) 2026 Matheus de Alencar
# SPDX-License-Identifier: Apache-2.0

config BOARD_RP2350B_PLUS_W
	select SOC_RP2350B_HAZARD3 if BOARD_RP2350B_PLUS_W_RP2350B_HAZARD3
	select SOC_RP2350B_M33 if BOARD_RP2350B_PLUS_W_RP2350B_M33
```

## boards/waveshare/rp2350b_plus_w/board.yml
```yaml
board:
  name: rp2350b_plus_w
  full_name: Waveshare RP2350B Plus W
  vendor: waveshare
  socs:
    - name: rp2350b
```

## boards/wch/ch32v307v_evt_r1/Kconfig.defconfig
```kconfig
# Copyright (c) 2026 James Bennion-Pedley
# SPDX-License-Identifier: Apache-2.0

if BOARD_CH32V307V_EVT_R1

configdefault ETH_DRIVER
	default y

endif # BOARD_CH32V307V_EVT_R1
```

## boards/we/ophelia5dk/Kconfig.ophelia5dk
```kconfig
# Copyright (c) 2025 Nordic Semiconductor ASA
# SPDX-License-Identifier: Apache-2.0

config BOARD_OPHELIA5DK
	select SOC_NRF54LM20A_CPUAPP if BOARD_OPHELIA5DK_NRF54LM20A_CPUAPP || \
		BOARD_OPHELIA5DK_NRF54LM20A_CPUAPP_NS
	select SOC_NRF54LM20A_CPUFLPR if BOARD_OPHELIA5DK_NRF54LM20A_CPUFLPR
```
