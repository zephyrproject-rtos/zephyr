## boards/waveshare/esp32s3_matrix/esp32s3_matrix_esp32s3_appcpu_defconfig
```kconfig
# Copyright (c) 2024 Joel Guittet
# SPDX-License-Identifier: Apache-2.0

CONFIG_CLOCK_CONTROL=y
```

## boards/waveshare/esp32s3_matrix/esp32s3_matrix_esp32s3_procpu_defconfig
```kconfig
# Copyright (c) 2024 Joel Guittet
# Copyright (c) 2025 Chen Xingyu <hi@xingrz.me>
# SPDX-License-Identifier: Apache-2.0

CONFIG_GPIO=y
CONFIG_CONSOLE=y
CONFIG_SERIAL=y
CONFIG_UART_CONSOLE=y
CONFIG_CLOCK_CONTROL=y
```

## boards/waveshare/esp32s3_rlcd_4_2/Kconfig
```kconfig
# SPDX-FileCopyrightText: Copyright The Zephyr Project Contributors
# SPDX-License-Identifier: Apache-2.0

config HEAP_MEM_POOL_ADD_SIZE_BOARD
	int
	default 4096 if BOARD_ESP32S3_RLCD_4_2_ESP32S3_PROCPU
	default 256 if BOARD_ESP32S3_RLCD_4_2_ESP32S3_APPCPU
```

## boards/waveshare/esp32s3_rlcd_4_2/Kconfig.defconfig
```kconfig
# SPDX-FileCopyrightText: Copyright The Zephyr Project Contributors
# SPDX-License-Identifier: Apache-2.0

if BOARD_ESP32S3_RLCD_4_2_ESP32S3_PROCPU

if LVGL

config LV_Z_BITS_PER_PIXEL
	default 1

choice LV_COLOR_DEPTH
	default LV_COLOR_DEPTH_1
endchoice

config LV_Z_AREA_X_ALIGNMENT_WIDTH
	default 12

config LV_Z_AREA_Y_ALIGNMENT_WIDTH
	default 2

endif # LVGL

if FUEL_GAUGE

# Composite fuel gauge gets battery voltage from ADC-based voltage-divider sensor

config ADC
	default y

config SENSOR
	default y

endif # FUEL_GAUGE

endif # BOARD_ESP32S3_RLCD_4_2_ESP32S3_PROCPU
```

## boards/waveshare/esp32s3_rlcd_4_2/Kconfig.esp32s3_rlcd_4_2
```kconfig
# SPDX-FileCopyrightText: Copyright The Zephyr Project Contributors
# SPDX-License-Identifier: Apache-2.0

config BOARD_ESP32S3_RLCD_4_2
	select SOC_ESP32S3_WROOM_N16R8
	select SOC_ESP32S3_PROCPU if BOARD_ESP32S3_RLCD_4_2_ESP32S3_PROCPU
	select SOC_ESP32S3_APPCPU if BOARD_ESP32S3_RLCD_4_2_ESP32S3_APPCPU
```

## boards/waveshare/esp32s3_rlcd_4_2/board.yml
```yaml
board:
  name: esp32s3_rlcd_4_2
  full_name: ESP32-S3-RLCD-4.2
  vendor: waveshare
  socs:
  - name: esp32s3
```

## boards/waveshare/esp32s3_rlcd_4_2/esp32s3_rlcd_4_2_esp32s3_procpu_defconfig
```kconfig
# SPDX-FileCopyrightText: Copyright The Zephyr Project Contributors
# SPDX-License-Identifier: Apache-2.0

CONFIG_GPIO=y
CONFIG_CONSOLE=y
CONFIG_SERIAL=y
CONFIG_UART_CONSOLE=y
CONFIG_CLOCK_CONTROL=y
CONFIG_ADC=y
CONFIG_INPUT=y
CONFIG_ESP_SPIRAM=y
CONFIG_SPIRAM_MODE_OCT=y
```

## boards/waveshare/esp32s3_touch_lcd_1_28/Kconfig
```kconfig
# Copyright (c) 2024 Joel Guittet
# SPDX-License-Identifier: Apache-2.0

config HEAP_MEM_POOL_ADD_SIZE_BOARD
	int
	default 4096 if BOARD_ESP32S3_TOUCH_LCD_1_28_ESP32S3_PROCPU
	default 256 if BOARD_ESP32S3_TOUCH_LCD_1_28_ESP32S3_APPCPU
```

## boards/waveshare/esp32s3_touch_lcd_1_28/Kconfig.defconfig
```kconfig
# Copyright (c) 2024 Joel Guittet
# SPDX-License-Identifier: Apache-2.0

if BOARD_ESP32S3_TOUCH_LCD_1_28_ESP32S3_PROCPU

config ENTROPY_GENERATOR
	default y

config KERNEL_MEM_POOL
	default y

config PWM
	default y if DISPLAY

configdefault LV_COLOR_16_SWAP
	default y if LVGL

endif # BOARD_ESP32S3_TOUCH_LCD_1_28_ESP32S3_PROCPU
```

## boards/waveshare/esp32s3_touch_lcd_1_28/Kconfig.esp32s3_touch_lcd_1_28
```kconfig
# Copyright (c) 2024 Joel Guittet
# SPDX-License-Identifier: Apache-2.0

config BOARD_ESP32S3_TOUCH_LCD_1_28
	select SOC_ESP32S3_R2
```

## boards/waveshare/esp32s3_touch_lcd_1_28/board.yml
```yaml
board:
  name: esp32s3_touch_lcd_1_28
  full_name: ESP32-S3-Touch-LCD-1.28
  vendor: waveshare
  socs:
  - name: esp32s3
```

## boards/waveshare/esp32s3_touch_lcd_1_28/esp32s3_touch_lcd_1_28_esp32s3_appcpu_defconfig
```kconfig
# Copyright (c) 2024 Joel Guittet
# SPDX-License-Identifier: Apache-2.0

CONFIG_MAIN_STACK_SIZE=2048
CONFIG_CLOCK_CONTROL=y
CONFIG_MINIMAL_LIBC=y
```

## boards/waveshare/esp32s3_touch_lcd_1_28/esp32s3_touch_lcd_1_28_esp32s3_procpu_defconfig
```kconfig
# Copyright (c) 2024 Joel Guittet
# SPDX-License-Identifier: Apache-2.0

CONFIG_GPIO=y
CONFIG_REGULATOR=y
CONFIG_CONSOLE=y
CONFIG_SERIAL=y
CONFIG_UART_CONSOLE=y
CONFIG_CLOCK_CONTROL=y
CONFIG_INPUT=y
CONFIG_INPUT_CST816S_INTERRUPT=n
```

## boards/waveshare/esp32s3_zero/Kconfig.esp32s3_zero
```kconfig
# Copyright (c) 2024 Joel Guittet
# Copyright (c) 2025 Chen Xingyu <hi@xingrz.me>
# Copyright (c) 2025 marrowbuster <info@marrowbuster.com>
# SPDX-License-Identifier: Apache-2.0

config BOARD_ESP32S3_ZERO
	select SOC_ESP32S3_FH4R2
	select SOC_ESP32S3_PROCPU if BOARD_ESP32S3_ZERO_ESP32S3_PROCPU
	select SOC_ESP32S3_APPCPU if BOARD_ESP32S3_ZERO_ESP32S3_APPCPU
```

## boards/waveshare/esp32s3_zero/board.yml
```yaml
board:
  name: esp32s3_zero
  full_name: ESP32-S3-Zero
  vendor: waveshare
  socs:
  - name: esp32s3
```

## boards/waveshare/esp32s3_zero/esp32s3_zero_esp32s3_appcpu_defconfig
```kconfig
# Copyright (c) 2024 Joel Guittet
# Copyright (c) 2025 marrowbuster <info@marrowbuster.com>
# SPDX-License-Identifier: Apache-2.0

CONFIG_CLOCK_CONTROL=y
```

## boards/waveshare/esp32s3_zero/esp32s3_zero_esp32s3_procpu_defconfig
```kconfig
# Copyright (c) 2024 Joel Guittet
# Copyright (c) 2025 Chen Xingyu <hi@xingrz.me>
# Copyright (c) 2025 marrowbuster <info@marrowbuster.com>
# SPDX-License-Identifier: Apache-2.0

CONFIG_GPIO=y
CONFIG_CONSOLE=y
CONFIG_SERIAL=y
CONFIG_UART_CONSOLE=y
CONFIG_CLOCK_CONTROL=y
```

## boards/waveshare/nrf51_ble400/Kconfig.nrf51_ble400
```kconfig
# nRF51 BLE400 board configuration

# Copyright (c) 2018 Roman Tataurov <diytronic@yandex.ru>
# SPDX-License-Identifier: Apache-2.0

config BOARD_NRF51_BLE400
	select SOC_NRF51822_QFAC
```

## boards/waveshare/nrf51_ble400/board.yml
```yaml
board:
  name: nrf51_ble400
  full_name: BLE400
  vendor: waveshare
  socs:
  - name: nrf51822
```

## boards/waveshare/open103z/Kconfig.waveshare_open103z
```kconfig
# Copyright (c) 2020 Stefano Manni
# SPDX-License-Identifier: Apache-2.0

config BOARD_WAVESHARE_OPEN103Z
	select SOC_STM32F103XE
```

## boards/waveshare/open103z/board.yml
```yaml
board:
  name: waveshare_open103z
  full_name: Open103Z
  vendor: waveshare
  socs:
    - name: stm32f103xe
```

## boards/waveshare/port407z/Kconfig.waveshare_port407z
```kconfig
# Copyright (c) 2025 Yongci
# SPDX-License-Identifier: Apache-2.0

config BOARD_WAVESHARE_PORT407Z
	select SOC_STM32F407XG
```

## boards/waveshare/port407z/board.yml
```yaml
board:
  name: waveshare_port407z
  full_name: Waveshare Port407Z
  vendor: waveshare
  socs:
    - name: stm32f407xx
```

## boards/waveshare/rp2040_geek/board.yml
```yaml
board:
  name: rp2040_geek
  full_name: RP2040-GEEK
  vendor: waveshare
  socs:
  - name: rp2040
```
