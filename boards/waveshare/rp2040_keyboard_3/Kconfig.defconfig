## boards/waveshare/rp2040_keyboard_3/Kconfig.defconfig
```kconfig
# Copyright (c) 2022 Peter Johanson
# SPDX-License-Identifier: Apache-2.0

if BOARD_RP2040_KEYBOARD_3

if I2C_DW

config I2C_DW_CLOCK_SPEED
	default 125

endif # I2C_DW

config USB_SELF_POWERED
	default n

source "boards/common/usb/Kconfig.cdc_acm_serial.defconfig"

endif # BOARD_RP2040_KEYBOARD_3
```

## boards/waveshare/rp2040_keyboard_3/Kconfig.rp2040_keyboard_3
```kconfig
# Copyright (c) 2025 Jonas Berg
# SPDX-License-Identifier: Apache-2.0

config BOARD_RP2040_KEYBOARD_3
	select SOC_RP2040
```

## boards/waveshare/rp2040_keyboard_3/board.yml
```yaml
board:
  name: rp2040_keyboard_3
  full_name: RP2040-Keyboard-3
  vendor: waveshare
  socs:
  - name: rp2040
```

## boards/waveshare/rp2040_matrix/Kconfig
```kconfig
# Copyright (c) 2025 Jonas Berg
# SPDX-License-Identifier: Apache-2.0

config BOARD_RP2040_MATRIX
	select RP2_FLASH_W25Q080
```

## boards/waveshare/rp2040_matrix/Kconfig.defconfig
```kconfig
# Copyright (c) 2022 Peter Johanson
# SPDX-License-Identifier: Apache-2.0

if BOARD_RP2040_MATRIX

if I2C_DW

config I2C_DW_CLOCK_SPEED
	default 125

endif # I2C_DW

config USB_SELF_POWERED
	default n

endif # BOARD_RP2040_MATRIX
```

## boards/waveshare/rp2040_matrix/Kconfig.rp2040_matrix
```kconfig
# Copyright (c) 2025 Jonas Berg
# SPDX-License-Identifier: Apache-2.0

config BOARD_RP2040_MATRIX
	select SOC_RP2040
```

## boards/waveshare/rp2040_matrix/board.yml
```yaml
board:
  name: rp2040_matrix
  full_name: RP2040-Matrix
  vendor: waveshare
  socs:
  - name: rp2040
```

## boards/waveshare/rp2040_plus/Kconfig
```kconfig
# Copyright (c) 2025 David Schneider
# SPDX-License-Identifier: Apache-2.0

config BOARD_RP2040_PLUS
	select RP2_FLASH_W25Q080
```

## boards/waveshare/rp2040_plus/Kconfig.defconfig
```kconfig
# Copyright (c) 2025 David Schneider
# SPDX-License-Identifier: Apache-2.0

if BOARD_RP2040_PLUS

if I2C_DW

config I2C_DW_CLOCK_SPEED
	default 125

endif # I2C_DW

endif # BOARD_RP2040_PLUS
```

## boards/waveshare/rp2040_plus/board.yml
```yaml
board:
  name: rp2040_plus
  full_name: RP2040-Plus
  vendor: waveshare
  socs:
  - name: rp2040
```

## boards/waveshare/rp2040_zero/Kconfig
```kconfig
# Copyright (c) 2024 Iacopo Moles
# SPDX-License-Identifier: Apache-2.0

config BOARD_RP2040_ZERO
	select RP2_FLASH_W25Q080
```

## boards/waveshare/rp2040_zero/Kconfig.defconfig
```kconfig
# Copyright (c) 2024 Iacopo Moles
# SPDX-License-Identifier: Apache-2.0

if BOARD_RP2040_ZERO

if I2C_DW

config I2C_DW_CLOCK_SPEED
	default 125

endif # I2C_DW

endif # BOARD_RP2040_ZERO
```

## boards/waveshare/rp2040_zero/Kconfig.rp2040_zero
```kconfig
# Copyright (c) 2024 Iacopo Moles
# SPDX-License-Identifier: Apache-2.0

config BOARD_RP2040_ZERO
	select SOC_RP2040
```

## boards/waveshare/rp2040_zero/board.yml
```yaml
board:
  name: rp2040_zero
  full_name: RP2040-Zero
  vendor: waveshare
  socs:
  - name: rp2040
```

## boards/waveshare/rp2350_zero/Kconfig.rp2350_zero
```kconfig
# Copyright (c) 2025 Stephano Cetola
# SPDX-License-Identifier: Apache-2.0

config BOARD_RP2350_ZERO
	select SOC_RP2350A_HAZARD3 if BOARD_RP2350_ZERO_RP2350A_HAZARD3
	select SOC_RP2350A_M33 if BOARD_RP2350_ZERO_RP2350A_M33
```

## boards/waveshare/rp2350_zero/board.yml
```yaml
board:
  name: rp2350_zero
  full_name: RP2350-Zero
  vendor: waveshare
  socs:
  - name: rp2350a
```

## boards/waveshare/waveshare_open103z/board.yml
```yaml
board:
  name: waveshare_open103z
  vendor: waveshare
  socs:
    - name: stm32f103xe
```

## boards/wch/ch32h417evt/Kconfig.ch32h417evt
```kconfig
# Copyright (c) 2026 Liu Changjie
# SPDX-License-Identifier: Apache-2.0

config BOARD_CH32H417EVT
	select SOC_CH32H417_V3F if BOARD_CH32H417EVT_CH32H417_V3F
	select SOC_CH32H417_V5F if BOARD_CH32H417EVT_CH32H417_V5F
```

## boards/wch/ch32h417evt/Kconfig.defconfig
```kconfig
# Copyright (c) 2026 Liu Changjie
# SPDX-License-Identifier: Apache-2.0

if BOARD_CH32H417EVT_CH32H417_V3F

configdefault MAIN_STACK_SIZE
	default 512

configdefault IDLE_STACK_SIZE
	default 256

configdefault ISR_STACK_SIZE
	default 512

endif # BOARD_CH32H417EVT_CH32H417_V3F
```

## boards/wch/ch32h417evt/board.yml
```yaml
board:
  name: ch32h417evt
  full_name: WCH CH32H417EVT
  vendor: wch
  socs:
    - name: ch32h417
```

## boards/wch/ch32h417evt/ch32h417evt_ch32h417_v3f_defconfig
```kconfig
# Copyright (c) 2026 Liu Changjie
# SPDX-License-Identifier: Apache-2.0

CONFIG_BOOT_BANNER=n
CONFIG_CLOCK_CONTROL=n
CONFIG_CONSOLE=n
CONFIG_PRINTK=n
CONFIG_SERIAL=n
CONFIG_SIZE_OPTIMIZATIONS=y

CONFIG_RV_BOOT_HART=0
```

## boards/wch/ch32h417evt/ch32h417evt_ch32h417_v5f_defconfig
```kconfig
# Copyright (c) 2026 Liu Changjie
# SPDX-License-Identifier: Apache-2.0

CONFIG_GPIO=y

CONFIG_SERIAL=y
CONFIG_CONSOLE=y
CONFIG_UART_CONSOLE=y

CONFIG_RV_BOOT_HART=1
```

## boards/wch/ch32l103evt/Kconfig.ch32l103evt
```kconfig
# Copyright (c) 2025 Paul Wedeck
# SPDX-License-Identifier: Apache-2.0

config BOARD_CH32L103EVT
	select SOC_CH32L103
```

## boards/wch/ch32l103evt/board.yml
```yaml
board:
  name: ch32l103evt
  full_name: WCH CH32L103C8T6-R0-1v2
  vendor: wch
  socs:
    - name: ch32l103
```

## boards/wch/ch32v003evt/Kconfig.ch32v003evt
```kconfig
# Copyright (c) 2024 Michael Hope
# SPDX-License-Identifier: Apache-2.0

config BOARD_CH32V003EVT
	select SOC_CH32V003
```
