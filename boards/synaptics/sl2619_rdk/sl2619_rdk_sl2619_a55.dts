/*
 * Copyright (c) 2026 Synaptics Incorporated
 * Author: Jisheng Zhang <jszhang@kernel.org>
 *
 * SPDX-License-Identifier: Apache-2.0
 */

/dts-v1/;

#include "synaptics/sl2619_a55.dtsi"

/ {
	model = "Synaptics SL2619 RDK A55";
	compatible = "syna,sl2619-rdk";

	chosen {
		zephyr,console = &uart0;
		zephyr,shell-uart = &uart0;
		zephyr,sram = &dram;
	};

	dram: memory@1000000 {
		compatible = "zephyr,memory-region", "mmio-sram";
		reg = <0x1000000 DT_SIZE_M(1)>;
		zephyr,memory-region = "DRAM";
	};
};

&uart0 {
	status = "okay";
	current-speed = <115200>;
};
