## boards/atmosic/atm34evk/Kconfig.defconfig
```kconfig
# Copyright (c) 2021-2023 Atmosic
#
# SPDX-License-Identifier: Apache-2.0

if (SOC_ATM34XX_2 || SOC_ATM34XX_5)

if BT

config HEAP_MEM_POOL_SIZE
	default 32768

config ENTROPY_GENERATOR
	default y

config BT_HCI_ACL_FLOW_CONTROL
	default n

endif # BT

if SERIAL

config UART_INTERRUPT_DRIVEN
	default y

endif # SERIAL

if BATTERY_UPD

choice BATTERY_TYPE
	prompt "Battery type"
	default BATTERY_TYPE_COIN

config BATTERY_TYPE_COIN
	bool "Battery is coin"

config BATTERY_TYPE_HSC_LIION
	bool "Battery is hsc liion"
endchoice

endif # BATTERY_UPD

endif # SOC_ATM34XX_2 || SOC_ATM34XX_5
```

## boards/atmosic/atm34evk/board.yml
```yaml
boards:
- name: ATMEVK-3405-PQK-2
  vendor: atmosic
  revision:
    format: custom
    default: normal
    revisions:
    - name: mcuboot
    - name: normal
  socs:
    - name: ATM34xx-2
      variants:
      - name: 'ns'

- name: ATMEVK-3405-PQK-5
  vendor: atmosic
  revision:
    format: custom
    default: normal
    revisions:
    - name: mcuboot
    - name: normal
  socs:
    - name: ATM34xx-5
      variants:
      - name: 'ns'

- name: ATMEVK-3425-PQK-2
  vendor: atmosic
  revision:
    format: custom
    default: normal
    revisions:
    - name: mcuboot
    - name: normal
  socs:
    - name: ATM34xx-2
      variants:
      - name: 'ns'

- name: ATMEVK-3425-YQK-5
  vendor: atmosic
  revision:
    format: custom
    default: normal
    revisions:
    - name: mcuboot
    - name: normal
  socs:
    - name: ATM34xx-5
      variants:
      - name: 'ns'

- name: ATMEVK-3430e-WQN-2
  vendor: atmosic
  revision:
    format: custom
    default: normal
    revisions:
    - name: mcuboot
    - name: normal
  socs:
    - name: ATM34xx-2
      variants:
      - name: 'ns'

- name: ATMEVK-3430e-YQN-5
  vendor: atmosic
  revision:
    format: custom
    default: normal
    revisions:
    - name: mcuboot
    - name: normal
  socs:
    - name: ATM34xx-5
      variants:
      - name: 'ns'

- name: ATMEVK-3405-YBV-5
  vendor: atmosic
  revision:
    format: custom
    default: normal
    revisions:
    - name: mcuboot
    - name: normal
  socs:
    - name: ATM34xx-5
      variants:
      - name: 'ns'
```

## boards/atmosic/atmevk-02/ATMEVK-M3221-02_defconfig
```kconfig
# Copyright (c) 2021 Atmosic
#
# SPDX-License-Identifier: Apache-2.0

CONFIG_CORTEX_M_SYSTICK=y
CONFIG_RUNTIME_NMI=y

# enable uart driver
CONFIG_SERIAL=y

# enable console
CONFIG_CONSOLE=y
CONFIG_UART_CONSOLE=y

# GPIOs
CONFIG_GPIO=y

# Watchdog
CONFIG_WATCHDOG=y
```

## boards/atmosic/atmevk-02/Kconfig.ATMEVK-M2202-02
```kconfig
# Copyright (c) 2021-2024 Atmosic
# SPDX-License-Identifier: Apache-2.0

config BOARD_ATMEVK_M2202_02
	select SOC_ATMX2XX_X1X
```

## boards/atmosic/atmevk-02/Kconfig.ATMEVK-M3221-02
```kconfig
# Copyright (c) 2021-2024 Atmosic
# SPDX-License-Identifier: Apache-2.0

config BOARD_ATMEVK_M3221_02
	select SOC_ATMX2XX_X1X
```

## boards/atmosic/atmevk-02/Kconfig.defconfig
```kconfig
# Copyright (c) 2021-2024 Atmosic
#
# SPDX-License-Identifier: Apache-2.0

if SOC_ATMX2XX_X1X

if BT

config BT_HCI_ACL_FLOW_CONTROL
	default n

config BT_AUTO_PHY_UPDATE
	default n
	# To avoid procedure collision.

config ENTROPY_GENERATOR
	default y

endif # BT

if SERIAL

config UART_INTERRUPT_DRIVEN
	default y

endif # SERIAL

if BATTERY_UPD

choice BATTERY_TYPE
	prompt "Battery type"
	default BATTERY_TYPE_COIN

config BATTERY_TYPE_COIN
	bool "Battery is coin"
endchoice

endif # BATTERY_UPD

endif # SOC_ATMX2XX_X1X
```

## boards/atmosic/atmevk-02/board.yml
```yaml
boards:
- name: ATMEVK-M2201-02
  vendor: atmosic
  socs:
    - name: ATMx2xx-x1x

- name: ATMEVK-M3201-02
  vendor: atmosic
  socs:
    - name: ATMx2xx-x1x

- name: ATMEVK-M2202-02
  vendor: atmosic
  socs:
    - name: ATMx2xx-x1x

- name: ATMEVK-M3202-02
  vendor: atmosic
  socs:
    - name: ATMx2xx-x1x

- name: ATMEVK-M2221-02
  vendor: atmosic
  socs:
    - name: ATMx2xx-x1x

- name: ATMEVK-M3221-02
  vendor: atmosic
  socs:
    - name: ATMx2xx-x1x

- name: ATMEVK-M2251-02
  vendor: atmosic
  socs:
    - name: ATMx2xx-x1x

- name: ATMEVK-M3231-02
  vendor: atmosic
  socs:
    - name: ATMx2xx-x1x
```

## boards/avnet/zub1cg_r5/Kconfig.defconfig
```kconfig
# Copyright The Zephyr Project Contributors
# SPDX-License-Identifier: Apache-2.0

if BOARD_ZUB1CG_R5

config BUILD_OUTPUT_BIN
	default y

if USERSPACE

config COMPILER_ISA_THUMB2
	default n

endif

endif # BOARD_ZUB1CG_R5
```

## boards/avnet/zub1cg_r5/Kconfig.zub1cg_r5
```kconfig
# Copyright The Zephyr Project Contributors
# SPDX-License-Identifier: Apache-2.0

config BOARD_ZUB1CG_R5
	select SOC_XILINX_ZYNQMP_RPU
```

## boards/avnet/zub1cg_r5/board.yml
```yaml
board:
  name: zub1cg_r5
  full_name: ZUBoard 1CG Development Board RPU Cortex-R5
  vendor: avnet
  socs:
  - name: zynqmp_rpu
```

## boards/avnet/zub1cg_r5/zub1cg_r5_defconfig
```kconfig
CONFIG_XIP=n

CONFIG_SERIAL=y

CONFIG_GPIO=y

CONFIG_CONSOLE=y
CONFIG_UART_CONSOLE=y

CONFIG_UART_XLNX_PS=y

CONFIG_ARM_MPU=y

CONFIG_ROMSTART_RELOCATION_ROM=y
```

## boards/bananapi/bpi_f3/Kconfig.bpi_f3
```kconfig
# Copyright (c) 2025 Junhui Liu <junhui@pigmoral.tech>
# SPDX-License-Identifier: Apache-2.0

config BOARD_BPI_F3
	select SOC_K1_N308
```

## boards/bananapi/bpi_f3/board.yml
```yaml
board:
  name: bpi_f3
  full_name: BPI-F3
  vendor: bananapi
  socs:
    - name: k1
```

## boards/bananapi/bpi_f3/bpi_f3_k1_n308_defconfig
```kconfig
# Copyright (c) 2025 Junhui Liu <junhui.liu@pigmoral.tech>
# SPDX-License-Identifier: Apache-2.0

CONFIG_XIP=n

# enable uart driver
CONFIG_SERIAL=y
CONFIG_UART_INTERRUPT_DRIVEN=y

# uart console
CONFIG_CONSOLE=y
CONFIG_UART_CONSOLE=y
```

## boards/barth/stg_800/Kconfig.stg_800
```kconfig
# Copyright (c) 2026 Jonas Berg
# SPDX-License-Identifier: Apache-2.0

config BOARD_STG_800
	select SOC_STM32F091XC
```

## boards/barth/stg_800/board.yml
```yaml
board:
  name: stg_800
  full_name: STG-800 lococube mini-PLC
  vendor: barth
  socs:
    - name: stm32f091xc
```

## boards/basic_atom/Kconfig
```kconfig
if BOARD_BASIC_ATOM

config BOARD
        default basic_atom

endif # BOARD_BASIC_ATOM
```

## boards/basic_atom/Kconfig.board
```kconfig
config  BOARD_BASIC_ATOM
        bool "Basic Atom Board"
        select PLATFORM_IA32
	depends on X86
```

## boards/basic_cortex_m3/Kconfig
```kconfig
if BOARD_BASIC_CORTEX_M3

config BOARD
        default basic_cortex_m3

endif # BOARD_BASIC_CORTEX_M3
```

## boards/basic_cortex_m3/Kconfig.board
```kconfig
config BOARD_BASIC_CORTEX_M3
	bool "Basic Cortex-M3 Board"
	depends on SOC_TI_LM3S6965
```

## boards/basic_cortex_m3/basic_cortex_m3_defconfig
```kconfig
CONFIG_ARM=y
CONFIG_BOARD_BASIC_CORTEX_M3=y
CONFIG_PLATFORM_TI_LM3S6965=y
CONFIG_SYS_CLOCK_HW_CYCLES_PER_SEC=12000000
CONFIG_CONSOLE=y
CONFIG_UART_CONSOLE=y
CONFIG_SERIAL=y
CONFIG_CORTEX_M_SYSTICK=y
CONFIG_FLASH_SIZE=256
CONFIG_SRAM_SIZE=64
CONFIG_UART_STELLARIS=y
```

## boards/basic_minuteia/Kconfig.board
```kconfig
config  BOARD_BASIC_MINUTEIA
        bool "Basic Minute-IA Board"
        depends on SOC_IA32
```

## boards/basic_minuteia/Kconfig.defconfig
```kconfig
if BOARD_BASIC_MINUTEIA

config BOARD
        default basic_minuteia

endif # BOARD_BASIC_MINUTEIA
```

## boards/bbc/bbc_microbit_v2/Kconfig.bbc_microbit_v2
```kconfig
# nRF52 BBC_MICROBIT_V2 board configuration

# Copyright (c) 2020 Lingao Meng
# SPDX-License-Identifier: Apache-2.0

config BOARD_BBC_MICROBIT_V2
	bool
	default y
	select SOC_NRF52833_QIAA
```
