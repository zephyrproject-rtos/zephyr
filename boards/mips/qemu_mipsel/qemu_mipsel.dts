/*
 * Copyright (c) MIPS LLC.
 *
 * SPDX-License-Identifier: Apache-2.0
 */

/dts-v1/;
#include <creator/cxt200.dtsi>

/ {
	model = "qemu mipsel";
	compatible = "mips,interaptiv";

	chosen {
		zephyr,sram = &sram0;
		zephyr,flash = &flash0;
	};
};
