## boards/mips/ci40/Kconfig.defconfig
```kconfig
# Kconfig - CI40 board configuration
#
# SPDX-License-Identifier: Apache-2.0
#

if BOARD_CI40

config BOARD
	default ci40

endif # BOARD_CI40
```

## boards/mips/ci40/ci40_defconfig
```kconfig
CONFIG_MIPS=y
CONFIG_BOARD_CI40=y
CONFIG_SOC_FAMILY_MIPS=y
CONFIG_SOC_DANUBE=y
CONFIG_MIPS_CORE_TIMER=y
# 550MHz system clock
CONFIG_SYS_CLOCK_HW_CYCLES_PER_SEC=550000000

# enable uart driver
CONFIG_SERIAL=y
CONFIG_UART_MIPS=y
# enable USART1 - USB serial
CONFIG_UART_MIPS_PORT_1=y
# enable console on this port by default
CONFIG_CONSOLE=y
CONFIG_UART_CONSOLE=y
CONFIG_UART_CONSOLE_ON_DEV_NAME="UART_1"
```

## boards/mips/linkit_smart_7688/Kconfig.board
```kconfig
#
# SPDX-License-Identifier: Apache-2.0
#

config BOARD_LINKIT_SMART_7688
	bool "MediaTek LinkIt Smart 7688"
	depends on SOC_MT76X8
```

## boards/mips/linkit_smart_7688/Kconfig.defconfig
```kconfig
#
# SPDX-License-Identifier: Apache-2.0
#

if BOARD_LINKIT_SMART_7688

config BOARD
	default "linkit_smart_7688"

endif # BOARD_LINKIT_SMART_7688
```

## boards/mips/linkit_smart_7688/linkit_smart_7688_defconfig
```kconfig
CONFIG_MIPS=y
CONFIG_SOC_MT76X8=y
CONFIG_BOARD_LINKIT_SMART_7688=y
CONFIG_MIPS_CP0_TIMER=y
CONFIG_CONSOLE=y
CONFIG_UART_CONSOLE=y
CONFIG_SERIAL=y
CONFIG_UART_NS16550=y
```

## boards/mips/qemu_malta/Kconfig.board
```kconfig
#
# Copyright (c) 2020 Antony Pavlov <antonynpavlov@gmail.com>
#
# SPDX-License-Identifier: Apache-2.0
#

config BOARD_QEMU_MALTA
	bool "QEMU emulation for little endian MIPS Malta"
	depends on SOC_QEMU_MALTA
	select QEMU_TARGET

config BOARD_QEMU_MALTA_BE
	bool "QEMU emulation for big endian MIPS Malta"
	depends on SOC_QEMU_MALTA
	select QEMU_TARGET
	select BIG_ENDIAN
```

## boards/mips/qemu_malta/Kconfig.defconfig
```kconfig
#
# Copyright (c) 2020 Antony Pavlov <antonynpavlov@gmail.com>
#
# SPDX-License-Identifier: Apache-2.0
#

config BUILD_OUTPUT_BIN
	default n
```

## boards/mips/qemu_malta/Kconfig.qemu_malta
```kconfig
# Copyright (c) 2022 Zephyr Project members and individual contributors
# SPDX-License-Identifier: Apache-2.0

config BOARD_QEMU_MALTA
	bool
	default y
	select SOC_QEMU_MALTA
	select QEMU_TARGET
	select BIG_ENDIAN
```

## boards/mips/qemu_malta/Kconfig.qemu_malta_be
```kconfig
# Copyright (c) 2022 Zephyr Project members and individual contributors
# SPDX-License-Identifier: Apache-2.0

config BOARD_QEMU_MALTA_BE
	bool
	default y
	select SOC_QEMU_MALTA
	select QEMU_TARGET
```

## boards/mips/qemu_malta/qemu_malta_be_defconfig
```kconfig
CONFIG_SOC_QEMU_MALTA=y
CONFIG_BOARD_QEMU_MALTA_BE=y
CONFIG_MIPS_CP0_TIMER=y
CONFIG_CONSOLE=y
CONFIG_UART_CONSOLE=y
CONFIG_SERIAL=y
CONFIG_QEMU_ICOUNT=y
CONFIG_QEMU_ICOUNT_SHIFT=3
```

## boards/mips/qemu_malta/qemu_malta_defconfig
```kconfig
CONFIG_SOC_QEMU_MALTA=y
CONFIG_BOARD_QEMU_MALTA=y
CONFIG_MIPS_CP0_TIMER=y
CONFIG_CONSOLE=y
CONFIG_UART_CONSOLE=y
CONFIG_SERIAL=y
CONFIG_UART_NS16550=y
CONFIG_QEMU_ICOUNT=y
CONFIG_QEMU_ICOUNT_SHIFT=3
```

## boards/mips/qemu_mipsel/Kconfig.board
```kconfig
# Kconfig - CI40 board configuration
#
# SPDX-License-Identifier: Apache-2.0
#

config BOARD_QEMU_MIPSEL
	bool "QEMU emulation for little endian MIPS"
	depends on SOC_DANUBE
	select HAS_DTS
```

## boards/mips/qemu_mipsel/Kconfig.defconfig
```kconfig
# Kconfig - QEMU MIPSEL board configuration
#
# SPDX-License-Identifier: Apache-2.0
#

if BOARD_QEMU_MIPSEL

config BOARD
	default qemu_mipsel

endif # BOARD_QEMU_MIPSEL
```

## boards/mips/qemu_mipsel/qemu_mipsel_defconfig
```kconfig
CONFIG_MIPS=y
CONFIG_BOARD_QEMU_MIPSEL=y
CONFIG_SOC_FAMILY_MIPS=y
CONFIG_SOC_DANUBE=y
CONFIG_MIPS_CORE_TIMER=y
CONFIG_SYS_CLOCK_TICKS_PER_SEC=100
CONFIG_SYS_CLOCK_HW_CYCLES_PER_SEC=200000000
```

## boards/muselab/nano_ch32v317/Kconfig.defconfig
```kconfig
# Copyright (c) 2026 James Bennion-Pedley
# SPDX-License-Identifier: Apache-2.0

if BOARD_NANO_CH32V317

configdefault NET_L2_ETHERNET
	default y

endif # BOARD_NANO_CH32V317
```

## boards/muselab/nano_ch32v317/Kconfig.nano_ch32v317
```kconfig
# Copyright (c) 2026 James Bennion-Pedley
# SPDX-License-Identifier: Apache-2.0

config BOARD_NANO_CH32V317
	select SOC_CH32V317
```

## boards/muselab/nano_ch32v317/board.yml
```yaml
board:
  name: nano_ch32v317
  full_name: MuseLab nanoCH32V317
  vendor: muselab
  socs:
    - name: ch32v317
      variants:
        - name: ram_64k
        - name: ram_96k
        - name: ram_128k
        - name: ram_192k
```

## boards/muselab/nano_ch57x/Kconfig.nano_ch57x
```kconfig
# SPDX-FileCopyrightText: 2026 SMILE (smile.eu)
# SPDX-License-Identifier: Apache-2.0

config BOARD_NANO_CH57X
	select SOC_CH570 if BOARD_NANO_CH57X_CH570
	select SOC_CH572 if BOARD_NANO_CH57X_CH572
```

## boards/muselab/nano_ch57x/board.yml
```yaml
board:
  name: nano_ch57x
  full_name: MuseLab nanoCH57x
  vendor: muselab
  socs:
    - name: ch570
    - name: ch572
```

## boards/muselab/nano_ch57x/nano_ch57x_ch572_defconfig
```kconfig
# SPDX-FileCopyrightText: 2026 SMILE (smile.eu)
# SPDX-License-Identifier: Apache-2.0

CONFIG_SERIAL=y
CONFIG_CONSOLE=y
CONFIG_UART_CONSOLE=y
```

## boards/mxchip/az3166_iotdevkit/Kconfig.az3166_iotdevkit
```kconfig
# Copyright (c) 2023 Benjamin Cabé <benjamin@zephyrproject.org>
# SPDX-License-Identifier: Apache-2.0

config BOARD_AZ3166_IOTDEVKIT
	select SOC_STM32F412RX
```

## boards/mxchip/az3166_iotdevkit/board.yml
```yaml
board:
  name: az3166_iotdevkit
  full_name: AZ3166 MXChip IoT DevKit
  vendor: mxchip
  socs:
    - name: stm32f412rx
```

## boards/native/common/extra_args/Kconfig
```kconfig
# Copyright (c) 2024 Nordic Semiconductor ASA
# SPDX-License-Identifier: Apache-2.0

config NATIVE_EXTRA_CMDLINE_ARGS
	depends on ARCH_POSIX
	string "Extra command line arguments"
	help
	  Extra command line options/arguments which will be handled like if they were passed to the
	  program from the shell. These will be parsed just before the shell provided ones.
```

## boards/native/common/sdl/Kconfig
```kconfig
# Copyright (c) 2018 Jan Van Winkel <jan.van_winkel@dxplore.eu>
# Copyright (c) 2022 Basalte bv
# Copyright (c) 2023 Nordic Semiconductor ASA
# SPDX-License-Identifier: Apache-2.0

config HAS_SDL
	depends on ARCH_POSIX
	bool
	help
	  This option specifies that the target board has SDL support

config SDL_THREAD_INTERVAL
	int "SDL thread sleep interval"
	default 10
	depends on HAS_SDL
	help
	  Sleep interval time of SDL thread to handle events in milliseconds.

config SDL_THREAD_PRIORITY
	int "SDL thread priority"
	default 0
	depends on HAS_SDL
	help
	  Priority of SDL thread to handle events.
```

## boards/native/native_posix/Kconfig
```kconfig
# Copyright (c) 2017 Oticon A/S
# SPDX-License-Identifier: Apache-2.0

config BOARD_NATIVE_POSIX
	bool
	imply NATIVE_POSIX_TIMER
	select POSIX_ARCH_CONSOLE
	select NATIVE_APPLICATION
	select 64BIT if BOARD_NATIVE_POSIX_NATIVE_64
	help
	  Native POSIX
	  Will produce a console Linux process which can be executed natively.
	  It provides some minimal needed models:
	  An interrupt controller, timer (system tick), and redirects kernel prints to
	  stdout.

if BOARD_NATIVE_POSIX

comment "Native POSIX options"

config NATIVE_POSIX_SLOWDOWN_TO_REAL_TIME
	bool "Slow down execution to real time"
	default n if ARCH_POSIX_LIBFUZZER
	default y if BT_USERCHAN || !TEST
	help
	  When selected the execution of the process will be slowed down to real time.
	  (if there is a lot of load it may be slower than real time)
	  If deselected, the process will run as fast as possible.
	  Note that this only decouples simulated time from real/wall time. In either
	  case the zephyr kernel and application cannot tell the difference unless they
	  interact with some other driver/device which runs at real time.

source "boards/native/common/sdl/Kconfig"

endif # BOARD_NATIVE_POSIX
```
