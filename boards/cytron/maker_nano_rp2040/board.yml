## boards/cytron/maker_nano_rp2040/board.yml
```yaml
board:
  name: maker_nano_rp2040
  full_name: Cytron Maker Nano RP2040
  vendor: cytron
  socs:
  - name: rp2040
```

## boards/cytron/maker_pi_rp2040/board.yml
```yaml
board:
  name: maker_pi_rp2040
  full_name: Cytron Maker Pi RP2040
  vendor: cytron
  socs:
  - name: rp2040
```

## boards/cytron/maker_uno_rp2040/board.yml
```yaml
board:
  name: maker_uno_rp2040
  full_name: Cytron Maker Uno RP2040
  vendor: cytron
  socs:
  - name: rp2040
```

## boards/cytron/motion_2350_pro/Kconfig.defconfig
```kconfig
# Copyright (c) 2025 Stephano Cetola
# SPDX-License-Identifier: Apache-2.0

if BOARD_MOTION_2350_PRO

config USB_SELF_POWERED
	default n

endif # BOARD_MOTION_2350_PRO
```

## boards/cytron/motion_2350_pro/board.yml
```yaml
board:
  name: motion_2350_pro
  full_name: Motion 2350 Pro
  vendor: cytron
  socs:
  - name: rp2350a
```

## boards/dfrobot/beetle_esp32c3/board.yml
```yaml
board:
  name: beetle_esp32c3
  full_name: DFRobot Beetle ESP32-C3
  vendor: dfrobot
  revision:
    format: major.minor.patch
    default: "2.0.0"
    revisions:
      - name: "1.0.0"
      - name: "2.0.0"
  socs:
    - name: esp32c3
```

## boards/dfrobot/beetle_rp2040/Kconfig.beetle_rp2040
```kconfig
# Copyright (c) 2025 Jonas Berg
# SPDX-License-Identifier: Apache-2.0

config BOARD_BEETLE_RP2040
	select SOC_RP2040
```

## boards/dfrobot/beetle_rp2040/board.yml
```yaml
board:
  name: beetle_rp2040
  full_name: DFRobot Beetle RP2040
  vendor: dfrobot
  socs:
  - name: rp2040
```

## boards/dfrobot/beetle_rp2350/Kconfig.beetle_rp2350
```kconfig
# Copyright (c) 2026 Jonas Berg
# SPDX-License-Identifier: Apache-2.0

config BOARD_BEETLE_RP2350
	select SOC_RP2350A_HAZARD3 if BOARD_BEETLE_RP2350_RP2350A_HAZARD3
	select SOC_RP2350A_M33 if BOARD_BEETLE_RP2350_RP2350A_M33
```

## boards/dfrobot/beetle_rp2350/Kconfig.defconfig
```kconfig
# Copyright (c) 2025 Stephano Cetola
# SPDX-License-Identifier: Apache-2.0

if BOARD_BEETLE_RP2350

config USB_SELF_POWERED
	default n

endif # BOARD_BEETLE_RP2350
```

## boards/dfrobot/beetle_rp2350/board.yml
```yaml
board:
  name: beetle_rp2350
  full_name: Beetle RP2350
  vendor: dfrobot
  socs:
  - name: rp2350a
```

## boards/digidrip/micromod9151/Kconfig.micromod9151
```kconfig
# MicroMod nRF9151 board configuration

# Copyright (c) 2026 Christian Hirsch
# SPDX-License-Identifier: Apache-2.0

config BOARD_MICROMOD9151
	select SOC_NRF9151_LACA
```

## boards/digidrip/micromod9151/board.yml
```yaml
board:
  name: micromod9151
  vendor: digidrip
  socs:
  - name: nrf9151
    variants:
    - name: 'ns'
```

## boards/digidrip/micromod9151/micromod9151_nrf9151_ns_defconfig
```kconfig
# SPDX-License-Identifier: Apache-2.0

# Enable MPU
CONFIG_ARM_MPU=y

# Enable hardware stack protection
CONFIG_HW_STACK_PROTECTION=y

# Enable TrustZone-M
CONFIG_ARM_TRUSTZONE_M=y

# This board implies building Non-Secure firmware
CONFIG_TRUSTED_EXECUTION_NONSECURE=y

# Enable SPI
CONFIG_SPI=y

# Enable GPIO
CONFIG_GPIO=y
CONFIG_GPIO_MCP23SXX=y

# Enable UART driver
CONFIG_SERIAL=y

# Enable console
CONFIG_CONSOLE=y
CONFIG_UART_CONSOLE=y

# Set GNSS Modem Antenna Config
CONFIG_MODEM_ANTENNA=y
CONFIG_MODEM_ANTENNA_GNSS_ONBOARD=n
CONFIG_MODEM_ANTENNA_AT_MAGPIO=""
CONFIG_MODEM_ANTENNA_AT_COEX0="AT\%XCOEX0=1,1,1565,1586"
```

## boards/digilent/arty_a7/Kconfig
```kconfig
# Copyright The Zephyr Project Contributors
# SPDX-License-Identifier: Apache-2.0

config BOARD_ARTY_A7
	select BOARD_LATE_INIT_HOOK if "$(dt_nodelabel_enabled,daplink_qspi_mux)"
```

## boards/digilent/arty_a7/Kconfig.arty_a7
```kconfig
# Digilent Arty board configuration

# Copyright (c) 2020 Henrik Brix Andersen <henrik@brixandersen.dk>
# SPDX-License-Identifier: Apache-2.0

config BOARD_ARTY_A7
	select SOC_DESIGNSTART_FPGA_CORTEX_M1 if BOARD_ARTY_A7_DESIGNSTART_FPGA_CORTEX_M1
	select SOC_DESIGNSTART_FPGA_CORTEX_M3 if BOARD_ARTY_A7_DESIGNSTART_FPGA_CORTEX_M3
```

## boards/digilent/arty_a7/Kconfig.defconfig
```kconfig
# Digilent Arty board configuration

# Copyright (c) 2020 Henrik Brix Andersen <henrik@brixandersen.dk>
# SPDX-License-Identifier: Apache-2.0

if BOARD_ARTY_A7_DESIGNSTART_FPGA_CORTEX_M1 || BOARD_ARTY_A7_DESIGNSTART_FPGA_CORTEX_M3

config CPU_CORTEX_M_HAS_SYSTICK
	default y

config CPU_HAS_ARM_MPU
	default y if BOARD_ARTY_A7_DESIGNSTART_FPGA_CORTEX_M3

config NUM_IRQS
	default 7

config GPIO
	default y if "$(dt_nodelabel_enabled,daplink_qspi_mux)"

endif # BOARD_ARTY_A7_DESIGNSTART_FPGA_CORTEX_M1 || BOARD_ARTY_A7_DESIGNSTART_FPGA_CORTEX_M3
```

## boards/digilent/arty_a7/arty_a7_designstart_fpga_cortex_m1_defconfig
```kconfig
# SPDX-License-Identifier: Apache-2.0

CONFIG_SYS_CLOCK_HW_CYCLES_PER_SEC=100000000

CONFIG_SERIAL=y
CONFIG_UART_INTERRUPT_DRIVEN=y
CONFIG_CONSOLE=y
CONFIG_UART_CONSOLE=y
```

## boards/digilent/arty_a7/board.yml
```yaml
board:
  name: arty_a7
  full_name: Arty
  vendor: digilent
  socs:
  - name: designstart_fpga_cortex_m1
  - name: designstart_fpga_cortex_m3
```

## boards/digilent/arty_a7/dts/bindings/arm,daplink-qspi-mux.yaml
```yaml
# Copyright (c) 2020 Henrik Brix Andersen <henrik@brixandersen.dk>
# SPDX-License-Identifier: Apache-2.0

description: ARM DesignStart FPGA DAPLink QSPI bus multiplexer

compatible: "arm,daplink-qspi-mux"

include: base.yaml

properties:
  interrupts:
    required: true
    description: |
      IRQ line connected to the level-detect non-interrupt DAPLink shield
      fitted signal

  mux-gpios:
    type: phandle-array
    required: true
    description: |
      GPIO for controlling the DAPLink QSPI bus multiplexer
```

## boards/digilent/zedboard/Kconfig
```kconfig
# Copyright (c) 2026 Analog Devices, Inc.
# SPDX-License-Identifier: Apache-2.0

config BOARD_ZEDBOARD
	select PINCTRL if UART_XLNX_PS
```

## boards/digilent/zedboard/Kconfig.defconfig
```kconfig
# Copyright (c) 2026 Analog Devices, Inc.
# SPDX-License-Identifier: Apache-2.0

if BOARD_ZEDBOARD

config UART_XLNX_PS
	default y

config SYS_CLOCK_HW_CYCLES_PER_SEC
	default $(dt_nodelabel_int_prop,arch_timer,clock-frequency)

endif
```

## boards/digilent/zedboard/Kconfig.zedboard
```kconfig
# Avnet ZedBoard configuration

# Copyright (c) 2026 Analog Devices, Inc.
# SPDX-License-Identifier: Apache-2.0

config BOARD_ZEDBOARD
	select SOC_XC7Z020
```

## boards/digilent/zedboard/board.yml
```yaml
board:
  name: zedboard
  full_name: ZedBoard
  vendor: digilent
  socs:
  - name: xc7z020
```

## boards/digilent/zybo/board.yml
```yaml
board:
  name: zybo
  full_name: Zybo
  vendor: digilent
  socs:
  - name: xc7z010
```
