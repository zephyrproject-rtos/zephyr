## boards/posix/native_sim/Kconfig
```kconfig
# Copyright (c) 2023 Nordic Semiconductor ASA
# SPDX-License-Identifier: Apache-2.0

config BOARD_NATIVE_SIM
	bool "Native simulator (Single Core)"
	select POSIX_ARCH_CONSOLE
	select NATIVE_LIBRARY
	select NATIVE_POSIX_TIMER
	depends on SOC_POSIX
	imply BOARD_NATIVE_POSIX if NATIVE_SIM_NATIVE_POSIX_COMPAT

if BOARD_NATIVE_SIM

comment "Native Simular (Single Core) options"

config NATIVE_SIM_NATIVE_POSIX_COMPAT
	bool "Pretend to be a native_posix board"
	default y
	help
	  When this option is set the native_sim board will pretend to be
	  a native_posix board from kconfig point of view, to allow using it directly with
	  code which was meant for the native_posix board and checks for the macro
	  CONFIG_BOARD_NATIVE_POSIX, or requires other kconfig options which depend on it.

config NATIVE_SIM_SLOWDOWN_TO_REAL_TIME
	bool "Slow down execution to real time"
	default n if ARCH_POSIX_LIBFUZZER
	default y if BT_USERCHAN || !TEST
	help
	  When selected the execution of the process will be slowed down to real time.
	  (if there is a lot of load it may be slower than real time)
	  If deselected, the process will run as fast as possible.
	  Note that this only decouples simulated time from real/wall time. In either
	  case the zephyr kernel and application cannot tell the difference unless they
	  interact with some other driver/device which runs at real time.

# This option definition exists only to enable NATIVE_SIM_NATIVE_POSIX_COMPAT
config BOARD_NATIVE_POSIX
	bool

config NATIVE_POSIX_SLOWDOWN_TO_REAL_TIME
	bool "Slow down execution to real time (native_posix compat)"
	select NATIVE_SIM_SLOWDOWN_TO_REAL_TIME
	help
	  Transitional option which allows applications which targeted native_posix
	  to set the correct native_sim option (CONFIG_NATIVE_SIM_SLOWDOWN_TO_REAL_TIME)

source "boards/$(ARCH)/common/sdl/Kconfig"

endif # BOARD_NATIVE_SIM
```

## boards/posix/native_sim/Kconfig.defconfig
```kconfig
# Copyright (c) 2023 Nordic Semiconductor ASA
# SPDX-License-Identifier: Apache-2.0

if BOARD_NATIVE_SIM

config BUILD_OUTPUT_BIN
	default n

config BUILD_OUTPUT_EXE
	default y

config OUTPUT_PRINT_MEMORY_USAGE
	default n

config BOARD
	default "native_sim_64" if BOARD_NATIVE_SIM_64BIT
	default "native_sim"

if NETWORKING

config NET_L2_ETHERNET
	default y if !NET_LOOPBACK && !NET_TEST

config ETH_NATIVE_POSIX
	default y if NET_L2_ETHERNET && ETH_DRIVER

endif # NETWORKING

choice BT_HCI_BUS_TYPE
	default BT_USERCHAN
	depends on BT_HCI
endchoice

if LOG

# For native_sim we can log synchronously without any problem
# Doing so will be nicer for debugging
choice LOG_MODE
	default LOG_MODE_IMMEDIATE
endchoice

endif # LOG

if CONSOLE

config POSIX_ARCH_CONSOLE
	default y if !SERIAL

config UART_CONSOLE
	default y if SERIAL

endif # CONSOLE

config FLASH_SIMULATOR
	default y
	depends on FLASH

config USB_NATIVE_POSIX
	default y
	depends on USB_DEVICE_DRIVER

config EEPROM_SIMULATOR
	default y
	depends on EEPROM

if I2C

config EMUL
	default y

endif # I2C

endif # BOARD_NATIVE_SIM
```

## boards/posix/native_sim/Kconfig.sysbuild
```kconfig
# Copyright (c) 2023 Nordic Semiconductor
#
# SPDX-License-Identifier: Apache-2.0

source "arch/posix/Kconfig.sysbuild"
```

## boards/posix/nrf52_bsim/Kconfig
```kconfig
# SPDX-License-Identifier: Apache-2.0

if BOARD_NRF52_BSIM

# The following file is normally parsed only for the ARM architecture, which is
# used by Nordic SoCs, so to make the symbols defined in this file available for
# the simulated nrf52_bsim board, which uses the POSIX architecture, the file
# must be read also from here.
source "soc/arm/nordic_nrf/Kconfig.peripherals"

endif # BOARD_NRF52_BSIM


# This would eventually be shared by a possible family of simulated NRF boards
# which use BabbleSim. When that happens, we can move this to a common
# Kconfig file

config SOC_SERIES_BSIM_NRFXX
	bool
	depends on SOC_POSIX
	help
	  Any NRF simulated SOC with BabbleSim, based on the POSIX arch

config SOC_SERIES_BSIM_NRF52X
	bool
	depends on SOC_SERIES_BSIM_NRFXX
	help
	  Any NRF52 simulated SOC with BabbleSim, based on the POSIX arch
```

## boards/posix/nrf52_bsim/Kconfig.board
```kconfig
# SPDX-License-Identifier: Apache-2.0

config BOARD_NRF52_BSIM
	bool "NRF52 simulation model"
	select SOC_SERIES_BSIM_NRFXX
	select SOC_SERIES_BSIM_NRF52X
	select SOC_COMPATIBLE_NRF
	select SOC_COMPATIBLE_NRF52X
	select SOC_COMPATIBLE_NRF52833
	select NRF_RTC_TIMER
	select CLOCK_CONTROL
	select HAS_NRFX
	select HAS_NORDIC_DRIVERS
	help
	  Will produce a console Linux process which can be executed natively.
	  It needs the BabbleSim simulator both in compile time and to execute
```

## boards/posix/nrf52_bsim/Kconfig.defconfig
```kconfig
# SPDX-License-Identifier: Apache-2.0

if BOARD_NRF52_BSIM

config BUILD_OUTPUT_BIN
	default n

config BUILD_OUTPUT_EXE
	default y

config OUTPUT_PRINT_MEMORY_USAGE
	default n

config BOARD
	default "nrf52_bsim"

config SYS_CLOCK_HW_CYCLES_PER_SEC
	default 32768

config SYS_CLOCK_TICKS_PER_SEC
	default 128 if !TICKLESS_KERNEL
	default 32768

config BT_CTLR
	default y
	depends on BT

# The 15.4 driver Tx encryption is currently not functional with this
# simulated board => we disable it by default. With this Openthread will normally
# default to encrypt packets on its own.
config NRF_802154_ENCRYPTION
	default n

if LOG

# For this board we can log synchronously without any problem
# Doing so will be nicer for debugging
choice LOG_MODE
	default LOG_MODE_IMMEDIATE
endchoice

endif # LOG

endif # BOARD_NRF52_BSIM
```

## boards/posix/nrf52_bsim/Kconfig.nrf52_bsim
```kconfig
# Copyright (c) 2022 Zephyr Project members and individual contributors
# SPDX-License-Identifier: Apache-2.0

config BOARD_NRF52_BSIM
	bool
	default y
	select SOC_POSIX
	select SOC_SERIES_BSIM_NRFXX
	select SOC_SERIES_BSIM_NRF52X
	select SOC_COMPATIBLE_NRF
	select SOC_COMPATIBLE_NRF52X
	select SOC_COMPATIBLE_NRF52832
	select CONSOLE_HAS_DRIVER
	select NRF_RTC_TIMER
	select CLOCK_CONTROL
	select HAS_NRFX
```

## boards/posix/nrf52_bsim/nrf52_bsim_defconfig
```kconfig
# SPDX-License-Identifier: Apache-2.0

CONFIG_SOC_POSIX=y
CONFIG_BOARD_NRF52_BSIM=y
CONFIG_CONSOLE=y
CONFIG_NO_OPTIMIZATIONS=y
CONFIG_SYS_CLOCK_HW_CYCLES_PER_SEC=32768
# For this board we can log immediately without any problem
# Doing so will be nicer for debugging
CONFIG_LOG_MODE_IMMEDIATE=y
```

## boards/posix/nrf_bsim/Kconfig
```kconfig
# SPDX-License-Identifier: Apache-2.0

if SOC_SERIES_BSIM_NRFXX

# The following file is normally parsed only for the ARM architecture, which is
# used by Nordic SoCs, so to make the symbols defined in this file available for
# the simulated nrf5x_bsim boards, which use the POSIX architecture, the file
# must be read also from here.
source "soc/arm/nordic_nrf/Kconfig.peripherals"

source "boards/$(ARCH)/common/extra_args/Kconfig"

endif # SOC_SERIES_BSIM_NRFXX


# This would eventually be shared by a possible family of simulated NRF boards
# which use BabbleSim. When that happens, we can move this to a common
# Kconfig file

config SOC_SERIES_BSIM_NRFXX
	bool
	select NATIVE_LIBRARY
	select SOC_COMPATIBLE_NRF
	select HAS_NRFX
	select HAS_NORDIC_DRIVERS
	select PINCTRL_DYNAMIC if PINCTRL
	help
	  Any NRF simulated SOC with BabbleSim, based on the POSIX arch

config SOC_SERIES_BSIM_NRF52X
	bool
	select SOC_SERIES_BSIM_NRFXX
	select SOC_COMPATIBLE_NRF52X
	help
	  Any NRF52 simulated SOC with BabbleSim, based on the POSIX arch

config SOC_SERIES_BSIM_NRF53X
	bool
	select SOC_SERIES_BSIM_NRFXX
	select SOC_COMPATIBLE_NRF53X
	help
	  Any NRF53 simulated SOC with BabbleSim, based on the POSIX arch

if BOARD_NRF5340BSIM_NRF5340_CPUAPP

# Replica of the option provided by the BOARD_NRF5340DK_NRF5340_CPUAPP board so samples can be
# reused as is
config BOARD_ENABLE_CPUNET
	bool "NRF53 Network MCU"

endif # BOARD_NRF5340BSIM_NRF5340_CPUNET

if SOC_SERIES_BSIM_NRF53X

# Let's reuse the RTC sync options so applications which use it can be reused as is
source "soc/arm/nordic_nrf/nrf53/Kconfig.sync_rtc"

endif # SOC_SERIES_BSIM_NRF53X
```

## boards/posix/nrf_bsim/Kconfig.board
```kconfig
# SPDX-License-Identifier: Apache-2.0

config BOARD_NRF52_BSIM
	bool "NRF52 simulation model"
	select SOC_SERIES_BSIM_NRFXX
	select SOC_SERIES_BSIM_NRF52X
	select SOC_COMPATIBLE_NRF
	select SOC_COMPATIBLE_NRF52X
	select SOC_COMPATIBLE_NRF52833
	select NRF_RTC_TIMER
	select CLOCK_CONTROL
	select HAS_NRFX
	select HAS_NORDIC_DRIVERS
	select NATIVE_LIBRARY
	help
	  Will produce a console Linux process which can be executed natively.
	  It needs the BabbleSim simulator both in compile time and to execute

config BOARD_NRF5340BSIM_NRF5340_CPUNET
	bool "Simulated NRF53 Network core"
	select SOC_SERIES_BSIM_NRFXX
	select SOC_SERIES_BSIM_NRF53X
	select SOC_COMPATIBLE_NRF
	select SOC_COMPATIBLE_NRF53X
	select SOC_COMPATIBLE_NRF5340_CPUNET
	select NRF_RTC_TIMER
	select CLOCK_CONTROL
	select HAS_NRFX
	select HAS_NORDIC_DRIVERS
	select NATIVE_LIBRARY
	help
	  Will produce a console Linux process which can be executed natively.
	  It needs the BabbleSim simulator both in compile time and to execute

config BOARD_NRF5340BSIM_NRF5340_CPUAPP
	bool "Simulated NRF53 Application core"
	select SOC_SERIES_BSIM_NRFXX
	select SOC_SERIES_BSIM_NRF53X
	select SOC_COMPATIBLE_NRF
	select SOC_COMPATIBLE_NRF53X
	select SOC_COMPATIBLE_NRF5340_CPUAPP
	select NRF_RTC_TIMER
	select CLOCK_CONTROL
	select HAS_NRFX
	select HAS_NORDIC_DRIVERS
	select NATIVE_LIBRARY
	help
	  Will produce a console Linux process which can be executed natively.
	  It needs the BabbleSim simulator both in compile time and to execute
```

## boards/posix/nrf_bsim/Kconfig.defconfig
```kconfig
# SPDX-License-Identifier: Apache-2.0

if SOC_SERIES_BSIM_NRFXX

config BUILD_OUTPUT_BIN
	default n

config BUILD_OUTPUT_EXE
	default y

config OUTPUT_PRINT_MEMORY_USAGE
	default n

config BOARD
	default "nrf52_bsim" if BOARD_NRF52_BSIM
	default "nrf5340bsim_nrf5340_cpunet" if BOARD_NRF5340BSIM_NRF5340_CPUNET
	default "nrf5340bsim_nrf5340_cpuapp" if BOARD_NRF5340BSIM_NRF5340_CPUAPP

config NATIVE_SIMULATOR_NUMBER_MCUS
	default 2 if BOARD_NRF5340BSIM_NRF5340_CPUNET || BOARD_NRF5340BSIM_NRF5340_CPUAPP
	default 1

config NATIVE_SIMULATOR_MCU_N
	default 1 if BOARD_NRF5340BSIM_NRF5340_CPUNET
	default 0

config NATIVE_SIMULATOR_AUTOSTART_MCU
	default y if BOARD_NRF5340BSIM_NRF5340_CPUNET

config NATIVE_SIMULATOR_PRIMARY_MCU_INDEX
	default 1 if SOC_SERIES_BSIM_NRF53X
	default 0

config SYS_CLOCK_HW_CYCLES_PER_SEC
	default 32768

config SYS_CLOCK_TICKS_PER_SEC
	default 128 if !TICKLESS_KERNEL
	default 32768

config BT_CTLR
	default y if BOARD_NRF52_BSIM || BOARD_NRF5340BSIM_NRF5340_CPUNET
	depends on BT

# The 15.4 driver Tx encryption is currently not functional with this
# simulated board => we disable it by default. With this Openthread will normally
# default to encrypt packets on its own.
config NRF_802154_ENCRYPTION
	default n

if LOG

# For this board we can log synchronously without any problem
# Doing so will be nicer for debugging
choice LOG_MODE
	default LOG_MODE_IMMEDIATE
endchoice

endif # LOG

if CONSOLE

config POSIX_ARCH_CONSOLE
	default y if !SERIAL

config UART_CONSOLE
	default y if SERIAL

endif # CONSOLE

endif # SOC_SERIES_BSIM_NRFXX
```

## boards/posix/nrf_bsim/nrf52_bsim_defconfig
```kconfig
# SPDX-License-Identifier: Apache-2.0

CONFIG_SOC_POSIX=y
CONFIG_BOARD_NRF52_BSIM=y
CONFIG_CONSOLE=y
CONFIG_NO_OPTIMIZATIONS=y
```

## boards/posix/simple_process/Kconfig.board
```kconfig
config BOARD_SIMPLE_PROCESS
	bool "Posix simple process"
	depends on SOC_POSIX
	select POSIX_SP_TIMER
	help
	Will produce a console Linux process which can be executed natively.
	It provides some minimal needed models:
	An interrupt controller, timer (system tick), and redirects kernel prints to
	stdout.
```

## boards/posix/simple_process/Kconfig.defconfig
```kconfig
if BOARD_SIMPLE_PROCESS

config BUILD_OUTPUT_BIN
	default n

config BUILD_OUTPUT_EXE
	default y

config BOARD
	default "simple_process"

endif
```

## boards/posix/simple_process/simple_process_defconfig
```kconfig
CONFIG_ARCH_POSIX=y
CONFIG_SOC_INF_CLOCK=y
CONFIG_BOARD_SIMPLE_PROCESS=y
CONFIG_CONSOLE=y
CONFIG_SERIAL=y
CONFIG_SYS_CLOCK_HW_CYCLES_PER_SEC=25000000
```

## boards/qcom/qcc744m_evk/board.yml
```yaml
board:
  name: qcc744m_evk
  full_name: QCC744M Evaluation Kit
  vendor: qcom
  socs:
    - name: bl618m05q2i
```

## boards/qemu/arc/Kconfig.qemu_arc
```kconfig
# Copyright (c) 2020 Synopsys, Inc. All rights reserved.
#
# SPDX-License-Identifier: Apache-2.0

config BOARD_QEMU_ARC
	select SOC_QEMU_ARC_EM if BOARD_QEMU_ARC_QEMU_ARC_EM
	select SOC_QEMU_ARC_HS if BOARD_QEMU_ARC_QEMU_ARC_HS || BOARD_QEMU_ARC_QEMU_ARC_HS_XIP
	select SOC_QEMU_ARC_HS5X if BOARD_QEMU_ARC_QEMU_ARC_HS5X
	select SOC_QEMU_ARC_HS6X if BOARD_QEMU_ARC_QEMU_ARC_HS6X
```

## boards/qemu/arc/board.yml
```yaml
board:
  name: qemu_arc
  full_name: QEMU Emulation for ARCv2 & ARCv3
  vendor: qemu
  socs:
  - name: qemu_arc_em
  - name: qemu_arc_hs
    variants:
    - name: xip
  - name: qemu_arc_hs5x
  - name: qemu_arc_hs6x
```

## boards/qemu/cortex_a53/Kconfig
```kconfig
# Copyright (c) 2019 Carlo Caione <ccaione@baylibre.com>
# SPDX-License-Identifier: Apache-2.0

config QEMU_CORTEX_A53_ETH_E1000
	bool
	default y if !NET_TEST
	depends on BOARD_QEMU_CORTEX_A53 && NETWORKING && DT_HAS_INTEL_E1000_ENABLED
	select ETH_E1000
	select NET_L2_ETHERNET
	select PCIE
	select PCIE_CONTROLLER
	select PCIE_ECAM
```

## boards/qemu/cortex_a53/Kconfig.defconfig
```kconfig
# Copyright (c) 2019 Carlo Caione <ccaione@baylibre.com>
# SPDX-License-Identifier: Apache-2.0

if BOARD_QEMU_CORTEX_A53

config BUILD_OUTPUT_BIN
	default y

config MAX_THREAD_BYTES
	default 3

if NETWORKING

choice NET_QEMU_NETWORKING
	default NET_QEMU_ETHERNET if QEMU_CORTEX_A53_ETH_E1000
endchoice

config NET_DRIVERS
	default n if QEMU_CORTEX_A53_ETH_E1000

endif # NETWORKING

# QEMU PCI requires at least 256M of virtual space
config KERNEL_VM_SIZE
	default 0x80000000 if PCIE

# QEMU PCI requires physical addresses with more than 32 bits
choice ARM64_VA_BITS
	default ARM64_VA_BITS_40 if PCIE
endchoice

choice ARM64_PA_BITS
	default ARM64_PA_BITS_40 if PCIE
endchoice

if QEMU_ICOUNT

config QEMU_ICOUNT_SHIFT
	default 4

config QEMU_ICOUNT_SLEEP
	default y

endif # QEMU_ICOUNT

endif # BOARD_QEMU_CORTEX_A53
```

## boards/qemu/cortex_a53/board.yml
```yaml
board:
  name: qemu_cortex_a53
  full_name: QEMU Emulation for ARM Cortex-A53
  vendor: arm
  socs:
  - name: qemu_cortex_a53
    variants:
    - name: smp
    - name: xip
```

## boards/qemu/cortex_a53/qemu_cortex_a53_defconfig
```kconfig
CONFIG_ARM_ARCH_TIMER=y

# Cache management
CONFIG_CACHE_MANAGEMENT=y

# Enable UART driver
CONFIG_SERIAL=y

# Enable console
CONFIG_CONSOLE=y
CONFIG_UART_CONSOLE=y

# Enable serial port
CONFIG_UART_INTERRUPT_DRIVEN=y

# Avoid timing skew in tests
CONFIG_QEMU_ICOUNT=y
```

## boards/qemu/cortex_a53_aarch32/Kconfig
```kconfig
# Copyright (c) 2026 Realtek Semiconductor Corp.
# SPDX-License-Identifier: Apache-2.0

config BOARD_QEMU_CORTEX_A53_AARCH32
	select SOC_QEMU_CORTEX_A53_AARCH32
	# The EL3 boot shim puts the GIC in a single security state (GICD_CTLR.DS=1)
	# and enters Zephyr in Non-secure EL1
	select GIC_SINGLE_SECURITY_STATE
	select ARMV8_A_NS
```

## boards/qemu/cortex_a53_aarch32/Kconfig.defconfig
```kconfig
# Copyright (c) 2026 Realtek Semiconductor Corp.
# SPDX-License-Identifier: Apache-2.0

if BOARD_QEMU_CORTEX_A53_AARCH32

# QEMU loads Zephyr from a raw binary (-device loader), so always emit zephyr.bin.
config BUILD_OUTPUT_BIN
	default y

if QEMU_ICOUNT

config QEMU_ICOUNT_SHIFT
	default 4

config QEMU_ICOUNT_SLEEP
	default y

endif # QEMU_ICOUNT

endif # BOARD_QEMU_CORTEX_A53_AARCH32
```

## boards/qemu/cortex_a53_aarch32/board.yml
```yaml
board:
  name: qemu_cortex_a53_aarch32
  full_name: QEMU Emulation for ARM Cortex-A53 AArch32
  vendor: arm
  socs:
  - name: qemu_cortex_a53_aarch32
```
