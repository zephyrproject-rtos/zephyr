## boards/pine64/ox64/board.yml
```yaml
board:
  name: ox64
  full_name: Pine64 Ox64
  vendor: pine64
  socs:
    - name: bl808c09q2i
      variants:
        - name: 2mb
```

## boards/pine64/pinecone/Kconfig.pinecone
```kconfig
# Copyright (c) 2026 MASSDRIVER EI (massdriver.space)
#
# SPDX-License-Identifier: Apache-2.0

config BOARD_PINECONE
	select SOC_BL602C20Q2I
```

## boards/pine64/pinecone/board.yml
```yaml
board:
  name: pinecone
  full_name: PineCone BL602 Evaluation Board
  vendor: pine64
  socs:
    - name: bl602c20q2i
```

## boards/pine64/pinedio_zigbee_dongle/Kconfig.pinedio_zigbee_dongle
```kconfig
# SPDX-FileCopyrightText: Copyright The Zephyr Project Contributors
# SPDX-License-Identifier: Apache-2.0

config BOARD_PINEDIO_ZIGBEE_DONGLE
	select SOC_BL706C22Q2I
```

## boards/pine64/pinedio_zigbee_dongle/board.yml
```yaml
board:
  name: pinedio_zigbee_dongle
  full_name: PineDio USB-C Zigbee Dongle
  vendor: pine64
  socs:
    - name: bl706c22q2i
```

## boards/pjrc/teensy4/Kconfig.defconfig
```kconfig
#
# Copyright (c) 2020, Bernhard Kraemer
#
# SPDX-License-Identifier: Apache-2.0
#

if BOARD_TEENSY40 || BOARD_TEENSY41 || BOARD_TEENSYMM

configdefault BUILD_OUTPUT_HEX
	default y

configdefault ETH_DRIVER
	default y if BOARD_TEENSY41

endif # BOARD_TEENSY40 || BOARD_TEENSY41
```

## boards/puya/py32/py32f003_minimal/Kconfig.py32f003_minimal
```kconfig
# SPDX-FileCopyrightText: Copyright The Zephyr Project Contributors
# SPDX-License-Identifier: Apache-2.0

config BOARD_PY32F003_MINIMAL
	select SOC_PY32F003X6
```

## boards/puya/py32/py32f003_minimal/board.yml
```yaml
# SPDX-FileCopyrightText: Copyright The Zephyr Project Contributors
# SPDX-License-Identifier: Apache-2.0

board:
  name: py32f003_minimal
  full_name: PY32F003 Minimal Circuit
  vendor: puya
  socs:
    - name: py32f003x6
      variants:
        - name: w16s6tu
        - name: l16s6tu
```

## boards/puya/py32/py32f003_minimal/py32f003_minimal_py32f003x6_w16s6tu_defconfig
```kconfig
# SPDX-FileCopyrightText: Copyright The Zephyr Project Contributors
# SPDX-License-Identifier: Apache-2.0

CONFIG_MAIN_STACK_SIZE=512
CONFIG_IDLE_STACK_SIZE=200
CONFIG_ISR_STACK_SIZE=512
CONFIG_GPIO=y
CONFIG_SERIAL=y
CONFIG_CONSOLE=y
CONFIG_UART_CONSOLE=y
```

## boards/puya/py32/py32f030_startkit/Kconfig.defconfig
```kconfig
# SPDX-FileCopyrightText: Copyright The Zephyr Project Contributors
# SPDX-License-Identifier: Apache-2.0

if BOARD_PY32F030_STARTKIT

configdefault MAIN_STACK_SIZE
	default 512

configdefault IDLE_STACK_SIZE
	default 200

configdefault ISR_STACK_SIZE
	default 512

endif # BOARD_PY32F030_STARTKIT
```

## boards/puya/py32/py32f030_startkit/Kconfig.py32f030_startkit
```kconfig
# Copyright (c) 2019 Antony Pavlov <antonynpavlov@gmail.com>
# SPDX-License-Identifier: Apache-2.0

config BOARD_PY32F030_STARTKIT
	select SOC_PY32F030X6
```

## boards/puya/py32/py32f030_startkit/board.yml
```yaml
# SPDX-FileCopyrightText: Copyright The Zephyr Project Contributors
# SPDX-License-Identifier: Apache-2.0

board:
  name: py32f030_startkit
  full_name: PY32F030 Start Kit Board
  vendor: puya
  socs:
    - name: py32f030x6
```

## boards/puya/py32/py32f030_startkit/py32f030_startkit_defconfig
```kconfig
# SPDX-FileCopyrightText: Copyright The Zephyr Project Contributors
# SPDX-License-Identifier: Apache-2.0

# GPIO Controller
CONFIG_GPIO=y

# UART console
CONFIG_SERIAL=y
CONFIG_CONSOLE=y
CONFIG_UART_CONSOLE=y
```

## boards/qemu/cortex_a53/Kconfig.qemu_cortex_a53
```kconfig
# Copyright (c) 2019 Carlo Caione <ccaione@baylibre.com>
# SPDX-License-Identifier: Apache-2.0

config BOARD_QEMU_CORTEX_A53
	select SOC_QEMU_CORTEX_A53
	select QEMU_CORTEX_A53_EXECUTION_STATE_AARCH64 if \
		BOARD_QEMU_CORTEX_A53_QEMU_CORTEX_A53 || \
		BOARD_QEMU_CORTEX_A53_QEMU_CORTEX_A53_SMP || \
		BOARD_QEMU_CORTEX_A53_QEMU_CORTEX_A53_XIP
	select QEMU_CORTEX_A53_EXECUTION_STATE_AARCH32 if \
		BOARD_QEMU_CORTEX_A53_QEMU_CORTEX_A53_AARCH32
```

## boards/qemu/cortex_a7/Kconfig.defconfig
```kconfig
# Copyright (c) Qualcomm Technologies, Inc. and/or its subsidiaries.
# SPDX-License-Identifier: Apache-2.0

if BOARD_QEMU_CORTEX_A7

config BUILD_OUTPUT_BIN
	default y

if QEMU_ICOUNT

config QEMU_ICOUNT_SHIFT
	default 4

config QEMU_ICOUNT_SLEEP
	default y

endif # QEMU_ICOUNT

endif # BOARD_QEMU_CORTEX_A7
```

## boards/qemu/cortex_a7/Kconfig.qemu_cortex_a7
```kconfig
# Copyright (c) Qualcomm Technologies, Inc. and/or its subsidiaries.
# SPDX-License-Identifier: Apache-2.0

config BOARD_QEMU_CORTEX_A7
	select SOC_QEMU_CORTEX_A7
```

## boards/qemu/cortex_a7/board.yml
```yaml
board:
  name: qemu_cortex_a7
  full_name: QEMU Emulation for Cortex-A7
  vendor: qemu
  socs:
  - name: qemu_cortex_a7
    variants:
    - name: smp
```

## boards/qemu/cortex_a7/qemu_cortex_a7_defconfig
```kconfig
# Copyright (c) Qualcomm Technologies, Inc. and/or its subsidiaries.
# SPDX-License-Identifier: Apache-2.0

CONFIG_ARM_AARCH32_MMU=y

CONFIG_ARM_ARCH_TIMER=y

# Cache management
CONFIG_CACHE_MANAGEMENT=y

# Enable UART driver
CONFIG_SERIAL=y

# Enable console
CONFIG_CONSOLE=y
CONFIG_UART_CONSOLE=y

# Enable serial port
CONFIG_UART_INTERRUPT_DRIVEN=y

# Avoid timing skew in tests
CONFIG_QEMU_ICOUNT=y
```

## boards/qemu/cortex_m3/qemu_cortex_m3_defconfig
```kconfig
# Copyright (c) 2016 Zephyr Contributors
# SPDX-License-Identifier: Apache-2.0

CONFIG_CONSOLE=y
CONFIG_UART_CONSOLE=y
CONFIG_SERIAL=y
CONFIG_SCHED_MULTIQ=y
```

## boards/qemu/m68k/Kconfig
```kconfig
# Copyright (c) 2026 Dimitri Varpusvuori
# SPDX-License-Identifier: Apache-2.0

config BOARD_QEMU_M68K
	select QEMU_TARGET
```

## boards/qemu/m68k/Kconfig.defconfig
```kconfig
# Copyright (c) 2026 Dimitri Varpusvuori
# SPDX-License-Identifier: Apache-2.0

if BOARD_QEMU_M68K

config CONSOLE
	default y

config SERIAL
	default y

config UART_CONSOLE
	default y

config QEMU_ICOUNT_SHIFT
	default 6 if QEMU_ICOUNT

if GOLDFISH_PIC

config NUM_IRQS
	default 448

config 2ND_LVL_ISR_TBL_OFFSET
	default 256

config NUM_2ND_LEVEL_AGGREGATORS
	default 6

config 2ND_LVL_INTR_00_OFFSET
	default 25

config 2ND_LVL_INTR_01_OFFSET
	default 26

config 2ND_LVL_INTR_02_OFFSET
	default 27

config 2ND_LVL_INTR_03_OFFSET
	default 28

config 2ND_LVL_INTR_04_OFFSET
	default 29

config 2ND_LVL_INTR_05_OFFSET
	default 30

endif # GOLDFISH_PIC

endif # BOARD_QEMU_M68K
```

## boards/qemu/m68k/Kconfig.qemu_m68k
```kconfig
# Copyright (c) 2026 Dimitri Varpusvuori
# SPDX-License-Identifier: Apache-2.0

config BOARD_QEMU_M68K
	select SOC_QEMU_VIRT_M68K_M68000 if BOARD_QEMU_M68K_QEMU_VIRT_M68K_M68000
	select SOC_QEMU_VIRT_M68K_M68010 if BOARD_QEMU_M68K_QEMU_VIRT_M68K_M68010
```
