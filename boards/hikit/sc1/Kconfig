## boards/hikit/sc1/Kconfig
```kconfig
# HiKit SC1 board configuration

# Copyright (c) 2022 Marcin Niestroj
# SPDX-License-Identifier: Apache-2.0

config BOARD_HIKIT_SC1
	select SOC_STM32L562XX
```

## boards/hikit/sc1/board.yml
```yaml
board:
  name: hikit_sc1
  full_name: HiKit SC1
  vendor: hikit
  socs:
  - name: stm32l562xx
    variants:
    - name: 'cetx'
```

## boards/hikit/sc1/hikit_sc1_defconfig
```kconfig
# SPDX-License-Identifier: Apache-2.0

# enable uart driver
CONFIG_SERIAL=y

# enable GPIO
CONFIG_GPIO=y

# board-level MAC from EEPROM NVMEM cell
CONFIG_NVMEM=y
CONFIG_NVMEM_EEPROM=y
CONFIG_EEPROM_AT2X_INIT_PRIORITY=55

# console
CONFIG_CONSOLE=y
CONFIG_UART_CONSOLE=y

# Enable MPU
CONFIG_ARM_MPU=y

# Enable HW stack protection
CONFIG_HW_STACK_PROTECTION=y

# Enable thread info in debug logs
CONFIG_DEBUG_THREAD_INFO=y 
```

## boards/holyiot/holyiot_21014/Kconfig.holyiot_21014
```kconfig
# Holyiot 21014 board configuration

# SPDX-FileCopyrightText: Copyright (c) 2025 Clunky Machines
# SPDX-License-Identifier: Apache-2.0

config BOARD_HOLYIOT_21014
	select SOC_NRF52810_QFAA
```

## boards/holyiot/holyiot_21014/board.yml
```yaml
board:
  name: holyiot_21014
  full_name: 21014 Module
  vendor: holyiot
  socs:
  - name: nrf52810
```

## boards/holyiot/holyiot_21014/holyiot_21014_defconfig
```kconfig
# SPDX-License-Identifier: Apache-2.0

# 32kHz clock source
CONFIG_CLOCK_CONTROL_NRF_K32SRC_RC=y

# Enable MPU
CONFIG_ARM_MPU=y

# Enable RTT
CONFIG_USE_SEGGER_RTT=y

# Enable GPIO
CONFIG_GPIO=y
```

## boards/holyiot/holyiot_25008/Kconfig.defconfig
```kconfig
# SPDX-FileCopyrightText: Copyright (c) 2025 Clunky Machines
# SPDX-License-Identifier: Apache-2.0

config HW_STACK_PROTECTION
	default ARCH_HAS_STACK_PROTECTION
```

## boards/holyiot/holyiot_25008/Kconfig.holyiot_25008
```kconfig
# Holyiot 25008 board configuration

# SPDX-FileCopyrightText: Copyright (c) 2025 Clunky Machines
# SPDX-License-Identifier: Apache-2.0

config BOARD_HOLYIOT_25008
	select SOC_NRF54L15_CPUAPP if BOARD_HOLYIOT_25008_NRF54L15_CPUAPP
```

## boards/holyiot/holyiot_25008/board.yml
```yaml
board:
  name: holyiot_25008
  full_name: HOLYIOT 25008
  vendor: holyiot
  socs:
    - name: nrf54l15
```

## boards/holyiot/holyiot_yj16019/board.yml
```yaml
board:
  name: holyiot_yj16019
  vendor: Shenzhen Holyiot Technology Co.
  socs:
  - name: nrf52832
```

## boards/holyiot/yj16019/Kconfig.holyiot_yj16019
```kconfig
# Holyiot YJ-16019 board configuration

# Copyright (c) 2019 Henrik Brix Andersen <henrik@brixandersen.dk>
# SPDX-License-Identifier: Apache-2.0

config BOARD_HOLYIOT_YJ16019
	select SOC_NRF52832_QFAA
```

## boards/holyiot/yj16019/board.yml
```yaml
board:
  name: holyiot_yj16019
  full_name: YJ-16019
  vendor: holyiot
  socs:
  - name: nrf52832
```

## boards/holyiot/yj17095/Kconfig.holyiot_yj17095
```kconfig
# Holyiot YJ-17095 board configuration

# Copyright (c) 2025 Marc Lasch <mlasch@mailbox.org>
# SPDX-License-Identifier: Apache-2.0

config BOARD_HOLYIOT_YJ17095
	select SOC_NRF52832_QFAA
```

## boards/holyiot/yj17095/board.yml
```yaml
board:
  name: holyiot_yj17095
  full_name: YJ-17095
  vendor: holyiot
  socs:
  - name: nrf52832
```

## boards/iar/stm32f429ii_aca/Kconfig.stm32f429ii_aca
```kconfig
# Copyright (c) 2016 Linaro Limited.
# Copyright (c) 2025 IAR Systems.
# SPDX-License-Identifier: Apache-2.0

config BOARD_STM32F429II_ACA
	select SOC_STM32F429XX
```

## boards/iar/stm32f429ii_aca/board.yml
```yaml
board:
  name: stm32f429ii_aca
  full_name: STM32F429II-ACA
  vendor: iar
  socs:
    - name: stm32f429xx
```

## boards/id8/seven/board.yml
```yaml
board:
  name: seven
  full_name: Seven nRF9151
  vendor: id8
  socs:
  - name: nrf9151
    variants:
    - name: 'ns'
```

## boards/id8/seven_nrf9151/Kconfig.defconfig
```kconfig
# Seven_nrf9151 board configuration

# Copyright (c) 2026 ID8 Engineering AB
# SPDX-License-Identifier: Apache-2.0
#
config HW_STACK_PROTECTION
	default ARCH_HAS_STACK_PROTECTION

if BOARD_SEVEN_NRF9151 || BOARD_SEVEN_NRF9151_NS

config BOARD_SEVEN
	select USE_DT_CODE_PARTITION if BOARD_SEVEN_NRF9151_NS

endif # BOARD_SEVEN_NRF9151 || BOARD_SEVEN_NRF9151_NS
```

## boards/id8/seven_nrf9151/Kconfig.seven
```kconfig
# Seven nRF9151 board configuration

# Copyright (c) 2026 ID8 Engineering AB
# SPDX-License-Identifier: Apache-2.0

config BOARD_SEVEN
	select SOC_NRF9151_LACA
```

## boards/ie/nrf52840_stamp_xl/Kconfig
```kconfig
# Copyright (c) 2026 Icy Electronics
# SPDX-License-Identifier: Apache-2.0

if BOARD_NRF52840_STAMP_XL

config BOARD_HAS_NRF5_BOOTLOADER
	bool "Board has nRF5 bootloader"
	default y
	help
	  If selected, applications are linked so that they can be loaded by Nordic
	  nRF5 bootloader.

endif # BOARD_NRF52840_STAMP_XL
```

## boards/ie/nrf52840_stamp_xl/Kconfig.nrf52840_stamp_xl
```kconfig
# Copyright (c) 2026 Icy Electronics
# SPDX-License-Identifier: Apache-2.0

config BOARD_NRF52840_STAMP_XL
	select SOC_NRF52840_QIAA
```

## boards/ie/nrf52840_stamp_xl/board.yml
```yaml
board:
  name: nrf52840_stamp_xl
  full_name: nRF52840 Stamp XL
  vendor: ie
  socs:
  - name: nrf52840
    variants:
    - name: uf2
```

## boards/ie/nrf54l15_discovery/Kconfig.nrf54l15_discovery
```kconfig
# Copyright (c) 2026 Icy Electronics
# SPDX-License-Identifier: Apache-2.0

config BOARD_NRF54L15_DISCOVERY
	select SOC_NRF52820_QDAA if BOARD_NRF54L15_DISCOVERY_NRF52820
	select SOC_NRF54L15_CPUAPP if BOARD_NRF54L15_DISCOVERY_NRF54L15_CPUAPP || BOARD_NRF54L15_DISCOVERY_NRF54L15_CPUAPP_NS
	select SOC_NRF54L15_CPUFLPR if BOARD_NRF54L15_DISCOVERY_NRF54L15_CPUFLPR || \
					    BOARD_NRF54L15_DISCOVERY_NRF54L15_CPUFLPR_XIP
```

## boards/ie/nrf54l15_discovery/board.yml
```yaml
board:
  name: nrf54l15_discovery
  full_name: nRF54L15 Discovery
  vendor: ie
  socs:
    - name: nrf52820
    - name: nrf54l15
      variants:
        - name: xip
          cpucluster: cpuflpr
        - name: ns
          cpucluster: cpuapp
```
