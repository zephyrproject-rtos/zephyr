## boards/u-blox/ubx_bmd330eval/Kconfig.ubx_bmd330eval
```kconfig
# BMD-330-EVAL board configuration

# Copyright (c) 2021 u-blox AG
# SPDX-License-Identifier: Apache-2.0

config BOARD_UBX_BMD330EVAL
	select SOC_NRF52810_QFAA
```

## boards/u-blox/ubx_bmd330eval/board.yml
```yaml
board:
  name: ubx_bmd330eval
  full_name: "EVK-BMD-330: BMD-330-EVAL"
  vendor: u-blox
  socs:
  - name: nrf52810
```

## boards/u-blox/ubx_bmd340eval/board.yml
```yaml
board:
  name: ubx_bmd340eval
  full_name: "EVK-BMD-34/38: BMD-340-EVAL and BMD-341-EVAL"
  vendor: u-blox
  socs:
  - name: nrf52840
```

## boards/u-blox/ubx_bmd345eval/Kconfig.ubx_bmd345eval
```kconfig
# BMD-340-EVAL board configuration

# Copyright (c) 2021 u-blox AG
# Copyright (c) 2021 Linumiz
# SPDX-License-Identifier: Apache-2.0

config BOARD_UBX_BMD345EVAL
	select SOC_NRF52840_QIAA
```

## boards/u-blox/ubx_bmd345eval/board.yml
```yaml
board:
  name: ubx_bmd345eval
  full_name: "EVK-BMD-34/38: BMD-345-EVAL"
  vendor: u-blox
  socs:
  - name: nrf52840
```

## boards/u-blox/ubx_bmd360eval/Kconfig.ubx_bmd360eval
```kconfig
# BMD-360-EVAL board configuration

# Copyright (c) 2021 u-blox AG
# SPDX-License-Identifier: Apache-2.0

config BOARD_UBX_BMD360EVAL
	select SOC_NRF52811_QFAA
```

## boards/u-blox/ubx_bmd360eval/board.yml
```yaml
board:
  name: ubx_bmd360eval
  full_name: "EVK-BMD-360: BMD-360-EVAL"
  vendor: u-blox
  socs:
  - name: nrf52811
```

## boards/u-blox/ubx_bmd380eval/Kconfig.ubx_bmd380eval
```kconfig
# BMD-380-EVAL board configuration

# Copyright (c) 2021 u-blox AG
# SPDX-License-Identifier: Apache-2.0

config BOARD_UBX_BMD380EVAL
	select SOC_NRF52840_QIAA

# should be CKAA,
# but SOC file not yet available from Nordic Semiconductor
```

## boards/u-blox/ubx_bmd380eval/board.yml
```yaml
board:
  name: ubx_bmd380eval
  full_name: "EVK-BMD-34/48: BMD-380-EVAL"
  vendor: u-blox
  socs:
  - name: nrf52840
```

## boards/u-blox/ubx_bmd380eval/ubx_bmd380eval_nrf52840_defconfig
```kconfig
# BMD-380-EVAL board configuration

# Copyright (c) 2021 u-blox AG
# SPDX-License-Identifier: Apache-2.0

# should be CKAA, but not available yet from Nordic Semiconductor

# Enable hardware stack protection
CONFIG_HW_STACK_PROTECTION=y

# Enable MPU
CONFIG_ARM_MPU=y

# Enable RTT
CONFIG_USE_SEGGER_RTT=y

# enable GPIO
CONFIG_GPIO=y

# enable uart driver
CONFIG_SERIAL=y

# enable console
CONFIG_CONSOLE=y
CONFIG_UART_CONSOLE=y
```

## boards/u-blox/ubx_evk_iris_w1/Kconfig.ubx_evk_iris_w1
```kconfig
# EVK-IRIS-W1 board configuration
# Copyright (c) 2025 u-blox AG
# SPDX-License-Identifier: Apache-2.0

config BOARD_UBX_EVK_IRIS_W1
	select SOC_PART_NUMBER_RW612ETA2I
```

## boards/u-blox/ubx_evk_iris_w1/board.yml
```yaml
board:
  name: ubx_evk_iris_w1
  full_name: EVK-IRIS-W106-RW612
  vendor: u-blox
  revision:
    format: custom
    default: fidelix
    revisions:
      - name: "fidelix"
      - name: "fidelix_16mb"
      - name: "macronix"
      - name: "macronix_16mb"
  socs:
    - name: rw612
      variants:
        - name: ethernet
```

## boards/u-blox/ubx_evkannab1/Kconfig
```kconfig
# u-blox EVK-ANNA-B1 board configuration
#
# Copyright (c) 2021 u-blox AG
# SPDX-License-Identifier: Apache-2.0

config BOARD_ENABLE_DCDC
	bool "DCDC mode"
	select SOC_DCDC_NRF52X
	default y
	depends on BOARD_UBX_EVKANNAB1
```

## boards/u-blox/ubx_evkannab1/Kconfig.ubx_evkannab1
```kconfig
# u-blox EVK-ANNA-B1 board configuration
#
# Copyright (c) 2021 u-blox AG
# SPDX-License-Identifier: Apache-2.0

config BOARD_UBX_EVKANNAB1
	select SOC_NRF52832_QFAA
```

## boards/u-blox/ubx_evkannab1/board.yml
```yaml
board:
  name: ubx_evkannab1
  full_name: EVK-ANNA-B11x
  vendor: u-blox
  socs:
  - name: nrf52832
```

## boards/u-blox/ubx_evkninab1/Kconfig.ubx_evkninab1
```kconfig
# u-blox EVK-NINA-B1 board configuration

# Copyright (c) 2021 u-blox AG
# SPDX-License-Identifier: Apache-2.0

config BOARD_UBX_EVKNINAB1
	select SOC_NRF52832_QFAA
```

## boards/u-blox/ubx_evkninab1/board.yml
```yaml
board:
  name: ubx_evkninab1
  full_name: EVK NINA-B11x
  vendor: u-blox
  socs:
  - name: nrf52832
```

## boards/u-blox/ubx_evkninab3/Kconfig.ubx_evkninab3
```kconfig
# EVK-NINA-B3 board configuration

# Copyright (c) 2021 u-blox AG
# SPDX-License-Identifier: Apache-2.0

config BOARD_UBX_EVKNINAB3
	select SOC_NRF52840_QIAA
```

## boards/u-blox/ubx_evkninab3/board.yml
```yaml
board:
  name: ubx_evkninab3
  full_name: EVK-NINA-B3
  vendor: u-blox
  socs:
  - name: nrf52840
```
