## boards/u-blox/ubx_evkninab4/Kconfig.ubx_evkninab4
```kconfig
# NINA-B4 EVK board configuration
#
# Copyright (c) 2021 u-blox AG
# SPDX-License-Identifier: Apache-2.0

config BOARD_UBX_EVKNINAB4
	select SOC_NRF52833_QIAA
```

## boards/u-blox/ubx_evkninab4/board.yml
```yaml
board:
  name: ubx_evkninab4
  full_name: EVK NINA-B40x
  vendor: u-blox
  socs:
  - name: nrf52833
```

## boards/u-blox/ubx_evkninab5/Kconfig.ubx_evkninab5
```kconfig
# Copyright 2026 NXP
# Copyright 2026 u-blox
# SPDX-License-Identifier: Apache-2.0

config BOARD_UBX_EVKNINAB5
	select SOC_MCXW716C
	select SOC_PART_NUMBER_MCXW716CMFTA
```

## boards/u-blox/ubx_evkninab5/board.yml
```yaml
board:
  name: ubx_evkninab5
  full_name: EVK-NINA-B5-MCXW716C
  vendor: u-blox
  socs:
    - name: mcxw716c
```

## boards/u-blox/ubx_evknorab2/Kconfig
```kconfig
# Copyright (c) 2026 u-blox AG
# SPDX-License-Identifier: Apache-2.0

config BOARD_UBX_EVKNORAB2
	select SOC_NRF54L10_DEVELOP_IN_NRF54L15 if SOC_NRF54L10
	select SOC_NRF54L05_DEVELOP_IN_NRF54L15 if SOC_NRF54L05
```

## boards/u-blox/ubx_evknorab2/Kconfig.defconfig
```kconfig
# Copyright (c) 2026 u-blox AG
# SPDX-License-Identifier: Apache-2.0

config HW_STACK_PROTECTION
	default ARCH_HAS_STACK_PROTECTION

if SPI_NOR

config SPI_NOR_FLASH_LAYOUT_PAGE_SIZE
	default 4096 if MCUBOOT || BOOTLOADER_MCUBOOT

endif # SPI_NOR

if BOARD_UBX_EVKNORAB2_NRF54L15_CPUAPP_NS || BOARD_UBX_EVKNORAB2_NRF54L10_CPUAPP_NS

config BOARD_UBX_EVKNORAB2
	select USE_DT_CODE_PARTITION if BOARD_UBX_EVKNORAB2_NRF54L15_CPUAPP_NS || \
		BOARD_UBX_EVKNORAB2_NRF54L10_CPUAPP_NS

config HAS_BT_CTLR
	default BT

# By default, if we build for a Non-Secure version of the board,
# enable building with TF-M as the Secure Execution Environment.
config BUILD_WITH_TFM
	default y

endif # BOARD_UBX_EVKNORAB2_NRF54L15_CPUAPP_NS || BOARD_UBX_EVKNORAB2_NRF54L10_CPUAPP_NS
```

## boards/u-blox/ubx_evknorab2/Kconfig.ubx_evknorab2
```kconfig
# Copyright (c) 2026 u-blox AG
# SPDX-License-Identifier: Apache-2.0

config BOARD_UBX_EVKNORAB2
	select SOC_NRF54L05_CPUAPP if BOARD_UBX_EVKNORAB2_NRF54L05_CPUAPP
	select SOC_NRF54L10_CPUAPP if BOARD_UBX_EVKNORAB2_NRF54L10_CPUAPP || BOARD_UBX_EVKNORAB2_NRF54L10_CPUAPP_NS
	select SOC_NRF54L15_CPUAPP if BOARD_UBX_EVKNORAB2_NRF54L15_CPUAPP || BOARD_UBX_EVKNORAB2_NRF54L15_CPUAPP_NS
	select SOC_NRF54L05_CPUFLPR if BOARD_UBX_EVKNORAB2_NRF54L05_CPUFLPR
	select SOC_NRF54L10_CPUFLPR if BOARD_UBX_EVKNORAB2_NRF54L10_CPUFLPR
	select SOC_NRF54L15_CPUFLPR if BOARD_UBX_EVKNORAB2_NRF54L15_CPUFLPR || \
					    BOARD_UBX_EVKNORAB2_NRF54L15_CPUFLPR_XIP
```

## boards/u-blox/ubx_evknorab2/board.yml
```yaml
board:
  name: ubx_evknorab2
  full_name: EVK-NORA-B2
  vendor: u-blox
  socs:
    - name: nrf54l05
    - name: nrf54l10
      variants:
        - name: ns
          cpucluster: cpuapp
    - name: nrf54l15
      variants:
        - name: xip
          cpucluster: cpuflpr
        - name: ns
          cpucluster: cpuapp
runners:
  run_once:
    '--recover':
      - runners:
          - nrfjprog
          - nrfutil
        run: first
        groups:
          - boards:
              - ubx_evknorab2/nrf54l05/cpuapp
              - ubx_evknorab2/nrf54l05/cpuflpr
              - ubx_evknorab2/nrf54l10/cpuapp
              - ubx_evknorab2/nrf54l10/cpuflpr
              - ubx_evknorab2/nrf54l10/cpuapp/ns
              - ubx_evknorab2/nrf54l15/cpuapp
              - ubx_evknorab2/nrf54l15/cpuapp/ns
              - ubx_evknorab2/nrf54l15/cpuflpr
              - ubx_evknorab2/nrf54l15/cpuflpr/xip
    '--erase':
      - runners:
          - nrfjprog
          - jlink
          - nrfutil
        run: first
        groups:
          - boards:
              - ubx_evknorab2/nrf54l05/cpuapp
              - ubx_evknorab2/nrf54l05/cpuflpr
              - ubx_evknorab2/nrf54l10/cpuapp
              - ubx_evknorab2/nrf54l10/cpuflpr
              - ubx_evknorab2/nrf54l10/cpuapp/ns
              - ubx_evknorab2/nrf54l15/cpuapp
              - ubx_evknorab2/nrf54l15/cpuapp/ns
              - ubx_evknorab2/nrf54l15/cpuflpr
              - ubx_evknorab2/nrf54l15/cpuflpr/xip
    '--reset':
      - runners:
          - nrfjprog
          - jlink
          - nrfutil
        run: last
        groups:
          - boards:
              - ubx_evknorab2/nrf54l05/cpuapp
              - ubx_evknorab2/nrf54l05/cpuflpr
              - ubx_evknorab2/nrf54l10/cpuapp
              - ubx_evknorab2/nrf54l10/cpuflpr
              - ubx_evknorab2/nrf54l10/cpuapp/ns
              - ubx_evknorab2/nrf54l15/cpuapp
              - ubx_evknorab2/nrf54l15/cpuapp/ns
              - ubx_evknorab2/nrf54l15/cpuflpr
              - ubx_evknorab2/nrf54l15/cpuflpr/xip
```

## boards/ublox/ubx_bmd340eval/Kconfig.ubx_bmd340eval
```kconfig
# BMD-340-EVAL board configuration

# Copyright (c) 2021 u-blox AG
# SPDX-License-Identifier: Apache-2.0

config BOARD_UBX_BMD340EVAL
	bool
	default y
	select SOC_NRF52840_QIAA
```

## boards/ublox/ubx_bmd345eval/Kconfig.defconfig
```kconfig
# BMD-345-EVAL board configuration

# Copyright (c) 2021 u-blox AG
# Copyright (c) 2021 Linumiz
# SPDX-License-Identifier: Apache-2.0

if BOARD_UBX_BMD345EVAL_NRF52840

config BT_CTLR
	default BT

endif # BOARD_UBX_BMD345EVAL_NRF52840
```

## boards/ublox/ubx_evkninab4/Kconfig.ubx_evkninab4
```kconfig
# NINA-B4 EVK board configuration
#
# Copyright (c) 2021 u-blox AG
# SPDX-License-Identifier: Apache-2.0

config BOARD_UBX_EVKNINAB4
	bool
	default y
	select SOC_NRF52833_QIAA
```

## boards/udoo/udoo_key/Kconfig.udoo_key
```kconfig
# Copyright (c) 2026 UDOO
# SPDX-License-Identifier: Apache-2.0

config HEAP_MEM_POOL_ADD_SIZE_BOARD
	int
	default 4096 if BOARD_UDOO_KEY_ESP32_PROCPU
	default 256 if BOARD_UDOO_KEY_ESP32_APPCPU
```

## boards/udoo/udoo_neo_full/Kconfig.udoo_neo_full
```kconfig
# Copyright 2018,2024 NXP
# SPDX-License-Identifier: Apache-2.0

config BOARD_UDOO_NEO_FULL
	select SOC_PART_NUMBER_MCIMX6X4EVM10AB
	select SOC_MCIMX6X_M4 if BOARD_UDOO_NEO_FULL_MCIMX6X_M4
```

## boards/udoo/udoo_neo_full/board.yml
```yaml
board:
  name: udoo_neo_full
  full_name: Neo Full
  vendor: udoo
  socs:
    - name: mcimx6x
```
