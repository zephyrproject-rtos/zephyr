/*
 * Copyright (c) 2026 u-blox AG
 *
 * SPDX-License-Identifier: Apache-2.0
 */

/dts-v1/;

#define USE_NON_SECURE_ADDRESS_MAP 1

#include <arm/nordic/nrf54l10_cpuapp_ns.dtsi>
#include "nrf54l_05_10_15_cpuapp_common.dtsi"

/ {
	compatible = "u-blox,ubx_evknorab2_nrf54l10-cpuapp";
	model = "u-blox EVK-NORA-B2 (NORA-B21x) nRF54L10 Application MCU";

	chosen {
		zephyr,code-partition = &slot0_ns_partition;
		zephyr,sram = &sram0_ns;
		zephyr,entropy = &psa_rng;
	};

	/delete-node/ rng;

	psa_rng: psa-rng {
		status = "okay";
	};
};

&uart30 {
	/* Disable so that TF-M can use this UART */
	status = "disabled";
};

/* Include default memory partition configuration file */
#include <vendor/nordic/nrf54l10_cpuapp_ns_partition.dtsi>
