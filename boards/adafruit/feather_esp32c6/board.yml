## boards/adafruit/feather_esp32c6/board.yml
```yaml
board:
  name: adafruit_feather_esp32c6
  full_name: Adafruit Feather ESP32C6
  vendor: adafruit
  socs:
  - name: esp32c6
```

## boards/adafruit/feather_esp32s2/Kconfig
```kconfig
# Copyright (c) 2023 Google, LLC
# SPDX-License-Identifier: Apache-2.0

config HEAP_MEM_POOL_ADD_SIZE_BOARD
	int
	default 4096

config BOARD_NEEDS_LATE_HOOK
	bool
	default y if BOARD_ADAFRUIT_FEATHER_ESP32S2_TFT || BOARD_ADAFRUIT_FEATHER_ESP32S2_TFT_REVERSE
	select BOARD_LATE_INIT_HOOK
```

## boards/adafruit/feather_esp32s2/Kconfig.adafruit_feather_esp32s2
```kconfig
# Copyright (c) 2025 Philipp Steiner <philipp.steiner1987@gmail.com>
# SPDX-License-Identifier: Apache-2.0

config BOARD_ADAFRUIT_FEATHER_ESP32S2
	select SOC_ESP32S2_R2
```

## boards/adafruit/feather_esp32s2/Kconfig.adafruit_feather_esp32s2_tft_reverse
```kconfig
# Copyright (c) 2025 Philipp Steiner <philipp.steiner1987@gmail.com>
# SPDX-License-Identifier: Apache-2.0

config BOARD_ADAFRUIT_FEATHER_ESP32S2_TFT_REVERSE
	select SOC_ESP32S2_R2
```

## boards/adafruit/feather_esp32s2/board.yml
```yaml
boards:
- name: adafruit_feather_esp32s2
  full_name: Adafruit Feather ESP32S2
  vendor: adafruit
  socs:
  - name: esp32s2
  revision:
    format: "letter"
    default: "C"
    revisions:
    - name: "B"
    - name: "C"
- name: adafruit_feather_esp32s2_tft
  full_name: Adafruit Feather ESP32S2 TFT
  vendor: adafruit
  socs:
  - name: esp32s2
- name: adafruit_feather_esp32s2_tft_reverse
  full_name: Adafruit Feather ESP32S2 TFT Reverse
  vendor: adafruit
  socs:
  - name: esp32s2
```

## boards/adafruit/feather_esp32s3/Kconfig.adafruit_feather_esp32s3
```kconfig
# Copyright (c) 2024 Espressif Systems (Shanghai) Co., Ltd.
# Copyright (c) 2024 Leon Rinkel <leon@rinkel.me>
# SPDX-License-Identifier: Apache-2.0

config BOARD_ADAFRUIT_FEATHER_ESP32S3
	select SOC_ESP32S3_WROOM_N8
	select SOC_ESP32S3_PROCPU if BOARD_ADAFRUIT_FEATHER_ESP32S3_ESP32S3_PROCPU
	select SOC_ESP32S3_APPCPU if BOARD_ADAFRUIT_FEATHER_ESP32S3_ESP32S3_APPCPU
```

## boards/adafruit/feather_esp32s3/board.yml
```yaml
board:
  name: adafruit_feather_esp32s3
  full_name: Adafruit Feather ESP32S3
  vendor: adafruit
  socs:
  - name: esp32s3
```

## boards/adafruit/feather_esp32s3_tft/Kconfig
```kconfig
# Adafruit Feather ESP32S3 board configuration

# Copyright (c) 2024 Espressif Systems (Shanghai) Co., Ltd.
# Copyright (c) 2024 Leon Rinkel <leon@rinkel.me>
# SPDX-License-Identifier: Apache-2.0

config HEAP_MEM_POOL_ADD_SIZE_BOARD
	int
	default 4096 if BOARD_ADAFRUIT_FEATHER_ESP32S3_TFT_ESP32S3_PROCPU
	default 256 if BOARD_ADAFRUIT_FEATHER_ESP32S3_TFT_ESP32S3_APPCPU
```

## boards/adafruit/feather_esp32s3_tft/Kconfig.defconfig
```kconfig
# Copyright (c) 2024 Leon Rinkel <leon@rinkel.me>
# SPDX-License-Identifier: Apache-2.0

if BOARD_ADAFRUIT_FEATHER_ESP32S3_TFT_ESP32S3_PROCPU

if DISPLAY

config BOARD_ADAFRUIT_FEATHER_ESP32S3_TFT
	select BOARD_LATE_INIT_HOOK

choice ST7789V_PIXEL_FORMAT
	default ST7789V_RGB565
endchoice

if LVGL

config LV_Z_BITS_PER_PIXEL
	default 16

choice LV_COLOR_DEPTH
	default LV_COLOR_DEPTH_16
endchoice

config LV_COLOR_16_SWAP
	default y

endif # LVGL

endif # DISPLAY

endif # BOARD_ADAFRUIT_FEATHER_ESP32S3_TFT_PROCPU
```

## boards/adafruit/feather_esp32s3_tft/board.yml
```yaml
board:
  name: adafruit_feather_esp32s3_tft
  full_name: Adafruit Feather ESP32S3 TFT
  vendor: adafruit
  socs:
  - name: esp32s3
```

## boards/adafruit/feather_esp32s3_tft_reverse/Kconfig
```kconfig
# Adafruit ESP32-S3 Reverse TFT Feather board configuration

# Copyright (c) 2024 Espressif Systems (Shanghai) Co., Ltd.
# Copyright (c) 2024 Leon Rinkel <leon@rinkel.me>
# Copyright (c) 2025 Philipp Steiner <philipp.steiner1987@gmail.com>
# SPDX-License-Identifier: Apache-2.0

config HEAP_MEM_POOL_ADD_SIZE_BOARD
	int
	default 4096 if BOARD_ADAFRUIT_FEATHER_ESP32S3_TFT_REVERSE_ESP32S3_PROCPU
	default 256 if BOARD_ADAFRUIT_FEATHER_ESP32S3_TFT_REVERSE_ESP32S3_APPCPU
```

## boards/adafruit/feather_esp32s3_tft_reverse/Kconfig.adafruit_feather_esp32s3_tft_reverse
```kconfig
# Copyright (c) 2024 Espressif Systems (Shanghai) Co., Ltd.
# Copyright (c) 2024 Leon Rinkel <leon@rinkel.me>
# Copyright (c) 2025 Philipp Steiner <philipp.steiner1987@gmail.com>
# SPDX-License-Identifier: Apache-2.0

config BOARD_ADAFRUIT_FEATHER_ESP32S3_TFT_REVERSE
	select SOC_ESP32S3_WROOM_N4R2
	select SOC_ESP32S3_PROCPU if BOARD_ADAFRUIT_FEATHER_ESP32S3_TFT_REVERSE_ESP32S3_PROCPU
	select SOC_ESP32S3_APPCPU if BOARD_ADAFRUIT_FEATHER_ESP32S3_TFT_REVERSE_ESP32S3_APPCPU
```

## boards/adafruit/feather_esp32s3_tft_reverse/board.yml
```yaml
board:
  name: adafruit_feather_esp32s3_tft_reverse
  full_name: Adafruit ESP32-S3 Reverse TFT Feather
  vendor: adafruit
  socs:
  - name: esp32s3
```

## boards/adafruit/feather_m0_basic_proto/Kconfig.adafruit_feather_m0_basic_proto
```kconfig
# Copyright (c) 2018 Henrik Brix Andersen <henrik@brixandersen.dk>
# Copyright (c) 2024 Gerson Fernando Budke <nandojve@gmail.com>
# SPDX-License-Identifier: Apache-2.0

config BOARD_ADAFRUIT_FEATHER_M0_BASIC_PROTO
	select SOC_SAMD21G18A
```

## boards/adafruit/feather_m0_basic_proto/board.yml
```yaml
board:
  name: adafruit_feather_m0_basic_proto
  full_name: Feather M0 Basic Proto
  vendor: adafruit
  socs:
    - name: samd21g18a
```

## boards/adafruit/feather_m0_lora/Kconfig.adafruit_feather_m0_lora
```kconfig
# Copyright (c) 2022 Miguel Dardenne <miguel.dardenne@gmail.com>
# Copyright (c) 2024 Gerson Fernando Budke <nandojve@gmail.com>
# SPDX-License-Identifier: Apache-2.0

config BOARD_ADAFRUIT_FEATHER_M0_LORA
	select SOC_SAMD21G18A
```

## boards/adafruit/feather_m0_lora/board.yml
```yaml
board:
  name: adafruit_feather_m0_lora
  full_name: Feather M0 LoRa
  vendor: adafruit
  socs:
    - name: samd21g18a
```

## boards/adafruit/feather_m4_can_express/Kconfig.adafruit_feather_m4_can_express
```kconfig
# Copyright (c) 2024 Daikin Comfort Technologies North America, Inc.
# SPDX-License-Identifier: Apache-2.0

config BOARD_ADAFRUIT_FEATHER_M4_CAN_EXPRESS
	select SOC_SAME51J19A
```

## boards/adafruit/feather_m4_can_express/board.yml
```yaml
board:
  name: adafruit_feather_m4_can_express
  full_name: Feather M4 CAN Express
  vendor: adafruit
  socs:
    - name: same51j19a
```

## boards/adafruit/feather_m4_express/Kconfig.adafruit_feather_m4_express
```kconfig
# Copyright (c) 2024 Daikin Comfort Technologies North America, Inc.
# SPDX-License-Identifier: Apache-2.0

config BOARD_ADAFRUIT_FEATHER_M4_EXPRESS
	select SOC_SAMD51J19A
```

## boards/adafruit/feather_m4_express/adafruit_feather_m4_express_defconfig
```kconfig
# Copyright (c) 2024 Daikin Comfort Technologies North America, Inc.
# SPDX-License-Identifier: Apache-2.0

CONFIG_SOC_ATMEL_SAMD5X_OSCULP32K_AS_MAIN=y

CONFIG_BOOTLOADER_BOSSA=y
CONFIG_BOOTLOADER_BOSSA_ADAFRUIT_UF2=y
CONFIG_BUILD_OUTPUT_HEX=y
CONFIG_BUILD_OUTPUT_UF2=y

CONFIG_ARM_MPU=y
CONFIG_HW_STACK_PROTECTION=y

CONFIG_CONSOLE=y
CONFIG_SERIAL=y
CONFIG_UART_CONSOLE=y
CONFIG_UART_INTERRUPT_DRIVEN=y
```

## boards/adafruit/feather_m4_express/board.yml
```yaml
board:
  name: adafruit_feather_m4_express
  full_name: Feather M4 Express
  vendor: adafruit
  socs:
    - name: samd51j19a
```

## boards/adafruit/feather_nrf52840/Kconfig
```kconfig
# Adafruit Feather nRF52840 boards configuration

# Copyright (c) 2020 Tobias Svehagen
# Copyright (c) 2024 Jacob Winther
# SPDX-License-Identifier: Apache-2.0

if (BOARD_ADAFRUIT_FEATHER_NRF52840_SENSE || BOARD_ADAFRUIT_FEATHER_NRF52840_EXPRESS_UF2)
config BOARD_SERIAL_BACKEND_CDC_ACM
	bool "USB CDC"
	default y

endif # BOARD_ADAFRUIT_FEATHER_NRF52840_SENSE || BOARD_ADAFRUIT_FEATHER_NRF52840_EXPRESS_UF2
```

## boards/adafruit/feather_nrf52840/Kconfig.adafruit_feather_nrf52840_express
```kconfig
# Adafruit Feather nRF52840 Express board configuration

# Copyright (c) 2020 Tobias Svehagen
# Copyright (c) 2024 Jacob Winther
# SPDX-License-Identifier: Apache-2.0

config BOARD_ADAFRUIT_FEATHER_NRF52840_EXPRESS
	select SOC_NRF52840_QIAA
```

## boards/adafruit/feather_nrf52840/Kconfig.defconfig
```kconfig
# Adafruit Feather nRF52840 Express board configuration

# Copyright (c) 2020 Tobias Svehagen
# Copyright (c) 2024 Jacob Winther
# SPDX-License-Identifier: Apache-2.0

if BOARD_ADAFRUIT_FEATHER_NRF52840

if BOARD_ADAFRUIT_FEATHER_NRF52840_NRF52840_UF2 || BOARD_ADAFRUIT_FEATHER_NRF52840_NRF52840_SENSE_UF2

source "boards/common/usb/Kconfig.cdc_acm_serial.defconfig"

endif

endif # BOARD_ADAFRUIT_FEATHER_NRF52840
```
