/*
 * Copyright (c) 2022 Kumar Gala <galak@kernel.org>
 *
 * SPDX-License-Identifier: Apache-2.0
 */

/ {
	dma_test_dmac: dma-test-dmac {
		compatible = "test-dma-memory-to-memory";
		dma = <&dmac>;
	};
};

&dmac {
	status = "okay";
};
