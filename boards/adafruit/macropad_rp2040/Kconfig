## boards/adafruit/macropad_rp2040/Kconfig
```kconfig
# Copyright (c) 2025 Benjamin Cabé <benjamin@zephyrproject.org>
# SPDX-License-Identifier: Apache-2.0

config BOARD_ADAFRUIT_MACROPAD_RP2040
	select RP2_FLASH_W25Q080
```

## boards/adafruit/macropad_rp2040/Kconfig.adafruit_macropad_rp2040
```kconfig
# Copyright (c) 2025 Benjamin Cabé <benjamin@zephyrproject.org>
# SPDX-License-Identifier: Apache-2.0

config BOARD_ADAFRUIT_MACROPAD_RP2040
	bool "Adafruit MacroPad RP2040"
	select SOC_RP2040
```

## boards/adafruit/macropad_rp2040/board.yml
```yaml
board:
  name: adafruit_macropad_rp2040
  full_name: Adafruit MacroPad RP2040
  vendor: adafruit
  socs:
    - name: rp2040
```

## boards/adafruit/metro_esp32s3/Kconfig.adafruit_metro_esp32s3
```kconfig
# Copyright (c) 2024 Espressif Systems (Shanghai) Co., Ltd.
# SPDX-License-Identifier: Apache-2.0

config BOARD_ADAFRUIT_METRO_ESP32S3
	select SOC_ESP32S3_WROOM_N16R8
	select SOC_ESP32S3_PROCPU if BOARD_ADAFRUIT_METRO_ESP32S3_ESP32S3_PROCPU
	select SOC_ESP32S3_APPCPU if BOARD_ADAFRUIT_METRO_ESP32S3_ESP32S3_APPCPU
```

## boards/adafruit/metro_esp32s3/Kconfig.defconfig
```kconfig
# Adafruit Metro ESP32S3 board configuration

# Copyright (c) 2024 Espressif Systems (Shanghai) Co., Ltd.
# SPDX-License-Identifier: Apache-2.0

if BOARD_ADAFRUIT_METRO_ESP32S3_ESP32S3_PROCPU

config HEAP_MEM_POOL_ADD_SIZE_BOARD
	int
	default 65535 if WIFI && BT
	default 51200 if WIFI
	default 40960 if BT
	default 4096

endif # BOARD_ADAFRUIT_METRO_ESP32S3_ESP32S3_PROCPU

if BOARD_ADAFRUIT_METRO_ESP32S3_ESP32S3_APPCPU

config HEAP_MEM_POOL_ADD_SIZE_BOARD
	default 256

endif # BOARD_ADAFRUIT_METRO_ESP32S3_ESP32S3_APPCPU
```

## boards/adafruit/metro_esp32s3/board.yml
```yaml
board:
  name: adafruit_metro_esp32s3
  vendor: adafruit
  socs:
  - name: esp32s3
```

## boards/adafruit/metro_rp2040/board.yml
```yaml
board:
  name: adafruit_metro_rp2040
  full_name: Metro RP2040
  vendor: adafruit
  socs:
  - name: rp2040
```

## boards/adafruit/metro_rp2350/Kconfig.adafruit_metro_rp2350
```kconfig
# Copyright (c) 2025 Pete Johanson
# SPDX-License-Identifier: Apache-2.0

config BOARD_ADAFRUIT_METRO_RP2350
	select SOC_RP2350B_M33 if BOARD_ADAFRUIT_METRO_RP2350_RP2350B_M33
```

## boards/adafruit/metro_rp2350/board.yml
```yaml
board:
  name: adafruit_metro_rp2350
  full_name: Adafruit Metro RP2350
  vendor: adafruit
  socs:
  - name: rp2350b
```

## boards/adafruit/nrf52_adafruit_feather/Kconfig.defconfig
```kconfig
# nRF52 ADAFRUIT FEATHER board configuration

# Copyright (c) 2018 LEDCity AG
# SPDX-License-Identifier: Apache-2.0

if BOARD_NRF52_ADAFRUIT_FEATHER

config BT_CTLR
	default BT

endif # BOARD_NRF52_ADAFRUIT_FEATHER
```

## boards/adafruit/nrf52_adafruit_feather/Kconfig.nrf52_adafruit_feather
```kconfig
# nRF52 ADAFRUIT FEATHER board configuration

# Copyright (c) 2018 LEDCity AG.
# SPDX-License-Identifier: Apache-2.0

config BOARD_NRF52_ADAFRUIT_FEATHER
	select SOC_NRF52832_QFAA
```

## boards/adafruit/nrf52_adafruit_feather/board.yml
```yaml
board:
  name: nrf52_adafruit_feather
  full_name: nRF52 Adafruit Feather
  vendor: adafruit
  socs:
  - name: nrf52832
```

## boards/adafruit/qt_py_ch32v203/Kconfig.adafruit_qt_py_ch32v203
```kconfig
# Copyright (c) 2026 Perry Naseck, MIT Media Lab <pnaseck@media.mit.edu>
# SPDX-License-Identifier: Apache-2.0

config BOARD_ADAFRUIT_QT_PY_CH32V203
	select SOC_CH32V203
```

## boards/adafruit/qt_py_ch32v203/board.yml
```yaml
board:
  name: adafruit_qt_py_ch32v203
  full_name: QT Py CH32V203
  vendor: adafruit
  socs:
    - name: ch32v203
```

## boards/adafruit/qt_py_esp32s3/Kconfig
```kconfig
# Copyright (c) 2024 Ian Wakely

config HEAP_MEM_POOL_ADD_SIZE_BOARD
	int
	default 4096 if BOARD_ADAFRUIT_QT_PY_ESP32S3_ESP32S3_PROCPU
	default 256 if BOARD_ADAFRUIT_QT_PY_ESP32S3_ESP32S3_APPCPU
```

## boards/adafruit/qt_py_esp32s3/Kconfig.adafruit_qt_py_esp32s3
```kconfig
# Adafruit ESP32S3 board configuration

# Copyright (c) 2024 Ian Wakely

config BOARD_ADAFRUIT_QT_PY_ESP32S3
	select SOC_ESP32S3_WROOM_N8 if "$(BOARD_REVISION)" = ""
	select SOC_ESP32S3_WROOM_N4R2 if "$(BOARD_REVISION)" = "psram"
	select SOC_ESP32S3_PROCPU if BOARD_ADAFRUIT_QT_PY_ESP32S3_ESP32S3_PROCPU
	select SOC_ESP32S3_APPCPU if BOARD_ADAFRUIT_QT_PY_ESP32S3_ESP32S3_APPCPU
```

## boards/adafruit/qt_py_esp32s3/board.yml
```yaml
board:
  name: adafruit_qt_py_esp32s3
  full_name: QT Py ESP32-S3
  vendor: adafruit
  socs:
  - name: esp32s3
  revision:
    format: "custom"
    default: ""
    revisions:
    - name: ""
    - name: "psram"
```

## boards/adafruit/qt_py_rp2040/Kconfig
```kconfig
# Copyright (c) 2022 Peter Johanson
# SPDX-License-Identifier: Apache-2.0

config BOARD_ADAFRUIT_QT_PY_RP2040
	select RP2_FLASH_W25Q080
```

## boards/adafruit/qt_py_rp2040/Kconfig.adafruit_qt_py_rp2040
```kconfig
# Copyright (c) 2022 Kelly Lord
# SPDX-License-Identifier: Apache-2.0

config BOARD_ADAFRUIT_QT_PY_RP2040
	select SOC_RP2040
```

## boards/adafruit/qt_py_rp2040/board.yml
```yaml
board:
  name: adafruit_qt_py_rp2040
  full_name: QT Py RP2040
  vendor: adafruit
  socs:
  - name: rp2040
```

## boards/adafruit/trinket_m0/Kconfig.adafruit_trinket_m0
```kconfig
# Copyright (c) 2018 Google LLC.
# Copyright (c) 2024 Gerson Fernando Budke <nandojve@gmail.com>
# SPDX-License-Identifier: Apache-2.0

config BOARD_ADAFRUIT_TRINKET_M0
	select SOC_SAMD21E18A
```

## boards/adafruit/trinket_m0/board.yml
```yaml
board:
  name: adafruit_trinket_m0
  full_name: Trinket M0
  vendor: adafruit
  socs:
    - name: samd21e18a
```

## boards/adafruit/trinkey_qt2040/Kconfig.adafruit_trinkey_qt2040
```kconfig
# Copyright (c) 2025 Jonas Berg
# SPDX-License-Identifier: Apache-2.0

config BOARD_ADAFRUIT_TRINKEY_QT2040
	select SOC_RP2040
```

## boards/adafruit/trinkey_qt2040/board.yml
```yaml
board:
  name: adafruit_trinkey_qt2040
  full_name: Trinkey QT2040
  vendor: adafruit
  socs:
  - name: rp2040
```

## boards/adafruit/trrs_trinkey/Kconfig.adafruit_trrs_trinkey
```kconfig
# Copyright (c) 2018 Google LLC.
# Copyright (c) 2024 Gerson Fernando Budke <nandojve@gmail.com>
# Copyright (c) 2025 Perry Naseck, MIT Media Lab <pnaseck@media.mit.edu>
# SPDX-License-Identifier: Apache-2.0

config BOARD_ADAFRUIT_TRRS_TRINKEY
	select SOC_SAMD21E18A
```
