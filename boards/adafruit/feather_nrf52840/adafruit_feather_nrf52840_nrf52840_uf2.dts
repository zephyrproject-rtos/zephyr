/*
 * Copyright (c) 2024 Jacob Winther
 *
 * SPDX-License-Identifier: Apache-2.0
 */

/dts-v1/;
#include "adafruit_feather_nrf52840_common.dtsi"
#include <nordic/nrf52840_partition_uf2_sdv6.dtsi>
#include <../boards/common/usb/cdc_acm_serial.dtsi>

/ {
	compatible = "adafruit,feather-nrf52840-uf2";
	model = "Adafruit Feather nRF52840 Express";

	leds {
		led0: led_0 {
			gpios = <&gpio1 15 0>;
		};
	};
};
