## boards/adafruit/feather_nrf52840/adafruit_feather_nrf52840_defconfig
```kconfig
# SPDX-License-Identifier: Apache-2.0

# Enable MPU
CONFIG_ARM_MPU=y

# Enable GPIO
CONFIG_GPIO=y

# Enable UART driver
CONFIG_SERIAL=y

# Enable console
CONFIG_CONSOLE=y
CONFIG_UART_CONSOLE=y
```

## boards/adafruit/feather_nrf52840/adafruit_feather_nrf52840_express_uf2_defconfig
```kconfig
# SPDX-License-Identifier: Apache-2.0

# Enable MPU
CONFIG_ARM_MPU=y

# enable GPIO
CONFIG_GPIO=y

# enable uart driver
CONFIG_SERIAL=y

# enable console
CONFIG_CONSOLE=y
CONFIG_UART_CONSOLE=y

# Logger cannot use itself to log
CONFIG_USB_CDC_ACM_LOG_LEVEL_OFF=y

# Enable USB
CONFIG_USB_DEVICE_STACK=y

# enable bossac
CONFIG_BOOTLOADER_BOSSA=y
CONFIG_BOOTLOADER_BOSSA_ADAFRUIT_UF2=y

# Build UF2 by default, supported by the Adafruit nRF52 Bootloader
CONFIG_BUILD_OUTPUT_UF2=y
```

## boards/adafruit/feather_nrf52840/adafruit_feather_nrf52840_nrf52840_sense_uf2_defconfig
```kconfig
# SPDX-License-Identifier: Apache-2.0

# Enable MPU
CONFIG_ARM_MPU=y

# Enable GPIO
CONFIG_GPIO=y

# Enable UART driver
CONFIG_SERIAL=y

# Enable console
CONFIG_CONSOLE=y
CONFIG_UART_CONSOLE=y

# 32kHz clock source
CONFIG_CLOCK_CONTROL_NRF_K32SRC_RC=y
CONFIG_CLOCK_CONTROL_NRF_K32SRC_500PPM=y

# Build UF2 by default, supported by the Adafruit nRF52 Bootloader
CONFIG_BUILD_OUTPUT_UF2=y
```

## boards/adafruit/feather_nrf52840/adafruit_feather_nrf52840_nrf52840_uf2_defconfig
```kconfig
# SPDX-License-Identifier: Apache-2.0

# Enable MPU
CONFIG_ARM_MPU=y

# Enable GPIO
CONFIG_GPIO=y

# Enable UART driver
CONFIG_SERIAL=y

# Enable console
CONFIG_CONSOLE=y
CONFIG_UART_CONSOLE=y

# Logger cannot use itself to log
CONFIG_USB_CDC_ACM_LOG_LEVEL_OFF=y

# Enable USB
CONFIG_USB_DEVICE_STACK=y
CONFIG_USB_DEVICE_INITIALIZE_AT_BOOT=y

# Build UF2 by default, supported by the Adafruit nRF52 Bootloader
CONFIG_BUILD_OUTPUT_UF2=y
```

## boards/adafruit/feather_nrf52840/adafruit_feather_nrf52840_sense_defconfig
```kconfig
# SPDX-License-Identifier: Apache-2.0

# Enable MPU
CONFIG_ARM_MPU=y

# enable GPIO
CONFIG_GPIO=y

# enable uart driver
CONFIG_SERIAL=y

# enable console
CONFIG_CONSOLE=y
CONFIG_UART_CONSOLE=y

# 32kHz clock source
CONFIG_CLOCK_CONTROL_NRF_K32SRC_RC=y
CONFIG_CLOCK_CONTROL_NRF_K32SRC_500PPM=y

# enable bossac
CONFIG_BOOTLOADER_BOSSA=y
CONFIG_BOOTLOADER_BOSSA_ADAFRUIT_UF2=y

# Build UF2 by default, supported by the Adafruit nRF52 Bootloader
CONFIG_BUILD_OUTPUT_UF2=y
```

## boards/adafruit/feather_nrf52840/board.yml
```yaml
board:
  name: adafruit_feather_nrf52840
  full_name: Feather nRF52840 (Express, Sense)
  vendor: adafruit
  socs:
    - name: nrf52840
      variants:
        - name: uf2
        - name: sense
          variants:
            - name: uf2
```

## boards/adafruit/feather_propmaker_rp2040/board.yml
```yaml
board:
  name: adafruit_feather_propmaker_rp2040
  full_name: RP2040 Prop-Maker Feather
  vendor: adafruit
  socs:
  - name: rp2040
```

## boards/adafruit/feather_rfm95_rp2040/board.yml
```yaml
board:
  name: adafruit_feather_rfm95_rp2040
  full_name: Feather RP2040 RFM95 Lora
  vendor: adafruit
  socs:
  - name: rp2040
```

## boards/adafruit/feather_rp2040/Kconfig.adafruit_feather_rp2040
```kconfig
# Copyright The Zephyr Project Contributors
# SPDX-License-Identifier: Apache-2.0

config BOARD_ADAFRUIT_FEATHER_RP2040
	select SOC_RP2040
```

## boards/adafruit/feather_rp2040/board.yml
```yaml
board:
  name: adafruit_feather_rp2040
  full_name: Feather RP2040
  vendor: adafruit
  socs:
  - name: rp2040
```

## boards/adafruit/feather_scorpio_rp2040/Kconfig.adafruit_feather_scorpio_rp2040
```kconfig
# Copyright (c) 2026 Jonas Berg
# SPDX-License-Identifier: Apache-2.0

config BOARD_ADAFRUIT_FEATHER_SCORPIO_RP2040
	select SOC_RP2040
```

## boards/adafruit/feather_scorpio_rp2040/board.yml
```yaml
board:
  name: adafruit_feather_scorpio_rp2040
  full_name: RP2040 Scorpio Feather
  vendor: adafruit
  socs:
  - name: rp2040
```

## boards/adafruit/feather_stm32f405/Kconfig.adafruit_feather_stm32f405
```kconfig
# Copyright (c) 2020 Lucian Copeland for Adafruit Industries
# SPDX-License-Identifier: Apache-2.0

config BOARD_ADAFRUIT_FEATHER_STM32F405
	select SOC_STM32F405XX
```

## boards/adafruit/feather_stm32f405/board.yml
```yaml
board:
  name: adafruit_feather_stm32f405
  full_name: Feather STM32F405 Express
  vendor: adafruit
  socs:
    - name: stm32f405xx
```

## boards/adafruit/grand_central_m4_express/Kconfig.adafruit_grand_central_m4_express
```kconfig
# Copyright (c) 2023 Lukas Jung <lukas.jung@mailbox.org>
# Copyright (c) 2024 Gerson Fernando Budke <nandojve@gmail.com>
# SPDX-License-Identifier: Apache-2.0

config BOARD_ADAFRUIT_GRAND_CENTRAL_M4_EXPRESS
	select SOC_SAMD51P20A
```

## boards/adafruit/grand_central_m4_express/board.yml
```yaml
board:
  name: adafruit_grand_central_m4_express
  full_name: Grand Central M4 Express
  vendor: adafruit
  socs:
    - name: samd51p20a
```

## boards/adafruit/itsybitsy/Kconfig.adafruit_itsybitsy
```kconfig
# Adafruit ItsyBitsy nRF52840 Express board configuration

# Copyright (c) 2022 Embla Flatlandsmo <embla.flatlandsmo@gmail.com>
# SPDX-License-Identifier: Apache-2.0

config BOARD_ADAFRUIT_ITSYBITSY
	select SOC_NRF52840_QIAA
```

## boards/adafruit/itsybitsy/Kconfig.defconfig
```kconfig
# Adafruit ItsyBitsy nRF52840 Express board configuration

# Copyright (c) 2022 Embla Flatlandsmo <embla.flatlandsmo@gmail.com>
# SPDX-License-Identifier: Apache-2.0

if BOARD_ADAFRUIT_ITSYBITSY

source "boards/common/usb/Kconfig.cdc_acm_serial.defconfig"

endif # BOARD_ADAFRUIT_ITSYBITSY
```

## boards/adafruit/itsybitsy/adafruit_itsybitsy_nrf52840_defconfig
```kconfig
# SPDX-License-Identifier: Apache-2.0

# Enable MPU
CONFIG_ARM_MPU=y

# enable GPIO
CONFIG_GPIO=y

# enable uart driver
CONFIG_SERIAL=y

# enable console
CONFIG_CONSOLE=y
CONFIG_UART_CONSOLE=y

# Flashing
CONFIG_USE_DT_CODE_PARTITION=y
CONFIG_BUILD_OUTPUT_UF2=y
```

## boards/adafruit/itsybitsy/board.yml
```yaml
board:
  name: adafruit_itsybitsy
  full_name: ItsyBitsy nRF52840
  vendor: adafruit
  socs:
  - name: nrf52840
```

## boards/adafruit/itsybitsy_m4_express/Kconfig.adafruit_itsybitsy_m4_express
```kconfig
# Copyright (c) 2020 Google LLC.
# Copyright (c) 2024 Gerson Fernando Budke <nandojve@gmail.com>
# SPDX-License-Identifier: Apache-2.0

config BOARD_ADAFRUIT_ITSYBITSY_M4_EXPRESS
	select SOC_SAMD51G19A
```

## boards/adafruit/itsybitsy_m4_express/board.yml
```yaml
board:
  name: adafruit_itsybitsy_m4_express
  vendor: adafruit
  socs:
    - name: samd51g19a
```

## boards/adafruit/itsybitsy_rp2040/board.yml
```yaml
board:
  name: adafruit_itsybitsy_rp2040
  full_name: Itsybitsy RP2040
  vendor: adafruit
  socs:
  - name: rp2040
```

## boards/adafruit/kb2040/Kconfig
```kconfig
# Copyright (c) 2022 Peter Johanson
# SPDX-License-Identifier: Apache-2.0

config BOARD_ADAFRUIT_KB2040
	select RP2_FLASH_W25Q080
```

## boards/adafruit/kb2040/board.yml
```yaml
board:
  name: adafruit_kb2040
  full_name: KB2040
  vendor: adafruit
  socs:
  - name: rp2040
```
