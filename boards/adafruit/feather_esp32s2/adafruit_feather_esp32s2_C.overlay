/*
 * Copyright (c) 2025 Philipp Steiner <philipp.steiner1987@gmail.com>
 *
 * SPDX-License-Identifier: Apache-2.0
 */

/ {
	/*
	 * On-board regulator powers I2C pull-ups and external devices connected
	 * via the STEMMA QT connector.
	 */
	i2c_reg: i2c_reg {
		compatible = "power-domain-gpio";
		label = "I2C Power";
		#power-domain-cells = <0>;
		enable-gpios = <&gpio0 7 GPIO_ACTIVE_HIGH>;
		startup-delay-us = <10>;
	};
};
