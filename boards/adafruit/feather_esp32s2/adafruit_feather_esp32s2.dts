/*
 * Copyright (c) 2025 Philipp Steiner
 *
 * SPDX-License-Identifier: Apache-2.0
 */

/dts-v1/;

#include "adafruit_feather_esp32s2_common.dtsi"
#include "feather_connector.dtsi"

/ {
	compatible = "espressif,esp32s2";
	model = "Adafruit Feather ESP32-S2";
};
