## boards/adafruit/trrs_trinkey/Kconfig.defconfig
```kconfig
# Adafruit TRRS Trinkey board configuration

# Copyright (c) 2022 Embla Flatlandsmo <embla.flatlandsmo@gmail.com>
# Copyright (c) 2025 Perry Naseck, MIT Media Lab <pnaseck@media.mit.edu>
# SPDX-License-Identifier: Apache-2.0

if BOARD_ADAFRUIT_TRRS_TRINKEY

source "boards/common/usb/Kconfig.cdc_acm_serial.defconfig"

endif # BOARD_ADAFRUIT_TRRS_TRINKEY
```

## boards/adafruit/trrs_trinkey/adafruit_trrs_trinkey_defconfig
```kconfig
# Copyright (c) 2024 Gerson Fernando Budke <nandojve@gmail.com>
# Copyright (c) 2025 Perry Naseck, MIT Media Lab <pnaseck@media.mit.edu>
# SPDX-License-Identifier: Apache-2.0

CONFIG_SOC_ATMEL_SAMD_OSC8M=y
CONFIG_SOC_ATMEL_SAMD_OSC8M_AS_MAIN=y

CONFIG_BOOTLOADER_BOSSA=y
CONFIG_BOOTLOADER_BOSSA_ADAFRUIT_UF2=y
CONFIG_BUILD_OUTPUT_UF2=y
CONFIG_BUILD_OUTPUT_HEX=y

CONFIG_CONSOLE=y
CONFIG_SERIAL=y
CONFIG_UART_CONSOLE=y
CONFIG_UART_INTERRUPT_DRIVEN=y
```

## boards/adafruit/trrs_trinkey/board.yml
```yaml
board:
  name: adafruit_trrs_trinkey
  full_name: TRRS Trinkey
  vendor: adafruit
  socs:
    - name: samd21e18a
```

## boards/adi/ad_swiot1l_sl/Kconfig.ad_swiot1l_sl
```kconfig
# AD-SWIOT1L-SL board configuration

# Copyright (c) 2025 Analog Devices, Inc.
# SPDX-License-Identifier: Apache-2.0

config BOARD_AD_SWIOT1L_SL
	select SOC_MAX32650
```

## boards/adi/ad_swiot1l_sl/ad_swiot1l_sl_defconfig
```kconfig
# Copyright (c) 2025 Analog Devices, Inc.
# SPDX-License-Identifier: Apache-2.0

# Enable MPU
CONFIG_ARM_MPU=y

# Enable GPIO
CONFIG_GPIO=y

# Console
CONFIG_CONSOLE=y
CONFIG_UART_CONSOLE=y

# Enable UART
CONFIG_SERIAL=y
CONFIG_UART_INTERRUPT_DRIVEN=y
```

## boards/adi/ad_swiot1l_sl/board.yml
```yaml
# Copyright (c) 2025 Analog Devices, Inc.
# SPDX-License-Identifier: Apache-2.0

board:
  name: ad_swiot1l_sl
  full_name: AD-SWIOT1L-SL
  vendor: adi
  socs:
    - name: max32650
```

## boards/adi/apard32690/Kconfig
```kconfig
# ADI APARD32690 board

# Copyright (c) 2026 Analog Devices, Inc
# SPDX-License-Identifier: Apache-2.0

config BOARD_APARD32690_ENABLE_QSPI_FLASHING
	bool "Set up QSPI flash bank within OpenOCD"
	default y if CODE_DATA_RELOCATION
	help
	  When using code relocation to place code into external flash accessed
	  with the SPIXF peripheral, ensure OpenOCD will initialize the bank
	  so the code relocated there can be flashed along with the rest of the
	  code located on internal flash.
```

## boards/adi/apard32690/Kconfig.apard32690
```kconfig
# MAX32690 board configuration

# Copyright (c) 2024 Analog Devices, Inc.
# SPDX-License-Identifier: Apache-2.0

config BOARD_APARD32690
	select SOC_MAX32690_M4 if BOARD_APARD32690_MAX32690_M4
```

## boards/adi/apard32690/board.yml
```yaml
# Copyright (c) 2024 Analog Devices, Inc.
# SPDX-License-Identifier: Apache-2.0

board:
  name: apard32690
  full_name: AD-APARD32690-SL
  vendor: adi
  socs:
    - name: max32690
  revision:
    format: letter
    default: D
    exact: true
    revisions:
      - name: D
      - name: E
```

## boards/adi/eval_adin1110ebz/Kconfig.adi_eval_adin1110ebz
```kconfig
# Copyright (c) 2024 BayLibre
# SPDX-License-Identifier: Apache-2.0

config BOARD_ADI_EVAL_ADIN1110EBZ
	select SOC_STM32L4S5XX
```

## boards/adi/eval_adin1110ebz/Kconfig.defconfig
```kconfig
# ADI EVAL-ADIN1110EBZ board configuration

# Copyright (c) 2024 BayLibre
# SPDX-License-Identifier: Apache-2.0

if BOARD_ADI_EVAL_ADIN1110EBZ

configdefault SPI_STM32_DMA
	default y

config MEMC
	default y

configdefault NET_L2_ETHERNET
	default y

endif # BOARD_ADI_EVAL_ADIN1110EBZ
```

## boards/adi/eval_adin1110ebz/board.yml
```yaml
board:
  name: adi_eval_adin1110ebz
  full_name: EVAL-ADIN1110EVB Evaluation board
  vendor: adi
  socs:
    - name: stm32l4s5xx
```

## boards/adi/eval_adin2111d1z/Kconfig.adi_eval_adin2111d1z
```kconfig
# EVAL ADIN2111D1Z board configuration

# Copyright (c) 2023-2024 Analog Devices, Inc.
# SPDX-License-Identifier: Apache-2.0

config BOARD_ADI_EVAL_ADIN2111D1Z
	select SOC_MAX32690_M4
```

## boards/adi/eval_adin2111d1z/board.yml
```yaml
# Copyright (c) 2023-2024 Analog Devices, Inc.
# SPDX-License-Identifier: Apache-2.0

board:
  name: adi_eval_adin2111d1z
  full_name: EVAL-ADIN2111D1Z
  vendor: adi
  socs:
    - name: max32690
```

## boards/adi/eval_adin2111ebz/Kconfig.defconfig
```kconfig
# ADI EVAL-ADIN2111EBZ board configuration

# Copyright (c) 2024 BayLibre
# SPDX-License-Identifier: Apache-2.0

if BOARD_ADI_EVAL_ADIN2111EBZ

configdefault MDIO_INIT_PRIORITY
	default 81

configdefault PHY_INIT_PRIORITY
	default 82

configdefault SPI_STM32_DMA
	default y

configdefault NET_L2_ETHERNET
	default y

if ETH_ADIN2111

configdefault NET_IF_MAX_IPV4_COUNT
	default 2

endif # ETH_ADIN2111

endif # BOARD_ADI_EVAL_ADIN2111EBZ
```

## boards/adi/eval_adin2111ebz/board.yml
```yaml
board:
  name: adi_eval_adin2111ebz
  full_name: EVAL-ADIN2111EVB Evaluation board
  vendor: adi
  socs:
    - name: stm32l4s5xx
```

## boards/adi/max32650evkit/Kconfig.max32650evkit
```kconfig
# MAX32650EVKIT boards configuration

# Copyright (c) 2025 Analog Devices, Inc.
# SPDX-License-Identifier: Apache-2.0

config BOARD_MAX32650EVKIT
	select SOC_MAX32650
```

## boards/adi/max32650evkit/board.yml
```yaml
# Copyright (c) 2025 Analog Devices, Inc.
# SPDX-License-Identifier: Apache-2.0

board:
  name: max32650evkit
  full_name: MAX32650EVKIT
  vendor: adi
  socs:
    - name: max32650
```

## boards/adi/max32650fthr/Kconfig.max32650fthr
```kconfig
# MAX32650FTHR board configuration

# Copyright (c) 2025 Analog Devices, Inc.
# SPDX-License-Identifier: Apache-2.0

config BOARD_MAX32650FTHR
	select SOC_MAX32650
```

## boards/adi/max32650fthr/board.yml
```yaml
# Copyright (c) 2025 Analog Devices, Inc.
# SPDX-License-Identifier: Apache-2.0

board:
  name: max32650fthr
  full_name: MAX32650FTHR
  vendor: adi
  socs:
    - name: max32650
```

## boards/adi/max32651evkit/Kconfig.max32651evkit
```kconfig
# MAX32651EVKIT boards configuration

# Copyright (c) 2026 Analog Devices, Inc.
# SPDX-License-Identifier: Apache-2.0

config BOARD_MAX32651EVKIT
	select SOC_MAX32651
```

## boards/adi/max32651evkit/board.yml
```yaml
# Copyright (c) 2026 Analog Devices, Inc.
# SPDX-License-Identifier: Apache-2.0

board:
  name: max32651evkit
  full_name: MAX32651EVKIT
  vendor: adi
  socs:
    - name: max32651
```

## boards/adi/max32655evkit/Kconfig.max32655evkit
```kconfig
# MAX32655EVKIT boards configuration

# Copyright (c) 2023-2024 Analog Devices, Inc.
# SPDX-License-Identifier: Apache-2.0

config BOARD_MAX32655EVKIT
	select SOC_MAX32655_M4 if BOARD_MAX32655EVKIT_MAX32655_M4
```

## boards/adi/max32655evkit/board.yml
```yaml
# Copyright (c) 2023-2024 Analog Devices, Inc.
# SPDX-License-Identifier: Apache-2.0

board:
  name: max32655evkit
  full_name: MAX32655EVKIT
  vendor: adi
  socs:
    - name: max32655
```

## boards/adi/max32655evkit/max32655evkit_max32655_rv32_defconfig
```kconfig
# Copyright (c) 2023-2024 Analog Devices, Inc.
# SPDX-License-Identifier: Apache-2.0

CONFIG_SYS_CLOCK_EXISTS=n

# Console
CONFIG_CONSOLE=y
CONFIG_UART_CONSOLE=y

# Enable UART
CONFIG_SERIAL=y
CONFIG_UART_INTERRUPT_DRIVEN=y

CONFIG_USE_DT_CODE_PARTITION=y
```
