## boards/atmark_techno/degu_evk/Kconfig
```kconfig
# Degu Evaluation Kit configuration

# Copyright (c) 2019 Atmark Techno, Inc.
# SPDX-License-Identifier: Apache-2.0

config BOARD_ENABLE_DCDC
	bool "DCDC mode"
	select SOC_DCDC_NRF52X
	default y
	depends on BOARD_DEGU_EVK
```

## boards/atmark_techno/degu_evk/degu_evk_defconfig
```kconfig
# SPDX-License-Identifier: Apache-2.0

# Enable MPU
CONFIG_ARM_MPU=y

# Enable UART driver
CONFIG_SERIAL=y

# Enable console
CONFIG_CONSOLE=y
CONFIG_UART_CONSOLE=y

# Enable USB (for CDC ACM console)
CONFIG_USB_DEVICE_STACK=y

# Additional board options
CONFIG_GPIO=y

# Required to enable 3V3 power rail and Vin1 monitor
CONFIG_REGULATOR=y
```

## boards/atmarktechno/degu_evk/Kconfig.defconfig
```kconfig
# Degu Evaluation Kit configuration

# Copyright (c) 2019 Atmark Techno, Inc.
# SPDX-License-Identifier: Apache-2.0

if BOARD_DEGU_EVK

source "boards/common/usb/Kconfig.cdc_acm_serial.defconfig"

endif # BOARD_DEGU_EVK
```

## boards/atmarktechno/degu_evk/board.yml
```yaml
board:
  name: degu_evk
  full_name: Degu Evaluation Kit
  vendor: atmarktechno
  socs:
  - name: nrf52840
```

## boards/atmel/sam/sam4e_xpro/Kconfig.defconfig
```kconfig
# Copyright (c) 2024 Gerson Fernando Budke <nandojve@gmail.com>
# SPDX-License-Identifier: Apache-2.0

if NETWORKING

config NET_L2_ETHERNET
	default y

endif # NETWORKING
```

## boards/atmel/sam/sam4e_xpro/Kconfig.sam4e_xpro
```kconfig
# Copyright (c) 2019-2024 Gerson Fernando Budke
# SPDX-License-Identifier: Apache-2.0

config BOARD_SAM4E_XPRO
	select SOC_SAM4E16E
```

## boards/atmel/sam/sam4e_xpro/board.yml
```yaml
board:
  name: sam4e_xpro
  full_name: SAM4E Xplained Pro
  vendor: atmel
  socs:
    - name: sam4e16e
```

## boards/atmel/sam/sam4e_xpro/sam4e_xpro_sam4e16e_defconfig
```kconfig
# SPDX-License-Identifier: Apache-2.0

CONFIG_BUILD_OUTPUT_HEX=y

CONFIG_ARM_MPU=y
CONFIG_HW_STACK_PROTECTION=y
CONFIG_WDT_DISABLE_AT_BOOT=y

CONFIG_CONSOLE=y
CONFIG_SERIAL=y
CONFIG_UART_CONSOLE=y
```

## boards/atmel/sam/sam4l_ek/Kconfig.sam4l_ek
```kconfig
# Copyright (c) 2020-2024 Gerson Fernando Budke <nandojve@gmail.com>
# SPDX-License-Identifier: Apache-2.0

config BOARD_SAM4L_EK
	select SOC_SAM4LC4C
```

## boards/atmel/sam/sam4l_ek/board.yml
```yaml
board:
  name: sam4l_ek
  full_name: SAM4L-EK
  vendor: atmel
  socs:
    - name: sam4lc4c
```

## boards/atmel/sam/sam4s_xplained/Kconfig.sam4s_xplained
```kconfig
# Copyright (c) 2024 Gerson Fernando Budke <nandojve@gmail.com>
# SPDX-License-Identifier: Apache-2.0

config BOARD_SAM4S_XPLAINED
	select SOC_SAM4S16C
```

## boards/atmel/sam/sam4s_xplained/board.yml
```yaml
board:
  name: sam4s_xplained
  full_name: SAM4S Xplained
  vendor: atmel
  socs:
    - name: sam4s16c
```

## boards/atmel/sam/sam_e70_xplained/Kconfig.defconfig
```kconfig
# Atmel SMART SAM E70 Xplained Board configuration

# Copyright (c) 2016 Piotr Mienkowski
# SPDX-License-Identifier: Apache-2.0

if ETH_SAM_GMAC

# Read MAC address from AT24MAC402 EEPROM

config EEPROM
	default y

config NVMEM
	default y

endif # ETH_SAM_GMAC

if NETWORKING

config NET_L2_ETHERNET
	default y

endif # NETWORKING
```

## boards/atmel/sam/sam_e70_xplained/Kconfig.sam_e70_xplained
```kconfig
# Copyright (c) 2016 Piotr Mienkowski
# Copyright (c) 2024 Gerson Fernando Budke <nandojve@gmail.com>
# SPDX-License-Identifier: Apache-2.0

config BOARD_SAM_E70_XPLAINED
	select SOC_SAME70Q21 if BOARD_SAM_E70_XPLAINED_SAME70Q21
	select SOC_SAME70Q21B if BOARD_SAM_E70_XPLAINED_SAME70Q21B
```

## boards/atmel/sam/sam_e70_xplained/board.yml
```yaml
board:
  name: sam_e70_xplained
  full_name: SAM E70(B) Xplained
  vendor: atmel
  socs:
    - name: same70q21
    - name: same70q21b
```

## boards/atmel/sam/sam_v71_xult/Kconfig.defconfig
```kconfig
# Atmel SMART SAM V71 Xplained Board configuration

# Copyright (c) 2019 Gerson Fernando Budke
# Copyright (c) 2016 Piotr Mienkowski
# SPDX-License-Identifier: Apache-2.0

if ETH_SAM_GMAC

# Read MAC address from AT24MAC402 EEPROM

config EEPROM
	default y

config NVMEM
	default y

endif # ETH_SAM_GMAC

if NETWORKING

config NET_L2_ETHERNET
	default y

endif # NETWORKING
```

## boards/atmel/sam/sam_v71_xult/Kconfig.sam_v71_xult
```kconfig
# Copyright (c) 2016 Piotr Mienkowski
# Copyright (c) 2024 Gerson Fernando Budke <nandojve@gmail.com>
# SPDX-License-Identifier: Apache-2.0

config BOARD_SAM_V71_XULT
	select SOC_SAMV71Q21 if BOARD_SAM_V71_XULT_SAMV71Q21
	select SOC_SAMV71Q21B if BOARD_SAM_V71_XULT_SAMV71Q21B
```

## boards/atmel/sam/sam_v71_xult/board.yml
```yaml
board:
  name: sam_v71_xult
  full_name: SAM V71(B) Xplained Ultra
  vendor: atmel
  socs:
    - name: samv71q21
    - name: samv71q21b
```

## boards/atmel/sam0/samc21n_xpro/Kconfig.samc21n_xpro
```kconfig
# Copyright (c) 2022 Kamil Serwus
# Copyright (c) 2024 Gerson Fernando Budke <nandojve@gmail.com>
# SPDX-License-Identifier: Apache-2.0

config BOARD_SAMC21N_XPRO
	select SOC_SAMC21N18A
```

## boards/atmel/sam0/samc21n_xpro/board.yml
```yaml
board:
  name: samc21n_xpro
  full_name: SAM C21N Xplained Pro Evaluation Kit
  vendor: atmel
  socs:
    - name: samc21n18a
```

## boards/atmel/sam0/samc21n_xpro/samc21n_xpro_defconfig
```kconfig
# Copyright (c) 2022 Kamil Serwus
# Copyright (c) 2024 Gerson Fernando Budke <nandojve@gmail.com>
# SPDX-License-Identifier: Apache-2.0

CONFIG_BUILD_OUTPUT_HEX=y

CONFIG_CONSOLE=y
CONFIG_SERIAL=y
CONFIG_UART_CONSOLE=y
CONFIG_UART_INTERRUPT_DRIVEN=y
```

## boards/atmel/sam0/samd20_xpro/Kconfig.samd20_xpro
```kconfig
# Copyright (c) 2018 Sean Nyekjaer
# Copyright (c) 2024 Gerson Fernando Budke <nandojve@gmail.com>
# SPDX-License-Identifier: Apache-2.0

config BOARD_SAMD20_XPRO
	select SOC_SAMD20J18
```

## boards/atmel/sam0/samd20_xpro/board.yml
```yaml
board:
  name: samd20_xpro
  full_name: SAM D20 Xplained Pro Evaluation Kit
  vendor: atmel
  socs:
    - name: samd20j18
```

## boards/atmel/sam0/samd21_xpro/Kconfig.samd21_xpro
```kconfig
# Copyright (c) 2018 Bryan O'Donoghue
# Copyright (c) 2024 Gerson Fernando Budke <nandojve@gmail.com>
# SPDX-License-Identifier: Apache-2.0

config BOARD_SAMD21_XPRO
	select SOC_SAMD21J18A
```
