/*
 * SPDX-FileCopyrightText: Copyright The Zephyr Project Contributors
 *
 * SPDX-License-Identifier: Apache-2.0
 *
 * HiFive Unleashed as emulated by the sifive_u machine of QEMU.
 */

#include "hifive_unleashed_u54.dts"

/* QEMU has no QSPI1 */
&spi1 {
	status = "disabled";
};

/* The GEM of QEMU does not timestamp frames and its 1588 timer does not run */
&eth0_ptp {
	status = "disabled";
};
