/*
 * Copyright (c) 2024 Antmicro <www.antmicro.com>
 *
 * SPDX-License-Identifier: Apache-2.0
 */

#include "hifive1.dts"

/ {
	compatible = "sifive,hifive1_revb";
	model = "SiFive HiFive 1 Rev. B";
};

&uart1 {
	current-speed = <115200>;
	status = "okay";
};

&spi0 {
	reg = <0x10014000 0x1000 0x20010000 0x3c0900>;
};

&spi2 {
	pinctrl-0 = <&spi1_cs2_default
		     &spi1_mosi_default
		     &spi1_miso_default
		     &spi1_sck_default>;
	pinctrl-names = "default";
	status = "okay";
};
