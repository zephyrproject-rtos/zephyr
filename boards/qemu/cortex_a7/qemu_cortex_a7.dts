/*
 * Copyright (c) Qualcomm Technologies, Inc. and/or its subsidiaries.
 *
 * SPDX-License-Identifier: Apache-2.0
 */

/dts-v1/;
#include <arm/qemu/qemu-virt-a7.dtsi>

/ {
	model = "QEMU Cortex-A7";
	compatible = "qemu,arm-cortex-a7";

	chosen {
		zephyr,sram = &sram0;
		zephyr,console = &uart0;
		zephyr,shell-uart = &uart0;
		zephyr,flash = &flash0;
	};
};

&uart0 {
	status = "okay";
	current-speed = <115200>;
};
