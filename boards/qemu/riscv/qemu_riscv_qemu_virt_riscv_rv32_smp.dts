/*
 * SPDX-FileCopyrightText: Copyright The Zephyr Project Contributors
 *
 * SPDX-License-Identifier: Apache-2.0
 *
 */

/dts-v1/;

#include <qemu/virt-riscv32.dtsi>
#include "qemu_riscv_qemu_virt_riscv.dtsi"
