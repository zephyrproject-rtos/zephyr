/*
 * Copyright (c) 2020, Synopsys, Inc. All rights reserved.
 *
 * SPDX-License-Identifier: Apache-2.0
 */

/dts-v1/;

#include "qemu_arc.dtsi"

/ {
	compatible = "snps,qemu-arcem";
	model = "QEMU ARC EM";

	cpus {
		#address-cells = <1>;
		#size-cells = <0>;

		cpu@0 {
			compatible = "snps,arcem";
			reg = <0>;
			device_type = "cpu";
		};
	};
};
