/*
 * Copyright (c) 2020, Synopsys, Inc. All rights reserved.
 *
 * SPDX-License-Identifier: Apache-2.0
 */

/dts-v1/;

#include "qemu_arc.dtsi"

/ {
	compatible = "snps,qemu-archs";
	model = "QEMU ARC HS";

	cpus {
		#address-cells = <1>;
		#size-cells = <0>;

		cpu@0 {
			compatible = "snps,archs";
			reg = <0>;
			device_type = "cpu";
		};
	};
};
