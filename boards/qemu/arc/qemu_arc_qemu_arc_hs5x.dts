/*
 * Copyright (c) 2022, Synopsys, Inc. All rights reserved.
 *
 * SPDX-License-Identifier: Apache-2.0
 */

/dts-v1/;

#include "qemu_arc.dtsi"

/ {
	model = "QEMU ARC HS";
	compatible = "snps,qemu-archs";

	cpus {
		#address-cells = <1>;
		#size-cells = <0>;

		cpu@0 {
			device_type = "cpu";
			compatible = "snps,archs";
			reg = <0>;
		};
	};
};
