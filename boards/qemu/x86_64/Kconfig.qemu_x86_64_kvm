## boards/qemu/x86_64/Kconfig.qemu_x86_64_kvm
```kconfig
# Copyright (c) 2026 Intel Corporation
#
# SPDX-License-Identifier: Apache-2.0

config BOARD_QEMU_X86_64_KVM
	select SOC_ATOM
```

## boards/qemu/x86_64/board.yml
```yaml
boards:
  - name: qemu_x86_64
    full_name: QEMU Emulation for X86 64bit
    vendor: intel
    socs:
      - name: atom
        variants:
          - name: 'nokpti'

  - name: qemu_x86_64_kvm
    full_name: QEMU Emulation for X86 64bit, KVM enabled
    vendor: intel
    socs:
      - name: atom
        variants:
          - name: 'nokpti'
```

## boards/qemu/x86_lakemont/board.yml
```yaml
board:
  name: qemu_x86_lakemont
  full_name: QEMU Emulation for X86 / Lakemont CPU
  vendor: intel
  socs:
    - name: lakemont
```

## boards/qemu/xtensa/Kconfig.defconfig
```kconfig
# Copyright (c) 2017, 2023 Intel Corporation
# SPDX-License-Identifier: Apache-2.0

if BOARD_QEMU_XTENSA

config BUILD_OUTPUT_BIN
	default n

config IPM_CONSOLE_STACK_SIZE
	default 2048 if IPM_CONSOLE_RECEIVER

# Must match XCHAL_DCACHE_LINESIZE form core-isa.h
configdefault DCACHE_LINE_SIZE
	default 4 if BOARD_QEMU_XTENSA_SAMPLE_CONTROLLER32_MPU
	default 32

configdefault MAIN_STACK_SIZE
	default 2048

configdefault PRIVILEGED_STACK_SIZE
	default 4096 if BOARD_QEMU_XTENSA_SAMPLE_CONTROLLER32_MPU

configdefault SYS_CLOCK_HW_CYCLES_PER_SEC
	default $(dt_node_int_prop_int,/cpus/cpu@0,clock-frequency)

endif # BOARD_QEMU_XTENSA
```

## boards/qemu/xtensa/qemu_xtensa_sample_controller32_mpu_defconfig
```kconfig
# SPDX-License-Identifier: Apache-2.0

CONFIG_CONSOLE=y
CONFIG_STACK_SENTINEL=y
CONFIG_GEN_ISR_TABLES=y
CONFIG_GEN_IRQ_VECTOR_TABLE=n
CONFIG_SIMULATOR_XTENSA=y
CONFIG_QEMU_ICOUNT_SHIFT=6
```

## boards/rakwireless/rak11161/Kconfig.rak11161
```kconfig
# SPDX-FileCopyrightText: Copyright (c) 2026 RAKwireless Technology Limited
# SPDX-License-Identifier: Apache-2.0

config BOARD_RAK11161
	select SOC_STM32WLE5XX
```

## boards/rakwireless/rak11162/Kconfig.rak11162
```kconfig
# Copyright (c) 2025 RAKwireless Technology Co., Ltd. <www.rakwireless.com>
# SPDX-License-Identifier: Apache-2.0

config BOARD_RAK11162
	select SOC_STM32WLE5XX
```

## boards/rakwireless/rak11310/Kconfig
```kconfig
# SPDX-FileCopyrightText: Copyright (c) 2026 RAKwireless Technology Limited
# SPDX-License-Identifier: Apache-2.0

config BOARD_RAK11310
	select RP2_FLASH_W25Q080
	select BOARD_EARLY_INIT_HOOK if PWM || ADC
	select PINCTRL_DYNAMIC if PWM || ADC
```

## boards/rakwireless/rak11310/Kconfig.defconfig
```kconfig
# SPDX-FileCopyrightText: Copyright (c) 2026 RAKwireless Technology Limited
# SPDX-License-Identifier: Apache-2.0

if BOARD_RAK11310

source "boards/common/usb/Kconfig.cdc_acm_serial.defconfig"

configdefault I2C_DW_CLOCK_SPEED
	default 125

configdefault USB_SELF_POWERED
	default n

endif # BOARD_RAK11310
```

## boards/rakwireless/rak11310/Kconfig.rak11310
```kconfig
# SPDX-FileCopyrightText: Copyright (c) 2026 RAKwireless Technology Limited
# SPDX-License-Identifier: Apache-2.0

config BOARD_RAK11310
	select SOC_RP2040
```

## boards/rakwireless/rak11310/board.yml
```yaml
# SPDX-FileCopyrightText: Copyright (c) 2026 RAKwireless Technology Limited
# SPDX-License-Identifier: Apache-2.0

board:
  name: rak11310
  full_name: RAK11310 WisBlock Core Module
  vendor: rakwireless
  socs:
  - name: rp2040
```

## boards/rakwireless/rak11310/rak11310_defconfig
```kconfig
# SPDX-FileCopyrightText: Copyright (c) 2026 RAKwireless Technology Limited
# SPDX-License-Identifier: Apache-2.0

CONFIG_GPIO=y
CONFIG_USE_DT_CODE_PARTITION=y
CONFIG_BUILD_OUTPUT_UF2=y
CONFIG_BUILD_OUTPUT_HEX=y
CONFIG_UART_INTERRUPT_DRIVEN=y
CONFIG_RESET=y
CONFIG_CLOCK_CONTROL=y

# Disable runtime PM by default
CONFIG_PM_DEVICE_RUNTIME_DEFAULT_ENABLE=n
```

## boards/rakwireless/rak11721/Kconfig.defconfig
```kconfig
# SPDX-FileCopyrightText: Copyright (c) 2026 RAKwireless Technology Limited
# SPDX-License-Identifier: Apache-2.0

if BOARD_RAK11721

config SYS_CLOCK_HW_CYCLES_PER_SEC
	default 32768 if AMBIQ_STIMER_TIMER

endif # BOARD_RAK11721
```

## boards/rakwireless/rak11721/Kconfig.rak11721
```kconfig
# SPDX-FileCopyrightText: Copyright (c) 2026 RAKwireless Technology Limited
# SPDX-License-Identifier: Apache-2.0

config BOARD_RAK11721
	select SOC_APOLLO3_BLUE
```

## boards/rakwireless/rak11722/board.yml
```yaml
board:
  name: rak11722
  full_name: RAK11722 WisBlock Core Module
  vendor: rakwireless
  socs:
  - name: apollo3_blue
```

## boards/rakwireless/rak19026/Kconfig.defconfig
```kconfig
# SPDX-FileCopyrightText: Copyright (c) 2026 RAKwireless Technology Limited
# SPDX-License-Identifier: Apache-2.0

if BOARD_RAK19026

source "boards/common/usb/Kconfig.cdc_acm_serial.defconfig"

endif # BOARD_RAK19026
```

## boards/rakwireless/rak19026/Kconfig.rak19026
```kconfig
# SPDX-FileCopyrightText: Copyright (c) 2026 RAKwireless Technology Limited
# SPDX-License-Identifier: Apache-2.0

config BOARD_RAK19026
	select SOC_NRF52840_QIAA
```

## boards/rakwireless/rak19026/board.yml
```yaml
board:
  name: rak19026
  full_name: RAK19026 WisMesh Base Board
  vendor: rakwireless
  socs:
  - name: nrf52840
```

## boards/rakwireless/rak3212/Kconfig.rak3212
```kconfig
# Copyright (c) 2025 Kenneth Lu
# SPDX-License-Identifier: Apache-2.0

config BOARD_RAK3212
	select SOC_ESP32S3
	select SOC_ESP32S3_PROCPU if BOARD_RAK3212_ESP32S3_PROCPU
	select SOC_ESP32S3_APPCPU if BOARD_RAK3212_ESP32S3_APPCPU
```

## boards/rakwireless/rak3272s/Kconfig.rak3272s
```kconfig
# Copyright (c) 2024 Kenneth Lu <kuohsianglu@gmail.com>
# SPDX-License-Identifier: Apache-2.0

config BOARD_RAK3272S
	select SOC_STM32WLE5XX
```

## boards/rakwireless/rak3312/Kconfig
```kconfig
# SPDX-License-Identifier: Apache-2.0
# Copyright (c) 2026 RAKwireless Technology Limited

config BOARD_RAK3312
	select BOARD_EARLY_INIT_HOOK if PWM
	select PINCTRL_DYNAMIC if PWM

config HEAP_MEM_POOL_ADD_SIZE_BOARD
	int
	default 4096 if BOARD_RAK3312_ESP32S3_PROCPU
	default 256 if BOARD_RAK3312_ESP32S3_APPCPU
```

## boards/rakwireless/rak3312/Kconfig.rak3312
```kconfig
# SPDX-License-Identifier: Apache-2.0
# Copyright (c) 2026 RAKwireless Technology Limited

config BOARD_RAK3312
	select SOC_ESP32S3
	select SOC_ESP32S3_PROCPU if BOARD_RAK3312_ESP32S3_PROCPU
	select SOC_ESP32S3_APPCPU if BOARD_RAK3312_ESP32S3_APPCPU
```
