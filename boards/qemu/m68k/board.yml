## boards/qemu/m68k/board.yml
```yaml
board:
  name: qemu_m68k
  full_name: QEMU M68K Virtual Machine
  vendor: qemu
  socs:
    - name: qemu_virt_m68k_m68000
    - name: qemu_virt_m68k_m68010
```

## boards/qemu/rh850/Kconfig
```kconfig
# SPDX-FileCopyrightText: Copyright (c) 2026 Linumiz
#
# SPDX-License-Identifier: Apache-2.0

config BOARD_QEMU_RH850
	bool
	default y
	select QEMU_TARGET
```

## boards/qemu/rh850/Kconfig.defconfig
```kconfig
# SPDX-FileCopyrightText: Copyright (c) 2026 Linumiz
#
# SPDX-License-Identifier: Apache-2.0

if BOARD_QEMU_RH850_U2C

config BUILD_OUTPUT_BIN
	default n

endif # BOARD_QEMU_RH850_U2C
```

## boards/qemu/rh850/Kconfig.qemu_rh850_u2a
```kconfig
# SPDX-FileCopyrightText: Copyright (c) 2026 Linumiz
#
# SPDX-License-Identifier: Apache-2.0

config BOARD_QEMU_RH850_U2A
	select SOC_R7F702300
```

## boards/qemu/rh850/Kconfig.qemu_rh850_u2b
```kconfig
# SPDX-FileCopyrightText: Copyright (c) 2026 Linumiz
#
# SPDX-License-Identifier: Apache-2.0

config BOARD_QEMU_RH850_U2B
	select SOC_RH850U2B
```

## boards/qemu/rh850/Kconfig.qemu_rh850_u2c
```kconfig
# SPDX-FileCopyrightText: Copyright (c) 2026 Linumiz
#
# SPDX-License-Identifier: Apache-2.0

config BOARD_QEMU_RH850_U2C
	select SOC_R7F702600
```

## boards/qemu/rh850/board.yml
```yaml
# SPDX-FileCopyrightText: Copyright (c) 2026 Linumiz
#
# SPDX-License-Identifier: Apache-2.0

boards:
  - name: qemu_rh850_u2a
    full_name: QEMU Emulation for Renesas RH850/U2A
    vendor: renesas
    socs:
      - name: r7f702300

  - name: qemu_rh850_u2b
    full_name: QEMU Emulation for Renesas RH850/U2B
    vendor: renesas
    socs:
      - name: rh850u2b

  - name: qemu_rh850_u2c
    full_name: QEMU Emulation for Renesas RH850/U2C
    vendor: renesas
    socs:
      - name: r7f702600
```

## boards/qemu/rh850/qemu_rh850_u2c_defconfig
```kconfig
# SPDX-FileCopyrightText: Copyright (c) 2026 Linumiz
#
# SPDX-License-Identifier: Apache-2.0

CONFIG_CONSOLE=y
CONFIG_SERIAL=y
CONFIG_UART_CONSOLE=y
CONFIG_USE_DT_CODE_PARTITION=y
CONFIG_QEMU_ICOUNT=y
CONFIG_QEMU_ICOUNT_SHIFT=4
CONFIG_QEMU_ICOUNT_SLEEP=y
```

## boards/qemu/riscv32/board.yml
```yaml
board:
  name: qemu_riscv32
  full_name: QEMU Emulation for RISCV32
  vendor: qemu
  socs:
    - name: qemu_virt_riscv32
      variants:
        - name: smode
        - name: smp
        - name: aia-imsic
          variants:
            - name: smp
        - name: aia-direct
          variants:
            - name: smp
```

## boards/qemu/riscv64/board.yml
```yaml
board:
  name: qemu_riscv64
  full_name: QEMU Emulation for RISCV64
  vendor: qemu
  socs:
    - name: qemu_virt_riscv64
      variants:
        - name: mmode
        - name: smp
        - name: opensbi
        - name: opensbi_smp
        - name: sv48
```

## boards/qemu/tricore/Kconfig
```kconfig
# SPDX-FileCopyrightText: Copyright (c) 2026 Infineon Technologies AG,
# SPDX-FileCopyrightText: or an affiliate of Infineon Technologies AG. All rights reserved.
# SPDX-FileCopyrightText: Copyright (c) 2026 Linumiz
#
# SPDX-License-Identifier: Apache-2.0

config BOARD_QEMU_TCXX_SELECTOR
	bool
	default y
	select QEMU_TARGET
```

## boards/qemu/tricore/Kconfig.defconfig
```kconfig
# SPDX-FileCopyrightText: Copyright (c) 2026 Infineon Technologies AG,
# SPDX-FileCopyrightText: or an affiliate of Infineon Technologies AG. All rights reserved.
# SPDX-FileCopyrightText: Copyright (c) 2026 Linumiz
#
# SPDX-License-Identifier: Apache-2.0

if BOARD_QEMU_TC3X || BOARD_QEMU_TC4X

config BUILD_OUTPUT_BIN
	default n

endif
```

## boards/qemu/tricore/board.yml
```yaml
# SPDX-FileCopyrightText: Copyright (c) 2026 Infineon Technologies AG,
# SPDX-FileCopyrightText: or an affiliate of Infineon Technologies AG. All rights reserved.
# SPDX-FileCopyrightText: Copyright (c) 2026 Linumiz
#
# SPDX-License-Identifier: Apache-2.0

boards:
  - name: qemu_tc3x
    full_name: QEMU Emulation for Infineon AURIX TC39x
    vendor: infineon
    socs:
      - name: qemu_tc3x

  - name: qemu_tc4x
    full_name: QEMU Emulation for Infineon AURIX TC4Dx
    vendor: infineon
    socs:
      - name: qemu_tc4x
```

## boards/qemu/tricore/qemu_tc4x_defconfig
```kconfig
# SPDX-FileCopyrightText: Copyright (c) 2026 Infineon Technologies AG,
# SPDX-FileCopyrightText: or an affiliate of Infineon Technologies AG. All rights reserved.
# SPDX-FileCopyrightText: Copyright (c) 2026 Linumiz
#
# SPDX-License-Identifier: Apache-2.0

CONFIG_CONSOLE=y
CONFIG_SERIAL=y
CONFIG_UART_CONSOLE=y
CONFIG_USE_DT_CODE_PARTITION=y
CONFIG_QEMU_ICOUNT=y
CONFIG_QEMU_ICOUNT_SHIFT=4
CONFIG_QEMU_ICOUNT_SLEEP=y
```

## boards/qemu/versatilepb/Kconfig.defconfig
```kconfig
# Copyright (c) 2026 Takayuki Goto
# SPDX-License-Identifier: Apache-2.0

if BOARD_QEMU_VERSATILEPB

config BUILD_OUTPUT_BIN
	default n

config SYS_CLOCK_TICKS_PER_SEC
	default 1000

if QEMU_ICOUNT

config QEMU_ICOUNT_SHIFT
	default 6

config QEMU_ICOUNT_SLEEP
	default y

endif # QEMU_ICOUNT

endif # BOARD_QEMU_VERSATILEPB
```

## boards/qemu/versatilepb/Kconfig.qemu_versatilepb
```kconfig
# Copyright (c) 2026 Takayuki Goto
# SPDX-License-Identifier: Apache-2.0

config BOARD_QEMU_VERSATILEPB
	select SOC_VERSATILEPB
```

## boards/qemu/versatilepb/board.yml
```yaml
board:
  name: qemu_versatilepb
  full_name: QEMU Emulation for ARM Versatile/PB (ARM926EJ-S)
  vendor: qemu
  socs:
  - name: versatilepb
```

## boards/qemu/versatilepb/qemu_versatilepb_defconfig
```kconfig
# Copyright (c) 2026 Takayuki Goto
# SPDX-License-Identifier: Apache-2.0

CONFIG_SERIAL=y
CONFIG_CONSOLE=y
CONFIG_UART_CONSOLE=y

CONFIG_ARMV5_EXCEPTION_STACK_SIZE=1024
CONFIG_ARMV5_FIQ_STACK_SIZE=1024
CONFIG_ARMV5_SVC_STACK_SIZE=1024
CONFIG_ARMV5_SYS_STACK_SIZE=4096
CONFIG_ISR_STACK_SIZE=4096
CONFIG_MAIN_STACK_SIZE=4096
CONFIG_IDLE_STACK_SIZE=2048
```

## boards/qemu/x86/Kconfig
```kconfig
# Copyright (c) 2024 Intel Corporation
#
# SPDX-License-Identifier: Apache-2.0

config BOARD_SELECTOR
	select QEMU_TARGET
	select HAS_COVERAGE_SUPPORT
```

## boards/qemu/x86/Kconfig.defconfig
```kconfig
# SPDX-License-Identifier: Apache-2.0
# Copyright (c) 2019 Intel Corp.

if BOARD_QEMU_X86 || BOARD_QEMU_X86_TINY

config BUILD_OUTPUT_BIN
	default n

# The EEPROM emulator must be initialized after the flash simulator
config EEPROM_INIT_PRIORITY
	default 60
	depends on EEPROM

config QEMU_ICOUNT
	default n if HPET_TIMER && SHELL

config QEMU_ICOUNT_SHIFT
	default 5

endif # BOARD_QEMU_X86 || BOARD_QEMU_X86_TINY

if BOARD_QEMU_X86

config KERNEL_VM_SIZE
	default 0x10000000 if ACPI

config MULTIBOOT_MEMMAP
	default y

endif # BOARD_QEMU_X86

if BOARD_QEMU_X86_TINY

config HAVE_CUSTOM_LINKER_SCRIPT
	default y

config CUSTOM_LINKER_SCRIPT
	default "$(ZEPHYR_BASE)/boards/qemu/x86/qemu_x86_tiny.ld"

config DEMAND_PAGING_PAGE_FRAMES_RESERVE
	# Need to accommodate the heap for newlib or common malloc in libc-hook.c
	default 6 if NEWLIB_LIBC || (COMMON_LIBC_MALLOC && COMMON_LIBC_MALLOC_ARENA_SIZE != 0)

endif # BOARD_QEMU_X86_TINY
```

## boards/qemu/x86/board.yml
```yaml
boards:

  - name: qemu_x86
    full_name: QEMU Emulation for X86
    vendor: intel
    socs:
      - name: atom
        variants:
          - name: 'nokpti'
          - name: 'nommu'
          - name: 'nopae'
          - name: 'virt'
          - name: 'xip'

  - name: qemu_x86_tiny
    full_name: QEMU Emulation for X86 Minimal Configuration
    vendor: intel
    socs:
      - name: atom
```

## boards/qemu/x86/qemu_x86_64_kvm_defconfig
```kconfig
CONFIG_PICOLIBC_USE_MODULE=y
CONFIG_PIC_DISABLE=y
CONFIG_LOAPIC=y
CONFIG_CONSOLE=y
CONFIG_SERIAL=y
CONFIG_UART_CONSOLE=y
CONFIG_TEST_RANDOM_GENERATOR=y
CONFIG_X86_DEBUG_INFO=y
CONFIG_SMP=y
CONFIG_MP_MAX_NUM_CPUS=2
CONFIG_X86_MMU=y
CONFIG_X86_VERY_EARLY_CONSOLE=y
CONFIG_QEMU_ICOUNT=n
```

## boards/qemu/x86_64/Kconfig
```kconfig
# Copyright (c) 2024 Intel Corporation
#
# SPDX-License-Identifier: Apache-2.0

config BOARD_QEMU_X86_64
	bool
	default y
	select X86_64
	select QEMU_TARGET
	select HAS_COVERAGE_SUPPORT
	select X86_CPU_HAS_CET if BOARD_QEMU_X86_64_KVM
```
