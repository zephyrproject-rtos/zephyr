/*
 * SPDX-FileCopyrightText: Copyright The Zephyr Project Contributors
 *
 * SPDX-License-Identifier: Apache-2.0
 */

/dts-v1/;

#include "qemu_riscv32.dts"

/ {
	cpus {
		riscv,isa-extensions = "i", "m", "a", "c", "zicsr", "zifencei", "zfinx", "zdinx";
	};
};
