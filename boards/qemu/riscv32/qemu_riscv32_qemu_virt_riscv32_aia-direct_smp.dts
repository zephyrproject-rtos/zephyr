/*
 * Copyright (c) Qualcomm Technologies, Inc. and/or its subsidiaries.
 * SPDX-License-Identifier: Apache-2.0
 */

/dts-v1/;

#include <qemu/virt-riscv-aia.dtsi>

/ {
	model = "QEMU RISC-V virt (AIA - APLIC Direct Delivery Mode - SMP)";
	compatible = "qemu,virt-riscv32-aia-direct-smp";

	chosen {
		zephyr,console = &uart0;
		zephyr,shell-uart = &uart0;
		zephyr,sram = &ram0;
	};
};

&uart0 {
	/* Wire UART to APLIC parent */
	interrupt-parent = <&aplic>;
	interrupts = <10 1 6>; /* source 10, priority 1, sense 6 (level high) */
	status = "okay";
};

&aplic {
	riscv,max-priority = <3>;
	interrupts-extended = <&hlic0 0x0b &hlic1 0x0b>;
};
