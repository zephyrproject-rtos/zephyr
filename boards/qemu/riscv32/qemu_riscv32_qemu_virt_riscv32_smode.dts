/* Copyright (c) 2026 Jisheng Zhang <jszhang@kernel.org> */
/* SPDX-License-Identifier: Apache-2.0 */

/dts-v1/;

#include <qemu/virt-riscv32.dtsi>
#include <qemu/virt-riscv-plic.dtsi>

/ {
	chosen {
		zephyr,console = &uart0;
		zephyr,shell-uart = &uart0;
		zephyr,sram = &ram0;
	};
};

&{/cpus} {
	riscv,privilege-modes = "m", "s", "u";
	mmu-type = "riscv,sv32";
};

&uart0 {
	status = "okay";
};
