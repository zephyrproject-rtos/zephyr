/* SPDX-License-Identifier: Apache-2.0 */

/dts-v1/;

#include <qemu/virt-riscv32.dtsi>

/ {
	chosen {
		zephyr,console = &uart0;
		zephyr,shell-uart = &uart0;
		zephyr,sram = &ram0;
	};
};

&uart0 {
	status = "okay";
};
