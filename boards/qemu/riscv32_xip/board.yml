## boards/qemu/riscv32_xip/board.yml
```yaml
board:
  name: qemu_riscv32_xip
  full_name: QEMU Emulation for RISCV32 XIP
  vendor: qemu
  socs:
    - name: fe310
```

## boards/qemu/riscv32e/board.yml
```yaml
board:
  name: qemu_riscv32e
  full_name: QEMU Emulation for RISCV32E
  vendor: qemu
  socs:
    - name: qemu_virt_riscv32e
```

## boards/qemu/riscv32e/qemu_riscv32e_defconfig
```kconfig
# SPDX-License-Identifier: Apache-2.0

CONFIG_CONSOLE=y
CONFIG_SERIAL=y
CONFIG_UART_CONSOLE=y
CONFIG_STACK_SENTINEL=y
CONFIG_QEMU_ICOUNT_SHIFT=6
CONFIG_XIP=n
CONFIG_RISCV_PMP=y
```

## boards/qemu/riscv64/Kconfig
```kconfig
# Copyright (c) 2024 Antmicro <www.antmicro.com>
# SPDX-License-Identifier: Apache-2.0

config BOARD_QEMU_RISCV64
	select QEMU_TARGET
```

## boards/qemu/riscv64/Kconfig.defconfig
```kconfig
# Copyright (c) 2024 Antmicro <www.antmicro.com>
# SPDX-License-Identifier: Apache-2.0

if BOARD_QEMU_RISCV64

config BUILD_OUTPUT_BIN
	default n

config HAS_COVERAGE_SUPPORT
	default y

config QEMU_ICOUNT_SHIFT
	default 6 if QEMU_ICOUNT

configdefault NET_L2_ETHERNET
	default y

configdefault NET_QEMU_DEVICE_EXTRA_ARGS
	default "bus=virtio-mmio-bus.0"

configdefault NET_TX_STACK_SIZE
	default 8192

configdefault NET_RX_STACK_SIZE
	default 8192

configdefault NET_TCP_WORKQ_STACK_SIZE
	default 8192

configdefault NET_MGMT_EVENT_STACK_SIZE
	default 8192

configdefault NET_SOCKETS_SERVICE_STACK_SIZE
	default 8192

configdefault TEST_RANDOM_GENERATOR
	default y if NETWORKING

endif # BOARD_QEMU_RISCV64
```

## boards/qemu/riscv64/qemu_riscv64_qemu_virt_riscv64_smode_defconfig
```kconfig
# SPDX-License-Identifier: Apache-2.0

CONFIG_CONSOLE=y
CONFIG_SERIAL=y
CONFIG_UART_CONSOLE=y
CONFIG_STACK_SENTINEL=y
CONFIG_XIP=n
CONFIG_RISCV_S_MODE=y
# The PLIC driver configures PLIC context 0 (M-mode) for hart 0.  In S-mode
# Zephyr the correct context is 1 (supervisor mode), so external device
# interrupts via the PLIC do not reach the CPU.  Disable interrupt-driven
# UART TX so the shell backend falls back to polling, which works correctly.
CONFIG_SHELL_BACKEND_SERIAL_INTERRUPT_DRIVEN=n
```

## boards/qemu/rx/Kconfig
```kconfig
# Copyright (c) 2025 Renesas Electronics Corporation
# SPDX-License-Identifier: Apache-2.0

config BOARD_QEMU_RX
	select QEMU_TARGET
```

## boards/qemu/rx/Kconfig.deconfig
```kconfig
# Copyright (c) 2025 Renesas Electronics Corporation
# SPDX-License-Identifier: Apache-2.0

if BOARD_QEMU_RX

config BUILD_OUTPUT_BIN
	default n

# DWT is not properly emulated in QEMU
choice NULL_POINTER_EXCEPTION_DETECTION
	bool
	default NULL_POINTER_EXCEPTION_DETECTION_NONE
endchoice

endif # BOARD_QEMU_RX
```

## boards/qemu/rx/Kconfig.qemu_rx
```kconfig
# Copyright (c) 2024 Renesas Electronics Corporation
# SPDX-License-Identifier: Apache-2.0

config BOARD_QEMU_RX
	select SOC_R5F562N8
```

## boards/qemu/rx/board.yml
```yaml
board:
  name: qemu_rx
  full_name: QEMU Emulation for Renesas RX
  vendor: renesas
  socs:
  - name: r5f562n8
```

## boards/qemu/rx/qemu_rx_defconfig
```kconfig
# Copyright (c) 2024 Renesas Electronics Corporation
# SPDX-License-Identifier: Apache-2.0

# Enable UART driver
CONFIG_SERIAL=y

# Enable console
CONFIG_CONSOLE=y
CONFIG_UART_CONSOLE=y

CONFIG_QEMU_ICOUNT_SHIFT=5
CONFIG_QEMU_ICOUNT=y
```

## boards/qemu/tricore/Kconfig.qemu_tc3x
```kconfig
# Copyright (c) 2026 Infineon Technologies AG
#
# SPDX-License-Identifier: Apache-2.0

config BOARD_QEMU_TC3X
	bool
	select SOC_QEMU_TC3X
```

## boards/qemu/tricore/Kconfig.qemu_tc4x
```kconfig
# SPDX-License-Identifier: Apache-2.0

config BOARD_QEMU_TC4X
	bool
	select SOC_QEMU_TC4X
```

## boards/qemu/x86/Kconfig.qemu_x86
```kconfig
# Copyright (c) 2024 Intel Corporation
#
# SPDX-License-Identifier: Apache-2.0

config BOARD_QEMU_X86
	select SOC_ATOM
```

## boards/qemu/x86/qemu_x86_64_atom_nokpti_defconfig
```kconfig
# SPDX-License-Identifier: Apache-2.0
# Copyright (c) 2019 Intel Corp.

CONFIG_X86_KPTI=n
```

## boards/qemu/x86/qemu_x86_atom_defconfig
```kconfig
# SPDX-License-Identifier: Apache-2.0
# Copyright (c) 2019 Intel Corp.

CONFIG_PIC_DISABLE=y
CONFIG_LOAPIC=y
CONFIG_CONSOLE=y
CONFIG_SERIAL=y
CONFIG_UART_CONSOLE=y
CONFIG_SYS_CLOCK_HW_CYCLES_PER_SEC=25000000
CONFIG_TEST_RANDOM_GENERATOR=y
CONFIG_X86_MMU=y
CONFIG_DEBUG_INFO=y
CONFIG_SCHED_SCALABLE=y
CONFIG_WAITQ_SCALABLE=y
CONFIG_X86_VERY_EARLY_CONSOLE=y
```

## boards/qemu/x86/qemu_x86_atom_nommu_defconfig
```kconfig
# SPDX-License-Identifier: Apache-2.0
# Copyright (c) 2019 Intel Corp.

CONFIG_X86_MMU=n
CONFIG_SCHED_DUMB=y
CONFIG_WAITQ_DUMB=y
CONFIG_X86_VERY_EARLY_CONSOLE=n
```

## boards/qemu/x86/qemu_x86_atom_virt_defconfig
```kconfig
# SPDX-License-Identifier: Apache-2.0
# Copyright (c) 2019 Intel Corp.

CONFIG_SRAM_OFFSET=0x100000
CONFIG_KERNEL_VM_SIZE=0x400000
CONFIG_KERNEL_VM_BASE=0x40000000
CONFIG_KERNEL_VM_OFFSET=0

CONFIG_LINKER_USE_BOOT_SECTION=y
CONFIG_LINKER_USE_PINNED_SECTION=y

# For now, the mapped stacks require physical addresses
# and cannot deal with mapping a stack with virtual
# address. So make sure memory mapped stack is not
# enabled.
CONFIG_THREAD_STACK_MEM_MAPPED=n
```

## boards/qemu/x86/qemu_x86_atom_xip_defconfig
```kconfig
# SPDX-License-Identifier: Apache-2.0
# Copyright (c) 2019 Intel Corp.

CONFIG_X86_MMU=n
CONFIG_XIP=y
```

## boards/qemu/x86_64/Kconfig.qemu_x86_64
```kconfig
# Copyright (c) 2024 Intel Corporation
#
# SPDX-License-Identifier: Apache-2.0

config BOARD_QEMU_X86_64
	select SOC_ATOM
```

## boards/qemu/x86_lakemont/Kconfig.qemu_x86_lakemont
```kconfig
# Copyright (c) 2024 Intel Corporation
#
# SPDX-License-Identifier: Apache-2.0

config BOARD_QEMU_X86_LAKEMONT
	select SOC_LAKEMONT
```

## boards/qemu/xtensa/Kconfig
```kconfig
# XTENSA board configuration

# Copyright (c) 2017, 2023 Intel Corporation
# SPDX-License-Identifier: Apache-2.0

config BOARD_QEMU_XTENSA
	select QEMU_TARGET
	select ARCH_SUPPORTS_COREDUMP
	select XTENSA_MMU if BOARD_QEMU_XTENSA_DC233C_MMU
	select XTENSA_MPU if BOARD_QEMU_XTENSA_SAMPLE_CONTROLLER32_MPU
```

## boards/qemu/xtensa/Kconfig.qemu_xtensa
```kconfig
# XTENSA board configuration

# Copyright (c) 2017, 2023 Intel Corporation
# SPDX-License-Identifier: Apache-2.0

config BOARD_QEMU_XTENSA
	select SOC_XTENSA_SAMPLE_CONTROLLER32 if BOARD_QEMU_XTENSA_SAMPLE_CONTROLLER32_MPU
	select SOC_XTENSA_DC233C if !BOARD_QEMU_XTENSA_SAMPLE_CONTROLLER32_MPU
```

## boards/qemu/xtensa/board.yml
```yaml
board:
  name: qemu_xtensa
  full_name: QEMU Emulation for Xtensa
  vendor: cdns
  socs:
  - name: dc233c
    variants:
    - name: mmu
  - name: sample_controller32
    variants:
    - name: mpu
```

## boards/qemu_cortex_m3/Kconfig.board
```kconfig
config BOARD_QEMU_CORTEX_M3
	bool "Cortex-M3 Emulation (Qemu)"
	depends on SOC_TI_LM3S6965
```
