## boards/qemu/hexagon/board.yml
```yaml
board:
  name: qemu_hexagon
  full_name: QEMU Emulation for Hexagon
  vendor: qemu
  socs:
    - name: qemu_hexagon_virt
```

## boards/qemu/hexagon/qemu_hexagon_qemu_hexagon_virt_defconfig
```kconfig
# SPDX-License-Identifier: Apache-2.0
# Copyright (c) Qualcomm Technologies, Inc. and/or its subsidiaries.

CONFIG_COMPILER_RT_RTLIB=y
CONFIG_BUILD_OUTPUT_BIN=y
CONFIG_PRINTK=y

# Serial console
CONFIG_SERIAL=y
CONFIG_UART_CONSOLE=y
CONFIG_CONSOLE=y
CONFIG_EARLY_CONSOLE=y

# Hexagon-specific features
CONFIG_HEXAGON_TIMER=y
CONFIG_DYNAMIC_INTERRUPTS=y

# Debug and development options
CONFIG_EXCEPTION_DEBUG=y
CONFIG_QEMU_ICOUNT_SHIFT=3
CONFIG_STACK_SENTINEL=y
CONFIG_THREAD_CUSTOM_DATA=y
```

## boards/qemu/kvm_arm64/Kconfig.defconfig
```kconfig
# Copyright (c) 2022 Huawei France Technologies SASU
# SPDX-License-Identifier: Apache-2.0

if BOARD_QEMU_KVM_ARM64

config BUILD_OUTPUT_BIN
	default y

endif # BOARD_QEMU_KVM_ARM64
```

## boards/qemu/kvm_arm64/Kconfig.qemu_kvm_arm64
```kconfig
# Copyright (c) 2022 Huawei France Technologies SASU
# SPDX-License-Identifier: Apache-2.0

config BOARD_QEMU_KVM_ARM64
	select SOC_QEMU_VIRT_ARM64
```

## boards/qemu/kvm_arm64/board.yml
```yaml
board:
  name: qemu_kvm_arm64
  full_name: QEMU Emulation for ARM AArch64 Virt KVM
  vendor: arm
  socs:
  - name: qemu_virt_arm64
```

## boards/qemu/leon3/board.yml
```yaml
board:
  name: qemu_leon3
  full_name: QEMU Emulation for LEON3
  vendor: gaisler
  socs:
  - name: leon3
```

## boards/qemu/leon3/qemu_leon3_defconfig
```kconfig
# SPDX-License-Identifier: Apache-2.0

CONFIG_CONSOLE=y
CONFIG_SERIAL=y
CONFIG_UART_CONSOLE=y
CONFIG_EXTRA_EXCEPTION_INFO=y
CONFIG_QEMU_ICOUNT_SHIFT=6
```

## boards/qemu/malta/Kconfig
```kconfig
#
# Copyright (c) 2020 Antony Pavlov <antonynpavlov@gmail.com>
#
# SPDX-License-Identifier: Apache-2.0
#

config BOARD_QEMU_MALTA
	select QEMU_TARGET
	select BIG_ENDIAN if BOARD_QEMU_MALTA_QEMU_MALTA_BE
```

## boards/qemu/malta/Kconfig.defconfig
```kconfig
#
# Copyright (c) 2020 Antony Pavlov <antonynpavlov@gmail.com>
#
# SPDX-License-Identifier: Apache-2.0
#

if BOARD_QEMU_MALTA

config BUILD_OUTPUT_BIN
	default n

endif # BOARD_QEMU_MALTA
```

## boards/qemu/malta/Kconfig.qemu_malta
```kconfig
#
# Copyright (c) 2020 Antony Pavlov <antonynpavlov@gmail.com>
#
# SPDX-License-Identifier: Apache-2.0
#

config BOARD_QEMU_MALTA
	select SOC_QEMU_MALTA
```

## boards/qemu/malta/board.yml
```yaml
board:
  name: qemu_malta
  full_name: QEMU Emulation for MIPS Malta
  vendor: qemu
  socs:
  - name: qemu_malta
    variants:
    - name: 'be'
```

## boards/qemu/malta/qemu_malta_qemu_malta_defconfig
```kconfig
CONFIG_MIPS_CP0_TIMER=y
CONFIG_CONSOLE=y
CONFIG_UART_CONSOLE=y
CONFIG_SERIAL=y
CONFIG_QEMU_ICOUNT=y
CONFIG_QEMU_ICOUNT_SHIFT=3
```

## boards/qemu/max/Kconfig.defconfig
```kconfig
# Copyright 2024-2025 HNU-ESNL: Guoqi Xie, Chenglai Xiong, Xingyu Hu and etc.
# Copyright 2024-2025 openEuler SIG-Zephyr
# SPDX-License-Identifier: Apache-2.0

if BOARD_QEMU_MAX

config BUILD_OUTPUT_BIN
	default y

config MAX_THREAD_BYTES
	default 3

# QEMU PCI requires at least 256M of virtual space
config KERNEL_VM_SIZE
	default 0x80000000 if PCIE

# QEMU PCI requires physical addresses with more than 32 bits
choice ARM64_VA_BITS
	default ARM64_VA_BITS_40 if PCIE
endchoice

choice ARM64_PA_BITS
	default ARM64_PA_BITS_40 if PCIE
endchoice

if QEMU_ICOUNT

config QEMU_ICOUNT_SHIFT
	default 4

config QEMU_ICOUNT_SLEEP
	default y

endif # QEMU_ICOUNT

endif # BOARD_QEMU_MAX
```

## boards/qemu/max/Kconfig.qemu_max
```kconfig
# Copyright 2024-2025 HNU-ESNL: Guoqi Xie, Chenglai Xiong, Xingyu Hu and etc.
# Copyright 2024-2025 openEuler SIG-Zephyr
# SPDX-License-Identifier: Apache-2.0

config BOARD_QEMU_MAX
	select SOC_QEMU_MAX
```

## boards/qemu/max/board.yml
```yaml
board:
  name: qemu_max
  full_name: QEMU Emulation for ARM MAX
  vendor: arm
  socs:
  - name: qemu_max
    variants:
    - name: smp
```

## boards/qemu/max/qemu_max_defconfig
```kconfig
# Copyright 2024-2025 HNU-ESNL: Guoqi Xie, Chenglai Xiong, Xingyu Hu and etc.
# Copyright 2024-2025 openEuler SIG-Zephyr
# SPDX-License-Identifier: Apache-2.0

# Basic board infomation
CONFIG_ARM_ARCH_TIMER=y
CONFIG_QEMU_ICOUNT=n

CONFIG_ARMV8_A_NS=y
CONFIG_CACHE_MANAGEMENT=y
CONFIG_TIMEOUT_64BIT=y
CONFIG_ARM64_SET_VMPIDR_EL2=y
CONFIG_ARM64_SET_VPIDR_EL2=y

# Enable UART driver
CONFIG_SERIAL=y
CONFIG_UART_PL011=y
CONFIG_UART_INTERRUPT_DRIVEN=y
```

## boards/qemu/max/qemu_max_qemu_max_smp_defconfig
```kconfig
# Copyright 2024-2025 HNU-ESNL: Guoqi Xie, Chenglai Xiong, Xingyu Hu and etc.
# Copyright 2024-2025 openEuler SIG-Zephyr
# SPDX-License-Identifier: Apache-2.0

# Basic board infomation
CONFIG_QEMU_ICOUNT=n

# SMP support
CONFIG_SMP=y
CONFIG_ARMV8_A_NS=y
CONFIG_MP_MAX_NUM_CPUS=4
CONFIG_CACHE_MANAGEMENT=y
CONFIG_TIMEOUT_64BIT=y
CONFIG_ARM64_SET_VMPIDR_EL2=y
CONFIG_ARM64_SET_VPIDR_EL2=y

# PSCI is supported
CONFIG_PM_CPU_OPS=y
CONFIG_PM_CPU_OPS_PSCI=y

# Enable Timer and Sys clock
CONFIG_SYS_CLOCK_TICKS_PER_SEC=1000
CONFIG_ARM_ARCH_TIMER=y

# Enable serial port
CONFIG_SERIAL=y
CONFIG_UART_PL011=y
CONFIG_UART_INTERRUPT_DRIVEN=y
```

## boards/qemu/microblaze/Kconfig
```kconfig
# Copyright (c) 2023 Advanced Micro Devices, Inc. (AMD)
# Copyright (c) 2023 Alp Sayin <alpsayin@gmail.com>
# SPDX-License-Identifier: Apache-2.0


config BOARD_QEMU_MICROBLAZE
	select QEMU_TARGET
```

## boards/qemu/microblaze/Kconfig.defconfig
```kconfig
# Copyright (c) 2023 Advanced Micro Devices, Inc. (AMD)
# Copyright (c) 2023 Alp Sayin <alpsayin@gmail.com>
# SPDX-License-Identifier: Apache-2.0


if BOARD_QEMU_MICROBLAZE

config BUILD_OUTPUT_BIN
	default n

endif # BOARD_QEMU_MICROBLAZE
```

## boards/qemu/microblaze/qemu_microblaze_defconfig
```kconfig
# Copyright (c) 2023 Advanced Micro Devices, Inc. (AMD)
# Copyright (c) 2023 Alp Sayin <alpsayin@gmail.com>
# SPDX-License-Identifier: Apache-2.0


CONFIG_UART_XLNX_UARTLITE=y
CONFIG_UART_INTERRUPT_DRIVEN=y
CONFIG_SERIAL=y
CONFIG_CONSOLE=y
CONFIG_UART_CONSOLE=y
CONFIG_EXTRA_EXCEPTION_INFO=y
CONFIG_QEMU_ICOUNT=n
CONFIG_XLNX_INTC_INITIALIZE_IVAR_REGISTERS=y
# TX and RX IRQs are shared. Disabling one doesn't really disable any.
# Interrupt driven shell implementation doesn't play nice with this paradigm
CONFIG_SHELL_BACKEND_SERIAL_INTERRUPT_DRIVEN=n
```

## boards/qemu/nios2/Kconfig
```kconfig
# Copyright (c) 2018 Intel Corporation
# SPDX-License-Identifier: Apache-2.0

config BOARD_QEMU_NIOS2
	select QEMU_TARGET
```

## boards/qemu/nios2/Kconfig.defconfig
```kconfig
# Copyright (c) 2018 Intel Corporation
# SPDX-License-Identifier: Apache-2.0

if BOARD_QEMU_NIOS2

config BUILD_OUTPUT_BIN
	default n

endif
```

## boards/qemu/nios2/board.yml
```yaml
board:
  name: qemu_nios2
  full_name: QEMU Emulation for Altera Nios-II
  vendor: altr
  socs:
  - name: qemu_nios2
```

## boards/qemu/or1k/Kconfig
```kconfig
#
# Copyright (c) 2025 Joel Holdsworth <jholdsworth@nvidia.com>
#
# SPDX-License-Identifier: Apache-2.0
#

config BOARD_QEMU_OR1K
	select QEMU_TARGET
```
