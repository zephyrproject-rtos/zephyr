## boards/qemu/cortex_a53_aarch32/qemu_cortex_a53_aarch32_defconfig
```kconfig
# Copyright (c) 2026 Realtek Semiconductor Corp.
# SPDX-License-Identifier: Apache-2.0
CONFIG_ARM_AARCH32_MMU=y
CONFIG_ARM_ARCH_TIMER=y

CONFIG_CACHE_MANAGEMENT=y

CONFIG_SERIAL=y
CONFIG_CONSOLE=y
CONFIG_UART_CONSOLE=y
CONFIG_UART_INTERRUPT_DRIVEN=y

CONFIG_QEMU_ICOUNT=y
```

## boards/qemu/cortex_a53_aarch32/qemu_cortex_a53_aarch32_qemu_cortex_a53_aarch32_smp_defconfig
```kconfig
# Copyright (c) 2026 Realtek Semiconductor Corp.
# SPDX-License-Identifier: Apache-2.0
CONFIG_ARM_ARCH_TIMER=y

CONFIG_CACHE_MANAGEMENT=y

CONFIG_SERIAL=y
CONFIG_CONSOLE=y
CONFIG_UART_CONSOLE=y
CONFIG_UART_INTERRUPT_DRIVEN=y

# SMP-related
CONFIG_USE_SWITCH=y
CONFIG_SMP=y
CONFIG_MP_MAX_NUM_CPUS=2
CONFIG_TIMEOUT_64BIT=y
```

## boards/qemu/cortex_a72/Kconfig.defconfig
```kconfig
# Copyright (c) 2019 Carlo Caione <ccaione@baylibre.com>
# Copyright (c) 2026 Muhammad Waleed Badar
# SPDX-License-Identifier: Apache-2.0

if BOARD_QEMU_CORTEX_A72

config BUILD_OUTPUT_BIN
	default y

config MAX_THREAD_BYTES
	default 3

if QEMU_ICOUNT

config QEMU_ICOUNT_SHIFT
	default 4

config QEMU_ICOUNT_SLEEP
	default y

endif # QEMU_ICOUNT

endif # BOARD_QEMU_CORTEX_A72
```

## boards/qemu/cortex_a72/Kconfig.qemu_cortex_a72
```kconfig
# Copyright (c) 2026 Muhammad Waleed Badar
# SPDX-License-Identifier: Apache-2.0

config BOARD_QEMU_CORTEX_A72
	select SOC_BCM2711
```

## boards/qemu/cortex_a72/board.yml
```yaml
board:
  name: qemu_cortex_a72
  full_name: QEMU Emulation for ARM Cortex-A72
  vendor: raspberrypi
  socs:
  - name: bcm2711
```

## boards/qemu/cortex_a9/Kconfig
```kconfig
#
# Kconfig - Cortex-A9 QEMU Emulation
#
# Copyright (c) 2021, Weidmueller Interface GmbH & Co. KG
# SPDX-License-Identifier: Apache-2.0
#

config BOARD_QEMU_CORTEX_A9
	select QEMU_TARGET
```

## boards/qemu/cortex_a9/Kconfig.defconfig
```kconfig
#
# Kconfig - Cortex-A9 (Zynq-7000) QEMU Emulation
#
# Copyright (c) 2021, Weidmueller Interface GmbH & Co. KG
# SPDX-License-Identifier: Apache-2.0
#

if BOARD_QEMU_CORTEX_A9

config BUILD_OUTPUT_BIN
	default n

config SYS_CLOCK_HW_CYCLES_PER_SEC
	int
	default 111111111

config SYS_CLOCK_TICKS_PER_SEC
	default 1000

if LOG_PROCESS_THREAD

config LOG_PROCESS_THREAD_STACK_SIZE
	default 8192

endif # LOG_PROCESS_THREAD

configdefault NET_L2_ETHERNET
	default y

configdefault NET_TX_STACK_SIZE
	default 8192

configdefault NET_RX_STACK_SIZE
	default 8192

configdefault NET_TCP_WORKQ_STACK_SIZE
	default 8192

configdefault NET_MGMT_EVENT_STACK_SIZE
	default 8192

configdefault TEST_RANDOM_GENERATOR
	default y if NETWORKING

if QEMU_ICOUNT

config QEMU_ICOUNT_SHIFT
	default 3

config QEMU_ICOUNT_SLEEP
	default y

endif # QEMU_ICOUNT

config SHELL_STACK_SIZE
	default 8192 if SHELL

endif # BOARD_QEMU_CORTEX_A9
```

## boards/qemu/cortex_a9/Kconfig.qemu_cortex_a9
```kconfig
#
# Kconfig - Cortex-A9 QEMU Emulation
#
# Copyright (c) 2021, Weidmueller Interface GmbH & Co. KG
# SPDX-License-Identifier: Apache-2.0
#

config BOARD_QEMU_CORTEX_A9
	select SOC_XILINX_XC7Z007S
```

## boards/qemu/cortex_a9/board.yml
```yaml
board:
  name: qemu_cortex_a9
  full_name: QEMU Emulation for Cortex-A9
  vendor: qemu
  socs:
  - name: xc7z007s
```

## boards/qemu/cortex_a9/qemu_cortex_a9_defconfig
```kconfig
#
# Copyright (c) 2021, Weidmueller Interface GmbH & Co. KG
#
# SPDX-License-Identifier: Apache-2.0
#

CONFIG_ARM_ARCH_TIMER=y

CONFIG_SERIAL=y
CONFIG_CONSOLE=y
CONFIG_UART_CONSOLE=y
```

## boards/qemu/cortex_m0/Kconfig
```kconfig
# Copyright (c) 2021 Nordic Semiconductor ASA
# SPDX-License-Identifier: Apache-2.0

config BOARD_QEMU_CORTEX_M0
	select QEMU_TARGET

config NRF_TIMER_TIMER
	bool "nRF Timer Counter (NRF_TIMER0) Timer"
	depends on CLOCK_CONTROL
	depends on SOC_COMPATIBLE_NRF
	depends on SYS_CLOCK_EXISTS
	select TICKLESS_CAPABLE
	default y
	help
	  This module implements a kernel device driver for the nRF Timer
	  Counter NRF_TIMER0 and provides the standard "system clock driver"
	  interfaces.
```

## boards/qemu/cortex_m0/Kconfig.defconfig
```kconfig
# QEMU Cortex-M0 board configuration

# Copyright (c) 2019 Nordic Semiconductor ASA.
# SPDX-License-Identifier: Apache-2.0

if BOARD_QEMU_CORTEX_M0

config NRF_RTC_TIMER
	default n if SYS_CLOCK_EXISTS

config SYS_CLOCK_HW_CYCLES_PER_SEC
	default 1000000

config SYS_CLOCK_TICKS_PER_SEC
	default 100

endif # BOARD_QEMU_CORTEX_M0
```

## boards/qemu/cortex_m0/Kconfig.qemu_cortex_m0
```kconfig
# QEMU Cortex-M0 board configuration

# Copyright (c) 2019 Nordic Semiconductor ASA.
# SPDX-License-Identifier: Apache-2.0

config BOARD_QEMU_CORTEX_M0
	select SOC_NRF51822_QFAA
```

## boards/qemu/cortex_m0/board.yml
```yaml
board:
  name: qemu_cortex_m0
  full_name: QEMU Emulation for ARM Cortex-M0
  vendor: nordic
  socs:
  - name: nrf51822
```

## boards/qemu/cortex_m0/qemu_cortex_m0_defconfig
```kconfig
# SPDX-License-Identifier: Apache-2.0

CONFIG_QEMU_ICOUNT_SHIFT=6

# Enable GPIO
CONFIG_GPIO=y

# Clock control
CONFIG_CLOCK_CONTROL_NRF_K32SRC_XTAL=y

# Enable UART driver
CONFIG_SERIAL=y

# Enable console
CONFIG_CONSOLE=y
CONFIG_UART_CONSOLE=y

# icount is kinda broken when the NRF timer emulation is used
CONFIG_QEMU_ICOUNT=n
```

## boards/qemu/cortex_m3/Kconfig
```kconfig
# Copyright (c) 2016 Zephyr Contributors
# SPDX-License-Identifier: Apache-2.0

config BOARD_QEMU_CORTEX_M3
	select QEMU_TARGET
```

## boards/qemu/cortex_m3/Kconfig.defconfig
```kconfig
# Copyright (c) 2016 Zephyr Contributors
# SPDX-License-Identifier: Apache-2.0

if BOARD_QEMU_CORTEX_M3

config BUILD_OUTPUT_BIN
	default n

# DWT is not properly emulated in QEMU
choice NULL_POINTER_EXCEPTION_DETECTION
	bool
	default NULL_POINTER_EXCEPTION_DETECTION_NONE
endchoice

# BT relies on PSA Crypto API to perform crypto operations and, on this platform,
# these APIs are provided thougth Mbed TLS. Unfortunately this platform is not
# provided with a true random number generator which is required to properly
# initialize the PSA Crypto core, so we need to enable the fake TEST_RANDOM_GENERATOR.
config TEST_RANDOM_GENERATOR
	bool
	default y if BT

endif # BOARD_QEMU_CORTEX_M3
```

## boards/qemu/cortex_m3/Kconfig.qemu_cortex_m3
```kconfig
# Copyright (c) 2016 Zephyr Contributors
# SPDX-License-Identifier: Apache-2.0

config BOARD_QEMU_CORTEX_M3
	select SOC_TI_LM3S6965
	help
	  Cortex-M3 Emulation (QEMU)
```

## boards/qemu/cortex_m3/board.yml
```yaml
board:
  name: qemu_cortex_m3
  full_name: QEMU Emulation for ARM Cortex-M3
  vendor: qemu
  socs:
  - name: ti_lm3s6965
```

## boards/qemu/cortex_r5/Kconfig
```kconfig
# Copyright (c) 2019 Lexmark International, Inc.
# SPDX-License-Identifier: Apache-2.0

config BOARD_QEMU_CORTEX_R5
	select QEMU_TARGET
```

## boards/qemu/cortex_r5/Kconfig.defconfig
```kconfig
# Copyright (c) 2019 Lexmark International, Inc.
# SPDX-License-Identifier: Apache-2.0

if BOARD_QEMU_CORTEX_R5

config BUILD_OUTPUT_BIN
	default n

if USERSPACE

config COMPILER_ISA_THUMB2
	default n

endif

config ISR_STACK_SIZE
	default 512

endif # BOARD_QEMU_CORTEX_R5
```

## boards/qemu/cortex_r5/board.yml
```yaml
board:
  name: qemu_cortex_r5
  full_name: QEMU Emulation for ARM Cortex-R5
  vendor: qemu
  socs:
  - name: zynqmp_rpu
```

## boards/qemu/cortex_r5/qemu_cortex_r5_defconfig
```kconfig
CONFIG_XIP=n
CONFIG_QEMU_ICOUNT_SHIFT=3

CONFIG_ISR_STACK_SIZE=512
CONFIG_THREAD_STACK_INFO=y

# enable uart driver
CONFIG_SERIAL=y

# enable console
CONFIG_CONSOLE=y
CONFIG_UART_CONSOLE=y

CONFIG_SYS_CLOCK_TICKS_PER_SEC=100
CONFIG_ARM_MPU=y
```

## boards/qemu/hexagon/Kconfig
```kconfig
# SPDX-License-Identifier: Apache-2.0
# Copyright (c) Qualcomm Technologies, Inc. and/or its subsidiaries.

config BOARD_QEMU_HEXAGON
	select QEMU_TARGET
```

## boards/qemu/hexagon/Kconfig.qemu_hexagon
```kconfig
# SPDX-License-Identifier: Apache-2.0
# Copyright (c) Qualcomm Technologies, Inc. and/or its subsidiaries.

config BOARD_QEMU_HEXAGON
	select SOC_QEMU_HEXAGON_VIRT
```
