/*
 * Copyright (c) 2026 Realtek Semiconductor Corp.
 *
 * SPDX-License-Identifier: Apache-2.0
 */

/dts-v1/;

#include <arm/qemu/qemu-virt-a53-aarch32.dtsi>

/ {
	model = "QEMU Cortex-A53 AArch32";
	compatible = "qemu,arm-cortex-a53-aarch32";

	chosen {
		/*
		 * QEMU's "virt" machine places its generated device tree at
		 * the base of RAM (0x40000000), so Zephyr sits above it at
		 * 0x60000000: QEMU loads the binary there and the EL3 boot
		 * shim enters it. See boards/.../shim/shim.S and board.cmake.
		 */
		zephyr,sram = &ram;
		zephyr,console = &uart0;
		zephyr,shell-uart = &uart0;
		zephyr,flash = &flash0;
	};

	ram: memory@60000000 {
		compatible = "mmio-sram";
		reg = <0x60000000 DT_SIZE_M(128)>;
	};
};

&uart0 {
	status = "okay";
	current-speed = <115200>;
};
