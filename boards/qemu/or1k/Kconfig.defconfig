## boards/qemu/or1k/Kconfig.defconfig
```kconfig
#
# Copyright (c) 2025 NVIDIA Corporation <jholdsworth@nvidia.com>
#
# SPDX-License-Identifier: Apache-2.0
#

if BOARD_QEMU_OR1K

config BUILD_OUTPUT_BIN
	default n

config QEMU_ICOUNT_SHIFT
	default 6 if QEMU_ICOUNT

endif # BOARD_QEMU_OR1K
```

## boards/qemu/or1k/Kconfig.qemu_or1k
```kconfig
#
# Copyright (c) 2025 NVIDIA Corporation <jholdsworth@nvidia.com>
#
# SPDX-License-Identifier: Apache-2.0
#

config BOARD_QEMU_OR1K
	select SOC_QEMU_OR1K
```

## boards/qemu/or1k/board.yml
```yaml
board:
  name: qemu_or1k
  full_name: QEMU Emulation for OpenRISC 1000
  vendor: qemu
  socs:
  - name: qemu_or1k
```

## boards/qemu/qemu_cortex_a53/qemu_cortex_a53_qemu_cortex_a53_smp_defconfig
```kconfig
CONFIG_ARM_ARCH_TIMER=y

# Cache management
CONFIG_CACHE_MANAGEMENT=y

# Enable UART driver
CONFIG_SERIAL=y

# Enable console
CONFIG_CONSOLE=y
CONFIG_UART_CONSOLE=y

# Enable serial port
CONFIG_UART_INTERRUPT_DRIVEN=y

# icount does not work well with SMP
CONFIG_QEMU_ICOUNT=n

# We have multiple QEMU-A53 boards, so let us exercise ARMV8_A_NS on this one
# (plus it is needed for SMP)
CONFIG_ARMV8_A_NS=y

# PSCI is supported with NS
CONFIG_PM_CPU_OPS=y

# SMP-related
CONFIG_SMP=y
CONFIG_MP_MAX_NUM_CPUS=2
CONFIG_TIMEOUT_64BIT=y
```

## boards/qemu/qemu_malta/board.yml
```yaml
board:
  name: qemu_malta
  vendor: qemu
  socs:
  - name: qemu_malta
    variants:
    - name: 'be'
```

## boards/qemu/qemu_riscv64/Kconfig.defconfig
```kconfig
# Copyright (c) 2024 Antmicro <www.antmicro.com>
# SPDX-License-Identifier: Apache-2.0

if BOARD_QEMU_RISCV64

config BUILD_OUTPUT_BIN
	default n

config HAS_COVERAGE_SUPPORT
	default y

config QEMU_ICOUNT_SHIFT
	default 6 if QEMU_ICOUNT

endif # BOARD_QEMU_RISCV64
```

## boards/qemu/qemu_riscv64/qemu_riscv64_qemu_virt_riscv64_smp_defconfig
```kconfig
# SPDX-License-Identifier: Apache-2.0

CONFIG_SMP=y
CONFIG_MP_MAX_NUM_CPUS=2
CONFIG_IDLE_STACK_SIZE=1024
CONFIG_QEMU_ICOUNT=n
```

## boards/qemu/qemu_x86/board.yml
```yaml
boards:

  - name: qemu_x86
    socs:
      - name: ia32
        variants:
          - name: 'nokpti'
          - name: 'nommu'
          - name: 'nopae'
          - name: 'virt'
          - name: 'xip'

  - name: qemu_x86_lakemont
    socs:
      - name: lakemont

  - name: qemu_x86_64
    socs:
      - name: ia32
        variants:
          - name: 'nokpti'

  - name: qemu_x86_tiny
    socs:
      - name: ia32
        variants:
          - name: '768'
```

## boards/qemu/qemu_x86/qemu_x86_ia32_nommu_defconfig
```kconfig
# SPDX-License-Identifier: Apache-2.0

CONFIG_X86_MMU=n
CONFIG_SCHED_DUMB=y
CONFIG_WAITQ_DUMB=y
CONFIG_X86_VERY_EARLY_CONSOLE=n
```

## boards/qemu/qemu_xtensa/board.yml
```yaml
board:
  name: qemu_xtensa
  vendor: Cadence Design Systems
  socs:
  - name: dc233c
    variants:
    - name: mmu
```

## boards/qemu/riscv/Kconfig
```kconfig
# SPDX-FileCopyrightText: Copyright The Zephyr Project Contributors
# SPDX-License-Identifier: Apache-2.0

config BOARD_QEMU_RISCV
	select QEMU_TARGET
	select HAS_COVERAGE_SUPPORT
```

## boards/qemu/riscv/Kconfig.defconfig
```kconfig
# SPDX-FileCopyrightText: Copyright The Zephyr Project Contributors
# SPDX-License-Identifier: Apache-2.0

if BOARD_QEMU_RISCV

# Use thread local storage by default so that this feature gets more CI coverage.
configdefault THREAD_LOCAL_STORAGE
	default y

configdefault BUILD_OUTPUT_BIN
	default n

configdefault QEMU_ICOUNT_SHIFT
	default 6

endif # BOARD_QEMU_RISCV
```

## boards/qemu/riscv/Kconfig.qemu_riscv
```kconfig
# SPDX-FileCopyrightText: Copyright The Zephyr Project Contributors
# SPDX-License-Identifier: Apache-2.0

config BOARD_QEMU_RISCV
	select SOC_QEMU_VIRT_RISCV32 if BOARD_QEMU_RISCV_QEMU_VIRT_RISCV32 || BOARD_QEMU_RISCV_QEMU_VIRT_RISCV32_SMP
	select SOC_QEMU_VIRT_RISCV32E if BOARD_QEMU_RISCV_QEMU_VIRT_RISCV32E
	select SOC_QEMU_VIRT_RISCV64 if BOARD_QEMU_RISCV_QEMU_VIRT_RISCV64 || BOARD_QEMU_RISCV_QEMU_VIRT_RISCV64_SMP
```

## boards/qemu/riscv/board.yml
```yaml
board:
  name: qemu_riscv
  full_name: QEMU Emulation for RISCV
  vendor: qemu
  socs:
    - name: qemu_virt_riscv
      variants:
        - name: smp
          cpucluster: rv32
        - name: smp
          cpucluster: rv64
```

## boards/qemu/riscv32/Kconfig
```kconfig
# Copyright (c) 2024 Antmicro <www.antmicro.com>
# SPDX-License-Identifier: Apache-2.0

config BOARD_QEMU_RISCV32
	select QEMU_TARGET
```

## boards/qemu/riscv32/Kconfig.defconfig
```kconfig
# Copyright (c) 2024 Antmicro <www.antmicro.com>
# SPDX-License-Identifier: Apache-2.0

if BOARD_QEMU_RISCV32

# Use thread local storage by default so that this feature gets more CI coverage.
config THREAD_LOCAL_STORAGE
	default y

config BUILD_OUTPUT_BIN
	default n

config HAS_COVERAGE_SUPPORT
	default y

config QEMU_ICOUNT_SHIFT
	default 6 if QEMU_ICOUNT

endif # BOARD_QEMU_RISCV32
```

## boards/qemu/riscv32/qemu_riscv32_defconfig
```kconfig
# SPDX-License-Identifier: Apache-2.0

CONFIG_CONSOLE=y
CONFIG_SERIAL=y
CONFIG_UART_CONSOLE=y
CONFIG_STACK_SENTINEL=y
CONFIG_XIP=n
CONFIG_RISCV_PMP=y
```

## boards/qemu/riscv32/qemu_riscv32_qemu_virt_riscv32_aia_defconfig
```kconfig
# Copyright (c) 2025 Synopsys, Inc.
# SPDX-License-Identifier: Apache-2.0

CONFIG_CONSOLE=y
CONFIG_SERIAL=y
CONFIG_UART_CONSOLE=y
CONFIG_STACK_SENTINEL=y
CONFIG_XIP=n
CONFIG_RISCV_PMP=y
CONFIG_SYS_CLOCK_HW_CYCLES_PER_SEC=10000000
CONFIG_SYS_CLOCK_EXISTS=y
```

## boards/qemu/riscv32/qemu_riscv32_qemu_virt_riscv32_opensbi_defconfig
```kconfig
# Copyright (c) 2024 sensry.io
# SPDX-License-Identifier: Apache-2.0

CONFIG_CONSOLE=y
CONFIG_SERIAL=y
CONFIG_UART_CONSOLE=y
CONFIG_STACK_SENTINEL=y
CONFIG_XIP=n
CONFIG_RISCV_PMP=y
CONFIG_SMP=y
CONFIG_MP_MAX_NUM_CPUS=1
CONFIG_IDLE_STACK_SIZE=1024
CONFIG_QEMU_ICOUNT=n

# enable the openSBI support, requires a compiled version of openSBI binary in machine mode
CONFIG_RISCV_OPENSBI=y

# we run zephyr in supervisor mode
CONFIG_RISCV_KERNEL_IN_SUPERVISOR_MODE=y
CONFIG_RISCV_MACHINE_TIMER=n

# options that have to be disabled by now
CONFIG_USERSPACE=n
CONFIG_RISCV_HAS_HART_ID=n
CONFIG_SMP=n
CONFIG_RISCV_PMP=n

# build output for qemu
CONFIG_BUILD_OUTPUT_BIN=y


CONFIG_THREAD_MONITOR=n
```

## boards/qemu/riscv32/qemu_riscv32_qemu_virt_riscv32_smp_defconfig
```kconfig
# SPDX-License-Identifier: Apache-2.0

CONFIG_CONSOLE=y
CONFIG_SERIAL=y
CONFIG_UART_CONSOLE=y
CONFIG_STACK_SENTINEL=y
CONFIG_XIP=n
CONFIG_RISCV_PMP=y
CONFIG_SMP=y
CONFIG_MP_MAX_NUM_CPUS=2
CONFIG_QEMU_ICOUNT=n
```

## boards/qemu/riscv32_xip/Kconfig.defconfig
```kconfig
# Copyright (c) 2024 Antmicro <www.antmicro.com>
# SPDX-License-Identifier: Apache-2.0

if BOARD_QEMU_RISCV32_XIP

# Use thread local storage by default so that this feature gets more CI coverage.
config THREAD_LOCAL_STORAGE
	default y

config BUILD_OUTPUT_BIN
	default n

config HAS_COVERAGE_SUPPORT
	default y

endif # BOARD_QEMU_RISCV32_XIP
```

## boards/qemu/riscv32_xip/Kconfig.qemu_riscv32_xip
```kconfig
# Copyright (c) 2024 Antmicro <www.antmicro.com>
# SPDX-License-Identifier: Apache-2.0

config BOARD_QEMU_RISCV32_XIP
	select SOC_SIFIVE_FREEDOM_FE310
```
