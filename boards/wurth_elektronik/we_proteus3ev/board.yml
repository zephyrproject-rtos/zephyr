## boards/x86/acrn/Kconfig.acrn
```kconfig
# SPDX-License-Identifier: Apache-2.0

config BOARD_ACRN_EHL_CRB
	bool
	default y
	select SOC_IA32
	select CPU_HAS_FPU
	select X86_64
```

## boards/x86/acrn/Kconfig.board
```kconfig
# ACRN User OS

# Copyright (c) 2019 Intel Corporation
# SPDX-License-Identifier: Apache-2.0

config BOARD_ACRN
	def_bool "$(BOARD)" = "acrn"
	depends on SOC_IA32
	select CPU_HAS_FPU
	select SET_GDT
```

## boards/x86/acrn/Kconfig.defconfig
```kconfig
# Copyright (c) 2021 Intel Corporation
# SPDX-License-Identifier: Apache-2.0

if BOARD_ACRN

config BOARD
	default "acrn"
	depends on BOARD_ACRN

config MP_MAX_NUM_CPUS
	default 2

config HEAP_MEM_POOL_SIZE
	default 32768 if ACPI
	depends on KERNEL_MEM_POOL

endif
```

## boards/x86/acrn/acrn_defconfig
```kconfig
# SPDX-License-Identifier: Apache-2.0

CONFIG_SOC_IA32=y
CONFIG_BOARD_ACRN=y
CONFIG_PIC_DISABLE=y
CONFIG_LOAPIC=y
CONFIG_LOAPIC_TIMER=y
CONFIG_CONSOLE=y
CONFIG_SERIAL=y
CONFIG_UART_NS16550=y
CONFIG_UART_CONSOLE=y
CONFIG_SYS_CLOCK_HW_CYCLES_PER_SEC=25000000
CONFIG_BUILD_OUTPUT_BIN=y
CONFIG_SHELL_BACKEND_SERIAL_INTERRUPT_DRIVEN=n
```

## boards/x86/acrn/acrn_ehl_crb_defconfig
```kconfig
# SPDX-License-Identifier: Apache-2.0

CONFIG_SOC_IA32=y
CONFIG_BOARD_ACRN=y
CONFIG_PIC_DISABLE=y
CONFIG_LOAPIC=y
CONFIG_APIC_TIMER=y
CONFIG_X2APIC=y
CONFIG_CONSOLE=y
CONFIG_SERIAL=y
CONFIG_UART_NS16550=y
CONFIG_UART_CONSOLE=y
CONFIG_SYS_CLOCK_HW_CYCLES_PER_SEC=1900000000
CONFIG_BUILD_OUTPUT_BIN=y
CONFIG_SHELL_BACKEND_SERIAL_INTERRUPT_DRIVEN=n
CONFIG_X86_MMU_PAGE_POOL_PAGES=29
```

## boards/x86/arduino_101/Kconfig.board
```kconfig
# SPDX-License-Identifier: Apache-2.0

config BOARD_ARDUINO_101
	bool "Arduino 101 Board"
	depends on SOC_SERIES_QUARK_SE
```

## boards/x86/arduino_101/Kconfig.defconfig
```kconfig
# SPDX-License-Identifier: Apache-2.0

if BOARD_ARDUINO_101

config BOARD
	default "arduino_101"

config TEXT_SECTION_OFFSET
	default 0x30

config SS_RESET_VECTOR
	default 0x40034000

if FLASH && SPI

config SPI_FLASH_W25QXXDV
	default y

config GPIO
	default y

if SPI_FLASH_W25QXXDV

config SPI_FLASH_W25QXXDV_GPIO_SPI_CS
	default y

if DISK_ACCESS_FLASH

config DISK_FLASH_DEV_NAME
	default SPI_FLASH_W25QXXDV_DRV_NAME

config DISK_FLASH_START
	default 0x0

config DISK_FLASH_MAX_RW_SIZE
	default 256

config DISK_ERASE_BLOCK_SIZE
	default 0x1000

config DISK_FLASH_ERASE_ALIGNMENT
	default 0x1000

config DISK_VOLUME_SIZE
	default 0x200000

endif # DISK_ACCESS_FLASH

endif # SPI_FLASH_W25QXXDV

endif # FLASH && SPI

if USB_DEVICE_STACK

config USB_VBUS_GPIO
	default y

config USB_VBUS_GPIO_DEV_NAME
	default "GPIO_0"

config USB_VBUS_GPIO_PIN_NUM
        default 28

endif # USB_DEVICE_STACK

endif # BOARD_ARDUINO_101
```

## boards/x86/arduino_101/arduino_101_mcuboot_defconfig
```kconfig
CONFIG_X86=y
CONFIG_SOC_QUARK_SE_C1000=y
CONFIG_SOC_SERIES_QUARK_SE=y
CONFIG_BOARD_ARDUINO_101=y
CONFIG_CPU_MINUTEIA=y
CONFIG_CONSOLE=y
CONFIG_UART_CONSOLE=y
CONFIG_SERIAL=y
CONFIG_UART_QMSI=y
CONFIG_UART_QMSI_0_BAUDRATE=1000000
CONFIG_UART_QMSI_0_HW_FC=y
CONFIG_PRINTK=y
CONFIG_PINMUX=y
CONFIG_GPIO=y
CONFIG_TEXT_SECTION_OFFSET=0x200
```

## boards/x86/arduino_101/arduino_101_mmu_defconfig
```kconfig
CONFIG_X86=y
CONFIG_SOC_QUARK_SE_C1000=y
CONFIG_SOC_SERIES_QUARK_SE=y
CONFIG_BOARD_ARDUINO_101=y
CONFIG_CPU_MINUTEIA=y
CONFIG_CONSOLE=y
CONFIG_UART_CONSOLE=y
CONFIG_SERIAL=y
CONFIG_UART_QMSI=y
CONFIG_UART_QMSI_0_BAUDRATE=1000000
CONFIG_UART_QMSI_0_HW_FC=y
CONFIG_PRINTK=y
CONFIG_PINMUX=y
CONFIG_GPIO=y
CONFIG_PHYS_RAM_ADDR=0xA8000000
CONFIG_RAM_SIZE=80
CONFIG_FLASH_BASE_ADDRESS=0x40010000
CONFIG_ROM_SIZE=320
CONFIG_ARC_INIT=n
CONFIG_X86_MMU=y
```

## boards/x86/ehl_crb/Kconfig.board
```kconfig
# Copyright (c) 2020 Intel Corporation
# SPDX-License-Identifier: Apache-2.0

config BOARD_EHL_CRB
	bool "Elkhart Lake CRB"
	depends on SOC_ELKHART_LAKE
	select X86_64

config BOARD_EHL_CRB_SBL
	bool "Elkhart Lake CRB (with Slim Bootloader)"
	depends on SOC_ELKHART_LAKE
	select X86_64
```

## boards/x86/ehl_crb/Kconfig.defconfig
```kconfig
# Copyright (c) 2020 Intel Corporation
# SPDX-License-Identifier: Apache-2.0

if BOARD_EHL_CRB || BOARD_EHL_CRB_SBL

config BOARD
	default "ehl_crb_sbl" if BOARD_EHL_CRB_SBL
	default "ehl_crb"

config BUILD_OUTPUT_STRIPPED
	default y

config MP_MAX_NUM_CPUS
	default 2

if BOARD_EHL_CRB_SBL
config SHELL_BACKEND_SERIAL_INTERRUPT_DRIVEN
	depends on SHELL_BACKEND_SERIAL
	default n
endif

# TSC on this board is 1.9 GHz, HPET and APIC are 19.2 MHz
config SYS_CLOCK_HW_CYCLES_PER_SEC
	default 1900000000 if APIC_TSC_DEADLINE_TIMER
	default 1900000000 if APIC_TIMER_TSC
	default 19200000

if APIC_TIMER
config APIC_TIMER_IRQ
	default 24
config APIC_TIMER_TSC_M
	default 3
config APIC_TIMER_TSC_N
	default 249
endif

endif # BOARD_EHL_CRB || BOARD_EHL_CRB_SBL
```

## boards/x86/ehl_crb/Kconfig.ehl_crb
```kconfig
# SPDX-License-Identifier: Apache-2.0

config BOARD_EHL_CRB
	bool
	default y
	select SOC_ELKHART_LAKE
	select X86_64
	select HAS_COVERAGE_SUPPORT
```

## boards/x86/ehl_crb/Kconfig.ehl_crb_sbl
```kconfig
# Copyright (c) 2022 Zephyr Project members and individual contributors
# SPDX-License-Identifier: Apache-2.0

config BOARD_EHL_CRB_SBL
	bool
	default y
	select SOC_ELKHART_LAKE
	select X86_64
```

## boards/x86/ehl_crb/ehl_crb_defconfig
```kconfig
# SPDX-License-Identifier: Apache-2.0

CONFIG_SOC_ELKHART_LAKE=y
CONFIG_BOARD_EHL_CRB=y
CONFIG_PIC_DISABLE=y
CONFIG_LOAPIC=y
CONFIG_CONSOLE=y
CONFIG_SERIAL=y
CONFIG_UART_CONSOLE=y
CONFIG_X2APIC=y
CONFIG_SMP=y
CONFIG_BUILD_OUTPUT_EFI=y
CONFIG_BUILD_NO_GAP_FILL=y
```

## boards/x86/ehl_crb/ehl_crb_sbl_defconfig
```kconfig
# SPDX-License-Identifier: Apache-2.0

CONFIG_SOC_ELKHART_LAKE=y
CONFIG_BOARD_EHL_CRB_SBL=y
CONFIG_PIC_DISABLE=y
CONFIG_LOAPIC=y
CONFIG_CONSOLE=y
CONFIG_SERIAL=y
CONFIG_UART_NS16550=y
CONFIG_UART_CONSOLE=y
CONFIG_X2APIC=y
CONFIG_SMP=y
```

## boards/x86/galileo/Kconfig
```kconfig
# Kconfig - Galileo Pinmux configuration options

#
# Copyright (c) 2016 Intel Corporation
#
# SPDX-License-Identifier: Apache-2.0
#

if PINMUX && BOARD_GALILEO
comment "Galileo Pinmux Options"

config PINMUX_GALILEO_EXP0_NAME
	string "Name of the GPIO expander 0"
	depends on PINMUX && BOARD_GALILEO
	default "EXP0"
	help
	  The name of the GPIO expander labeled as EXP0 in the schematic.

config PINMUX_GALILEO_EXP1_NAME
	string "Name of the GPIO expander 1"
	depends on PINMUX && BOARD_GALILEO
	default "EXP1"
	help
	  The name of the GPIO expander labeled as EXP1 in the schematic.

config PINMUX_GALILEO_EXP2_NAME
	string "Name of the GPIO expander 2"
	depends on PINMUX && BOARD_GALILEO
	default "EXP2"
	help
	  The name of the GPIO expander labeled as EXP2 in the schematic.

config PINMUX_GALILEO_PWM0_NAME
	string "Name of the PWM LED expander 0"
	depends on PINMUX && BOARD_GALILEO
	default "PWM0"
	help
	  The name of the PWM LED expander labeled as PWM0 in the schematic.

config PINMUX_GALILEO_GPIO_DW_NAME
	string "Name of the DesignWare GPIO"
	depends on PINMUX && BOARD_GALILEO
	default "GPIO_0"
	help
	  The name of the DesignWare GPIO with GPIO<0>..GPIO<7> in the schematic.

config PINMUX_GALILEO_GPIO_INTEL_CW_NAME
	string "Name of the Legacy Bridge Core Well GPIO"
	depends on PINMUX && BOARD_GALILEO
	default "GPIO_M0"
	help
	  The name of the Legacy Bridge Core Well GPIO with GPIO<8>..GPIO<9>
	  in the schematic.

config PINMUX_GALILEO_GPIO_INTEL_RW_NAME
	string "Name of the Legacy Bridge Resume Well GPIO"
	depends on PINMUX && BOARD_GALILEO
	default "GPIO_M1"
	help
	  The name of the Legacy Bridge Resume Well GPIO with
	  GPIO_SUS<0>..GPIO_SUS<5> in the schematic.
endif
```

## boards/x86/galileo/Kconfig.board
```kconfig
config BOARD_GALILEO
	bool "Galileo Gen2"
	depends on SOC_SERIES_QUARK_X1000
	select HAS_DTS
	help
	The Intel Galileo Gen 2 development board is a microcontroller board
	based on the Intel Quark SoC X1000 application processor, a 32-bit
	Intel(r) Pentium(r) brand system on a chip (SoC). It is the first board
	based on Intel architecture designed to be hardware and software
	pin-compatible with shields designed for the Arduino Uno* R3.
```

## boards/x86/galileo/Kconfig.defconfig
```kconfig
# SPDX-License-Identifier: Apache-2.0

if BOARD_GALILEO

config BUILD_OUTPUT_STRIPPED
	default y

config BOARD
	default "galileo"

config I2C
	default y

config GPIO
	default y

config PWM
	default y

config SPI
	default y

config SHARED_IRQ
	default y

if GPIO && I2C

config GPIO_PCAL9535A
	default y

if GPIO_PCAL9535A

config GPIO_PCAL9535A_0
	default y

if GPIO_PCAL9535A_0

config GPIO_PCAL9535A_0_DEV_NAME
	default "EXP0"
config GPIO_PCAL9535A_0_I2C_ADDR
	default 0x25
config GPIO_PCAL9535A_0_I2C_MASTER_DEV_NAME
	default "$(dt_str_val,DT_SNPS_DESIGNWARE_I2C_0_LABEL)"

endif # GPIO_PCAL9535A_0

config GPIO_PCAL9535A_1
	default y

if GPIO_PCAL9535A_1

config GPIO_PCAL9535A_1_DEV_NAME
	default "EXP1"
config GPIO_PCAL9535A_1_I2C_ADDR
	default 0x26
config GPIO_PCAL9535A_1_I2C_MASTER_DEV_NAME
	default "$(dt_str_val,DT_SNPS_DESIGNWARE_I2C_0_LABEL)"

endif # GPIO_PCAL9535A_1

config GPIO_PCAL9535A_2
	default y

if GPIO_PCAL9535A_2

config GPIO_PCAL9535A_2_DEV_NAME
	default "EXP2"
config GPIO_PCAL9535A_2_I2C_ADDR
	default 0x27
config GPIO_PCAL9535A_2_I2C_MASTER_DEV_NAME
	default "$(dt_str_val,DT_SNPS_DESIGNWARE_I2C_0_LABEL)"

endif # GPIO_PCAL9535A_2

endif # GPIO_PCAL9535A

endif # GPIO && I2C

if PWM && I2C

config PWM_PCA9685
	default y

if PWM_PCA9685

config PWM_PCA9685_0
	default y

if PWM_PCA9685_0

config PWM_PCA9685_0_DEV_NAME
	default "PWM0"
config PWM_PCA9685_0_I2C_ADDR
	default 0x47
config PWM_PCA9685_0_I2C_MASTER_DEV_NAME
	default "$(dt_str_val,DT_SNPS_DESIGNWARE_I2C_0_LABEL)"

endif # PWM_PCA9685_0
endif # PWM_PCA9685
endif # PWM && I2C

# SPI uses GPIO pin for CS, so it needs to be initialized after
# the gpio_dw driver ( and the pinmux driver for port 1)
config SPI_INIT_PRIORITY
	default 90 if SPI_INTEL

# Pin multiplexer uses PCAL9535A, needs to be initialized after it
config PINMUX_INIT_PRIORITY
	default 80 if PINMUX

endif # BOARD_GALILEO
```

## boards/x86/galileo/galileo_defconfig
```kconfig
CONFIG_NANO_TIMERS=y
CONFIG_NANO_TIMEOUTS=y
CONFIG_X86=y
CONFIG_SOC_QUARK_X1000=y
CONFIG_SOC_SERIES_QUARK_X1000=y
CONFIG_BOARD_GALILEO=y
CONFIG_CPU_MINUTEIA=y
CONFIG_PCI_LEGACY_BRIDGE=y
CONFIG_CONSOLE=y
CONFIG_SERIAL=y
CONFIG_UART_NS16550=y
CONFIG_UART_CONSOLE=y
CONFIG_HPET_TIMER_LEVEL_LOW=y
CONFIG_SYS_CLOCK_HW_CYCLES_PER_SEC=25000000
CONFIG_GPIO=y
CONFIG_GPIO_DW_0_IRQ_SHARED=y
CONFIG_I2C=y
CONFIG_I2C_DW=y
CONFIG_I2C_0=y
CONFIG_I2C_0_IRQ_SHARED=y
CONFIG_GPIO_PCAL9535A=y
CONFIG_GPIO_SCH=y
CONFIG_GPIO_SCH_0=y
CONFIG_GPIO_SCH_1=y
CONFIG_SHARED_IRQ=y
CONFIG_SHARED_IRQ_0_LEVEL_LOW=y
```

## boards/x86/gpmrb/Kconfig.board
```kconfig
# Gordon Peak MRB

# Copyright (c) 2018 Intel Corporation
# SPDX-License-Identifier: Apache-2.0

config BOARD_GPMRB
	def_bool "$(BOARD)" = "gpmrb"
	depends on SOC_APOLLO_LAKE
```

## boards/x86/gpmrb/Kconfig.defconfig
```kconfig
# Copyright (c) 2019 Intel Corporation
# SPDX-License-Identifier: Apache-2.0

if BOARD_GPMRB

config MULTIBOOT
	default n

config BOARD
	default "gpmrb"

config BUILD_OUTPUT_STRIPPED
	default y

endif # BOARD_GPMRB
```

## boards/x86/gpmrb/gpmrb_defconfig
```kconfig
# Copyright (c) 2019 Intel Corporation
# SPDX-License-Identifier: Apache-2.0

CONFIG_X86=y
CONFIG_SOC_APOLLO_LAKE=y
CONFIG_BOARD_GPMRB=y
CONFIG_APIC_TIMER=y
CONFIG_PIC_DISABLE=y
CONFIG_LOAPIC=y
CONFIG_CONSOLE=y
CONFIG_SERIAL=y
CONFIG_UART_NS16550=y
CONFIG_UART_CONSOLE=y
CONFIG_I2C=y
```

## boards/x86/intel_adl/Kconfig.board
```kconfig
# Copyright (c) 2023 Intel Corporation
# SPDX-License-Identifier: Apache-2.0

config BOARD_INTEL_ADL_CRB
	bool "Alder Lake CRB"
	depends on SOC_ALDER_LAKE
	select X86_64
	select HAS_COVERAGE_SUPPORT

config BOARD_INTEL_ADL_RVP
	bool "Alder Lake RVP"
	depends on SOC_ALDER_LAKE
	select X86_64
	select HAS_COVERAGE_SUPPORT
```

## boards/x86/intel_adl/Kconfig.defconfig
```kconfig
# Copyright (c) 2023 Intel Corporation
# SPDX-License-Identifier: Apache-2.0

if BOARD_INTEL_ADL_CRB || BOARD_INTEL_ADL_RVP || BOARD_UP_SQUARED_PRO_7000

config BOARD
	default "intel_adl_crb" if BOARD_INTEL_ADL_CRB
	default "intel_adl_rvp" if BOARD_INTEL_ADL_RVP
	default "up_squared_pro_7000" if BOARD_UP_SQUARED_PRO_7000

config BUILD_OUTPUT_STRIPPED
	default y

config MP_MAX_NUM_CPUS
	default 2

# TSC on this board is 1.9 GHz, HPET and APIC are 19.2 MHz
config SYS_CLOCK_HW_CYCLES_PER_SEC
	default 1900000000 if APIC_TSC_DEADLINE_TIMER
	default 1900000000 if APIC_TIMER_TSC
	default 19200000

if APIC_TIMER
config APIC_TIMER_IRQ
	default 24
config APIC_TIMER_TSC_M
	default 3
config APIC_TIMER_TSC_N
	default 249
endif

config ACPI
	default y

if ACPI
config HEAP_MEM_POOL_ADD_SIZE_ACPI
	default 64000000
config MAIN_STACK_SIZE
	default 320000
config ACPI_PRT_BUS_NAME
	default "_SB.PC00"

if SHELL
config SHELL_STACK_SIZE
	default 320000
endif # SHELL
endif # ACPI

endif # BOARD_INTEL_ADL_CRB || BOARD_INTEL_ADL_RVP || BOARD_UP_SQUARED_PRO_7000
```
