/*
 * Copyright (c) 2024 Analog Devices, Inc.
 *
 * SPDX-License-Identifier: Apache-2.0
 */

#include <zephyr/dt-bindings/sensor/adxl372.h>
#include <zephyr/dt-bindings/gpio/arduino-header-r3.h>


&arduino_spi {
	status = "okay";

	adxl372_eval_adxl372_ardz: adxl372@0 {
		compatible = "adi,adxl372";
		reg = <0x0>;
		spi-max-frequency = <DT_FREQ_M(1)>;
		int1-gpios = <&arduino_header ARDUINO_HEADER_R3_D7 GPIO_ACTIVE_HIGH>;
		fifo-mode = <ADXL372_FIFO_MODE_STREAMED>;
		fifo-watermark = <0x80>;
		status = "okay";
	};
};
