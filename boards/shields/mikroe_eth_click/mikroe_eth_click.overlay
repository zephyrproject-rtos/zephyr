/* Copyright (c) 2020 Linaro Limited.
 * SPDX-License-Identifier: Apache-2.0
 */

&mikrobus_spi {
	status = "okay";

	eth_click_mikroe_eth_click: eth_click@0 {
		compatible = "microchip,enc28j60";
		reg = <0x0>;
		local-mac-address = [00 00 00 01 02 03];
		/* Errata B7/1 specifies min 8Mhz, 20MHz max according to RM */
		spi-max-frequency = <10000000>;
		int-gpios = <&mikrobus_header 7 GPIO_ACTIVE_LOW>;	/* INT */
	};
};
