/*
 * Copyright (c) 2025 Jonas Berg
 *
 * SPDX-License-Identifier: Apache-2.0
 */

/ {
	aliases {
		rtc = &sparkfun_rv8803;
	};
};

&zephyr_i2c {
	status = "okay";

	sparkfun_rv8803: rv8803@32 {
		status = "okay";
		compatible = "microcrystal,rv8803";
		reg = <0x32>;
	};
};
