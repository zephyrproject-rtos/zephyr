/*
 * Copyright 2026 Renato Mauro
 *
 * SPDX-License-Identifier: Apache-2.0
 */

&slcd_panel {
	rotated;
};

&clk_lse {
	status = "okay";  /* Enable the on-board external quartz at 32.768 kHz */
	driving-capability = <3>;
};

&slcd {
	status = "okay";
	lcd-duty = "LCD_DUTY_1_4";
	lcd-bias = "LCD_BIAS_1_3";
	lcd-mux-segment = "LCD_MUXSEGMENT_DISABLE";
	lcd-voltage-source = "LCD_VOLTAGESOURCE_INTERNAL";
	lcd-prescaler = "LCD_PRESCALER_1";
	lcd-divider = "LCD_DIVIDER_31";
	lcd-contrast = "LCD_CONTRASTLEVEL_5";
	lcd-pulse-on-duration = "LCD_PULSEONDURATION_4";
	lcd-dead-time = "LCD_DEADTIME_0";
	lcd-high-drive = "LCD_HIGHDRIVE_DISABLE";
	lcd-blink-mode = "LCD_BLINKMODE_OFF";
	lcd-blink-frequency = "LCD_BLINKFREQUENCY_DIV32";
	pin-list = <4 23 6 13 15 29 31 33 35 25 17 8 9 26 24 34 32 30 28 14 12 5 22 3>;
	com-list = <0 2 4 6 1 3 5 7>;
	character-bit-list = <(1 << 22) (1 << 22) (1 << 23) (1 << 4) (1 << 4) (1 << 3) (1 << 3)
			      (1 << 3) (1 << 22) (1 << 22) (1 << 23) (1 << 4) (1 << 4) (1 << 3)
			      (1 << 12) (1 << 12) (1 << 13) (1 << 6) (1 << 6) (1 << 5) (1 << 5)
			      (1 << 5) (1 << 12) (1 << 12) (1 << 13) (1 << 6) (1 << 6) (1 << 5)
			      (1 << 28) (1 << 28) (1 << 29) (1 << 15) (1 << 15) (1 << 14) (1 << 14)
			      (1 << 14) (1 << 28) (1 << 28) (1 << 29) (1 << 15) (1 << 15) (1 << 14)
			      (1 << 0) (1 << 0) (1 << 1) (1 << 31) (1 << 31) (1 << 30) (1 << 30)
			      (1 << 30) (1 << 0) (1 << 0) (1 << 1) (1 << 31) (1 << 31) (1 << 30)
			      (1 << 24) (1 << 24) (1 << 25) (1 << 3) (1 << 3) (1 << 2) (1 << 2)
			      (1 << 2)
			      (1 << 24) (1 << 24) (1 << 25) (1 << 3) (1 << 3) (1 << 2)
			      (1 << 9) (1 << 9) (1 << 8) (1 << 17) (1 << 17) (1 << 26) (1 << 26)
			      (1 << 26)
			      (1 << 9) (1 << 9) (1 << 8) (1 << 17) (1 << 17) (1 << 26)>;
	character-com-list = <2 0 2 2 0 2 0 6 6 4 0 6 4 4
			      2 0 2 2 0 2 0 6 6 4 0 6 4 4
			      2 0 2 2 0 2 0 6 6 4 0 6 4 4
			      3 1 3 2 0 2 0 6 7 5 1 6 4 4
			      2 0 2 3 1 3 1 7 6 4 0 7 5 5
			      2 0 2 2 0 2 0 6 6 4 0 6 4 4>;
	indicator-bit-list = <(1 << 23) (1 << 23) (1 << 13) (1 << 13)
			      (1 << 29) (1 << 29) (1 << 1) (1 << 1)
			      (1 << 8) (1 << 8) (1 << 25) (1 << 25)>;
	indicator-com-list = <6 4 6 4 6 4 7 5 6 4 6 4>;
};
