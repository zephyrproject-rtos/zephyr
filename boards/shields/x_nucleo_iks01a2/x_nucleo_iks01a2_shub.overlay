/*
 *
 * Copyright (c) 2020 STMicroelectronics
 *
 * SPDX-License-Identifier: Apache-2.0
 */

#include <zephyr/dt-bindings/gpio/arduino-header-r3.h>

&arduino_i2c {
	lsm6dsl_x_nucleo_iks01a2_shub: lsm6dsl@6b {
		compatible = "st,lsm6dsl";
		reg = <0x6b>;
		irq-gpios = <&arduino_header ARDUINO_HEADER_R3_D4 GPIO_ACTIVE_HIGH>;
	};
};
