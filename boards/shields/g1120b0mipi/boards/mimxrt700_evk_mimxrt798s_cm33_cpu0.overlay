/*
 * Copyright 2025 NXP
 *
 * SPDX-License-Identifier: Apache-2.0
 */

#include <zephyr/dt-bindings/mipi_dbi/mipi_dbi.h>
#include <zephyr/dt-bindings/display/panel.h>

&zephyr_lcdif {
	status = "okay";
	clock-frequency = <279000000>;
	wr-period = <14>;
	wr-assert = <6>;
	wr-deassert = <13>;
	cs-assert = <1>;
	cs-deassert = <4>;
};
