## boards/shields/ap4_evb_disp_shield_rev2/Kconfig.shield
```kconfig
# Copyright (c) 2024, Ambiq Micro Inc. <www.ambiq.com>
# SPDX-License-Identifier: Apache-2.0

config SHIELD_AMBIQ_AP4_EVB_DISP_SHIELD_REV2
	def_bool $(shields_list_contains,ap4_evb_disp_shield_rev2)
```

## boards/shields/ap510_disp/Kconfig.shield
```kconfig
# Copyright (c) 2025 Ambiq Micro Inc.
# SPDX-License-Identifier: Apache-2.0

config SHIELD_AP510_DISP
	def_bool $(shields_list_contains,ap510_disp)

config SHIELD_AP510_DISP_SPI
	def_bool $(shields_list_contains,ap510_disp_spi)

config SHIELD_AP510B_DISP
	def_bool $(shields_list_contains,ap510b_disp)
```

## boards/shields/ap510_disp/boards/apollo510_evb.conf
```kconfig
# Copyright (c) 2025 Ambiq Micro Inc.
# SPDX-License-Identifier: Apache-2.0

CONFIG_FPU=y
CONFIG_GPIO=y
CONFIG_INPUT=y
```

## boards/shields/ap510_jdi_disp/Kconfig.shield
```kconfig
# Copyright (c) 2025 Ambiq Micro Inc.
# SPDX-License-Identifier: Apache-2.0

config SHIELD_AP510_JDI_DISP
	def_bool $(shields_list_contains,ap510_jdi_disp)
```

## boards/shields/ap510_jdi_disp/boards/apollo510_eb.conf
```kconfig
# Copyright (c) 2025 Ambiq Micro Inc.
# SPDX-License-Identifier: Apache-2.0

CONFIG_FPU=y
CONFIG_GPIO=y
CONFIG_PWM_AMBIQ_TIMER=y
CONFIG_PWM=y
CONFIG_LS014B7DD01=y
CONFIG_JDI=y
```

## boards/shields/apollo4p_evb_disp_shield/Kconfig.shield
```kconfig
# Copyright (c) 2023 Antmicro <www.antmicro.com>
# SPDX-License-Identifier: Apache-2.0
config SHIELD_APOLLO4P_EVB_DISP_SHIELD
	def_bool $(shields_list_contains,apollo4p_evb_disp_shield)
```

## boards/shields/apollo4p_evb_disp_shield_rev2/Kconfig.shield
```kconfig
# SPDX-License-Identifier: Apache-2.0
#
# Copyright (c) 2025, Ambiq Micro

config SHIELD_AMBIQ_APOLLO4P_EVB_DISP_SHIELD_REV2
	def_bool $(shields_list_contains,apollo4p_evb_disp_shield_rev2)
```

## boards/shields/apollo5_eb_display_8080_card/Kconfig.shield
```kconfig
# Copyright (c) 2025 Ambiq Micro Inc.
# SPDX-License-Identifier: Apache-2.0

config SHIELD_APOLLO5_EB_DISPLAY_8080_CARD
	def_bool $(shields_list_contains,apollo5_eb_display_8080_card)
```

## boards/shields/arceli_eth_w5500/Kconfig.shield
```kconfig
# Copyright (c) 2022 Linumiz
# SPDX-License-Identifier: Apache-2.0

config SHIELD_ARCELI_ETH_W5500
	def_bool $(shields_list_contains,arceli_eth_w5500)
```

## boards/shields/arducam_cu450_ov5640/Kconfig.shield
```kconfig
# Copyright (c) 2025 Renesas Electronics Corporation
# SPDX-License-Identifier: Apache-2.0

config SHIELD_ARDUCAM_CU450_OV5640_DVP
	def_bool $(shields_list_contains,arducam_cu450_ov5640_dvp)
```

## boards/shields/arducam_mega/Kconfig.shield
```kconfig
# Copyright (c) 2026 Mario Paja
# SPDX-License-Identifier: Apache-2.0

config SHIELD_ARDUCAM_MEGA
	def_bool $(shields_list_contains,arducam_mega)

config SHIELD_ARDUCAM_MEGA_ARDUINO
	def_bool $(shields_list_contains,arducam_mega_arduino)

config SHIELD_ARDUCAM_MEGA_MIKROBUS
	def_bool $(shields_list_contains,arducam_mega_mikrobus)

config SHIELD_ARDUCAM_MEGA_XIAO
	def_bool $(shields_list_contains,arducam_mega_xiao)
```

## boards/shields/arduino-core/Kconfig.shield
```kconfig
# Copyright (c) 2023 Intel Corporation
# SPDX-License-Identifier: Apache-2.0

config SHIELD_ARDUINO_CORE
	def_bool $(shields_list_contains,arduino_core)
```

## boards/shields/arduino_giga_display_shield/Kconfig.shield
```kconfig
# Copyright (c) 2025 Arduino SA
# SPDX-License-Identifier: Apache-2.0

config SHIELD_ARDUINO_GIGA_DISPLAY_SHIELD
	def_bool $(shields_list_contains,arduino_giga_display_shield)
```

## boards/shields/arduino_giga_display_shield/boards/arduino_giga_r1_m7.conf
```kconfig
# Copyright (c) 2025 Arduino SA
# SPDX-License-Identifier: Apache-2.0

CONFIG_MEMC=y
CONFIG_DISPLAY_INIT_PRIORITY=87
CONFIG_STM32_LTDC_DISABLE_FMC_BANK1=y
CONFIG_INPUT_GT911_INTERRUPT=y
CONFIG_INPUT_GT911_MAX_TOUCH_POINTS=5
# Enable DMA to be used with dfsdm driver
CONFIG_DMA=y
# dimension of the internal buffer used when DMA is enabled
CONFIG_DMIC_STM32_DFSDM_MAX_SAMPLES=4096
```

## boards/shields/arduino_modulino_latch_relay/Kconfig.shield
```kconfig
# Copyright 2026 Silicon Labs
# SPDX-License-Identifier: Apache-2.0

config SHIELD_ARDUINO_MODULINO_LATCH_RELAY
	def_bool $(shields_list_contains,arduino_modulino_latch_relay)
```

## boards/shields/arduino_modulino_pixels/Kconfig.shield
```kconfig
# Copyright 2025 Google LLC
# SPDX-License-Identifier: Apache-2.0

config SHIELD_ARDUINO_MODULINO_PIXELS
	def_bool $(shields_list_contains,arduino_modulino_pixels)
```

## boards/shields/arduino_modulino_smartleds/Kconfig.shield
```kconfig
# Copyright 2025 Google LLC
# SPDX-License-Identifier: Apache-2.0

config SHIELD_ARDUINO_MODULINO_SMARTLEDS
	def_bool $(shields_list_contains,arduino_modulino_smartleds)
```

## boards/shields/arduino_modulino_thermo/Kconfig.shield
```kconfig
# SPDX-FileCopyrightText: Copyright The Zephyr Project Contributors
# SPDX-License-Identifier: Apache-2.0

config SHIELD_ARDUINO_MODULINO_THERMO
	def_bool $(shields_list_contains,arduino_modulino_thermo)
```

## boards/shields/arduino_uno_click/Kconfig.shield
```kconfig
# Copyright (c) 2023 Andriy Gelman
# SPDX-License-Identifier: Apache-2.0

config ARDUINO_UNO_CLICK
	def_bool $(shields_list_contains,arduino_uno_click)
```

## boards/shields/atmel_oled1_xpro/Kconfig.defconfig
```kconfig
# Copyright (c) 2024 Scott Barnes <scott@atomsmith.net>
# SPDX-License-Identifier: Apache-2.0

if SHIELD_ATMEL_OLED1_XPRO || \
	SHIELD_ATMEL_OLED1_XPRO_EXT2 || \
	SHIELD_ATMEL_OLED1_XPRO_EXT3

if DISPLAY

if LVGL

config LV_Z_VDB_SIZE
	default 64

config LV_DPI_DEF
	default 145

config LV_Z_BITS_PER_PIXEL
	default 1

choice LV_COLOR_DEPTH
	default LV_COLOR_DEPTH_1
endchoice

endif # LVGL

endif # DISPLAY

endif	# SHIELD_ATMEL_OLED1_XPRO || \
	# SHIELD_ATMEL_OLED1_XPRO_EXT2 || \
	# SHIELD_ATMEL_OLED1_XPRO_EXT3
```

## boards/shields/atmel_oled1_xpro/Kconfig.shield
```kconfig
# Copyright (c) 2024 Scott Barnes <scott@atomsmith.net>
# SPDX-License-Identifier: Apache-2.0

config SHIELD_ATMEL_OLED1_XPRO
	def_bool $(shields_list_contains,atmel_oled1_xpro)

config SHIELD_ATMEL_OLED1_XPRO_EXT2
	def_bool $(shields_list_contains,atmel_oled1_xpro_ext2)

config SHIELD_ATMEL_OLED1_XPRO_EXT3
	def_bool $(shields_list_contains,atmel_oled1_xpro_ext3)
```

## boards/shields/atmel_rf2xx/Kconfig.defconfig
```kconfig
# Copyright (c) 2020 Gerson Fernando Budke <nandojve@gmail.com>
# SPDX-License-Identifier: Apache-2.0

if SHIELD_ATMEL_RF2XX || \
	SHIELD_ATMEL_RF2XX_ARDUINO || \
	SHIELD_ATMEL_RF2XX_MIKROBUS || \
	SHIELD_ATMEL_RF2XX_XPRO || \
	SHIELD_ATMEL_RF2XX_LEGACY || \
	SHIELD_ATMEL_RF2XX_XPLAINED

if NETWORKING

config IEEE802154_RF2XX
	default y
	depends on IEEE802154

config NET_CONFIG_IEEE802154_DEV_NAME
	default "RF2XX_0"
	depends on IEEE802154_RF2XX

orsource "boards/*.defconfig"

endif	# NETWORKING

endif	# SHIELD_ATMEL_RF2XX || \
	# SHIELD_ATMEL_RF2XX_ARDUINO || \
	# SHIELD_ATMEL_RF2XX_MIKROBUS || \
	# SHIELD_ATMEL_RF2XX_XPRO || \
	# SHIELD_ATMEL_RF2XX_LEGACY || \
	# SHIELD_ATMEL_RF2XX_XPLAINED
```
