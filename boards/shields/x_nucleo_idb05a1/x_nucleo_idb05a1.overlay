/*
 * Copyright (c) 2019 STMicroelectronics
 *
 * SPDX-License-Identifier: Apache-2.0
 */

#include <zephyr/dt-bindings/gpio/arduino-header-r3.h>

/ {
	chosen {
		zephyr,bt-hci = &spbtle_rf_x_nucleo_idb05a1;
	};
};

&arduino_spi {
	cs-gpios = <&arduino_header ARDUINO_HEADER_R3_A1 GPIO_ACTIVE_LOW>;

	spbtle_rf_x_nucleo_idb05a1: spbtle-rf@0 {
		compatible = "st,hci-spi-v1";
		reg = <0>;
		reset-gpios = <&arduino_header ARDUINO_HEADER_R3_D7 GPIO_ACTIVE_LOW>;
		irq-gpios = <&arduino_header ARDUINO_HEADER_R3_A0
			     (GPIO_ACTIVE_HIGH | GPIO_PULL_DOWN)>;
		spi-max-frequency = <DT_FREQ_M(2)>;
		spi-hold-cs;
	};
};
