/*
 * Copyright (c) 2019 STMicroelectronics
 *
 * SPDX-License-Identifier: Apache-2.0
 */

#include <zephyr/dt-bindings/gpio/arduino-header-r3.h>

&arduino_spi {
	spbtle_rf_x_nucleo_idb05a1: spbtle-rf@0 {
		cs-gpios = <&arduino_header ARDUINO_HEADER_R3_D10
			    (GPIO_ACTIVE_HIGH | GPIO_PULL_UP)>;
		irq-gpios = <&arduino_header ARDUINO_HEADER_R3_D9 0>;
	};
};
