/*
 * Copyright (c) 2025 Jonas Berg
 *
 * SPDX-License-Identifier: Apache-2.0
 */

&zephyr_i2c {
	status = "okay";

	ht16k33_adafruit_ht16k33: ht16k33@70 {
		compatible = "holtek,ht16k33";
		reg = <0x70>;
	};
};
