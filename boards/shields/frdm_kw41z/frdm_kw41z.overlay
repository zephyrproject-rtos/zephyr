/*
 * Copyright (c) 2018, NXP
 *
 * SPDX-License-Identifier: Apache-2.0
 */

/ {
	chosen {
		zephyr,bt-hci = &bt_hci_uart;
	};
};

&arduino_serial {
	status = "okay";
	current-speed = <115200>;

	bt_hci_uart: bt_hci_uart {
		compatible = "zephyr,bt-hci-uart";
		status = "okay";
	};
};
