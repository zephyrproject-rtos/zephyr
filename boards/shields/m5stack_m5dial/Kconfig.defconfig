## boards/shields/m5stack_m5dial/Kconfig.defconfig
```kconfig
# M5Stack M5Dial shield configuration
# Copyright (c) 2023 Martin Kiepfer <mrmarteng@teleschirm.org>
# SPDX-License-Identifier: Apache-2.0

if SHIELD_M5STACK_M5DIAL

config INPUT
	default y

config INPUT_FT5336_INTERRUPT
	default y if INPUT

config LV_COLOR_16_SWAP
	default y if LVGL

config PWM
	default y

config REGULATOR
	default y

endif # SHIELD_M5STACK_M5DIAL
```

## boards/shields/m5stack_m5dial/Kconfig.shield
```kconfig
# M5Stack M5Dial board configuration

# Copyright (c) 2023 Martin Kiepfer <mrmarteng@teleschirm.org>
# SPDX-License-Identifier: Apache-2.0

config SHIELD_M5STACK_M5DIAL
	def_bool $(shields_list_contains,m5stack_m5dial)
```

## boards/shields/m5stack_roverc/Kconfig.shield
```kconfig
# Copyright (c) 2024 Julien Vermillard <julien@vermillard.com>
# SPDX-License-Identifier: Apache-2.0

config SHIELD_M5STACK_ROVERC
	def_bool $(shields_list_contains,m5stack_roverc)
```

## boards/shields/m5stack_unit_minioled/Kconfig.defconfig
```kconfig
# SPDX-License-Identifier: Apache-2.0
# Copyright (c) 2026 The Zephyr Project Contributors

if SHIELD_M5STACK_UNIT_MINIOLED

if DISPLAY

if LVGL

config LV_Z_VDB_SIZE
	default 40

config LV_DPI_DEF
	default 185

config LV_Z_COLOR_MONO_HW_INVERSION
	default y

choice LV_COLOR_DEPTH
	default LV_COLOR_DEPTH_1
endchoice

endif # LVGL

endif # DISPLAY

endif # SHIELD_M5STACK_UNIT_MINIOLED
```

## boards/shields/m5stack_unit_minioled/Kconfig.shield
```kconfig
# SPDX-License-Identifier: Apache-2.0
# Copyright (c) 2026 The Zephyr Project Contributors

config SHIELD_M5STACK_UNIT_MINIOLED
	def_bool $(shields_list_contains,m5stack_unit_minioled)
```

## boards/shields/max31790/Kconfig.shield
```kconfig
# Copyright (c) 2023 SILA Embedded Solutions GmbH
# SPDX-License-Identifier: Apache-2.0

config SHIELD_MAX31790
	def_bool $(shields_list_contains,max31790)
```

## boards/shields/max3421e/Kconfig.defconfig
```kconfig
# Copyright (c) 2022 Nordic Semiconductor ASA
# SPDX-License-Identifier: Apache-2.0

if SHIELD_SPARKFUN_MAX3421E

config UHC_DRIVER
	default y

endif # SHIELD_SPARKFUN_MAX3421E
```

## boards/shields/max3421e/Kconfig.shield
```kconfig
# Copyright (c) 2022 Nordic Semiconductor ASA
# SPDX-License-Identifier: Apache-2.0

config SHIELD_SPARKFUN_MAX3421E
	def_bool $(shields_list_contains,sparkfun_max3421e)
```

## boards/shields/max7219/Kconfig.defconfig
```kconfig
# Copyright (c) 2022 Jimmy Ou <yanagiis@gmail.com>
# SPDX-License-Identifier: Apache-2.0

if SHIELD_MAX7219_8X8

if DISPLAY

config SPI
	default y

config MAX7219
	default y

endif # DISPLAY

endif # SHIELD_MAX7219_GENERIC
```

## boards/shields/max7219/Kconfig.shield
```kconfig
# Copyright (c) 2022 Jimmy Ou <yanagiis@gmail.com>
# SPDX-License-Identifier: Apache-2.0

config SHIELD_MAX7219_8X8
	def_bool $(shields_list_contains,max7219_8x8)
```

## boards/shields/mb1280_stmod_plus/Kconfig.shield
```kconfig
# SPDX-FileCopyrightText: Copyright The Zephyr Project Contributors
# SPDX-License-Identifier: Apache-2.0

config SHIELD_MB1280_STMOD_PLUS
	def_bool $(shields_list_contains,mb1280_stmod_plus)

config SHIELD_MB1280_STMOD_PLUS_ADC
	def_bool $(shields_list_contains,mb1280_stmod_plus_adc)

config SHIELD_MB1280_STMOD_PLUS_I2C
	def_bool $(shields_list_contains,mb1280_stmod_plus_i2c)

config SHIELD_MB1280_STMOD_PLUS_PWM
	def_bool $(shields_list_contains,mb1280_stmod_plus_pwm)

config SHIELD_MB1280_STMOD_PLUS_SERIAL
	def_bool $(shields_list_contains,mb1280_stmod_plus_serial)

config SHIELD_MB1280_STMOD_PLUS_SPI
	def_bool $(shields_list_contains,mb1280_stmod_plus_spi)
```

## boards/shields/mba117xl_tm070/Kconfig.shield
```kconfig
# Copyright (c) 2025 TQ-Systems GmbH <oss@ew.tq-group.com>
# SPDX-License-Identifier: Apache 2.0
# Author: Isaac L. L. Yuki

config SHIELD_MBA117XL_TM070
	def_bool $(shields_list_contains,mba117xl_tm070)
```

## boards/shields/mchp_rnbd451_bt/Kconfig.defconfig
```kconfig
# Copyright (c) 2025-2026 Microchip Technology Inc.
# SPDX-License-Identifier: Apache-2.0

if SHIELD_MCHP_RNBD451_BT || \
	SHIELD_MCHP_RNBD451_BT_MIKROBUS || \
	SHIELD_MCHP_RNBD451_BT_XPLAINED_PRO

if BT

config MAIN_STACK_SIZE
	default 2048 if BT_HOST_CRYPTO

config BT_BUF_ACL_TX_COUNT
	default 12

config BT_BUF_EVT_RX_COUNT
	default 13

config BT_BUF_EVT_DISCARDABLE_COUNT
	default 12

config BT_HCI_ACL_FLOW_CONTROL
	default n

endif # BT

endif   # SHIELD_MCHP_RNBD451_BT
```

## boards/shields/mchp_rnbd451_bt/Kconfig.shield
```kconfig
# Copyright (c) 2025-2026 Microchip Technology Inc.
# SPDX-License-Identifier: Apache-2.0

config SHIELD_MCHP_RNBD451_BT
	def_bool $(shields_list_contains,mchp_rnbd451_bt)

config SHIELD_MCHP_RNBD451_BT_MIKROBUS
	def_bool $(shields_list_contains,mchp_rnbd451_bt_mikrobus)

config SHIELD_MCHP_RNBD451_BT_XPLAINED_PRO
	def_bool $(shields_list_contains,mchp_rnbd451_bt_xplained_pro)
```

## boards/shields/mcp2515/Kconfig.defconfig
```kconfig
# Copyright (c) 2019 Linaro Limited
# SPDX-License-Identifier: Apache-2.0

if SHIELD_DFROBOT_CAN_BUS_V2_0 || SHIELD_KEYESTUDIO_CAN_BUS_KS0411

if CAN

config GPIO
	default y

config SPI
	default y

config CAN_INIT_PRIORITY
	default 80

endif # CAN

endif # SHIELD_DFROBOT_CAN_BUS_V2_0 || SHIELD_KEYESTUDIO_CAN_BUS_KS0411
```

## boards/shields/mcp2515/Kconfig.shield
```kconfig
# Copyright (c) 2019 Linaro Limited
# SPDX-License-Identifier: Apache-2.0

config SHIELD_DFROBOT_CAN_BUS_V2_0
	def_bool $(shields_list_contains,dfrobot_can_bus_v2_0)

config SHIELD_KEYESTUDIO_CAN_BUS_KS0411
	def_bool $(shields_list_contains,keyestudio_can_bus_ks0411)

config SHIELD_ADAFRUIT_CAN_PICOWBELL
	def_bool $(shields_list_contains,adafruit_can_picowbell)

config SHIELD_SEEED_XIAO_CAN
	def_bool $(shields_list_contains,seeed_xiao_can)

config SHIELD_WAVESHARE_PICO_CAN_B
	def_bool $(shields_list_contains,waveshare_pico_can_b)
```

## boards/shields/mikroe_3d_hall_3_click/Kconfig.shield
```kconfig
# Copyright The Zephyr Project Contributors
# SPDX-License-Identifier: Apache-2.0

config SHIELD_MIKROE_3D_HALL_3_CLICK
	def_bool $(shields_list_contains,mikroe_3d_hall_3_click)
```

## boards/shields/mikroe_accel13_click/Kconfig.shield
```kconfig
# Copyright (c) 2023 Mark Olsson <mark@markolsson.se>
# SPDX-License-Identifier: Apache-2.0

config SHIELD_MIKROE_ACCEL13_CLICK
	def_bool $(shields_list_contains,mikroe_accel13_click)
```

## boards/shields/mikroe_accel4_click/Kconfig.shield
```kconfig
#Copyright (C) 2026 Savoir-faire Linux, Inc.
#SPDX-License-Identifier: Apache-2.0

config SHIELD_MIKROE_ACCEL4_CLICK
	def_bool $(shields_list_contains,mikroe_accel4_click)
```

## boards/shields/mikroe_adc_click/Kconfig.defconfig
```kconfig
# Copyright (c) 2020 Vestas Wind Systems A/S
# SPDX-License-Identifier: Apache-2.0

if SHIELD_MIKROE_ADC_CLICK

if ADC

config SPI
	default y

config ADC_MCP320X
	default y

config ADC_INIT_PRIORITY
	default 80

endif # ADC

endif # SHIELD_MIKROE_ADC_CLICK
```

## boards/shields/mikroe_adc_click/Kconfig.shield
```kconfig
# Copyright (c) 2020 Vestas Wind Systems A/S
# SPDX-License-Identifier: Apache-2.0

config SHIELD_MIKROE_ADC_CLICK
	def_bool $(shields_list_contains,mikroe_adc_click)
```

## boards/shields/mikroe_air_quality_3_click/Kconfig.shield
```kconfig
# Copyright The Zephyr Project Contributors
# SPDX-License-Identifier: Apache-2.0

config SHIELD_MIKROE_AIR_QUALITY_3_CLICK
	def_bool $(shields_list_contains,mikroe_air_quality_3_click)
```

## boards/shields/mikroe_ambient_2_click/Kconfig.shield
```kconfig
# Copyright The Zephyr Project Contributors
# SPDX-License-Identifier: Apache-2.0

config SHIELD_MIKROE_AMBIENT_2_CLICK
	def_bool $(shields_list_contains,mikroe_ambient_2_click)
```

## boards/shields/mikroe_ble_tiny_click/Kconfig.shield
```kconfig
# Copyright (c) 2024 Ian Morris
# SPDX-License-Identifier: Apache-2.0

config SHIELD_MIKROE_BLE_TINY_CLICK
	def_bool $(shields_list_contains,mikroe_ble_tiny_click)
```
