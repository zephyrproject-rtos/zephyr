## boards/shields/sc_scobc_v1_dev_board/Kconfig.defconfig
```kconfig
# Copyright (c) 2026 Space Cubics Inc.
# SPDX-License-Identifier: Apache-2.0

if SHIELD_SC_SCOBC_V1_DEV_BOARD

configdefault ETH_DRIVER
	default y

endif # SHIELD_SC_SCOBC_V1_DEV_BOARD
```

## boards/shields/sc_scobc_v1_dev_board/Kconfig.shield
```kconfig
# Copyright (c) 2026 Space Cubics Inc.
# SPDX-License-Identifier: Apache-2.0

config SHIELD_SC_SCOBC_V1_DEV_BOARD
	def_bool $(shields_list_contains,sc_scobc_v1_dev_board)
```

## boards/shields/seeed_w5500/Kconfig.defconfig
```kconfig
# Copyright (c) 2024 Marcin Niestroj
# SPDX-License-Identifier: Apache-2.0

if SHIELD_SEEED_W5500

configdefault ETH_DRIVER
	default y

endif # SHIELD_SEEED_W5500
```

## boards/shields/seeed_wio_sx1262_esp32s3/Kconfig.shield
```kconfig
# Copyright (c) 2026 Marcin Niestroj
# SPDX-License-Identifier: Apache-2.0

config SHIELD_SEEED_WIO_SX1262_ESP32S3
	def_bool $(shields_list_contains,seeed_wio_sx1262_esp32s3)
```

## boards/shields/seeed_xiao_display_gadgets/Kconfig.defconfig
```kconfig
# SPDX-FileCopyrightText: Copyright The Zephyr Project Contributors
# SPDX-License-Identifier: Apache-2.0

if SHIELD_SEEED_XIAO_DISPLAY_0_96 || SHIELD_SEEED_XIAO_DISPLAY_1_14 || \
	SHIELD_SEEED_XIAO_DISPLAY_1_47

if DISPLAY

# The display backlight is controlled by a fixed regulator
configdefault REGULATOR
	default y

if LVGL

configdefault INPUT
	default y

endif # LVGL

endif # DISPLAY

endif # SHIELD_SEEED_XIAO_DISPLAY_*
```

## boards/shields/seeed_xiao_display_gadgets/Kconfig.shield
```kconfig
# SPDX-FileCopyrightText: Copyright The Zephyr Project Contributors
# SPDX-License-Identifier: Apache-2.0

config SHIELD_SEEED_XIAO_DISPLAY_0_96
	def_bool $(shields_list_contains,seeed_xiao_display_0_96)

config SHIELD_SEEED_XIAO_DISPLAY_1_14
	def_bool $(shields_list_contains,seeed_xiao_display_1_14)

config SHIELD_SEEED_XIAO_DISPLAY_1_47
	def_bool $(shields_list_contains,seeed_xiao_display_1_47)
```

## boards/shields/seeed_xiao_expansion_board/Kconfig.defconfig
```kconfig
# Copyright (c) 2024 Charles Dias <charlesdias.cd@outlook.com>
# SPDX-License-Identifier: Apache-2.0

if SHIELD_SEEED_XIAO_EXPANSION_BOARD

if DISPLAY

if LVGL

config LV_Z_VDB_SIZE
	default 64

config LV_DPI_DEF
	default 148

choice LV_COLOR_FORMAT_DEFAULT
	default LV_COLOR_FORMAT_I1
endchoice

endif # LVGL

endif # DISPLAY

endif # SHIELD_SEEED_XIAO_EXPANSION_BOARD
```

## boards/shields/seeed_xiao_logger_hat/Kconfig.defconfig
```kconfig
# SPDX-FileCopyrightText: Copyright The Zephyr Project Contributors
# SPDX-License-Identifier: Apache-2.0

if SHIELD_SEEED_XIAO_LOGGER_HAT

config SENSOR
	default y

config SHT4X
	default y

config RTC
	default y

config RTC_PCF8563
	default y

config GPIO
	default y

config BH1750
	default y

config ADC
	default y

config VOLTAGE_DIVIDER
	default y

endif # SHIELD_SEEED_XIAO_LOGGER_HAT
```

## boards/shields/seeed_xiao_logger_hat/Kconfig.shield
```kconfig
# SPDX-FileCopyrightText: Copyright The Zephyr Project Contributors
# SPDX-License-Identifier: Apache-2.0

config SHIELD_SEEED_XIAO_LOGGER_HAT
	def_bool $(shields_list_contains,seeed_xiao_logger_hat)
```

## boards/shields/seeed_xiao_logger_hat/dts/bindings/seeed,xiao-logger-hat.yaml
```yaml
# SPDX-FileCopyrightText: Copyright (c) 2026, Dawid Zadlo
# SPDX-License-Identifier: Apache-2.0

description: seeed logger hat GPIO Controller

compatible: "seeed,xiao-logger-hat"

properties:
  gpios:
    type: phandle-array
    required: true
```

## boards/shields/seeed_xiao_round_display/Kconfig.defconfig
```kconfig
# Copyright (c) 2024 Nicolas Goualard <nicolas.goualard@sfr.fr>
# SPDX-License-Identifier: Apache-2.0

if SHIELD_SEEED_XIAO_ROUND_DISPLAY

if DISPLAY

if LVGL

config INPUT
	default y

configdefault LV_COLOR_16_SWAP
	default y

endif # LVGL
endif # DISPLAY

endif # SHIELD_XIAO_ROUND_DISPLAY
```

## boards/shields/sensry_sensor_addon/Kconfig.shield
```kconfig
# Copyright (c) 2026 Sensry GmbH
# SPDX-License-Identifier: Apache-2.0

config SHIELD_SENSRY_SENSOR_ADDON
	def_bool $(shields_list_contains,sensry_sensor_addon)
```

## boards/shields/sensry_sensor_addon/boards/Kconfig.defconfig
```kconfig
# Copyright (c) 2026 Sensry GmbH
# SPDX-License-Identifier: Apache-2.0

if BOARD_NRF54L15DK_NRF54L15_CPUAPP && SPI

config SPI_COMPLETION_TIMEOUT_TOLERANCE
	default 1000

if (SPI_NRFX_SPIM || SPI_NRFX_SPIM_RTIO) && !HAS_NORDIC_DMM

# Fit a BMI270 configuration block in the EasyDMA staging buffer.
config SPI_NRFX_RAM_BUFFER_SIZE
	default 64

endif # (SPI_NRFX_SPIM || SPI_NRFX_SPIM_RTIO) && !HAS_NORDIC_DMM

endif # BOARD_NRF54L15DK_NRF54L15_CPUAPP && SPI
```

## boards/shields/smarc_car_brd/Kconfig.shield
```kconfig
# SPDX-FileCopyrightText: Copyright 2026 Ezurio
# SPDX-License-Identifier: Apache-2.0

config SHIELD_SMARC_CAR_BRD
	def_bool $(shields_list_contains,smarc_car_brd)
```

## boards/shields/st_b_lcd40_dsi1_mb1166/boards/stm32f769i_eval.conf
```kconfig
# SPDX-FileCopyrightText: Copyright 2026 STMicroelectronics
# SPDX-License-Identifier: Apache-2.0

CONFIG_MEMC=y
```

## boards/shields/waveshare_3_5_rpi_lcd_f/Kconfig.defconfig
```kconfig
# SPDX-FileCopyrightText: 2026 Texas Instruments Incorporated
# SPDX-License-Identifier: Apache-2.0

if SHIELD_WAVESHARE_3_5_RPI_LCD_F

if DISPLAY

if LVGL

choice LV_COLOR_DEPTH
	default LV_COLOR_DEPTH_16
endchoice

config LV_Z_VDB_SIZE
	default 16

config INPUT
	default y

config LV_Z_POINTER_INPUT
	default y

endif # LVGL

endif # DISPLAY

endif # SHIELD_WAVESHARE_3_5_RPI_LCD_F
```

## boards/shields/waveshare_3_5_rpi_lcd_f/Kconfig.shield
```kconfig
# SPDX-FileCopyrightText: 2026 Texas Instruments Incorporated
# SPDX-License-Identifier: Apache-2.0

config SHIELD_WAVESHARE_3_5_RPI_LCD_F
	def_bool $(shields_list_contains,waveshare_3_5_rpi_lcd_f)
```

## boards/shields/waveshare_3_5_rpi_lcd_f/boards/lp_am13e230.conf
```kconfig
# SPDX-FileCopyrightText: 2026 Texas Instruments Incorporated
# SPDX-License-Identifier: Apache-2.0

CONFIG_SPI=y
CONFIG_SPI_TI_UNICOMM=y
CONFIG_I2C=y
CONFIG_I2C_TI_UNICOMM=y
CONFIG_GPIO=y
CONFIG_INPUT_GT911=y
CONFIG_LV_COLOR_16_SWAP=y
```

## boards/shields/waveshare_3_5_rpi_lcd_f/boards/lp_mspm0g3519.conf
```kconfig
# SPDX-FileCopyrightText: 2026 Texas Instruments Incorporated
# SPDX-License-Identifier: Apache-2.0

CONFIG_I2C=y
CONFIG_INPUT_GT911=y
CONFIG_LV_COLOR_16_SWAP=y
```

## boards/shields/waveshare_dsi_lcd/Kconfig.defconfig
```kconfig
#
# Copyright 2025 NXP
#
# SPDX-License-Identifier: Apache-2.0
#

if SHIELD_WAVESHARE_7INCH_DSI_LCD_C

if DISPLAY

if LVGL

config LV_Z_DOUBLE_VDB
	default y

choice LV_Z_RENDERING_MODE
	default LV_Z_FULL_REFRESH
endchoice

choice LV_COLOR_FORMAT_DEFAULT
	default LV_COLOR_FORMAT_XRGB8888
endchoice

endif # LVGL

endif # DISPLAY

endif # SHIELD_7INCH_DSI_LCD_C
```

## boards/shields/waveshare_pico_oled_1_3/Kconfig.defconfig
```kconfig
# Copyright (c) 2025 TOKITA Hiroshi
# SPDX-License-Identifier: Apache-2.0

if SHIELD_WAVESHARE_PICO_OLED_1_3

if DISPLAY

if LVGL

config LV_DPI_DEF
	default 110

choice LV_Z_COLOR_FORMAT
	default LV_Z_COLOR_FORMAT_I1
endchoice

endif # LVGL

endif # DISPLAY

endif # SHIELD_WAVESHARE_PICO_OLED_1_3
```

## boards/shields/wiznet_w5500/Kconfig.defconfig
```kconfig
# Copyright (c) 2026 Krisztian Szilvasi
# SPDX-License-Identifier: Apache-2.0

if SHIELD_WIZNET_W5500

configdefault ETH_DRIVER
	default y

endif # SHIELD_WIZNET_W5500
```
