## boards/shields/mikroe_silent_step_2_click/Kconfig.shield
```kconfig
# Copyright (c) 2025 Navimatix GmbH
# SPDX-License-Identifier: Apache-2.0

config SHIELD_MIKROE_SILENT_STEP_2_CLICK
	def_bool $(shields_list_contains,mikroe_silent_step_2_click)
```

## boards/shields/mikroe_stepper_18_click/Kconfig.shield
```kconfig
# Copyright (c) 2025 Navimatix GmbH
# SPDX-License-Identifier: Apache-2.0

config SHIELD_MIKROE_STEPPER_18_CLICK
	def_bool $(shields_list_contains,mikroe_stepper_18_click)
```

## boards/shields/mikroe_stepper_19_click/Kconfig.shield
```kconfig
# Copyright (c) 2025 Navimatix GmbH
# SPDX-License-Identifier: Apache-2.0

config SHIELD_MIKROE_STEPPER_19_CLICK
	def_bool $(shields_list_contains,mikroe_stepper_19_click)
```

## boards/shields/mikroe_temp_hum_click/Kconfig.shield
```kconfig
# SPDX-FileCopyrightText: Copyright (c) 2026 ID8 Engineering AB
# SPDX-License-Identifier: Apache-2.0

config SHIELD_MIKROE_TEMP_HUM_CLICK
	def_bool $(shields_list_contains,mikroe_temp_hum_click)
	depends on I2C
```

## boards/shields/mikroe_two_wire_eth_click/Kconfig.shield
```kconfig
# SPDX-FileCopyrightText: Copyright (c) 2026 Siemens AG
# SPDX-License-Identifier: Apache-2.0

config SHIELD_MIKROE_TWO_WIRE_ETH_CLICK
	def_bool $(shields_list_contains,mikroe_two_wire_eth_click)
```

## boards/shields/mikroe_weather_click/Kconfig.shield
```kconfig
# Copyright (c) 2024 Common Ground Electronics
# SPDX-License-Identifier: Apache-2.0

config SHIELD_MIKROE_WEATHER_CLICK_I2C
	def_bool $(shields_list_contains,mikroe_weather_click_i2c)

config SHIELD_MIKROE_WEATHER_CLICK_SPI
	def_bool $(shields_list_contains,mikroe_weather_click_spi)
```

## boards/shields/mikroe_wifi_bt_click/Kconfig.defconfig
```kconfig
# Copyright (c) 2022 Linaro Limited.
# SPDX-License-Identifier: Apache-2.0

if SHIELD_MIKROE_WIFI_BT_CLICK || \
	SHIELD_MIKROE_WIFI_BT_CLICK_MIKROBUS || \
	SHIELD_MIKROE_WIFI_BT_CLICK_ARDUINO

if NETWORKING

choice WIFI_ESP_AT_VERSION
	default WIFI_ESP_AT_VERSION_2_0
	depends on WIFI_ESP_AT
endchoice

orsource "boards/*.defconfig"

endif # NETWORKING

endif   # SHIELD_MIKROE_WIFI_BT_CLICK
```

## boards/shields/mikroe_wifi_bt_click/Kconfig.shield
```kconfig
# Copyright (c) 2022 Linaro Limited.
# SPDX-License-Identifier: Apache-2.0

config SHIELD_MIKROE_WIFI_BT_CLICK
	def_bool $(shields_list_contains,mikroe_wifi_bt_click)

config SHIELD_MIKROE_WIFI_BT_CLICK_MIKROBUS
	def_bool $(shields_list_contains,mikroe_wifi_bt_click_mikrobus)

config SHIELD_MIKROE_WIFI_BT_CLICK_ARDUINO
	def_bool $(shields_list_contains,mikroe_wifi_bt_click_arduino)
```

## boards/shields/npm1100_ek/Kconfig.defconfig
```kconfig
# Copyright (c) 2023 Nordic Semiconductor ASA
# SPDX-License-Identifier: Apache-2.0

if SHIELD_NPM1100_EK

config REGULATOR
	default y

endif # SHIELD_NPM1100_EK
```

## boards/shields/npm1100_ek/Kconfig.shield
```kconfig
# Copyright (c) 2023 Nordic Semiconductor ASA
# SPDX-License-Identifier: Apache-2.0

config SHIELD_NPM1100_EK
	def_bool $(shields_list_contains,npm1100_ek)
```

## boards/shields/npm1300_ek/Kconfig.defconfig
```kconfig
# Copyright (c) 2023 Nordic Semiconductor ASA
# SPDX-License-Identifier: Apache-2.0

if SHIELD_NPM1300_EK

config REGULATOR
	default y

config GPIO
	default y

config SENSOR
	default y

endif # SHIELD_NPM1300_EK
```

## boards/shields/npm1300_ek/Kconfig.shield
```kconfig
# Copyright (c) 2023 Nordic Semiconductor ASA
# SPDX-License-Identifier: Apache-2.0

config SHIELD_NPM1300_EK
	def_bool $(shields_list_contains,npm1300_ek)
```

## boards/shields/npm1304_ek/Kconfig.shield
```kconfig
# Copyright (c) 2025 Nordic Semiconductor ASA
# SPDX-License-Identifier: Apache-2.0

config SHIELD_NPM1304_EK
	def_bool $(shields_list_contains,npm1304_ek)
```

## boards/shields/npm2100_ek/Kconfig.shield
```kconfig
# Copyright (c) 2025 Nordic Semiconductor ASA
# SPDX-License-Identifier: Apache-2.0

config SHIELD_NPM2100_EK
	def_bool $(shields_list_contains,npm2100_ek)
```

## boards/shields/npm6001_ek/Kconfig.defconfig
```kconfig
# Copyright (c) 2022 Nordic Semiconductor ASA
# SPDX-License-Identifier: Apache-2.0

if SHIELD_NPM6001_EK

config GPIO
	default y

config REGULATOR
	default y

config WATCHDOG
	default y

endif # SHIELD_NPM6001_EK
```

## boards/shields/npm6001_ek/Kconfig.shield
```kconfig
# Copyright (c) 2022 Nordic Semiconductor ASA
# SPDX-License-Identifier: Apache-2.0

config SHIELD_NPM6001_EK
	def_bool $(shields_list_contains,npm6001_ek)
```

## boards/shields/nrf21540_ek/Kconfig.defconfig
```kconfig
# Copyright (c) 2021, Nordic Semiconductor ASA
# SPDX-License-Identifier: Apache-2.0

if SHIELD_NRF21540_EK

config SPI
	default y

endif # SHIELD_NRF21540_EK
```

## boards/shields/nrf21540_ek/Kconfig.shield
```kconfig
# Copyright (c) 2021, Nordic Semiconductor ASA
# SPDX-License-Identifier: Apache-2.0

config SHIELD_NRF21540_EK
	def_bool $(shields_list_contains,nrf21540_ek)
```

## boards/shields/nrf7002eb/Kconfig.shield
```kconfig
# Copyright (c) 2024 Nordic Semiconductor ASA
# SPDX-License-Identifier: Apache-2.0

config SHIELD_NRF7002EB
	def_bool $(shields_list_contains,nrf7002eb)

config SHIELD_NRF7002EB_COEX
	def_bool $(shields_list_contains,nrf7002eb_coex)
```

## boards/shields/nrf7002eb2/Kconfig.shield
```kconfig
# Copyright (c) 2025 Nordic Semiconductor ASA
# SPDX-License-Identifier: Apache-2.0

config SHIELD_NRF7002EB2
	def_bool $(shields_list_contains,nrf7002eb2)

config SHIELD_NRF7002EB2_NRF7001
	def_bool $(shields_list_contains,nrf7002eb2_nrf7001)

config SHIELD_NRF7002EB2_NRF7000
	def_bool $(shields_list_contains,nrf7002eb2_nrf7000)

config SHIELD_NRF7002EB2_COEX
	def_bool $(shields_list_contains,nrf7002eb2_coex)
```

## boards/shields/nrf7002ek/Kconfig.shield
```kconfig
# Copyright (c) 2024 Nordic Semiconductor ASA
# SPDX-License-Identifier: Apache-2.0

config SHIELD_NRF7002EK
	def_bool $(shields_list_contains,nrf7002ek)

config SHIELD_NRF7002EK_NRF7001
	def_bool $(shields_list_contains,nrf7002ek_nrf7001)

config SHIELD_NRF7002EK_NRF7000
	def_bool $(shields_list_contains,nrf7002ek_nrf7000)
```

## boards/shields/nrf700x_nrf54l15pdk/Kconfig.shield
```kconfig
# Copyright (c) 2024 Nordic Semiconductor ASA
# SPDX-License-Identifier: Apache-2.0

config SHIELD_NRF700X_NRF54L15PDK
	select NRF_WIFI_COMBINED_BUCKEN_IOVDD_GPIO
	def_bool $(shields_list_contains,nrf700x_nrf54l15pdk)
```

## boards/shields/nxp_adtja1101/Kconfig.defconfig
```kconfig
# Copyright 2024 NXP
# SPDX-License-Identifier: Apache-2.0

if SHIELD_NXP_ADTJA1101

config NETWORKING
	default y

config PHY_TJA11xx
	default y

endif # SHIELD_NXP_ADTJA1101
```

## boards/shields/nxp_adtja1101/Kconfig.shield
```kconfig
# Copyright 2024 NXP
# SPDX-License-Identifier: Apache-2.0

config SHIELD_NXP_ADTJA1101
	def_bool $(shields_list_contains,nxp_adtja1101)
```

## boards/shields/nxp_arduino_wifi_bt/Kconfig.shield
```kconfig
# Copyright 2025 NXP
# SPDX-License-Identifier: Apache-2.0

config SHIELD_NXP_ARDUINO_AW510_WIFI_BT
	def_bool $(shields_list_contains,nxp_arduino_aw510_wifi_bt)
```
