/*
 * Copyright (c) 2025 Jonas Berg
 *
 * SPDX-License-Identifier: Apache-2.0
 */

&zephyr_i2c {
	status = "okay";

	adafruit_apds9960: apds9960@39 {
		compatible = "avago,apds9960";
		status = "okay";
		reg = <0x39>;
	};
};
