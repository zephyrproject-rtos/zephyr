## boards/shields/Kconfig
```kconfig
config HAS_ARDUINO_SERIAL
	bool
	help
	  This option specifies that the target platform is compatible
	  with Arduino Serial

config HAS_ARDUINO_I2C
	bool
	help
	  This option specifies that the target platform is compatible
	  with Arduino I2C

config HAS_ARDUINO_SPI
	bool
	help
	  This option specifies that the target platform is compatible
	  with Arduino SPI
```

## boards/shields/abrobot_esp32c3_oled/Kconfig.shield
```kconfig
# Copyright (c) 2024 Rick Cai <wwhheerree@hotmail.com>
# SPDX-License-Identifier: Apache-2.0

config SHIELD_SH1106_72X40
	def_bool $(shields_list_contains,sh1106_72x40)
```

## boards/shields/ad_apardpfw_sl/Kconfig.defconfig
```kconfig
# Copyright (c) 2026 Analog Devices, Inc.
# SPDX-License-Identifier: Apache-2.0

if SHIELD_AD_APARDPFW_SL

if ETH_ADIN2111

config NET_IF_MAX_IPV4_COUNT
	default 3

config NET_IF_MAX_IPV6_COUNT
	default 3

endif # ETH_ADIN2111

endif # SHIELD_AD_APARDPFW_SL
```

## boards/shields/ad_apardpfw_sl/Kconfig.shield
```kconfig
# Copyright (c) 2026 Analog Devices, Inc.
# SPDX-License-Identifier: Apache-2.0

config SHIELD_AD_APARDPFW_SL
	def_bool $(shields_list_contains,ad_apardpfw_sl)
	depends on DT_HAS_ADI_ADIN2111_ENABLED
	help
	  AD-APARDPFW-SL 10BASE-T1L power forwarder shield with ADIN2111
	  Ethernet switch. Requires board-specific SPI configuration
	  (see boards/apard32690_max32690_m4.overlay for an example).
	  This shield is not compatible with Arduino R3 boards.
```

## boards/shields/adafruit_24lc32/Kconfig.shield
```kconfig
# Copyright (c) 2025 Jonas Berg
# SPDX-License-Identifier: Apache-2.0

config SHIELD_ADAFRUIT_24LC32
	def_bool $(shields_list_contains,adafruit_24lc32)
```

## boards/shields/adafruit_2_8_tft_touch_v2/Kconfig.defconfig
```kconfig
# Copyright (c) 2019 Linaro Limited
# SPDX-License-Identifier: Apache-2.0

if SHIELD_ADAFRUIT_2_8_TFT_TOUCH_V2 || SHIELD_ADAFRUIT_2_8_TFT_TOUCH_V2_NANO

if DISPLAY

if INPUT

# NOTE: Enable if IRQ line is available (requires to solder jumper)
config INPUT_FT5336_INTERRUPT
	default n

endif # INPUT

if LVGL

config LV_Z_VDB_SIZE
	default 64

config LV_Z_BITS_PER_PIXEL
	default 24

choice LV_COLOR_DEPTH
	default LV_COLOR_DEPTH_32
endchoice

config INPUT
	default y

endif # LVGL

endif # DISPLAY

if DISK_DRIVERS

config DISK_DRIVER_SDMMC
	default y

endif # DISK_DRIVERS

endif # SHIELD_ADAFRUIT_2_8_TFT_TOUCH_V2
```

## boards/shields/adafruit_2_8_tft_touch_v2/Kconfig.shield
```kconfig
# Copyright (c) 2019 Linaro Limited
# SPDX-License-Identifier: Apache-2.0

config SHIELD_ADAFRUIT_2_8_TFT_TOUCH_V2
	def_bool $(shields_list_contains,adafruit_2_8_tft_touch_v2)

config SHIELD_ADAFRUIT_2_8_TFT_TOUCH_V2_NANO
	def_bool $(shields_list_contains,adafruit_2_8_tft_touch_v2_nano)
```

## boards/shields/adafruit_ad5693r/Kconfig.shield
```kconfig
# Copyright (c) 2025 Jonas Berg
# SPDX-License-Identifier: Apache-2.0

config SHIELD_ADAFRUIT_AD5693R
	def_bool $(shields_list_contains,adafruit_ad5693r)
```

## boards/shields/adafruit_adalogger_featherwing/Kconfig.shield
```kconfig
# Copyright (c) 2024 Philip-Dylan Gleonec <philip-dylan@gleonec.bzh>
# SPDX-License-Identifier: Apache-2.0

config SHIELD_ADAFRUIT_DATA_LOGGER
	def_bool $(shields_list_contains,adafruit_adalogger_featherwing)
```

## boards/shields/adafruit_aw9523/Kconfig.shield
```kconfig
# Copyright (c) 2024 TOKITA Hiroshi
# SPDX-License-Identifier: Apache-2.0

config SHIELD_ADAFRUIT_AW9523
	def_bool $(shields_list_contains,adafruit_aw9523)
```

## boards/shields/adafruit_data_logger/Kconfig.defconfig
```kconfig
# Copyright (c) 2019-2023 Henrik Brix Andersen <henrik@brixandersen.dk>
# SPDX-License-Identifier: Apache-2.0

if SHIELD_ADAFRUIT_DATA_LOGGER

if DISK_ACCESS

config SPI
	default y

config DISK_DRIVER_SDMMC
	default y

endif # DISK_ACCESS

endif # SHIELD_ADAFRUIT_DATA_LOGGER
```

## boards/shields/adafruit_data_logger/Kconfig.shield
```kconfig
# Copyright (c) 2019 Henrik Brix Andersen <henrik@brixandersen.dk>
# SPDX-License-Identifier: Apache-2.0

config SHIELD_ADAFRUIT_DATA_LOGGER
	def_bool $(shields_list_contains,adafruit_data_logger)
```

## boards/shields/adafruit_dps310/Kconfig.shield
```kconfig
# Copyright (c) 2025 Jonas Berg
# SPDX-License-Identifier: Apache-2.0

config SHIELD_ADAFRUIT_DPS310
	def_bool $(shields_list_contains,adafruit_dps310)
```

## boards/shields/adafruit_drv2605l/Kconfig.shield
```kconfig
# Copyright (c) 2025 Jonas Berg
# SPDX-License-Identifier: Apache-2.0

config SHIELD_ADAFRUIT_DRV2605L
	def_bool $(shields_list_contains,adafruit_drv2605l)
```

## boards/shields/adafruit_ds2484/Kconfig.shield
```kconfig
# Copyright (c) 2025 Jonas Berg
# SPDX-License-Identifier: Apache-2.0

config SHIELD_ADAFRUIT_DS2484
	def_bool $(shields_list_contains,adafruit_ds2484)
```

## boards/shields/adafruit_featherwing_128x32_OLED/Kconfig.shield
```kconfig
# Copyright (c) 2025 Stefan Schmidt <kontakt@stefanschmidt-embedded.de>
# SPDX-License-Identifier: Apache-2.0

config SHIELD_ADAFRUIT_FEATHERWING_128X32_OLED
	def_bool $(shields_list_contains,adafruit_featherwing_128x32_OLED)
```

## boards/shields/adafruit_featherwing_128x32_oled/Kconfig.shield
```kconfig
# Copyright The Zephyr Project Contributors
# SPDX-License-Identifier: Apache-2.0

config SHIELD_ADAFRUIT_FEATHERWING_128X32_OLED
	def_bool $(shields_list_contains,adafruit_featherwing_128x32_oled)
```

## boards/shields/adafruit_featherwing_128x64_oled/Kconfig.shield
```kconfig
# Copyright The Zephyr Project Contributors
# SPDX-License-Identifier: Apache-2.0

config SHIELD_ADAFRUIT_FEATHERWING_128X64_OLED
	def_bool $(shields_list_contains,adafruit_featherwing_128x64_oled)
```

## boards/shields/adafruit_featherwing_max3421e/Kconfig.shield
```kconfig
# Copyright The Zephyr Project Contributors
# SPDX-License-Identifier: Apache-2.0

config SHIELD_ADAFRUIT_FEATHERWING_MAX3421E
	def_bool $(shields_list_contains,adafruit_featherwing_max3421e)
```

## boards/shields/adafruit_ht16k33/Kconfig.shield
```kconfig
# Copyright (c) 2025 Jonas Berg
# SPDX-License-Identifier: Apache-2.0

config SHIELD_ADAFRUIT_HT16K33
	def_bool $(shields_list_contains,adafruit_ht16k33)
```

## boards/shields/adafruit_hts221/Kconfig.shield
```kconfig
# Copyright (c) 2026 Jonas Berg
# SPDX-License-Identifier: Apache-2.0

config SHIELD_ADAFRUIT_HTS221
	def_bool $(shields_list_contains,adafruit_hts221)
```

## boards/shields/adafruit_ina219/Kconfig.shield
```kconfig
# Copyright (c) 2025 Jonas Berg
# SPDX-License-Identifier: Apache-2.0

config SHIELD_ADAFRUIT_INA219
	def_bool $(shields_list_contains,adafruit_ina219)
```

## boards/shields/adafruit_ina228/Kconfig.shield
```kconfig
# Copyright (c) 2025 Ian Wakely
# SPDX-License-Identifier: Apache-2.0

config SHIELD_ADAFRUIT_INA228
	def_bool $(shields_list_contains,adafruit_ina228)
```

## boards/shields/adafruit_ina237/Kconfig.shield
```kconfig
# Copyright (c) 2025 Jonas Berg
# SPDX-License-Identifier: Apache-2.0

config SHIELD_ADAFRUIT_INA237
	def_bool $(shields_list_contains,adafruit_ina237)
```

## boards/shields/adafruit_ina3221/Kconfig.shield
```kconfig
# Copyright (c) 2026 Jonas Berg
# SPDX-License-Identifier: Apache-2.0

config SHIELD_ADAFRUIT_INA3221
	def_bool $(shields_list_contains,adafruit_ina3221)
```
