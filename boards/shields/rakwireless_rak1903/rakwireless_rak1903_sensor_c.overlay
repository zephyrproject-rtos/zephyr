/*
 * SPDX-License-Identifier: Apache-2.0
 * Copyright (c) 2026 RAKwireless Technology Limited
 */

#include <zephyr/dt-bindings/gpio/gpio.h>

#include "rakwireless_rak1903.dtsi"

&rak1903 {
	int-gpios = <&wisblock_sensor_c WISBLOCK_SENSOR_GPIO2 GPIO_ACTIVE_LOW>;
};
