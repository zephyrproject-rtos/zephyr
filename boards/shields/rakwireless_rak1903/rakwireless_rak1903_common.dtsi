/*
 * SPDX-FileCopyrightText: Copyright RAKwireless Technology Limited
 * SPDX-License-Identifier: Apache-2.0
 */

#include <zephyr/dt-bindings/gpio/gpio.h>
#include <zephyr/dt-bindings/gpio/wisblock-sensor-slot.h>

/ {
	aliases {
		light-sensor = &opt3001_rak1903;
	};
};

&wisblock_i2c1 {
	status = "okay";

	opt3001_rak1903: opt3001@44 {
		compatible = "ti,opt3001";
		reg = <0x44>;
	};
};
