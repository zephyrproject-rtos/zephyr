/*
 * Copyright (c) 2026 Renesas Electronics Corporation
 *
 * SPDX-License-Identifier: Apache-2.0
 */

&zephyr_mipi_dsi {
	pll-div = <1>;
	pll-mul-int = <50>;
	pll-mul-frac = "0.00";
	lp-divisor = <5>;
	ulps-wakeup-period = <97>;
	video-mode-delay = <186>;
	timing = <1183 11 26 40>;

	phys-timing {
		t-init = <71999>;
		t-clk-prep = <8>;
		t-hs-prep = <5>;
		t-lp-exit = <7>;
		dphytim4 = <27 1 19 7>;
		dphytim5 = <19 8 11>;
	};
};

&zephyr_lcdif {
	ext-ram = <&sdram1>;
};

&renesas_disp_int {
	status = "okay";
};
