/*
 * Copyright (c) 2019 PHYTEC Messtechnik GmbH
 * Copyright (c) 2022 Miguel Dardenne <miguel.dardenne@gmail.com>
 *
 * SPDX-License-Identifier: Apache-2.0
 */

/ {
	chosen {
		zephyr,display = &ssd1306_ssd1306_128x32;
	};
};

&arduino_i2c {
	status = "okay";

	#include <ssd1306_128x32_common.dtsi>
};
