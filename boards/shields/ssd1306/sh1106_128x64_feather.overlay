/*
 * Copyright (c) 2019 PHYTEC Messtechnik GmbH
 * Copyright (c) 2022 Miguel Dardenne <miguel.dardenne@gmail.com>
 *
 * SPDX-License-Identifier: Apache-2.0
 */

/ {
	chosen {
		zephyr,display = &sh1106_sh1106_128x64;
	};
};

&feather_i2c {
	status = "okay";

	#include <sh1106_128x64_common.dtsi>
};
