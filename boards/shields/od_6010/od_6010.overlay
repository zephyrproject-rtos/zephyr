/*
 * Copyright 2026 NXP
 *
 * SPDX-License-Identifier: Apache-2.0
 */

/* OD-6010 SLCD Panel Shield Device Tree Overlay
 *
 * The OD-6010 is a 6-digit 7-segment LCD panel with 6 indicators.
 * Hardware Configuration:
 * - 6 Display Positions (digits 1-6, right to left per datasheet)
 * - 7 Segments per Position (A-G)
 * - 4 COM lines (COM1-COM4 in datasheet, COM0-COM3 in DTS)
 * - 12 Front-plane pins (Pin 0-11)
 * - 6 Indicators (P1-P6): dot indicators between digit positions
 *
 * OD-6010 Pin Assignment Table according to spec:
 *
 *      |PIN0|PIN1|PIN2|PIN3|PIN4|PIN5|PIN6|PIN7|PIN8|PIN9|PIN10|PIN11
 * -----+----+----+----+----+----+----+----+----+----+----+-----+-----
 * COM0 | 1A | P6 | 2A | P3 | 3A | P2 | 4A | P1 | 5A | P4 | 6A  | P5
 * COM1 | 1B | 1F | 2B | 2F | 3B | 3F | 4B | 4F | 5B | 5F | 6B  | 6F
 * COM2 | 1C | 1G | 2C | 2G | 3C | 3G | 4C | 4G | 5C | 5G | 6C  | 6G
 * COM3 | 1D | 1E | 2D | 2E | 3D | 3E | 4D | 4E | 5D | 5E | 6D  | 6E
 *
 * Display Layout:
 *
 *   __   __  P1  __  P2  __  P3  __   __
 *  |__| |__|    |__|    |__|    |__| |__|
 *  |__| |__| P4 |__| P5 |__| P6 |__| |__|
 *  dig6 dig5    dig4    dig3    dig2 dig1
 *
 * The segment naming:
 *
 *    AAA
 *   F   B
 *    GGG
 *   E   C
 *    DDD
 */

auxdisplay_0: &slcd {
	slcd_panel: od_6010 {
		compatible = "slcd-panel";
		columns = <6>;
		rows = <1>;
		segment-type = <7>; /* 7 segment SLCD panel */

		/* Which pin controls which segment. 6 positions x 7 segments = 42 elements.
		 * Segment order per position: A B C D E F G
		 * Since the display starts from left to right, so position 0 is digit 6,
		 * then digit 5..1.
		 */
		segment-pins = <
				/* Pins for dig6 segments(6A~6G) */
				10 10 10 10 11 11 11
				/* Pins for dig5 segments(5A~5G) */
				8 8 8 8 9 9 9
				/* Pins for dig4 segments(4A~4G) */
				6 6 6 6 7 7 7
				/* Pins for dig3 segments(3A~3G) */
				4 4 4 4 5 5 5
				/* Pins for dig2 segments(2A~2G) */
				2 2 2 2 3 3 3
				/* Pins for dig1 segments(1A~1G) */
				0 0 0 0 1 1 1>;

		/* Which com controls which segment. 6 positions x 7 segments = 42 elements. */
		segment-coms = <
				/* COMs for dig6 segments(6A~6G) */
				0 1 2 3 3 1 2
				/* COMs for dig5 segments(5A~5G) */
				0 1 2 3 3 1 2
				/* COMs for dig4 segments(4A~4G) */
				0 1 2 3 3 1 2
				/* COMs for dig3 segments(3A~3G) */
				0 1 2 3 3 1 2
				/* COMs for dig2 segments(2A~2G) */
				0 1 2 3 3 1 2
				/* COMs for dig1 segments(1A~1G) */
				0 1 2 3 3 1 2>;

		/* 6 dot indicators P1-P6, all driven at COM0. */
		num-indicators = <6>;

		/* Which pin controls which indicator, from indicator P1 to P6 */
		indicator-pins = <7 5 3 9 11 1>;

		/* All driven by COM0. */
		indicator-coms = <0 0 0 0 0 0>;

		/*
		 * Dot indicator index(0-based) at each inter-digit gap,
		 * 5 entries for 6 positions, P1/2/3 at top, P4/5/6 at bottom.
		 * 0xff means no indicator.
		 */
		upper-dot-indicators = <0xff 0 1 2 0xff>;
		lower-dot-indicators = <0xff 3 4 5 0xff>;
	};
};
