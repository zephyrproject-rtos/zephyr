/*
 * Copyright (c) 2025 Jonas Berg
 *
 * SPDX-License-Identifier: Apache-2.0
 */

/ {
	aliases {
		dht0 = &sparkfun_shtc3;
	};
};

&zephyr_i2c {
	status = "okay";

	sparkfun_shtc3: shtc3@70 {
		status = "okay";
		compatible = "sensirion,shtc3", "sensirion,shtcx";
		reg = <0x70>;
		measure-mode = "normal";
		clock-stretching;
	};
};
