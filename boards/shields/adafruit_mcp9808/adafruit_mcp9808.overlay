/*
 * Copyright (c) 2025 Jonas Berg
 *
 * SPDX-License-Identifier: Apache-2.0
 */

&zephyr_i2c {
	status = "okay";

	adafruit_mcp9808: mcp9808@18 {
		compatible = "microchip,mcp9808", "jedec,jc-42.4-temp";
		reg = <0x18>;
	};
};
