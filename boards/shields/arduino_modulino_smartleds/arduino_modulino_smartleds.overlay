/*
 * Copyright 2025 Google LLC
 *
 * SPDX-License-Identifier: Apache-2.0
 */

#include <zephyr/dt-bindings/led/led.h>

/ {
	aliases {
		led-strip = &modulino_smartleds;
	};
};

&zephyr_i2c {
	modulino_smartleds: modulino-smartleds@36 {
		compatible = "arduino,modulino-smartleds";
		reg = <0x36>;
		chain-length = <8>;
		color-mapping = <LED_COLOR_ID_RED
				 LED_COLOR_ID_GREEN
				 LED_COLOR_ID_BLUE>;
	};
};
