/*
 * Copyright The Zephyr Project Contributors
 * SPDX-License-Identifier: Apache-2.0
 */

#include <zephyr/dt-bindings/gpio/mikro-bus.h>

/ {
	aliases {
		accel0 = &lsm6dsl_mikroe_lsm6dsl_click;
	};
};

&mikrobus_spi {
	status = "okay";

	lsm6dsl_mikroe_lsm6dsl_click: lsm6dsl@0 {
		compatible = "st,lsm6dsl";
		reg = <0>;
		spi-max-frequency = <1000000>;
		irq-gpios = <&mikrobus_header MIKROBUS_INT GPIO_ACTIVE_LOW>;
	};
};
