## boards/shields/mikroe_can_fd_6_click/Kconfig.shield
```kconfig
# SPDX-FileCopyrightText: Copyright (c) 2025 Navimatix GmbH
# SPDX-FileCopyrightText: Copyright (c) 2025 TiaC Systems
# SPDX-License-Identifier: Apache-2.0

config SHIELD_MIKROE_CAN_FD_6_CLICK
	def_bool $(shields_list_contains,mikroe_can_fd_6_click)
```

## boards/shields/mikroe_dali2_click/Kconfig.shield
```kconfig
# Copyright The Zephyr Project Contributors
# SPDX-License-Identifier: Apache-2.0

config SHIELD_MIKROE_DALI2_CLICK
	def_bool $(shields_list_contains,mikroe_dali2_click)
```

## boards/shields/mikroe_eeprom_13_click/Kconfig.shield
```kconfig
# SPDX-FileCopyrightText: Copyright (c) 2026 Navimatix GmbH
# SPDX-FileCopyrightText: Copyright (c) 2026 TiaC Systems
# SPDX-License-Identifier: Apache-2.0

config SHIELD_MIKROE_EEPROM_13_CLICK
	def_bool $(shields_list_contains,mikroe_eeprom_13_click)
```

## boards/shields/mikroe_eeram_33v_click/Kconfig.shield
```kconfig
# Copyright (c) 2026 Ambiq Micro Inc. <www.ambiq.com>
# SPDX-License-Identifier: Apache-2.0

config SHIELD_MIKROE_EERAM_33V_CLICK
	def_bool $(shields_list_contains,mikroe_eeram_33v_click)
```

## boards/shields/mikroe_eth3_click/Kconfig.shield
```kconfig
# Copyright (c) 2024 Mario Paja
# SPDX-License-Identifier: Apache-2.0

config SHIELD_MIKROE_ETH3_CLICK
	def_bool $(shields_list_contains,mikroe_eth3_click)
```

## boards/shields/mikroe_eth_click/Kconfig.defconfig
```kconfig
# Copyright (c) 2020 Linaro Limited
# SPDX-License-Identifier: Apache-2.0

if SHIELD_MIKROE_ETH_CLICK

# ENC28J60 is L2 chip slave on SPI
configdefault NET_L2_ETHERNET
	default y

endif # SHIELD_MIKROE_ETH_CLICK
```

## boards/shields/mikroe_eth_click/Kconfig.shield
```kconfig
# Copyright (c) 2020 Linaro Limited.
# SPDX-License-Identifier: Apache-2.0

config SHIELD_MIKROE_ETH_CLICK
	def_bool $(shields_list_contains,mikroe_eth_click)
```

## boards/shields/mikroe_flash_5_click/Kconfig.shield
```kconfig
# Copyright The Zephyr Project Contributors
# SPDX-License-Identifier: Apache-2.0

config SHIELD_MIKROE_FLASH_5_CLICK
	def_bool $(shields_list_contains,mikroe_flash_5_click)
```

## boards/shields/mikroe_flash_6_click/Kconfig.shield
```kconfig
# SPDX-FileCopyrightText: Copyright (c) 2026 Navimatix GmbH
# SPDX-FileCopyrightText: Copyright (c) 2026 TiaC Systems
# SPDX-License-Identifier: Apache-2.0

config SHIELD_MIKROE_FLASH_6_CLICK
	def_bool $(shields_list_contains,mikroe_flash_6_click)
```

## boards/shields/mikroe_flash_8_click/Kconfig.shield
```kconfig
# Copyright The Zephyr Project Contributors
# SPDX-License-Identifier: Apache-2.0

config SHIELD_MIKROE_FLASH_8_CLICK
	def_bool $(shields_list_contains,mikroe_flash_8_click)
```

## boards/shields/mikroe_h_bridge_4_click/Kconfig.shield
```kconfig
# Copyright (c) 2025 Jilay Sandeep Pandya
# SPDX-License-Identifier: Apache-2.0

config SHIELD_MIKROE_H_BRIDGE_4_CLICK
	def_bool $(shields_list_contains,mikroe_h_bridge_4_click)
```

## boards/shields/mikroe_illuminance_click/Kconfig.shield
```kconfig
# Copyright The Zephyr Project Contributors
# SPDX-License-Identifier: Apache-2.0

config SHIELD_MIKROE_ILLUMINANCE_CLICK
	def_bool $(shields_list_contains,mikroe_illuminance_click)
```

## boards/shields/mikroe_ir_gesture_click/Kconfig.shield
```kconfig
# Copyright The Zephyr Project Contributors
# SPDX-License-Identifier: Apache-2.0

config SHIELD_MIKROE_IR_GESTURE_CLICK
	def_bool $(shields_list_contains,mikroe_ir_gesture_click)
```

## boards/shields/mikroe_lin_click/Kconfig.shield
```kconfig
# Copyright (c) 2026 Renesas Electronics Corporation
# SPDX-License-Identifier: Apache-2.0

config SHIELD_MIKROE_LIN_CLICK
	def_bool $(shields_list_contains,mikroe_lin_click)
```

## boards/shields/mikroe_lsm6dsl_click/Kconfig.shield
```kconfig
# Copyright The Zephyr Project Contributors
# SPDX-License-Identifier: Apache-2.0

config SHIELD_MIKROE_LSM6DSL_CLICK
	def_bool $(shields_list_contains,mikroe_lsm6dsl_click)
```

## boards/shields/mikroe_lte_iot10_click/Kconfig.defconfig
```kconfig
# Copyright (c) 2025 Benjamin Cabé <benjamin@zephyrproject.org>
# SPDX-License-Identifier: Apache-2.0

if SHIELD_MIKROE_LTE_IOT10_CLICK

if MODEM_CELLULAR

# Using regulator-fixed driver to pull RTS low and effectively disable flow control since it can't
# really be setup in a generic way when using shields.
config REGULATOR
	default y

endif # MODEM_CELLULAR

endif # SHIELD_MIKROE_LTE_IOT10_CLICK
```

## boards/shields/mikroe_lte_iot10_click/Kconfig.shield
```kconfig
# Copyright (c) 2025 Benjamin Cabé <benjamin@zephyrproject.org>
# SPDX-License-Identifier: Apache-2.0

config SHIELD_MIKROE_LTE_IOT10_CLICK
	def_bool $(shields_list_contains,mikroe_lte_iot10_click)
```

## boards/shields/mikroe_lte_iot7_click/Kconfig.defconfig
```kconfig
# SPDX-FileCopyrightText: Copyright (c) 2026 ID8 Engineering AB
# SPDX-License-Identifier: Apache-2.0

if SHIELD_MIKROE_LTE_IOT7_CLICK

if MODEM_CELLULAR

# Needed by the regulator-fixed node in the shield overlay.
config REGULATOR
	default y

endif # MODEM_CELLULAR

endif # SHIELD_MIKROE_LTE_IOT7_CLICK
```

## boards/shields/mikroe_mcp2518fd_click/Kconfig.shield
```kconfig
# Copyright (c) 2023 Andriy Gelman
# SPDX-License-Identifier: Apache-2.0

config SHIELD_MIKROE_MCP2518FD_CLICK
	def_bool $(shields_list_contains,mikroe_mcp2518fd_click)
```

## boards/shields/mikroe_mcp251x_click/Kconfig.shield
```kconfig
# SPDX-FileCopyrightText: Copyright (c) 2026 Navimatix GmbH
# SPDX-FileCopyrightText: Copyright (c) 2026 TiaC Systems
# SPDX-License-Identifier: Apache-2.0

config SHIELD_MIKROE_CAN_SPI_CLICK
	def_bool $(shields_list_contains,mikroe_can_spi_click)

config SHIELD_MIKROE_MCP25625_CLICK
	def_bool $(shields_list_contains,mikroe_mcp25625_click)
```

## boards/shields/mikroe_mcp251xfd_click/Kconfig.shield
```kconfig
# SPDX-FileCopyrightText: Copyright (c) 2023 Andriy Gelman
# SPDX-FileCopyrightText: Copyright (c) 2026 Navimatix GmbH
# SPDX-FileCopyrightText: Copyright (c) 2026 TiaC Systems
# SPDX-License-Identifier: Apache-2.0

config SHIELD_MIKROE_MCP2517FD_CLICK
	def_bool $(shields_list_contains,mikroe_mcp2517fd_click)

config SHIELD_MIKROE_MCP2518FD_CLICK
	def_bool $(shields_list_contains,mikroe_mcp2518fd_click)

config SHIELD_MIKROE_MCP251863_CLICK
	def_bool $(shields_list_contains,mikroe_mcp251863_click)
```

## boards/shields/mikroe_pressure_3_click/Kconfig.shield
```kconfig
# Copyright The Zephyr Project Contributors
# SPDX-License-Identifier: Apache-2.0

config SHIELD_MIKROE_PRESSURE_3_CLICK
	def_bool $(shields_list_contains,mikroe_pressure_3_click)
```

## boards/shields/mikroe_proximity_9_click/Kconfig.shield
```kconfig
# Copyright The Zephyr Project Contributors
# SPDX-License-Identifier: Apache-2.0

config SHIELD_MIKROE_PROXIMITY_9_CLICK
	def_bool $(shields_list_contains,mikroe_proximity_9_click)
```

## boards/shields/mikroe_rs485_isolator_5_click/Kconfig.shield
```kconfig
# SPDX-FileCopyrightText: Copyright (c) 2026 ID8 Engineering AB
# SPDX-License-Identifier: Apache-2.0

config SHIELD_MIKROE_RS485_ISOLATOR_5_CLICK
	def_bool $(shields_list_contains,mikroe_rs485_isolator_5_click)
```

## boards/shields/mikroe_rtc_18_click/Kconfig.shield
```kconfig
# Copyright (c) 2025 Dipak Shetty
# SPDX-License-Identifier: Apache-2.0

config SHIELD_MIKROE_RTC_18_CLICK
	def_bool $(shields_list_contains,mikroe_rtc_18_click)
```
