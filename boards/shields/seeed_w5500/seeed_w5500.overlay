/*
 * Copyright (c) 2024 Marcin Niestroj
 * SPDX-License-Identifier: Apache-2.0
 */

#include <zephyr/dt-bindings/gpio/arduino-header-r3.h>

&arduino_spi {
	status = "okay";

	eth_w5500: eth-w5500@0 {
		compatible = "wiznet,w5500";
		reg = <0x0>;
		spi-max-frequency = <DT_FREQ_M(20)>;
		int-gpios = <&arduino_header ARDUINO_HEADER_R3_D2 GPIO_ACTIVE_LOW>;
	};
};
