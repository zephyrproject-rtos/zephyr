/*
 * Copyright The Zephyr Project Contributors
 * SPDX-License-Identifier: Apache-2.0
 */

&mikrobus_spi {
	status = "okay";
	cs-gpios = <&mikrobus_header 2 GPIO_ACTIVE_LOW>;

	spi_nand_mikroe_flash_8_click: spi-nand@0 {
		compatible = "jedec,spi-nand";
		reg = <0>;
		status = "okay";
		spi-max-frequency = <104000000>;

		/* gd5f2gq5ue parameters */
		jedec-id = [c8 52];
		size-bytes = <DT_SIZE_M(256)>;
		erase-block-size = <DT_SIZE_K(128)>;
		write-block-size = <DT_SIZE_K(2)>;
		block-erase-duration-max = <5000>;
		page-program-duration-max = <600>;
		page-read-duration-max = <200>;
		reset-duration-max = <500>;
	};
};
