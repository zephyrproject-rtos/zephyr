/*
 * Copyright (c) 2025 Jonas Berg
 *
 * SPDX-License-Identifier: Apache-2.0
 */

/ {
	zephyr,user {
		dac = <&dac_adafruit_ad5693r>;
		dac-channel-id = <0>;
		dac-resolution = <16>;
	};
};

&zephyr_i2c {
	status = "okay";

	dac_adafruit_ad5693r: dac@4c {
		status = "okay";
		compatible = "adi,ad5693";
		reg = <0x4c>;
		#io-channel-cells = <1>;
	};
};
