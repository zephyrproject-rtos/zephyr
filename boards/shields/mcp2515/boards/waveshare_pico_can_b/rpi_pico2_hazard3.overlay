/*
 * SPDX-FileCopyrightText: Copyright (c) 2026 Navimatix GmbH
 * SPDX-FileCopyrightText: Copyright (c) 2026 TiaC Systems
 * SPDX-License-Identifier: Apache-2.0
 */

/* Support for "Raspberry Pi Pico 2 (Hazard3)". */

#include "pico_r3-pinctrl.dtsi"
