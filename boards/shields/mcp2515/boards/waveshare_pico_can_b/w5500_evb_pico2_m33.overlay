/*
 * SPDX-FileCopyrightText: Copyright (c) 2026 Navimatix GmbH
 * SPDX-FileCopyrightText: Copyright (c) 2026 TiaC Systems
 * SPDX-License-Identifier: Apache-2.0
 */

/* Support for "Wiznet W5500 Evaluation Board with RP2350 (W5500-EVB-Pico2)". */

#include "pico_r3-pinctrl.dtsi"
