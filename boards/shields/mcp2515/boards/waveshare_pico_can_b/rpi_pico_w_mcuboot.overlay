/*
 * SPDX-FileCopyrightText: Copyright (c) 2026 Navimatix GmbH
 * SPDX-FileCopyrightText: Copyright (c) 2026 TiaC Systems
 * SPDX-License-Identifier: Apache-2.0
 */

/* Support for "Raspberry Pi Pico W - MCUboot". */

#include "pico_r3-pinctrl.dtsi"
