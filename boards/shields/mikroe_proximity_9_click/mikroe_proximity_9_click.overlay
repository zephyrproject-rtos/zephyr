/*
 * Copyright The Zephyr Project Contributors
 * SPDX-License-Identifier: Apache-2.0
 */

#include <zephyr/dt-bindings/gpio/mikro-bus.h>

/ {
	aliases {
		prox-sensor0 = &vcnl4040_mikroe_proximity_9_click;
	};
};

&mikrobus_i2c {
	status = "okay";

	vcnl4040_mikroe_proximity_9_click: vcnl4040@60 {
		compatible = "vishay,vcnl4040";
		reg = <0x60>;
		int-gpios = <&mikrobus_header MIKROBUS_INT GPIO_ACTIVE_LOW>;
	};
};
