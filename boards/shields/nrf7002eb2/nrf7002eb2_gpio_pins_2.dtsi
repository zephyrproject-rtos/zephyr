/*
 * Copyright (c) 2025 Nordic Semiconductor
 *
 * SPDX-License-Identifier: Apache-2.0
 */

&nrf70 {
	iovdd-ctrl-gpios = <&gpio1 13 GPIO_ACTIVE_HIGH>;
	bucken-gpios = <&gpio1 4 GPIO_ACTIVE_HIGH>;
	host-irq-gpios = <&gpio1 5 GPIO_ACTIVE_HIGH>;
};

&gpio1 {
	status = "okay";
};
