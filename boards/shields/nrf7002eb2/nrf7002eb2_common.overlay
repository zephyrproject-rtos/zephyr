/*
 * Copyright (c) 2026 Nordic Semiconductor
 *
 * SPDX-License-Identifier: Apache-2.0
 *
 * Common overlay snippet for nRF70 EB-II shield (included by shield overlays).
 */
#include <freq.h>

/* Common assignments for nRF70 EB-II shield */
reg = <0>;
spi-max-frequency = <DT_FREQ_M(8)>;

/* Maximum TX power limits for 2.4 GHz */
wifi-max-tx-pwr-2g-dsss = <21>;
wifi-max-tx-pwr-2g-mcs0 = <16>;
wifi-max-tx-pwr-2g-mcs7 = <16>;

/* List of interfaces */
wlan0: wlan0 {
	compatible = "nordic,wlan";
};
