/*
 * Copyright (c) 2026 Nordic Semiconductor
 *
 * SPDX-License-Identifier: Apache-2.0
 *
 * nRF7002 EB-II board overlay for nrf54lm20dk/nrf54lm20b/cpuapp.
 * Includes common SoC overlay snippet.
 */
#include "../nrf54lm20.overlay"
