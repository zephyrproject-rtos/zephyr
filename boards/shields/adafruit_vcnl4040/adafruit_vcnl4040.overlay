/*
 * Copyright (c) 2025 Jonas Berg
 *
 * SPDX-License-Identifier: Apache-2.0
 */

&zephyr_i2c {
	status = "okay";

	adafruit_vcnl4040: vcnl4040@60 {
		compatible = "vishay,vcnl4040";
		reg = <0x60>;
	};
};
