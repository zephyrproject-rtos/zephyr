/*
 * Copyright 2024 NXP
 *
 * SPDX-License-Identifier: Apache-2.0
 */

/*
 * The p3t1755 shield board is plugged into the arduino interface on
 * the FRDM-MCXN236 board, and the J13 on the shield board is connected
 * to the J9 on the MCXN236 referred below.
 * J13-1 -> J9-3; J13-2 -> J9-4;
 * J13-3 -> J9-1; J13-4 -> J9-22;
 */

#include <freq.h>

&flexcomm5_lpi2c5 {
	status = "disabled";
};

&i3c1 {
	status = "okay";

	i2c-scl-hz = <DT_FREQ_K(400)>;
	i3c-scl-hz = <DT_FREQ_K(400)>;
	i3c-od-scl-hz = <DT_FREQ_K(100)>;
};
