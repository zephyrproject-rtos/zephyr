/*
 * Copyright 2024 NXP
 *
 * SPDX-License-Identifier: Apache-2.0
 */

/*
 * The p3t1755 shield board is plugged into the arduino interface on
 * the MIMXRT1180-EVK board, and the J13 on the shield board is connected
 * to the J50 on the RT1180 referred below.
 * J13-1 -> J50-1; J13-2 -> J50-2;
 * J13-3 -> J50-3; J13-4 -> J50-4;
 */

#include <freq.h>

&lpi2c2 {
	status = "disabled";
};

&i3c2 {
	status = "okay";

	i2c-scl-hz = <DT_FREQ_K(400)>;
	i3c-scl-hz = <DT_FREQ_K(400)>;
	i3c-od-scl-hz = <DT_FREQ_K(100)>;
};
