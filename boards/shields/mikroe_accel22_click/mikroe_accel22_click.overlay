/*
 * Copyright (c) 2026 Analog Devices, Inc.
 * SPDX-License-Identifier: Apache-2.0
 */

#include <zephyr/dt-bindings/sensor/adxl367.h>
#include <zephyr/dt-bindings/gpio/mikro-bus.h>

/ {
	aliases {
		accel0 = &adxl367_mikroe_accel22_click;
	};
};

&mikrobus_spi {
	status = "okay";

	adxl367_mikroe_accel22_click: adxl367@0 {
		compatible = "adi,adxl367";
		reg = <0x0>;
		spi-max-frequency = <DT_FREQ_M(1)>;
		int1-gpios = <&mikrobus_header MIKROBUS_INT GPIO_ACTIVE_HIGH>;
		int2-gpios = <&mikrobus_header MIKROBUS_AN GPIO_ACTIVE_HIGH>;
		status = "okay";
	};
};
