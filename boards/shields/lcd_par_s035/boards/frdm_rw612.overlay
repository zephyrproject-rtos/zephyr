/*
 * Copyright 2025 NXP
 *
 * SPDX-License-Identifier: Apache-2.0
 */

&lcdic {
	/* Enable byte swapping */
	nxp,swap-bytes;
	/* Raise the timer0 ratio to enable longer reset delay */
	nxp,timer0-ratio = <15>;
	/* Lower timer1 ratio to enable shorter TE delay */
	nxp,timer1-ratio = <0>;
};
