/*
 * Copyright 2024, NXP
 *
 * SPDX-License-Identifier: Apache-2.0
 */


&flexio_i2c {
	status = "okay";
	gt911_lcd_par_s035: gt911-lcd_par_s035@5d {
		/delete-property/ reset-gpios;
		alt-addr = <0x14>;
	};
};
