/*
 * Copyright (c) 2025 STMicroelectronics
 *
 * SPDX-License-Identifier: Apache-2.0
 */

&dma1 {
	status = "okay";
};

&dmamux1 {
	status = "okay";
};

&mco1 {
	clocks = <&rcc STM32_SRC_SYSCLK MCO1_SEL(MCO_SEL_SYSCLK)>;
	prescaler = <MCO1_PRE(MCO_PRE_DIV_4)>;
	pinctrl-0 = <&rcc_mco_pa8>;
	pinctrl-names = "default";
	status = "okay";
};
