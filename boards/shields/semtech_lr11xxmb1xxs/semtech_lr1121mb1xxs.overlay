/*
 * Copyright (c) 2024 Semtech Corporation
 *
 * SPDX-License-Identifier: Apache-2.0
 */

#include "semtech_lr11xxmb1xxs_common.dtsi"

lora_semtech_lr1121mb1xxs: &lora_semtech_lr11xxmb1xxs {
	compatible = "semtech,lr1121";

	/* LR1121 shields all have XTAL */
};
