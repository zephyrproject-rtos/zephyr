## boards/shields/adafruit_lc709203f/Kconfig.shield
```kconfig
# Copyright (c) 2026 Jonas Berg
# SPDX-License-Identifier: Apache-2.0

config SHIELD_ADAFRUIT_LC709203F
	def_bool $(shields_list_contains,adafruit_lc709203f)
```

## boards/shields/adafruit_lis2mdl/Kconfig.shield
```kconfig
# Copyright (c) 2025 Jonas Berg
# SPDX-License-Identifier: Apache-2.0

config SHIELD_ADAFRUIT_LIS2MDL
	def_bool $(shields_list_contains,adafruit_lis2mdl)
```

## boards/shields/adafruit_lis3dh/Kconfig.shield
```kconfig
# Copyright (c) 2025 Jonas Berg
# SPDX-License-Identifier: Apache-2.0

config SHIELD_ADAFRUIT_LIS3DH
	def_bool $(shields_list_contains,adafruit_lis3dh)
```

## boards/shields/adafruit_ltr329/Kconfig.shield
```kconfig
# Copyright (c) 2025 Jonas Berg
# SPDX-License-Identifier: Apache-2.0

config SHIELD_ADAFRUIT_LTR329
	def_bool $(shields_list_contains,adafruit_ltr329)
```

## boards/shields/adafruit_max17048/Kconfig.shield
```kconfig
# Copyright (c) 2026 Jonas Berg
# SPDX-License-Identifier: Apache-2.0

config SHIELD_ADAFRUIT_MAX17048
	def_bool $(shields_list_contains,adafruit_max17048)
```

## boards/shields/adafruit_mcp4728/Kconfig.shield
```kconfig
# Copyright (c) 2025 Jonas Berg
# SPDX-License-Identifier: Apache-2.0

config SHIELD_ADAFRUIT_MCP4728
	def_bool $(shields_list_contains,adafruit_mcp4728)
```

## boards/shields/adafruit_mcp9808/Kconfig.shield
```kconfig
# Copyright (c) 2025 Jonas Berg
# SPDX-License-Identifier: Apache-2.0

config SHIELD_ADAFRUIT_MCP9808
	def_bool $(shields_list_contains,adafruit_mcp9808)
```

## boards/shields/adafruit_neopixel_grid_bff/Kconfig.shield
```kconfig
# Copyright (c) 2024 Ian Wakely
# SPDX-License-Identifier: Apache-2.0

config SHIELD_ADAFRUIT_NEOPIXEL_GRID_BFF
	def_bool $(shields_list_contains,adafruit_neopixel_grid_bff)
```

## boards/shields/adafruit_pca9685/Kconfig.shield
```kconfig
# Copyright (c) 2022 Nick Ward <nix.ward@gmail.com>
# SPDX-License-Identifier: Apache-2.0

config SHIELD_ADAFRUIT_PCA9685
	def_bool $(shields_list_contains,adafruit_pca9685)
```

## boards/shields/adafruit_pcf8523/Kconfig.shield
```kconfig
# Copyright (c) 2025 Jonas Berg
# SPDX-License-Identifier: Apache-2.0

config SHIELD_ADAFRUIT_PCF8523
	def_bool $(shields_list_contains,adafruit_pcf8523)
```

## boards/shields/adafruit_sht4x/Kconfig.shield
```kconfig
# Copyright (c) 2025 Jonas Berg
# SPDX-License-Identifier: Apache-2.0

config SHIELD_ADAFRUIT_SHT4X
	def_bool $(shields_list_contains,adafruit_sht4x)
```

## boards/shields/adafruit_tsl2591/Kconfig.shield
```kconfig
# Copyright (c) 2025 Jonas Berg
# SPDX-License-Identifier: Apache-2.0

config SHIELD_ADAFRUIT_TSL2591
	def_bool $(shields_list_contains,adafruit_tsl2591)
```

## boards/shields/adafruit_vcnl4040/Kconfig.shield
```kconfig
# Copyright (c) 2025 Jonas Berg
# SPDX-License-Identifier: Apache-2.0

config SHIELD_ADAFRUIT_VCNL4040
	def_bool $(shields_list_contains,adafruit_vcnl4040)
```

## boards/shields/adafruit_winc1500/Kconfig.defconfig
```kconfig
# Copyright (c) 2020 Kim Bøndergaard <kim.bondergaard@prevas.dk>, Prevas A/S
# SPDX-License-Identifier: Apache-2.0

if SHIELD_ADAFRUIT_WINC1500

if NETWORKING

config WIFI
	default y

endif #NETWORKING

endif # SHIELD_ADAFRUIT_WINC1500
```

## boards/shields/adafruit_winc1500/Kconfig.shield
```kconfig
# Copyright (c) 2020 Kim Bøndergaard <kim.bondergaard@prevas.dk>, Prevas A/S
# SPDX-License-Identifier: Apache-2.0

config SHIELD_ADAFRUIT_WINC1500
	def_bool $(shields_list_contains,adafruit_winc1500)
```

## boards/shields/adi_ev_ade9153ashieldz/Kconfig.shield
```kconfig
# Copyright (c) 2024 Plentify (Pty) Ltd.
# SPDX-License-Identifier: Apache-2.0

config SHIELD_ADI_EV_ADE9153ASHIELDZ
	def_bool $(shields_list_contains,adi_ev_ade9153ashieldz)
	select ADE9153A
	select SENSOR
	select GPIO
```

## boards/shields/adi_eval_ade9153ashieldz/Kconfig.shield
```kconfig
# Copyright (c) 2025 Plentify (Pty) Ltd
# SPDX-License-Identifier: Apache-2.0

config SHIELD_ADI_EVAL_ADE9153ASHIELDZ
	def_bool $(shields_list_contains,adi_eval_ade9153ashieldz)
	select ADE9153A
	select SENSOR
	select GPIO
```

## boards/shields/adi_gmsl2_camera_bridge/Kconfig.shield
```kconfig
# Copyright (c) 2026 Charles Dias.
# SPDX-License-Identifier: Apache-2.0

config SHIELD_ADI_GMSL2_CAMERA_BRIDGE
	def_bool $(shields_list_contains,adi_gmsl2_camera_bridge)
```

## boards/shields/adi_lsmspg/Kconfig.shield
```kconfig
# Copyright (c) 2026 Analog Devices, Inc
#
# SPDX-License-Identifier: Apache-2.0

config SHIELD_ADI_LSMSPG
	def_bool $(shields_list_contains,adi_lsmspg)
	select MFD
	select I2C
	select SPI
```

## boards/shields/ambiq_mikrobus_i2c/Kconfig.shield
```kconfig
# Copyright (c) 2025 Ambiq Micro Inc. <www.ambiq.com>
# SPDX-License-Identifier: Apache-2.0

config SHIELD_AMBIQ_MIKROBUS_I2C
	def_bool $(shields_list_contains,ambiq_mikrobus_i2c)
```

## boards/shields/amg88xx/Kconfig.defconfig
```kconfig
# Copyright (c) 2022 Nordic Semiconductor ASA
#
# SPDX-License-Identifier: Apache-2.0

if SHIELD_AMG88XX_EVAL_KIT

config I2C
	default y if SENSOR

endif # SHIELD_AMG88XX_EVAL_KIT
```

## boards/shields/amg88xx/Kconfig.shield
```kconfig
# Copyright (c) 2022 Nordic Semiconductor ASA
#
# SPDX-License-Identifier: Apache-2.0

config SHIELD_AMG88XX_EVAL_KIT
	def_bool $(shields_list_contains,amg88xx_eval_kit)
```

## boards/shields/ap4_evb_disp_shield/kconfig.defconfig
```kconfig
# Copyright (c) 2025, Ambiq Micro Inc. <www.ambiq.com>
# SPDX-License-Identifier: Apache-2.0

if MEMC

if MEMC_MSPI_APS_Z8

choice "MSPI APS Z8 Part selection"
        default MEMC_MSPI_APS25616N
endchoice

endif # MEMC_MSPI_APS_Z8

endif # MEMC
```
