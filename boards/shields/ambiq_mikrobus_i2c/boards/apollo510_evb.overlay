/*
 * Copyright (c) 2025 Ambiq Micro Inc. <www.ambiq.com>
 *
 * SPDX-License-Identifier: Apache-2.0
 *
 * apollo510_evb: Click Board I2C socket is wired to IOM1.
 * SCL=GP8 (M1SCL), SDA=GP9 (M1SDA).
 */

&iom1 {
	status = "okay";
	cmdq-buffer-location = "SRAM_NO_CACHE";
	cmdq-buffer-size = <256>;

	mikrobus_i2c: i2c {
		pinctrl-0 = <&i2c1_default>;
		pinctrl-names = "default";
		clock-frequency = <I2C_BITRATE_STANDARD>;
		scl-gpios = <&gpio0_31 8 (GPIO_OPEN_DRAIN | GPIO_PULL_UP)>;
		sda-gpios = <&gpio0_31 9 (GPIO_OPEN_DRAIN | GPIO_PULL_UP)>;
		status = "okay";
	};
};
