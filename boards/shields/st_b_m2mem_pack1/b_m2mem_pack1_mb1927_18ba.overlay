/*
 * Copyright (c) 2026 Filip Stojanovic <filipembedded@gmail.com>
 * SPDX-License-Identifier: Apache-2.0
 */

#include <freq.h>
#include <mem.h>

#include "b_m2mem_pack1_common.dtsi"

&m2mem_xspi {
	status = "okay";

	m2mem_flash: mx25uw25645: mspi-nor-flash@0 {
		compatible = "mxicy,mx25u", "jedec,nor";
		reg = <0>;
		size = <DT_SIZE_M(256)>; /* 256 Mbits */
		status = "okay";

		mspi-max-frequency = <DT_FREQ_M(50)>;
		mspi-io-mode = "MSPI_IO_MODE_OCTAL";
		mspi-data-rate = "MSPI_DATA_RATE_SINGLE";
		mspi-hardware-ce-num = <0>;

		read-command = <0xec13>;
		write-command = <0x12ed>;
		command-length = "INSTR_2_BYTE";
		/* The number of dummy cycles for the octal read is taken from
		 * configuration register 2 of the memory itself, see the
		 * mxicy,mx25u quirk, so rx-dummy is deliberately not set here.
		 */
		jedec-id = [c2 81 39];

		reset-gpios = <&m2mem_ldo_en M2MEM_CONNECTOR_GPIO_LDO_EN GPIO_ACTIVE_LOW>;
		/* The reset line drives the module LDO enable, so a reset is a
		 * power cycle. Keep the rail down long enough for the memory to
		 * lose its volatile configuration, then let it start up before
		 * the first command.
		 */
		t-reset-pulse = <5000000>;
		t-reset-recovery = <10000000>;

		partitions {
			compatible = "fixed-partitions";
			#address-cells = <1>;
			#size-cells = <1>;

			m2mem_flash0: partition@0 {
				label = "storage";
				reg = <0x0 DT_SIZE_M(32)>;
			};
		};
	};
};
