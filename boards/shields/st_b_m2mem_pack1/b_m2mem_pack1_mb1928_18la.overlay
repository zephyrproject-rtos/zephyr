/*
 * Copyright (c) 2026 Filip Stojanovic <filipembedded@gmail.com>
 * SPDX-License-Identifier: Apache-2.0
 */

#include <freq.h>
#include <mem.h>
#include <zephyr/dt-bindings/flash_controller/xspi.h>

#include "b_m2mem_pack1_common.dtsi"

&m2mem_xspi {
	status = "okay";

	m95p32: xspi-nor-flash@0 {
		compatible = "st,stm32-xspi-nor";
		reg = <0>;
		size = <DT_SIZE_M(32)>; /* 32 Mbits */
		ospi-max-frequency = <DT_FREQ_M(50)>;
		spi-bus-width = <XSPI_QUAD_MODE>;
		data-rate = <XSPI_STR_TRANSFER>;
		reset-gpios = <&m2mem_ldo_en M2MEM_CONNECTOR_GPIO_LDO_EN GPIO_ACTIVE_LOW>;
		reset-gpios-duration = <1>;
		status = "okay";

		#address-cells = <1>;
		#size-cells = <1>;
		ranges = <0x0 0x90000000 DT_SIZE_M(4)>;

		m2mem_flash0: flash@0 {
			compatible = "soc-nv-flash";
			reg = <0x0 DT_SIZE_M(4)>;
			erase-block-size = <DT_SIZE_K(4)>;
			write-block-size = <1>;
		};
	};
};
