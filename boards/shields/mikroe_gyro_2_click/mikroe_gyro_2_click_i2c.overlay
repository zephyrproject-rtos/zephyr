/*
 * SPDX-FileCopyrightText: Copyright (c) 2026 Analog Devices, Inc.
 * SPDX-License-Identifier: Apache-2.0
 *
 * mikroBUS CS low selects I2C. AN and RST stay high.
 * The default I2C ADD jumper ties SA0 high, giving address 0x21.
 */

#include <zephyr/dt-bindings/gpio/mikro-bus.h>

&mikrobus_i2c {
	status = "okay";

	fxas21002: fxas21002@21 {
		compatible = "nxp,fxas21002";
		reg = <0x21>;
		bus-mode-gpios = <&mikrobus_header MIKROBUS_CS GPIO_ACTIVE_LOW>;
		spi-cs-gpios = <&mikrobus_header MIKROBUS_AN GPIO_ACTIVE_LOW>;
		reset-gpios = <&mikrobus_header MIKROBUS_RST GPIO_ACTIVE_LOW>;
		int1-gpios = <&mikrobus_header MIKROBUS_INT GPIO_ACTIVE_LOW>;
	};
};
