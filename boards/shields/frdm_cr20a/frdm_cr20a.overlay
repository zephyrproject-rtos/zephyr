/*
 * Copyright (c) 2019, NXP
 *
 * SPDX-License-Identifier: Apache-2.0
 */

#include <zephyr/dt-bindings/gpio/arduino-header-r3.h>

/ {
	chosen {
		zephyr,ieee802154 = &ieee802154_frdm_cr20a;
	};
};

&arduino_spi {
	status = "okay";

	ieee802154_frdm_cr20a: mcr20a@0 {
		compatible = "nxp,mcr20a";
		reg = <0x0>;
		spi-max-frequency = <4000000>;
		irqb-gpios = <&arduino_header ARDUINO_HEADER_R3_D2
			      (GPIO_ACTIVE_LOW | GPIO_PULL_UP)>;
		reset-gpios = <&arduino_header ARDUINO_HEADER_R3_D5 GPIO_ACTIVE_LOW>;
		status = "okay";
	};
};
