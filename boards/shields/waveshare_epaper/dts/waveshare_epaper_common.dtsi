/*
 * Copyright (c) 2020 Nordic Semiconductor ASA
 *
 * SPDX-License-Identifier: Apache-2.0
 */

#include <zephyr/dt-bindings/gpio/arduino-header-r3.h>

&arduino_spi {
	cs-gpios = <&arduino_header ARDUINO_HEADER_R3_D10 GPIO_ACTIVE_LOW>,
		   <&arduino_header ARDUINO_HEADER_R3_D4 GPIO_ACTIVE_LOW>;
	status = "okay";

	waveshare_epaper_sdhc: sdhc@1 {
		compatible = "zephyr,sdhc-spi-slot";
		reg = <1>;
		spi-max-frequency = <24000000>;
		status = "okay";

		mmc {
			compatible = "zephyr,sdmmc-disk";
			disk-name = "SD";
			status = "okay";
		};
	};
};
