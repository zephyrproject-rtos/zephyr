/*
 * Copyright (c) 2024 Nordic Semiconductor ASA
 *
 * SPDX-License-Identifier: Apache-2.0
 */

/ {
	nrf70: coex {
		compatible = "nordic,nrf7002-coex";
		status = "okay";

		status0-gpios = <&edge_connector 5 GPIO_ACTIVE_HIGH>;
		req-gpios = <&edge_connector 6 GPIO_ACTIVE_HIGH>;
		grant-gpios = <&edge_connector 15 (GPIO_PULL_DOWN | GPIO_ACTIVE_LOW)>;
	};
};
