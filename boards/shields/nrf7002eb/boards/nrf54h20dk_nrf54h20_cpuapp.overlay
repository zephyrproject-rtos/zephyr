/*
 * Copyright (c) 2024 Nordic Semiconductor ASA
 *
 * SPDX-License-Identifier: Apache-2.0
 */

/* Only GPIOs 1..11 are supported for PORT1 in nRF54H20DK board, for now
 * remove this as Wi-Fi SR co-existence is not yet supported on this board.
 * The external SR RF switch may not even be present on this board.
 */
&nrf70 {
	/delete-property/ srrf-switch-gpios;
};
