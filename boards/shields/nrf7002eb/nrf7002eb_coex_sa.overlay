/*
 * Copyright (c) 2025 Nordic Semiconductor ASA
 *
 * SPDX-License-Identifier: Apache-2.0
 */

/ {
	nrf_radio_coex: coex {
		compatible = "nordic,nrf7002-coex";
		status = "okay";

		status0-gpios = <&gpio1 7 GPIO_ACTIVE_HIGH>;
		req-gpios = <&gpio1 8 GPIO_ACTIVE_HIGH>;
		grant-gpios = <&gpio1 3 (GPIO_PULL_DOWN | GPIO_ACTIVE_LOW)>;
	};
};

&gpio1 {
	status = "okay";
};

&gpiote130 {
	status = "okay";
};
