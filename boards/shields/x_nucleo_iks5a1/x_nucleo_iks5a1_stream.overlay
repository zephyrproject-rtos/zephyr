/*
 * Copyright (c) 2026 STMicroelectronics
 *
 * SPDX-License-Identifier: Apache-2.0
 */

#include <zephyr/dt-bindings/gpio/arduino-header-r3.h>
#include <zephyr/dt-bindings/sensor/ism6hg256x.h>

/ {
	aliases {
		stream0 = &ism6hg256x_6a_x_nucleo_iks5a1;
		accel0 = &ism6hg256x_6a_x_nucleo_iks5a1;
	};
};

&arduino_i2c {
	ism6hg256x_6a_x_nucleo_iks5a1: ism6hg256x@6a {
		compatible = "st,ism6hg256x";
		reg = <0x6a>;
		accel-odr = <ISM6HG256X_HG_XL_ODR_AT_480Hz>;
		accel-range = <ISM6HG256X_DT_FS_16G>;
		gyro-odr = <ISM6HG256X_HG_XL_ODR_AT_480Hz>;
		gyro-range = <ISM6HG256X_DT_FS_500DPS>;

		fifo-watermark = <64>;
		accel-fifo-batch-rate = <LSM6DSVXXX_DT_XL_BATCHED_AT_15Hz>;
		gyro-fifo-batch-rate = <LSM6DSVXXX_DT_GY_BATCHED_AT_15Hz>;
		temp-fifo-batch-rate = <LSM6DSVXXX_DT_TEMP_BATCHED_AT_15Hz>;

		sflp-odr = <LSM6DSVXXX_DT_SFLP_ODR_AT_15Hz>;
		sflp-fifo-enable = <LSM6DSVXXX_DT_SFLP_FIFO_GAME_ROTATION_GRAVITY_GBIAS>;

		int1-gpios = <&arduino_header ARDUINO_HEADER_R3_D5 GPIO_ACTIVE_HIGH>;
		drdy-pin = <1>;
	};
};
