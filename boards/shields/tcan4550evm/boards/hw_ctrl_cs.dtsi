/*
 * SPDX-FileCopyrightText: Copyright (c) 2025 Navimatix GmbH
 * SPDX-FileCopyrightText: Copyright (c) 2025 TiaC Systems
 *
 * SPDX-License-Identifier: Apache-2.0
 */

&arduino_spi {
	/delete-property/ cs-gpios;
};
