/*
 * Copyright (c) 2023 Marcin Niestroj
 *
 * SPDX-License-Identifier: Apache-2.0
 */

#include <zephyr/dt-bindings/gpio/arduino-header-r3.h>

/ {
	aliases {
		lora0 = &lora_semtech_sx1276mb1mas;
	};
};

&arduino_spi {
	status = "okay";

	cs-gpios = <&arduino_header ARDUINO_HEADER_R3_D10 GPIO_ACTIVE_LOW>;

	lora_semtech_sx1276mb1mas: lora@0 {
		compatible = "semtech,sx1276";
		reg = <0x0>;
		spi-max-frequency = <DT_FREQ_M(1)>;

		reset-gpios = <&arduino_header ARDUINO_HEADER_R3_A0 GPIO_ACTIVE_LOW>;

		dio-gpios = <&arduino_header ARDUINO_HEADER_R3_D2
			     (GPIO_PULL_DOWN | GPIO_ACTIVE_HIGH)>,
			    <&arduino_header ARDUINO_HEADER_R3_D3
			     (GPIO_PULL_DOWN | GPIO_ACTIVE_HIGH)>,
			    <&arduino_header ARDUINO_HEADER_R3_D4
			     (GPIO_PULL_DOWN | GPIO_ACTIVE_HIGH)>,
			    <&arduino_header ARDUINO_HEADER_R3_D5
			     (GPIO_PULL_DOWN | GPIO_ACTIVE_HIGH)>,
			    <&arduino_header ARDUINO_HEADER_R3_D8
			     (GPIO_PULL_DOWN | GPIO_ACTIVE_HIGH)>,
			    <&arduino_header ARDUINO_HEADER_R3_D9
			     (GPIO_PULL_DOWN | GPIO_ACTIVE_HIGH)>;

		rfo-enable-gpios = <&arduino_header ARDUINO_HEADER_R3_A4 GPIO_ACTIVE_HIGH>;
	};
};
