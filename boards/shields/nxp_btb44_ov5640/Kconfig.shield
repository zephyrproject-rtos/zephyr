## boards/shields/nxp_btb44_ov5640/Kconfig.shield
```kconfig
# Copyright 2024 NXP
# SPDX-License-Identifier: Apache-2.0

config SHIELD_NXP_BTB44_OV5640
	def_bool $(shields_list_contains,nxp_btb44_ov5640)
```

## boards/shields/nxp_ias_camera_to_rpi_camera_adapter/Kconfig.shield
```kconfig
# Copyright (c) 2026 NXP
# SPDX-License-Identifier: Apache-2.0

config SHIELD_NXP_IAS_CAMERA_TO_RPI_CAMERA_ADAPTER
	def_bool $(shields_list_contains,nxp_ias_camera_to_rpi_camera_adapter)
```

## boards/shields/nxp_ias_to_rpi_camera_adapter/Kconfig.defconfig
```kconfig
# Copyright (c) 2026 NXP
# SPDX-License-Identifier: Apache-2.0

if SHIELD_NXP_IAS_TO_RPI_CAMERA_ADAPTER

config REGULATOR
	default y

config REGULATOR_FIXED
	default y

endif # SHIELD_NXP_IAS_TO_RPI_CAMERA_ADAPTER
```

## boards/shields/nxp_m2_bt_uart/Kconfig.shield
```kconfig
# Copyright 2025 NXP
# SPDX-License-Identifier: Apache-2.0

config SHIELD_NXP_M2_BT_UART
	def_bool $(shields_list_contains,nxp_m2_bt_uart)
```

## boards/shields/nxp_m2_ieee802154/Kconfig.defconfig
```kconfig
# Copyright 2026 NXP
# SPDX-License-Identifier: Apache-2.0

if SHIELD_NXP_M2_2EL_2LL_IEEE802154

config HDLC_RCP_IF
	default y

config HDLC_RCP_IF_SPI
	default y

config HDLC_RCP_IF_SPI_DEFERRED_INIT
	default y

config HDLC_RCP_IF_SPI_SMALL_PACKET_SIZE
	default 48

config HDLC_RCP_IF_SPI_ALIGN_ALLOWANCE
	default 16

config SPI
	default y

config I2C
	default y

config BT
	default y

config BT_H4
	default y

config BT_H4_NXP_CTLR
	default y

config NET_L2_OPENTHREAD
	default y

endif # SHIELD_NXP_M2_2EL_2LL_IEEE802154
```

## boards/shields/nxp_m2_ieee802154/Kconfig.shield
```kconfig
# Copyright 2026 NXP
# SPDX-License-Identifier: Apache-2.0

config SHIELD_NXP_M2_2EL_2LL_IEEE802154
	def_bool $(shields_list_contains,nxp_m2_2el_2ll_ieee802154)
```

## boards/shields/nxp_m2_wifi_bt/Kconfig.defconfig
```kconfig
# Copyright 2025 NXP
# SPDX-License-Identifier: Apache-2.0

if SHIELD_NXP_M2_1XK_WIFI_BT

if BT

choice BT_NXP_MODULE
	default BT_NXP_IW416
endchoice

endif # BT

if WIFI

config WIFI_NXP
	default y

config WIFI_NM_WPA_SUPPLICANT_11AX
	default n

config WIFI_NM_WPA_SUPPLICANT_11AC
	default n

choice NXP_WIFI_PART
	default NXP_IW416
endchoice

choice NXP_IW416_MODULE
	default NXP_IW416_MURATA_1XK_M2
endchoice

if WIFI_NM_HOSTAPD_AP

config WIFI_NM_HOSTAPD_REGULATORY_REGION
	default "WW"

endif # WIFI_NM_HOSTAPD_AP

endif # WIFI

endif # SHIELD_NXP_M2_1XK_WIFI_BT

if SHIELD_NXP_M2_2EL_WIFI_BT

if BT

choice BT_NXP_MODULE
	default BT_NXP_NW612
endchoice

endif # BT

if WIFI

config WIFI_NXP
	default y

choice NXP_WIFI_PART
	default NXP_IW61X
endchoice

choice NXP_IW61X_MODULE
	default NXP_IW612_MURATA_2EL_M2
endchoice

if WIFI_NM_HOSTAPD_AP

config WIFI_NM_HOSTAPD_REGULATORY_REGION
	default "WW"

endif # WIFI_NM_HOSTAPD_AP

endif # WIFI

endif # SHIELD_NXP_M2_2EL_WIFI_BT

if SHIELD_NXP_M2_2LL_WIFI_BT

if BT

choice BT_NXP_MODULE
	default BT_NXP_IW610
endchoice

endif # BT

if WIFI

config WIFI_NXP
	default y

choice NXP_WIFI_PART
	default NXP_IW610
endchoice

choice NXP_IW610_MODULE
	default NXP_IW610_MURATA_2LL_M2
endchoice

if WIFI_NM_HOSTAPD_AP

config WIFI_NM_HOSTAPD_REGULATORY_REGION
	default "US"

endif # WIFI_NM_HOSTAPD_AP

endif # WIFI

endif # SHIELD_NXP_M2_2LL_WIFI_BT

if (BT_NXP_IW416) || (BT_NXP_NW612) || (BT_NXP_IW610) || (NXP_IW416) || (NXP_IW61X) || (NXP_IW610)

if BT

config SYSTEM_WORKQUEUE_STACK_SIZE
	default 2048

config BT_LONG_WQ_STACK_SIZE
	default 2560

config MAIN_STACK_SIZE
	default 2560

if SHELL

config SHELL_STACK_SIZE
	default 4096

endif # SHELL

endif # BT

if WIFI_NXP

if SHELL

config NXP_WIFI_SHELL
	default y

endif # SHELL

endif # WIFI_NXP

endif
```

## boards/shields/nxp_m2_wifi_bt/Kconfig.shield
```kconfig
# Copyright 2025 NXP
# SPDX-License-Identifier: Apache-2.0

config SHIELD_NXP_M2_1XK_WIFI_BT
	def_bool $(shields_list_contains,nxp_m2_1xk_wifi_bt)

config SHIELD_NXP_M2_2EL_WIFI_BT
	def_bool $(shields_list_contains,nxp_m2_2el_wifi_bt)

config SHIELD_NXP_M2_2LL_WIFI_BT
	def_bool $(shields_list_contains,nxp_m2_2ll_wifi_bt)
```

## boards/shields/nxp_mx8_dsi_oled1a/Kconfig.defconfig
```kconfig
#
# Copyright 2025 NXP
#
# SPDX-License-Identifier: Apache-2.0
#

if SHIELD_NXP_MX8_DSI_OLED1A

config GPIO
	default y

config GPIO_ADP5585
	default y

if DISPLAY

if LVGL

config LV_Z_VDB_SIZE
	default 100

config LV_Z_DOUBLE_VDB
	default y

config LV_Z_BITS_PER_PIXEL
	default 32

config LV_Z_FULL_REFRESH
	default y

choice LV_COLOR_DEPTH
	default LV_COLOR_DEPTH_32
endchoice

endif # LVGL

endif # DISPLAY

endif # SHIELD_NXP_MX8_DSI_OLED1A
```

## boards/shields/nxp_mx8_dsi_oled1a/Kconfig.shield
```kconfig
#
# Copyright 2025 NXP
#
# SPDX-License-Identifier: Apache-2.0
#

config SHIELD_NXP_MX8_DSI_OLED1A
	def_bool $(shields_list_contains,nxp_mx8_dsi_oled1a)
```

## boards/shields/nxp_mx9_dsi_oled/Kconfig.shield
```kconfig
#
# Copyright 2025 NXP
#
# SPDX-License-Identifier: Apache-2.0
#

config SHIELD_NXP_MX9_DSI_OLED
	def_bool $(shields_list_contains,nxp_mx9_dsi_oled)
```

## boards/shields/nxp_s32k5xx_mb/Kconfig.shield
```kconfig
# Copyright 2025 NXP
# SPDX-License-Identifier: Apache-2.0

config SHIELD_NXP_S32K5XX_MB
	def_bool $(shields_list_contains,nxp_s32k5xx_mb)
```

## boards/shields/od_6010/Kconfig.shield
```kconfig
# Copyright 2026 NXP
#
# SPDX-License-Identifier: Apache-2.0

config SHIELD_OD_6010
	def_bool $(shields_list_contains,od_6010)
	select AUXDISPLAY_SLCD_7SEGMENT
```

## boards/shields/olimex_shield_midi/Kconfig.shield
```kconfig
# Copyright (c) 2025 Titouan Christophe
# SPDX-License-Identifier: Apache-2.0

config SHIELD_OLIMEX_SHIELD_MIDI
	def_bool $(shields_list_contains,olimex_shield_midi)
```

## boards/shields/open_smart_3_8_tft_touch_arduino/Kconfig.defconfig
```kconfig
# Copyright (c) 2024 Kim Bøndergaard <kim@fam-boendergaard.dk>
# SPDX-License-Identifier: Apache-2.0

if SHIELD_OPEN_SMART_3_8_TFT_TOUCH_ARDUINO

if DISPLAY

if INPUT


endif # INPUT

if LVGL

config LV_Z_VDB_SIZE
	default 32

config LV_Z_BITS_PER_PIXEL
	default 24

choice LV_COLOR_DEPTH
	default LV_COLOR_DEPTH_16
endchoice

config INPUT
	default y

endif # LVGL

endif # DISPLAY

endif # SHIELD_OPEN_SMART_3_8_TFT_TOUCH_ARDUINO
```

## boards/shields/open_smart_3_8_tft_touch_arduino/Kconfig.shield
```kconfig
# Copyright (c) 2024 Kim Bøndergaard <kim@fam-boendergaard.dk>
# SPDX-License-Identifier: Apache-2.0

config SHIELD_OPEN_SMART_3_8_TFT_TOUCH_ARDUINO
	def_bool $(shields_list_contains,open_smart_3_8_tft_touch_arduino)
```

## boards/shields/openthread_rcp_arduino/Kconfig.defconfig
```kconfig
# Copyright 2025 Basalte bv
# SPDX-License-Identifier: Apache-2.0

if SHIELD_OPENTHREAD_RCP_ARDUINO_SERIAL || SHIELD_OPENTHREAD_RCP_ARDUINO_SPI

if OPENTHREAD

config SERIAL
	default y if SHIELD_OPENTHREAD_RCP_ARDUINO_SERIAL

config SPI
	default y if SHIELD_OPENTHREAD_RCP_ARDUINO_SPI

config HDLC_RCP_IF
	default y

endif # OPENTHREAD

endif
```

## boards/shields/openthread_rcp_arduino/Kconfig.shield
```kconfig
# Copyright 2025 Basalte bv
# SPDX-License-Identifier: Apache-2.0

config SHIELD_OPENTHREAD_RCP_ARDUINO_SERIAL
	def_bool $(shields_list_contains,openthread_rcp_arduino_serial)

config SHIELD_OPENTHREAD_RCP_ARDUINO_SPI
	def_bool $(shields_list_contains,openthread_rcp_arduino_spi)
```

## boards/shields/openthread_rcp_spi/Kconfig.defconfig
```kconfig
# Copyright 2025 Basalte bv
# SPDX-License-Identifier: Apache-2.0

if SHIELD_OPENTHREAD_RCP_SPI

if OPENTHREAD

config SPI
	default y

config HDLC_RCP_IF
	default y

endif # OPENTHREAD

endif
```

## boards/shields/openthread_rcp_spi/Kconfig.shield
```kconfig
# Copyright 2025 Basalte bv
# SPDX-License-Identifier: Apache-2.0

config SHIELD_OPENTHREAD_RCP_SPI
	def_bool $(shields_list_contains,openthread_rcp_spi)
```

## boards/shields/p3t1755dp_ard/Kconfig.shield
```kconfig
#
# Copyright 2024 NXP
#
# SPDX-License-Identifier: Apache-2.0
#

config SHIELD_P3T1755DP_ARD
	def_bool $(shields_list_contains,p3t1755dp_ard)
```

## boards/shields/p3t1755dp_ard_i2c/Kconfig.shield
```kconfig
#
# Copyright 2024 NXP
#
# SPDX-License-Identifier: Apache-2.0
#

config SHIELD_P3T1755DP_ARD_I3C
	def_bool $(shields_list_contains,p3t1755dp_ard_i3c)
```

## boards/shields/pca63566/Kconfig.shield
```kconfig
# Copyright (c) 2024 Nordic Semiconductor ASA
# SPDX-License-Identifier: Apache-2.0

config SHIELD_PCA63566
	def_bool $(shields_list_contains,pca63566)
```

## boards/shields/pmod_acl/Kconfig.shield
```kconfig
# Copyright (c) 2024 Analog Devices, Inc.
# SPDX-License-Identifier: Apache-2.0

config SHIELD_PMOD_ACL
	def_bool $(shields_list_contains,pmod_acl)
```
