/*
 * Copyright (c) 2022 Linaro Limited.
 * SPDX-License-Identifier: Apache-2.0
 */

&mikrobus_serial {
	current-speed = <115200>;
	status = "okay";

	mikroe_wifi_bt_click {
		compatible = "espressif,esp-at";
		status = "okay";
	};
};
