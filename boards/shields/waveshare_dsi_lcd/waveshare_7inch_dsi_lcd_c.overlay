/*
 * Copyright 2025 NXP
 *
 * SPDX-License-Identifier: Apache-2.0
 */

#include <zephyr/dt-bindings/mipi_dsi/mipi_dsi.h>

&display_i2c {
	dsi_panel: waveshare_panel@45 {
		compatible = "waveshare,dsi2dpi";
		reg = <0x45>;
		data-lanes = <2>;
		pixel-format = <MIPI_DSI_PIXFMT_RGB888>;
		status = "okay";
	};
};
