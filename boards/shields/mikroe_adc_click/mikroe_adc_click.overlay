/*
 * Copyright (c) 2020 Vestas Wind Systems A/S
 *
 * SPDX-License-Identifier: Apache-2.0
 */

&mikrobus_spi {
	status = "okay";

	mcp3204_mikroe_adc_click: mcp3204@0 {
		compatible = "microchip,mcp3204";
		reg = <0x0>;
		spi-max-frequency = <100000>;
		#io-channel-cells = <1>;
	};
};
