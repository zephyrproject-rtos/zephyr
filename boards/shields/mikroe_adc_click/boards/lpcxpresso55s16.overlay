/*
 * Copyright (c) 2020 Henrik Brix Andersen <henrik@brixandersen.dk>
 *
 * SPDX-License-Identifier: Apache-2.0
 */

#include <zephyr/dt-bindings/adc/adc.h>

/delete-node/ &mcp3204_mikroe_adc_click;

&mikrobus_spi {
	status = "okay";

	/* LPCXpresso55S16 uses SSEL1 for mikroBUS SPI */
	mcp3204_mikroe_adc_click: mcp3204@1 {
		compatible = "microchip,mcp3204";
		reg = <0x1>;
		spi-max-frequency = <100000>;
		#io-channel-cells = <1>;
	};
};
