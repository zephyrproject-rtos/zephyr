/*
 * Copyright (c) 2026 Jonas Berg
 *
 * SPDX-License-Identifier: Apache-2.0
 */

&zephyr_i2c {
	status = "okay";

	adafruit_ina3221: ina3221@40 {
		status = "okay";
		compatible = "ti,ina3221";
		reg = <0x40>;
		shunt-resistors = <50>, <50>, <50>;
	};
};
