/*
 *  Copyright (c) 2023 Antmicro <www.antmicro.com>
 *
 * SPDX-License-Identifier: Apache-2.0
 */

/ {
	aliases {
		accel0 = &adxl362;
	};
};

&iom1 {
	compatible = "ambiq,spi";
	pinctrl-0 = <&spi1_default>;
	pinctrl-names = "default";
	clock-frequency = <1000000>;
	status = "okay";

	adxl362: adxl362@0 {
		compatible = "adi,adxl362";
		reg = <0>;
		spi-max-frequency = <5000000>;
		status = "okay";
	};
};
