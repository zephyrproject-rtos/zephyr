/*
 * Copyright (c) 2026 Espressif Systems (Shanghai) Co., Ltd.
 *
 * SPDX-License-Identifier: Apache-2.0
 */

&esp_threadbr_spi {
	status = "okay";
	cs-gpios = <&esp_threadbr_header 21 GPIO_ACTIVE_LOW>;

	esp_sub_eth: esp-sub-eth@0 {
		compatible = "wiznet,w5500";
		reg = <0x0>;
		spi-max-frequency = <8000000>;
		int-gpios = <&esp_threadbr_header 19 GPIO_ACTIVE_LOW>;
		reset-gpios = <&esp_threadbr_header 20 GPIO_ACTIVE_LOW>;
	};
};
