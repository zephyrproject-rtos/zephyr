## boards/shields/seeed_grove_base_sheild/Kconfig.shield
```kconfig
# Copyright (c) 2024 TOKITA Hiroshi
# SPDX-License-Identifier: Apache-2.0

config SHIELD_SEEED_GROVE_BASE_SHEILD
	def_bool $(shields_list_contains,seeed_grove_base_sheild)
```

## boards/shields/seeed_w5500/Kconfig.shield
```kconfig
# Copyright (c) 2024 Marcin Niestroj
# SPDX-License-Identifier: Apache-2.0

config SHIELD_SEEED_W5500
	def_bool $(shields_list_contains,seeed_w5500)
```

## boards/shields/seeed_xiao_cob_led/Kconfig.shield
```kconfig
# SPDX-FileCopyrightText: Copyright The Zephyr Project Contributors
# SPDX-License-Identifier: Apache-2.0

config SHIELD_SEEED_XIAO_COB_LED
	def_bool $(shields_list_contains,seeed_xiao_cob_led)
```

## boards/shields/seeed_xiao_e_paper/Kconfig.shield
```kconfig
# Copyright (c) 2026 Ujjval Rathod <ujjwalrathod007@gmail.com>
# SPDX-License-Identifier: Apache-2.0

config SHIELD_SEEED_XIAO_E_PAPER
	def_bool $(shields_list_contains,seeed_xiao_e_paper)
```

## boards/shields/seeed_xiao_esp32s3_sense/Kconfig.shield
```kconfig
# Copyright (c) 2024 Charles Dias <charlesdias.cd@outlook.com>
# SPDX-License-Identifier: Apache-2.0

config SHIELD_SEEED_XIAO_ESP32S3_SENSE
	def_bool $(shields_list_contains,seeed_xiao_esp32s3_sense)
```

## boards/shields/seeed_xiao_expansion_board/Kconfig.shield
```kconfig
# Copyright (c) 2024 Charles Dias <charlesdias.cd@outlook.com>
# SPDX-License-Identifier: Apache-2.0

config SHIELD_SEEED_XIAO_EXPANSION_BOARD
	def_bool $(shields_list_contains,seeed_xiao_expansion_board)
```

## boards/shields/seeed_xiao_hsp24/Kconfig.shield
```kconfig
# SPDX-FileCopyrightText: Copyright The Zephyr Project Contributors
# SPDX-License-Identifier: Apache-2.0

config SHIELD_SEEED_XIAO_HSP24
	def_bool $(shields_list_contains,seeed_xiao_hsp24)
```

## boards/shields/seeed_xiao_round_display/Kconfig.shield
```kconfig
# Copyright (c) 2024 Nicolas Goualard <nicolas.goualard@sfr.fr>
# SPDX-License-Identifier: Apache-2.0

config SHIELD_SEEED_XIAO_ROUND_DISPLAY
	def_bool $(shields_list_contains,seeed_xiao_round_display)
```

## boards/shields/semtech_lr11xxmb1xxs/Kconfig.shield
```kconfig
# Copyright (c) 2024 Semtech Corporation
# SPDX-License-Identifier: Apache-2.0

config SHIELD_SEMTECH_LR1110MB1xxS
	def_bool $(shields_list_contains,semtech_lr1110mb1xxs)

config SHIELD_SEMTECH_LR1120MB1xxS
	def_bool $(shields_list_contains,semtech_lr1120mb1xxs)

config SHIELD_SEMTECH_LR1121MB1xxS
	def_bool $(shields_list_contains,semtech_lr1121mb1xxs)
```

## boards/shields/semtech_sx1261mb2bas/Kconfig.shield
```kconfig
# Copyright (c) 2025 Carlo Caione <carlo.caione@gmail.com>
# SPDX-License-Identifier: Apache-2.0

config SHIELD_SEMTECH_SX1261MB2BAS
	def_bool $(shields_list_contains,semtech_sx1261mb2bas)
```

## boards/shields/semtech_sx1262mb2das/Kconfig.defconfig
```kconfig
# Copyright (c) 2022 Konstantinos Papadopoulos <kostas.papadopulos@gmail.com>
# SPDX-License-Identifier: Apache-2.0

if SHIELD_SEMTECH_SX1262MB2DAS

if LORA

config SPI
	default y

endif # LORA

endif # SHIELD_SEMTECH_SX1262MB2DAS
```

## boards/shields/semtech_sx1262mb2das/Kconfig.shield
```kconfig
# Copyright (c) 2022 Konstantinos Papadopoulos <kostas.papadopulos@gmail.com>
# SPDX-License-Identifier: Apache-2.0

config SHIELD_SEMTECH_SX1262MB2DAS
	def_bool $(shields_list_contains,semtech_sx1262mb2das)
```

## boards/shields/semtech_sx126xmb2xxs/Kconfig.shield
```kconfig
# Copyright (c) 2024 Semtech Corporation
# SPDX-License-Identifier: Apache-2.0

config SHIELD_SEMTECH_SX1261MB1BAS
	def_bool $(shields_list_contains,semtech_sx1261mb1bas)

config SHIELD_SEMTECH_SX1261MB1CAS
	def_bool $(shields_list_contains,semtech_sx1261mb1cas)

config SHIELD_SEMTECH_SX1261MB2BAS
	def_bool $(shields_list_contains,semtech_sx1261mb2bas)


config SHIELD_SEMTECH_SX1262MB1CAS
	def_bool $(shields_list_contains,semtech_sx1262mb1cas)

config SHIELD_SEMTECH_SX1262MB1CBS
	def_bool $(shields_list_contains,semtech_sx1262mb1cbs)

config SHIELD_SEMTECH_SX1262MB1DAS
	def_bool $(shields_list_contains,semtech_sx1262mb1das)

config SHIELD_SEMTECH_SX1262MB1PAS
	def_bool $(shields_list_contains,semtech_sx1262mb1pas)

config SHIELD_SEMTECH_SX1262MB2CAS
	def_bool $(shields_list_contains,semtech_sx1262mb2cas)


config SHIELD_SEMTECH_SX1268MB1GAS
	def_bool $(shields_list_contains,semtech_sx1268mb1gas)
```

## boards/shields/semtech_sx1272mb2das/Kconfig.defconfig
```kconfig
# Copyright (c) 2020 Lemonbeat GmbH
# SPDX-License-Identifier: Apache-2.0

if SHIELD_SEMTECH_SX1272MB2DAS

if LORA

config SPI
	default y

endif # LORA

endif # SHIELD_SEMTECH_SX1272MB2DAS
```

## boards/shields/semtech_sx1272mb2das/Kconfig.shield
```kconfig
# Copyright (c) 2020 Lemonbeat GmbH
# SPDX-License-Identifier: Apache-2.0

config SHIELD_SEMTECH_SX1272MB2DAS
	def_bool $(shields_list_contains,semtech_sx1272mb2das)
```

## boards/shields/semtech_sx1276mb1mas/Kconfig.shield
```kconfig
# Copyright (c) 2023 Marcin Niestroj
# SPDX-License-Identifier: Apache-2.0

config SHIELD_SEMTECH_SX1276MB1MAS
	def_bool $(shields_list_contains,semtech_sx1276mb1mas)
```

## boards/shields/silabs_wifi_expansion_kit/Kconfig.defconfig
```kconfig
# Copyright (c) 2023 grandcentrix GmbH
# SPDX-License-Identifier: Apache-2.0

if SHIELD_SILABS_WIFI_EXPANSION_KIT_SLEXP8023A || SHIELD_SILABS_WIFI_EXPANSION_KIT_SLEXP8022A

if NETWORKING

config WIFI
	default y

config WIFI_OFFLOAD
	default y

config NET_L2_ETHERNET
	default y

config NET_L2_WIFI_MGMT
	default y

endif # NETWORKING

endif # SHIELD_SILABS_WIFI_EXPANSION_KIT_SLEXP8023A || SHIELD_SILABS_WIFI_EXPANSION_KIT_SLEXP8022A
```

## boards/shields/silabs_wifi_expansion_kit/Kconfig.shield
```kconfig
# Copyright (c) 2023 grandcentrix GmbH
# SPDX-License-Identifier: Apache-2.0

config SHIELD_SILABS_WIFI_EXPANSION_KIT_SLEXP8023A
	def_bool $(shields_list_contains,silabs_wifi_expansion_kit_slexp8023a)

config SHIELD_SILABS_WIFI_EXPANSION_KIT_SLEXP8022A
	def_bool $(shields_list_contains,silabs_wifi_expansion_kit_slexp8022a)
```

## boards/shields/sparkfun_carrier_asset_tracker/Kconfig.defconfig
```kconfig
# Copyright (c) 2024 Jerónimo Agulló <jeronimoagullo97@gmail.com>
# SPDX-License-Identifier: Apache-2.0

if SHIELD_SPARKFUN_CARRIER_ASSET_TRACKER

config SERIAL
	default y

config UART_INTERRUPT_DRIVEN
	default y

config UART_ASYNC_API
	default y

config I2C
	default y

config SPI
	default y

endif # SHIELD_SPARKFUN_CARRIER_ASSET_TRACKER
```

## boards/shields/sparkfun_carrier_asset_tracker/Kconfig.shield
```kconfig
# Copyright (c) 2024 Jerónimo Agulló <jeronimoagullo97@gmail.com>
# SPDX-License-Identifier: Apache-2.0

config SHIELD_SPARKFUN_CARRIER_ASSET_TRACKER
	def_bool $(shields_list_contains,sparkfun_carrier_asset_tracker)
```

## boards/shields/sparkfun_environmental_combo/Kconfig.shield
```kconfig
# Copyright (c) 2025 Jonas Berg
# SPDX-License-Identifier: Apache-2.0

config SHIELD_SPARKFUN_ENVIRONMENTAL_COMBO
	def_bool $(shields_list_contains,sparkfun_environmental_combo)
```

## boards/shields/sparkfun_rv8803/Kconfig.shield
```kconfig
# Copyright (c) 2025 Jonas Berg
# SPDX-License-Identifier: Apache-2.0

config SHIELD_SPARKFUN_RV8803
	def_bool $(shields_list_contains,sparkfun_rv8803)
```

## boards/shields/sparkfun_sara_r4/Kconfig.defconfig
```kconfig
# Copyright (c) 2019 Linaro Limited
# SPDX-License-Identifier: Apache-2.0

if SHIELD_SPARKFUN_SARA_R4

if NETWORKING

config MODEM
	default y

config MODEM_SHELL
	default y

config MODEM_UBLOX_SARA
	default y

choice MODEM_UBLOX_SARA_VARIANT
	default MODEM_UBLOX_SARA_R4
endchoice

config MODEM_UBLOX_SARA_R4_NET_STATUS
	default y

config UART_INTERRUPT_DRIVEN
	default y

# extend retry timing to 20 seconds for LTE/LTE-M
config COAP_INIT_ACK_TIMEOUT_MS
	default 20000

# Hack: disable IPv6 for now
config NET_IPV6
	default n

config NET_CONFIG_NEED_IPV6
	default n

endif # NETWORKING

endif # SHIELD_SPARKFUN_SARA_R4
```

## boards/shields/sparkfun_sara_r4/Kconfig.shield
```kconfig
# Copyright (c) 2019 Linaro Limited
# SPDX-License-Identifier: Apache-2.0

config SHIELD_SPARKFUN_SARA_R4
	def_bool $(shields_list_contains,sparkfun_sara_r4)
```
