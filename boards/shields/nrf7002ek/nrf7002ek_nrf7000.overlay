/*
 * Copyright (c) 2024 Nordic Semiconductor ASA
 *
 * SPDX-License-Identifier: Apache-2.0
 */
#include <freq.h>

/ {
	chosen {
		zephyr,wifi = &wlan0;
	};
};

&arduino_spi {
	status = "okay";

	nrf70: nrf7002-spi@0 {
		compatible = "nordic,nrf7000-spi";
		reg = <0>;
		spi-max-frequency = <DT_FREQ_M(8)>;
		status = "okay";

		/* Include common nRF70 overlays */
		#include "nrf7002ek_common.dtsi"
		#include "nrf7002ek_common_5g.dtsi"
	};
};
