/*
 * Copyright 2024, NXP
 *
 * SPDX-License-Identifier: Apache-2.0
 */

&zephyr_mipi_dsi {
	/* Raise the DSI clock frequency */
	phy-clock = <792000000>;
};

/* Only the eLCDIF has a selectable bus width; keep it set for a switch back to it */
&lcdif {
	data-bus-width = "24-bit";
};
