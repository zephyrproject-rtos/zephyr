/*
 * Copyright (c) 2024 Charles Dias
 *
 * SPDX-License-Identifier: Apache-2.0
 */

/* AHB clocks must respect the minimum ratio AHB / DCMI_PIXCLK of 2.5 (AN5020 - Rev 3).
 * The OV2640 PCLK is around 72 MHz for QQVGA resolution (160x120) with MCO1_SEL_HSI48
 * and MCO_PRE_DIV_4.
 */
&rcc {
	clocks = <&pll>;
	clock-frequency = <DT_FREQ_M(240)>;
	d1cpre = <1>;
	hpre = <1>;
	d1ppre = <2>;
	d2ppre1 = <2>;
	d2ppre2 = <2>;
	d3ppre = <2>;
};

&mco1 {
	status = "okay";
	clocks = <&rcc STM32_SRC_HSI48 MCO1_SEL(MCO1_SEL_HSI48)>;
	prescaler = <MCO1_PRE(MCO_PRE_DIV_4)>;
	pinctrl-0 = <&rcc_mco_1_pa8>;
	pinctrl-names = "default";
};

&dma1 {
	status = "okay";
};

&dmamux1 {
	status = "okay";
};
