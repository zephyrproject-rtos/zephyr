## boards/shields/lcm_rgb_5inch/Kconfig.shield
```kconfig
# Copyright 2026 NXP
# SPDX-License-Identifier: Apache-2.0

config SHIELD_LCM_RGB_5INCH
	def_bool $(shields_list_contains,lcm_rgb_5inch)
```

## boards/shields/link_board_eth/Kconfig.defconfig
```kconfig
# Copyright (c) 2019 Linaro Limited
# SPDX-License-Identifier: Apache-2.0

if SHIELD_LINK_BOARD_ETH

configdefault ETH_DRIVER
	default y

endif # SHIELD_LINK_BOARD_ETH
```

## boards/shields/m5stack_cardputer/Kconfig.defconfig
```kconfig
# Copyright (c) 2025 Linaro Limited
# SPDX-License-Identifier: Apache-2.0

if SHIELD_M5STACK_CARDPUTER

config INPUT
	default y

endif # SHIELD_M5STACK_CARDPUTER
```

## boards/shields/mchp_lan8840_eds2_dc/Kconfig.defconfig
```kconfig
# Copyright (C) 2026 Microchip Technology Inc
# SPDX-License-Identifier: Apache-2.0

if SHIELD_MCHP_LAN8840_EDS2_DC

configdefault EEPROM
	default y

endif # SHIELD_MCHP_LAN8840_EDS2_DC
```

## boards/shields/mchp_lan8840_eds2_dc/Kconfig.shield
```kconfig
# Copyright (c) 2026 Microchip Technology Inc.
# SPDX-License-Identifier: Apache-2.0

config SHIELD_MCHP_LAN8840_EDS2_DC
	def_bool $(shields_list_contains,mchp_lan8840_eds2_dc)
```

## boards/shields/mchp_lan8840_eds2_dc/boards/sama7d65_curiosity.conf
```kconfig
# Copyright (C) 2026 Microchip Technology Inc
# SPDX-License-Identifier: Apache-2.0

CONFIG_NET_IF_MAX_IPV4_COUNT=2
```

## boards/shields/mchp_touch_qt7/Kconfig.shield
```kconfig
# Copyright (c) 2026 Microchip Technology Inc.
# SPDX-License-Identifier: Apache-2.0

config SHIELD_MCHP_TOUCH_QT7
	bool
	def_bool $(shields_list_contains,qt7_pic32cm_jh01_cpro)
	depends on INPUT
```

## boards/shields/mikroe_accel22_click/Kconfig.shield
```kconfig
# Copyright (c) 2026 Analog Devices, Inc.
# SPDX-License-Identifier: Apache-2.0

config SHIELD_MIKROE_ACCEL22_CLICK
	def_bool $(shields_list_contains,mikroe_accel22_click)
```

## boards/shields/mikroe_accel_click/Kconfig.shield
```kconfig
# Copyright (c) 2026 Analog Devices, Inc.
# SPDX-License-Identifier: Apache-2.0

config SHIELD_MIKROE_ACCEL_CLICK
	def_bool $(shields_list_contains,mikroe_accel_click)
```

## boards/shields/mikroe_adac_click/Kconfig.shield
```kconfig
# Copyright (c) 2026 Analog Devices, Inc
#
# SPDX-License-Identifier: Apache-2.0

config SHIELD_MIKROE_ADAC_CLICK
	def_bool $(shields_list_contains,mikroe_adac_click)
	select MFD
	select I2C
```

## boards/shields/mikroe_ambient_25_click/Kconfig.shield
```kconfig
# Copyright (c) 2026 Carl Zeiss Meditec AG
# SPDX-License-Identifier: Apache-2.0

config SHIELD_MIKROE_AMBIENT_25_CLICK
	def_bool $(shields_list_contains,mikroe_ambient_25_click)
```

## boards/shields/mikroe_ammonia_click/Kconfig.shield
```kconfig
# SPDX-FileCopyrightText: Copyright The Zephyr Project Contributors
# SPDX-License-Identifier: Apache-2.0

config SHIELD_MIKROE_AMMONIA_CLICK
	def_bool $(shields_list_contains,mikroe_ammonia_click)

config SHIELD_MIKROE_AMMONIA_CLICK_SPI
	def_bool $(shields_list_contains,mikroe_ammonia_click_spi)
```

## boards/shields/mikroe_dali_2_click/Kconfig.shield
```kconfig
# SPDX-License-Identifier: Apache-2.0
# SPDX-FileCopyrightText: Copyright (c) 2026 sevenlab engineering GmbH

config SHIELD_MIKROE_DALI_2_CLICK
	def_bool $(shields_list_contains,mikroe_dali_2_click)
```

## boards/shields/mikroe_gyro_2_click/Kconfig.shield
```kconfig
# SPDX-FileCopyrightText: Copyright (c) 2026 Analog Devices, Inc.
# SPDX-License-Identifier: Apache-2.0

config SHIELD_MIKROE_GYRO_2_CLICK_I2C
	def_bool $(shields_list_contains,mikroe_gyro_2_click_i2c)

config SHIELD_MIKROE_GYRO_2_CLICK_SPI
	def_bool $(shields_list_contains,mikroe_gyro_2_click_spi)
```

## boards/shields/mikroe_i2c_to_spi_click/Kconfig.defconfig
```kconfig
# SPDX-FileCopyrightText: Copyright Alif Semiconductor
# SPDX-License-Identifier: Apache-2.0

if SHIELD_MIKROE_I2C_TO_SPI_CLICK

config I2C
	default y

config SPI
	default y

config GPIO
	default y

endif # SHIELD_MIKROE_I2C_TO_SPI_CLICK
```

## boards/shields/mikroe_i2c_to_spi_click/Kconfig.shield
```kconfig
# SPDX-FileCopyrightText: Copyright Alif Semiconductor
# SPDX-License-Identifier: Apache-2.0

config SHIELD_MIKROE_I2C_TO_SPI_CLICK
	def_bool $(shields_list_contains,mikroe_i2c_to_spi_click)
```

## boards/shields/mikroe_oled_c_click/Kconfig.shield
```kconfig
# SPDX-FileCopyrightText: Copyright The Zephyr Project Contributors
# SPDX-License-Identifier: Apache-2.0

config SHIELD_MIKROE_OLED_C_CLICK
	def_bool $(shields_list_contains,mikroe_oled_c_click)
```

## boards/shields/mikroe_surface_temp_2_click/Kconfig.shield
```kconfig
# Copyright (c) 2026 Analog Devices, Inc.
# SPDX-License-Identifier: Apache-2.0

config SHIELD_MIKROE_SURFACE_TEMP_2_CLICK
	def_bool $(shields_list_contains,mikroe_surface_temp_2_click)
```

## boards/shields/mr_mcxn_t1_f9p/Kconfig.shield
```kconfig
# Copyright (c) 2026 CogniPilot Foundation
# SPDX-License-Identifier: Apache-2.0

config SHIELD_MR_MCXN_T1_F9P
	def_bool $(shields_list_contains,mr_mcxn_t1_f9p)
```

## boards/shields/mr_mcxn_t1_io/Kconfig.shield
```kconfig
# Copyright (c) 2026 CogniPilot Foundation
# SPDX-License-Identifier: Apache-2.0

config SHIELD_MR_MCXN_T1_IO
	def_bool $(shields_list_contains,mr_mcxn_t1_io)
```
