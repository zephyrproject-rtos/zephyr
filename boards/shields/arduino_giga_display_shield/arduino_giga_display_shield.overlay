/*
 * Copyright (c) 2025 Arduino SA
 *
 * SPDX-License-Identifier: Apache-2.0
 */

&zephyr_mipi_dsi {
	st7701: st7701@0 {
		status = "okay";
		compatible = "sitronix,st7701";
		reg = <0x0>;
		height = <800>;
		width = <480>;
		data-lanes = <2>;
		pixel-format = <MIPI_DSI_PIXFMT_RGB565>;
		rotation = <0>;
		gip-e0 = [e0 00 00 02];
		gip-e1 = [e1 08 00 0a 00 07 00 09 00 00 33 33];
		gip-e2 = [e2 00 00 00 00 00 00 00 00 00 00 00 00 00];
		gip-e3 = [e3 00 00 33 33];
		gip-e4 = [e4 44 44];
		gip-e5 = [e5 0e 60 a0 a0 10 60 a0 a0 0a 60 a0 a0 0c 60 a0 a0];
		gip-e6 = [e6 00 00 33 33];
		gip-e7 = [e7 44 44];
		gip-e8 = [e8 0d 60 a0 a0 0f 60 a0 a0 09 60 a0 a0 0b 60 a0 a0];
		gip-eb = [eb 02 01 e4 e4 44 00 40];
		gip-ec = [ec 02 01];
		gip-ed = [ed ab 89 76 54 01 ff ff ff ff ff ff 10 45 67 98 ba];
		gip-ed = [ed ab 89 76 54 01 ff ff ff ff ff ff 10 45 67 98 ba];
		pvgamctrl = [b0 40 c9 91 0d 12 07 02 09 09 1f 04 50 0f e4 29 df];
		nvgamctrl = [b1 40 cb d0 11 92 07 00 08 07 1c 06 53 12 63 eb df];

		display-timings {
			compatible = "zephyr,panel-timing";
			hsync-active = <1>;
			vsync-active = <0>;
			de-active = <0>;
			pixelclk-active = <0>;
			hback-porch = <40>;
			hsync-len = <32>;
			hfront-porch = <8>;
			vback-porch = <6>;
			vsync-len = <8>;
			vfront-porch = <9>;
		};
	};
};
