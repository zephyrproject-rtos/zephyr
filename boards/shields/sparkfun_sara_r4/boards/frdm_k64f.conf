## boards/shields/sparkfun_shtc3/Kconfig.shield
```kconfig
# Copyright (c) 2025 Jonas Berg
# SPDX-License-Identifier: Apache-2.0

config SHIELD_SPARKFUN_SHTC3
	def_bool $(shields_list_contains,sparkfun_shtc3)
```

## boards/shields/ssd1306/Kconfig.defconfig
```kconfig
# Copyright (c) 2019 Linaro Limited
# SPDX-License-Identifier: Apache-2.0

if SHIELD_SSD1306_128X64 || SHIELD_SSD1306_128X64_SPI || SHIELD_SSD1306_128X32 || SHIELD_SH1106_128X64

if DISPLAY

if LVGL

config LV_Z_VDB_SIZE
	default 64

config LV_DPI_DEF
	default 116 if SHIELD_SH1106_128X64
	default 148

config LV_Z_BITS_PER_PIXEL
	default 1

choice LV_COLOR_DEPTH
	default LV_COLOR_DEPTH_1
endchoice

endif # LVGL

endif # DISPLAY

endif # SHIELD_SSD1306_128X64 || SHIELD_SSD1306_128X64_SPI || SHIELD_SSD1306_128X32 || SHIELD_SH1106_128X64
```

## boards/shields/ssd1306/Kconfig.shield
```kconfig
# Copyright (c) 2019 Linaro Limited
# SPDX-License-Identifier: Apache-2.0

config SHIELD_SSD1306_128X32
	def_bool $(shields_list_contains,ssd1306_128x32)

config SHIELD_SSD1306_128X64
	def_bool $(shields_list_contains,ssd1306_128x64)

config SHIELD_SSD1306_128X64_SPI
	def_bool $(shields_list_contains,ssd1306_128x64_spi)

config SHIELD_SH1106_128X64
	def_bool $(shields_list_contains,sh1106_128x64)
```

## boards/shields/st7735r/Kconfig.defconfig
```kconfig
# Copyright (c) 2020 Kim Bøndergaard <kim@fam-boendergaard.dk>
# SPDX-License-Identifier: Apache-2.0

if SHIELD_ST7735R_ADA_160x128

if DISPLAY

if LVGL

config LV_Z_BITS_PER_PIXEL
	default 16

endif # LVGL

endif # DISPLAY

endif # SHIELD_ST7735R_ADA_160x128
```

## boards/shields/st7735r/Kconfig.shield
```kconfig
# Copyright (c) 2020 Kim Bøndergaard <kim@fam-boendergaard.dk>
# SPDX-License-Identifier: Apache-2.0

config SHIELD_ST7735R_ADA_160x128
	def_bool $(shields_list_contains,st7735r_ada_160x128)
```

## boards/shields/st7789v_generic/Kconfig.defconfig
```kconfig
# Copyright (c) 2019 Jan Van Winkel <jan.van_winkel@dxplore.eu>
# SPDX-License-Identifier: Apache-2.0

if SHIELD_ST7789V_TL019FQV01 || SHIELD_ST7789V_WAVESHARE_240X240

if DISPLAY

choice ST7789V_PIXEL_FORMAT
	default ST7789V_RGB888 if SHIELD_ST7789V_TL019FQV01
	default ST7789V_RGB565 if SHIELD_ST7789V_WAVESHARE_240X240
endchoice

if LVGL

config LV_Z_BITS_PER_PIXEL
	default 24 if SHIELD_ST7789V_TL019FQV01
	default 16 if SHIELD_ST7789V_WAVESHARE_240X240

choice LV_COLOR_DEPTH
	default LV_COLOR_DEPTH_16 if SHIELD_ST7789V_WAVESHARE_240X240
endchoice

configdefault LV_COLOR_16_SWAP
	default y if SHIELD_ST7789V_WAVESHARE_240X240

endif # LVGL

endif # DISPLAY

endif # SHIELD_ST7789V_TL019FQV01 || SHIELD_ST7789V_WAVESHARE_240X240
```

## boards/shields/st7789v_generic/Kconfig.shield
```kconfig
# Copyright (c) 2019 Jan Van Winkel <jan.van_winkel@dxplore.eu>
# SPDX-License-Identifier: Apache-2.0

config SHIELD_ST7789V_TL019FQV01
	def_bool $(shields_list_contains,st7789v_tl019fqv01)

config SHIELD_ST7789V_WAVESHARE_240X240
	def_bool $(shields_list_contains,st7789v_waveshare_240x240)
```

## boards/shields/st7789v_generic/boards/fk750m1_vbt6.defconfig
```kconfig
# Copyright (c) 2025 Honbo He <hehongbo918@gmail.com>
# SPDX-License-Identifier: Apache-2.0

CONFIG_DISPLAY=y
CONFIG_ST7789V=y
CONFIG_LVGL=y
CONFIG_SPI=y
CONFIG_GPIO=y
CONFIG_SPI_STM32_DMA=y
```

## boards/shields/st87mxx/Kconfig.defconfig
```kconfig
# Copyright (c) 2025  STMicroelectronics
# SPDX-License-Identifier: Apache-2.0

if SHIELD_ST87MXX

if NETWORKING

config MODEM
	default y

config UART_INTERRUPT_DRIVEN
	default y

config MODEM_SHELL
	default y

config MODEM_ST87MXX
	default y

# extend retry timing to 20 seconds for LTE/LTE-M
config COAP_INIT_ACK_TIMEOUT_MS
	default 20000

endif # NETWORKING

endif # SHIELD_ST87MXX
```

## boards/shields/st87mxx/Kconfig.shield
```kconfig
# Copyright (c) 2025 STMicroelectronics
# SPDX-License-Identifier: Apache-2.0

config SHIELD_ST87MXX
	def_bool $(shields_list_contains,shield_st87mxx)
```

## boards/shields/st_b_cams_imx_mb1854/Kconfig.defconfig
```kconfig
# ST_B_CAMS_IMX_MB1854 configuration

# Copyright (c) 2025 STMicroelectronics
# SPDX-License-Identifier: Apache-2.0

configdefault VIDEO_STM32_DCMIPP_SENSOR_PIXEL_FORMAT
	default "pRAA"

configdefault VIDEO_STM32_DCMIPP_SENSOR_WIDTH
	default 2592

configdefault VIDEO_STM32_DCMIPP_SENSOR_HEIGHT
	default 1944

# GPIO driver is needed for the shield's GPIO hogs
configdefault GPIO
	default y if VIDEO_STM32_DCMIPP
```

## boards/shields/st_b_cams_imx_mb1854/Kconfig.shield
```kconfig
# Copyright (c) 2025 STMicroelectronics.
# SPDX-License-Identifier: Apache-2.0

config SHIELD_ST_B_CAMS_IMX_MB1854
	def_bool $(shields_list_contains,st_b_cams_imx_mb1854)
```

## boards/shields/st_b_cams_imx_mb1854/boards/stm32n6570_dk_stm32n657xx_sb.conf
```kconfig
CONFIG_VIDEO_STM32_DCMIPP_SENSOR_PIXEL_FORMAT="pRAA"
CONFIG_VIDEO_STM32_DCMIPP_SENSOR_WIDTH=2592
CONFIG_VIDEO_STM32_DCMIPP_SENSOR_HEIGHT=1944
```

## boards/shields/st_b_cams_omv_mb1683/Kconfig.defconfig
```kconfig
# Copyright (c) 2024 Charles Dias <charlesdias.cd@outlook.com>
# SPDX-License-Identifier: Apache-2.0

if SHIELD_ST_B_CAMS_OMV_MB1683

# Enable the STM32 DCMI driver as the camera interface requires it.
config VIDEO_STM32_DCMI
	default y

endif # SHIELD_ST_B_CAMS_OMV_MB1683
```

## boards/shields/st_b_cams_omv_mb1683/Kconfig.shield
```kconfig
# Copyright (c) 2025 Charles Dias <charlesdias.cd@outlook.com>
# SPDX-License-Identifier: Apache-2.0

config SHIELD_ST_B_CAMS_OMV_MB1683
	def_bool $(shields_list_contains,st_b_cams_omv_mb1683)
```

## boards/shields/st_b_cams_omv_mb1683/boards/stm32h7s78_dk_stm32h7s7xx_ext_flash_app.conf
```kconfig
CONFIG_VIDEO_STM32_DCMIPP_SENSOR_PIXEL_FORMAT="RGBP"
CONFIG_VIDEO_STM32_DCMIPP_SENSOR_WIDTH=320
CONFIG_VIDEO_STM32_DCMIPP_SENSOR_HEIGHT=240
```

## boards/shields/st_b_dsi_mb1314/Kconfig.shield
```kconfig
# Copyright (c) 2025 STMicroelectronics

# SPDX-License-Identifier: Apache-2.0

config SHIELD_ST_B_DSI_MB1314
	def_bool $(shields_list_contains,st_b_dsi_mb1314)
```

## boards/shields/st_b_dsi_mb1314/boards/stm32l4r9i_disco.conf
```kconfig
# SPDX-FileCopyrightText: Copyright (c) 2024 STMicroelectronics
# SPDX-License-Identifier: Apache-2.0

# GPIO hogs require enabling the GPIO driver to work.
CONFIG_GPIO=y
CONFIG_GPIO_HOGS_INIT_PRIORITY=71
```

## boards/shields/st_b_lcd40_dsi1_mb1166/Kconfig.defconfig
```kconfig
# Copyright (c) 2023 BrainCo Inc.
# Copyright (c) 2024 Erik Andersson <erian747@gmail.com>
# SPDX-License-Identifier: Apache-2.0

if SHIELD_ST_B_LCD40_DSI1_MB1166 || SHIELD_ST_B_LCD40_DSI1_MB1166_A09

orsource "boards/*.defconfig"

endif # SHIELD_ST_B_LCD40_DSI1_MB1166 || SHIELD_ST_B_LCD40_DSI1_MB1166_A09
```

## boards/shields/st_b_lcd40_dsi1_mb1166/Kconfig.shield
```kconfig
# Copyright (c) 2023 bytes at work AG
# Copyright (c) 2024 Erik Andersson <erian747@gmail.com>

# SPDX-License-Identifier: Apache-2.0

config SHIELD_ST_B_LCD40_DSI1_MB1166
	def_bool $(shields_list_contains,st_b_lcd40_dsi1_mb1166)

config SHIELD_ST_B_LCD40_DSI1_MB1166_A09
	def_bool $(shields_list_contains,st_b_lcd40_dsi1_mb1166_a09)
```
