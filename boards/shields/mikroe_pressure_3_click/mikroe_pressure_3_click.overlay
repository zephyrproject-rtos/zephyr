/*
 * Copyright The Zephyr Project Contributors
 * SPDX-License-Identifier: Apache-2.0
 */

/ {
	aliases {
		pressure-sensor = &dps310_mikroe_pressure_3_click;
	};
};

&mikrobus_i2c {
	status = "okay";

	dps310_mikroe_pressure_3_click: dps310@76 {
		compatible = "infineon,dps310";
		reg = <0x76>;
	};
};
