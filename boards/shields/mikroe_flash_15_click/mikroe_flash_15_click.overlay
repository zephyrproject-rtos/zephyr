/*
 * Copyright The Zephyr Project Contributors
 * SPDX-License-Identifier: Apache-2.0
 */

#include <zephyr/dt-bindings/gpio/mikro-bus.h>

&mikrobus_spi {
	cs-gpios = <&mikrobus_header MIKROBUS_CS GPIO_ACTIVE_LOW>;
	status = "okay";

	spi_nand_mikroe_flash_15_click: spi-nand@0 {
		compatible = "jedec,spi-nand";
		reg = <0>;
		spi-max-frequency = <133000000>;
		wp-gpios = <&mikrobus_header MIKROBUS_AN GPIO_ACTIVE_LOW>;
		hold-gpios = <&mikrobus_header MIKROBUS_PWM GPIO_ACTIVE_LOW>;

		/* f35sqa512m parameters */
		jedec-id = [cd 70 70];
		size-bytes = <DT_SIZE_M(64)>;
		plane-bytes = <DT_SIZE_M(64)>;
		erase-block-size = <DT_SIZE_K(128)>;
		write-block-size = <DT_SIZE_K(2)>;
		block-erase-duration-max = <10000>;
		page-program-duration-max = <750>;
		page-read-duration-max = <60>;
		reset-duration-max = <200>;
		status = "okay";
	};
};
