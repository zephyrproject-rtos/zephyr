/*
 * Copyright 2026 NXP
 *
 * SPDX-License-Identifier: Apache-2.0
 */

/* The board label names the LCDIFv2, whose output bus has no selectable width */
&zephyr_lcdif {
	/delete-property/ data-bus-width;
};
