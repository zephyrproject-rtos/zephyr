## boards/shields/rk055hdmipi4m/Kconfig.shield
```kconfig
# Copyright 2023 NXP
# SPDX-License-Identifier: Apache-2.0

config SHIELD_RK055HDMIPI4M
	def_bool $(shields_list_contains,rk055hdmipi4m)
```

## boards/shields/rk055hdmipi4m/boards/mimxrt595_evk_mimxrt595s_cm33.conf
```kconfig
#
# Copyright 2023,2025 NXP
#
# SPDX-License-Identifier: Apache-2.0
#

CONFIG_LV_Z_VDB_CUSTOM_SECTION=y
# M33 core and LCDIF both access FlexSPI2 through the same cache,
# so coherency does not need to be managed.
CONFIG_MCUX_DCNANO_LCDIF_MAINTAIN_CACHE=n
```

## boards/shields/rk055hdmipi4ma0/Kconfig.defconfig
```kconfig
# Copyright 2023 NXP
# SPDX-License-Identifier: Apache-2.0

if SHIELD_RK055HDMIPI4MA0

if DISPLAY

# Enable MIPI DSI, as this display controller requires it.

config MIPI_DSI
	default y

endif # DISPLAY

if LVGL

# Configure LVGL to use touchscreen with KSCAN API

config INPUT
	default y

config INPUT_GT911_INTERRUPT
	default y

# LVGL should allocate buffers equal to size of display
config LV_Z_VDB_SIZE
	default 100

# Enable double buffering
config LV_Z_DOUBLE_VDB
	default y

# Force full refresh. This prevents memory copy associated with partial
# display refreshes, which is not necessary for the eLCDIF driver
config LV_Z_FULL_REFRESH
	default y

config LV_Z_BITS_PER_PIXEL
	default 16

config LV_DPI_DEF
	default 128

# Use offloaded render thread
config LV_Z_FLUSH_THREAD
	default y

choice LV_COLOR_DEPTH
	default LV_COLOR_DEPTH_16
endchoice

endif # LVGL

endif # SHIELD_RK055HDMIPI4MA0
```

## boards/shields/rk055hdmipi4ma0/Kconfig.shield
```kconfig
# Copyright 2023 NXP
# SPDX-License-Identifier: Apache-2.0

config SHIELD_RK055HDMIPI4MA0
	def_bool $(shields_list_contains,rk055hdmipi4ma0)
```

## boards/shields/rk055hdmipi4ma0/boards/mimxrt595_evk_cm33.conf
```kconfig
#
# Copyright 2023, NXP
#
# SPDX-License-Identifier: Apache-2.0
#

# Use external framebuffer memory
CONFIG_MCUX_DCNANO_LCDIF_EXTERNAL_FB_MEM=y
CONFIG_LV_Z_VBD_CUSTOM_SECTION=y
# Use FlexSPI2 for framebuffer (pSRAM is present on this bus)
CONFIG_MCUX_DCNANO_LCDIF_EXTERNAL_FB_ADDR=0x38400000
# M33 core and LCDIF both access FlexSPI2 through the same cache,
# so coherency does not need to be managed.
CONFIG_MCUX_DCNANO_LCDIF_MAINTAIN_CACHE=n
```

## boards/shields/rk055hdmipi4ma0/boards/mimxrt700_evk_mimxrt798s_cm33_cpu0.conf
```kconfig
CONFIG_MCUX_DCNANO_LCDIF_MAINTAIN_CACHE=n
CONFIG_REGULATOR=y
CONFIG_MEMC=y # Enable MEMC to use PSRAM
CONFIG_LV_Z_VDB_ZEPHYR_REGION=y
CONFIG_LV_Z_VDB_ZEPHYR_REGION_NAME="SRAM1"
CONFIG_LV_Z_VDB_SIZE=20
CONFIG_LV_Z_FULL_REFRESH=n
```

## boards/shields/rpi_pico_uno_flexypin/Kconfig.shield
```kconfig
# Copyright (c) 2024 TOKITA Hiroshi
# SPDX-License-Identifier: Apache-2.0

config SHIELD_RPI_PICO_UNO_FLEXYPIN
	def_bool $(shields_list_contains,rpi_pico_uno_flexypin)
```

## boards/shields/rtk0eg0019b01002bj/Kconfig.defconfig
```kconfig
# Copyright (c) 2025 Renesas Electronics Corporation
# SPDX-License-Identifier: Apache-2.0

if INPUT_RENESAS_RA_CTSU

config INPUT_RENESAS_RA_CTSU_NUM_SELF_ELEMENTS
	default 12
	depends on !INPUT_RENESAS_RA_QE_TOUCH_CFG

endif # INPUT_RENESAS_RA_CTSU
```

## boards/shields/rtk0eg0019b01002bj/Kconfig.shield
```kconfig
# Copyright (c) 2025 Renesas Electronics Corporation
# SPDX-License-Identifier: Apache-2.0

config SHIELD_RTK0EG0019B01002BJ
	def_bool $(shields_list_contains,rtk0eg0019b01002bj)
```

## boards/shields/rtk0eg0019b01002bj/boards/rssk_ra2l1.conf
```kconfig
# Copyright (c) 2025 Renesas Electronics Corporation
# SPDX-License-Identifier: Apache-2.0

CONFIG_INPUT_RENESAS_RA_DEVICE_VCC=5000
```

## boards/shields/rtk0eg0019b01002bj/dts/bindings/rtk0eg0019b01002bj-led-matrix.yaml
```yaml
# Copyright (c) 2025 Renesas Electronics Corporation
# SPDX-License-Identifier: Apache-2.0

description: |
  This binding provides resources required for the LED matrix
  on the RTK0EG0019B01002BJ board.

compatible: "rtk0eg0019b01002bj-led-matrix"

properties:
  led-row-gpios:
    type: phandle-array
    required: true
    description: |
      Identity of GPIOs that will be used to control the LED matrix.
      Each entry in the array corresponds to a row of the matrix.

  led-col-gpios:
    type: phandle-array
    required: true
    description: |
      Identity of GPIOs that will be used to control the LED matrix.
      Each entry in the array corresponds to a column of the matrix.

  num-rows:
    type: int
    required: true
    description: |
      Number of rows in the LED matrix.

  num-cols:
    type: int
    required: true
    description: |
      Number of columns in the LED matrix.
```

## boards/shields/rtk7eka6m3b00001bu/Kconfig.defconfig
```kconfig
# Copyright (c) 2025 Renesas Electronics Corporation
# SPDX-License-Identifier: Apache-2.0

if SHIELD_RTK7EKA6M3B00001BU

if LVGL

# Configure LVGL to use touchscreen with input API

config INPUT
	default y

# LVGL should allocate buffers equal to size of display
config LV_Z_VDB_SIZE
	default 100

# Enable double buffering
config LV_Z_DOUBLE_VDB
	default y

# Force full refresh. This prevents memory copy associated with partial
# display refreshes, which is not necessary for the GLCDC driver
config LV_Z_FULL_REFRESH
	default y

config LV_Z_BITS_PER_PIXEL
	default 32

# Use offloaded render thread
config LV_Z_FLUSH_THREAD
	default y

choice LV_COLOR_DEPTH
	default LV_COLOR_DEPTH_32
endchoice

endif # LVGL

endif # SHIELD_RTK7EKA6M3B00001BU
```

## boards/shields/rtk7eka6m3b00001bu/Kconfig.shield
```kconfig
# Copyright (c) 2025 Renesas Electronics Corporation
# SPDX-License-Identifier: Apache-2.0

config SHIELD_RTK7EKA6M3B00001BU
	def_bool $(shields_list_contains,rtk7eka6m3b00001bu)
```

## boards/shields/rtklcdpar1s00001be/Kconfig.defconfig
```kconfig
# Copyright (c) 2025 Renesas Electronics Corporation
# SPDX-License-Identifier: Apache-2.0

if SHIELD_RTKLCDPAR1S00001BE

if LVGL

# Configure LVGL to use touchscreen with input API

config INPUT
	default y

# LVGL should allocate buffers equal to size of display
config LV_Z_VDB_SIZE
	default 100

# Enable double buffering
config LV_Z_DOUBLE_VDB
	default y

config LV_Z_BITS_PER_PIXEL
	default 16

# Use offloaded render thread
config LV_Z_FLUSH_THREAD
	default n

choice LV_COLOR_DEPTH
	default LV_COLOR_DEPTH_16
endchoice

endif # LVGL

orsource "boards/*.defconfig"

endif # SHIELD_RTKLCDPAR1S00001BE
```

## boards/shields/rtklcdpar1s00001be/Kconfig.shield
```kconfig
# Copyright (c) 2025 Renesas Electronics Corporation
# SPDX-License-Identifier: Apache-2.0

config SHIELD_RTKLCDPAR1S00001BE
	def_bool $(shields_list_contains,rtklcdpar1s00001be)
```

## boards/shields/rtkmipilcdb00000be/Kconfig.defconfig
```kconfig
# Copyright (c) 2024 Renesas Electronics Corporation
# SPDX-License-Identifier: Apache-2.0

if SHIELD_RTKMIPILCDB00000BE
if DISPLAY

# Enable MIPI DSI, as this display controller requires it.
config MIPI_DSI
	default y

if LVGL

# Configure LVGL to use touchscreen with input API
config INPUT
	default y

# GT911 driver drives reset pin low, GT911 and ILI9806E_DSI driver share a reset line,
# so it needs to initialize before the display_ili9806e_dsi driver but after the MIPI DSI driver
config INPUT_INIT_PRIORITY
	default 89

# LVGL should allocate buffers equal to size of display
config LV_Z_VDB_SIZE
	default 100

# Enable double buffering
config LV_Z_DOUBLE_VDB
	default y

# Force full refresh. This prevents memory copy associated with partial
# display refreshes, which is not necessary for the GLCDC driver
config LV_Z_FULL_REFRESH
	default y

# Use offloaded render thread
choice LV_COLOR_DEPTH
	default LV_COLOR_DEPTH_16
endchoice

endif # LVGL

endif # DISPLAY

orsource "boards/*.defconfig"

endif # SHIELD_RTKMIPILCDB00000BE
```

## boards/shields/rtkmipilcdb00000be/Kconfig.shield
```kconfig
# Copyright (c) 2024 Renesas Electronics Corporation
# SPDX-License-Identifier: Apache-2.0

config SHIELD_RTKMIPILCDB00000BE
	def_bool $(shields_list_contains,rtkmipilcdb00000be)
```

## boards/shields/rtkmipilcdb00000be/boards/ek_ra8d1.conf
```kconfig
# Copyright (c) 2025 Renesas Electronics Corporation
# SPDX-License-Identifier: Apache-2.0

CONFIG_LV_Z_FLUSH_THREAD=n
CONFIG_LV_Z_BITS_PER_PIXEL=16
CONFIG_LV_COLOR_DEPTH_16=y
```

## boards/shields/seeed_grove_3axis_digital_accelerometer/Kconfig.shield
```kconfig
# Copyright (c) 2024 TOKITA Hiroshi
# SPDX-License-Identifier: Apache-2.0

config SHIELD_SEEED_GROVE_LIS3DHTR
	def_bool $(shields_list_contains,seeed_grove_lis3dhtr)
```
