/*
 * Copyright (c) 2023 Mark Olsson <mark@markolsson.se>
 *
 * SPDX-License-Identifier: Apache-2.0
 */

/ {
	aliases {
		accel0 = &iis2dlpc_mikroe_accel13_click;
	};
};

&mikrobus_i2c {
	status = "okay";

	iis2dlpc_mikroe_accel13_click: iis2dlpc@18 {
		compatible = "st,iis2dlpc";
		reg = <0x18>;
		drdy-gpios = <&mikrobus_header 7 GPIO_ACTIVE_HIGH>;
		drdy-int = <2>;
		status = "okay";
	};
};
