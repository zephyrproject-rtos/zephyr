/*
 * Copyright The Zephyr Project Contributors
 *
 * SPDX-License-Identifier: Apache-2.0
 */

&feather_spi {
	status = "okay";
	cs-gpios = <&feather_header 17 GPIO_ACTIVE_LOW>; /* D10 */

	zephyr_uhc0: max3421e@0 {
		compatible = "maxim,max3421e-spi";
		reg = <0>;
		spi-max-frequency = <26000000>;
		int-gpios = <&feather_header 16 GPIO_ACTIVE_LOW>; /* D9 */
		status = "okay";
	};
};
