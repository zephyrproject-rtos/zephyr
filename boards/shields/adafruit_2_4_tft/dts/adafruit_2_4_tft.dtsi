/*
 * Copyright (c) 2026 Conclusive Engineering
 * Copyright (c) 2026 Texas Instruments
 *
 * SPDX-License-Identifier: Apache-2.0
 */

#include <zephyr/dt-bindings/display/panel.h>
#include <zephyr/dt-bindings/gpio/arduino-header-r3.h>

/ {
	chosen {
		zephyr,display = &adafruit_2_4_tft_ili9340;
	};

	adafruit_2_4_tft_mipi_dbi: adafruit_2_4_tft_mipi_dbi {
		compatible = "zephyr,mipi-dbi-spi";
		spi-dev = <&arduino_spi>;
		dc-gpios = <&arduino_header ARDUINO_HEADER_R3_D9 GPIO_ACTIVE_HIGH>;
		reset-gpios = <&arduino_header ARDUINO_HEADER_R3_D8 GPIO_ACTIVE_LOW>;
		write-only;
		#address-cells = <1>;
		#size-cells = <0>;

		adafruit_2_4_tft_ili9340: ili9340@0 {
			compatible = "ilitek,ili9340";
			mipi-max-frequency = <15151515>;
			reg = <0>;
			width = <320>;
			height = <240>;
			pixel-format = <PANEL_PIXEL_FORMAT_RGB_888>;
			rotation = <90>;
			frmctr1 = [00 18];
			pwctrl1 = [23 00];
			vmctrl1 = [3e 28];
			vmctrl2 = [86];
			pgamctrl = [0f 31 2b 0c 0e 08 4e f1 37 07 10 03 0e 09 00];
			ngamctrl = [00 0e 14 03 11 07 31 c1 48 08 0f 0c 31 36 0f];
		};
	};
};
