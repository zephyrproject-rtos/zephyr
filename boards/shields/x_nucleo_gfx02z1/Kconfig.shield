## boards/shields/x_nucleo_gfx02z1/Kconfig.shield
```kconfig
# Copyright (c) 2026 Michele Vaccari
# SPDX-License-Identifier: Apache-2.0

config SHIELD_X_NUCLEO_GFX02Z1_AZ2
	def_bool $(shields_list_contains,x_nucleo_gfx02z1_az2)
```

## boards/shields/zc143ac72mipi/Kconfig.defconfig
```kconfig
# Copyright 2025 NXP
# SPDX-License-Identifier: Apache-2.0

if SHIELD_ZC143AC72MIPI

# Enable input subsystem for TMA525b driver
config INPUT
	default y

if LVGL

config LV_Z_VDB_SIZE
	default 16

config LV_DPI_DEF
	default 128

# Use offloaded render thread
config LV_Z_FLUSH_THREAD
	default y

choice LV_COLOR_DEPTH
	default LV_COLOR_DEPTH_16
endchoice

configdefault LV_Z_AREA_X_ALIGNMENT_WIDTH
	default 2

configdefault LV_Z_AREA_Y_ALIGNMENT_WIDTH
	default 2

endif # LVGL

endif # SHIELD_ZC143AC72MIPI
```

## boards/sifive/hifive_unleashed/Kconfig
```kconfig
# SPDX-FileCopyrightText: Copyright The Zephyr Project Contributors
# SPDX-License-Identifier: Apache-2.0

config BOARD_HIFIVE_UNLEASHED
	select QEMU_TARGET if BOARD_HIFIVE_UNLEASHED_FU540_E51_QEMU || \
				BOARD_HIFIVE_UNLEASHED_FU540_U54_QEMU
```

## boards/sifive/hifive_unleashed/Kconfig.defconfig
```kconfig
# Copyright (c) 2021 Katsuhiro Suzuki
# Copyright (c) 2024 Antmicro <www.antmicro.com>
# SPDX-License-Identifier: Apache-2.0

if BOARD_HIFIVE_UNLEASHED

config SYS_CLOCK_TICKS_PER_SEC
	default 1000

endif # BOARD_HIFIVE_UNLEASHED
```

## boards/sifive/hifive_unleashed/board.yml
```yaml
board:
  name: hifive_unleashed
  full_name: HiFive Unleashed
  vendor: sifive
  socs:
    - name: fu540
      variants:
        - name: qemu
          cpucluster: e51
        - name: qemu
          cpucluster: u54
```

## boards/sifive/hifive_unmatched/Kconfig.defconfig
```kconfig
# Copyright (c) 2021 Katsuhiro Suzuki
# SPDX-License-Identifier: Apache-2.0

if BOARD_HIFIVE_UNMATCHED

config SYS_CLOCK_TICKS_PER_SEC
	default 1000

endif # BOARD_HIFIVE_UNMATCHED
```

## boards/silabs/explorer_kits/simg301_ek2719a/Kconfig.defconfig
```kconfig
# Copyright (c) 2026 Silicon Laboratories Inc.
# SPDX-License-Identifier: Apache-2.0

if BOARD_SIMG301_EK2719A

config FPU
	default y if SOC_GECKO_USE_RAIL || BT

endif
```

## boards/silabs/explorer_kits/siwx917/Kconfig.siwx917_ek2708a
```kconfig
# SPDX-FileCopyrightText: Copyright (c) 2026 Silicon Laboratories Inc.
# SPDX-License-Identifier: Apache-2.0

config BOARD_SIWX917_EK2708A
	select SOC_SIWG917Y111MGABA
```

## boards/silabs/explorer_kits/siwx917/board.yml
```yaml
# SPDX-FileCopyrightText: Copyright (c) 2026 Silicon Laboratories Inc.
# SPDX-License-Identifier: Apache-2.0

boards:
  - name: siwx917_ek2708a
    full_name: SiWx917Y Module Wi-Fi 6 and Bluetooth LE Explorer Kit (BRD2708A)
    vendor: silabs
    socs:
      - name: siwg917y111mgaba
```

## boards/silabs/explorer_kits/six301/Kconfig.defconfig
```kconfig
# Copyright The Zephyr Project Contributors
# SPDX-License-Identifier: Apache-2.0

if BOARD_SIXG301_EK2719A

config FPU
	default y if SOC_GECKO_USE_RAIL || BT

if BT

config MAIN_STACK_SIZE
	default 3072 if PM
	default 2304

endif # BT

endif
```

## boards/silabs/explorer_kits/six301/Kconfig.sixg301_ek2719a
```kconfig
# Copyright The Zephyr Project Contributors
# SPDX-License-Identifier: Apache-2.0

config BOARD_SIXG301_EK2719A
	select SOC_SIMG301M104LIL
```

## boards/silabs/radio_boards/six301/Kconfig.sixg301_rb4407a
```kconfig
# Copyright The Zephyr Project Contributors
# SPDX-License-Identifier: Apache-2.0

config BOARD_SIXG301_RB4407A
	select SOC_SIMG301M104LIL
```

## boards/silabs/radio_boards/six301/board.yml
```yaml
boards:
  - name: sixg301_rb4407a
    full_name: SixG301 +10 dBm, 4 MB Flash Radio Board
    vendor: silabs
    socs:
      - name: simg301m104lil
```

## boards/silabs/radio_boards/xg21/Kconfig.defconfig
```kconfig
# Copyright (c) 2020 Piotr Mienkowski
# Copyright (c) 2020 TriaGnoSys GmbH
# Copyright (c) 2026 Silicon Laboratories Inc.
# SPDX-License-Identifier: Apache-2.0

if BOARD_SLWRB4180A || BOARD_SLWRB4180B || BOARD_XG21_RB4195B || BOARD_XG21_RB4196B

config LOG_BACKEND_SWO_FREQ_HZ
	default 875000
	depends on LOG_BACKEND_SWO

config FPU
	default y if SOC_GECKO_USE_RAIL || BT

if BT

config MAIN_STACK_SIZE
	default 3072 if PM
	default 2304

endif # BT

endif
```

## boards/silabs/radio_boards/xg21/Kconfig.xg21_rb4196b
```kconfig
# Copyright (c) 2026 Silicon Laboratories Inc.
# SPDX-License-Identifier: Apache-2.0

config BOARD_XG21_RB4196B
	select SOC_EFR32MG21B020F1024IM32
```

## boards/silabs/radio_boards/xg21/board.yml
```yaml
# Copyright The Zephyr Project Contributors
# SPDX-License-Identifier: Apache-2.0

boards:
  - name: slwrb4180a
    full_name: EFR32xG21 2.4 GHz 20 dBm (SLWRB4180A)
    vendor: silabs
    socs:
      - name: efr32mg21a020f1024im32
  - name: slwrb4180b
    full_name: EFR32xG21 2.4 GHz 20 dBm (SLWRB4180B)
    vendor: silabs
    socs:
      - name: efr32mg21a020f1024im32
  - name: xg21_rb4195b
    full_name: EFR32xG21B 2.4 GHz 10 dBm (xG21-RB4195B)
    vendor: silabs
    socs:
      - name: efr32mg21b010f1024im32
  - name: xg21_rb4196b
    full_name: EFR32xG21B 2.4 GHz 20 dBm (xG21-RB4196B)
    vendor: silabs
    socs:
      - name: efr32mg21b020f1024im32
```

## boards/silabs/radio_boards/xg21_rb4195b/board.yml
```yaml
board:
  name: xg21_rb4195b
  full_name: EFR32xG21B 2.4 GHz 10 dBm (xG21-RB4195B)
  vendor: silabs
  socs:
    - name: efr32mg21b010f1024im32
```

## boards/silabs/radio_boards/xg21_rb4196b/board.yml
```yaml
board:
  name: xg21_rb4196b
  full_name: EFR32xG21B 2.4 GHz 20 dBm (xG21-RB4196B)
  vendor: silabs
  socs:
    - name: efr32mg21b020f1024im32
```

## boards/silabs/radio_boards/xg22/Kconfig.xg22_rb4415a
```kconfig
# Copyright (c) 2026 Silicon Laboratories Inc.
# SPDX-License-Identifier: Apache-2.0

config BOARD_XG22_RB4415A
	select SOC_EFR32MG22E224F512IM40
```

## boards/silabs/radio_boards/xg22/board.yml
```yaml
boards:
  - name: slwrb4182a
    full_name: EFR32xG22 2.4 GHz +6 dBm Radio Board
    vendor: silabs
    socs:
      - name: efr32mg22c224f512im40
  - name: slwrb4311a
    full_name: BGM220P Bluetooth Module 2.4 GHz +8 dBm Radio Board
    vendor: silabs
    socs:
      - name: bgm220pc22hna
  - name: xg22_rb4415a
    full_name: EFR32xG22E 2.4 GHz 6 dBm (xG22-RB4415A)
    vendor: silabs
    socs:
      - name: efr32mg22e224f512im40
```

## boards/silabs/radio_boards/xg24/Kconfig.xg24_rb4188a
```kconfig
# Copyright (c) 2026 Silicon Laboratories Inc.
# SPDX-License-Identifier: Apache-2.0

config BOARD_XG24_RB4188A
	select SOC_EFR32MG24B220F1536IM48
```

## boards/silabs/radio_boards/xg24/Kconfig.xgm240_rb4318a
```kconfig
# Copyright (c) 2026 Silicon Laboratories Inc.
# SPDX-License-Identifier: Apache-2.0

config BOARD_XGM240_RB4318A
	select SOC_MGM240SD22VNA
```

## boards/silabs/radio_boards/xg24/board.yml
```yaml
boards:
  - name: xg24_rb4186c
    full_name: EFR32xG24 2.4 GHz 10 dBm (xG24-RB4186C)
    vendor: silabs
    socs:
      - name: efr32mg24b210f1536im48
  - name: xg24_rb4187c
    full_name: EFR32xG24 2.4 GHz 20 dBm (xG24-RB4187C)
    vendor: silabs
    socs:
      - name: efr32mg24b220f1536im48
  - name: xg24_rb4188a
    full_name: EFR32xG24 2.4 GHz 20 dBm Antenna Diversity Radio Board
    vendor: silabs
    socs:
      - name: efr32mg24b220f1536im48
  - name: xgm240_rb4316a
    full_name: xGM240P 10 dBm Module Radio Board (xGM240-RB4316A)
    vendor: silabs
    socs:
      - name: mgm240pb22vna
  - name: xgm240_rb4317a
    full_name: xGM240P 20 dBm Module Radio Board (xGM240-RB4317A)
    vendor: silabs
    socs:
      - name: mgm240pb32vna
  - name: xgm240_rb4318a
    full_name: xGM240S +10 dBm SiP Module Radio Board (xGM240-RB4318A)
    vendor: silabs
    socs:
      - name: mgm240sd22vna
```

## boards/silabs/radio_boards/xg29/Kconfig.defconfig
```kconfig
# Copyright (c) 2025 Silicon Laboratories Inc.
# SPDX-License-Identifier: Apache-2.0

if BOARD_BG29_RB4420A || BOARD_XG29_RB4412A || BOARD_XG29_RB4413A

config LOG_BACKEND_SWO_FREQ_HZ
	default 875000
	depends on LOG_BACKEND_SWO

config FPU
	default y if SOC_GECKO_USE_RAIL || BT

if BT

config MAIN_STACK_SIZE
	default 3072 if PM
	default 2304

endif # BT

endif
```
