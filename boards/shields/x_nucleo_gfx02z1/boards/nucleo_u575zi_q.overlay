/*
 * Copyright (c) 2026 Michele Vaccari
 *
 * SPDX-License-Identifier: Apache-2.0
 */

#include <zephyr/dt-bindings/flash_controller/ospi.h>
#include <freq.h>

&mx_flash {
	mspi-max-frequency = <DT_FREQ_M(50)>;
	data-rate = <MSPI_DATA_RATE_SINGLE>;
	mspi-io-mode = <MSPI_IO_MODE_QUAD>;
};
