/* Copyright (c) 2022 Linumiz
 * SPDX-License-Identifier: Apache-2.0
 */

#include <zephyr/dt-bindings/gpio/arduino-header-r3.h>

&arduino_spi {
	status = "okay";

	eth_w5500_arceli_eth_w5500: eth_w5500@0 {
		compatible = "wiznet,w5500";
		reg = <0x0>;
		spi-max-frequency = <80000000>;
		int-gpios = <&arduino_header ARDUINO_HEADER_R3_D9 GPIO_ACTIVE_LOW>;
		reset-gpios = <&arduino_header ARDUINO_HEADER_R3_D8 GPIO_ACTIVE_LOW>;
	};
};
