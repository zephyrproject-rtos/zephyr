/*
 * Copyright (c) 2025-2026 Microchip Technology Inc.
 *
 * SPDX-License-Identifier: Apache-2.0
 */

/ {
	chosen {
		zephyr,bt-hci = &bt_hci_uart;
	};
};

&mikrobus_serial {
	status = "okay";

	bt_hci_uart: bluetooth {
		compatible = "zephyr,bt-hci-uart";
		status = "okay";
	};
};
