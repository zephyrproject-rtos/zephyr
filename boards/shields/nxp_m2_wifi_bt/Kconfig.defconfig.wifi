## boards/shields/nxp_m2_wifi_bt/Kconfig.defconfig.wifi
```kconfig
# Copyright 2026 NXP
# SPDX-License-Identifier: Apache-2.0

if NETWORKING

if NET_L2_WIFI_MGMT

configdefault WIFI_MGMT_AP_MAX_NUM_STA
	default 8 if NXP_WIFI_SOFTAP_SUPPORT

configdefault WIFI_SHELL_MAX_AP_STA
	default 8

endif # NET_L2_WIFI_MGMT

endif # NETWORKING

if SHIELD_NXP_ADAPTER_M2_2LL_WIFI_BT

configdefault NXP_WIFI_SLIM
	default y

endif # SHIELD_NXP_ADAPTER_M2_2LL_WIFI_BT

if NXP_WIFI_PRESET

source "drivers/wifi/nxp/Kconfig.preset"

if NETWORKING

configdefault NET_PKT_RX_COUNT
	default 36 if SHIELD_NXP_M2_2LL_WIFI_BT
	default 72 if SHIELD_NXP_M2_1XK_WIFI_BT || SHIELD_NXP_M2_2EL_WIFI_BT
	default 16 if SHIELD_NXP_ADAPTER_M2_2LL_WIFI_BT

configdefault NET_PKT_TX_COUNT
	default 36 if SHIELD_NXP_M2_2LL_WIFI_BT
	default 36 if SHIELD_NXP_M2_1XK_WIFI_BT || SHIELD_NXP_M2_2EL_WIFI_BT
	default 16 if SHIELD_NXP_ADAPTER_M2_2LL_WIFI_BT

configdefault NET_BUF_RX_COUNT
	default 40 if SHIELD_NXP_M2_2LL_WIFI_BT
	default 80 if SHIELD_NXP_M2_1XK_WIFI_BT || SHIELD_NXP_M2_2EL_WIFI_BT
	default 20 if SHIELD_NXP_ADAPTER_M2_2LL_WIFI_BT

configdefault NET_BUF_TX_COUNT
	default 40 if SHIELD_NXP_M2_2LL_WIFI_BT
	default 40 if SHIELD_NXP_M2_1XK_WIFI_BT || SHIELD_NXP_M2_2EL_WIFI_BT
	default 20 if SHIELD_NXP_ADAPTER_M2_2LL_WIFI_BT

if NET_TCP

configdefault NET_TCP_MAX_SEND_WINDOW_SIZE
	default 46720 if SHIELD_NXP_M2_2LL_WIFI_BT
	default 46720 if SHIELD_NXP_M2_1XK_WIFI_BT || SHIELD_NXP_M2_2EL_WIFI_BT
	default 20440 if SHIELD_NXP_ADAPTER_M2_2LL_WIFI_BT

configdefault NET_TCP_MAX_RECV_WINDOW_SIZE
	default 46720 if SHIELD_NXP_M2_2LL_WIFI_BT
	default 46720 if SHIELD_NXP_M2_1XK_WIFI_BT || SHIELD_NXP_M2_2EL_WIFI_BT
	default 20440 if SHIELD_NXP_ADAPTER_M2_2LL_WIFI_BT

endif # NET_TCP

endif # NETWORKING

if SOC_MIMX9131 && SHIELD_NXP_M2_2LL_WIFI_BT

configdefault NXP_WIFI_TX_TASK_STACK_SIZE
	default 8192

configdefault NXP_WIFI_CORE_TASK_STACK_SIZE
	default 4096

configdefault NXP_WIFI_SCAN_TASK_STACK_SIZE
	default 8192

configdefault NXP_WIFI_MON_TASK_STACK_SIZE
	default 8192

configdefault NXP_WIFI_POWERSAVE_TASK_STACK_SIZE
	default 4096

configdefault NXP_WIFI_DRIVER_TASK_STACK_SIZE
	default 8192

configdefault NXP_WIFI_WLCMGR_TASK_STACK_SIZE
	default 8192

endif # SOC_MIMX9131 && SHIELD_NXP_M2_2LL_WIFI_BT

endif # NXP_WIFI_PRESET
```

## boards/shields/rakwireless_rak12002/Kconfig.defconfig
```kconfig
# SPDX-FileCopyrightText: Copyright RAKwireless Technology Limited
# SPDX-License-Identifier: Apache-2.0

if SHIELD_RAKWIRELESS_RAK12002_INT

configdefault GPIO
	default y if RTC

endif # SHIELD_RAKWIRELESS_RAK12002_INT
```

## boards/shields/rakwireless_rak12002/Kconfig.shield
```kconfig
# SPDX-FileCopyrightText: Copyright RAKwireless Technology Limited
# SPDX-License-Identifier: Apache-2.0

config SHIELD_RAKWIRELESS_RAK12002_SENSOR_A
	def_bool $(shields_list_contains,rakwireless_rak12002_sensor_a)

config SHIELD_RAKWIRELESS_RAK12002_SENSOR_B
	def_bool $(shields_list_contains,rakwireless_rak12002_sensor_b)

config SHIELD_RAKWIRELESS_RAK12002_SENSOR_C
	def_bool $(shields_list_contains,rakwireless_rak12002_sensor_c)

config SHIELD_RAKWIRELESS_RAK12002_SENSOR_D
	def_bool $(shields_list_contains,rakwireless_rak12002_sensor_d)

config SHIELD_RAKWIRELESS_RAK12002_SENSOR_E
	def_bool $(shields_list_contains,rakwireless_rak12002_sensor_e)

config SHIELD_RAKWIRELESS_RAK12002_SENSOR_F
	def_bool $(shields_list_contains,rakwireless_rak12002_sensor_f)

config SHIELD_RAKWIRELESS_RAK12002
	def_bool SHIELD_RAKWIRELESS_RAK12002_SENSOR_A || \
		SHIELD_RAKWIRELESS_RAK12002_SENSOR_B || \
		SHIELD_RAKWIRELESS_RAK12002_SENSOR_C || \
		SHIELD_RAKWIRELESS_RAK12002_SENSOR_D || \
		SHIELD_RAKWIRELESS_RAK12002_SENSOR_E || \
		SHIELD_RAKWIRELESS_RAK12002_SENSOR_F

config SHIELD_RAKWIRELESS_RAK12002_INT
	def_bool SHIELD_RAKWIRELESS_RAK12002_SENSOR_B || \
		SHIELD_RAKWIRELESS_RAK12002_SENSOR_C || \
		SHIELD_RAKWIRELESS_RAK12002_SENSOR_D || \
		SHIELD_RAKWIRELESS_RAK12002_SENSOR_E || \
		SHIELD_RAKWIRELESS_RAK12002_SENSOR_F
```

## boards/shields/rakwireless_rak12004/Kconfig.defconfig
```kconfig
# SPDX-FileCopyrightText: Copyright RAKwireless Technology Limited
# SPDX-License-Identifier: Apache-2.0

if SHIELD_RAKWIRELESS_RAK12004

configdefault POWER_DOMAIN
	default y

configdefault POWER_DOMAIN_GPIO_INIT_PRIORITY
	default 45

endif # SHIELD_RAKWIRELESS_RAK12004
```

## boards/shields/rakwireless_rak12004/Kconfig.shield
```kconfig
# SPDX-FileCopyrightText: Copyright RAKwireless Technology Limited
# SPDX-License-Identifier: Apache-2.0

config SHIELD_RAKWIRELESS_RAK12004
	def_bool $(shields_list_contains,rakwireless_rak12004)
```

## boards/shields/rakwireless_rak12005/Kconfig.defconfig
```kconfig
# SPDX-FileCopyrightText: Copyright RAKwireless Technology Limited
# SPDX-License-Identifier: Apache-2.0

if SHIELD_RAKWIRELESS_RAK12005

configdefault INPUT
	default y

endif # SHIELD_RAKWIRELESS_RAK12005
```

## boards/shields/rakwireless_rak12006/Kconfig.defconfig
```kconfig
# SPDX-FileCopyrightText: Copyright (c) 2026 RAKwireless Technology Limited
# SPDX-License-Identifier: Apache-2.0

if SHIELD_RAKWIRELESS_RAK12006

configdefault INPUT
	default y

endif # SHIELD_RAKWIRELESS_RAK12006
```

## boards/shields/rakwireless_rak12010/Kconfig.defconfig
```kconfig
# SPDX-FileCopyrightText: Copyright (c) 2026 RAKwireless Technology Limited
# SPDX-License-Identifier: Apache-2.0

if SHIELD_RAKWIRELESS_RAK12010

if SENSOR

config GPIO
	default y

config POWER_DOMAIN
	default y

config POWER_DOMAIN_GPIO_INIT_PRIORITY
	default 45

endif # SENSOR

endif # SHIELD_RAKWIRELESS_RAK12010
```

## boards/shields/rakwireless_rak12013/Kconfig.defconfig
```kconfig
# SPDX-FileCopyrightText: Copyright (c) 2026 RAKwireless Technology Limited
# SPDX-License-Identifier: Apache-2.0

if SHIELD_RAKWIRELESS_RAK12013

if INPUT

config POWER_DOMAIN
	default y

config POWER_DOMAIN_GPIO_INIT_PRIORITY
	default 45

endif # INPUT

endif # SHIELD_RAKWIRELESS_RAK12013
```

## boards/shields/rakwireless_rak12014/Kconfig.shield
```kconfig
# SPDX-FileCopyrightText: Copyright RAKwireless Technology Limited
# SPDX-License-Identifier: Apache-2.0

config SHIELD_RAKWIRELESS_RAK12014_SENSOR_C
	def_bool $(shields_list_contains,rakwireless_rak12014_sensor_c)

config SHIELD_RAKWIRELESS_RAK12014_SENSOR_D
	def_bool $(shields_list_contains,rakwireless_rak12014_sensor_d)

config SHIELD_RAKWIRELESS_RAK12014_SENSOR_E
	def_bool $(shields_list_contains,rakwireless_rak12014_sensor_e)

config SHIELD_RAKWIRELESS_RAK12014_SENSOR_F
	def_bool $(shields_list_contains,rakwireless_rak12014_sensor_f)

config SHIELD_RAKWIRELESS_RAK12014
	def_bool SHIELD_RAKWIRELESS_RAK12014_SENSOR_C || \
		SHIELD_RAKWIRELESS_RAK12014_SENSOR_D || \
		SHIELD_RAKWIRELESS_RAK12014_SENSOR_E || \
		SHIELD_RAKWIRELESS_RAK12014_SENSOR_F
```

## boards/shields/rakwireless_rak12015/Kconfig.defconfig
```kconfig
# SPDX-FileCopyrightText: Copyright (c) 2026 RAKwireless Technology Limited
# SPDX-License-Identifier: Apache-2.0

if SHIELD_RAKWIRELESS_RAK12015

if INPUT

configdefault POWER_DOMAIN
	default y

configdefault POWER_DOMAIN_GPIO_INIT_PRIORITY
	default 45

endif # INPUT

endif # SHIELD_RAKWIRELESS_RAK12015
```

## boards/shields/rakwireless_rak12022/Kconfig.defconfig
```kconfig
# SPDX-FileCopyrightText: Copyright RAKwireless Technology Limited
# SPDX-License-Identifier: Apache-2.0

if SHIELD_RAKWIRELESS_RAK12022

if SENSOR

configdefault GPIO
	default y

configdefault POWER_DOMAIN
	default y

configdefault POWER_DOMAIN_GPIO_INIT_PRIORITY
	default 45

endif # SENSOR

endif # SHIELD_RAKWIRELESS_RAK12022
```

## boards/shields/rakwireless_rak12022/Kconfig.shield
```kconfig
# SPDX-FileCopyrightText: Copyright RAKwireless Technology Limited
# SPDX-License-Identifier: Apache-2.0

config SHIELD_RAKWIRELESS_RAK12022_2WIRE
	def_bool $(shields_list_contains,rakwireless_rak12022_2wire)

config SHIELD_RAKWIRELESS_RAK12022_3WIRE
	def_bool $(shields_list_contains,rakwireless_rak12022_3wire)

config SHIELD_RAKWIRELESS_RAK12022_4WIRE
	def_bool $(shields_list_contains,rakwireless_rak12022_4wire)

config SHIELD_RAKWIRELESS_RAK12022
	def_bool SHIELD_RAKWIRELESS_RAK12022_2WIRE || \
		SHIELD_RAKWIRELESS_RAK12022_3WIRE || \
		SHIELD_RAKWIRELESS_RAK12022_4WIRE
```

## boards/shields/rakwireless_rak16000/Kconfig.defconfig
```kconfig
# SPDX-FileCopyrightText: Copyright (c) 2026 RAKwireless Technology Limited
# SPDX-License-Identifier: Apache-2.0

if SHIELD_RAKWIRELESS_RAK16000

if SENSOR

configdefault GPIO
	default y

configdefault POWER_DOMAIN
	default y

configdefault POWER_DOMAIN_GPIO_INIT_PRIORITY
	default 45

endif # SENSOR

endif # SHIELD_RAKWIRELESS_RAK16000
```

## boards/shields/x_nucleo_plc01a1/Kconfig.shield
```kconfig
# Copyright (c) 2026 Sebastian Balling
# SPDX-License-Identifier: Apache-2.0

config SHIELD_X_NUCLEO_PLC01A1
	def_bool $(shields_list_contains,x_nucleo_plc01a1)
```

## boards/waveshare/esp32s3_touch_amoled_1_75c/Kconfig
```kconfig
# Copyright (c) 2026 Hassan Naeem
# SPDX-License-Identifier: Apache-2.0

config HEAP_MEM_POOL_ADD_SIZE_BOARD
	int
	default 4096 if BOARD_ESP32S3_TOUCH_AMOLED_1_75C_ESP32S3_PROCPU
	default 256 if BOARD_ESP32S3_TOUCH_AMOLED_1_75C_ESP32S3_APPCPU
```

## boards/waveshare/esp32s3_touch_amoled_1_75c/Kconfig.defconfig
```kconfig
# Copyright (c) 2026 Hassan Naeem
# SPDX-License-Identifier: Apache-2.0

if BOARD_ESP32S3_TOUCH_AMOLED_1_75C_ESP32S3_PROCPU

choice SOC_FAMILY_ESPRESSIF_SPIRAM_MODE
	default SOC_FAMILY_ESPRESSIF_SPIRAM_MODE_OCT
endchoice

endif # BOARD_ESP32S3_TOUCH_AMOLED_1_75C_ESP32S3_PROCPU
```

## boards/waveshare/esp32s3_touch_amoled_1_75c/board.yml
```yaml
board:
  name: esp32s3_touch_amoled_1_75c
  full_name: ESP32-S3-Touch-AMOLED-1.75C
  vendor: waveshare
  socs:
  - name: esp32s3
```

## boards/waveshare/esp32s3_touch_amoled_1_75c/esp32s3_touch_amoled_1_75c_esp32s3_appcpu_defconfig
```kconfig
# Copyright (c) 2026 Hassan Naeem
# SPDX-License-Identifier: Apache-2.0

CONFIG_CLOCK_CONTROL=y
```

## boards/waveshare/esp32s3_touch_amoled_1_75c/esp32s3_touch_amoled_1_75c_esp32s3_procpu_defconfig
```kconfig
# Copyright (c) 2026 Hassan Naeem
# SPDX-License-Identifier: Apache-2.0

CONFIG_GPIO=y
CONFIG_REGULATOR=y
CONFIG_CONSOLE=y
CONFIG_SERIAL=y
CONFIG_UART_CONSOLE=y
CONFIG_CLOCK_CONTROL=y
CONFIG_INPUT=y
```

## boards/waveshare/esp32s3_touch_lcd_2_8c/board.yml
```yaml
board:
  name: esp32s3_touch_lcd_2_8c
  full_name: ESP32-S3-Touch-LCD-2.8C
  vendor: waveshare
  socs:
  - name: esp32s3
```

## boards/wch/ch32x035evt/Kconfig.ch32x035evt
```kconfig
# Copyright (c) 2026 Chen Ren
# SPDX-License-Identifier: Apache-2.0

config BOARD_CH32X035EVT
	select SOC_CH32X035
```
