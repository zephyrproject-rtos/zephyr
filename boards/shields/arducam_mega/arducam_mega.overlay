/*
 * Copyright (c) 2026 Mario Paja
 *
 * SPDX-License-Identifier: Apache-2.0
 */

/ {
	chosen {
		zephyr,camera = &arducam_mega;
	};
};

&arducam_mega_spi {
	arducam_mega: arducam-mega@0 {
		compatible = "arducam,mega";
		reg = <0>;
		spi-max-frequency = <4000000>;
	};
};
