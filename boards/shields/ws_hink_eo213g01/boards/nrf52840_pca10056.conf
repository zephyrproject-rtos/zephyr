## boards/shields/wuxi_ov5640/Kconfig.shield
```kconfig
# Copyright 2024 NXP
# SPDX-License-Identifier: Apache-2.0

config SHIELD_WUXI_OV5640
	def_bool $(shields_list_contains,wuxi_ov5640)
```

## boards/shields/x_nucleo_53l0a1/Kconfig.defconfig
```kconfig
# Copyright (c) 2021 Titouan Christophe
# SPDX-License-Identifier: Apache-2.0

if SHIELD_X_NUCLEO_53L0A1

config VL53L0X_RECONFIGURE_ADDRESS
	default y if SENSOR

endif # SHIELD_X_NUCLEO_53L0A1
```

## boards/shields/x_nucleo_53l0a1/Kconfig.shield
```kconfig
# Copyright (c) 2021 Titouan Christophe
# SPDX-License-Identifier: Apache-2.0

config SHIELD_X_NUCLEO_53L0A1
	def_bool $(shields_list_contains,x_nucleo_53l0a1)
```

## boards/shields/x_nucleo_67w61m1/boards/nucleo_c5a3zg.conf
```kconfig
# Copyright (c) 2026 STMicroelectronics
# SPDX-License-Identifier: Apache-2.0

CONFIG_NET_IF_MAX_IPV4_COUNT=2
CONFIG_NET_IF_MAX_IPV6_COUNT=2
```

## boards/shields/x_nucleo_bnrg2a1/Kconfig.defconfig
```kconfig
# Copyright (c) 2024 STMicroelectronics
# SPDX-License-Identifier: Apache-2.0

if SHIELD_X_NUCLEO_BNRG2A1

if BT

config SPI
	default y

choice BT_HCI_BUS_TYPE
	default BT_SPI
endchoice

config BT_BLUENRG_ACI
	default y

# Disable Flow control
config BT_HCI_ACL_FLOW_CONTROL
	default n

endif # BT

endif # SHIELD_X_NUCLEO_BNRG2A1
```

## boards/shields/x_nucleo_bnrg2a1/Kconfig.shield
```kconfig
# Copyright (c) 2024 STMicroelectronics
# SPDX-License-Identifier: Apache-2.0

config SHIELD_X_NUCLEO_BNRG2A1
	def_bool $(shields_list_contains,x_nucleo_bnrg2a1)
```

## boards/shields/x_nucleo_cca02m2/Kconfig.shield
```kconfig
# Copyright (c) 2026 STMicroelectronics
# SPDX-License-Identifier: Apache-2.0

config SHIELD_X_NUCLEO_CCA02M2
	def_bool $(shields_list_contains,x_nucleo_cca02m2)
```

## boards/shields/x_nucleo_eeprma2/Kconfig.defconfig
```kconfig
# Copyright (c) 2021 Thomas Stranger
# SPDX-License-Identifier: Apache-2.0

if SHIELD_X_NUCLEO_EEPRMA2

if EEPROM

config EEPROM_INIT_PRIORITY
	default 75

endif # EEPROM

endif # SHIELD_X_NUCLEO_EEPRMA2
```

## boards/shields/x_nucleo_eeprma2/Kconfig.shield
```kconfig
# Copyright (c) 2021 Thomas Stranger
# SPDX-License-Identifier: Apache-2.0

config SHIELD_X_NUCLEO_EEPRMA2
	def_bool $(shields_list_contains,x_nucleo_eeprma2)
```

## boards/shields/x_nucleo_gfx01m2/Kconfig.defconfig
```kconfig
# Copyright (c) 2025 Christian Rask
# SPDX-License-Identifier: Apache-2.0

if SHIELD_X_NUCLEO_GFX01M2

configdefault SPI_STM32_INTERRUPT
	default y

configdefault SPI_STM32_DMA
	default y

endif # SHIELD_X_NUCLEO_GFX01M2
```

## boards/shields/x_nucleo_gfx01m2/Kconfig.shield
```kconfig
# Copyright (c) 2025 Christian Rask
# SPDX-License-Identifier: Apache-2.0

config SHIELD_X_NUCLEO_GFX01M2
	def_bool $(shields_list_contains,x_nucleo_gfx01m2)
```

## boards/shields/x_nucleo_gnss1a1/Kconfig.defconfig
```kconfig
# Copyright (c) 2026 Carlo Caione <ccaione@baylibre.com>
# SPDX-License-Identifier: Apache-2.0

if SHIELD_X_NUCLEO_GNSS1A1

config GNSS
	default y

config UART_INTERRUPT_DRIVEN
	default y

endif # SHIELD_X_NUCLEO_GNSS1A1
```

## boards/shields/x_nucleo_gnss1a1/Kconfig.shield
```kconfig
# Copyright (c) 2026 Carlo Caione <ccaione@baylibre.com>
# SPDX-License-Identifier: Apache-2.0

config SHIELD_X_NUCLEO_GNSS1A1
	def_bool $(shields_list_contains,x_nucleo_gnss1a1)
```

## boards/shields/x_nucleo_gnss1a1/boards/nucleo_wl55jc.conf
```kconfig
# SPDX-FileCopyrightText: Copyright (c) 2026 STMicroelectronics
# SPDX-License-Identifier: Apache-2.0

# GPIO hogs require enabling the GPIO driver to work.
CONFIG_GPIO=y
```

## boards/shields/x_nucleo_idb05a1/Kconfig.defconfig
```kconfig
# Copyright (c) 2019 Linaro Limited
# SPDX-License-Identifier: Apache-2.0

if SHIELD_X_NUCLEO_IDB05A1

if BT

config SPI
	default y

config BT_SPI
	default y

config BT_BLUENRG_ACI
	default y
# Disable Flow control
config BT_HCI_ACL_FLOW_CONTROL
	default n
config BT_HCI_VS
	default n

endif # BT

endif
```

## boards/shields/x_nucleo_idb05a1/Kconfig.shield
```kconfig
# Copyright (c) 2019 Linaro Limited
# SPDX-License-Identifier: Apache-2.0

config SHIELD_X_NUCLEO_IDB05A1
	def_bool $(shields_list_contains,x_nucleo_idb05a1)
```

## boards/shields/x_nucleo_iks01a1/Kconfig.defconfig
```kconfig
# Kconfig - ST Nucleo Expansion Board x-nucleo-iks01a1 configuration
#
# Copyright (c) 2018 Linaro Limited.
#
# SPDX-License-Identifier: Apache-2.0
#

if SHIELD_X_NUCLEO_IKS01A1

if HTS221

choice HTS221_TRIGGER_MODE
	default  HTS221_TRIGGER_NONE
endchoice

endif # HTS221

if LIS3MDL

choice LIS3MDL_TRIGGER_MODE
	default LIS3MDL_TRIGGER_NONE
endchoice

endif # LIS3MDL

if I2C_STM32

config I2C_STM32_INTERRUPT
	default y

endif # I2C_STM32

endif # SHIELD_X_NUCLEO_IKS01A1
```

## boards/shields/x_nucleo_iks01a1/Kconfig.shield
```kconfig
# Kconfig - ST Nucleo Expansion Board x-nucleo-iks01a1 configuration
#
# Copyright (c) 2018 Linaro Limited.
#
# SPDX-License-Identifier: Apache-2.0
#

config SHIELD_X_NUCLEO_IKS01A1
	bool "x-nucleo-iks01a1"
	select I2C
	select SENSOR
	select HTS221
	select LPS25HB
	select LSM6DS0
	select LIS3MDL
```

## boards/shields/x_nucleo_iks01a2/Kconfig.defconfig
```kconfig
# Copyright (c) 2022 TOKITA Hiroshi <tokita.hiroshi@fujitsu.com>
#
# SPDX-License-Identifier: Apache-2.0

if SHIELD_X_NUCLEO_IKS01A2

config I2C
	default y if SENSOR

endif # SHIELD_X_NUCLEO_IKS01A2
```

## boards/shields/x_nucleo_iks01a2/Kconfig.shield
```kconfig
# Copyright (c) 2019 Linaro Limited
# SPDX-License-Identifier: Apache-2.0

config SHIELD_X_NUCLEO_IKS01A2
	def_bool $(shields_list_contains,x_nucleo_iks01a2)
```

## boards/shields/x_nucleo_iks01a3/Kconfig.defconfig
```kconfig
# Copyright (c) 2022 Intel Corporation
#
# SPDX-License-Identifier: Apache-2.0

if SHIELD_X_NUCLEO_IKS01A3

config I2C
	default y if SENSOR

endif # SHIELD_X_NUCLEO_IKS01A3
```

## boards/shields/x_nucleo_iks02a1/Kconfig.defconfig
```kconfig
# Copyright (c) 2020 STMicroelectronics
#
# SPDX-License-Identifier: Apache-2.0

if SHIELD_X_NUCLEO_IKS02A1

config I2C
	default y if SENSOR

endif # SHIELD_X_NUCLEO_IKS02A1

rsource "boards/*.defconfig"
```

## boards/shields/x_nucleo_iks02a1/Kconfig.shield
```kconfig
# Copyright (c) 2020 STMicroelectronics
# SPDX-License-Identifier: Apache-2.0

config SHIELD_X_NUCLEO_IKS02A1
	def_bool $(shields_list_contains,x_nucleo_iks02a1)
```
