## boards/shields/st_b_lcd40_dsi1_mb1166/boards/stm32f769i_disco.conf
```kconfig
# Copyright (c) 2025 STMicroelectronics
# SPDX-License-Identifier: Apache-2.0

CONFIG_MEMC=y
```

## boards/shields/st_b_lcd40_dsi1_mb1166/boards/stm32h747i_disco_m7.conf
```kconfig
# Copyright (c) 2023 bytes at work AG
# SPDX-License-Identifier: Apache-2.0

CONFIG_MEMC=y
CONFIG_STM32_LTDC_RGB888=y
CONFIG_HEAP_MEM_POOL_SIZE=65536
# Initialize after LTDC
CONFIG_DISPLAY_OTM8009A_INIT_PRIORITY=86
```

## boards/shields/st_b_lcd40_dsi1_mb1166/boards/stm32h747i_disco_stm32h747xx_m7.conf
```kconfig
# Copyright (c) 2023 bytes at work AG
# SPDX-License-Identifier: Apache-2.0

CONFIG_MEMC=y
```

## boards/shields/st_b_lcd40_dsi1_mb1166/boards/stm32h757i_eval_stm32h757xx_m7.conf
```kconfig
# Copyright (c) 2023 bytes at work AG
# Copyright (c) 2025 Foss Analytical A/S
# SPDX-License-Identifier: Apache-2.0

CONFIG_MEMC=y
CONFIG_STM32_LTDC_ARGB8888=y
```

## boards/shields/st_b_m2mem_pack1/Kconfig.shield
```kconfig
# Copyright (c) 2026 Filip Stojanovic <filipembedded@gmail.com>
# SPDX-License-Identifier: Apache-2.0

config SHIELD_ST_B_M2MEM_PACK1
	def_bool $(shields_list_contains,b_m2mem_pack1_mb1927_18ba) ||\
		$(shields_list_contains,b_m2mem_pack1_mb1927_33ba) ||\
		$(shields_list_contains,b_m2mem_pack1_mb1928_33la) ||\
		$(shields_list_contains,b_m2mem_pack1_mb1928_33lb)

config SHIELD_B_M2MEM_PACK1_MB1927_18BA
	def_bool $(shields_list_contains,b_m2mem_pack1_mb1927_18ba)

config SHIELD_B_M2MEM_PACK1_MB1927_33BA
	def_bool $(shields_list_contains,b_m2mem_pack1_mb1927_33ba)

config SHIELD_B_M2MEM_PACK1_MB1928_33LA
	def_bool $(shields_list_contains,b_m2mem_pack1_mb1928_33la)

config SHIELD_B_M2MEM_PACK1_MB1928_33LB
	def_bool $(shields_list_contains,b_m2mem_pack1_mb1928_33lb)
```

## boards/shields/st_gh08172t/Kconfig.shield
```kconfig
# Copyright 2026 Renato Mauro
#
# SPDX-License-Identifier: Apache-2.0

config SHIELD_ST_GH08172T
	def_bool $(shields_list_contains,st_gh08172t)
	select AUXDISPLAY_ST_SLCD
```

## boards/shields/st_lcd_dsi_mb1835/Kconfig.defconfig
```kconfig
# Copyright (c) 2025 Charles Dias
# SPDX-License-Identifier: Apache-2.0

if SHIELD_ST_LCD_DSI_MB1835

orsource "boards/*.defconfig"

if LVGL

config LV_Z_BITS_PER_PIXEL
	default 32

config LV_Z_FLUSH_THREAD
	default y

choice LV_COLOR_DEPTH
	default LV_COLOR_DEPTH_32
endchoice

endif # LVGL

endif # SHIELD_ST_LCD_DSI_MB1835
```

## boards/shields/st_lcd_dsi_mb1835/Kconfig.shield
```kconfig
# Copyright (c) 2025 Charles Dias
# SPDX-License-Identifier: Apache-2.0

config SHIELD_ST_LCD_DSI_MB1835
	def_bool $(shields_list_contains,st_lcd_dsi_mb1835)
```

## boards/shields/st_mb1835/Kconfig.shield
```kconfig
# Copyright (c) 2025 Charles Dias
# SPDX-License-Identifier: Apache-2.0

config SHIELD_ST_MB1835
	def_bool $(shields_list_contains,st_mb1835)
```

## boards/shields/st_mb1835/boards/stm32u5g9j_dk1.conf
```kconfig
# Heap memory pool configuration
CONFIG_HEAP_MEM_POOL_SIZE=65536

# Display configuration
CONFIG_MIPI_DSI=y
CONFIG_STM32_LTDC_ARGB8888=y
CONFIG_DISPLAY_HX8379C_INIT_PRIORITY=87
```

## boards/shields/st_mb1897_cam/Kconfig.shield
```kconfig
# Copyright (c) 2025 STMicroelectronics

# SPDX-License-Identifier: Apache-2.0

config SHIELD_ST_MB1897_CAM
	def_bool $(shields_list_contains,st_mb1897_cam)
```

## boards/shields/st_stm32f4dis_cam/Kconfig.shield
```kconfig
# Copyright (c) 2025 STMicroelectronics

# SPDX-License-Identifier: Apache-2.0

config SHIELD_ST_STM32F4DIS_CAM
	def_bool $(shields_list_contains,st_stm32f4dis_cam)
```

## boards/shields/st_stm32mp13_gc2145_cam/Kconfig.shield
```kconfig
# Copyright (c) 2025 STMicroelectronics

# SPDX-License-Identifier: Apache-2.0

config SHIELD_ST_STM32MP13_GC2145_CAM
	def_bool $(shields_list_contains,st_stm32mp13_gc2145_cam)
```

## boards/shields/st_stm32mp13_gc2145_cam/boards/stm32mp135f_dk.conf
```kconfig
CONFIG_VIDEO_STM32_DCMIPP_SENSOR_PIXEL_FORMAT="RGBP"
CONFIG_VIDEO_STM32_DCMIPP_SENSOR_WIDTH=640
CONFIG_VIDEO_STM32_DCMIPP_SENSOR_HEIGHT=480
```

## boards/shields/steval_56g3mai/Kconfig.defconfig
```kconfig
# SPDX-FileCopyrightText: Copyright The Zephyr Project Contributors
# SPDX-FileCopyrightText: Copyright (c) 2026 LANDROVAL
# SPDX-License-Identifier: Apache-2.0

if SHIELD_STEVAL_56G3MAI

configdefault VIDEO_VD56G3 y

endif # SHIELD_STEVAL_56G3MAI

if SHIELD_STEVAL_56G3MAI && VIDEO_STM32_DCMIPP

configdefault VIDEO_STM32_DCMIPP_SENSOR_PIXEL_FORMAT "Y10P"
configdefault VIDEO_STM32_DCMIPP_SENSOR_WIDTH 1124
configdefault VIDEO_STM32_DCMIPP_SENSOR_HEIGHT 1364

# Assert the camera connector power rail on boards that define csi_gpio1_hog.
configdefault GPIO_HOGS y

endif # SHIELD_STEVAL_56G3MAI && VIDEO_STM32_DCMIPP
```

## boards/shields/steval_56g3mai/Kconfig.shield
```kconfig
# SPDX-FileCopyrightText: Copyright The Zephyr Project Contributors
# SPDX-FileCopyrightText: Copyright (c) 2026 LANDROVAL
# SPDX-License-Identifier: Apache-2.0

config SHIELD_STEVAL_56G3MAI
	def_bool

configdefault SHIELD_STEVAL_56G3MAI
	default $(shields_list_contains,steval_56g3mai)
```

## boards/shields/swir_hl78xx_ev_kit/Kconfig.shield
```kconfig
# Copyright (c) 2025 Netfeasa Ltd.
# SPDX-License-Identifier: Apache-2.0

config SHIELD_SWIR_HL78XX_EV_KIT
	def_bool $(shields_list_contains,swir_hl78xx_ev_kit)
```

## boards/shields/tcan4550evm/Kconfig.shield
```kconfig
# Copyright (c) 2023 Vestas Wind Systems A/S
# SPDX-License-Identifier: Apache-2.0

config SHIELD_TCAN4550EVM
	def_bool $(shields_list_contains,tcan4550evm)
```

## boards/shields/ti_bp_bassensorsmkii/Kconfig.shield
```kconfig
# Copyright (c) 2023 Intel Corporation
# SPDX-License-Identifier: Apache-2.0

config SHIELD_TI_BP_BASSENSORSMKII
	def_bool $(shields_list_contains,ti_bp_bassensorsmkii)
```

## boards/shields/tn0xxx/Kconfig.defconfig
```kconfig
# Copyright (c) 2023 Alen Daniel
# SPDX-License-Identifier: Apache-2.0

if SHIELD_TN0216ANVNANN

if DISPLAY

if LVGL

config LV_Z_VDB_SIZE
	default 100

config LV_Z_BITS_PER_PIXEL
	default 1

choice LV_COLOR_DEPTH
	default LV_COLOR_DEPTH_1
endchoice

endif # LVGL

endif # DISPLAY

endif # SHIELD_TN0216ANVNANN
```

## boards/shields/tn0xxx/Kconfig.shield
```kconfig
# Copyright (c) 2023 Alen Daniel
# SPDX-License-Identifier: Apache-2.0

config SHIELD_TN0216ANVNANN
	def_bool $(shields_list_contains,tn0216anvnann)
```
