/*
 * Copyright (c) 2024 Erik Andersson <erian747@gmail.com>
 *
 * SPDX-License-Identifier: Apache-2.0
 */

&zephyr_mipi_dsi {
	status = "okay";
	loosely-packed;
	largest-packet-size = <64>;
	bta-ack-disable;
};
