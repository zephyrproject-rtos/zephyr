/*
 * Copyright (c) 2023 bytes at work AG
 *
 * SPDX-License-Identifier: Apache-2.0
 */
&ltdc {
	/* orisetech, otm8009a */
	display-timings {
		compatible = "zephyr,panel-timing";
		hsync-active = <0>;
		vsync-active = <0>;
		de-active = <0>;
		pixelclk-active = <0>;
		hsync-len = <2>;
		vsync-len = <1>;
		hback-porch = <34>;
		vback-porch = <15>;
		hfront-porch = <34>;
		vfront-porch = <16>;
	};
};
