/*
 * Copyright (c) 2024 David Ullmann
 * SPDX-License-Identifier: Apache-2.0
 */

#include <zephyr/dt-bindings/gpio/gpio.h>
#include <zephyr/dt-bindings/gpio/arduino-header-r3.h>

/ {
	aliases {
		lora0 = &rylr_lora_modem;
	};
};

&arduino_serial {
	current-speed = <115200>;
	status = "okay";

	rylr_lora_modem: rylr_lora_modem {
		compatible = "reyax,rylrxxx";
		status = "okay";
		reset-gpios = <&arduino_header ARDUINO_HEADER_R3_D10 GPIO_ACTIVE_LOW>;
	};
};
