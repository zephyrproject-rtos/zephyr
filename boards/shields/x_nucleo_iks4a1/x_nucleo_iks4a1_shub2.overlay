/*
 * Copyright (c) 2024 STMicroelectronics
 *
 * SPDX-License-Identifier: Apache-2.0
 */

#include <zephyr/dt-bindings/gpio/arduino-header-r3.h>

/ {
	aliases {
		accel0 = &lsm6dso16is_6a_x_nucleo_iks4a1_shub;
	};
};

&arduino_i2c {
	lsm6dso16is_6a_x_nucleo_iks4a1_shub: lsm6dso16is@6a {
		compatible = "st,lsm6dso16is";
		reg = <0x6a>;
		irq-gpios = <&arduino_header ARDUINO_HEADER_R3_A5 GPIO_ACTIVE_HIGH>;
		drdy-pin = <1>;
	};
};
