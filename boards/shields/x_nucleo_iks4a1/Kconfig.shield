## boards/shields/x_nucleo_iks4a1/Kconfig.shield
```kconfig
# Copyright (c) 2024 STMicroelectronics
# SPDX-License-Identifier: Apache-2.0

config SHIELD_X_NUCLEO_IKS01A4
	def_bool $(shields_list_contains,x_nucleo_iks4a1)
```

## boards/shields/x_nucleo_iks5a1/Kconfig.shield
```kconfig
# Copyright (c) 2026 STMicroelectronics
# SPDX-License-Identifier: Apache-2.0

config SHIELD_X_NUCLEO_IKS01A5
	def_bool $(shields_list_contains,x_nucleo_iks5a1)
```

## boards/shields/x_nucleo_nfc04a1/Kconfig.shield
```kconfig
# Copyright (c) 2023 Kickmaker
# SPDX-License-Identifier: Apache-2.0

config SHIELD_X_NUCLEO_NFC04A1
	def_bool $(shields_list_contains,x_nucleo_nfc04a1)
```

## boards/shields/x_nucleo_pgeez1/Kconfig.shield
```kconfig
# SPDX-FileCopyrightText: Copyright 2026 EXALT Technologies
# SPDX-License-Identifier: Apache-2.0

config SHIELD_X_NUCLEO_PGEEZ1
	def_bool $(shields_list_contains,x_nucleo_pgeez1)
```

## boards/shields/x_nucleo_s2868a1/Kconfig.defconfig
```kconfig
# Copyright (c) 2021 Nikos Oikonomou <nikoikonomou92@gmail.com>
# SPDX-License-Identifier: Apache-2.0

if SHIELD_X_NUCLEO_S2868A1

if IEEE802154

config SPI
	default y
	depends on IEEE802154

config IEEE802154_S2LP
	default y
	depends on IEEE802154

config NET_CONFIG_IEEE802154_DEV_NAME
	default "IEEE802154_S2LP"
	depends on IEEE802154_S2LP

endif # IEEE802154

endif # SHIELD_X_NUCLEO_S2868A1
```

## boards/shields/x_nucleo_s2868a1/Kconfig.shield
```kconfig
# Copyright (c) 2021 Nikos Oikonomou <nikoikonomou92@gmail.com>
# SPDX-License-Identifier: Apache-2.0

config SHIELD_X_NUCLEO_S2868A1
	def_bool $(shields_list_contains,x_nucleo_s2868a1)
```

## boards/shields/x_nucleo_wb05kn1/Kconfig.defconfig
```kconfig
# Copyright (c) 2024 STMicroelectronics
# SPDX-License-Identifier: Apache-2.0

if SHIELD_X_NUCLEO_WB05KN1_UART || SHIELD_X_NUCLEO_WB05KN1_SPI

if BT

config SPI_STM32_INTERRUPT
	default y
	depends on SPI

config BT_BLUENRG_ACI
	default y

# Disable Flow control
config BT_HCI_ACL_FLOW_CONTROL
	default n

endif # BT

endif # SHIELD_X_NUCLEO_WB05KN1_UART || SHIELD_X_NUCLEO_WB05KN1_SPI
```

## boards/shields/x_nucleo_wb05kn1/Kconfig.shield
```kconfig
# Copyright (c) 2024 STMicroelectronics
# SPDX-License-Identifier: Apache-2.0

config SHIELD_X_NUCLEO_WB05KN1_UART
	def_bool $(shields_list_contains,x_nucleo_wb05kn1_uart)

config SHIELD_X_NUCLEO_WB05KN1_SPI
	def_bool $(shields_list_contains,x_nucleo_wb05kn1_spi)
```

## boards/shields/x_nucleo_wba25a1/Kconfig.shield
```kconfig
# Copyright (c) 2026 STMicroelectronics
# SPDX-License-Identifier: Apache-2.0

config SHIELD_X_NUCLEO_WBA25A1_UART
	def_bool $(shields_list_contains,x_nucleo_wba25a1_uart)

config SHIELD_X_NUCLEO_WBA25A1_SPI
	def_bool $(shields_list_contains,x_nucleo_wba25a1_spi)
```

## boards/shields/x_stm32mp_msp01/Kconfig.shield
```kconfig
# Copyright (c) 2026 Linaro Limited
# SPDX-License-Identifier: Apache-2.0

config SHIELD_X_STM32MP_MSP01
	def_bool $(shields_list_contains,x_stm32mp_msp01)
```

## boards/shields/zc143ac72mipi/Kconfig.shield
```kconfig
# Copyright 2025 NXP
# SPDX-License-Identifier: Apache-2.0

config SHIELD_ZC143AC72MIPI
	def_bool $(shields_list_contains,zc143ac72mipi)
```

## boards/shields/zc143ac72mipi/boards/mimxrt700_evk_mimxrt798s_cm33_cpu0.conf
```kconfig
CONFIG_REGULATOR=y
CONFIG_DCACHE=n
CONFIG_CO5300_EXTERNAL_FB_MEM=y
# Place the panel frame buffer on SRAM
CONFIG_CO5300_EXTERNAL_FB_ADDR=0x30100000
```

## boards/shields/zhaw_lumamatrix/Kconfig.shield
```kconfig
# Copyright (c) 2026 Institute of Embedded Systems ZHAW
# SPDX-License-Identifier: Apache-2.0

config SHIELD_ZHAW_LUMAMATRIX
	def_bool $(shields_list_contains,zhaw_lumamatrix)
```

## boards/sifive/hifive1/Kconfig
```kconfig
# Copyright (c) 2024 Antmicro <www.antmicro.com>
# SPDX-License-Identifier: Apache-2.0

config BOARD_HIFIVE1
	select RISCV_CORE_E31 if "$(BOARD_REVISION)" = "B"
```

## boards/sifive/hifive1/Kconfig.defconfig
```kconfig
# SPDX-License-Identifier: Apache-2.0
# Copyright (c) 2018 SiFive, Inc.

if BOARD_HIFIVE1_REVB

config HAS_FLASH_LOAD_OFFSET
	default y

config FLASH_BASE_ADDRESS
	default $(dt_node_reg_addr_hex,/soc/spi@10014000,1)

config FLASH_LOAD_OFFSET
	default 0x0

endif # BOARD_HIFIVE1_REVB
```

## boards/sifive/hifive1/Kconfig.hifive1
```kconfig
# Copyright (c) 2024 Antmicro <www.antmicro.com>
# SPDX-License-Identifier: Apache-2.0

config BOARD_HIFIVE1
	select SOC_SIFIVE_FREEDOM_FE310
```

## boards/sifive/hifive1/Kconfig.hifive1_revb
```kconfig
# Copyright (c) 2025 Antmicro <www.antmicro.com>
# SPDX-License-Identifier: Apache-2.0

config BOARD_HIFIVE1_REVB
	select SOC_SIFIVE_FREEDOM_FE310_G002
```

## boards/sifive/hifive1/board.yml
```yaml
boards:
  - name: hifive1
    full_name: HiFive1
    vendor: sifive
    socs:
      - name: fe310_g000
  - name: hifive1_revb
    full_name: HiFive1 Rev B
    vendor: sifive
    socs:
      - name: fe310_g002
```

## boards/sifive/hifive1/hifive1_defconfig
```kconfig
# SPDX-License-Identifier: Apache-2.0
# Copyright (c) 2018 SiFive, Inc.

CONFIG_CONSOLE=y
CONFIG_SERIAL=y
CONFIG_UART_SIFIVE_PORT_0=y
CONFIG_UART_CONSOLE=y
CONFIG_GPIO=y
```

## boards/sifive/hifive1/hifive1_fe310_A_defconfig
```kconfig
# SPDX-License-Identifier: Apache-2.0
# Copyright (c) 2018 SiFive, Inc.

CONFIG_BUILD_OUTPUT_HEX=y
```

## boards/sifive/hifive_unleashed/Kconfig.hifive_unleashed
```kconfig
# Copyright (c) 2021 Katsuhiro Suzuki
# SPDX-License-Identifier: Apache-2.0

config BOARD_HIFIVE_UNLEASHED
	select SOC_SIFIVE_FREEDOM_FU540_E51 if BOARD_HIFIVE_UNLEASHED_FU540_E51
	select SOC_SIFIVE_FREEDOM_FU540_U54 if BOARD_HIFIVE_UNLEASHED_FU540_U54
```

## boards/sifive/hifive_unleashed/hifive_unleashed_e51_defconfig
```kconfig
# SPDX-License-Identifier: Apache-2.0

CONFIG_CONSOLE=y
CONFIG_GPIO=y
CONFIG_SERIAL=y
CONFIG_UART_SIFIVE_PORT_0=y
CONFIG_UART_CONSOLE=y
CONFIG_XIP=n
```

## boards/sifive/hifive_unmatched/Kconfig.hifive_unmatched
```kconfig
# Copyright (c) 2021 Katsuhiro Suzuki
# SPDX-License-Identifier: Apache-2.0

config BOARD_HIFIVE_UNMATCHED
	select SOC_SIFIVE_FREEDOM_FU740_S7 if BOARD_HIFIVE_UNMATCHED_FU740_S7
	select SOC_SIFIVE_FREEDOM_FU740_U74 if BOARD_HIFIVE_UNMATCHED_FU740_U74
```

## boards/sifive/hifive_unmatched/board.yml
```yaml
board:
  name: hifive_unmatched
  full_name: HiFive Unmatched
  vendor: sifive
  socs:
    - name: fu740
```

## boards/sifive/hifive_unmatched/hifive_unmatched_u74_defconfig
```kconfig
# SPDX-License-Identifier: Apache-2.0

CONFIG_CONSOLE=y
CONFIG_SERIAL=y
CONFIG_UART_SIFIVE_PORT_0=y
CONFIG_UART_CONSOLE=y
CONFIG_XIP=n
CONFIG_RV_BOOT_HART=1
CONFIG_FLOAT_HARD=y
```
