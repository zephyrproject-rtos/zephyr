/*
 * Copyright (c) 2024 Semtech Corporation
 *
 * SPDX-License-Identifier: Apache-2.0
 */

#include "semtech_sx126xmb2xxs_common.dtsi"

lora_semtech_sx1261mb2xxs: &lora_semtech_sx126xmb2xxs {
	compatible = "semtech,sx1261-new";

	reg-mode = <SX126X_REG_MODE_DCDC>;
};
