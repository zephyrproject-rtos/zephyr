/*
 * Copyright (c) 2024 Semtech Corporation
 *
 * SPDX-License-Identifier: Apache-2.0
 */

#include "semtech_sx126xmb1xxs_common.dtsi"

lora_semtech_sx1268mb1xxs: &lora_semtech_sx126xmb1xxs {
	compatible = "semtech,sx1268-new";
};
