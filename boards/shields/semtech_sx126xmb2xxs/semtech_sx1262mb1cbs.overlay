/*
 * Copyright (c) 2024 Semtech Corporation
 *
 * SPDX-License-Identifier: Apache-2.0
 */

#include "semtech_sx126xmb1xxs_common.dtsi"

lora_semtech_sx1262mb1xxs: &lora_semtech_sx126xmb1xxs {
	compatible = "semtech,sx1262-new";

	dio3-as-tcxo-control;
	tcxo-wakeup-time = <8>;
};
