/*
 * Copyright (c) 2024 Semtech Corporation
 *
 * SPDX-License-Identifier: Apache-2.0
 */

#include "semtech_sx126xmb2xxs_common.dtsi"

lora_semtech_sx1262mb2xxs: &lora_semtech_sx126xmb2xxs {
	compatible = "semtech,sx1262-new";
};
