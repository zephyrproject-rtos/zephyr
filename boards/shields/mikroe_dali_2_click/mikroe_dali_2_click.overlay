/*
 * SPDX-License-Identifier: Apache-2.0
 * SPDX-FileCopyrightText: Copyright (c) 2026 sevenlab engineering GmbH
 */

/ {
	aliases {
		dali = &mikroe_dali2_click;
	};
};

/ {
	mikroe_dali2_click: dali2_click {
		compatible = "zephyr,dali-pwm";

		rx-gpios = <&mikrobus_header 7 GPIO_ACTIVE_HIGH>;
		tx-flank-shift-us = <(-46)>;
		rx-flank-shift-us = <(-68)>;

		/*
		 * Defaults, a board overlay can override them. counter, pwms,
		 * chan-id-rx and chan-id-tx are set by the board overlays.
		 */
		tx-rx-propagation-max-us = <2400>;
		rx-max-latency-us = <80>;
		rx-grey-area-us = <800>;
		status = "okay";
	};
};
