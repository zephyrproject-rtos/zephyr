/*
 * SPDX-License-Identifier: Apache-2.0
 * SPDX-FileCopyrightText: Copyright (c) 2026 sevenlab engineering GmbH
 */

#include <zephyr/dt-bindings/gpio/mikro-bus.h>

/ {
	aliases {
		dali = &mikroe_dali2_click;
	};
};

/ {
	mikroe_dali2_click: dali2_click {
		compatible = "zephyr,dali-pwm";

		rx-gpios = <&mikrobus_header MIKROBUS_INT GPIO_ACTIVE_HIGH>;
		tx-flank-shift-us = <(-46)>;
		rx-flank-shift-us = <(-68)>;

		/* override the following based on your board */
		counter-alarms = <&timer2 0>, <&timer2 1>;
		counter-alarm-names = "rx", "tx";
		pwms = <&pwm0 0 PWM_USEC(41) PWM_POLARITY_NORMAL>;
		status = "okay";
	};
};
