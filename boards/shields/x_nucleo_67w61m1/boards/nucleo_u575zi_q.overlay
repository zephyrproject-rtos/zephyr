/*
 * Copyright (c) 2026 STMicroelectronics
 *
 * SPDX-License-Identifier: Apache-2.0
 */

&arduino_spi {
	dmas = <&gpdma1 0 7 STM32_DMA_PERIPH_TX>,
	       <&gpdma1 1 6 STM32_DMA_PERIPH_RX>;
	dma-names = "tx", "rx";
};
