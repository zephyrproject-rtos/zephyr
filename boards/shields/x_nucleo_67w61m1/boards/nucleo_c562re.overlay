/*
 * Copyright (c) 2026 STMicroelectronics
 *
 * SPDX-License-Identifier: Apache-2.0
 */

&arduino_spi {
	dmas = <&lpdma1 5 STM32_DMA_PERIPH_TX>,
	       <&lpdma1 4 STM32_DMA_PERIPH_RX>;
	dma-names = "tx", "rx";
};

&lpdma1 {
	status = "okay";
};
