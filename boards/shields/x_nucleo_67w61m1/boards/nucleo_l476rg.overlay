/*
 * Copyright (c) 2026 STMicroelectronics
 *
 * SPDX-License-Identifier: Apache-2.0
 */

&arduino_spi {
	dmas = <&dma1 3 1 (STM32_DMA_PERIPH_TX | STM32_DMA_PRIORITY_HIGH)>,
	       <&dma1 2 1 (STM32_DMA_PERIPH_RX | STM32_DMA_PRIORITY_HIGH)>;
	dma-names = "tx", "rx";

	st67w611m1: st67w611m1@0 {
		spi-max-frequency = <DT_FREQ_M(20)>;
	};
};

&dma1 {
	status = "okay";
};
