/*
 * Copyright (c) 2023 Joseph Yates
 *
 * SPDX-License-Identifier: Apache-2.0
 */


&pinctrl {
	i2c1_default: i2c1_default {
		group1 {
			pinmux = <I2C1_SDA_P6>, <I2C1_SCL_P7>;
			input-enable;
			input-schmitt-enable;
			bias-pull-up;
		};
	};
};

&i2c1 {
	pinctrl-0 = <&i2c1_default>;
	pinctrl-names = "default";
	clock-frequency = <I2C_BITRATE_FAST>;
	status = "okay";
};
