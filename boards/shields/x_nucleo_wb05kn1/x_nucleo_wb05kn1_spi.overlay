/*
 * Copyright (c) 2024 STMicroelectronics
 *
 * SPDX-License-Identifier: Apache-2.0
 */

#include <zephyr/dt-bindings/gpio/arduino-header-r3.h>

/ {
	 chosen {
		 zephyr,bt-hci = &hci_spi;
	 };
};

&arduino_spi {
	cs-gpios = <&arduino_header ARDUINO_HEADER_R3_D10 GPIO_ACTIVE_LOW>;

	hci_spi: wb05n@0 {
		compatible = "st,hci-spi-v2";
		reg = <0>;
		reset-gpios = <&arduino_header ARDUINO_HEADER_R3_D7 GPIO_ACTIVE_LOW>;
		irq-gpios = <&arduino_header ARDUINO_HEADER_R3_A0
			     (GPIO_ACTIVE_HIGH | GPIO_PULL_DOWN)>;
		spi-cpol; /* CPOL=1 */
		spi-cpha; /* CPHA=1 */
		spi-hold-cs;
		spi-max-frequency = <DT_FREQ_M(8)>; /* the maximum supported SPI speed */
		reset-assert-duration-ms = <6>;
		status = "okay";
	};
};
