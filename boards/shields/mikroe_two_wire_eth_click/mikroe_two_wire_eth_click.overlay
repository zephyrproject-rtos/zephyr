/*
 * SPDX-FileCopyrightText: Copyright (c) 2026 Siemens AG
 * SPDX-License-Identifier: Apache-2.0
 */

&mikrobus_spi {
	status = "okay";

	eth_mikroe_two_wire_eth_click: lan865x@0 {
		compatible = "microchip,lan865x";
		status = "okay";
		reg = <0>;
		spi-cs-setup-delay-ns = <1000>;
		phy-handle = <&phy_mikroe_two_wire_eth_click>;

		int-gpios = <&mikrobus_header 7 GPIO_ACTIVE_LOW>;
		rst-gpios = <&mikrobus_header 1 GPIO_ACTIVE_LOW>;

		spi-max-frequency = <20000000>;

		mdio_mikroe_two_wire_eth_click: lan865x_mdio {
			compatible = "microchip,lan865x-mdio";
			status = "okay";
			#address-cells = <1>;
			#size-cells = <0>;

			phy_mikroe_two_wire_eth_click: ethernet-phy@0 {
				compatible = "microchip,t1s-phy";
				reg = <0x0>;
				status = "okay";

				plca-enable;
				plca-node-id = <1>;
				plca-node-count = <8>;
				plca-burst-count = <0x0>;
				plca-burst-timer = <0x80>;
				plca-to-timer = <0x20>;
			};
		};
	};
};
