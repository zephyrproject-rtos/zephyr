/*
 * Copyright (c) 2022 Panasonic Industrial Devices Europe GmbH
 * SPDX-License-Identifier: Apache-2.0
 */

#include <zephyr/dt-bindings/gpio/arduino-header-r3.h>

&arduino_i2c {
	status = "okay";
	amg88xx_amg88xx_grid_eye_eval_shield: amg88xx@68 {
		compatible = "panasonic,amg88xx";
		reg = <0x68>;
		int-gpios = <&arduino_header ARDUINO_HEADER_R3_D2 (GPIO_ACTIVE_LOW | GPIO_PULL_UP)>;
		status = "okay";
	};
};
