/*
 * Copyright (c) 2024 TOKITA Hiroshi <tokita.hiroshi@gmail.com>
 * SPDX-License-Identifier: Apache-2.0
 */

/* For convenience, we use the same definitions as LIS3DHTR as the default for this series. */

#include "seeed_grove_accel.overlay"
