/*
 * Copyright (c) 2019 Foundries.io
 *
 * SPDX-License-Identifier: Apache-2.0
 */

/*
 * WNC-M14A2A shield uses an odd UART available on *some* Arduino-R3-compatible
 * headers.  It needs to be defined individually.
 */

#include <zephyr/dt-bindings/gpio/arduino-header-r3.h>

&uart2 {
	current-speed = <115200>;
	hw-flow-control;
	status = "okay";

	wnc_m14a2a: wncm14a2a {
		status = "okay";
		compatible = "wnc,m14a2a";
		mdm-boot-mode-sel-gpios = <&arduino_header ARDUINO_HEADER_R3_D1 GPIO_ACTIVE_HIGH>;
		mdm-power-gpios = <&arduino_header ARDUINO_HEADER_R3_D2 GPIO_ACTIVE_LOW>;
		mdm-keep-awake-gpios = <&arduino_header ARDUINO_HEADER_R3_D6 GPIO_ACTIVE_HIGH>;
		mdm-reset-gpios = <&arduino_header ARDUINO_HEADER_R3_D8 GPIO_ACTIVE_HIGH>;
		mdm-shld-trans-ena-gpios = <&arduino_header ARDUINO_HEADER_R3_D9 GPIO_ACTIVE_HIGH>;
	};
};
