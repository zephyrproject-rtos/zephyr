/*
 * Copyright (c) 2024 Renesas Electronics Corporation
 * SPDX-License-Identifier: Apache-2.0
 */

&pmod_sd_shield {
	interrupt-names = "accs", "card", "dma-req", "sdio-int";
	interrupts = <60 12>, <61 12>, <62 12>, <63 12>;
	pinctrl-0 = <&sdhc1_default>;
};
