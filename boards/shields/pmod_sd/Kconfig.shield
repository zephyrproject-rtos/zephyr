## boards/shields/pmod_sd/Kconfig.shield
```kconfig
# Copyright (c) 2024 Renesas Electronics Corporation
# SPDX-License-Identifier: Apache-2.0

config SHIELD_PMOD_SD
	def_bool $(shields_list_contains,pmod_sd)
```

## boards/shields/rakwireless_rak13002/Kconfig.defconfig
```kconfig
# SPDX-License-Identifier: Apache-2.0
# Copyright (c) 2026 RAKwireless Technology Limited

if SHIELD_RAKWIRELESS_RAK13002

if !MCUBOOT

config GPIO
	default y

endif # !MCUBOOT

endif # SHIELD_RAKWIRELESS_RAK13002
```

## boards/shields/rakwireless_rak13002/Kconfig.shield
```kconfig
# SPDX-License-Identifier: Apache-2.0
# Copyright (c) 2026 RAKwireless Technology Limited

config SHIELD_RAKWIRELESS_RAK13002
	def_bool $(shields_list_contains,rakwireless_rak13002)
```

## boards/shields/rakwireless_rak19001/Kconfig.shield
```kconfig
# SPDX-License-Identifier: Apache-2.0
# Copyright (c) 2026 RAKwireless Technology Limited

config SHIELD_RAKWIRELESS_RAK19001
	def_bool $(shields_list_contains,rakwireless_rak19001)
```

## boards/shields/rakwireless_rak19002/Kconfig.defconfig
```kconfig
# SPDX-License-Identifier: Apache-2.0
# Copyright (c) 2026 RAKwireless Technology Limited

if SHIELD_RAKWIRELESS_RAK19002

if !MCUBOOT

config GPIO
	default y

config REGULATOR
	default y

endif # !MCUBOOT

endif # SHIELD_RAKWIRELESS_RAK19002
```

## boards/shields/rakwireless_rak19002/Kconfig.shield
```kconfig
# SPDX-License-Identifier: Apache-2.0
# Copyright (c) 2026 RAKwireless Technology Limited

config SHIELD_RAKWIRELESS_RAK19002
	bool

config SHIELD_RAKWIRELESS_RAK19002_SENSOR_A
	def_bool $(shields_list_contains,rakwireless_rak19002_sensor_a)
	select SHIELD_RAKWIRELESS_RAK19002

config SHIELD_RAKWIRELESS_RAK19002_SENSOR_B
	def_bool $(shields_list_contains,rakwireless_rak19002_sensor_b)
	select SHIELD_RAKWIRELESS_RAK19002

config SHIELD_RAKWIRELESS_RAK19002_SENSOR_C
	def_bool $(shields_list_contains,rakwireless_rak19002_sensor_c)
	select SHIELD_RAKWIRELESS_RAK19002

config SHIELD_RAKWIRELESS_RAK19002_SENSOR_D
	def_bool $(shields_list_contains,rakwireless_rak19002_sensor_d)
	select SHIELD_RAKWIRELESS_RAK19002

config SHIELD_RAKWIRELESS_RAK19002_SENSOR_E
	def_bool $(shields_list_contains,rakwireless_rak19002_sensor_e)
	select SHIELD_RAKWIRELESS_RAK19002

config SHIELD_RAKWIRELESS_RAK19002_SENSOR_F
	def_bool $(shields_list_contains,rakwireless_rak19002_sensor_f)
	select SHIELD_RAKWIRELESS_RAK19002
```

## boards/shields/rakwireless_rak1901/Kconfig.shield
```kconfig
# SPDX-License-Identifier: Apache-2.0
# Copyright (c) 2026 RAKwireless Technology Limited

config SHIELD_RAKWIRELESS_RAK1901
	def_bool $(shields_list_contains,rakwireless_rak1901)
```

## boards/shields/rakwireless_rak19010/Kconfig.defconfig
```kconfig
# SPDX-License-Identifier: Apache-2.0
# Copyright (c) 2026 RAKwireless Technology Limited

if SHIELD_RAKWIRELESS_RAK19010

if !MCUBOOT

config GPIO
	default y

endif # !MCUBOOT

endif # SHIELD_RAKWIRELESS_RAK19010
```

## boards/shields/rakwireless_rak19011/Kconfig.defconfig
```kconfig
# SPDX-License-Identifier: Apache-2.0
# Copyright (c) 2026 RAKwireless Technology Limited

if SHIELD_RAKWIRELESS_RAK19011

if !MCUBOOT

config GPIO
	default y

config INPUT
	default y

endif # !MCUBOOT

endif # SHIELD_RAKWIRELESS_RAK19011
```

## boards/shields/rakwireless_rak19012/Kconfig.shield
```kconfig
# SPDX-License-Identifier: Apache-2.0
# Copyright (c) 2026 RAKwireless Technology Limited

config SHIELD_RAKWIRELESS_RAK19012
	def_bool $(shields_list_contains,rakwireless_rak19012)
```

## boards/shields/rakwireless_rak19015/Kconfig.defconfig
```kconfig
# SPDX-License-Identifier: Apache-2.0
# Copyright (c) 2026 RAKwireless Technology Limited

if SHIELD_RAKWIRELESS_RAK19015

if !MCUBOOT

config GPIO
	default y

config LED
	default y

config ADC
	default y

config SENSOR
	default y

config FUEL_GAUGE
	default y

endif # !MCUBOOT

endif # SHIELD_RAKWIRELESS_RAK19015
```

## boards/shields/rakwireless_rak19017/Kconfig.defconfig
```kconfig
# SPDX-License-Identifier: Apache-2.0
# Copyright (c) 2026 RAKwireless Technology Limited

if SHIELD_RAKWIRELESS_RAK19017

if !MCUBOOT

config GPIO
	default y

config LED
	default y

endif # !MCUBOOT

endif # SHIELD_RAKWIRELESS_RAK19017
```

## boards/shields/rakwireless_rak1902/Kconfig.defconfig
```kconfig
# SPDX-License-Identifier: Apache-2.0
# Copyright (c) 2026 RAKwireless Technology Limited

if SHIELD_RAKWIRELESS_RAK1902

if !MCUBOOT

config I2C
	default y

config SENSOR
	default y

endif # !MCUBOOT

endif # SHIELD_RAKWIRELESS_RAK1902
```

## boards/shields/rakwireless_rak1905/Kconfig.defconfig
```kconfig
# SPDX-License-Identifier: Apache-2.0
# Copyright (c) 2026 RAKwireless Technology Limited

if SHIELD_RAKWIRELESS_RAK1905

if !MCUBOOT

config GPIO
	default y

config I2C
	default y

config SENSOR
	default y

endif # !MCUBOOT

endif # SHIELD_RAKWIRELESS_RAK1905
```

## boards/shields/rakwireless_rak1905/Kconfig.shield
```kconfig
# SPDX-License-Identifier: Apache-2.0
# Copyright (c) 2026 RAKwireless Technology Limited

config SHIELD_RAKWIRELESS_RAK1905
	bool

config SHIELD_RAKWIRELESS_RAK1905_SENSOR_A
	def_bool $(shields_list_contains,rakwireless_rak1905_sensor_a)
	select SHIELD_RAKWIRELESS_RAK1905

config SHIELD_RAKWIRELESS_RAK1905_SENSOR_B
	def_bool $(shields_list_contains,rakwireless_rak1905_sensor_b)
	select SHIELD_RAKWIRELESS_RAK1905

config SHIELD_RAKWIRELESS_RAK1905_SENSOR_C
	def_bool $(shields_list_contains,rakwireless_rak1905_sensor_c)
	select SHIELD_RAKWIRELESS_RAK1905

config SHIELD_RAKWIRELESS_RAK1905_SENSOR_D
	def_bool $(shields_list_contains,rakwireless_rak1905_sensor_d)
	select SHIELD_RAKWIRELESS_RAK1905

config SHIELD_RAKWIRELESS_RAK1905_SENSOR_E
	def_bool $(shields_list_contains,rakwireless_rak1905_sensor_e)
	select SHIELD_RAKWIRELESS_RAK1905

config SHIELD_RAKWIRELESS_RAK1905_SENSOR_F
	def_bool $(shields_list_contains,rakwireless_rak1905_sensor_f)
	select SHIELD_RAKWIRELESS_RAK1905
```

## boards/shields/rakwireless_rak5802/Kconfig.defconfig
```kconfig
# SPDX-License-Identifier: Apache-2.0
# Copyright (c) 2026 RAKwireless Technology Limited

if SHIELD_RAKWIRELESS_RAK5802

if !MCUBOOT

config GPIO
	default y

config SERIAL
	default y

config MODBUS_SERIAL
	default y

endif # !MCUBOOT

endif # SHIELD_RAKWIRELESS_RAK5802
```

## boards/shields/raspberry_pi_camera_module_2/Kconfig.shield
```kconfig
# Copyright (c) 2025 tinyVision.ai Inc.
# SPDX-License-Identifier: Apache-2.0

config SHIELD_RASPBERRY_PI_CAMERA_MODULE_2
	def_bool $(shields_list_contains,raspberry_pi_camera_module_2)
```

## boards/shields/raspberry_pi_camera_module_2/boards/nucleo_n657x0_q_stm32n657xx_sb.conf
```kconfig
CONFIG_VIDEO_STM32_DCMIPP_SENSOR_PIXEL_FORMAT="pBAA"
CONFIG_VIDEO_STM32_DCMIPP_SENSOR_WIDTH=3280
CONFIG_VIDEO_STM32_DCMIPP_SENSOR_HEIGHT=2464
```

## boards/shields/renesas_aik_ov2640_cam/Kconfig.shield
```kconfig
# Copyright (c) 2026 Renesas Electronics Corporation
# SPDX-License-Identifier: Apache-2.0

config SHIELD_RENESAS_AIK_OV2640_CAM
	def_bool $(shields_list_contains,renesas_aik_ov2640_cam)
```

## boards/shields/renesas_us159_da14531evz/Kconfig.shield
```kconfig
# Copyright (c) 2024 Renesas Electronics Corporation
# SPDX-License-Identifier: Apache-2.0

config SHIELD_RENESAS_US159_DA14531EVZ
	def_bool $(shields_list_contains,renesas_us159_da14531evz)
```

## boards/shields/reyax_lora/Kconfig.shield
```kconfig
# Copyright (c) 2024 David Ullmann
# SPDX-License-Identifier: Apache-2.0

config SHIELD_REYAX_LORA
	def_bool $(shields_list_contains,reyax_lora)
```

## boards/shields/reyax_lora/boards/cy8ckit_062s4.conf
```kconfig
# Copyright (c) 2024 David Ullmann
# SPDX-License-Identifier: Apache-2.0

CONFIG_LORA=y
CONFIG_LORA_RYLRXXX=y
CONFIG_UART_INTERRUPT_DRIVEN=y
```

## boards/shields/rk043fn02h_ct/Kconfig.defconfig
```kconfig
# Copyright 2024 NXP
# SPDX-License-Identifier: Apache-2.0

if SHIELD_RK043FN02H_CT

if LVGL

config INPUT
	default y

# LVGL should allocate buffers equal to size of display
config LV_Z_VDB_SIZE
	default 100

# Enable double buffering
config LV_Z_DOUBLE_VDB
	default y

# Force full refresh. This prevents memory copy associated with partial
# display refreshes, which is not necessary for the eLCDIF driver
config LV_Z_FULL_REFRESH
	default y

config LV_Z_BITS_PER_PIXEL
	default 16

config LV_DPI_DEF
	default 128

# Use offloaded render thread
config LV_Z_FLUSH_THREAD
	default y

choice LV_COLOR_DEPTH
	default LV_COLOR_DEPTH_16
endchoice

# Force display buffers to be aligned to cache line size (32 bytes)
config LV_Z_VDB_ALIGN
	default 32

endif # LVGL

endif # SHIELD_RK043FN02H_CT
```

## boards/shields/rk043fn02h_ct/Kconfig.shield
```kconfig
# Copyright 2024 NXP
# SPDX-License-Identifier: Apache-2.0

config SHIELD_RK043FN02H_CT
	def_bool $(shields_list_contains,rk043fn02h_ct)
```

## boards/shields/rk043fn66hs_ctg/Kconfig.shield
```kconfig
# Copyright 2024 NXP
# SPDX-License-Identifier: Apache-2.0

config SHIELD_RK043FN66HS_CTG
	def_bool $(shields_list_contains,rk043fn66hs_ctg)
```
