/*
 * Copyright (c) 2024 Renesas Electronics Corporation
 * SPDX-License-Identifier: Apache-2.0
 */

/ {
	aliases {
		sdhc0 = &pmod_sd_shield;
	};
};

&pmod_sd_shield {
	pinctrl-0 = <&sdhc0_default>;
	pinctrl-names = "default";
	status = "okay";

	sdmmc {
		compatible = "zephyr,sdmmc-disk";
		disk-name = "SD";
		status = "okay";
	};
};
