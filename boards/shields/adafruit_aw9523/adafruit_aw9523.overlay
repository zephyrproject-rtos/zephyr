/*
 * Copyright (c) 2024 TOKITA Hiroshi
 *
 * SPDX-License-Identifier: Apache-2.0
 */

&zephyr_i2c {
	status = "okay";

	adafruit_aw9523: aw9523b@58 {
		compatible = "awinic,aw9523b";
		reg = <0x58>;
		status = "okay";

		adafruit_aw9523_gpio: aw9523b-gpio {
			compatible = "awinic,aw9523b-gpio";
			gpio-controller;
			#gpio-cells = <2>;
			status = "okay";
		};
	};
};
