## boards/shields/v2c_daplink/Kconfig.defconfig
```kconfig
# Copyright (c) 2020 Henrik Brix Andersen <henrik@brixandersen.dk>
# SPDX-License-Identifier: Apache-2.0

if SHIELD_V2C_DAPLINK || SHIELD_V2C_DAPLINK_CFG

if BOARD_ARTY_A7_ARM_DESIGNSTART_M1 || BOARD_ARTY_A7_ARM_DESIGNSTART_M3

if DISK_ACCESS

config SPI
	default y

config DISK_DRIVER_SDMMC
	default y

endif # DISK_ACCESS

endif # BOARD_ARTY_A7_ARM_DESIGNSTART_M1 || BOARD_ARTY_A7_ARM_DESIGNSTART_M3

endif # SHIELD_V2C_DAPLINK || SHIELD_V2C_DAPLINK_CFG
```

## boards/shields/v2c_daplink/Kconfig.shield
```kconfig
# Copyright (c) 2020 Henrik Brix Andersen <henrik@brixandersen.dk>
# SPDX-License-Identifier: Apache-2.0

config SHIELD_V2C_DAPLINK
	def_bool $(shields_list_contains,v2c_daplink)

config SHIELD_V2C_DAPLINK_CFG
	def_bool $(shields_list_contains,v2c_daplink_cfg)
```

## boards/shields/waveshare_at24/Kconfig.defconfig
```kconfig
# Copyright (c) 2020 Stefano Manni
# SPDX-License-Identifier: Apache-2.0

if SHIELD_WAVESHARE_AT24

config I2C
	default y

config EEPROM_AT24
	default y

endif # SHIELD_WAVESHARE_AT24
```

## boards/shields/waveshare_at24/Kconfig.shield
```kconfig
# Copyright (c) 2020 Stefano Manni
# SPDX-License-Identifier: Apache-2.0

config SHIELD_WAVESHARE_AT24
	def_bool $(shields_list_contains,waveshare_at24)
```

## boards/shields/waveshare_dsi_lcd/Kconfig.shield
```kconfig
#
# Copyright 2025 NXP
#
# SPDX-License-Identifier: Apache-2.0
#

config SHIELD_WAVESHARE_7INCH_DSI_LCD_C
	def_bool $(shields_list_contains,waveshare_7inch_dsi_lcd_c)
```

## boards/shields/waveshare_epaper/Kconfig.defconfig
```kconfig
#
# Copyright (c) 2019, PHYTEC Messtechnik GmbH
# Copyright (c) 2019 Linaro Limited
#
# SPDX-License-Identifier: Apache-2.0
#

if SHIELD_WAVESHARE_EPAPER_GDEH029A1 || SHIELD_WAVESHARE_EPAPER_GDEH0213B1 || SHIELD_WAVESHARE_EPAPER_GDEH0213B72 || SHIELD_WAVESHARE_EPAPER_GDEW075T7 || SHIELD_WAVESHARE_EPAPER_GDEH0154A07 || SHIELD_WAVESHARE_EPAPER_GDEW042T2


if DISPLAY

config SPI
	default y

config SSD16XX
	default y if SHIELD_WAVESHARE_EPAPER_GDEH029A1
	default y if SHIELD_WAVESHARE_EPAPER_GDEH0213B1
	default y if SHIELD_WAVESHARE_EPAPER_GDEH0213B72
	default y if SHIELD_WAVESHARE_EPAPER_GDEH0154A07

config UC81XX
	default y if SHIELD_WAVESHARE_EPAPER_GDEW075T7
	default y if SHIELD_WAVESHARE_EPAPER_GDEW042T2

if LVGL

config LV_Z_VDB_SIZE
	default 16 if SHIELD_WAVESHARE_EPAPER_GDEW075T7
	default 16

config LV_Z_DPI
	default 188 if SHIELD_WAVESHARE_EPAPER_GDEH0154A07
	default 120 if SHIELD_WAVESHARE_EPAPER_GDEW042T2
	default 130

choice LV_COLOR_DEPTH
	default LV_COLOR_DEPTH_1
endchoice

config LV_Z_BITS_PER_PIXEL
	default 1

endif # LVGL

endif # DISPLAY

endif # SHIELD_WAVESHARE_EPAPER_GDEH02
```

## boards/shields/waveshare_epaper/Kconfig.shield
```kconfig
# Copyright (c) 2019 Linaro Limited
# SPDX-License-Identifier: Apache-2.0

config SHIELD_WAVESHARE_EPAPER_GDEH029A1
	def_bool $(shields_list_contains,waveshare_epaper_gdeh029a1)

config SHIELD_WAVESHARE_EPAPER_GDEH0213B1
	def_bool $(shields_list_contains,waveshare_epaper_gdeh0213b1)

config SHIELD_WAVESHARE_EPAPER_GDEH0213B72
	def_bool $(shields_list_contains,waveshare_epaper_gdeh0213b72)

config SHIELD_WAVESHARE_EPAPER_GDEW075T7
	def_bool $(shields_list_contains,waveshare_epaper_gdew075t7)

config SHIELD_WAVESHARE_EPAPER_GDEH0154A07
	def_bool $(shields_list_contains,waveshare_epaper_gdeh0154a07)

config SHIELD_WAVESHARE_EPAPER_GDEW042T2
	def_bool $(shields_list_contains,waveshare_epaper_gdew042t2)

config SHIELD_WAVESHARE_EPAPER_GDEW042T2_P
	def_bool $(shields_list_contains,waveshare_epaper_gdew042t2-p)
```

## boards/shields/waveshare_pico_lcd_1_14/Kconfig.defconfig
```kconfig
# Copyright (c) 2025 TOKITA Hiroshi
# SPDX-License-Identifier: Apache-2.0

if SHIELD_WAVESHARE_PICO_LCD_1_14 || SHIELD_WAVESHARE_PICO_LCD_1_14_DISPLAY

if DISPLAY

choice ST7789V_PIXEL_FORMAT
	default ST7789V_RGB565
endchoice

if LVGL

config LV_DPI_DEF
	default 242

config LV_Z_BITS_PER_PIXEL
	default 16

choice LV_COLOR_DEPTH
	default LV_COLOR_DEPTH_16
endchoice

configdefault LV_COLOR_16_SWAP
	default y

endif # LVGL

endif # DISPLAY

endif # SHIELD_WAVESHARE_PICO_LCD_1_14
```

## boards/shields/waveshare_pico_lcd_1_14/Kconfig.shield
```kconfig
# Copyright (c) 2025 TOKITA Hiroshi
# SPDX-License-Identifier: Apache-2.0

config SHIELD_WAVESHARE_PICO_LCD_1_14
	def_bool $(shields_list_contains,waveshare_pico_lcd_1_14)

config SHIELD_WAVESHARE_PICO_LCD_1_14_DISPLAY
	def_bool $(shields_list_contains,waveshare_pico_lcd_1_14_display)

config SHIELD_WAVESHARE_PICO_LCD_1_14_BUTTONS
	def_bool $(shields_list_contains,waveshare_pico_lcd_1_14_buttons)
```

## boards/shields/waveshare_pico_oled_1_3/Kconfig.shield
```kconfig
# Copyright (c) 2025 TOKITA Hiroshi
# SPDX-License-Identifier: Apache-2.0

config SHIELD_WAVESHARE_PICO_OLED_1_3
	def_bool $(shields_list_contains,waveshare_pico_oled_1_3)

config SHIELD_WAVESHARE_PICO_OLED_1_3_DISPLAY
	def_bool $(shields_list_contains,waveshare_pico_oled_1_3_display)

config SHIELD_WAVESHARE_PICO_OLED_1_3_BUTTONS
	def_bool $(shields_list_contains,waveshare_pico_oled_1_3_buttons)
```

## boards/shields/waveshare_rs485_can/Kconfig.shield
```kconfig
# Copyright (c) 2023 Alexander Kozhinov
#
# SPDX-License-Identifier: Apache-2.0

config SHIELD_WAVESHARE_RS485_CAN
	def_bool $(shields_list_contains,waveshare_rs485_can)
```

## boards/shields/waveshare_ups/Kconfig.shield
```kconfig
# Copyright (c) 2023 Joseph Yates
# SPDX-License-Identifier: Apache-2.0

config SHIELD_WAVESHARE_PICO_UPS_B
	def_bool $(shields_list_contains,waveshare_pico_ups_b)
```

## boards/shields/weact_ov2640_cam_module/Kconfig.shield
```kconfig
# Copyright (c) 2024 Charles Dias
# SPDX-License-Identifier: Apache-2.0

config SHIELD_WEACT_OV2640_CAM_MODULE
	def_bool $(shields_list_contains,weact_ov2640_cam_module)
```

## boards/shields/weact_ov2640_cam_module/boards/mini_stm32h743.conf
```kconfig
#
# Copyright (c) 2024 Charles Dias <charlesdias.cd@outlook.com>
#
# SPDX-License-Identifier: Apache-2.0
#

CONFIG_VIDEO_HFLIP=y
CONFIG_VIDEO_VFLIP=y
```

## boards/shields/weact_ov5640_cam_module/Kconfig.shield
```kconfig
# Copyright (c) 2024 Charles Dias
# SPDX-License-Identifier: Apache-2.0

config SHIELD_WEACT_OV5640_CAM_MODULE
	def_bool $(shields_list_contains,weact_ov5640_cam_module)
```

## boards/shields/wiznet_w5500/Kconfig.shield
```kconfig
# Copyright (c) 2026 Krisztian Szilvasi
# SPDX-License-Identifier: Apache-2.0

config SHIELD_WIZNET_W5500
	def_bool $(shields_list_contains,wiznet_w5500)
```

## boards/shields/wiznet_wiz550io/Kconfig.defconfig
```kconfig
# Copyright (c) 2024 Grant Ramsay
# SPDX-License-Identifier: Apache-2.0

if SHIELD_WIZNET_WIZ550IO

if NETWORKING

config NET_L2_ETHERNET
	default y

endif # NETWORKING

endif # SHIELD_WIZNET_WIZ550IO
```

## boards/shields/wiznet_wiz550io/Kconfig.shield
```kconfig
# Copyright (c) 2024 Grant Ramsay
# SPDX-License-Identifier: Apache-2.0

config SHIELD_WIZNET_WIZ550IO
	def_bool $(shields_list_contains,wiznet_wiz550io)

if SHIELD_WIZNET_WIZ550IO

config WIZ550IO_PRE_W5500_INIT_PRIORITY
	int "WIZ550io pre W5500 init priority"
	default 79
	help
	  Must occur before W5500 init.
	  The default is ETH_INIT_PRIORITY - 1.

config WIZ550IO_POST_NET_IF_INIT_PRIORITY
	int "WIZ550io post net interface init priority"
	default 91
	help
	  Must occur after net interface init.
	  The default is CONFIG_NET_INIT_PRIO + 1.

endif # SHIELD_WIZNET_WIZ550IO
```

## boards/shields/wiznet_wiz550io/dts/bindings/wiznet,wiz550io.yaml
```yaml
# Copyright (c) 2024 Grant Ramsay
# SPDX-License-Identifier: Apache-2.0

description: |
  WIZnet WIZ550io - W5500 Ethernet controller.
  WIZ550io contains a W5500 Ethernet controller with an extra PIC12F519 MCU.
  The PIC12F519 MCU initialises the W5500 with a unique MAC address after a
  GPIO reset. The unique MAC address is used if neither
  "zephyr,random-mac-address" or "local-mac-address" properties are
  configured in the corresponding W5500 device.

compatible: "wiznet,wiz550io"

include: base.yaml

properties:
  wiznet,w5500:
    type: phandle
    required: true
    description: The corresponding W5500 device within the WIZ550io module
  reset-gpios:
    type: phandle-array
    required: true
    description: |
      Reset pin (active low output).
      The reset-gpios property must be assigned to WIZ550io rather than
      the W5500 device. The hardware reset pin is required for WIZ550io,
      as a software reset of W5500 will clear the MAC address assigned
      by the PIC12F519.
  ready-gpios:
    type: phandle-array
    description: |
      Ready pin (active high input).
      Optional GPIO pin that signals when the PIC12F519 has finished
      configuring the W5500. Enabling this reduces the 150ms delay
      after GPIO reset.
```

## boards/shields/wnc_m14a2a/Kconfig.defconfig
```kconfig
# Copyright (c) 2019 Linaro Limited
# SPDX-License-Identifier: Apache-2.0

if SHIELD_WNC_M14A2A

if NETWORKING

config MODEM
	default y

config MODEM_SHELL
	default y

config MODEM_WNCM14A2A
	default y

config UART_INTERRUPT_DRIVEN
	default y

# extend retry timing to 20 seconds for LTE/LTE-M
config COAP_INIT_ACK_TIMEOUT_MS
	default 20000

endif # NETWORKING

endif # SHIELD_WNC_M14A2A
```

## boards/shields/wnc_m14a2a/Kconfig.shield
```kconfig
# Copyright (c) 2019 Linaro Limited
# SPDX-License-Identifier: Apache-2.0

config SHIELD_WNC_M14A2A
	def_bool $(shields_list_contains,wnc_m14a2a)
```
