/*
 * Copyright (c) 2019 Karsten Koenig
 *
 * SPDX-License-Identifier: Apache-2.0
 */

&spi1 {
	status = "okay";
	cs-gpios = <&gpio1 3 0>;
	sck-pin = <36>;
	mosi-pin = <37>;
	miso-pin = <38>;

	mcp2515@0 {
		compatible = "microchip,mcp2515";
		spi-max-frequency = <1000000>;
		int-gpios = <&gpio1 7 GPIO_INT_ACTIVE_LOW>;
		status = "okay";
		label = "CAN_1";
		reg = <0>;
		bus-speed = <125000>;
		osc-freq = <24000000>;
		sjw = <1>;
		prop-seg = <2>;
		phase-seg1 = <7>;
		phase-seg2 = <6>;
		#address-cells = <1>;
		#size-cells = <0>;
	};
};
