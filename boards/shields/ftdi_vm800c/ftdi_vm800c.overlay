/*
 * Copyright (c) 2021 Hubert Miś <hubert.mis@gmail.com>
 *
 * SPDX-License-Identifier: Apache-2.0
 */

#include <zephyr/dt-bindings/gpio/arduino-header-r3.h>

&arduino_spi {
	status = "okay";

	cs-gpios = <&arduino_header ARDUINO_HEADER_R3_D10
		    (GPIO_PULL_UP | GPIO_ACTIVE_LOW)>;

	ft800_ftdi_vm800c: ft800@0 {
		compatible = "ftdi,ft800";
		reg = <0x0>;
		spi-max-frequency = <8000000>;
		irq-gpios = <&arduino_header ARDUINO_HEADER_R3_D2 GPIO_ACTIVE_LOW>;

		pclk = <5>;
		pclk-pol = <1>;
		cspread = <1>;
		swizzle = <0>;
		vsize = <272>;
		voffset = <12>;
		vcycle = <292>;
		vsync0 = <0>;
		vsync1 = <10>;
		hsize = <480>;
		hoffset = <43>;
		hcycle = <548>;
		hsync0 = <0>;
		hsync1 = <41>;

		status = "okay";
	};
};
