## boards/shields/ftdi_vm800c/Kconfig.shield
```kconfig
# Copyright (c) 2021 Hubert Miś <hubert.mis@gmail.com>
# SPDX-License-Identifier: Apache-2.0

config SHIELD_FTDI_VM800C
	def_bool $(shields_list_contains,ftdi_vm800c)
```

## boards/shields/g1120b0mipi/Kconfig.shield
```kconfig
# Copyright 2023 NXP
# SPDX-License-Identifier: Apache-2.0

config SHIELD_G1120B0MIPI
	def_bool $(shields_list_contains,g1120b0mipi)
```

## boards/shields/g1120b0mipi/boards/mimxrt595_evk_mimxrt595s_cm33.conf
```kconfig
# Enable DMA, so that DSI MCUX will use SMARTDMA
CONFIG_DMA=y
CONFIG_MIPI_DSI_MCUX_2L_SWAP16=y
CONFIG_LV_COLOR_16_SWAP=n
```

## boards/shields/g1120b0mipi/boards/mimxrt700_evk_mimxrt798s_cm33_cpu0.conf
```kconfig
CONFIG_REGULATOR=y
CONFIG_DCACHE=n
CONFIG_MIPI_DSI_MCUX_2L_SWAP16=y
CONFIG_LV_COLOR_16_SWAP=n
```

## boards/shields/giga_display_shield/boards/arduino_giga_r1_m7.conf
```kconfig
# Copyright (c) 2025 Arduino SA
# SPDX-License-Identifier: Apache-2.0

CONFIG_MEMC=y
CONFIG_STM32_LTDC_RGB565=y
CONFIG_HEAP_MEM_POOL_SIZE=65536
CONFIG_DISPLAY_ST7701_INIT_PRIORITY=87
CONFIG_STM32_LTDC_DISABLE_FMC_BANK1=y
CONFIG_INPUT_GT911_INTERRUPT=y
```

## boards/shields/huatian_mt9m114/Kconfig.shield
```kconfig
# Copyright 2024 NXP
# SPDX-License-Identifier: Apache-2.0

config SHIELD_HUATIAN_MT9M114
	def_bool $(shields_list_contains,huatian_mt9m114)
```

## boards/shields/ili9340_generic/Kconfig.shield
```kconfig
# Copyright (c) 2019 Linaro Limited
# SPDX-License-Identifier: Apache-2.0

config SHIELD_ILI9140_ADAFRUIT_2_8_TFT_TOUCH_V2
	def_bool $(shields_list_contains,ili9340_adafruit_2_8_tft_touch_v2)
```

## boards/shields/inventek_eswifi/Kconfig.defconfig
```kconfig
# Copyright (c) 2020 ATL Electronics
# SPDX-License-Identifier: Apache-2.0

if SHIELD_INVENTEK_ESWIFI || \
	SHIELD_INVENTEK_ESWIFI_ARDUINO_SPI || \
	SHIELD_INVENTEK_ESWIFI_ARDUINO_UART

if NETWORKING

orsource "boards/*.defconfig"

choice WIFI_ESWIFI_BUS
	default WIFI_ESWIFI_BUS_SPI if SHIELD_INVENTEK_ESWIFI_ARDUINO_SPI
	default WIFI_ESWIFI_BUS_UART if SHIELD_INVENTEK_ESWIFI_ARDUINO_UART
	depends on WIFI_ESWIFI
endchoice

endif	# NETWORKING

endif	# SHIELD_INVENTEK_ESWIFI || \
	# SHIELD_INVENTEK_ESWIFI_ARDUINO_SPI || \
	# SHIELD_INVENTEK_ESWIFI_ARDUINO_UART
```

## boards/shields/inventek_eswifi/Kconfig.shield
```kconfig
# Copyright (c) 2020 ATL Electronics
# SPDX-License-Identifier: Apache-2.0

config SHIELD_INVENTEK_ESWIFI
	def_bool $(shields_list_contains,inventek_eswifi)

config SHIELD_INVENTEK_ESWIFI_ARDUINO_SPI
	def_bool $(shields_list_contains,inventek_eswifi_arduino_spi)

config SHIELD_INVENTEK_ESWIFI_ARDUINO_UART
	def_bool $(shields_list_contains,inventek_eswifi_arduino_uart)
```

## boards/shields/lcd_par_s035/Kconfig.defconfig
```kconfig
# Copyright 2024 NXP
# SPDX-License-Identifier: Apache-2.0

if SHIELD_LCD_PAR_S035
if LVGL

# Enable double buffering
config LV_Z_DOUBLE_VDB
	default y

config LV_Z_BITS_PER_PIXEL
	default 16

choice LV_COLOR_DEPTH
	default LV_COLOR_DEPTH_16
endchoice

# VDB size is 10% of the full screen size
config LV_Z_VDB_SIZE
	default 10

# Configure LVGL to use touchscreen
config INPUT
	default y

config INPUT_GT911_INTERRUPT
	default y

endif # LVGL

if INPUT

# GT911 driver drives reset pin low, so it needs to initialize before
# the display driver but after the MIPI DBI driver
config INPUT_INIT_PRIORITY
	default 82

endif # INPUT

endif # SHIELD_LCD_PAR_S035
```

## boards/shields/lcd_par_s035/Kconfig.shield
```kconfig
# Copyright 2024 NXP
# SPDX-License-Identifier: Apache-2.0

config SHIELD_LCD_PAR_S035
	def_bool $(shields_list_contains,lcd_par_s035_spi) ||\
		$(shields_list_contains,lcd_par_s035_8080)

config SHIELD_LCD_PAR_S035_INIT_PRIORITY
	int "LCD_PAR_S035 shield init priority"
	default 85
	depends on SHIELD_LCD_PAR_S035
	help
	  SYSINIT() priority to initialize the shield
```

## boards/shields/link_board_can/Kconfig.defconfig
```kconfig
# Copyright (c) 2019 Linaro Limited
# SPDX-License-Identifier: Apache-2.0

if SHIELD_LINK_BOARD_CAN

if NETWORKING

config SPI
	default y

config CAN_MCP2515
	default y

rsource "boards/*.defconfig"

endif # NETWORKING

endif # SHIELD_LINK_BOARD_CAN
```

## boards/shields/link_board_eth/Kconfig.shield
```kconfig
# Copyright (c) 2019 Linaro Limited
# SPDX-License-Identifier: Apache-2.0

config SHIELD_LINK_BOARD_ETH
	def_bool $(shields_list_contains,link_board_eth)
```

## boards/shields/lmp90100_evb/Kconfig.defconfig
```kconfig
# Copyright (c) 2019 Vestas Wind Systems A/S
# SPDX-License-Identifier: Apache-2.0

if SHIELD_LMP90100_EVB

if ADC

config ADC_LMP90XXX_GPIO
	default y

config ADC_INIT_PRIORITY
	default 80

endif # ADC

endif # SHIELD_LMP90100_EVB
```

## boards/shields/lmp90100_evb/Kconfig.shield
```kconfig
# Copyright (c) 2019 Vestas Wind Systems A/S
# SPDX-License-Identifier: Apache-2.0

config SHIELD_LMP90100_EVB
	def_bool $(shields_list_contains,lmp90100_evb)
```

## boards/shields/ls0xx_generic/Kconfig.defconfig
```kconfig
# Copyright (c) 2020 Rohit Gujarathi
# SPDX-License-Identifier: Apache-2.0

if SHIELD_LS013B7DH03

if DISPLAY

if LVGL

config LV_Z_VDB_SIZE
	default 16

config LV_DPI_DEF
	default 150

config LV_Z_BITS_PER_PIXEL
	default 1

choice LV_COLOR_DEPTH
	default LV_COLOR_DEPTH_1
endchoice

endif # LVGL

endif # DISPLAY

endif # SHIELD_LS013B7DH03
```

## boards/shields/ls0xx_generic/Kconfig.shield
```kconfig
# Copyright (c) 2020 Rohit Gujarathi
# SPDX-License-Identifier: Apache-2.0

config SHIELD_LS013B7DH03
	def_bool $(shields_list_contains,ls013b7dh03)
```

## boards/shields/m5stack_cardputer/Kconfig.shield
```kconfig
# Copyright (c) 2025 Linaro Limited
# SPDX-License-Identifier: Apache-2.0

config SHIELD_M5STACK_CARDPUTER
	def_bool $(shields_list_contains,m5stack_cardputer)
```

## boards/shields/m5stack_core2_ext/Kconfig.shield
```kconfig
# Copyright (c) 2023 Martin Kiepfer <mrmarteng@teleschirm.org>
# SPDX-License-Identifier: Apache-2.0

config SHIELD_M5STACK_CORE2_EXT
	def_bool $(shields_list_contains,m5stack_core2_ext)
```
