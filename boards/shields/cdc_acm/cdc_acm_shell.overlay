/*
 * Copyright (c) 2021 Nordic Semiconductor ASA
 *
 * SPDX-License-Identifier: Apache-2.0
 */

/ {
	chosen {
		zephyr,shell-uart = &shell_cdc_acm_uart0;
	};
};

&zephyr_udc0 {
	shell_cdc_acm_uart0: shell_cdc_acm_uart0 {
		compatible = "zephyr,cdc-acm-uart";
		label = "SHELL_CDC_ACM_0";
	};
};
