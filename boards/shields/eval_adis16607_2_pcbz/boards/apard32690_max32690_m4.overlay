/*
 * Copyright (c) 2026 Analog Devices, Inc.
 *
 * SPDX-License-Identifier: Apache-2.0
 */

#include <zephyr/dt-bindings/gpio/arduino-header-r3.h>
#include <zephyr/dt-bindings/gpio/adi-max32-gpio.h>

/ {
	aliases {
		imu0 = &adis16607_eval_adis16607_2_pcbz;
		6dof-motion-drdy0 = &adis16607_eval_adis16607_2_pcbz;
	};
};

&arduino_spi {
	adis16607_eval_adis16607_2_pcbz: adis16607@0 {
		drdy-gpios = <&arduino_header ARDUINO_HEADER_R3_D2
			      (GPIO_ACTIVE_HIGH | MAX32_GPIO_VSEL_VDDIOH)>;
		reset-gpios = <&arduino_header ARDUINO_HEADER_R3_D4
			       (GPIO_ACTIVE_LOW | MAX32_GPIO_VSEL_VDDIOH)>;
	};
};
