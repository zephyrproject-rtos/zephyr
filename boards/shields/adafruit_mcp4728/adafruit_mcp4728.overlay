/*
 * Copyright (c) 2025 Jonas Berg
 *
 * SPDX-License-Identifier: Apache-2.0
 */

/ {
	zephyr,user {
		dac = <&dac_adafruit_mcp4728>;
		dac-channel-id = <0>;
		dac-resolution = <12>;
	};
};

&zephyr_i2c {
	status = "okay";

	dac_adafruit_mcp4728: dac@60 {
		status = "okay";
		compatible = "microchip,mcp4728";
		reg = <0x60>;
		#io-channel-cells = <1>;
		voltage-reference = <01 01 01 01>; /* Internal reference (2.048V) */
		power-down-mode = <00 00 00 00>; /* Normal mode */
	};
};
