/*
 * Copyright (c) 2025 Jonas Berg
 *
 * SPDX-License-Identifier: Apache-2.0
 */

/ {
	aliases {
		pressure-sensor = &adafruit_lps22;
	};
};

&zephyr_i2c {
	status = "okay";

	adafruit_lps22: lps22@5d {
		compatible = "st,lps22hb-press";
		status = "okay";
		reg = <0x5d>;
	};
};
