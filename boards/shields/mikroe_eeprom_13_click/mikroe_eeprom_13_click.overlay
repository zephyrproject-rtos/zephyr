/*
 * SPDX-FileCopyrightText: Copyright (c) 2026 Navimatix GmbH
 * SPDX-FileCopyrightText: Copyright (c) 2026 TiaC Systems
 *
 * SPDX-License-Identifier: Apache-2.0
 */

#include <mem.h>
#include <zephyr/dt-bindings/gpio/gpio.h>
#include <zephyr/dt-bindings/i2c/i2c.h>

/ {
	aliases {
		eeprom-0 = &i2c_mikroe_eeprom_13_click;
	};
};

&mikrobus_i2c {
	status = "okay";
	clock-frequency = <I2C_BITRATE_FAST>;

	i2c_mikroe_eeprom_13_click: eeprom@50 {
		compatible = "st,m24m01", "st,m24xxx", "atmel,at24";
		reg = <0x50>;
		size = <DT_SIZE_K(128)>;
		pagesize = <256>;
		address-width = <16>;
		timeout = <5>;
		status = "okay";

		/*
		 * All write operations are disabled when the /WC signal is
		 * driven high. Thus the meaning of WP is inverse, high and
		 * not low active.
		 */
		wp-gpios = <&mikrobus_header 1 GPIO_ACTIVE_HIGH>;
	};
};
