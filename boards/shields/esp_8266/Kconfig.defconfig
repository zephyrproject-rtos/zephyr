## boards/shields/esp_8266/Kconfig.defconfig
```kconfig
# Copyright (c) 2020 Gerson Fernando Budke <nandojve@gmail.com>
# SPDX-License-Identifier: Apache-2.0

if SHIELD_ESP_8266 || \
	SHIELD_ESP_8266_ARDUINO || \
	SHIELD_ESP_8266_MIKROBUS

if NETWORKING

choice WIFI_ESP_AT_VERSION
	default WIFI_ESP_AT_VERSION_1_7
	depends on WIFI_ESP_AT
endchoice

orsource "boards/*.defconfig"

endif # NETWORKING

endif   # SHIELD_ESP_8266 || \
	# SHIELD_ESP_8266_ARDUINO || \
	# SHIELD_ESP_8266_MIKROBUS
```

## boards/shields/esp_8266/Kconfig.shield
```kconfig
# Copyright (c) 2020 Gerson Fernando Budke <nandojve@gmail.com>
# SPDX-License-Identifier: Apache-2.0

config SHIELD_ESP_8266
	def_bool $(shields_list_contains,esp_8266)

config SHIELD_ESP_8266_ARDUINO
	def_bool $(shields_list_contains,esp_8266_arduino)

config SHIELD_ESP_8266_MIKROBUS
	def_bool $(shields_list_contains,esp_8266_mikrobus)
```

## boards/shields/esp_8266/boards/numaker_pfm_m467.conf
```kconfig
# SPDX-License-Identifier: Apache-2.0

# Without enable, ESP8266 shield will continuously push data to board (+IPD) anyway
# on receive and board's Rx buffer can get OOM easily. However, current driver
# implementation on Passive Receive mode has the following concerns:
# 1. On <conn_id>,CLOSED, driver closes the socket prematurely and buffered Rx data on
#    ESP8266 shield gets unable to fetch (AT+RECVDATA).
#    NOTE: To re-produce the issue, go samples/net/sockets/http_get in which the server
#          end will close the connection immediately after replying the http response.
# 2. On +IPD, driver doesn't consider available Rx buffer and straight schedules to fetch
#    buffered Rx data on ESP8266 shield, still causing Rx buffer OOM. One approach may
#    pre-allocate Rx buffer before the schedule.
#    NOTE: To re-produce the issue, go samples/net/sockets/big_http_download/src, adding
#          delay e.g. k_msleep(8000) in the download() while loop.
#    NOTE: With or without this feature enabled, esp_socket_prepare_pkt() enabling timed
#          wait (CONFIG_WIFI_ESP_AT_RX_NET_PKT_ALLOC_TIMEOUT) can relieve the problem to
#          some degree.
#
# See: https://github.com/zephyrproject-rtos/zephyr/issues/52702
#CONFIG_WIFI_ESP_AT_PASSIVE_MODE=y
```

## boards/shields/esp_threadbr_ethernet/Kconfig.shield
```kconfig
# Copyright (c) 2026 Espressif Systems (Shanghai) Co., Ltd.
# SPDX-License-Identifier: Apache-2.0

config SHIELD_ESP_THREADBR_ETHERNET
	def_bool $(shields_list_contains,esp_threadbr_ethernet)
```

## boards/shields/esp_threadbr_zigbeegw_ethernet/Kconfig.defconfig
```kconfig
# Copyright (c) 2025 Espressif (c)
# SPDX-License-Identifier: Apache-2.0

if SHIELD_ESP_THREADBR_ZIGBEEGW_ETHERNET

configdefault NET_L2_ETHERNET
	default y

endif # SHIELD_ESP_THREADBR_ZIGBEEGW_ETHERNET
```

## boards/shields/esp_threadbr_zigbeegw_ethernet/Kconfig.shield
```kconfig
# Copyright (c) 2025 Espressif Shanghai (c)
# SPDX-License-Identifier: Apache-2.0

config SHIELD_ESP_THREADBR_ZIGBEEGW_ETHERNET
	def_bool $(shields_list_contains,esp_threadbr_zigbeegw_ethernet)
```

## boards/shields/esp_tz_router_eth/Kconfig.defconfig
```kconfig
# Copyright (c) 2025 Espressif (c)
# SPDX-License-Identifier: Apache-2.0

if SHIELD_ESP_TZ_ROUTER_ETH

configdefault NET_L2_ETHERNET
	default y

endif # SHIELD_ESP_TZ_ROUTER_ETH
```

## boards/shields/esp_tz_router_eth/Kconfig.shield
```kconfig
# Copyright (c) 2025 Espressif Shanghai (c)
# SPDX-License-Identifier: Apache-2.0

config SHIELD_ESP_TZ_ROUTER_ETH
	def_bool $(shields_list_contains,esp_tz_router_eth)
```

## boards/shields/eval_ad4052_ardz/Kconfig.shield
```kconfig
# Copyright (c) 2025 Analog Devices, Inc.
# SPDX-License-Identifier: Apache-2.0

config SHIELD_EVAL_AD4052_ARDZ
	def_bool $(shields_list_contains,eval_ad4052_ardz)
```

## boards/shields/eval_ad5529r_ardz/Kconfig.shield
```kconfig
# Copyright (c) 2026 Analog Devices, Inc.
# SPDX-License-Identifier: Apache-2.0

config SHIELD_EVAL_AD5529R_ARDZ
	def_bool $(shields_list_contains,eval_ad5529r_ardz)
```

## boards/shields/eval_adg1712ardz/Kconfig.shield
```kconfig
# Copyright (c) 2026 Analog Devices Inc.
# SPDX-License-Identifier: Apache-2.0

config SHIELD_EVAL_ADG1712ARDZ
	def_bool $(shields_list_contains,eval_adg1712ardz)
```

## boards/shields/eval_adgm3121/Kconfig.shield
```kconfig
# Copyright (c) 2026 Analog Devices Inc.
# SPDX-License-Identifier: Apache-2.0

config SHIELD_EVAL_ADGM3121
	def_bool $(shields_list_contains,eval_adgm3121)
```

## boards/shields/eval_adxl362_ardz/Kconfig.shield
```kconfig
# Copyright (c) 2024 Analog Devices, Inc.
# SPDX-License-Identifier: Apache-2.0

config SHIELD_EVAL_ADXL362_ARDZ
	def_bool $(shields_list_contains,eval_adxl362_ardz)
```

## boards/shields/eval_adxl367_ardz/Kconfig.shield
```kconfig
# Copyright (c) 2025 Analog Devices, Inc.
# SPDX-License-Identifier: Apache-2.0

config SHIELD_EVAL_ADXL367_ARDZ
	def_bool $(shields_list_contains,eval_adxl367_ardz)
```

## boards/shields/eval_adxl372_ardz/Kconfig.shield
```kconfig
# Copyright (c) 2024 Analog Devices, Inc.
# SPDX-License-Identifier: Apache-2.0

config SHIELD_EVAL_ADXL372_ARDZ
	def_bool $(shields_list_contains,eval_adxl372_ardz)
```

## boards/shields/eval_cn0391_ardz/Kconfig.shield
```kconfig
# Copyright (c) 2026 Analog Devices, Inc.
# SPDX-License-Identifier: Apache-2.0

config SHIELD_EVAL_CN0391_ARDZ
	def_bool $(shields_list_contains,eval_cn0391_ardz)
```

## boards/shields/frdm_cr20a/Kconfig.defconfig
```kconfig
#
# Copyright (c) 2019, NXP
# Copyright (c) 2019 Linaro Limited
# SPDX-License-Identifier: Apache-2.0
#

if SHIELD_FRDM_CR20A

if IEEE802154

rsource "boards/*.defconfig"

endif # IEEE802154

endif # SHIELD_FRDM_CR20A
```

## boards/shields/frdm_cr20a/Kconfig.shield
```kconfig
# Copyright (c) 2019 Linaro Limited
# SPDX-License-Identifier: Apache-2.0

config SHIELD_FRDM_CR20A
	def_bool $(shields_list_contains,frdm_cr20a)
```

## boards/shields/frdm_cr20a/boards/frdm_k64f.conf
```kconfig
#
# Copyright (c) 2019, NXP
#
# SPDX-License-Identifier: Apache-2.0
#

CONFIG_NET_L2_ETHERNET=n
```

## boards/shields/frdm_kw41z/Kconfig.shield
```kconfig
# Copyright (c) 2019 Linaro Limited
# SPDX-License-Identifier: Apache-2.0

config SHIELD_FRDM_KW41Z
	def_bool $(shields_list_contains,frdm_kw41z)
```

## boards/shields/frdm_stbc_agm01/Kconfig.defconfig
```kconfig
# Copyright (c) 2022 Intel Corporation
#
# SPDX-License-Identifier: Apache-2.0

if SHIELD_FRDM_STBC_AGM01

config I2C
	default y if SENSOR

endif # SHIELD_FRDM_STBC_AGM01
```

## boards/shields/frdm_stbc_agm01/Kconfig.shield
```kconfig
# Copyright (c) 2021 Ryan Holleran
# SPDX-License-Identifier: Apache-2.0

config SHIELD_FRDM_STBC_AGM01
	def_bool $(shields_list_contains,frdm_stbc_agm01)
```

## boards/shields/ftdi_vm800c/Kconfig.defconfig
```kconfig
# Copyright (c) 2021 Hubert Miś <hubert.mis@gmail.com>
# SPDX-License-Identifier: Apache-2.0

if SHIELD_FTDI_VM800C

config FT800
	default y

endif	# SHIELD_FTDI_VM800C
```
