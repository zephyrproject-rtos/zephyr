/*
 * Copyright (c) 2020 Gerson Fernando Budke <nandojve@gmail.com>
 *
 * SPDX-License-Identifier: Apache-2.0
 */

&arduino_serial {
	current-speed = <115200>;
	status = "okay";

	esp8266 {
		compatible = "espressif,esp-at";
		status = "okay";
	};
};
