/*
 * Copyright The Zephyr Project Contributors
 * SPDX-License-Identifier: Apache-2.0
 */

#include <zephyr/dt-bindings/gpio/mikro-bus.h>

/ {
	aliases {
		light-sensor = &opt3001_mikroe_ambient_2_click;
	};
};

&mikrobus_i2c {
	status = "okay";

	opt3001_mikroe_ambient_2_click: opt3001@44 {
		compatible = "ti,opt3001";
		reg = <0x44>;
		int-gpios = <&mikrobus_header MIKROBUS_INT GPIO_ACTIVE_LOW>;
	};
};
