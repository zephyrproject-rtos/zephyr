/*
 * Copyright 2025 Google LLC
 *
 * SPDX-License-Identifier: Apache-2.0
 */

#include <zephyr/dt-bindings/led/led.h>

/ {
	aliases {
		led-strip = &modulino_pixels;
	};
};

&zephyr_i2c {
	modulino_pixels: modulino-pixels@36 {
		compatible = "arduino,modulino-pixels";
		reg = <0x36>;
		chain-length = <8>;
		color-mapping = <LED_COLOR_ID_RED
				 LED_COLOR_ID_GREEN
				 LED_COLOR_ID_BLUE>;
	};
};
