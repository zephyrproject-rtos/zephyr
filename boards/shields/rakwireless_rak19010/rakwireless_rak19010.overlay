/*
 * SPDX-License-Identifier: Apache-2.0
 * Copyright (c) 2026 RAKwireless Technology Limited
 */

#include <wisblock/wisblock_sensor_a.dtsi>
#include <wisblock/wisblock_sensor_b.dtsi>
#include <wisblock/wisblock_sensor_c.dtsi>
#include <wisblock/wisblock_sensor_d.dtsi>
