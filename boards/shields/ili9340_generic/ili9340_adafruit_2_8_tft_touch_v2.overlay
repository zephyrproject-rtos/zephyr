/*
 * Copyright (c) 2019 PHYTEC Messtechnik GmbH
 *
 * SPDX-License-Identifier: Apache-2.0
 */

&arduino_spi {
	status = "okay";
	cs-gpios = <&arduino_header 16 0>;			/* D10 */


	ili9340@0 {
		compatible = "ilitek,ili9xxx";
		label = "ILI9340";
		spi-max-frequency = <15151515>;
		reg = <0>;
		cmd-data-gpios = <&arduino_header 15 GPIO_ACTIVE_LOW>;	/* D9 */
		pixel-format = "RGB_888";
		height = <320>;
		width = <240>;
	};
};
