&mikrobus_spi {
	cs-gpios = <&mikrobus_header 2 GPIO_ACTIVE_LOW>;

	mcp2518fd_mikroe_mcp2518fd_click: mcp2518fd@0 {
		compatible = "microchip,mcp251xfd";
		reg = <0x0>;

		spi-max-frequency = <18000000>;
		int-gpios = <&mikrobus_header 7 GPIO_ACTIVE_LOW>;
		osc-freq = <40000000>;
		status = "okay";
	};
};

/ {
	chosen {
		zephyr,canbus = &mcp2518fd_mikroe_mcp2518fd_click;
	};
};
