/*
 * Copyright (c) 2019 Brett Witherspoon
 *
 * SPDX-License-Identifier: Apache-2.0
 */

/ {
	aliases {
		accel0 = &adxl362_0_boostxl_ulpsense;
	};
};

&boosterpack_spi {
	adxl362_0_boostxl_ulpsense: adxl362@0 {
		compatible = "adi,adxl362";
		reg = <0>;
		spi-max-frequency = <8000000>;
		int1-gpios = <&boosterpack_header 36 0>;
	};
};
