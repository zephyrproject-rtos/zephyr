/*
 * Copyright The Zephyr Project Contributors
 * SPDX-License-Identifier: Apache-2.0
 */

#include <zephyr/dt-bindings/gpio/mikro-bus.h>

&mikrobus_i2c {
	status = "okay";

	ccs811_mikroe_air_quality_3_click: ccs811@5a {
		compatible = "ams,ccs811";
		reg = <0x5a>;
		reset-gpios = <&mikrobus_header MIKROBUS_RST GPIO_ACTIVE_LOW>;
		wake-gpios = <&mikrobus_header MIKROBUS_CS GPIO_ACTIVE_LOW>;
		irq-gpios = <&mikrobus_header MIKROBUS_INT GPIO_ACTIVE_LOW>;
	};
};
