/*
 * Copyright (c) 2025 Jonas Berg
 *
 * SPDX-License-Identifier: Apache-2.0
 */

&zephyr_i2c {
	status = "okay";

	mcp23017_adafruit_8chan_solenoid: mcp23017@20 {
		compatible = "microchip,mcp23017";
		reg = <0x20>;
		gpio-controller;
		#gpio-cells = <2>;
		ngpios = <16>;
	};
};
