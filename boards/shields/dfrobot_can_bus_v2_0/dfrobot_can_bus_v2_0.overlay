/*
 * Copyright (c) 2019 Karsten Koenig
 *
 * SPDX-License-Identifier: Apache-2.0
 */

&arduino_spi {
	status = "okay";
	cs-gpios = <&arduino_header 16 GPIO_ACTIVE_LOW>; /* D10 */

	can1: mcp2515@0 {
		compatible = "microchip,mcp2515";
		spi-max-frequency = <1000000>;
		int-gpios = <&arduino_header 8 GPIO_ACTIVE_LOW>; /* D2 */
		status = "okay";
		label = "CAN_1";
		reg = <0x0>;
		osc-freq = <16000000>;
		bus-speed = <125000>;
		sjw = <1>;
		prop-seg = <2>;
		phase-seg1 = <7>;
		phase-seg2 = <6>;
		#address-cells = <1>;
		#size-cells = <0>;
	};
};

/ {
	chosen {
		zephyr,can-primary = &can1;
	};
};
