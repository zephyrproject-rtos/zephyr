/*
 * Copyright (c) 2026 Carl Zeiss Meditec AG
 * SPDX-License-Identifier: Apache-2.0
 */

#include <zephyr/dt-bindings/gpio/mikro-bus.h>

&mikrobus_i2c {
	status = "okay";

	tls2522_mikroe_ambient_25_click: tsl2522@39 {
		compatible = "ams,tsl2522";
		reg = <0x39>;
		int-gpios = <&mikrobus_header MIKROBUS_INT GPIO_ACTIVE_LOW>;
	};
};
