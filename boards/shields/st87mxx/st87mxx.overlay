/*
 * Copyright (c) 2025 STMicroelectronics
 *
 * SPDX-License-Identifier: Apache-2.0
 */

&arduino_serial {
	current-speed = <115200>;
	status = "okay";

	st_87mxx: modem {
		compatible = "st,st87mxx";
		mdm-reset-gpios = <&arduino_header 15 0>;
		mdm-ring-gpios = <&arduino_header 14 0>;
		status = "okay";
	};
};
