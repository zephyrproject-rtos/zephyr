/*
 * Copyright (c) 2020 Gerson Fernando Budke <nandojve@gmail.com>
 *
 * SPDX-License-Identifier: Apache-2.0
 */

/ {
	chosen {
		zephyr,ieee802154 = &ieee802154_atmel_rf2xx_legacy;
	};
};

&ext1_spi {
	status = "okay";

	ieee802154_atmel_rf2xx_legacy: rf2xx@0 {
		compatible = "atmel,rf2xx";
		reg = <0x0>;
		spi-max-frequency = <6000000>;
		irq-gpios = <&ext1_header 10
			     (GPIO_PULL_DOWN | GPIO_ACTIVE_HIGH)>;
		reset-gpios = <&ext1_header 8 GPIO_ACTIVE_LOW>;
		slptr-gpios = <&ext1_header 11 GPIO_ACTIVE_HIGH>;
		status = "okay";
	};
};
