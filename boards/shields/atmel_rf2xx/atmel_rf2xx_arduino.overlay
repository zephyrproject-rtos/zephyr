/*
 * Copyright (c) 2020 Gerson Fernando Budke <nandojve@gmail.com>
 *
 * SPDX-License-Identifier: Apache-2.0
 */

#include <zephyr/dt-bindings/gpio/arduino-header-r3.h>

/ {
	chosen {
		zephyr,ieee802154 = &ieee802154_atmel_rf2xx_arduino;
	};
};

&arduino_spi {
	status = "okay";

	cs-gpios = <&arduino_header ARDUINO_HEADER_R3_D10
		    (GPIO_PULL_UP | GPIO_ACTIVE_LOW)>;

	ieee802154_atmel_rf2xx_arduino: rf2xx@0 {
		compatible = "atmel,rf2xx";
		reg = <0x0>;
		spi-max-frequency = <6000000>;
		irq-gpios = <&arduino_header ARDUINO_HEADER_R3_D2
			     (GPIO_PULL_DOWN | GPIO_ACTIVE_HIGH)>;
		reset-gpios = <&arduino_header ARDUINO_HEADER_R3_D8 GPIO_ACTIVE_LOW>;
		slptr-gpios = <&arduino_header ARDUINO_HEADER_R3_D9 GPIO_ACTIVE_HIGH>;
		status = "okay";
	};
};
