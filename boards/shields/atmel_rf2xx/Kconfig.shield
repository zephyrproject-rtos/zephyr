## boards/shields/atmel_rf2xx/Kconfig.shield
```kconfig
# Copyright (c) 2020 Gerson Fernando Budke <nandojve@gmail.com>
# SPDX-License-Identifier: Apache-2.0

config SHIELD_ATMEL_RF2XX
	def_bool $(shields_list_contains,atmel_rf2xx)

config SHIELD_ATMEL_RF2XX_ARDUINO
	def_bool $(shields_list_contains,atmel_rf2xx_arduino)

config SHIELD_ATMEL_RF2XX_MIKROBUS
	def_bool $(shields_list_contains,atmel_rf2xx_mikrobus)

config SHIELD_ATMEL_RF2XX_XPRO
	def_bool $(shields_list_contains,atmel_rf2xx_xpro)

config SHIELD_ATMEL_RF2XX_LEGACY
	def_bool $(shields_list_contains,atmel_rf2xx_legacy)

config SHIELD_ATMEL_RF2XX_XPLAINED
	def_bool $(shields_list_contains,atmel_rf2xx_xplained)
```

## boards/shields/boostxl_ulpsense/Kconfig.defconfig
```kconfig
# Copyright (c) 2022 TOKITA Hiroshi <tokita.hiroshi@fujitsu.com>
#
# SPDX-License-Identifier: Apache-2.0

if SHIELD_BOOSTXL_ULPSENSE

config SPI
	default y if SENSOR

endif # SHIELD_BOOSTXL_ULPSENSE
```

## boards/shields/boostxl_ulpsense/Kconfig.shield
```kconfig
# Copyright (c) 2021 Nordic Semiconductor ASA
# SPDX-License-Identifier: Apache-2.0

config SHIELD_BOOSTXL_ULPSENSE
	def_bool $(shields_list_contains,boostxl_ulpsense)
```

## boards/shields/buydisplay_2_8_tft_touch_arduino/Kconfig.defconfig
```kconfig
# Copyright (c) 2020 Teslabs Engineering S.L.
# SPDX-License-Identifier: Apache-2.0

if SHIELD_BUYDISPLAY_2_8_TFT_TOUCH_ARDUINO

if DISPLAY

if LVGL

config LV_Z_VDB_SIZE
	default 64

config LV_Z_BITS_PER_PIXEL
	default 16

choice LV_COLOR_DEPTH
	default LV_COLOR_DEPTH_16
endchoice

configdefault LV_COLOR_16_SWAP
	default y

config INPUT
	default y

endif # LVGL

endif # DISPLAY

endif # SHIELD_BUYDISPLAY_2_8_TFT_TOUCH_ARDUINO
```

## boards/shields/buydisplay_2_8_tft_touch_arduino/Kconfig.shield
```kconfig
# Copyright (c) 2020 Teslabs Engineering S.L.
# SPDX-License-Identifier: Apache-2.0

config SHIELD_BUYDISPLAY_2_8_TFT_TOUCH_ARDUINO
	def_bool $(shields_list_contains,buydisplay_2_8_tft_touch_arduino)
```

## boards/shields/buydisplay_3_5_tft_touch_arduino/Kconfig.shield
```kconfig
# Copyright (c) 2020 Teslabs Engineering S.L.
# SPDX-License-Identifier: Apache-2.0

config SHIELD_BUYDISPLAY_3_5_TFT_TOUCH_ARDUINO
	def_bool $(shields_list_contains,buydisplay_3_5_tft_touch_arduino)
```

## boards/shields/canis_canpico/Kconfig.shield
```kconfig
# Copyright (c) 2025 Steve Boylan
# SPDX-License-Identifier: Apache-2.0

config SHIELD_CANIS_CANPICO
	def_bool $(shields_list_contains,canis_canpico)
```

## boards/shields/cdc_acm/Kconfig.defconfig
```kconfig
# Copyright (c) 2021 Nordic Semiconductor ASA
# SPDX-License-Identifier: Apache-2.0

if SHIELD_CDC_ACM_CONSOLE || SHIELD_CDC_ACM_SHELL || SHIELD_CDC_ACM_BT_C2H

# TEST_LOGGING_DEFAULTS option sets all log levels to INF,
# including the USB_CDC_ACM_LOG_LEVEL and that can not work.
config TEST_LOGGING_DEFAULTS
	default n

config SERIAL
	default y

config UART_LINE_CTRL
	default y

config USB_DEVICE_STACK
	default y

config USB_DEVICE_INITIALIZE_AT_BOOT
	default y

endif #if SHIELD_CDC_ACM_CONSOLE || SHIELD_CDC_ACM_SHELL || ...

if SHIELD_CDC_ACM_CONSOLE

config CONSOLE
	default y

config UART_CONSOLE
	default y

endif #if SHIELD_CDC_ACM_CONSOLE

if SHIELD_CDC_ACM_SHELL

config SHELL_BACKEND_SERIAL_CHECK_DTR
	default y

config LOG_PRINTK
	default y

endif #if SHIELD_CDC_ACM_SHELL
```

## boards/shields/cdc_acm/Kconfig.shield
```kconfig
# Copyright (c) 2021
# SPDX-License-Identifier: Apache-2.0

config SHIELD_CDC_ACM_CONSOLE
	def_bool $(shields_list_contains,cdc_acm_console)

config SHIELD_CDC_ACM_SHELL
	def_bool $(shields_list_contains,cdc_acm_shell)

config SHIELD_CDC_ACM_BT_C2H
	def_bool $(shields_list_contains,cdc_acm_bt_c2h)
```

## boards/shields/ci_shield/Kconfig.defconfig
```kconfig
# Copyright (c) 2020 STMicroelectronics
# SPDX-License-Identifier: Apache-2.0

if DISK_ACCESS_SDHC

config SPI
	default y

config DISK_ACCESS_SPI_SDHC
	default y

endif
```

## boards/shields/ci_shield/Kconfig.shield
```kconfig
# Copyright (c) 2020 STMicroelectronics
# SPDX-License-Identifier: Apache-2.0

config SHIELD_CI_SHIELD
	def_bool $(shields_list_contains,ci_shield)
```

## boards/shields/cy15framkit-001/Kconfig.defconfig
```kconfig
# Copyright (c) 2021 Caspar Friedrich <c.s.w.friedrich@gmail.com>
# SPDX-License-Identifier: Apache-2.0

if SHIELD_CY15FRAMKIT_001

config I2C
	default y

config SPI
	default y

config EEPROM
	default y

config EEPROM_FM24W256
	default y

config EEPROM_FM25W256
	default y

endif # SHIELD_CY15FRAMKIT_001
```

## boards/shields/cy15framkit-001/Kconfig.shield
```kconfig
# Copyright (c) 2021 Caspar Friedrich <c.s.w.friedrich@gmail.com>
# SPDX-License-Identifier: Apache-2.0

config SHIELD_CY15FRAMKIT_001
	def_bool $(shields_list_contains,cy15framkit-001)
```

## boards/shields/dac80508_evm/Kconfig.defconfig
```kconfig
# Copyright (c) 2020 M2I Corporation
# SPDX-License-Identifier: Apache-2.0

if SHIELD_DAC80508_EVM

if DAC

config SPI
	default y

config DAC_DACX0508
	default y

config DAC_INIT_PRIORITY
	default 80

endif # DAC

endif # SHIELD_DAC80508_EVM
```

## boards/shields/dac80508_evm/Kconfig.shield
```kconfig
# Copyright (c) 2020 M2I Corporation
# SPDX-License-Identifier: Apache-2.0

config SHIELD_DAC80508_EVM
	def_bool $(shields_list_contains,dac80508_evm)
```

## boards/shields/dfrobot_can_bus_v2_0/Kconfig.defconfig
```kconfig
# Copyright (c) 2019 Linaro Limited
# SPDX-License-Identifier: Apache-2.0

if SHIELD_DFROBOT_CAN_BUS_V2_0

if CAN

config SPI
	default y

config CAN_MCP2515
	default y

config CAN_INIT_PRIORITY
	default 80

endif # CAN

endif # SHIELD_DFROBOT_CAN_BUS_V2_0
```

## boards/shields/dfrobot_can_bus_v2_0/Kconfig.shield
```kconfig
# Copyright (c) 2019 Linaro Limited
# SPDX-License-Identifier: Apache-2.0

config SHIELD_DFROBOT_CAN_BUS_V2_0
	def_bool $(shields_list_contains,dfrobot_can_bus_v2_0)
```

## boards/shields/dfrobot_gravity_tm6605/Kconfig.shield
```kconfig
# Copyright (c) 2026 Anuj Deshpande
# SPDX-License-Identifier: Apache-2.0

config SHIELD_DFROBOT_GRAVITY_TM6605
	def_bool $(shields_list_contains,dfrobot_gravity_tm6605)
```

## boards/shields/dvp_20pin_ov7670/Kconfig.shield
```kconfig
# Copyright 2025 tinyVision.ai Inc.
# SPDX-License-Identifier: Apache-2.0

config SHIELD_DVP_20PIN_OV7670
	def_bool $(shields_list_contains,dvp_20pin_ov7670)
```

## boards/shields/dvp_fpc24_mt9m114/Kconfig.shield
```kconfig
# Copyright 2024 NXP
# SPDX-License-Identifier: Apache-2.0

config SHIELD_DVP_FPC24_MT9M114
	def_bool $(shields_list_contains,dvp_fpc24_mt9m114)
```

## boards/shields/ek_ra8d1_rtk7eka6m3b00001bu/Kconfig.shield
```kconfig
# Copyright (c) 2025 Renesas Electronics Corporation
# SPDX-License-Identifier: Apache-2.0

config SHIELD_EK_RA8D1_RTK7EKA6M3B00001BU
	def_bool $(shields_list_contains,ek_ra8d1_rtk7eka6m3b00001bu)
```

## boards/shields/esp32s3_box3_at581x/Kconfig.defconfig
```kconfig
# Copyright (c) 2026 NotioNext Ltd.
# SPDX-License-Identifier: Apache-2.0

if SHIELD_ESP32S3_BOX3_AT581X

config SENSOR
	default y

endif # SHIELD_ESP32S3_BOX3_AT581X
```

## boards/shields/esp32s3_box3_at581x/Kconfig.shield
```kconfig
# Copyright (c) 2026 NotioNext Ltd.
# SPDX-License-Identifier: Apache-2.0

config SHIELD_ESP32S3_BOX3_AT581X
	def_bool $(shields_list_contains,esp32s3_box3_at581x)
```
