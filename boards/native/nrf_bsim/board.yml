## boards/nicemcu/nicemcu_wb5e/Kconfig.nicemcu_wb5e
```kconfig
# Copyright The Zephyr Project Contributors
# SPDX-License-Identifier: Apache-2.0

config BOARD_NICEMCU_WB5E
	select SOC_BK7258_CPU0 if BOARD_NICEMCU_WB5E_BK7258_CPU0
```

## boards/nicemcu/nicemcu_wb5e/board.yml
```yaml
board:
  name: nicemcu_wb5e
  full_name: NiceMCU WB5E
  vendor: nicemcu
  socs:
  - name: bk7258
```

## boards/nordic/nrf5340_audio_dk/Kconfig.defconfig
```kconfig
# nRF5340 Audio DK board configuration

# Copyright (c) 2019 Nordic Semiconductor ASA
# SPDX-License-Identifier: Apache-2.0

configdefault HW_STACK_PROTECTION
	default ARCH_HAS_STACK_PROTECTION

if BOARD_NRF5340_AUDIO_DK_NRF5340_CPUAPP || BOARD_NRF5340_AUDIO_DK_NRF5340_CPUAPP_NS

configdefault BT_HCI_IPC
	default y if BT_HCI

endif # BOARD_NRF5340_AUDIO_DK_NRF5340_CPUAPP || BOARD_NRF5340_AUDIO_DK_NRF5340_CPUAPP_NS
```

## boards/nordic/nrf5340dk/Kconfig
```kconfig
# Copyright The Zephyr Project Contributors
# SPDX-License-Identifier: Apache-2.0

if BOARD_NRF5340DK_NRF5340_CPUAPP || BOARD_NRF5340DK_NRF5340_CPUAPP_NS

config HEAP_MEM_POOL_ADD_SIZE_BOARD
	int
	default 4096 if BT_HCI_IPC

endif # BOARD_NRF5340DK_NRF5340_CPUAPP || BOARD_NRF5340DK_NRF5340_CPUAPP_NS
```

## boards/nordic/nrf5340dk/Kconfig.defconfig
```kconfig
# nRF5340 DK nRF5340 board configuration

# Copyright (c) 2019-2020 Nordic Semiconductor ASA
# SPDX-License-Identifier: Apache-2.0

configdefault HW_STACK_PROTECTION
	default ARCH_HAS_STACK_PROTECTION

if NORDIC_QSPI_NOR

configdefault NORDIC_QSPI_NOR_FLASH_LAYOUT_PAGE_SIZE
	default 4096 if MCUBOOT || BOOTLOADER_MCUBOOT

endif # NORDIC_QSPI_NOR

if BOARD_NRF5340DK_NRF5340_CPUAPP || BOARD_NRF5340DK_NRF5340_CPUAPP_NS

configdefault BT_HCI_IPC
	default y if BT_HCI

endif # BOARD_NRF5340DK_NRF5340_CPUAPP || BOARD_NRF5340DK_NRF5340_CPUAPP_NS
```

## boards/nordic/nrf7120dk/Kconfig
```kconfig
# Copyright (c) 2026 Nordic Semiconductor ASA
# SPDX-License-Identifier: Apache-2.0

config BOARD_NRF7120DK
	select SOC_NRF7120_DEVELOP_IN_NRF7120E if SOC_NRF7120
```

## boards/nordic/nrf7120dk/Kconfig.nrf7120dk
```kconfig
# Copyright (c) 2025 Nordic Semiconductor ASA
# SPDX-License-Identifier: Apache-2.0
config BOARD_NRF7120DK
	select SOC_NRF7120_ENGA_CPUAPP if BOARD_NRF7120DK_NRF7120_CPUAPP || \
		BOARD_NRF7120DK_NRF7120_CPUAPP_NS
	select SOC_NRF7120_ENGA_CPUFLPR if BOARD_NRF7120DK_NRF7120_CPUFLPR || \
		BOARD_NRF7120DK_NRF7120_CPUFLPR_XIP
	select SOC_NRF7120E_ENGA_CPUAPP if BOARD_NRF7120DK_NRF7120E_CPUAPP || \
		BOARD_NRF7120DK_NRF7120E_CPUAPP_NS
	select SOC_NRF7120E_ENGA_CPUFLPR if BOARD_NRF7120DK_NRF7120E_CPUFLPR || \
		BOARD_NRF7120DK_NRF7120E_CPUFLPR_XIP
```

## boards/nordic/thingy53/Kconfig
```kconfig
# Thingy53 NRF5340 board configuration

# Copyright (c) 2021 Nordic Semiconductor ASA
# SPDX-License-Identifier: Apache-2.0

config THINGY53_INIT_PRIORITY
	int "Init priority"
	default 79
	help
	  Initialization priority of the Thingy:53.

if BOARD_THINGY53_NRF5340_CPUAPP || BOARD_THINGY53_NRF5340_CPUAPP_NS

config HEAP_MEM_POOL_ADD_SIZE_BOARD
	int
	default 4096 if BT_HCI_IPC

endif # BOARD_THINGY53_NRF5340_CPUAPP || BOARD_THINGY53_NRF5340_CPUAPP_NS
```

## boards/nordic/thingy53/Kconfig.defconfig
```kconfig
# Thingy53 NRF5340 board configuration

# Copyright (c) 2021 Nordic Semiconductor ASA
# SPDX-License-Identifier: Apache-2.0

configdefault HW_STACK_PROTECTION
	default ARCH_HAS_STACK_PROTECTION

if NORDIC_QSPI_NOR

configdefault NORDIC_QSPI_NOR_FLASH_LAYOUT_PAGE_SIZE
	default 4096 if MCUBOOT || BOOTLOADER_MCUBOOT

endif # NORDIC_QSPI_NOR

if BOARD_THINGY53_NRF5340_CPUAPP || BOARD_THINGY53_NRF5340_CPUAPP_NS

if !TRUSTED_EXECUTION_SECURE

configdefault BT_HCI_IPC
	default y if BT_HCI

configdefault BT_HAS_HCI_VS
	default BT

configdefault USB_NRFX_ATTACHED_EVENT_DELAY
	default 700 if USB_DEVICE_DRIVER

configdefault I2C
	default y

configdefault SPI
	default y

configdefault REGULATOR
	default y

endif # !TRUSTED_EXECUTION_SECURE

source "boards/common/usb/Kconfig.cdc_acm_serial.defconfig"

endif # BOARD_THINGY53_NRF5340_CPUAPP || BOARD_THINGY53_NRF5340_CPUAPP_NS

if BOARD_THINGY53_NRF5340_CPUNET

configdefault BT_ECC
	default BT

endif # BOARD_THINGY53_NRF5340_CPUNET
```

## boards/norik/dect_nr_plus_usb_dongle/Kconfig.defconfig
```kconfig
# DECT NR+ USB Dongle board configuration

# Copyright (c) 2026 Norik Systems
# SPDX-License-Identifier: Apache-2.0

config HW_STACK_PROTECTION
	default ARCH_HAS_STACK_PROTECTION

if BOARD_DECT_NR_PLUS_USB_DONGLE_NRF9151 || BOARD_DECT_NR_PLUS_USB_DONGLE_NRF9151_NS

config BOARD_DECT_NR_PLUS_USB_DONGLE
	select USE_DT_CODE_PARTITION if BOARD_DECT_NR_PLUS_USB_DONGLE_NRF9151_NS

endif # BOARD_DECT_NR_PLUS_USB_DONGLE_NRF9151 || BOARD_DECT_NR_PLUS_USB_DONGLE_NRF9151_NS
```

## boards/norik/dect_nr_plus_usb_dongle/board.yml
```yaml
board:
  name: dect_nr_plus_usb_dongle
  full_name: DECT NR+ USB Dongle
  vendor: norik
  socs:
  - name: nrf9151
    variants:
    - name: ns
```

## boards/nucode/nucode_nu54/Kconfig.defconfig
```kconfig
# NUCODE NU54V DK board configuration

# Copyright (c) 2026 NUCODE Co., Ltd.
# SPDX-License-Identifier: Apache-2.0

config HW_STACK_PROTECTION
	default ARCH_HAS_STACK_PROTECTION
```

## boards/nucode/nucode_nu54/Kconfig.nucode_nu54
```kconfig
# NUCODE NU54V DK board configuration

# Copyright (c) 2024 Nordic Semiconductor ASA
# Copyright (c) 2026 NUCODE Co., Ltd.
# SPDX-License-Identifier: Apache-2.0

config BOARD_NUCODE_NU54
	select SOC_NRF54L15_CPUAPP if BOARD_NUCODE_NU54_NRF54L15_CPUAPP
```

## boards/nucode/nucode_nu54/board.yml
```yaml
board:
  name: nucode_nu54
  full_name: NUCODE NU54V DK
  vendor: nucode
  socs:
  - name: nrf54l15
```

## boards/nucode/nucode_nu54/nucode_nu54_nrf54l15_cpuapp_defconfig
```kconfig
# Copyright (c) 2024 Nordic Semiconductor ASA
# Copyright (c) 2026 NUCODE Co., Ltd.
# SPDX-License-Identifier: Apache-2.0

# Enable UART driver and console
CONFIG_SERIAL=y
CONFIG_CONSOLE=y
CONFIG_UART_CONSOLE=y

# Enable GPIO
CONFIG_GPIO=y

# Enable MPU
CONFIG_ARM_MPU=y
```

## boards/nucode/nucode_nu87/Kconfig.nucode_nu87
```kconfig
# NUCODE NU87 board configuration

# Copyright (c) 2026 NUCODE Co., Ltd.
# SPDX-License-Identifier: Apache-2.0

config BOARD_NUCODE_NU87
	select SOC_RTL872XD
```

## boards/nucode/nucode_nu87/board.yml
```yaml
board:
  name: nucode_nu87
  full_name: NUCODE NU87-TinyDK
  vendor: nucode
  socs:
    - name: rtl872xd
```

## boards/nucode/nucode_nu87/nucode_nu87_rtl872xd_defconfig
```kconfig
# Copyright (c) 2026 NUCODE Co., Ltd.
# SPDX-License-Identifier: Apache-2.0

CONFIG_CONSOLE=y
CONFIG_UART_CONSOLE=y

# Enable LogUart
CONFIG_SERIAL=y

CONFIG_GPIO=y
```

## boards/nucode/nucode_nu87/nucode_nu87_rtl872xd_ns_defconfig
```kconfig
# Copyright (c) 2026 NUCODE Co., Ltd.
# SPDX-License-Identifier: Apache-2.0

CONFIG_TRUSTED_EXECUTION_NONSECURE=y

CONFIG_CONSOLE=y
CONFIG_UART_CONSOLE=y

# Enable LogUart
CONFIG_SERIAL=y

CONFIG_GPIO=y
```
