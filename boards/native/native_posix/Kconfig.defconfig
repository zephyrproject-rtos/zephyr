## boards/native/native_posix/Kconfig.defconfig
```kconfig
# Copyright (c) 2017 Oticon A/S
# SPDX-License-Identifier: Apache-2.0

if BOARD_NATIVE_POSIX

config BUILD_OUTPUT_BIN
	default n

config BUILD_OUTPUT_EXE
	default y

config OUTPUT_PRINT_MEMORY_USAGE
	default n

if NETWORKING

config NET_L2_ETHERNET
	default y if !NET_LOOPBACK && !NET_TEST

config ETH_NATIVE_POSIX
	default y if NET_L2_ETHERNET && ETH_DRIVER

endif # NETWORKING

if CONSOLE

config POSIX_ARCH_CONSOLE
	default y if !SERIAL

config UART_CONSOLE
	default y if SERIAL

endif # CONSOLE

if I2C

config EMUL
	default y

endif # I2C

endif # BOARD_NATIVE_POSIX
```

## boards/native/native_posix/Kconfig.native_posix_64
```kconfig
# Copyright (c) 2024 Nordic Semiconductor ASA
# SPDX-License-Identifier: Apache-2.0

config BOARD_NATIVE_POSIX_64
	select SOC_POSIX
```

## boards/native/native_posix/board.yml
```yaml
boards:
- name: native_posix
  full_name: Native POSIX execution (native_posix)
  vendor: zephyr
  socs:
  - name: native
    variants:
    - name: "64"
```

## boards/native/native_sim/Kconfig
```kconfig
# Copyright (c) 2023 Nordic Semiconductor ASA
# Copyright (c) 2025 GARDENA GmbH
# SPDX-License-Identifier: Apache-2.0

config BOARD_NATIVE_SIM
	bool
	select POSIX_ARCH_CONSOLE
	select NATIVE_LIBRARY
	select NATIVE_SIM_TIMER
	select 64BIT if BOARD_NATIVE_SIM_NATIVE_64
	help
	  Native simulator (Single Core)
	  Will produce a console Linux process which can be executed natively.

if BOARD_NATIVE_SIM

comment "Native Simulator (Single Core) options"

config NATIVE_SIM_SLOWDOWN_TO_REAL_TIME
	bool "Slow down execution to real time"
	default n if ARCH_POSIX_LIBFUZZER
	default y if BT_USERCHAN || !TEST
	help
	  When selected the execution of the process will be slowed down to real time.
	  (if there is a lot of load it may be slower than real time)
	  If deselected, the process will run as fast as possible.
	  Note that this only decouples simulated time from real/wall time. In either
	  case the zephyr kernel and application cannot tell the difference unless they
	  interact with some other driver/device which runs at real time.

config NATIVE_POSIX_SLOWDOWN_TO_REAL_TIME
	bool "Slow down execution to real time (native_posix compat)"
	select NATIVE_SIM_SLOWDOWN_TO_REAL_TIME
	select DEPRECATED
	help
	  Transitional option which allows applications which targeted native_posix
	  to set the correct native_sim option (CONFIG_NATIVE_SIM_SLOWDOWN_TO_REAL_TIME)

config NATIVE_SIM_REBOOT
	bool "Reboot support"
	depends on REBOOT
	help
	  Enables the reboot implementation for the native sim executable.

source "boards/native/common/sdl/Kconfig"
source "boards/native/common/extra_args/Kconfig"

endif # BOARD_NATIVE_SIM
```

## boards/native/native_sim/Kconfig.defconfig
```kconfig
# Copyright (c) 2023 Nordic Semiconductor ASA
# SPDX-License-Identifier: Apache-2.0

if BOARD_NATIVE_SIM

config BUILD_OUTPUT_BIN
	default n

config BUILD_OUTPUT_EXE
	default y

config OUTPUT_PRINT_MEMORY_USAGE
	default n

configdefault NET_L2_ETHERNET
	default y if !NET_LOOPBACK && !NET_TEST

configdefault ETH_NATIVE_TAP
	default y if NET_L2_ETHERNET && ETH_DRIVER && !WIFI

config WIFI_NM_WPA_SUPPLICANT
	default y if WIFI && !WIFI_OFFLOAD

configdefault COMMON_LIBC_MALLOC_ARENA_SIZE
	default 65536 if WIFI_NATIVE_SIM

if CONSOLE

config POSIX_ARCH_CONSOLE
	default y if !SERIAL

config UART_CONSOLE
	default y if SERIAL

endif # CONSOLE

endif # BOARD_NATIVE_SIM
```

## boards/native/native_sim/Kconfig.native_sim_64
```kconfig
# Copyright (c) 2024 Nordic Semiconductor ASA
# SPDX-License-Identifier: Apache-2.0

config BOARD_NATIVE_SIM_64
	select SOC_POSIX
```

## boards/native/native_sim/board.yml
```yaml
boards:
- name: native_sim
  full_name: Native simulator - native_sim
  vendor: zephyr
  socs:
  - name: native
    variants:
    - name: "64"
```

## boards/native/native_sim/native_sim_defconfig
```kconfig
# SPDX-License-Identifier: Apache-2.0

CONFIG_CONSOLE=y
CONFIG_SYS_CLOCK_HW_CYCLES_PER_SEC=1000000
```

## boards/native/nrf_bsim/Kconfig
```kconfig
# Copyright (c) 2024 Nordic Semiconductor ASA
# SPDX-License-Identifier: Apache-2.0

config BOARD_NRF52_BSIM
	bool
	select SOC_SERIES_BSIM_NRF52X
	select SOC_COMPATIBLE_NRF52833
	select NRF_RTC_TIMER
	select CLOCK_CONTROL
	help
	  NRF52 simulation model
	  Will produce a console Linux process which can be executed natively.
	  It needs the BabbleSim simulator both in compile time and to execute

config BOARD_NRF5340BSIM_NRF5340_CPUNET
	bool
	select SOC_SERIES_BSIM_NRF53X
	select SOC_COMPATIBLE_NRF5340_CPUNET
	select NRF_RTC_TIMER
	select CLOCK_CONTROL
	help
	  Simulated NRF53 Network core
	  Will produce a console Linux process which can be executed natively.
	  It needs the BabbleSim simulator both in compile time and to execute

config BOARD_NRF5340BSIM_NRF5340_CPUAPP
	bool
	select SOC_SERIES_BSIM_NRF53X
	select SOC_COMPATIBLE_NRF5340_CPUAPP
	select NRF_RTC_TIMER
	select CLOCK_CONTROL
	help
	  Simulated NRF53 Application core
	  Will produce a console Linux process which can be executed natively.
	  It needs the BabbleSim simulator both in compile time and to execute

config BOARD_NRF54L15BSIM_NRF54L15_CPUAPP
	bool
	select SOC_SERIES_BSIM_NRF54LX
	select SOC_COMPATIBLE_NRF54L15
	select SOC_COMPATIBLE_NRF54L15_CPUAPP
	select CLOCK_CONTROL
	help
	  Simulated NRF54L15 Application core
	  Will produce a console Linux process which can be executed natively.
	  It needs the BabbleSim simulator both in compile time and to execute


if SOC_SERIES_BSIM_NRFXX

# The following file is normally parsed only for the ARM architecture, which is
# used by Nordic SoCs, so to make the symbols defined in this file available for
# the simulated nrf5x_bsim boards, which use the POSIX architecture, the file
# must be read also from here.
source "soc/nordic/common/Kconfig.peripherals"

source "boards/native/common/extra_args/Kconfig"

endif # SOC_SERIES_BSIM_NRFXX


# This would eventually be shared by a possible family of simulated NRF boards
# which use BabbleSim. When that happens, we can move this to a common
# Kconfig file

config SOC_SERIES_BSIM_NRFXX
	bool
	select NATIVE_LIBRARY
	select SOC_COMPATIBLE_NRF
	select HAS_NRFX
	select HAS_NORDIC_DRIVERS
	select PINCTRL_DYNAMIC if PINCTRL
	help
	  Any NRF simulated SOC with BabbleSim, based on the POSIX arch

config SOC_SERIES_BSIM_NRF52X
	bool
	select SOC_SERIES_BSIM_NRFXX
	select SOC_COMPATIBLE_NRF52X
	help
	  Any NRF52 simulated SOC with BabbleSim, based on the POSIX arch

config SOC_SERIES_BSIM_NRF53X
	bool
	select SOC_SERIES_BSIM_NRFXX
	select SOC_COMPATIBLE_NRF53X
	help
	  Any NRF53 simulated SOC with BabbleSim, based on the POSIX arch

config SOC_SERIES_BSIM_NRF54LX
	bool
	select SOC_SERIES_BSIM_NRFXX
	select SOC_COMPATIBLE_NRF54LX
	help
	  Any NRF54L simulated SOC with BabbleSim, based on the POSIX arch

if BOARD_NRF5340BSIM_NRF5340_CPUAPP

# Replica of the option provided by the BOARD_NRF5340DK_NRF5340_CPUAPP board so samples can be
# reused as is
config BOARD_ENABLE_CPUNET
	bool "NRF53 Network MCU"

endif # BOARD_NRF5340BSIM_NRF5340_CPUNET

if SOC_SERIES_BSIM_NRF53X

# Let's reuse the RTC sync options so applications which use it can be reused as is
source "soc/nordic/nrf53/Kconfig.sync_rtc"

endif # SOC_SERIES_BSIM_NRF53X
```

## boards/native/nrf_bsim/Kconfig.defconfig
```kconfig
# SPDX-License-Identifier: Apache-2.0
# Copyright (c) 2023 Nordic Semiconductor ASA

if SOC_SERIES_BSIM_NRFXX

config BUILD_OUTPUT_BIN
	default n

config BUILD_OUTPUT_EXE
	# When the IPC service is used, the net core image requires the application core image, as it needs
	# access to its IPC buffer. Without it, the executable cannot be built.
	default y if !(BOARD_NRF5340BSIM_NRF5340_CPUNET && IPC_SERVICE && (NATIVE_SIMULATOR_EXTRA_IMAGE_PATHS = ""))

config OUTPUT_PRINT_MEMORY_USAGE
	default n

config NATIVE_SIMULATOR_NUMBER_MCUS
	default 2 if BOARD_NRF5340BSIM_NRF5340_CPUNET || BOARD_NRF5340BSIM_NRF5340_CPUAPP
	default 1

config NATIVE_SIMULATOR_MCU_N
	default 1 if BOARD_NRF5340BSIM_NRF5340_CPUNET
	default 0

config NATIVE_SIMULATOR_AUTOSTART_MCU
	default y if BOARD_NRF5340BSIM_NRF5340_CPUNET

config NATIVE_SIMULATOR_PRIMARY_MCU_INDEX
	default 1 if SOC_SERIES_BSIM_NRF53X
	default 0

config SYS_CLOCK_HW_CYCLES_PER_SEC
	default 1000000 if NRF_GRTC_TIMER
	default 32768

config SYS_CLOCK_TICKS_PER_SEC
	default 128 if !TICKLESS_KERNEL
	default 10000 if NRF_GRTC_TIMER
	default 32768

config BT_CTLR
	default y if BOARD_NRF52_BSIM || BOARD_NRF5340BSIM_NRF5340_CPUNET
	depends on BT

config HEAP_MEM_POOL_ADD_SIZE_BOARD
	int
	default 4096 if BT_HCI_IPC
	default 4096 if NRF_802154_SER_HOST && BOARD_NRF5340BSIM_NRF5340_CPUAPP
	default 4096 if NRF_802154_SER_RADIO && BOARD_NRF5340BSIM_NRF5340_CPUNET

if BOARD_NRF5340BSIM_NRF5340_CPUAPP || BOARD_NRF5340BSIM_NRF5340_CPUNET

config MBOX_NRFX_IPC
	default MBOX

endif # BOARD_NRF5340BSIM_NRF5340_CPUAPP || BOARD_NRF5340BSIM_NRF5340_CPUNET

if BOARD_NRF5340BSIM_NRF5340_CPUAPP

config IPC_SERVICE_BACKEND_RPMSG_SHMEM_RESET
	default y if IPC_SERVICE_BACKEND_RPMSG

config BT_HCI_IPC
	default y if BT

endif # BOARD_NRF5340BSIM_NRF5340_CPUAPP

# The 15.4 driver Tx encryption is currently not functional with this
# simulated board => we disable it by default. With this Openthread will normally
# default to encrypt packets on its own.
config NRF_802154_ENCRYPTION
	default n

if CONSOLE

config POSIX_ARCH_CONSOLE
	default y

endif # CONSOLE

endif # SOC_SERIES_BSIM_NRFXX
```

## boards/native/nrf_bsim/Kconfig.nrf52_bsim
```kconfig
# Copyright (c) 2024 Nordic Semiconductor ASA
# SPDX-License-Identifier: Apache-2.0

config BOARD_NRF52_BSIM
	select SOC_POSIX
```

## boards/native/nrf_bsim/Kconfig.nrf5340bsim
```kconfig
# Copyright (c) 2024 Nordic Semiconductor ASA
# SPDX-License-Identifier: Apache-2.0

config BOARD_NRF5340BSIM
	select SOC_POSIX
```

## boards/native/nrf_bsim/Kconfig.nrf5340bsim_nrf5340_cpunet
```kconfig
# Copyright (c) 2024 Nordic Semiconductor ASA
# SPDX-License-Identifier: Apache-2.0

config BOARD_NRF5340BSIM_NRF5340_CPUNET
	select SOC_POSIX
```

## boards/native/nrf_bsim/Kconfig.nrf54l15bsim
```kconfig
# Copyright (c) 2024 Nordic Semiconductor ASA
# SPDX-License-Identifier: Apache-2.0

config BOARD_NRF54L15BSIM
	select SOC_POSIX
```

## boards/native/nrf_bsim/Kconfig.nrf54lm20bsim
```kconfig
# Copyright (c) 2024 Nordic Semiconductor ASA
# SPDX-License-Identifier: Apache-2.0

config BOARD_NRF54LM20BSIM
	select SOC_POSIX
```

## boards/native/nrf_bsim/nrf52_bsim_defconfig
```kconfig
# Copyright (c) 2024 Nordic Semiconductor ASA
# SPDX-License-Identifier: Apache-2.0

CONFIG_CONSOLE=y
CONFIG_NO_OPTIMIZATIONS=y
```

## boards/native/nrf_bsim/nrf5340bsim_nrf5340_cpuapp_defconfig
```kconfig
# SPDX-License-Identifier: Apache-2.0
# Copyright (c) 2023 Nordic Semiconductor ASA

CONFIG_CONSOLE=y
CONFIG_NO_OPTIMIZATIONS=y
```

## boards/native/nrf_bsim/nrf54l15bsim_nrf54l15_cpuapp_defconfig
```kconfig
# SPDX-License-Identifier: Apache-2.0
# Copyright (c) 2023 Nordic Semiconductor ASA

CONFIG_CONSOLE=y
CONFIG_NO_OPTIMIZATIONS=y

# Start SYSCOUNTER on driver init
CONFIG_NRF_GRTC_START_SYSCOUNTER=y
```

## boards/nice/promicro_nrf52840/Kconfig
```kconfig
# Copyright (c) 2024 MASSDRIVER EI (massdriver.space)
# SPDX-License-Identifier: Apache-2.0

if BOARD_PROMICRO_NRF52840

config BOARD_HAS_NRF5_BOOTLOADER
	bool "Board has nRF5 bootloader"
	default y
	help
	  If selected, applications are linked so that they can be loaded by Nordic
	  nRF5 bootloader.

config BOARD_SERIAL_BACKEND_CDC_ACM
	bool "USB CDC"
	default y

endif # BOARD_PROMICRO_NRF52840
```

## boards/nice/promicro_nrf52840/board.yml
```yaml
board:
  name: promicro_nrf52840
  full_name: Nice!Nano Pro Micro nRF52840
  socs:
  - name: nrf52840
    variants:
    - name: uf2
```

## boards/nios2/altera_max10/Kconfig.altera_max10
```kconfig
# Copyright (c) 2022 Zephyr Project members and individual contributors
# SPDX-License-Identifier: Apache-2.0

config BOARD_ALTERA_MAX10
	bool
	default y
	select SOC_NIOS2F_ZEPHYR
```

## boards/nios2/altera_max10/Kconfig.board
```kconfig
# Altera MAX10 Board

# SPDX-License-Identifier: Apache-2.0

config BOARD_ALTERA_MAX10
	def_bool "$(BOARD)" = "altera_max10"
	depends on SOC_NIOS2F_ZEPHYR
```

## boards/nios2/altera_max10/Kconfig.defconfig
```kconfig
# SPDX-License-Identifier: Apache-2.0

if BOARD_ALTERA_MAX10

config BOARD
	default "altera_max10"

if FLASH

config SOC_FLASH_NIOS2_QSPI
	default y

if SOC_FLASH_NIOS2_QSPI

if DISK_DRIVER_FLASH

endif # DISK_DRIVER_FLASH

endif # SOC_FLASH_NIOS2_QSPI

endif # FLASH

endif # BOARD_ALTERA_MAX10
```

## boards/nios2/altera_max10/altera_max10_defconfig
```kconfig
# SPDX-License-Identifier: Apache-2.0

CONFIG_HAS_ALTERA_HAL=y
CONFIG_CONSOLE=y
CONFIG_SERIAL=y
CONFIG_UART_CONSOLE=y
```

## boards/nios2/qemu_nios2/Kconfig.board
```kconfig
# QEMU NIOS II target

# SPDX-License-Identifier: Apache-2.0

config BOARD_QEMU_NIOS2
	def_bool "$(BOARD)" = "qemu_nios2"
	depends on SOC_NIOS2_QEMU
	select QEMU_TARGET
```
