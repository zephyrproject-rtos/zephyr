/*
 * Copyright (c) 2023 TOKITA Hiroshi <tokita.hiroshi@fujitsu.com>
 *
 * SPDX-License-Identifier: Apache-2.0
 */

&pinctrl {
	sci2_default: sci2_default {
		group1 {
			/* tx */
			psels = <RA_PSEL(RA_PSEL_SCI_2, 3, 2)>;
			drive-strength = "medium";
		};
		group2 {
			/* rx */
			psels = <RA_PSEL(RA_PSEL_SCI_2, 3, 1)>;
		};
	};
};
