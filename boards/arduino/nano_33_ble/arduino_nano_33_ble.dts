/*
 * Copyright (c) 2020 Jefferson Lee
 *
 * SPDX-License-Identifier: Apache-2.0
 */
/dts-v1/;
#include <nordic/nrf52840_qiaa.dtsi>
#include "arduino_nano_33_ble-common.dtsi"
#include "arduino_nano_33_ble-pinctrl.dtsi"
#include "arduino_nano_connector.dtsi"

/ {
	compatible = "arduino,arduino_nano_33_ble";
	model = "Arduino Nano 33 BLE";
};
