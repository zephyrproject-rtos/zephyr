/*
 * SPDX-License-Identifier: Apache-2.0
 *
 * Copyright (c) 2023 Benjamin Björnsson <benjamin.bjornsson@gmail.com>
 */

/ {
	dma_test_dmac: dma-test-dmac {
		compatible = "test-dma-memory-to-memory";
		dma = <&dmac>;
		max-transfer-size = <2048>;
	};
};

&dmac {
	status = "okay";
};
