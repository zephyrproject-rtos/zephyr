## boards/arduino/nesso_n1/Kconfig
```kconfig
# Copyright (c) 2026 Carlo Caione <ccaione@baylibre.com>
# SPDX-License-Identifier: Apache-2.0

config HEAP_MEM_POOL_ADD_SIZE_BOARD
	int
	default 4096 if BOARD_ARDUINO_NESSO_N1_ESP32C6_HPCORE
	default 256 if BOARD_ARDUINO_NESSO_N1_ESP32C6_LPCORE
```

## boards/arduino/nesso_n1/Kconfig.arduino_nesso_n1
```kconfig
# Arduino Nesso N1 board configuration
#
# Copyright (c) 2026 Carlo Caione <ccaione@baylibre.com>
# SPDX-License-Identifier: Apache-2.0

config BOARD_ARDUINO_NESSO_N1
	select SOC_ESP32C6
	select SOC_ESP32C6_HPCORE if BOARD_ARDUINO_NESSO_N1_ESP32C6_HPCORE
	select SOC_ESP32C6_LPCORE if BOARD_ARDUINO_NESSO_N1_ESP32C6_LPCORE
```

## boards/arduino/nesso_n1/Kconfig.defconfig
```kconfig
# Arduino Nesso N1 board configuration
#
# Copyright (c) 2026 Carlo Caione <ccaione@baylibre.com>
# SPDX-License-Identifier: Apache-2.0

if BOARD_ARDUINO_NESSO_N1_ESP32C6_HPCORE

configdefault LV_COLOR_16_SWAP
	default y if LVGL

# The FT6336 IRQ delivery is unreliable on this board; use polling.
configdefault INPUT_FT5336_INTERRUPT
	default n

endif # BOARD_ARDUINO_NESSO_N1_ESP32C6_HPCORE
```

## boards/arduino/nesso_n1/arduino_nesso_n1_esp32c6_lpcore_defconfig
```kconfig
# Copyright (c) 2026 Carlo Caione <ccaione@baylibre.com>
# SPDX-License-Identifier: Apache-2.0

# Memory protection
CONFIG_THREAD_STACK_INFO=n
CONFIG_THREAD_CUSTOM_DATA=n

# Boot
CONFIG_BOOT_BANNER=n

# Console
CONFIG_PRINTK=n

# Build
CONFIG_SIZE_OPTIMIZATIONS=y
```

## boards/arduino/nesso_n1/board.yml
```yaml
board:
  name: arduino_nesso_n1
  full_name: Arduino Nesso N1
  vendor: arduino
  socs:
  - name: esp32c6
```

## boards/arduino/nicla_sense_me/arduino_nicla_sense_me_defconfig
```kconfig
# SPDX-License-Identifier: Apache-2.0

# Enable MPU
CONFIG_ARM_MPU=y
CONFIG_HW_STACK_PROTECTION=y

# enable GPIO
CONFIG_GPIO=y

# enable uart driver
CONFIG_SERIAL=y

# enable console
CONFIG_CONSOLE=y
CONFIG_UART_CONSOLE=y
```

## boards/arduino/nicla_sense_me/board.yml
```yaml
board:
  name: arduino_nicla_sense_me
  full_name: Arduino Nicla Sense ME
  vendor: arduino
  socs:
  - name: nrf52832
```

## boards/arduino/nicla_vision/Kconfig.arduino_nicla_vision
```kconfig
# Copyright 2024 Felipe Neves
# SPDX-License-Identifier: Apache-2.0

config BOARD_ARDUINO_NICLA_VISION
	select SOC_STM32H747XX_M7 if BOARD_ARDUINO_NICLA_VISION_STM32H747XX_M7
	select SOC_STM32H747XX_M4 if BOARD_ARDUINO_NICLA_VISION_STM32H747XX_M4
```

## boards/arduino/nicla_vision/Kconfig.defconfig
```kconfig
# Copyright 2024 Felipe Neves
# SPDX-License-Identifier: Apache-2.0

if BOARD_ARDUINO_NICLA_VISION

if BOARD_ARDUINO_NICLA_VISION_STM32H747XX_M7
source "boards/common/usb/Kconfig.cdc_acm_serial.defconfig"
endif

if BT

choice AIROC_PART
	default CYW4343W
endchoice

choice CYW4343W_MODULE
	default CYW4343W_MURATA_1DX
endchoice

endif # BT

endif # BOARD_ARDUINO_NICLA_VISION
```

## boards/arduino/nicla_vision/arduino_nicla_vision_stm32h747xx_m4_defconfig
```kconfig
# Copyright 2024 Felipe Neves
# SPDX-License-Identifier: Apache-2.0

# Enable GPIO
CONFIG_GPIO=y

# Enable MPU
CONFIG_ARM_MPU=y

# Enable HW stack protection
CONFIG_HW_STACK_PROTECTION=y

# On M4, USART4 is used as the UART console backend by default
CONFIG_SERIAL=y
CONFIG_CONSOLE=y
CONFIG_UART_CONSOLE=y
```

## boards/arduino/nicla_vision/board.yml
```yaml
board:
  name: arduino_nicla_vision
  full_name: Arduino Nicla Vision
  vendor: arduino
  socs:
    - name: stm32h747xx
```

## boards/arduino/opta/Kconfig.arduino_opta
```kconfig
# Copyright (c) 2023 Felipe Neves
# Copyright (c) 2024 DNDG srl
# SPDX-License-Identifier: Apache-2.0

config BOARD_ARDUINO_OPTA
	select SOC_STM32H747XX_M4 if BOARD_ARDUINO_OPTA_STM32H747XX_M4
	select SOC_STM32H747XX_M7 if BOARD_ARDUINO_OPTA_STM32H747XX_M7
```

## boards/arduino/opta/Kconfig.defconfig
```kconfig
# Copyright 2024 Rahul Arasikere <arasikere.rahul@gmail.com>
# Copyright 2024 DNDG srl
# SPDX-License-Identifier: Apache-2.0

if BOARD_ARDUINO_OPTA

configdefault NET_L2_ETHERNET
	default y

if BOARD_ARDUINO_OPTA_STM32H747XX_M7

source "boards/common/usb/Kconfig.cdc_acm_serial.defconfig"

endif # BOARD_ARDUINO_OPTA_STM32H747XX_M7

if WIFI_AIROC

config HEAP_MEM_POOL_ADD_SIZE_BOARD
	int
	default 20480

endif # WIFI_AIROC

endif # BOARD_ARDUINO_OPTA
```

## boards/arduino/opta/arduino_opta_stm32h747xx_m4_defconfig
```kconfig
# Copyright (c) 2023 Felipe Neves
# SPDX-License-Identifier: Apache-2.0

# Enable GPIO
CONFIG_GPIO=y

# Enable MPU
CONFIG_ARM_MPU=y

# Enable HW stack protection
CONFIG_HW_STACK_PROTECTION=y

# Use zephyr,code-partition as flash offset
CONFIG_USE_DT_CODE_PARTITION=y
```

## boards/arduino/opta/arduino_opta_stm32h747xx_m7_defconfig
```kconfig
# Copyright (c) 2023 Felipe Neves
# Copyright (c) 2024 DNDG srl
# SPDX-License-Identifier: Apache-2.0

# Enable GPIO
CONFIG_GPIO=y

# Clock configuration
CONFIG_CLOCK_CONTROL=y

# Enable MPU
CONFIG_ARM_MPU=y

# Enable HW stack protection
CONFIG_HW_STACK_PROTECTION=y

# Use zephyr,code-partition as flash offset
CONFIG_USE_DT_CODE_PARTITION=y

# Enable correct power supply
CONFIG_POWER_SUPPLY_SMPS_1V8_SUPPLIES_EXT_AND_LDO=y

# Don't start M4 during the M7 boot (this is what the original Opta does)
CONFIG_STM32H7_BOOT_M4_AT_INIT=n

# Enable console
CONFIG_SERIAL=y
CONFIG_CONSOLE=y
CONFIG_UART_CONSOLE=y

# Enable USB Stack (needed for the console to work)
CONFIG_USB_DEVICE_STACK=y
```

## boards/arduino/opta/board.yml
```yaml
board:
  name: arduino_opta
  full_name: Arduino OPTA
  vendor: arduino
  socs:
    - name: stm32h747xx
```

## boards/arduino/opta/dts/bindings/gpio-power-switches.yaml
```yaml
# Copyright (c) 2024 DNDG srl
# SPDX-License-Identifier: Apache-2.0

description: |
  This allows to define a group of relays (like in the original Opta)
  or other kinds of power switches controlled by a GPIO. Each power
  switch is defined in a child node of the gpio-power-switches node.

compatible: "gpio-power-switches"

child-binding:
  description: GPIO power switch child node
  properties:
    gpios:
      type: phandle-array
      required: true
```

## boards/arduino/portenta_c33/Kconfig.arduino_portenta_c33
```kconfig
# Copyright (c) 2025 Arduino SA
# SPDX-License-Identifier: Apache-2.0

config BOARD_ARDUINO_PORTENTA_C33
	select SOC_R7FA6M5BH3CFC
```

## boards/arduino/portenta_c33/arduino_portenta_c33_defconfig
```kconfig
# Copyright (c) 2025 Arduino SA
# SPDX-License-Identifier: Apache-2.0

CONFIG_GPIO=y

CONFIG_BUILD_OUTPUT_BIN=y

CONFIG_SERIAL=y
CONFIG_UART_CONSOLE=y
CONFIG_UART_INTERRUPT_DRIVEN=y
CONFIG_CONSOLE=y

CONFIG_DYNAMIC_INTERRUPTS=y

CONFIG_REGULATOR=y
```

## boards/arduino/portenta_c33/board.yml
```yaml
board:
  name: arduino_portenta_c33
  full_name: Arduino Portenta C33
  vendor: arduino
  socs:
  - name: r7fa6m5bh3cfc
```

## boards/arduino/portenta_h7/Kconfig.arduino_portenta_h7
```kconfig
# Arduino Portenta H7 board configuration

# Copyright (c) 2022 Benjamin Björnsson <benjamin.bjornsson@gmail.com>.
# SPDX-License-Identifier: Apache-2.0

config BOARD_ARDUINO_PORTENTA_H7
	select SOC_STM32H747XX_M7 if BOARD_ARDUINO_PORTENTA_H7_STM32H747XX_M7
	select SOC_STM32H747XX_M4 if BOARD_ARDUINO_PORTENTA_H7_STM32H747XX_M4
```

## boards/arduino/portenta_h7/Kconfig.defconfig
```kconfig
# Copyright 2024 Rahul Arasikere <arasikere.rahul@gmail.com>
# SPDX-License-Identifier: Apache-2.0

if BOARD_ARDUINO_PORTENTA_H7

configdefault REGULATOR
	default y if NETWORKING

configdefault NET_L2_ETHERNET
	default y

if BOARD_ARDUINO_PORTENTA_H7_STM32H747XX_M7

source "boards/common/usb/Kconfig.cdc_acm_serial.defconfig"

endif # BOARD_ARDUINO_PORTENTA_H7_STM32H747XX_M7

if WIFI_AIROC

config HEAP_MEM_POOL_ADD_SIZE_BOARD
	int
	default 20480

endif # WIFI_AIROC

endif # BOARD_ARDUINO_PORTENTA_H7

if BT

choice AIROC_PART
	default CYW4343W
endchoice

choice CYW4343W_MODULE
	default CYW4343W_MURATA_1DX
endchoice

endif # BT
```

## boards/arduino/portenta_h7/arduino_portenta_h7_stm32h747xx_m4_defconfig
```kconfig
# Copyright (c) 2022 Benjamin Björnsson <benjamin.bjornsson@gmail.com>.
# SPDX-License-Identifier: Apache-2.0

# Enable GPIO
CONFIG_GPIO=y

# Enable MPU
CONFIG_ARM_MPU=y

# Enable HW stack protection
CONFIG_HW_STACK_PROTECTION=y

# On M4, USART1 is used as the UART console backend by default
CONFIG_SERIAL=y
CONFIG_CONSOLE=y
CONFIG_UART_CONSOLE=y
```

## boards/arduino/portenta_h7/arduino_portenta_h7_stm32h747xx_m7_defconfig
```kconfig
# Copyright (c) 2022 Benjamin Björnsson <benjamin.bjornsson@gmail.com>.
# SPDX-License-Identifier: Apache-2.0

# Enable GPIO
CONFIG_GPIO=y

# Enable MPU
CONFIG_ARM_MPU=y

# Enable HW stack protection
CONFIG_HW_STACK_PROTECTION=y

# Use zephyr,code-partition as flash offset
CONFIG_USE_DT_CODE_PARTITION=y

# On M7, USB CDC ACM is used as the UART console backend by default

# Enable regulator
CONFIG_REGULATOR=y
CONFIG_REGULATOR_FIXED=y
```
