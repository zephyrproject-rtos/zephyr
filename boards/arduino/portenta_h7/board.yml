## boards/arduino/portenta_h7/board.yml
```yaml
board:
  name: arduino_portenta_h7
  vendor: arduino
  socs:
    - name: stm32h747xx
  revision:
    format: major.minor.patch
    default: 1.0.0
    revisions:
      - name: 1.0.0
      - name: 4.10.0
```

## boards/arduino/uno_q/Kconfig.arduino_uno_q
```kconfig
# Copyright (c) 2025 Arduino SA
# SPDX-License-Identifier: Apache-2.0

config BOARD_ARDUINO_UNO_Q
	select SOC_STM32U585XX
```

## boards/arduino/uno_q/Kconfig.defconfig
```kconfig
# Copyright (c) 2025 Arduino SA
# SPDX-License-Identifier: Apache-2.0

if BOARD_ARDUINO_UNO_Q

config SPI_STM32_INTERRUPT
	default y
	depends on SPI

endif # BOARD_ARDUINO_UNO_Q
```

## boards/arduino/uno_q/arduino_uno_q_defconfig
```kconfig
# SPDX-License-Identifier: Apache-2.0

# Enable UART driver
CONFIG_SERIAL=y

# Enable GPIO
CONFIG_GPIO=y

# Enable console
CONFIG_CONSOLE=y
CONFIG_UART_CONSOLE=y
```

## boards/arduino/uno_q/board.yml
```yaml
board:
  name: arduino_uno_q
  full_name: Arduino UNO Q
  vendor: arduino
  socs:
    - name: stm32u585xx
```

## boards/arduino/uno_r4/Kconfig.arduino_uno_r4
```kconfig
# Copyright (c) 2023 TOKITA Hiroshi <tokita.hiroshi@fujitsu.com>
# SPDX-License-Identifier: Apache-2.0

config BOARD_ARDUINO_UNO_R4
	select SOC_R7FA4M1AB3CFM
```

## boards/arduino/uno_r4/Kconfig.arduino_uno_r4_wifi
```kconfig
# Copyright (c) 2024 TOKITA Hiroshi <tokita.hiroshi@fujitsu.com>
# SPDX-License-Identifier: Apache-2.0

config BOARD_ARDUINO_UNO_R4_WIFI
	select SOC_R7FA4M1AB3CFM
```

## boards/arduino/uno_r4/arduino_uno_r4_minima_defconfig
```kconfig
# Copyright (c) 2023 TOKITA Hiroshi <tokita.hiroshi@fujitsu.com>
# SPDX-License-Identifier: Apache-2.0

CONFIG_SYS_CLOCK_HW_CYCLES_PER_SEC=48000000

CONFIG_BUILD_OUTPUT_HEX=y

# Enable UART driver
CONFIG_SERIAL=y
CONFIG_UART_INTERRUPT_DRIVEN=y

# Enable console
CONFIG_CONSOLE=y
CONFIG_UART_CONSOLE=y

# Enable GPIO
CONFIG_GPIO=y

CONFIG_CLOCK_CONTROL=y

CONFIG_USE_DT_CODE_PARTITION=y
```

## boards/arduino/uno_r4/board.yml
```yaml
board:
  name: arduino_uno_r4
  full_name: Arduino UNO R4 Minima/WiFi
  vendor: arduino
  revision:
    format: custom
    default: "minima"
    revisions:
      - name: "minima"
      - name: "wifi"
  socs:
    - name: r7fa4m1ab3cfm
```

## boards/arduino/uno_r4_minima/board.yml
```yaml
board:
  name: arduino_uno_r4_minima
  vendor: arduino
  socs:
  - name: r7fa4m1ab3cfm
```

## boards/arduino/zero/Kconfig.arduino_zero
```kconfig
# Copyright (c) 2017 Google LLC.
# Copyright (c) 2024 Gerson Fernando Budke <nandojve@gmail.com>
# SPDX-License-Identifier: Apache-2.0

config BOARD_ARDUINO_ZERO
	select SOC_SAMD21G18A
```

## boards/arduino/zero/board.yml
```yaml
board:
  name: arduino_zero
  full_name: Arduino/Genuino Zero
  vendor: arduino
  socs:
    - name: samd21g18a
```

## boards/arduino_101/Kconfig
```kconfig
if BOARD_ARDUINO_101

config BOARD
        default "arduino_101"

if NBLE

config GPIO
	def_bool y

config NBLE_UART_ON_DEV_NAME
        default UART_NS16550_PORT_0_NAME

endif

if UART_PIPE

config UART_PIPE_ON_DEV_NAME
	default UART_NS16550_PORT_1_NAME

endif

if FLASH

config SPI_FLASH_W25QXXDV
	def_bool y
config SPI_FLASH_W25QXXDV_SPI_NAME
	default SPI_DW_PORT_0_DRV_NAME
config SPI_FLASH_W25QXXDV_SPI_SLAVE
	default 1

endif

if COUNTER

config AON_TIMER_IRQ
	default 28
config AON_TIMER_IRQ_PRI
	default 2

endif

endif # BOARD_ARDUINO_101
```

## boards/arduino_101/Kconfig.board
```kconfig
config  BOARD_ARDUINO_101
        bool "Arduino 101 Board"
        depends on SOC_QUARK_SE
```

## boards/arduino_101/Kconfig.defconfig
```kconfig
if BOARD_ARDUINO_101

config BOARD
        default "arduino_101"

if NBLE

config BLUETOOTH_NRF51_PM
	def_bool y

config NBLE_UART_ON_DEV_NAME
        default UART_NS16550_PORT_0_NAME

endif

if BLUETOOTH_H4

config BLUETOOTH_NRF51_PM
	def_bool y

config NBLE_UART_ON_DEV_NAME
        default UART_NS16550_PORT_0_NAME

endif

if UART_PIPE

config UART_PIPE_ON_DEV_NAME
	default UART_NS16550_PORT_1_NAME

endif

if FLASH && SPI

config SPI_FLASH_W25QXXDV
	def_bool y

if SPI_FLASH_W25QXXDV

config SPI_FLASH_W25QXXDV_SPI_NAME
	default SPI_DW_PORT_0_DRV_NAME
config SPI_FLASH_W25QXXDV_SPI_SLAVE
	default 1

endif # SPI_FLASH_W25QXXDV

endif # FLASH && SPI

endif # BOARD_ARDUINO_101
```

## boards/arduino_101/arduino_101_defconfig
```kconfig
CONFIG_X86=y
CONFIG_SOC_QUARK_SE=y
CONFIG_BOARD_ARDUINO_101=y
CONFIG_CPU_MINUTEIA=y
CONFIG_CONSOLE=y
CONFIG_UART_CONSOLE=y
CONFIG_SERIAL=y
CONFIG_UART_IRQ_RISING_EDGE=y
CONFIG_UART_NS16550=y
CONFIG_UART_NS16550_PORT_0_BAUD_RATE=1000000
CONFIG_UART_NS16550_PORT_0_OPTIONS=1
CONFIG_PRINTK=y
CONFIG_IPM=y
CONFIG_IPM_QUARK_SE=y
CONFIG_IPM_QUARK_SE_MASTER=y
CONFIG_IPM_CONSOLE_RECEIVER=y
CONFIG_ARC_INIT=y
CONFIG_PINMUX=y
CONFIG_SPI_DW_LEVEL_HIGH=y
```

## boards/arduino_101_sss/Kconfig.board
```kconfig
config  BOARD_ARDUINO_101_SSS
        bool "Arduino 101 Sensor Sub System"
        select PLATFORM_QUARK_SE_SS
	depends on ARC
```

## boards/arduino_101_sss/Kconfig.defconfig
```kconfig
if BOARD_ARDUINO_101_SSS

config BOARD
	default "arduino_101_sss"

endif # BOARD_ARDUINO_101_SSS
```

## boards/arduino_due/Kconfig
```kconfig
if BOARD_ARDUINO_DUE

config BOARD
	default arduino_due

if PINMUX

# The pinmux driver does not care
# base address or pin counts.
# So define both as 0.
config PINMUX_BASE
	default 0

config PINMUX_NUM_PINS
	default 0

endif # PINMUX

endif # BOARD_ARDUINO_DUE
```

## boards/arduino_due/Kconfig.board
```kconfig
config BOARD_ARDUINO_DUE
	bool "Arduino Due Board"
	depends on SOC_ATMEL_SAM3X8E
```

## boards/arduino_due/Kconfig.defconfig
```kconfig
if BOARD_ARDUINO_DUE

config BOARD
	default arduino_due

if I2C

config I2C_ATMEL_SAM3
	default y

if I2C_ATMEL_SAM3

config I2C_ATMEL_SAM3_0
	default y

config I2C_ATMEL_SAM3_1
	default y

endif # I2C_ATMEL_SAM3

endif # I2C

endif # BOARD_ARDUINO_DUE
```

## boards/arduino_due/arduino_due_defconfig
```kconfig
CONFIG_ARM=y
CONFIG_SOC_ATMEL_SAM3X8E=y
CONFIG_BOARD_ARDUINO_DUE=y
CONFIG_CORTEX_M_SYSTICK=y
CONFIG_CONSOLE=y
CONFIG_UART_CONSOLE=y
CONFIG_SERIAL=y
CONFIG_UART_ATMEL_SAM3=y
CONFIG_SOC_ATMEL_SAM3_EXT_MAINCK=y
CONFIG_PINMUX=y
```

## boards/arm/96b_aerocore2/96b_aerocore2_defconfig
```kconfig
# Copyright (c) 2020 Linaro Limited
# SPDX-License-Identifier: Apache-2.0

CONFIG_SOC_SERIES_STM32F4X=y
CONFIG_SOC_STM32F427XX=y
# 168MHz system clock
CONFIG_SYS_CLOCK_HW_CYCLES_PER_SEC=168000000

# Enable MPU
CONFIG_ARM_MPU=y

CONFIG_SERIAL=y

# console
CONFIG_CONSOLE=y
CONFIG_UART_CONSOLE=y

# enable pinmux
CONFIG_PINMUX=y

# enable GPIO
CONFIG_GPIO=y

# clock configuration
CONFIG_CLOCK_CONTROL=y


# SYSCLK selection
CONFIG_CLOCK_STM32_SYSCLK_SRC_PLL=y

# use HSE as PLL input
CONFIG_CLOCK_STM32_PLL_SRC_HSE=y
CONFIG_CLOCK_STM32_HSE_CLOCK=24000000

# produce 168MHz clock at PLL output
CONFIG_CLOCK_STM32_PLL_M_DIVISOR=24
CONFIG_CLOCK_STM32_PLL_N_MULTIPLIER=336
CONFIG_CLOCK_STM32_PLL_P_DIVISOR=2
CONFIG_CLOCK_STM32_PLL_Q_DIVISOR=7
CONFIG_CLOCK_STM32_AHB_PRESCALER=1

# APB1 clock must not exceed 50MHz limit
CONFIG_CLOCK_STM32_APB1_PRESCALER=4
CONFIG_CLOCK_STM32_APB2_PRESCALER=2
```

## boards/arm/96b_aerocore2/Kconfig.board
```kconfig
#  Copyright (c) 2020 Linaro Limited
#  SPDX-License-Identifier: Apache-2.0

config BOARD_96B_AEROCORE2
	bool "96Boards AEROCORE2 (STM32F427)"
	depends on SOC_STM32F427XX
```

## boards/arm/96b_argonkey/96b_argonkey_defconfig
```kconfig
# SPDX-License-Identifier: Apache-2.0

CONFIG_SOC_SERIES_STM32F4X=y
CONFIG_SOC_STM32F412CG=y

# 84MHz system clock
CONFIG_SYS_CLOCK_HW_CYCLES_PER_SEC=84000000

# Enable MPU
CONFIG_ARM_MPU=y

# enable uart driver
CONFIG_SERIAL=y

# enable pinmux
CONFIG_PINMUX=y

# enable GPIO
CONFIG_GPIO=y

# clock configuration
CONFIG_CLOCK_CONTROL=y

# SYSCLK selection
CONFIG_CLOCK_STM32_SYSCLK_SRC_PLL=y

# PLL configuration
CONFIG_CLOCK_STM32_PLL_SRC_HSE=y
CONFIG_CLOCK_STM32_HSE_CLOCK=16000000

# produce 84MHz clock at PLL output
CONFIG_CLOCK_STM32_PLL_M_DIVISOR=8
CONFIG_CLOCK_STM32_PLL_N_MULTIPLIER=84
CONFIG_CLOCK_STM32_PLL_P_DIVISOR=2
CONFIG_CLOCK_STM32_PLL_Q_DIVISOR=8
CONFIG_CLOCK_STM32_AHB_PRESCALER=1

# APB1 clock must not exceed 50MHz limit
# APB2 clock is fixed at 42MHz to prevent known SPI/I2S bug
CONFIG_CLOCK_STM32_APB1_PRESCALER=2
CONFIG_CLOCK_STM32_APB2_PRESCALER=2

# console
CONFIG_CONSOLE=y
CONFIG_UART_CONSOLE=y
```
