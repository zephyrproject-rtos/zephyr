/**
 * Copyright (c) 2024 Rahul Arasikere <arasikere.rahul@gmail.com>.
 *
 * SPDX-License-Identifier: Apache-2.0
 */

&clk_lsi {
	status = "okay";
};

&rtc {
	clocks = <&rcc STM32_CLOCK(APB4, 16)>,
		 <&rcc STM32_SRC_LSI RTC_SEL(2)>;
	status = "okay";
};
