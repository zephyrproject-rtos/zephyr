## boards/arduino/arduino_uno_r4_minima/board.yml
```yaml
board:
  name: arduino_uno_r4_minima
  vendor: Arduino
  socs:
  - name: r7fa4m1ab3cfm
```

## boards/arduino/due/Kconfig.arduino_due
```kconfig
# Copyright (c) 2017 Justin Watson
# SPDX-License-Identifier: Apache-2.0

config BOARD_ARDUINO_DUE
	select SOC_SAM3X8E
```

## boards/arduino/due/board.yml
```yaml
board:
  name: arduino_due
  full_name: Arduino Due
  vendor: arduino
  socs:
    - name: sam3x8e
```

## boards/arduino/giga_r1/Kconfig.defconfig
```kconfig
# Copyright 2023 Google LLC
# SPDX-License-Identifier: Apache-2.0

if BOARD_ARDUINO_GIGA_R1

if BOARD_ARDUINO_GIGA_R1_STM32H747XX_M7
source "boards/common/usb/Kconfig.cdc_acm_serial.defconfig"
endif

if BT

choice AIROC_PART
	default CYW4343W
endchoice

choice CYW4343W_MODULE
	default CYW4343W_MURATA_1DX
endchoice

endif # BT

endif # BOARD_ARDUINO_GIGA_R1
```

## boards/arduino/giga_r1/arduino_giga_r1_stm32h747xx_m4_defconfig
```kconfig
# Copyright 2023 Google LLC
# SPDX-License-Identifier: Apache-2.0

# Enable GPIO
CONFIG_GPIO=y

# Enable MPU
CONFIG_ARM_MPU=y

# Enable HW stack protection
CONFIG_HW_STACK_PROTECTION=y

# On M4, USART2 is used as the UART console backend by default
CONFIG_SERIAL=y
CONFIG_CONSOLE=y
CONFIG_UART_CONSOLE=y
```

## boards/arduino/giga_r1/arduino_giga_r1_stm32h747xx_m7_defconfig
```kconfig
# Copyright 2023 Google LLC
# SPDX-License-Identifier: Apache-2.0

# Disable the internal SMPS regulator
CONFIG_POWER_SUPPLY_DIRECT_SMPS=n

# Enable GPIO
CONFIG_GPIO=y

# Enable MPU
CONFIG_ARM_MPU=y

# Enable HW stack protection
CONFIG_HW_STACK_PROTECTION=y

# On M7, USB CDC ACM is used as the UART console backend by default

# Use zephyr,code-partition as flash offset
CONFIG_USE_DT_CODE_PARTITION=y
```

## boards/arduino/giga_r1/board.yml
```yaml
board:
  name: arduino_giga_r1
  full_name: Arduino GIGA R1 WiFi
  vendor: arduino
  socs:
    - name: stm32h747xx
```

## boards/arduino/mkrzero/Kconfig.arduino_mkrzero
```kconfig
# Copyright (c) 2022 TOKITA Hiroshi <tokita.hiroshi@fujitsu.com>
# Copyright (c) 2024 Gerson Fernando Budke <nandojve@gmail.com>
# SPDX-License-Identifier: Apache-2.0

config BOARD_ARDUINO_MKRZERO
	select SOC_SAMD21G18A
```

## boards/arduino/mkrzero/Kconfig.defconfig
```kconfig
# Arduino MKR Zero board configuration

# Copyright (c) 2022 TOKITA Hiroshi <tokita.hiroshi@fujitsu.com>
# SPDX-License-Identifier: Apache-2.0

if DISK_DRIVERS

config DISK_DRIVER_SDMMC
	default y

config SPI
	default y

config GPIO
	default y

endif # DISK_DRIVERS
```

## boards/arduino/mkrzero/arduino_mkrzero_samd21g18a_defconfig
```kconfig
# Copyright (c) 2024 Gerson Fernando Budke <nandojve@gmail.com>
# SPDX-License-Identifier: Apache-2.0

CONFIG_SOC_ATMEL_SAMD_XOSC32K=y
CONFIG_SOC_ATMEL_SAMD_XOSC32K_AS_MAIN=y

CONFIG_BOOTLOADER_BOSSA=y
CONFIG_BOOTLOADER_BOSSA_ARDUINO=y

CONFIG_CONSOLE=y
CONFIG_SERIAL=y
CONFIG_UART_CONSOLE=y
CONFIG_UART_INTERRUPT_DRIVEN=y
```

## boards/arduino/mkrzero/board.yml
```yaml
board:
  name: arduino_mkrzero
  full_name: Arduino MKR Zero
  vendor: arduino
  socs:
    - name: samd21g18a
```

## boards/arduino/nano_33_ble/Kconfig
```kconfig
# Copyright The Zephyr Project Contributors
# SPDX-License-Identifier: Apache-2.0

config BOARD_ARDUINO_NANO_33_BLE
	select BOARD_EARLY_INIT_HOOK
```

## boards/arduino/nano_33_ble/Kconfig.arduino_nano_33_ble
```kconfig
# Copyright (c) 2020 Jefferson Lee.
# SPDX-License-Identifier: Apache-2.0

config BOARD_ARDUINO_NANO_33_BLE
	select SOC_NRF52840_QIAA
```

## boards/arduino/nano_33_ble/Kconfig.defconfig
```kconfig
# Copyright (c) 2020 Jefferson Lee.
# SPDX-License-Identifier: Apache-2.0

if BOARD_ARDUINO_NANO_33_BLE

config REGULATOR
	default y if SENSOR

endif # BOARD_ARDUINO_NANO_33_BLE
```

## boards/arduino/nano_33_ble/arduino_nano_33_ble_nrf52840_sense_defconfig
```kconfig
# SPDX-License-Identifier: Apache-2.0

# Enable MPU
CONFIG_ARM_MPU=y
CONFIG_HW_STACK_PROTECTION=y

# enable peripherals
CONFIG_GPIO=y
CONFIG_SERIAL=y

# enable console
CONFIG_CONSOLE=y
CONFIG_UART_CONSOLE=y

# enable sam-ba bootloader on legacy mode
CONFIG_BOOTLOADER_BOSSA=y
CONFIG_BOOTLOADER_BOSSA_LEGACY=y
```

## boards/arduino/nano_33_ble/board.yml
```yaml
board:
  name: arduino_nano_33_ble
  full_name: Arduino Nano 33 BLE (Sense)
  vendor: arduino
  revision:
    format: custom
    default: "rev1"
    exact: true
    revisions:
    - name: "rev1"
    - name: "rev2"
  socs:
  - name: nrf52840
    variants:
    - name: 'sense'
```

## boards/arduino/nano_33_iot/Kconfig.arduino_nano_33_iot
```kconfig
# Copyright (c) 2020 Google LLC.
# Copyright (c) 2024 Gerson Fernando Budke <nandojve@gmail.com>
# SPDX-License-Identifier: Apache-2.0

config BOARD_ARDUINO_NANO_33_IOT
	select SOC_SAMD21G18A
```

## boards/arduino/nano_33_iot/board.yml
```yaml
board:
  name: arduino_nano_33_iot
  full_name: Arduino Nano 33 IOT
  vendor: arduino
  socs:
    - name: samd21g18a
```

## boards/arduino/nano_connect/Kconfig
```kconfig
# Copyright (c) Arduino s.r.l. and/or its affiliated companies
# SPDX-License-Identifier: Apache-2.0

config BOARD_ARDUINO_NANO_CONNECT
	select RP2_FLASH_AT25SF128A
```

## boards/arduino/nano_connect/Kconfig.arduino_nano_connect
```kconfig
# Copyright (c) Arduino s.r.l. and/or its affiliated companies
# SPDX-License-Identifier: Apache-2.0

config BOARD_ARDUINO_NANO_CONNECT
	select SOC_RP2040
```

## boards/arduino/nano_connect/board.yml
```yaml
board:
  name: arduino_nano_connect
  full_name: Arduino Nano RP2040 Connect
  vendor: arduino
  socs:
  - name: rp2040
```

## boards/arduino/nano_matter/Kconfig.arduino_nano_matter
```kconfig
# Copyright (c) 2020 Piotr Mienkowski
# Copyright (c) 2020 TriaGnoSys GmbH
# Copyright (c) 2025 Pete Johanson
# Copyright (c) 2025 Silicon Laboratories Inc.
# SPDX-License-Identifier: Apache-2.0

config BOARD_ARDUINO_NANO_MATTER
	select SOC_MGM240SD22VNA
```

## boards/arduino/nano_matter/Kconfig.defconfig
```kconfig
# Copyright (c) 2020 Piotr Mienkowski
# Copyright (c) 2020 TriaGnoSys GmbH
# Copyright (c) 2025 Pete Johanson
# Copyright (c) 2025 Silicon Laboratories Inc.
# SPDX-License-Identifier: Apache-2.0

if BOARD_ARDUINO_NANO_MATTER

config LOG_BACKEND_SWO_FREQ_HZ
	default 875000
	depends on LOG_BACKEND_SWO

if SOC_GECKO_USE_RAIL

config FPU
	default y

endif # SOC_GECKO_USE_RAIL

if BT

config FPU
	default y

config MAIN_STACK_SIZE
	default 3072 if PM
	default 2304

endif # BT

endif # BOARD_ARDUINO_NANO_MATTER
```

## boards/arduino/nano_matter/board.yml
```yaml
board:
  name: arduino_nano_matter
  full_name: Arduino Nano Matter
  vendor: arduino
  socs:
    - name: mgm240sd22vna
```
