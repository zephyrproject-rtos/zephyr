## boards/sparc/generic_leon3/generic_leon3_defconfig
```kconfig
# SPDX-License-Identifier: Apache-2.0

CONFIG_SOC_LEON3=y
CONFIG_BOARD_GENERIC_LEON3=y
CONFIG_CONSOLE=y
CONFIG_SERIAL=y
CONFIG_UART_CONSOLE=y
CONFIG_EXTRA_EXCEPTION_INFO=y
```

## boards/sparc/gr716a_mini/Kconfig.board
```kconfig
# Copyright (c) 2019-2020 Cobham Gaisler AB
#
# SPDX-License-Identifier: Apache-2.0

config BOARD_GR716A_MINI
	bool "GR716-MINI Development Board"
	depends on SOC_GR716A
```

## boards/sparc/gr716a_mini/Kconfig.defconfig
```kconfig
# Copyright (c) 2019-2020 Cobham Gaisler AB
#
# SPDX-License-Identifier: Apache-2.0

if BOARD_GR716A_MINI

config BOARD
	default "gr716a_mini"

config SYS_CLOCK_HW_CYCLES_PER_SEC
	default 20000000

endif
```

## boards/sparc/gr716a_mini/Kconfig.gr716a_mini
```kconfig
# Copyright (c) 2022 Zephyr Project members and individual contributors
# SPDX-License-Identifier: Apache-2.0

config BOARD_GR716A_MINI
	bool
	default y
	select SOC_GR716A
```

## boards/sparc/gr716a_mini/gr716a_mini_defconfig
```kconfig
# SPDX-License-Identifier: Apache-2.0

CONFIG_SOC_GR716A=y
CONFIG_BOARD_GR716A_MINI=y
CONFIG_CONSOLE=y
CONFIG_SERIAL=y
CONFIG_UART_CONSOLE=y
CONFIG_LEON_GPTIMER=y
```

## boards/sparc/qemu_at697/Kconfig.board
```kconfig
#
# Copyright (c) 2018 ispace, inc.
#
# SPDX-License-Identifier: Apache-2.0
#

config BOARD_QEMU_AT697
	bool "AT697 LEON2 Emulation (QEMU)"
	select QEMU_TARGET
```

## boards/sparc/qemu_at697/Kconfig.defconfig
```kconfig
#
# Copyright (c) 2018 ispace, inc.
#
# SPDX-License-Identifier: Apache-2.0
#

if BOARD_QEMU_AT697

config BOARD
	default "qemu_at697"

endif # BOARD_QEMU_AT697
```

## boards/sparc/qemu_at697/qemu_at697_defconfig
```kconfig
CONFIG_SOC_AT697=y
CONFIG_SYS_CLOCK_HW_CYCLES_PER_SEC=12500000
CONFIG_BUILD_OUTPUT_BIN=n

CONFIG_GEN_ISR_TABLES=y
CONFIG_GEN_IRQ_VECTOR_TABLE=n

CONFIG_OVERRIDE_FRAME_POINTER_DEFAULT=y

CONFIG_CONSOLE=y
CONFIG_UART_CONSOLE=y
CONFIG_UART_CONSOLE_ON_DEV_NAME="uart0"
CONFIG_SERIAL=y
CONFIG_UART_LEON2=y
CONFIG_STDOUT_CONSOLE=y
CONFIG_EARLY_CONSOLE=y

CONFIG_LEON2_TIMER=y

CONFIG_TEST_EXTRA_STACKSIZE=2048
```

## boards/sparc/qemu_leon3/Kconfig.board
```kconfig
# Copyright (c) 2019-2020 Cobham Gaisler AB
#
# SPDX-License-Identifier: Apache-2.0

config BOARD_QEMU_LEON3
	bool "QEMU LEON3 target"
	depends on SOC_LEON3
	select QEMU_TARGET
	select CPU_HAS_FPU
```

## boards/sparc/qemu_leon3/Kconfig.defconfig
```kconfig
# Copyright (c) 2019-2020 Cobham Gaisler AB
#
# SPDX-License-Identifier: Apache-2.0

if BOARD_QEMU_LEON3

config BOARD
	default "qemu_leon3"

endif
```

## boards/sparc/qemu_leon3/Kconfig.qemu_leon3
```kconfig
# Copyright (c) 2022 Zephyr Project members and individual contributors
# SPDX-License-Identifier: Apache-2.0

config BOARD_QEMU_LEON3
	bool
	default y
	select SOC_LEON3
	select QEMU_TARGET
	select CPU_HAS_FPU
```

## boards/sparc/qemu_leon3/qemu_leon3_defconfig
```kconfig
# SPDX-License-Identifier: Apache-2.0

CONFIG_SOC_LEON3=y
CONFIG_BOARD_QEMU_LEON3=y
CONFIG_CONSOLE=y
CONFIG_SERIAL=y
CONFIG_UART_CONSOLE=y
CONFIG_EXTRA_EXCEPTION_INFO=y
CONFIG_QEMU_ICOUNT_SHIFT=6
```

## boards/sparkfun/artemis_nano/Kconfig.artemis_nano
```kconfig
# SPDX-License-Identifier: Apache-2.0
# Copyright (c) 2024 Ali Sarlak


if BOARD_ARTEMIS_NANO

config BOARD_ARTEMIS_NANO
	select SOC_APOLLO3_BLUE

config SYS_CLOCK_HW_CYCLES_PER_SEC
	default 32768 if AMBIQ_STIMER_TIMER

endif # BOARD_ARTEMIS_NANO
```

## boards/sparkfun/artemis_nano/Kconfig.defconfig
```kconfig
# Sparkfun artemis_nano board configuration

# Copyright (c) 2024 Ali Sarlak
# SPDX-License-Identifier: Apache-2.0

if BOARD_ARTEMIS_NANO

config FLASH_BASE_ADDRESS
	default 0x10000

endif
```

## boards/sparkfun/artemis_nano/artemis_nano_defconfig
```kconfig
# SPDX-License-Identifier: Apache-2.0
# Artemis Nano Kernel Configuration

# Enable Console and UART
CONFIG_CONSOLE=y
CONFIG_UART_CONSOLE=y
CONFIG_SERIAL=y
CONFIG_UART_INTERRUPT_DRIVEN=y
```

## boards/sparkfun/micromod/Kconfig
```kconfig
# Sparkfun micromod board configuration

# Copyright (c) 2024 Jerónimo Agulló <jeronimoagullo97@gmail.com>
# SPDX-License-Identifier: Apache-2.0

if BOARD_MICROMOD_NRF52840

config BOARD_ENABLE_DCDC
	bool "DCDC mode"
	select SOC_DCDC_NRF52X
	default y

config BOARD_ENABLE_DCDC_HV
	bool "High Voltage DCDC converter"
	select SOC_DCDC_NRF52X_HV
	default y
	depends on SOC_NRF52840_QIAA

endif # BOARD_MICROMOD_NRF52840
```

## boards/sparkfun/micromod/Kconfig.micromod
```kconfig
# Copyright (c) 2024 Jerónimo Agulló <jeronimoagullo97@gmail.com>
# SPDX-License-Identifier: Apache-2.0

config BOARD_MICROMOD
	select SOC_NRF52840_QIAA if BOARD_MICROMOD_NRF52840
```

## boards/sparkfun/micromod/board.yml
```yaml
board:
  name: micromod
  full_name: MicroMod board Processor
  vendor: sparkfun
  socs:
  - name: nrf52840
```

## boards/sparkfun/micromod/micromod_nrf52840_defconfig
```kconfig
# SPDX-License-Identifier: Apache-2.0

# Enable MPU
CONFIG_ARM_MPU=y

# Enable hardware stack protection
CONFIG_HW_STACK_PROTECTION=y

# Enable RTT
CONFIG_USE_SEGGER_RTT=y

# Enable GPIO
CONFIG_GPIO=y

# Enable console
CONFIG_CONSOLE=y

# Enable UART
CONFIG_SERIAL=y
```

## boards/sparkfun/nrf52_sparkfun/Kconfig.defconfig
```kconfig
# Sparkfun nRF52832 breakout  board configuration

# Copyright (c) 2017 Shawn Nock <shawn@monadnock.ca>
# Copyright (c) 2016 Nordic Semiconductor ASA
# SPDX-License-Identifier: Apache-2.0

if BOARD_NRF52_SPARKFUN

config BT_CTLR
	default BT

endif # BOARD_NRF52_SPARKFUN
```

## boards/sparkfun/nrf52_sparkfun/Kconfig.nrf52_sparkfun
```kconfig
# Sparkfun nRF52832 breakout board configuration

# Copyright (c) 2017 Shawn Nock <shawn@monadnock.ca>
# Copyright (c) 2016 Linaro Limited.
# SPDX-License-Identifier: Apache-2.0

config BOARD_NRF52_SPARKFUN
	select SOC_NRF52832_QFAA
```

## boards/sparkfun/nrf52_sparkfun/board.yml
```yaml
board:
  name: nrf52_sparkfun
  full_name: nRF52832 breakout
  vendor: sparkfun
  socs:
  - name: nrf52832
```

## boards/sparkfun/pro_micro_rp2040/Kconfig
```kconfig
# Copyright (c) 2021 Pete Johanson
# SPDX-License-Identifier: Apache-2.0

config BOARD_SPARKFUN_PRO_MICRO_RP2040
	select RP2_FLASH_W25Q080
```
