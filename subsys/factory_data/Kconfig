## subsys/fs/Kconfig.fatfs
```kconfig
# Copyright (c) 2016 Intel Corporation
# Copyright (c) 2020 Nordic Semiconductor ASA
# Copyright (c) 2023 Husqvarna AB
# SPDX-License-Identifier: Apache-2.0

config FAT_FILESYSTEM_ELM
	bool "ELM FAT file system support"
	depends on FILE_SYSTEM
	select DISK_ACCESS
	help
	  Use the ELM FAT File system implementation.

if FAT_FILESYSTEM_ELM

menu "ELM FAT file system settings"
	visible if FAT_FILESYSTEM_ELM

config FS_FATFS_READ_ONLY
	bool "Read-only support for all volumes"
	help
	  Excludes write code from ELM FAT file system driver.
	  Select this when using FAT for read-only access to slightly
	  reduce code size.
	  This option affects FF_FS_READONLY defined in ffconf.h, inside
	  ELM FAT module.

config FS_FATFS_MKFS
	bool
	help
	  Adds code for creating disks with FAT file system.
	  This option affects FF_USE_MKFS defined in ffconf.h, inside
	  ELM FAT module.

config FS_FATFS_MOUNT_MKFS
	bool "Allow formatting volume when mounting fails"
	default y
	select FS_FATFS_MKFS
	help
	  This option adds code that allows fs_mount to attempt to format
	  a volume if no file system is found.
	  If formatting is not needed, disabling this flag will slightly
	  reduce application size.
	  Note: This option is destructive to data and will automatically
	  destroy your disk, if mount attempt fails. In case when your
	  disk can be detached from a device and recovered using other
	  system, it may be worth disabling this option.
	  When this option is disabled, disk needs to be FAT formatted
	  prior to connecting to a device, otherwise it will not be
	  mountable.

if FS_FATFS_MOUNT_MKFS

config FS_FATFS_MAX_ROOT_ENTRIES
	int "Max number of entries in FAT FS root directory"
	default 512
	range 1 32768
	help
	  Sets how many root directory entries will be allocated when
	  formatting new FAT system to a device.
	  Note that this should be multiply of FS_FATFS_MAX_SS / 32.

endif # FS_FATFS_MOUNT_MKFS

config FS_FATFS_EXFAT
	bool "ExFAT support"
	select FS_FATFS_LFN
	help
	  Enable the exFAT format support for FatFs.

config FS_FATFS_NUM_FILES
	int "Maximum number of opened files"
	default 4
	help
	  Affects how many file objects area available for parallel
	  use by FAT driver. Each object is of size sizeof(FIL), where
	  FIL is defined in ff.h of ELM FAT driver, and is pre-allocated
	  at compile-time.
	  This affects use of fs_open on FAT type mounted file systems.

config FS_FATFS_NUM_DIRS
	int "Maximum number of opened directories"
	default 4
	help
	  Affects how many directory objects area available for parallel
	  use by FAT driver. Each object is of size sizeof(DIR), where
	  DIR is defined in ff.h of ELM FAT driver, and is pre-allocated
	  at compile-time.
	  This affects use of fs_opendir on FAT type mounted file systems.

config FS_FATFS_LFN
	bool "Long filenames (LFN)"
	help
	  Without long filenames enabled, file names are limited to 8.3 format.
	  This option increases working buffer size.

if FS_FATFS_LFN

choice FS_FATFS_LFN_MODE
	prompt "LFN memory mode"
	default FS_FATFS_LFN_MODE_BSS

config FS_FATFS_LFN_MODE_BSS
	bool "Static buffer"
	help
	  Enable LFN with static working buffer on the BSS. Always NOT thread-safe.
	  This option affects FF_USE_LFN defined in ffconf.h, inside
	  ELM FAT module, by setting its value to 1.

config FS_FATFS_LFN_MODE_STACK
	bool "Stack buffer"
	help
	  Enable LFN with dynamic working buffer on the STACK.
	  This option affects FF_USE_LFN defined in ffconf.h, inside
	  ELM FAT module, by setting its value to 2.

config FS_FATFS_LFN_MODE_HEAP
	bool "Heap buffer"
	depends on HEAP_MEM_POOL_SIZE > 0
	help
	  Enable LFN with dynamic working buffer on the HEAP.
	  This option affects FF_USE_LFN defined in ffconf.h, inside
	  ELM FAT module, by setting its value to 3.

endchoice

config FS_FATFS_FF_USE_LFN
	int
	default 1 if FS_FATFS_LFN_MODE_BSS
	default 2 if FS_FATFS_LFN_MODE_STACK
	default 3 if FS_FATFS_LFN_MODE_HEAP
	help
	  Translates FS_FATFS_LFN_MODE selection to FF_USE_LFN, defined in ffconf.h,
	  inside ELM FAT module.

config FS_FATFS_MAX_LFN
	int "Max filename length"
	range 12 255
	default 255
	help
	  The working buffer occupies (FS_FATFS_MAX_LFN + 1) * 2 bytes and
	  additional 608 bytes at exFAT enabled.
	  It should be set 255 to support full featured LFN operations.

endif # FS_FATFS_LFN

config FS_FATFS_CODEPAGE
	int "FatFS code page (character set)"
	default 437
	help
	  Valid code page values:
	   437 - U.S.
	   720 - Arabic
	   737 - Greek
	   771 - KBL
	   775 - Baltic
	   850 - Latin 1
	   852 - Latin 2
	   855 - Cyrillic
	   857 - Turkish
	   860 - Portuguese
	   861 - Icelandic
	   862 - Hebrew
	   863 - Canadian French
	   864 - Arabic
	   865 - Nordic
	   866 - Russian
	   869 - Greek 2
	   932 - Japanese (DBCS)
	   936 - Simplified Chinese (DBCS)
	   949 - Korean (DBCS)
	   950 - Traditional Chinese (DBCS)
	   0 - Include all supported code pages
	  This option affects FF_CODE_PAGE defined in ffconf.h, inside
	  ELM FAT module.

config FS_FATFS_MAX_SS
	int "Maximum supported sector size"
	range 512 4096
	default 512
	help
	  Value set here will be used as maximum supported read/write
	  sector size, with 512 being minimum value.
	  Option affects write/read granularity and will increase
	  size of buffers used by FAT driver, which in practice affects
	  how much RAM each FATFS object, used with FAT mount point,
	  requires, which is this value plus some constant amount,
	  independent from this setting.
	  This will affect your compile time RAM allocation, when
	  mount point is defined as static/global life time variable,
	  or stack.
	  When this value is set to 512, all mount points will use
	  512 as sector size, all other values will cause FAT driver
	  to query device for sector size on mount.
	  This option affects FF_MAX_SS defined in ffconf.h, inside
	  ELM FAT module.

config FS_FATFS_MIN_SS
	int "Minimum expected sector size"
	range 512 FS_FATFS_MAX_SS
	default 512
	help
	  Specifies minimum sector size the FAT FS driver is expected to
	  support. Set this to FS_FATFS_MAX_FS when you have single
	  device with FAT FS or all connected devices use the same
	  sector size, to have slight reduction in code in FAT FS driver.
	  The reduction comes from the fact that FAT FS does not have to
	  query every connected device for sector size.
	  This option affects FF_MIN_SS defined in ffconf.h, inside
	  ELM FAT module.

config FS_FATFS_WINDOW_ALIGNMENT
	int "Memory alignment for the member \"win\" in FATFS"
	default 1
	help
	  Specifies alignment, in bytes of FAT FS window buffer that is
	  used for device's read/write operations. MMC controllers may
	  require read/write buffer to start at memory address with
	  specific alignment, for example 16 or 512 bytes, the value
	  provided here is used as such alignment. Note that the window
	  buffer is internal element of FATFS structure, which means
	  that, in worst scenario, value provided here may cause FATFS
	  structure to have size of twice the value.

config FS_FATFS_REENTRANT
	bool "FatFs reentrant"
	depends on !FS_FATFS_LFN_MODE_BSS
	help
	  Enable the FatFs re-entrancy (thread safe) option for file/directory
	  access for each volume. Will create a zephyr mutex object for each
	  FatFs volume and a FatFs system mutex.

endmenu

endif # FAT_FILESYSTEM_ELM
```

## subsys/fs/Kconfig.littlefs
```kconfig
# Copyright (c) 2019 Bolt Innovation Management, LLC
# Copyright (c) 2019 Peter Bigot Consulting, LLC
# Copyright (c) 2020 Nordic Semiconductor ASA
# SPDX-License-Identifier: Apache-2.0

config FILE_SYSTEM_LITTLEFS
	bool "LittleFS support"
	depends on FILE_SYSTEM_LIB_LINK
	depends on ZEPHYR_LITTLEFS_MODULE
	help
	  Enables LittleFS file system support.

if FILE_SYSTEM_LITTLEFS

menu "LittleFS Settings"
	visible if FILE_SYSTEM_LITTLEFS

config FS_LITTLEFS_NUM_FILES
	int "Maximum number of opened files"
	default 4
	help
	  This is a global maximum across all mounted littlefs filesystems.

config FS_LITTLEFS_NUM_DIRS
	int "Maximum number of opened directories"
	default 4
	help
	  This is a global maximum across all mounted littlefs filesystems.

config FS_LITTLEFS_READ_SIZE
	int "Minimum size of a block read"
	default 16
	help
	  All read operations will be a multiple of this value.

config FS_LITTLEFS_PROG_SIZE
	int "Minimum size of a block program"
	default 16
	help
	  All program operations will be a multiple of this value.

config FS_LITTLEFS_CACHE_SIZE
	int "Size of block caches in bytes"
	default 64
	help
	  Each cache buffers a portion of a block in RAM.  The littlefs
	  needs a read cache, a program cache, and one additional cache
	  per file. Larger caches can improve performance by storing
	  more data and reducing the number of disk accesses. Must be a
	  multiple of the read and program sizes of the underlying flash
	  device, and a factor of the block size.

config FS_LITTLEFS_LOOKAHEAD_SIZE
	int "Size of lookahead buffer in bytes"
	default 32
	help
	  A larger lookahead buffer increases the number of blocks found
	  during an allocation pass. The lookahead buffer is stored as a
	  compact bitmap, so each byte of RAM can track 8 blocks.

config FS_LITTLEFS_BLOCK_CYCLES
	int "Number of erase cycles before moving data to another block"
	default 512
	help
	  For dynamic wear leveling, the number of erase cycles before data
	  is moved to another block.  Set to a non-positive value to
	  disable leveling.

endmenu

config FS_LITTLEFS_FC_HEAP_SIZE
	int "Enable flexible file cache sizes for littlefs"
	default 0
	help
	  littlefs requires a per-file buffer to cache data.

	  When applications customize littlefs configurations and support
	  different cache sizes for different partitions this preallocation is
	  inadequate as an application might require a small number of files
	  using a large cache size and a larger number of files using a
	  smaller cache size.  In that case application should provide a
	  positive value for the heap size.  Be aware that there is a
	  per-allocation overhead that affects how much usable space is
	  present in the heap.

	  If this option is set to a non-positive value the heap is sized to
	  support up to FS_LITTLE_FS_NUM_FILES blocks of
	  FS_LITTLEFS_CACHE_SIZE bytes.

if FS_LITTLEFS_FC_HEAP_SIZE <= 0

config FS_LITTLEFS_HEAP_PER_ALLOC_OVERHEAD_SIZE
	int "Size of per-allocation overhead for littleFS heap in bytes"
	default 32
	help
	  In case when total size of littleFS heap is automatically calculated
	  we need to take into account overhead caused per block allocation.
	  For the purpose of heap size calculation the size of each cache block
	  will be increased by this value.
	  NOTE: when your app fails to open pre-defined number of files, as set
	  by FS_LITTLEFS_NUM_FILES, try to increase the value.

endif # FS_LITTLEFS_FC_HEAP_SIZE <= 0

config FS_LITTLEFS_FMP_DEV
	bool "Support for littlefs on flash devices"
	depends on FLASH_MAP
	depends on FLASH_PAGE_LAYOUT || !FLASH_HAS_EXPLICIT_ERASE
	default y
	help
	  Enable this option to provide support for littlefs on flash devices
	  (using the flash_map API).

config FS_LITTLEFS_BLK_DEV
	bool "Support for littlefs on block devices"
	help
	  Enable this option to provide support for littlefs on the block
	  devices (like for example SD card).

config FS_LITTLEFS_DISK_VERSION
	bool "Support for selecting littlefs disk version"
	default y if $(dt_compat_any_has_prop,$(DT_COMPAT_ZEPHYR_FSTAB_LITTLEFS),disk-version)
	help
	  Enable this option to provide support for selecting littlefs disk version
	  to maintain backward compatibility with existing littlefs
	  with the same major disk version.

endif # FILE_SYSTEM_LITTLEFS
```

## subsys/fs/devfs/Kconfig
```kconfig
#Copyright (c) 2024 BayLibre SAS

#SPDX-License-Identifier: Apache-2.0

config DEVFS
	bool "Device Filesystem"
	help
	  Enable support of Device Filesystem.

if DEVFS

config DEVFS_FILE_NUM_MAX
	int "maximum number of files supported by devfs"
	default 256
	range 1 512

module = DEVFS
module-str = devfs
source "subsys/logging/Kconfig.template.log_config"

endif # ZMS
```

## subsys/fs/ext2/Kconfig
```kconfig
# Copyright (c) 2023 Antmicro
# SPDX-License-Identifier: Apache-2.0

# Ext2 file system

config FILE_SYSTEM_EXT2
	bool "Ext2 file system support"
	depends on FILE_SYSTEM_LIB_LINK
	help
	  Enable Ext2 file system support.

module = EXT2
module-str = Ext2
source "subsys/logging/Kconfig.template.log_config"

if FILE_SYSTEM_EXT2

menu "Ext2 file system Settings"
	visible if FILE_SYSTEM_EXT2

config EXT2_MAX_FILES
	int "Maximum number of opened inodes"
	default 10

config EXT2_MAX_BLOCK_SIZE
	int "Maximum size of supported block"
	range 1024 4096
	default 4096
	help
	  This flag is used to determine size of internal structures that
	  are used to store fetched blocks.

config EXT2_MAX_BLOCK_COUNT
	int "Maximum number of blocks that might be used"
	default 10
	help
	  This flag is used to determine size of internal structures that
	  are used to store fetched blocks.

config EXT2_DISK_STARTING_SECTOR
	int "Ext2 starting sector"
	default 0
	help
	  The current Ext2 implementation does not support GUID Partition Table. The starting sector
	  of the file system must be specified by this option.

config EXT2_SUPERBLOCK_ALIGNMENT
	int "Ext2 superblock alignment"
	default 1
	help
	  Some SD host controllers require alignment of their data buffers
	  in order for DMA to work correctly. Devices should change default of
	  this value if they require alignment. This represents the alignment
	  of struct ext2_disk_superblock in bytes.

endmenu
endif
```

## subsys/fs/fuse/Kconfig
```kconfig
# Copyright (c) 2025 Antmicro <www.antmicro.com>
# SPDX-License-Identifier: Apache-2.0

config FUSE
	bool "FUSE primitives support"
	help
	  Enable FUSE primitives support.

config FUSE_UID_VALUE
	int "Fuse user ID"
	default 0
	help
	  Each fuse request contains user ID, this config allows setting
	  that value. The result is as if user with given UID accessed the file/resource.

config FUSE_GID_VALUE
	int "Fuse group ID"
	default 0
	help
	  Each fuse request contains group ID, this config allows setting
	  that value. The result is as if user with given GID accessed the file/resource.

config FUSE_PID_VALUE
	int "Fuse process ID"
	default 0
	help
	  Each fuse request contains process ID, this config allows setting
	  that value. The result is as if process with given PID accessed the file/resource.

module = FUSE
module-str = fuse
source "subsys/logging/Kconfig.template.log_config"
```

## subsys/fs/fuse_client/Kconfig
```kconfig
# Copyright (c) 2025 Antmicro <www.antmicro.com>
# SPDX-License-Identifier: Apache-2.0

config FUSE_CLIENT
	bool "FUSE client-side primitives support"
	help
	  Enable FUSE client-side primitives support.

config FUSE_CLIENT_UID_VALUE
	int "FUSE user ID"
	default 0
	help
	  Each FUSE request contains user ID, this config allows setting
	  that value. The result is as if user with given UID accessed the file/resource.

config FUSE_CLIENT_GID_VALUE
	int "FUSE group ID"
	default 0
	help
	  Each FUSE request contains group ID, this config allows setting
	  that value. The result is as if user with given GID accessed the file/resource.

config FUSE_CLIENT_PID_VALUE
	int "FUSE process ID"
	default 0
	help
	  Each FUSE request contains process ID, this config allows setting
	  that value. The result is as if process with given PID accessed the file/resource.

module = FUSE_CLIENT
module-str = fuse
source "subsys/logging/Kconfig.template.log_config"
```
