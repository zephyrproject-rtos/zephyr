## subsys/fs/nvs/Kconfig
```kconfig
# Non-volatile Storage NVS

# Copyright (c) 2018 Laczen
# SPDX-License-Identifier: Apache-2.0

config NVS
	bool "Non-volatile Storage"
	depends on FLASH
	depends on FLASH_PAGE_LAYOUT
	select CRC
	help
	  Enable support of Non-volatile Storage.

if NVS

config NVS_LOOKUP_CACHE
	bool "Non-volatile Storage lookup cache"
	help
	  Enable Non-volatile Storage cache, used to reduce the NVS data lookup
	  time. Each cache entry holds an address of the most recent allocation
	  table entry (ATE) for all NVS IDs that fall into that cache position.

config NVS_LOOKUP_CACHE_SIZE
	int "Non-volatile Storage lookup cache size"
	default 128
	range 1 65536
	depends on NVS_LOOKUP_CACHE
	help
	  Number of entries in Non-volatile Storage lookup cache.
	  It is recommended that it be a power of 2.

config NVS_LOOKUP_CACHE_FOR_SETTINGS
	bool "Non-volatile Storage lookup cache optimized for settings"
	depends on NVS_LOOKUP_CACHE
	help
	  Use the lookup cache hash function that results in the least number of
	  collissions and, in turn, the best NVS performance provided that the NVS
	  is used as the settings backend only. This option should NOT be enabled
	  if the NVS is also written to directly, outside the settings layer.

config NVS_DATA_CRC
	bool "Non-volatile Storage CRC protection on the data"
	help
	  Enable a CRC-32 on the data part of each NVS element.
	  The ATE CRC is not impacted by this feature and stays the same.
	  The CRC-32 is transparently stored at the end of the data field,
	  in the NVS data section, so 4 more bytes are needed per NVS element.

config NVS_INIT_BAD_MEMORY_REGION
	bool "Non-volatile Storage bad memory region recovery"
	help
	  Enable automatic initialization of a NVS on a memory region that does
	  not contain a valid NVS. A region containing an invalid NVS can be
	  caused by corruption or by providing a non-empty region. This option
	  ensures a new NVS can be created.

module = NVS
module-str = nvs
source "subsys/logging/Kconfig.template.log_config"

endif # NVS
```

## subsys/fs/sfcb/Kconfig
```kconfig
# Kconfig - Simple Flash Circular Buffer

#
# Copyright (c) 2017 Laczen
#
# SPDX-License-Identifier: Apache-2.0
#

config SFCB
	bool
	prompt "Simple Flash Circular Buffer"
	default n
	depends on FLASH_MAP
	help
	  Enable support of Simple Flash Circular Buffer.
```

## subsys/fs/zffs/Kconfig
```kconfig
config ZFFS_AREA_MAX
	int "todo"
	depends on FILE_SYSTEM_ZFFS
	default 12
	help
	    todo

config ZFFS_AREA_BUF_SIZE
	int "todo"
	depends on FILE_SYSTEM_ZFFS
	default 256
	help
	    todo

config ZFFS_AREA_ALIGNED_SIZE
	int "todo"
	depends on FILE_SYSTEM_ZFFS
	range 1 4
	default 1
	help
	    todo

config ZFFS_TREE_T
	int "todo"
	depends on FILE_SYSTEM_ZFFS
	default 8
	help
	    todo

config ZFFS_TREE_CACHE_NODE_MAX
	int "todo"
	depends on FILE_SYSTEM_ZFFS
	default 16
	help
	    todo

config ZFFS_NAME_MAX
	int "todo"
	depends on FILE_SYSTEM_ZFFS
	default 63
	help
	    todo

config ZFFS_MISC_ID_STEP
	int "todo"
	depends on FILE_SYSTEM_ZFFS
	default 1024
	help
	    todo

config ZFFS_BLOCK_SIZE
	int "todo"
	depends on FILE_SYSTEM_ZFFS
	default 1024
	help
	    todo
```

## subsys/fs/zms/Kconfig
```kconfig
# Copyright (c) 2018 Laczen
# Copyright (c) 2024 BayLibre SAS

# SPDX-License-Identifier: Apache-2.0

# Zephyr Memory Storage ZMS

config ZMS
	bool "Zephyr Memory Storage"
	select CRC
	help
	  Enable Zephyr Memory Storage, which is a key-value storage system designed to work with
	  all types of non-volatile storage technologies.
	  It supports classical on-chip NOR flash as well as new technologies like RRAM and MRAM.

if ZMS

config ZMS_LOOKUP_CACHE
	bool "ZMS lookup cache"
	help
	  Enable ZMS cache to reduce the ZMS data lookup time.
	  Each cache entry holds an address of the most recent allocation
	  table entry (ATE) for all ZMS IDs that fall into that cache position.

config ZMS_LOOKUP_CACHE_SIZE
	int "ZMS lookup cache size"
	default 128
	range 1 65536
	depends on ZMS_LOOKUP_CACHE
	help
	  Number of entries in the ZMS lookup cache.
	  Every additional entry in cache will use 8 bytes of RAM.

config ZMS_DATA_CRC
	bool "ZMS data CRC"

config ZMS_CUSTOMIZE_BLOCK_SIZE
	bool "Customize the size of the buffer used internally for reads and writes"
	help
	  ZMS uses an internal buffer to read/write and compare stored data.
	  Increasing the size of this buffer should be done carefully in order to not
	  overflow the stack.
	  Increasing it makes ZMS able to work with storage devices
	  that have a larger `write-block-size` (which decreases the performance of ZMS).

config ZMS_CUSTOM_BLOCK_SIZE
	int "ZMS internal buffer size"
	default 32
	depends on ZMS_CUSTOMIZE_BLOCK_SIZE
	help
	  Changes the internal buffer size of ZMS

config ZMS_LOOKUP_CACHE_FOR_SETTINGS
	bool "ZMS Storage lookup cache optimized for settings"
	depends on ZMS_LOOKUP_CACHE && SETTINGS_ZMS
	help
	  Use the lookup cache hash function that results in the least number of
	  collissions and, in turn, the best ZMS performance provided that the ZMS
	  is used as the settings backend only. This option should NOT be enabled
	  if the ZMS is also written to directly, outside the settings layer.

config ZMS_NO_DOUBLE_WRITE
	bool "Avoid writing the same data again in the storage"
	help
	  For some memory technologies, write cycles for memory cells are limited and any
	  unncessary writes should be avoided.
	  Enable this config to avoid rewriting data in the storage if it already exists.
	  This option will reduce write performance as it will need to do a research of the
	  data in the whole storage before any write.

module = ZMS
module-str = zms
source "subsys/logging/Kconfig.template.log_config"

endif # ZMS
```

## subsys/gnss/Kconfig
```kconfig
# Copyright (c) 2025 Croxel Inc.
# Copyright (c) 2025 CogniPilot Foundation
# SPDX-License-Identifier: Apache-2.0

rsource "rtk/Kconfig"
```

## subsys/gnss/rtk/Kconfig
```kconfig
# Copyright (c) 2025 Croxel Inc.
# Copyright (c) 2025 CogniPilot Foundation
# SPDX-License-Identifier: Apache-2.0

menuconfig GNSS_RTK
	bool "GNSS RTK client"
	select EXPERIMENTAL
	help
	  Enable GNSS RTK data-correction clients

if GNSS_RTK

rsource "protocol/Kconfig"
rsource "serial/Kconfig"

module = GNSS_RTK
module-str = GNSS RTK
source "subsys/logging/Kconfig.template.log_config"

endif
```

## subsys/gnss/rtk/protocol/Kconfig
```kconfig
# Copyright (c) 2025 Croxel Inc.
# Copyright (c) 2025 CogniPilot Foundation
# SPDX-License-Identifier: Apache-2.0

choice GNSS_RTK_PROTOCOL
	prompt "GNSS RTK Protocol selection"
	default GNSS_RTK_PROTOCOL_RTCM3
	help
	  Select the GNSS RTK Protocol to use in data-correction

config GNSS_RTK_PROTOCOL_RTCM3
	bool "RTCM3 Protocol"
	select CRC
	help
	  Select RTCM3 protocol as GNSS RTK corrections

endchoice
```

## subsys/graphic/Kconfig
```kconfig
# SPDX-FileCopyrightText: Copyright (c) 2026 STMicroelectronics
# SPDX-License-Identifier: Apache-2.0

menuconfig GRAPHIC
	bool "GRAPHIC subsystem"
	select GRAPHIC_DRIVERS
	help
	  Enable support for the graphic subsystem as well as graphic drivers.

if GRAPHIC

module = GRAPHIC
module-str = graphic
source "subsys/logging/Kconfig.template.log_config"

config GRAPHIC_SHELL
	bool "Graphic shell"
	depends on SHELL

endif # GRAPHIC
```

## subsys/greybus/Kconfig
```kconfig
# Kconfig - Greybus configuration options
#
# Copyright (c) 2019 Christopher Friedt, <chrisfriedt@gmail.com>
#
# SPDX-License-Identifier: Apache-2.0

menuconfig GREYBUS
	bool "Greybus"
	select POSIX_API
	select PTHREAD_IPC
	help
	  This option enables Greybus support.

if GREYBUS

module = GREYBUS
module-str = gb
#source "subsys/logging/Kconfig.template.log_config"

config GREYBUS_STATIC_MANIFEST
	bool "Static Greybus Manifest"
	default n
	help
	  Statically linke a Greybus manifest. This
	  manifest must be pre-compiled with the 'manifesto' tool
	  and also pre-converted to a C-array using the 'xxd' tool
	  or something similar.
	  
	  The resulting static-manifest.h must include a
	  static const unsigned char manifest_mnfb[]; as well as
	  static const unsigned manifest_mnfb_len;

config GREYBUS_AUDIO
	bool "Greybus Audio"
	default n
	help
	  Select this for Greybus Audio support.

config GREYBUS_CAMERA
	bool "Greybus Camera"
	default n
	help
	  Select this for Greybus Camera support.

config GREYBUS_CONTROL
	bool "Greybus Control"
	default n
	help
	  Select this for a Greybus Control cport.

config GREYBUS_DEBUG
	bool "Debug Greybus"
	default n
	help
	  Select this to debug Greybus.

config GREYBUS_LOG_FUNC
	bool "Greybus Debug with Function Name"
	default n
	help
	  Select this option to show the function name in Greybus debug messages.

config GREYBUS_LOG_FILE
	bool "Greybus Debug with File Name"
	default y
	help
	  Select this option to show the filename and line number in Greybus debug messages.

config GREYBUS_GPIO
	bool "Greybus GPIO"
	default n
	help
	  Select this for Greybus GPIO support.

config GREYBUS_HID
	bool "Greybus HID"
	default n
	help
	  Select this for Greybus HID support.

config GREYBUS_I2C
	bool "Greybus I2C support"
	default n
	help
	  Select this for Greybus I2C support.

config GREYBUS_LIGHTS
	bool "Greybus Lights"
	default n
	help
	  Select this for Greybus Light support.

config GREYBUS_LOOPBACK
	bool "Greybus Loopback"
	default n
	help
	  Select this for Greybus Loopback support.

config GREYBUS_POWER_SUPPLY
	bool "Greybus Power Supply"
	default n
	help
	  Select this for Greybus Power Supply support.

config GREYBUS_PWM
	bool "Greybus PWM"
	default n
	help
	  Select this for Greybus Pulse Width Modulation support.

config GREYBUS_SDIO
	bool "Greybus SDIO"
	default n
	help
	  Select this for Greybus Secure Digital IO support.

config GREYBUS_SPI
	bool "Greybus SPI"
	default n
	help
	  Select this for Greybus Serial Peripheral Interface support.

config GREYBUS_UART
	bool "Greybus UART"
	default n
	help
	  Select this for Greybus Universal Asynchronous Receiver Transmitter support.

config GREYBUS_USB
	bool "Greybus USB"
	default n
	help
	  Select this for Greybus Universal Serial Bus support.

config GREYBUS_VIBRATOR
	bool "Greybus Vibrator"
	default n
	help
	  Select this for Greybus Vibrator support.

endif # GREYBUS
```
