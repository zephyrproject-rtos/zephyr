## subsys/factory_data/Kconfig
```kconfig
# Copyright (c) 2022 GARDENA GmbH
#
# SPDX-License-Identifier: Apache-2.0

menuconfig FACTORY_DATA
	bool "Per-device factory data"
	help
	  The factory data subsystem allows its users to store device specific data,
	  e.g. MAC addresses, during manufacturing. Later on, the productive firmwares
	  contain only code to read the factory data.

if FACTORY_DATA

choice FACTORY_DATA_BACKEND
	prompt "Factory data back-end"
	default FACTORY_DATA_FCB if FCB
	default FACTORY_DATA_LV
	depends on FACTORY_DATA
	help
	  Storage back-end to be used by the factory data subsystem.

config FACTORY_DATA_FCB
	bool "FCB"
	depends on FCB
	help
	  Use FCB as a factory data storage back-end.

config FACTORY_DATA_LV
	bool "LV"
	help
	  Use length-value data structures as factory data storage back-end.

config FACTORY_DATA_DUMMY
	bool "Dummy implementation"
	help
	  Minimalistic, non-functional factory data storage back-end stubs. Serves as baseline when
	  comparing the code size of different implementations.

config FACTORY_DATA_CUSTOM
	bool "CUSTOM"
	help
	  Use a custom settings storage back-end.
endchoice

config FACTORY_DATA_FCB_MAGIC
	hex "FCB magic number for the factory data subsystem"
	default 0xfac70fcb
	depends on FACTORY_DATA_FCB
	help
	  Magic 32-bit word for to identify valid FCB factory data area

config FACTORY_DATA_FCB_NUM_AREAS
	int "Number of flash areas used by the factory data FCB subsystem"
	default 1
	depends on FACTORY_DATA_FCB
	help
	  Number of areas to allocate in the factory data FCB. A smaller number is
	  used if the flash hardware cannot support this value.

config FACTORY_DATA_LV_MAGIC
	hex "FCB magic number for the factory data subsystem"
	default 0xfac70715
	depends on FACTORY_DATA_LV
	help
	  Magic 32-bit word for to identify valid LV factory data area

config FACTORY_DATA_WRITE
	bool "Factory data write API."
	default n
	depends on FACTORY_DATA
	help
	  Enable code to write factory data.

config FACTORY_DATA_SHELL
	bool "Factory data shell support"
	default y
	depends on FACTORY_DATA && SHELL
	select FACTORY_DATA_WRITE
	help
	  Enable factory data shell, the (currently) only way to write factory data.

config FACTORY_DATA_NAME_LEN_MAX
	int "Max name length in bytes"
	default 32
	depends on FACTORY_DATA
	help
	  Maximum size in bytes for factory data value names. The bigger the more stack space gets
	  used on data load.

config FACTORY_DATA_VALUE_LEN_MAX
	int "Max value length in bytes"
	default 512
	depends on FACTORY_DATA
	help
	  Maximum size in bytes for factory data value payloads. The bigger the more stack space
	  gets used on data load.


endif
```

## subsys/fault_tolerance/Kconfig
```kconfig
menu "Enhanced Fault Tolerance Support"

config FT_API_ENABLED
    bool "Enable Enhanced Fault Tolerance API"
    default n
    help
      Enable this option to include the enhanced fault tolerance API in the build.
      This API provides detection and recovery for various embedded system faults.

if FT_API_ENABLED

config FT_EVENT_QUEUE_SIZE
    int "Fault event queue size"
    default 16
    range 4 128
    help
      Maximum number of fault events that can be queued for processing.

config FT_WORKER_STACK_SIZE
    int "Worker thread stack size"
    default 2048
    range 512 8192
    help
      Stack size for the fault tolerance worker thread.

config FT_WORKER_PRIORITY
    int "Worker thread priority"
    default 5
    range 0 15
    help
      Priority of the fault tolerance worker thread.
      Lower values indicate higher priority.

config FT_INIT_PRIORITY
    int "Initialization priority"
    default 50
    range 0 99
    help
      System initialization priority for fault tolerance subsystem.

module = FT
module-str = Fault Tolerance
source "subsys/logging/Kconfig.template.log_config"

config FT_STACK_OVERFLOW_DETECT
    bool "Enable stack overflow detection"
    default y
    help
      Enable detection of thread stack overflows.

config FT_WATCHDOG_SUPPORT
    bool "Enable watchdog monitoring"
    default n
    depends on WATCHDOG
    help
      Enable watchdog timer monitoring and bark detection.

config FT_DEADLOCK_DETECT
    bool "Enable deadlock detection"
    default n
    help
      Enable runtime deadlock detection between threads.

config FT_MEMORY_CORRUPTION_DETECT
    bool "Enable memory corruption detection"
    default n
    help
      Enable memory corruption detection using checksums or canaries.

endif # FT_API_ENABLED

endmenu
```

## subsys/fb/Kconfig
```kconfig
# Frame buffer configuration options

# Copyright (c) 2018 Phytec Messtechnik GmbH
# SPDX-License-Identifier: Apache-2.0

menuconfig CHARACTER_FRAMEBUFFER
	bool "Character framebuffer for dot matrix displays"
	help
	  Character framebuffer for dot matrix displays.

if CHARACTER_FRAMEBUFFER

config CHARACTER_FRAMEBUFFER_USE_DEFAULT_FONTS
	bool "Use default fonts"
	default y
	help
	  Use default fonts.

config CHARACTER_FRAMEBUFFER_SHELL
	bool "Character Framebuffer shell"
	depends on SHELL
	help
	  Activate shell module that provides Framebuffer commands to the
	  console.

module = CFB
module-str = cfb
source "subsys/logging/Kconfig.template.log_config"

endif # CHARACTER_FRAMEBUFFER
```

## subsys/fido2/Kconfig
```kconfig
# Copyright (c) 2026 Siratul Islam <email@sirat.me>
# SPDX-License-Identifier: Apache-2.0

menuconfig FIDO2
	bool "FIDO2 authenticator"
	select ZCBOR
	select ZCBOR_CANONICAL
	select PSA_CRYPTO
	help
	  Enable the FIDO2/CTAP2 authenticator subsystem.

if FIDO2

module = FIDO2
module-str = fido2
source "subsys/logging/Kconfig.template.log_config"

config FIDO2_THREAD_STACK_SIZE
	int "FIDO2 processing thread stack size"
	default 4096

config FIDO2_THREAD_PRIORITY
	int "FIDO2 processing thread priority"
	default 7

config FIDO2_CBOR_MAX_SIZE
	int "Maximum CBOR message buffer size"
	default 1024
	range 1024 4096
	help
	  Maximum size of CBOR encoded CTAP2 request and response messages.

config FIDO2_MAX_CREDENTIALS
	int "Maximum number of resident credentials"
	default 16
	range 1 256
	help
	  Maximum number of discoverable (resident) credentials that
	  can be stored on the device.

config FIDO2_UP_TIMEOUT_MS
	int "User presence timeout in milliseconds"
	default 30000
	help
	  Time to wait for user presence confirmation before timing out.
	  Default 30 seconds, as per FIDO2 specification.

config FIDO2_EXT_CRED_PROTECT
	bool "credProtect extension"
	help
	  Enable the CTAP2 credProtect extension.

config FIDO2_EXT_HMAC_SECRET
	bool "hmac-secret extension"
	select PSA_WANT_ALG_HMAC
	help
	  Enable the CTAP2 hmac-secret extension.

config FIDO2_EXT_LARGE_BLOB_KEY
	bool "largeBlobKey extension"
	help
	  Enable the CTAP2 largeBlobKey extension for per-credential
	  large blob storage. Not yet implemented.

config FIDO2_EXT_CRED_BLOB
	bool "credBlob extension"
	depends on FIDO2_EXT_CRED_PROTECT
	help
	  Enable the CTAP2 credBlob extension. Requires credProtect support.
	  Authenticators supporting credBlob MUST also support credProtect.

config FIDO2_EXT_THIRD_PARTY_PAYMENT
	bool "thirdPartyPayment extension"
	help
	  Enable the CTAP2 thirdPartyPayment extension.

config FIDO2_CREDENTIAL_MANAGEMENT
	bool "Credential management command"
	help
	  Enable the CTAP 2.1 authenticatorCredentialManagement (0x0A)
	  command. Requires PIN protocol support since all credMgmt
	  subcommands require a pinUvAuthToken with CM permission.

config FIDO2_AAGUID
	string "Authenticator AAGUID (32 hex chars)"
	help
	  Authenticator AAGUID encoded as 32 hexadecimal characters with no
	  separators (16 bytes).

config FIDO2_ALWAYS_UV
	bool "Always require user verification"
	help
	  When enabled, this forces user verification for every MakeCredential
	  and GetAssertion operation regardless of what the Relying Party requests,
	  including when userVerification is set to "discouraged".

	  This overrides makeCredUvNotRqd

rsource "transport/Kconfig"
rsource "storage/Kconfig"

endif # FIDO2
```

## subsys/fido2/storage/Kconfig
```kconfig
# Copyright (c) 2026 Siratul Islam <email@sirat.me>
# SPDX-License-Identifier: Apache-2.0

menu "Credential Storage"

choice FIDO2_STORAGE_BACKEND
	prompt "Credential storage backend"
	default FIDO2_STORAGE_SETTINGS

config FIDO2_STORAGE_SETTINGS
	bool "Zephyr settings subsystem"
	depends on SETTINGS
	help
	  Store FIDO2 credentials using the Zephyr settings subsystem.

config FIDO2_STORAGE_SECURE
	bool "Secure storage subsystem"
	depends on SECURE_STORAGE
	help
	  Store FIDO2 credentials using the secure storage subsystem.

endchoice

endmenu
```

## subsys/fido2/transport/Kconfig
```kconfig
# Copyright (c) 2026 Siratul Islam <email@sirat.me>
# SPDX-License-Identifier: Apache-2.0

menu "Transport"

config FIDO2_TRANSPORT_USB_HID
	bool "CTAP over USB HID"
	depends on USB_DEVICE_STACK_NEXT
	select USBD_HID_SUPPORT
	help
	  Enable FIDO2 communication over USB HID (CTAPHID).

config FIDO2_CTAPHID_TIMEOUT_MS
	int "CTAPHID message reassembly timeout in milliseconds"
	default 500
	range 100 2000
	depends on FIDO2_TRANSPORT_USB_HID
	help
	  Maximum time to wait for continuation packets during CTAPHID
	  message reassembly. If a complete message is not received within
	  this timeout, the authenticator sends an error response and
	  aborts the transaction.

config FIDO2_CTAPHID_KEEPALIVE_INTERVAL_MS
	int "CTAPHID keepalive interval in milliseconds"
	default 100
	range 20 100
	depends on FIDO2_TRANSPORT_USB_HID
	help
	  Interval for CTAPHID keepalive packets. The specification requires
	  this to be at most 100ms for USB HID to prevent host timeouts.

config FIDO2_HID_RX_WORKQ_STACK_SIZE
	int "USB HID RX workqueue stack size"
	default 4096
	range 1024 16384
	depends on FIDO2_TRANSPORT_USB_HID
	help
	  Stack size for the dedicated USB HID RX workqueue used to
	  process incoming CTAPHID reports.

config FIDO2_TRANSPORT_BLE
	bool "CTAP over BLE"
	depends on BT
	depends on BT_PERIPHERAL
	help
	  Enable FIDO2 communication over Bluetooth Low Energy.

config FIDO2_TRANSPORT_NFC
	bool "CTAP over NFC"
	help
	  Enable FIDO2 communication over NFC.

endmenu
```

## subsys/fido2/uv/Kconfig
```kconfig
# Copyright (c) 2026 Siratul Islam <email@sirat.me>
# SPDX-License-Identifier: Apache-2.0

menu "User Verification"

config FIDO2_PIN_PROTOCOL
	bool "Client PIN support"
	default y
	help
	  Enable CTAP2 client PIN protocol for user verification.

config FIDO2_PIN_MAX_RETRIES
	int "Maximum PIN retries"
	default 8
	depends on FIDO2_PIN_PROTOCOL

config FIDO2_UV_BIOMETRIC
	bool "Biometric user verification"
	depends on BIOMETRICS
	help
	  Use a biometrics driver for FIDO2 user verification.

endmenu
```

## subsys/fpga_bridge/Kconfig
```kconfig
# FPGA bridge configuration options

# Copyright (c) 2023, Intel Corporation.
# SPDX-License-Identifier: Apache-2.0

menuconfig FPGA_BRIDGE
	bool "FPGA Bridge Subsystem"
	help
	  Enable support for FPGA Bridge Subsystem.

if FPGA_BRIDGE

module = FPGA_BRIDGE
module-str = fpga_bridge
source "subsys/logging/Kconfig.template.log_config"

config FPGA_BRIDGE_INTEL
	bool "FPGA Bridge enable for Intel devices"
	depends on ARM_SIP_SVC_SUBSYS
	help
	  Enable FPGA Bridges support for Intel devices.

config FPGA_BRIDGE_SHELL
	bool "FPGA Bridge commands"
	depends on SHELL
	help
	  Enable FPGA bridge shell support.

endif # FPGA_MANAGER
```

## subsys/fpga_manager/Kconfig
```kconfig
# FPGA manager configuration option

#Copyright (c) 2023, Intel Corporation.
#SPDX-License-Identifier: Apache-2.0

menuconfig FPGA_MANAGER
	bool "FPGA Manager SUBSYSTEM"
	help
	  Enable support for FPGA MANAGER Subsystem.

if FPGA_MANAGER

module = FPGA_MANAGER
module-str = fpga_manager
source "subsys/logging/Kconfig.template.log_config"

config FPGA_MANAGER_INTEL
	bool "FPGA Manager for Intel devices"
	depends on FILE_SYSTEM && ARM_SIP_SVC_SUBSYS && FPGA_BRIDGE && FPGA_BRIDGE_INTEL
	help
	  Enable FPGA Manager support for Intel devices.

config FPGA_MANAGER_SHELL
	bool "FPGA Manager shell"
	depends on SHELL
	help
	  Enable FPGA Manager shell support.

config FPGA_MANAGER_THREAD_STACK_SIZE
	int "FPGA Manager thread stack size"
	default 900
	depends on FPGA_MANAGER_INTEL
	help
	  Stack size of the FPGA Manager thread

endif # FPGA_MANAGER
```

## subsys/fs/Kconfig
```kconfig
# Copyright (c) 2016 Intel Corporation
# Copyright (c) 2020 Nordic Semiconductor (ASA)
# SPDX-License-Identifier: Apache-2.0

menu "File Systems"

config FILE_SYSTEM_LIB_LINK
	bool "Link file system libraries into build"
	help
	  Link in the underlying file system libraries. This can be
	  enabled without CONFIG_FILE_SYSTEM to enable applications
	  to work directly with the underlying file system libraries.
	  This can be useful to avoid linking in the entire filesystem
	  implementation via `struct fs_file_system_t` if only a subset
	  is used.

config FILE_SYSTEM
	bool "File system support"
	select FILE_SYSTEM_LIB_LINK
	help
	  Enables support for file system.

if FILE_SYSTEM

module = FS
module-str = fs
source "subsys/logging/Kconfig.template.log_config"

config APP_LINK_WITH_FS
	bool "Link 'app' with FS"
	default y
	help
	  Add FS header files to the 'app' include path. It may be
	  disabled if the include paths for FS are causing aliasing
	  issues for 'app'.

config FILE_SYSTEM_MAX_TYPES
	int "Maximum number of distinct file system types allowed"
	default 2
	help
	  Zephyr provides several file system types including FatFS and
	  LittleFS, but it is possible to define additional ones and
	  register them.  A slot is required for each type.

config FILE_SYSTEM_MAX_FILE_NAME
	int "Optional override for maximum file name length"
	default -1
	help
	  Specify the maximum file name allowed across all enabled file
	  system types.  Zero or a negative value selects the maximum
	  file name length for enabled in-tree file systems.  This
	  default may be inappropriate when registering an out-of-tree
	  file system.  Selecting a value less than the actual length
	  supported by a file system may result in memory access
	  violations.

config FILE_SYSTEM_INIT_PRIORITY
	int "File system initialization priority"
	default 99
	help
	  Specify the initialization priority for file systems. In case
	  automount is enabled, the initialization should be done after
	  the underlying storage device is initialized.

config FILE_SYSTEM_SHELL
	bool "File system shell"
	depends on SHELL
	depends on HEAP_MEM_POOL_SIZE > 0
	help
	  This shell provides basic browsing of the contents of the
	  file system.

if FILE_SYSTEM_SHELL

config FILE_SYSTEM_SHELL_TEST_COMMANDS
	bool "File system shell read/write/erase test commands"
	select CBPRINTF_FP_SUPPORT
	help
	  Enable additional file system shell commands for performing
	  read/write/erase tests with speed output.

config FILE_SYSTEM_SHELL_BUFFER_SIZE
	hex "File system shell buffer size"
	depends on FILE_SYSTEM_SHELL_TEST_COMMANDS
	default 0x100
	range 0x20 0x1000000
	help
	  Size of the buffer used for file system commands, will determine the
	  maximum size that can be used with a read/write test. Note that this
	  is used on the stack.

endif # FILE_SYSTEM_SHELL

config FILE_SYSTEM_MKFS
	bool "Allow to format file system"
	help
	  Enables function fs_mkfs that can be used to format a storage device.

config FUSE_FS_ACCESS
	bool "FUSE based access to file system partitions"
	depends on ARCH_POSIX
	help
	  Expose file system partitions to the host system through FUSE.

rsource "Kconfig.fatfs"
rsource "Kconfig.littlefs"
rsource "ext2/Kconfig"

endif # FILE_SYSTEM

rsource "fcb/Kconfig"
rsource "nvs/Kconfig"

endmenu
```
