## subsys/usb/device_next/class/Kconfig.usbtmc
```kconfig
# SPDX-FileCopyrightText: Copyright The Zephyr Project Contributors
# SPDX-License-Identifier: Apache-2.0

config USBD_USBTMC_CLASS
	bool "USB Test and Measurement Class support [EXPERIMENTAL]"
	default y
	depends on DT_HAS_ZEPHYR_USBTMC_DEVICE_ENABLED
	select EXPERIMENTAL
	help
	  USB Test and Measurement Class (USBTMC) device support.

if USBD_USBTMC_CLASS

config USBD_USBTMC_BUF_POOL_SIZE
	int "USBTMC transfer buffer size"
	range 512 65536
	default 2048
	help
	  Size of the buffers used for bulk transfers and to stage message
	  data submitted by the application. It limits the number of message
	  data bytes transferred at once, larger messages are transferred in
	  multiple chunks. The size must be a multiple of the maximum bulk
	  endpoint packet size.

config USBD_USBTMC_TX_BUF_COUNT
	int "Number of buffers to stage message data to be sent"
	range 1 16
	default 2
	help
	  Number of buffers, per instance, used to stage message data
	  submitted by the application before the host reads it.

module = USBD_USBTMC
module-str = usbd usbtmc
source "subsys/logging/Kconfig.template.log_config"

endif # USBD_USBTMC_CLASS
```

## subsys/usb/device_next/class/Kconfig.xbox360
```kconfig
# Copyright (c) 2026 Adrien RICCIARDI
#
# SPDX-License-Identifier: Apache-2.0

config USBD_XBOX360_CONTROLLER_CLASS
	bool "Xbox 360 controller USB class support"
	help
	  Enable the Xbox 360 controller device class support.

if USBD_XBOX360_CONTROLLER_CLASS

module = USBD_XBOX360_CONTROLLER
module-str = usbd xbox360
source "subsys/logging/Kconfig.template.log_config"

endif
```

## subsys/usb/host/Kconfig
```kconfig
# Copyright (c) 2022 Nordic Semiconductor ASA
#
# SPDX-License-Identifier: Apache-2.0

menuconfig USB_HOST_STACK
	bool "USB host stack [EXPERIMENTAL]"
	select EXPERIMENTAL
	select UHC_DRIVER
	help
	  USB host stack for device enumeration and class drivers.

if USB_HOST_STACK

module = USBH
module-str = usbh
source "subsys/logging/Kconfig.template.log_config"

config USBH_USB_DEVICE_MAX
	int "Maximum number of USB devices supported."
	default 4
	range 2 127
	help
	  Maximum number of USB devices supported for all controllers.

config USBH_USB_DEVICE_HEAP
	int "Memory used to cache device descriptors"
	default 1024
	range 256 16384
	help
	  Memory used to cache device descriptors.

config USBH_SHELL
	bool "USB host shell"
	depends on SHELL
	help
	  Shell commands for USB host support.

config USBH_INIT_PRIO
	int
	default 90
	help
	  USB host thread initialization priority level.

config USBH_STACK_SIZE
	int "USB host stack thread stack size"
	default 2048
	help
	  Stack size in bytes for both usbh and usbh_bus kernel threads.

	  The bus thread runs usbh_device_init() and uhc_bus_reset(); with verbose
	  host-controller drivers and logging, 1024 is often too small on AArch64
	  (stack corruption after k_sem_take / control-transfer completion).

config USBH_MAX_UHC_MSG
	int "Maximum number of UHC events"
	default 10
	help
	  Maximum number of USB host controller events that can be queued.

rsource "Kconfig.usbip"
rsource "class/Kconfig"

config USBH_USB2_ENUM_SCHEME
	bool "USB2 enumeration (64-byte GET_DESCRIPTOR before SET_ADDRESS)"
	default y
	help
	  USB2 (non-SuperSpeed) enumeration order in usbh_device_init():

	    1) Bus reset (host driver: Address Device BSR=1)
	    2) GET_DESCRIPTOR(DEVICE) with wLength=64
	    3) Optional second bus reset (off by default)
	    4) Address assignment (xHCI: @ref uhc_assign_address / Address Device BSR=0;
	       legacy HCDs: CH9 SET_ADDRESS)
	    5) busy-wait(post-set-address); Zephyr busy-waits (mutex held)
	    6) GET_DESCRIPTOR(DEVICE) for the full 18-byte device descriptor

	  On integrated xHCI hosts the host stack calls @ref uhc_assign_address()
	  (Address Device BSR=0) instead of CH9 SET_ADDRESS; the HCD returns the
	  wire address from the output slot context.

	  Disable to use the legacy order: 8-byte read, validate, 18-byte read,
	  then SET_ADDRESS.

config USBH_USB2_ENUM_SECOND_RESET
	bool "Second bus reset after first GET_DESCRIPTOR"
	default n
	depends on USBH_USB2_ENUM_SCHEME
	help
	  After the 64-byte descriptor read and before SET_ADDRESS, call
	  uhc_bus_reset() again. Can require host-controller-specific slot
	  recovery; leave disabled unless your HCD needs it.

config USBH_POST_SET_ADDRESS_MS
	int "Milliseconds to delay after SET_ADDRESS"
	default 10
	range 0 500
	depends on USBH_USB2_ENUM_SCHEME
	help
	  Post-SET_ADDRESS settle interval before the full device descriptor read.
	  usbh_device_init() holds udev->mutex across enumeration; k_msleep() is
	  used so other threads can run while the device mutex remains held.
	  Set to 0 to skip.

config USBH_GET_DESCRIPTOR_TRIES
	int "GET_DESCRIPTOR retry count"
	default 2
	range 1 5
	depends on USBH_USB2_ENUM_SCHEME
	help
	  Retry count for the first GET_DESCRIPTOR loop in USB2 enumeration,
	  with USBH_ENUM_RETRY_DELAY_MS between tries.

config USBH_SET_ADDRESS_TRIES
	int "SET_ADDRESS retry count"
	default 2
	range 1 5
	depends on USBH_USB2_ENUM_SCHEME
	help
	  Retry count for SET_ADDRESS in USB2 enumeration, with
	  USBH_SET_ADDRESS_RETRY_DELAY_MS between tries.

config USBH_ENUM_RETRY_DELAY_MS
	int "Milliseconds between GET_DESCRIPTOR retries"
	default 100
	range 0 500
	depends on USBH_USB2_ENUM_SCHEME

config USBH_SET_ADDRESS_RETRY_DELAY_MS
	int "Milliseconds between SET_ADDRESS retries"
	default 200
	range 0 500
	depends on USBH_USB2_ENUM_SCHEME

config USBH_POST_SET_CONFIGURATION_MS
	int "Milliseconds to delay after SET_CONFIGURATION before full cfg read"
	default 0
	range 0 500
	help
	  Some devices and integrated xHCI hosts need a short settle after
	  SET_CONFIGURATION before the next EP0 transfer. If enumeration fails
	  reading the full configuration descriptor (often the first chunk right
	  after SET_CONFIGURATION), try 5–20 ms here. Uses k_msleep() like
	  USBH_POST_SET_ADDRESS_MS.

endif # USB_HOST_STACK
```

## subsys/usb/host/Kconfig.hub
```kconfig
# Copyright (c) 2026 Advanced Micro Devices, Inc.
# SPDX-License-Identifier: Apache-2.0

config USBH_HUB
	bool "USB hub support (Chapter 11)"
	default n
	help
	  Hub control requests and host-core hub driver (Chapter 11 hub driver).
	  Powers downstream ports, handles port status change events, and
	  enumerates devices on hub ports.

if USBH_HUB

config USBH_HUB_INSTANCES_COUNT
	int "Number of USB hub driver instances"
	default 2
	range 1 8
	help
	  One instance is bound per physical hub on the bus (one hub driver
	  context per physical hub). Increase for cascaded hubs. Each hub also
	  consumes one entry from CONFIG_USBH_USB_DEVICE_MAX.

config USBH_HUB_PORT_RESET_MS
	int "Milliseconds to wait during hub port reset"
	default 50
	range 10 500
	help
	  Delay after SET_FEATURE(PORT_RESET) before polling for C_PORT_RESET.

config USBH_HUB_MAX_PORTS
	int "Maximum downstream ports supported by the hub driver"
	default 8
	range 1 15
	help
	  Size of the hub status-change bitmap and port scan loops.

endif # USBH_HUB
```
