## subsys/profiling/irq_stats/Kconfig
```kconfig
# SPDX-FileCopyrightText: Copyright The Zephyr Project Contributors
# SPDX-License-Identifier: Apache-2.0

config IRQ_STATS
	bool "Per-interrupt statistics"
	depends on ARCH_SUPPORTS_IRQ_STATS
	help
	  Collect per-interrupt statistics from the interrupt dispatch
	  path: invocation count, total handler CPU cycles and the
	  longest single invocation, per software ISR table index and
	  per CPU. Zephyr's equivalent of /proc/interrupts. Adds two
	  cycle counter reads and a few words of bookkeeping to every
	  interrupt dispatched through the software ISR table.
	  Caution: the counters use NUM_IRQS * MP_MAX_NUM_CPUS * 16
	  bytes of RAM.

if IRQ_STATS

config IRQ_STATS_SHELL
	bool "irqstats shell command"
	depends on SHELL
	default y
	help
	  Provide the "irqstats" shell command to show and reset the
	  collected statistics.

config IRQ_STATS_MAX_NESTING
	int "Maximum tracked interrupt nesting depth"
	default 8
	range 1 32
	help
	  Depth of the per-CPU stack used to track nested interrupts.
	  Interrupts nested deeper than this are still dispatched
	  normally but not measured.

endif
```

## subsys/profiling/perf/event/Kconfig
```kconfig
# SPDX-FileCopyrightText: Copyright 2026 Arm Limited and/or its
# SPDX-FileCopyrightText: affiliates <open-source-office@arm.com>
#
# SPDX-License-Identifier: Apache-2.0

config PROFILING_PERF_EVENTS
	bool "Performance event subsystem"
	depends on MULTITHREADING
	help
	  Enable provider-based performance event discovery and counter
	  session management. Applications can resolve named events and
	  capture counter snapshots through the C API.

	  Providers and shell commands are enabled separately. This
	  subsystem does not require stack-sampling support.

if PROFILING_PERF_EVENTS

config PROFILING_PERF_EVENTS_MAX_EVENTS
	int "Maximum events in a stat session"
	default 8
	range 1 32
	help
	  Maximum number of events that can be measured in one stat session.

config PROFILING_PERF_EVENTS_NAME_MAX
	int "Maximum shell event name length"
	default 64
	range 8 128
	help
	  Maximum canonical event name length, including the NUL terminator,
	  retained by the perf stat shell frontend.

config PROFILING_PERF_EVENTS_SHELL
	bool "Perf counter session shell commands"
	depends on SHELL
	help
	  Add perf list and perf stat commands and stat result buffering to the
	  existing perf shell command.

config PROFILING_PERF_EVENT_PROVIDER_CPU
	bool "CPU performance counter provider"
	depends on ARM64_PMUV3
	help
	  Register a per-CPU provider (cpu0, cpu1, ...) that exposes hardware
	  performance events (cycles, instructions, cache and branch events)
	  through the portable <zephyr/arch/pmu.h> API. The ARMv8-A PMUv3
	  backend is used today; any architecture that implements the pmu_*()
	  primitives can back this provider unchanged.

	  On SMP, each counter session is steered onto the target CPU. Enable
	  CONFIG_SCHED_CPU_MASK to measure a CPU other than the calling one.

endif
```

## subsys/profiling/pmu_sampling/Kconfig
```kconfig
# Copyright (c) 2026 Advanced Micro Devices, Inc.
# SPDX-License-Identifier: Apache-2.0

config PROFILING_PMU_SAMPLING
	bool "PMU overflow PC sampling profiler (ARM64)"
	depends on PROFILING
	depends on ARM64
	depends on ARM64_PMUV3
	depends on GEN_SW_ISR_TABLE
	select SCHED_CPU_MASK if SMP
	help
	  Enable periodic program-counter sampling using a programmable PMU counter
	  overflow interrupt (PMINTENSET_EL1). Requires a GIC interrupt line for
	  the PMU on your SoC: either an enabled arm,armv8-pmu devicetree node with
	  interrupts, or CONFIG_ARM64_PMU_OVERFLOW_IRQ set to the correct INTID.

	  On SMP systems, per-CPU work queues are created at init time to program
	  each CPU's PMU counter independently when sampling starts.

	  Sampling is driven through the public API in
	  include/zephyr/profiling/pmu_sampling.h.

	  Design, devicetree, and limitations: subsys/profiling/pmu_sampling/README.rst

if PROFILING_PMU_SAMPLING

config PROFILING_PMU_SAMPLE_BUFFER_LEN
	int "Number of PC samples to retain in RAM"
	default 512
	help
	  Ring buffer capacity. When full, new samples overwrite the oldest entries.

config ARM64_PMU_OVERFLOW_IRQ
	int "PMU overflow GIC IRQ (INTID) when no devicetree node"
	default -1
	help
	  When negative, the interrupt number is taken from the first enabled
	  arm,armv8-pmu devicetree node. Otherwise this INTID is used (board-specific).

config PROFILING_PMU_ZPERF_MAX
	int "Max zperf blob size for pmu_sampling_export_zperf() (bytes)"
	default 32768
	help
	  Static buffer used by pmu_sampling_export_zperf(). Must be at least
	  pmu_sampling_export_zperf_size() for your workload (header + 24 bytes per
	  stored sample). Increase if export returns -ENOSPC.

endif # PROFILING_PMU_SAMPLING
```

## subsys/rc/Kconfig
```kconfig
# SPDX-FileCopyrightText: Copyright (c) 2026 Linumiz
# SPDX-License-Identifier: Apache-2.0

menuconfig RC
	bool "Remote control (IR) support"
	help
	  Enable the remote control subsystem: raw pulse and space capture,
	  protocol decoding and encoding, and transmission for infrared
	  remote controls.

if RC

config RC_INIT_PRIORITY
	int "Remote control device init priority"
	default 90
	help
	  Init priority of remote control devices. Must be higher than the
	  priority of devices they depend on, such as Pulse IO controllers.

config RC_RAW_BUFFER_SIZE
	int "Raw receive buffer size per device, in words"
	default 128
	help
	  Number of raw pulse and space words buffered per device between
	  the driver and the rc receive work queue. Must be a power of 2.

config RC_DECODER_STATE_SIZE
	int "Decoder state size per device, in bytes"
	default 128
	help
	  Memory per device for the state of all built protocol decoders.
	  Device init fails if the built decoders need more.

config RC_RX_WORKQ_STACK_SIZE
	int "Receive work queue stack size"
	default 2048 if 64BIT || SPARC
	default 1024
	help
	  Stack size of the work queue that decodes raw words of all rc
	  devices.

config RC_RX_WORKQ_PRIORITY
	int "Receive work queue priority"
	default 10
	help
	  Preemptible priority of the work queue that decodes raw words of
	  all rc devices.

module = RC
module-str = rc
source "subsys/logging/Kconfig.template.log_config"

endif # RC
```

## subsys/rc/protocols/Kconfig
```kconfig
# SPDX-FileCopyrightText: Copyright (c) 2026 Linumiz
# SPDX-License-Identifier: Apache-2.0

menu "Protocols"

config RC_PROTOCOL_NEC
	bool "NEC protocol"
	default y
	help
	  Decoder and encoder for NEC, extended NEC and 32 bit NEC.

endmenu
```

## subsys/safety_test/Kconfig
```kconfig
# Copyright (c) 2026 Aerlync Labs Inc.
# SPDX-License-Identifier: Apache-2.0

menuconfig SAFETY_TEST
	bool "Safety test subsystem"
	help
	  Framework for registering and executing hardware and software self-tests at
	  boot time and at runtime.

if SAFETY_TEST

config SAFETY_TEST_STRICT_CRITICAL
	bool "Refuse SAFETY_TEST_ACTION_CONTINUE for critical tests"
	default y
	help
	  When set, a SAFETY_TEST_ACTION_CONTINUE returned from
	  safety_test_safe_state() is ignored for a test carrying
	  SAFETY_TEST_FLAG_CRITICAL, and the system halts instead. This gives a
	  production build a compile-time guarantee that a critical failure
	  cannot be waved through. Clear it only in test builds.

choice
	prompt "Default action when a critical test fails"
	default SAFETY_TEST_DEFAULT_ACTION_HALT
	help
	  Action returned by the built-in weak safety_test_safe_state()
	  implementation. Applications that override that function choose their
	  own action and this setting no longer applies to them.

config SAFETY_TEST_DEFAULT_ACTION_HALT
	bool "Halt"

config SAFETY_TEST_DEFAULT_ACTION_RESET
	bool "Cold reboot"
	depends on REBOOT

endchoice

config SAFETY_TEST_BUDGET_FAILS
	bool "Treat a duration budget overrun as a test failure"
	help
	  When set, a test that runs longer than its max_duration_us is scored as
	  failed, which for a SAFETY_TEST_FLAG_CRITICAL test reaches the safe
	  state and can halt or reset the board.

	  Leave this off unless the diagnostic timing is itself safety relevant
	  and the budgets have been measured on a loaded system. The measurement
	  is wall time, so an unrelated interrupt can push a healthy test over its
	  budget. With this off, an overrun is still recorded and logged.

config SAFETY_TEST_EARLY_TESTS
	bool "Run safety tests at the EARLY init level"
	help
	  Execute tests registered for SAFETY_TEST_LEVEL_EARLY. At that point no
	  kernel service is available and, on most targets, neither is the cycle
	  counter, so duration budgets are not checked at that level.

	  Logging is not usable that early either: the log buffer is created
	  after the EARLY level, so messages are discarded. A critical failure
	  here prints nothing and the board simply stops. The failing test is
	  recorded in a noinit variable that a debugger can read, and that is
	  reported on the next boot if RAM survived the reset.

config SAFETY_TEST_INIT_PRIORITY
	int "Init priority for safety test execution"
	default 99
	range 0 999
	help
	  SYS_INIT priority at which each level's tests run. The default places
	  them after ordinary device drivers, which typically initialize in the
	  40-60 range. Raise it to run tests later within their level.

module = SAFETY_TEST
module-str = safety test
source "subsys/logging/Kconfig.template.log_config"

endif # SAFETY_TEST
```

## subsys/secure_storage/Kconfig
```kconfig
# Copyright (c) 2024 Nordic Semiconductor
# SPDX-License-Identifier: Apache-2.0

menuconfig SECURE_STORAGE
	bool "Secure storage subsystem"
	depends on !BUILD_WITH_TFM
	select MBEDTLS_PSA_CRYPTO_STORAGE_C if MBEDTLS_PSA_CRYPTO_C
	help
	  The secure storage subsystem provides an implementation of the PSA Secure Storage API
	  functions on board targets that don't already have one.
	  It allows making use of the PSA Secure Storage API and persistent keys in the PSA Crypto
	  API in a standard and portable way.
	  It is configurable and different implementations can be used to accommodate the varying
	  capabilities of different devices.
	  In addition to providing functional support for the PSA Secure Storage API, depending on
	  the device-specific security features that are available and used, the subsystem may
	  secure the data stored through it at rest.
	  This is however highly dependent on the device and configuration in use, and not a
	  guarantee of the subsystem.

if SECURE_STORAGE

module = SECURE_STORAGE
module-str = secure_storage
source "subsys/logging/Kconfig.template.log_config"

config SECURE_STORAGE_INIT_PRIORITY
	int "Initialization priority"
	depends on SECURE_STORAGE_ITS_STORE_IMPLEMENTATION_SETTINGS || \
		SECURE_STORAGE_ITS_STORE_IMPLEMENTATION_ZMS || \
		(SECURE_STORAGE_ITS_TRANSFORM_IMPLEMENTATION_AEAD && \
		!SECURE_STORAGE_ITS_TRANSFORM_AEAD_NO_INSECURE_KEY_WARNING)
	default APPLICATION_INIT_PRIORITY
	range 0 99
	help
	  Initialization priority for the secure storage components that are
	  initialized at boot time with the APPLICATION level.

config SECURE_STORAGE_64_BIT_UID
	bool "Make psa_storage_uid_t 64-bit"
	help
	  Zephyr, by default, uses a 30-bit psa_storage_uid_t, which allows using only 32 bits to
	  identify entries, requiring less memory per entry.
	  Enable this for backward compatibility if you are updating an existing installation with
	  stored entries that was using Zephyr prior to 4.3 or if for some reason you need the full
	  64-bit UID range.
	  Beware: when CONFIG_SECURE_STORAGE_ITS_TRANSFORM_IMPLEMENTATION_AEAD is used, this option
	  influences both the encryption keys generated and the additional data used to generate
	  authentication tags.
	  This means that entries stored with and without this option enabled are incompatible.

rsource "Kconfig.its"
rsource "Kconfig.ps"

endif # SECURE_STORAGE
```

## subsys/secure_storage/Kconfig.its
```kconfig
# Copyright (c) 2026 BayLibre SAS
# SPDX-License-Identifier: Apache-2.0

choice SECURE_STORAGE_ITS_IMPLEMENTATION
	prompt "Internal Trusted Storage (ITS) API implementation"

config SECURE_STORAGE_ITS_IMPLEMENTATION_ZEPHYR
	bool "Zephyr's ITS implementation"
	select SECURE_STORAGE_ITS_TRANSFORM_MODULE
	select SECURE_STORAGE_ITS_STORE_MODULE
	help
	  Use Zephyr's implementation of the ITS API.
	  It calls into the transform and store modules, which
	  can be configured and have custom implementations.

config SECURE_STORAGE_ITS_IMPLEMENTATION_CUSTOM
	bool "Custom ITS implementation"
	help
	  A custom implementation of the ITS API is present.
	  Implement the functions declared in <zephyr/secure_storage/its.h>.
	  The header is made available when this Kconfig option is enabled.

endchoice # SECURE_STORAGE_ITS_IMPLEMENTATION

config SECURE_STORAGE_ITS_MAX_DATA_SIZE
	int "Maximum data size of an ITS entry in bytes"
	default 128
	help
	  The maximum size, in bytes, that the data of an ITS entry can be.
	  Increasing this value increases the stack usage when serving PSA ITS API calls.

menuconfig SECURE_STORAGE_ITS_TRANSFORM_MODULE
	bool "ITS transform module"
	help
	  The module that handles the transformation and validation of the
	  ITS data before it's written to and after it's read from NVM.
	  Zephyr's ITS implementation calls into it.

if SECURE_STORAGE_ITS_TRANSFORM_MODULE

rsource "Kconfig.its_transform"

endif

menuconfig SECURE_STORAGE_ITS_STORE_MODULE
	bool "ITS store module"
	help
	  The module that handles the storage/retrieval of the ITS data to/from NVM.
	  Zephyr's ITS implementation calls into it.

if SECURE_STORAGE_ITS_STORE_MODULE

rsource "Kconfig.its_store"

endif
```
