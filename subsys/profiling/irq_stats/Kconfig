## subsys/secure_storage/Kconfig.ps
```kconfig
# Copyright (c) 2026 BayLibre SAS
# SPDX-License-Identifier: Apache-2.0

choice SECURE_STORAGE_PS_IMPLEMENTATION
	prompt "Protected Storage (PS) API implementation"
	default SECURE_STORAGE_PS_IMPLEMENTATION_ITS

config SECURE_STORAGE_PS_IMPLEMENTATION_ZEPHYR
	bool "Zephyr's PS implementation"
	select SECURE_STORAGE_PS_TRANSFORM_MODULE
	select SECURE_STORAGE_PS_STORE_MODULE
	help
	  Use Zephyr's implementation of the PS API.
	  It calls into the transform and store modules, which
	  can be configured and have custom implementations.

config SECURE_STORAGE_PS_IMPLEMENTATION_ITS
	bool "PS calls directly into the ITS"
	help
	  The PS API doesn't have an implementation of its own, and directly calls into the ITS API.
	  This means that the implementation of the PS API will be identical to that of the ITS API.

config SECURE_STORAGE_PS_IMPLEMENTATION_CUSTOM
	bool "Custom PS implementation"
	help
	  A custom implementation of the PS API is present.
	  Implement the functions declared in <zephyr/secure_storage/ps.h>.
	  The header is made available when this Kconfig option is enabled.

endchoice # SECURE_STORAGE_PS_IMPLEMENTATION

config SECURE_STORAGE_PS_SUPPORTS_SET_EXTENDED
	bool "PS API implementation supports psa_ps_create() and psa_ps_set_extended()"
	depends on SECURE_STORAGE_PS_IMPLEMENTATION_CUSTOM
	help
	  Whether the psa_ps_create() and psa_ps_set_extended() functions are implemented.

config SECURE_STORAGE_PS_MAX_DATA_SIZE
	int "Maximum data size of a PS entry in bytes"
	default 128
	help
	  The maximum size, in bytes, that the data of a PS entry can be.
	  Increasing this value increases the stack usage when serving PSA PS API calls.

menuconfig SECURE_STORAGE_PS_TRANSFORM_MODULE
	bool "PS transform module"
	depends on SECURE_STORAGE_PS_IMPLEMENTATION_ZEPHYR
	help
	  The module that handles the transformation and validation of the
	  PS data before it's written to and after it's read from NVM.
	  Zephyr's PS implementation calls into it.

if SECURE_STORAGE_PS_TRANSFORM_MODULE

rsource "Kconfig.ps_transform"

endif

menuconfig SECURE_STORAGE_PS_STORE_MODULE
	bool "PS store module"
	depends on SECURE_STORAGE_PS_IMPLEMENTATION_ZEPHYR
	help
	  The module that handles the storage/retrieval of the PS data to/from NVM.
	  Zephyr's PS implementation calls into it.

if SECURE_STORAGE_PS_STORE_MODULE

rsource "Kconfig.ps_store"

endif
```

## subsys/secure_storage/Kconfig.ps_replay_protection
```kconfig
# Copyright (c) 2026 BayLibre SAS
# SPDX-License-Identifier: Apache-2.0

choice SECURE_STORAGE_PS_REPLAY_PROTECTION_IMPLEMENTATION
	prompt "Protected Storage (PS) replay protection implementation"
	default SECURE_STORAGE_PS_REPLAY_PROTECTION_RANDOM

config SECURE_STORAGE_PS_REPLAY_PROTECTION_RANDOM
	bool "Random value"
	select PSA_CRYPTO
	help
	  Generate a new random value with psa_generate_random() each time the
	  entry is written. Its size is set by
	  CONFIG_SECURE_STORAGE_PS_REPLAY_PROTECTION_SIZE (4 bytes by default).

config SECURE_STORAGE_PS_REPLAY_PROTECTION_COUNTER
	bool "Counter"
	select PSA_CRYPTO
	help
	  Pick a random initial value and increment it by 1 each time the entry
	  is overwritten. The counter has a length of
	  CONFIG_SECURE_STORAGE_PS_REPLAY_PROTECTION_SIZE bytes and it's stored
	  in big endian format.

config SECURE_STORAGE_PS_REPLAY_PROTECTION_CUSTOM
	bool "Use a custom solution for replay protection"
	help
	  Implement the secure_storage_ps_get_replay_protection() function
	  declared in <zephyr/secure_storage/ps/replay_protection.h>
	  and set CONFIG_SECURE_STORAGE_PS_REPLAY_PROTECTION_SIZE appropriately.

endchoice # SECURE_STORAGE_PS_REPLAY_PROTECTION_IMPLEMENTATION

config SECURE_STORAGE_PS_REPLAY_PROTECTION_SIZE
	int "Size of replay protection data stored in ITS"
	range 1 SECURE_STORAGE_ITS_MAX_DATA_SIZE
	default 4 if SECURE_STORAGE_PS_REPLAY_PROTECTION_RANDOM || \
		     SECURE_STORAGE_PS_REPLAY_PROTECTION_COUNTER
	help
	  Size of the replay protection value of each PS entry. The value is
	  stored in ITS, together with the entry's create flags, and passed to
	  the PS transform module, which binds it to the data stored in PS.
	  Note: as the create flags take one byte, the actual maximum is
	        CONFIG_SECURE_STORAGE_ITS_MAX_DATA_SIZE - 1. Kconfig cannot
	        express this, so the upper bound of the range is one byte too
	        large and a build-time assertion enforces the exact limit.
```

## subsys/task_wdt/Kconfig
```kconfig
# Software watchdog configuration

# Copyright (c) 2020 Libre Solar Technologies GmbH
# SPDX-License-Identifier: Apache-2.0

menuconfig TASK_WDT
	bool "Task-level software watchdog"
	select REBOOT
	help
	  Enable task watchdog

	  The task watchdog allows to have individual watchdog channels
	  per thread, even if the hardware supports only a single watchdog.

if TASK_WDT

config TASK_WDT_DUMMY
	bool "Dummy implementation for testing"
	help
	  Allows the code to use all Task Watchdog APIs, but does nothing.
	  This can be useful to temporarily disable the Task Watchdog while
	  debugging.

config TASK_WDT_CHANNELS
	int "Maximum number of task watchdog channels"
	default 5
	range 2 100
	help
	  The timeouts for each channel are stored in an array. Allocate only
	  the required amount of channels to reduce memory footprint.

config TASK_WDT_HW_FALLBACK
	bool "Use hardware watchdog as a fallback"
	default y
	help
	  This option allows to specify a hardware watchdog device in the
	  application that is used as an additional safety layer if the task
	  watchdog itself gets stuck.

config TASK_WDT_MIN_TIMEOUT
	int "Minimum timeout for task watchdog (ms)"
	depends on TASK_WDT_HW_FALLBACK
	default 100
	range 1 10000
	help
	  The task watchdog uses a continuously restarted k_timer as its
	  backend. This value specifies the minimum timeout in milliseconds
	  among all task watchdogs used in the application.

	  If a hardware watchdog is configured as a fallback for the task
	  watchdog, its timeout is set to this value plus
	  TASK_WDT_HW_FALLBACK_DELAY.

config TASK_WDT_HW_FALLBACK_DELAY
	int "Additional delay for hardware watchdog (ms)"
	depends on TASK_WDT_HW_FALLBACK
	default 20
	range 1 10000
	help
	  The timeout of the hardware watchdog fallback will be increased by
	  this value to provide sufficient time for corrective actions in the
	  callback function.

	  In addition to that, the delay allows to compensate deviations
	  between different clock sources for the hardware watchdog and the
	  kernel timer. This is especially important if the hardware watchdog
	  is clocked by an inaccurate low-speed RC oscillator.

config TASK_WDT_HW_FALLBACK_PAUSE_HALTED_BY_DBG
	bool "Pause the hardware watchdog when halted by the debugger"
	depends on TASK_WDT_HW_FALLBACK
	default y
	help
	  Configure the hardware watchdog to automatically pause when the
	  system is halted by the debugger.
	  Note that this feature is supported only by a subset of hardware
	  watchdogs.

config TASK_WDT_HW_FALLBACK_PAUSE_IN_SLEEP
	bool "Pause the hardware watchdog in system sleep"
	depends on TASK_WDT_HW_FALLBACK
	help
	  Configure the hardware watchdog to automatically pause when the
	  system reaches a sleep power state. When the system is resumed, the
	  watchdog is also automatically resumed.
	  Note that this feature is supported only by a subset of hardware
	  watchdogs.

config TASK_WDT_THREAD_INFO
	bool "Report the thread owning a timed out channel"
	help
	  Record the thread owning each channel, which by default is the
	  thread which fed the channel last. When a channel times out, log
	  the owner thread's name, state, priority and unused stack space
	  (if CONFIG_INIT_STACKS and CONFIG_THREAD_STACK_INFO are enabled)
	  before calling the callback or resetting the system.

config TASK_WDT_COREDUMP
	bool "Core dump the owner thread before resetting the system"
	depends on TASK_WDT_THREAD_INFO
	depends on DEBUG_COREDUMP
	help
	  If a channel without a callback times out, create a core dump
	  before resetting the system, with the owner thread as the faulting
	  thread. Combined with CONFIG_DEBUG_COREDUMP_MEMORY_DUMP_THREADS,
	  this allows to find out where the owner thread was stuck.

config TASK_WDT_FAULT_REASONS
	bool "Fault reasons and minimum feed interval"
	help
	  Allow to add channels with task_wdt_add_ext(), whose callback is
	  told the reason of the fault, and to set a minimum interval between
	  two feeds of a channel with task_wdt_window_set(). Feeding a channel
	  too early is reported as a fault, which detects a thread stuck in a
	  loop feeding its channel.

config TASK_WDT_SUPERVISION
	bool "Checkpoint supervision"
	select TASK_WDT_FAULT_REASONS
	help
	  Allow to supervise the program flow of an entity defined with
	  TASK_WDT_SUPERVISION_DEFINE(), which reports the checkpoints it
	  reaches with task_wdt_checkpoint(). Reaching a checkpoint which is
	  not allowed after the previous one, or reaching the end of a
	  deadline too early or too late, is reported as a fault on the
	  channel the entity is attached to.

menuconfig TASK_WDT_GROUPS
	bool "Channel groups, recovery and escalation"
	help
	  Allow to add channels to a group defined with
	  TASK_WDT_GROUP_DEFINE(), whose policy decides whether a fault calls
	  the channel callback, calls the recovery function of the group from
	  a dedicated work queue, or resets the system. A group moves to the
	  next action when it reports too many faults within a period, and the
	  system is reset if the recovery does not feed the channel again in
	  time.

if TASK_WDT_GROUPS

config TASK_WDT_RECOVERY_STACK_SIZE
	int "Recovery work queue stack size"
	default 1024
	help
	  Stack size of the work queue thread calling the recovery functions
	  of the groups.

config TASK_WDT_RECOVERY_PRIORITY
	int "Recovery work queue priority"
	default 0 if !COOP_ENABLED
	default -1
	help
	  Priority of the work queue thread calling the recovery functions of
	  the groups. It should be higher than the priority of the supervised
	  threads, so a thread stuck in a loop does not prevent its recovery.

endif # TASK_WDT_GROUPS

DT_CHOSEN_TASK_WDT_RESET_INFO := zephyr,task-wdt-reset-info

menuconfig TASK_WDT_RESET_INFO
	bool "Keep the cause of a task watchdog reset"
	select CRC
	help
	  When a channel times out and its callback does not return (or there
	  is no callback), store a record with the channel, the name of its
	  owner thread (if CONFIG_TASK_WDT_THREAD_INFO and CONFIG_THREAD_NAME
	  are enabled), the uptime and the number of consecutive task watchdog
	  resets. After the reset, the record can be read with
	  task_wdt_reset_info_get().

if TASK_WDT_RESET_INFO

choice TASK_WDT_RESET_INFO_BACKEND
	prompt "Reset information storage"
	default TASK_WDT_RESET_INFO_NOINIT

config TASK_WDT_RESET_INFO_NOINIT
	bool "Non-initialized RAM"
	help
	  Store the record in RAM which is not cleared at boot. The record
	  survives a reset as long as the hardware retains the RAM contents.

config TASK_WDT_RESET_INFO_RETENTION
	bool "Retention area"
	depends on RETENTION
	depends on RETENTION_MUTEX_FORCE_DISABLE
	depends on RETAINED_MEM_MUTEX_FORCE_DISABLE
	depends on $(dt_chosen_enabled,$(DT_CHOSEN_TASK_WDT_RESET_INFO))
	help
	  Store the record in the retention area selected with the
	  zephyr,task-wdt-reset-info chosen node. The record is written from
	  the task watchdog timer interrupt, so the retention and retained
	  memory mutexes have to be disabled, and the retained memory driver
	  must not block, as the RAM based drivers.

endchoice

config TASK_WDT_RESET_INFO_HW_FALLBACK
	bool "Detect resets by the hardware watchdog fallback"
	depends on TASK_WDT_HW_FALLBACK
	depends on HWINFO
	default y
	help
	  If the hardware reset cause is a watchdog reset but no record was
	  stored by the task watchdog, report that the hardware watchdog
	  fallback reset the system, which means the whole system was stuck.
	  The application has to clear the hardware reset cause with
	  hwinfo_clear_reset_cause() after the task watchdog was initialized.

DT_CHOSEN_BOOT_MODE := zephyr,boot-mode

config TASK_WDT_SAFE_MODE
	bool "Boot into a safe mode after repeated task watchdog resets"
	depends on RETENTION_BOOT_MODE
	depends on $(dt_chosen_enabled,$(DT_CHOSEN_BOOT_MODE))
	depends on RETENTION_MUTEX_FORCE_DISABLE
	depends on RETAINED_MEM_MUTEX_FORCE_DISABLE
	help
	  Set the boot mode to TASK_WDT_SAFE_MODE_BOOT_MODE with
	  bootmode_set() before the task watchdog resets the system for the
	  TASK_WDT_SAFE_MODE_RESETS-th consecutive time. The boot mode is set
	  from the task watchdog timer interrupt, so the retention and
	  retained memory mutexes have to be disabled.

if TASK_WDT_SAFE_MODE

config TASK_WDT_SAFE_MODE_RESETS
	int "Consecutive task watchdog resets before booting into the safe mode"
	default 3
	range 1 255

config TASK_WDT_SAFE_MODE_BOOT_MODE
	int "Boot mode of the safe mode"
	default 1
	range 1 255
	help
	  Boot mode value passed to bootmode_set(). The default is
	  BOOT_MODE_TYPE_BOOTLOADER.

endif # TASK_WDT_SAFE_MODE

endif # TASK_WDT_RESET_INFO

config TASK_WDT_SHELL
	bool "Task watchdog shell utilities"
	depends on SHELL
	help
	  Activate shell module that provides Task watchdog commands.

endif
```
