## subsys/testsuite/ztest/benchmark/Kconfig
```kconfig
# Copyright (c) 2025 Måns Ansgariusson <mansgariusson@gmail.com>
# SPDX-License-Identifier: Apache-2.0

menu "benchmarking options"
config ZTEST_BENCHMARK
	bool "ztest benchmarking features"
	select TIMING_FUNCTIONS
	select REQUIRES_FULL_LIBC
	select REQUIRES_FLOAT_PRINTF
	select EXPERIMENTAL
	help
		Enable features for benchmarking purposes.

if ZTEST_BENCHMARK

config ZTEST_BENCHMARK_PERCENTILES
	bool "Report latency percentiles"
	help
	  Retain the individual samples of each benchmark and report
	  min, p50, p90, p99, p99.9, p99.99 and max alongside the usual
	  statistics.

	  The mean and the standard error describe how precisely the
	  average was estimated, which is the right question for
	  throughput but not for latency: a real-time system is
	  characterised by how bad an individual operation can be, and
	  that lives in the tail of the distribution.

	  A percentile needs enough samples to be resolved at all. p99
	  needs at least 100, p99.9 at least 1000 and p99.99 at least
	  10000; below that the reported value degenerates to the
	  maximum. Retaining samples costs 8 bytes each, so the buffer
	  has to be sized for the number of iterations the benchmarks
	  run.

config ZTEST_BENCHMARK_MAX_SAMPLES
	int "Number of samples retained for percentiles"
	depends on ZTEST_BENCHMARK_PERCENTILES
	default 1024
	help
	  Size of the sample buffer, in samples of 8 bytes each. Only one
	  benchmark runs at a time, so a single buffer of this size is
	  allocated for all of them. It has to be at least as large as
	  the sample count of the largest benchmark: the retained samples
	  are the first ones taken rather than a sample of the whole run,
	  so percentiles over a truncated prefix would miss whatever
	  happened after the buffer filled, which is where the tail tends
	  to live. A benchmark that overruns the buffer reports no
	  percentiles at all and says how many samples did not fit.

choice ZTEST_BENCHMARK_OUTPUT_FORMAT
	prompt "Ztest benchmark output format"
	default ZTEST_BENCHMARK_OUTPUT_VERBOSE
	help
	  Select the output format for benchmark results.

config ZTEST_BENCHMARK_OUTPUT_VERBOSE
	bool "Output verbose benchmark results"
	help
	  Output format designed to be read by humans. It will have a readable format with units and
	  descriptions.

config ZTEST_BENCHMARK_OUTPUT_CSV
	bool "Output benchmark results in CSV format"
	help
	  Formats benchmark output as comma-separated values for machine parsing.

	  Each row is prefixed with a single-letter record type that indicates the benchmark kind
	  and determines the column layout.

	  Sampled benchmarks (created with ZTEST_BENCHMARK() or ZTEST_BENCHMARK_SETUP_TEARDOWN()),
	  emit rows of the form:

	    S, suite, name, samples, total_cycles, mean, stddev, std_error, min, min_sample, max,
	    max_sample

	  All cycle values are noise-corrected against the control measurement.

	  - suite: test suite name
	  - name: benchmark name
	  - samples: number of iterations
	  - total_cycles: aggregate cycle count
	  - mean: average cycles per iteration
	  - stddev: standard deviation
	  - std_error: standard error of the mean
	  - min / max: extreme cycle values
	  - min_sample / max_sample: iteration at which each extreme occurred

	  Manually sampled benchmarks (created with ZTEST_BENCHMARK_MANUAL()) emit "M" rows with
	  the same column layout as "S" rows, where samples is the number of iterations that
	  recorded a span. A manual benchmark that records no samples emits
	  "M, suite, name, INCONCLUSIVE" instead.

	  Timed benchmarks (created with ZTEST_BENCHMARK_TIMED() or
	  ZTEST_BENCHMARK_TIMED_SETUP_TEARDOWN()) emit rows of the form:

	    T, suite, name, iterations, total_cycles, net_cycles, ops_per_sec, cycles_per_op

	  - suite: test suite name
	  - name: benchmark name
	  - iterations: number of completed runs
	  - total_cycles: gross cycle count
	  - net_cycles: cycles after subtracting loop overhead
	  - ops_per_sec: throughput (operations per second)
	  - cycles_per_op: average cost per operation

	  If measured overhead exceeds the total time, the row contains INCONCLUSIVE instead of
	  numeric results (e.g. "T, my_suite, my_benchmark, INCONCLUSIVE").

	  With CONFIG_ZTEST_BENCHMARK_PERCENTILES, every sampled and manual benchmark emits an
	  additional row of the form:

	    P, suite, name, samples, min, p50, p90, p99, p999, p9999, max

	  - samples: number of retained samples the percentiles were taken over
	  - min / max: extreme cycle values
	  - p50 ... p9999: nearest-rank percentiles, p9999 being the 99.99th

	  All values are noise-corrected against the control measurement.
endchoice

endif
endmenu
```

## subsys/usb/device_next/app/Kconfig.cdc_acm_serial
```kconfig
# Copyright (c) 2024 Nordic Semiconductor ASA
# SPDX-License-Identifier: Apache-2.0

# This file contains Kconfig options and defaults for configuring the USB
# device stack and CDC ACM instance to be used as the default serial backend
# for logging or shell.


menuconfig CDC_ACM_SERIAL_INITIALIZE_AT_BOOT
	bool "Initialize USB device and CDC ACM UART at boot"
	depends on USBD_CDC_ACM_CLASS
	help
	  This is intended for use with cdc-acm-snippet or as a default serial
	  backend only in applications where no other USB features are
	  required, configured, and enabled.

if CDC_ACM_SERIAL_INITIALIZE_AT_BOOT

config CDC_ACM_SERIAL_ENABLE_AT_BOOT
	bool "USB device will be enabled at boot"
	default y
	help
	  When disabled, the application is responsible for enabling/disabling
	  the USB device.

config CDC_ACM_SERIAL_MANUFACTURER_STRING
	string "USB device manufacturer string descriptor"
	default "Zephyr Project"
	help
	  USB device manufacturer string descriptor.

config CDC_ACM_SERIAL_PRODUCT_STRING
	string "USB device product string descriptor"
	default "CDC ACM serial backend"
	help
	  USB device product string descriptor.

config CDC_ACM_SERIAL_VID
	hex "USB device Vendor ID"
	default 0x2fe3
	help
	  You must use your own VID for samples and applications outside of
	  Zephyr Project.

config CDC_ACM_SERIAL_PID
	hex "USB device Product ID"
	default 0x0004
	help
	  You must use your own PID for samples and applications outside of
	  Zephyr Project.

config CDC_ACM_SERIAL_SELF_POWERED
	bool "USB device Self-powered attribute"
	help
	  Set the Self-powered attribute in the configuration.

config CDC_ACM_SERIAL_MAX_POWER
	int "USB device bMaxPower value"
	default 125
	range 0 250
	help
	  bMaxPower value in the configuration in 2 mA units.

config CDC_ACM_SERIAL_REBOOT_TO_BOOTLOADER
	bool "Reboot into the bootloader on a magic DTE rate"
	depends on SOC_REBOOT_TO_BOOTLOADER_HOOK && UART_USE_RUNTIME_CONFIGURE
	default y if BOOTLOADER_BOSSA
	help
	  Reboot the device into its bootloader when the host sets the DTE rate
	  to CDC_ACM_SERIAL_REBOOT_DTE_RATE. Arduino style programmers use this
	  to put a board into programming mode without the user having to press
	  a button.

config CDC_ACM_SERIAL_REBOOT_DTE_RATE
	int "DTE rate that triggers the reboot"
	depends on CDC_ACM_SERIAL_REBOOT_TO_BOOTLOADER
	default 1200
	help
	  DTE rate, in bits per second, that triggers a reboot into the
	  bootloader. BOSSA compatible bootloaders use 1200.

endif #CDC_ACM_SERIAL_INITIALIZE_AT_BOOT
```

## subsys/usb/device_next/class/Kconfig.ccid
```kconfig
# Copyright (c) 2026 TeraTron GmbH
# SPDX-License-Identifier: Apache-2.0

menuconfig USBD_CCID_CLASS
	bool "USB CCID device class"
	depends on DT_HAS_ZEPHYR_CCID_ENABLED
	help
	  Enable single-slot USB Chip/Smart Card Interface Devices (CCID)
	  class function. The application must register a card backend before
	  initializing the USB device. Each backend supplies card state, power
	  control, protocol parameter handling, and APDU exchange independently
	  of the card transport and application protocol.

if USBD_CCID_CLASS

config USBD_CCID_MAX_MESSAGE_SIZE
	int "Maximum CCID message size"
	range 271 4096
	default 1024
	help
	  Maximum command or response message, including the 10-byte CCID bulk
	  message header. This value is reported in dwMaxCCIDMessageLength.

config USBD_CCID_MAX_APDU_SIZE
	int "Maximum assembled APDU size"
	range 261 65544
	default 4096
	help
	  Capacity of each instance's command and response APDU buffers. This is
	  independent of the USB message size: extended APDUs can span multiple
	  CCID messages. Oversized APDUs fail with XFR_OVERRUN. Choose a capacity
	  suitable for the backend and available RAM; two buffers are allocated
	  per enabled instance.

config USBD_CCID_THREAD_STACK_SIZE
	int "CCID worker thread stack size"
	default 1536
	help
	  Stack size in bytes of each thread which invokes a card backend.
	  Each interface has a dedicated thread so backend operations may block
	  independently of other interfaces.

config USBD_CCID_THREAD_PRIORITY
	int "CCID worker thread priority"
	default 8
	help
	  Preemptive priority of each CCID worker thread.

module = USBD_CCID
module-str = usbd_ccid
source "subsys/logging/Kconfig.template.log_config"

endif
```

## subsys/usb/device_next/class/Kconfig.cdc_acm
```kconfig
# Copyright (c) 2022 Nordic Semiconductor ASA
#
# SPDX-License-Identifier: Apache-2.0

config USBD_CDC_ACM_CLASS
	bool "USB CDC ACM implementation"
	depends on SERIAL
	depends on DT_HAS_ZEPHYR_CDC_ACM_UART_ENABLED
	select SERIAL_HAS_DRIVER
	select SERIAL_SUPPORT_INTERRUPT
	select UART_INTERRUPT_DRIVEN
	default y
	help
	  USB device CDC ACM class implementation.

if USBD_CDC_ACM_CLASS

config USBD_CDC_ACM_WORKQUEUE
	bool "Use dedicated workqueue in CDC ACM"
	help
	  Use the dedicated queue in CDC ACM implementation if the system work
	  queue cannot be used due to performance issues or other conflicts.

config USBD_CDC_ACM_STACK_SIZE
	int "USB CDC ACM workqueue stack size"
	depends on USBD_CDC_ACM_WORKQUEUE
	default 1024
	help
	  USB CDC ACM workqueue stack size.

config USBD_CDC_ACM_TX_DELAY_MS
	int
	default 100
	help
	  Time in milliseconds to wait before sending actual payload to host.
	  This is needed to prevent tty ECHO on Linux.

module = USBD_CDC_ACM
module-str = usbd cdc_acm
default-count = 1
source "subsys/logging/Kconfig.template.log_config"

endif
```

## subsys/usb/device_next/class/Kconfig.cdc_ecm
```kconfig
# Copyright (c) 2023 Nordic Semiconductor ASA
#
# SPDX-License-Identifier: Apache-2.0

config USBD_CDC_ECM_CLASS
	bool "USB CDC ECM implementation"
	default y
	depends on NET_L2_ETHERNET
	depends on DT_HAS_ZEPHYR_CDC_ECM_ETHERNET_ENABLED
	help
	  USB CDC Ethernet Control Model (ECM) implementation"

if USBD_CDC_ECM_CLASS

config USBD_CDC_ECM_TX_TIMEOUT
	int "TX transfer timeout (milliseconds)"
	range 1 1000
	default 100
	help
	  Maximum time cdc_ecm_send() waits for the previous IN transfer to
	  complete before it drops the packet.

module = USBD_CDC_ECM
module-str = usbd cdc_ecm
default-count = 1
source "subsys/logging/Kconfig.template.log_config"

endif
```

## subsys/usb/device_next/class/Kconfig.cdc_ncm
```kconfig
# Copyright (c) 2024 Nordic Semiconductor ASA
#
# SPDX-License-Identifier: Apache-2.0

config USBD_CDC_NCM_CLASS
	bool "USB CDC NCM implementation"
	default y
	depends on NET_L2_ETHERNET
	depends on DT_HAS_ZEPHYR_CDC_NCM_ETHERNET_ENABLED
	help
	  USB CDC Network Control Model (NCM) implementation

if USBD_CDC_NCM_CLASS

config USBD_CDC_NCM_MAX_DGRAM_PER_NTB
	int "Max number of received datagrams per NTB"
	range 0 $(UINT16_MAX)
	default 2
	help
	  How many datagrams we are able to receive per NTB.

config USBD_CDC_NCM_SUPPORT_NTB32
	bool "Support NTB32 format"
	help
	  Enable support for NTB32 format which allows larger
	  packet sizes.

config USBD_CDC_NCM_TX_TIMEOUT
	int "TX transfer timeout (milliseconds)"
	default 100
	help
	  Maximum time cdc_ncm_send() waits for the previous IN transfer to
	  complete before it drops the packet. A transfer completes only when
	  the host issues an IN token, which it does not while the host side
	  of the interface is down, even though the device is enumerated.
	  Unbounded, the send blocks forever and holds up every other flow
	  queued on the same network TX thread. Raising CONFIG_NET_TC_TX_COUNT
	  does not necessarily separate them, since the default priority
	  mapping places several priorities on one traffic class.

module = USBD_CDC_NCM
module-str = usbd cdc_ncm
source "subsys/logging/Kconfig.template.log_config"

endif
```

## subsys/usb/device_next/class/Kconfig.loopback
```kconfig
# Copyright (c) 2022 Nordic Semiconductor ASA
#
# SPDX-License-Identifier: Apache-2.0

config USBD_LOOPBACK_CLASS
	bool "USB Loopback Class"
	help
	  USB device loopback class.
	  Primarily used for test and development purposes.

if USBD_LOOPBACK_CLASS

config USBD_LOOPBACK_HS_INT_IN_EP_TPL
	int "High speed interrupt IN TPL" if USBD_MAX_SPEED_HIGH
	range 64 3072
	default 64
	help
	  Interrupt IN endpoints TPL in high speed configuration.
	  Larger values require UDC buffer pool adjustment. TPL in full speed
	  configuration is always 64.

config USBD_LOOPBACK_HS_INT_OUT_EP_TPL
	int "High speed interrupt OUT TPL" if USBD_MAX_SPEED_HIGH
	range 64 3072
	default 64
	help
	  Interrupt OUT endpoints TPL in high speed configuration.
	  Larger values require UDC buffer pool adjustment. TPL in full speed
	  configuration is always 64.

module = USBD_LOOPBACK
module-str = usbd loopback
default-count = 1
source "subsys/logging/Kconfig.template.log_config"

source "subsys/usb/common/Kconfig.template.instances_count"
endif
```

## subsys/usb/device_next/class/Kconfig.msc
```kconfig
# Copyright (c) 2022 Nordic Semiconductor ASA
#
# SPDX-License-Identifier: Apache-2.0

config USBD_MSC_CLASS
	bool "USB Mass Storage Device class support"
	select DISK_ACCESS
	help
	  USB Mass Storage device class (SCSI target) support. LUNs are
	  pre-bound at build time via USBD_DEFINE_MSC_LUN() to a disk_access
	  volume. Command opcodes match the initiator mid-layer through
	  include/zephyr/scsi/scsi_opcode.h only; CONFIG_SCSI is not enabled
	  and scsi_device/scsi_exec are not used on this path.

if USBD_MSC_CLASS

config USBD_MSC_STACK_SIZE
	int "USB MSC thread stack size"
	default 1024
	help
	  USB MSC thread stack size.

config USBD_MSC_LUNS_PER_INSTANCE
	int "Number of LUNs"
	default 1
	range 1 16
	help
	  Maximum number of Logical Units that can be registered per instance.

config USBD_MSC_SCSI_BUFFER_SIZE
	int "SCSI Buffer size"
	default 512
	help
	  Buffer size must be able to hold at least one sector. All LUNs within
	  single instance share the SCSI buffer.

config USBD_MSC_DOUBLE_BUFFERING
	bool "SCSI double buffering"
	default y
	help
	  Allocate two SCSI buffers instead of one to increase throughput by
	  using one buffer by disk subsystem and one by USB at the same time.

module = USBD_MSC
module-str = usbd msc
default-count = 1
source "subsys/logging/Kconfig.template.log_config"

source "subsys/usb/common/Kconfig.template.instances_count"
endif
```
