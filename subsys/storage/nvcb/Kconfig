## subsys/storage/nvcb/Kconfig
```kconfig
# Non-volatile circular buffer
# Copyright (c) 2024 Laczen
# SPDX-License-Identifier: Apache-2.0

config NVCB
	bool "Non-volatile circular buffer"
	help
	  Enable support of Non-volatile circular buffers.

if NVCB

module = NVCB
module-str = nvcb
source "subsys/logging/Kconfig.template.log_config"

endif # NVCB
```

## subsys/storage/nvmp/Kconfig
```kconfig
# Copyright (c) 2024, Laczen
# SPDX-License-Identifier: Apache-2.0

menuconfig NVMP
	bool "nvmp support"
	help
	  Enables support for the nvmp system, which enables using unified
	  routines to read/write and erase non volatile memory.

if NVMP

config NVMP_FLASH
	bool "nvmp support for flash devices"
	default y if DT_HAS_ZEPHYR_FLASH_NVMP_FIXED_PARTITIONS_ENABLED
	depends on FLASH
	help
	  Enables nvmp support for flash devices.

if NVMP_FLASH

config NVMP_FLASH_RUNTIME_VERIFY
	bool "runtime verification of flash properties"
	default n
	help
	  Enable runtime verification that block size is multiple of the flash
	  erase block size, that write block size is a multiple of the flash
	  write block size, and that the erase-value is correct.

endif #NVMP_FLASH

config NVMP_EEPROM
	bool "nvmp support for eeprom devices"
	default y if DT_HAS_ZEPHYR_EEPROM_NVMP_FIXED_PARTITIONS_ENABLED
	depends on EEPROM
	help
	  Enables nvmp support for eeprom devices.

module = NVMP
module-str = nvmp
source "subsys/logging/Kconfig.template.log_config"

endif #NVMP
```

## subsys/storage/storage_area/Kconfig
```kconfig
# Copyright (c) 2024 Laczen
# SPDX-License-Identifier: Apache-2.0

menuconfig STORAGE_AREA
	bool "Storage area subsystem"
	help
	  Storage area subsystem.

if STORAGE_AREA

config STORAGE_AREA_OFFSET_64BIT
	bool "Large storage area addressing"
	default y if 64BIT
	help
	  Enable 64bit addressing range.

config STORAGE_AREA_VERIFY
	bool "Verification support"
	default y if DEBUG
	help
	  Verify if the definition of the storage area is
	  valid for the used backend.

config STORAGE_AREA_DISK
	bool "Storage area on disk"
	select DISK_ACCESS
	help
	  Use storage area on disk.

config STORAGE_AREA_EEPROM
	bool "Storage area on eeprom"
	select EEPROM
	help
	  Use storage area on eeprom.

config STORAGE_AREA_FLASH
	bool "Storage area on flash"
	select FLASH
	help
	  Use storage area on flash.

config STORAGE_AREA_RAM
	bool "Storage area on ram"
	help
	  Use storage area on ram.

config STORAGE_AREA_STORE
	bool "Storage area record storage"
	select CRC
	help
	  Use record storage on a storage area.

if STORAGE_AREA_STORE

config STORAGE_AREA_STORE_SEMAPHORE
	bool "Thread safety using semaphore"
	default y if MULTITHREADING
	help
	  Use a semaphore for multithreading.

endif #STORAGE_AREA_STORE


module = STORAGE_AREA
module-str = shared_info
source "subsys/logging/Kconfig.template.log_config"

endif # STORAGE_AREA
```

## subsys/storage/stream/Kconfig
```kconfig
#
# Copyright (c) 2020 Nordic Semiconductor ASA
#
# SPDX-License-Identifier: Apache-2.0
#

menuconfig STREAM_FLASH
	bool "Stream to flash"
	help
	  Enable support of stream to flash API

if STREAM_FLASH

config STREAM_FLASH_INSPECT
	bool "Check whether device layout is OK with Stream Flash definition"
	default y
	select FLASH_PAGE_LAYOUT
	help
	  Runs simple check to find whether provided device can be used for
	  stream flash by verifying that buffer size will fit into page.
	  Once correct configuration has been established and tested it is
	  worth to disable the option to cut out some unneeded code.

config STREAM_FLASH_POST_WRITE_CALLBACK
	bool "Write complete callback"
	default y
	help
	  Enable callback that will be invoked once data is synchronized from
	  stream to device. When callback is not used, disabling the option
	  allows to save some code storage and RAM.

config STREAM_FLASH_ERASE
	bool "Perform erase operations"
	depends on FLASH_HAS_EXPLICIT_ERASE
	help
	  If disabled an external actor must erase the flash area being written
	  to.
	  Option available only if there is at least one device in, a configuration,
	  that requires erase prior to write.

config STREAM_FLASH_ERASE_ONLY_WHEN_SUPPORTED
	bool "Check if device supports erase prior to attempting one"
	depends on STREAM_FLASH_ERASE
	depends on FLASH_HAS_NO_EXPLICIT_ERASE
	help
	  This is used in stream flash code to exclude invocation of erase on devices that do not
	  have such requirement prior to write nor support rase as a way to increase write speed.
	  Option is available only if there is a mix of devices, in a configuration, where some
	  support erase and some do not. If user is sure to not use Stream Flash with devices that
	  have no support for erase, this option may be disabled to discard small amount of code
	  from final application.

config STREAM_FLASH_PROGRESS
	bool "Persistent stream write progress"
	depends on SETTINGS
	depends on !SETTINGS_NONE
	help
	  Enable API for loading and storing the current write progress to flash
	  using the settings subsystem. In case of power failure or device
	  reset, the API can be used to resume writing from the latest state.

module = STREAM_FLASH
module-str = stream flash
source "subsys/logging/Kconfig.template.log_config"

endif # STREAM_FLASH
```

## subsys/testsuite/Kconfig
```kconfig
# Copyright (c) 2016 Intel Corporation
# SPDX-License-Identifier: Apache-2.0

menu "Testing"

source "subsys/testsuite/ztest/Kconfig"

config TEST
	bool "Mark project as a test"
	# For tests, store thread names in binary and dump them on crash to
	# ease debugging.
	select THREAD_NAME
	help
	  Mark a project or an application as a test. This will enable a few
	  test defaults.

config TEST_EXTRA_STACK_SIZE
	int "Test function extra thread stack size"
	default 2048 if COVERAGE_GCOV
	default 768 if XTENSA
	default 0
	depends on TEST
	help
	  Additional stack for tests on some platform where default is not
	  enough.

config TEST_USERSPACE
	bool "Indicate that this test exercises user mode"
	help
	  This option indicates that a test case puts threads in user mode,
	  and that the build system will [override and] enable USERSPACE
	  if the platform supports it. It should be set in a .conf file on
	  a per-test basis and is not meant to be used outside test cases.
	  Tests with this option should also have the "userspace" filtering
	  tag in their testcase.yaml file.

	  The userspace APIs are no-ops if userspace is not enabled, so it is
	  OK to enable this even if the test will run on platforms which do
	  not support userspace. The test should still run on those platforms,
	  just with all threads in supervisor mode.

	  If a test *requires* that userspace be enabled in order to
	  pass, CONFIG_ARCH_HAS_USERSPACE should be filtered in its
	  testcase.yaml.

config TEST_LOGGING_DEFAULTS
	bool "Test case logging defaults"
	depends on TEST
	select LOG
	select LOG_DEFAULT_MINIMAL
	default y
	help
	  Option which implements default policy of enabling logging in
	  minimal mode for all test cases. For tests that need alternate
	  logging configuration, or no logging at all, disable this
	  in the project-level defconfig.

config TEST_ENABLE_USERSPACE
	bool
	depends on TEST_USERSPACE
	depends on ARCH_HAS_USERSPACE
	select USERSPACE
	imply DYNAMIC_OBJECTS
	default y
	help
	  This hidden option implements the TEST_USERSPACE logic. It turns on
	  USERSPACE when CONFIG_ARCH_HAS_USERSPACE is set and the test
	  case itself indicates that it exercises user mode via
	  CONFIG_TEST_USERSPACE.

config TEST_USERSPACE_WITHOUT_HW_STACK_PROTECTION
	bool "Run User Mode tests without additionally enabling stack protection"
	depends on TEST_ENABLE_USERSPACE
	default y if SOC_SERIES_KINETIS_KE1XF || SOC_SERIES_S32K1
	help
	  A HW platform might not have sufficient MPU/MMU capabilities to support
	  running all test cases with User Mode and HW Stack Protection features
	  simultaneously enabled. For this platforms we execute the User Mode-
	  related tests without enabling HW stack protection.

config TEST_HW_STACK_PROTECTION
	bool "Hardware-based stack overflow detection if available"
	depends on ARCH_HAS_STACK_PROTECTION
	depends on TEST
	select HW_STACK_PROTECTION
	default y if !TEST_USERSPACE_WITHOUT_HW_STACK_PROTECTION
	help
	  This option will enable hardware-based stack protection by default
	  for all test cases if the hardware supports it.

config TEST_FLASH_DRIVERS
	bool "Test flash drivers"
	depends on BOARD_QEMU_X86
	select FLASH_HAS_DRIVER_ENABLED
	help
	  This option will help test the flash drivers. This should be enabled
	  only when using qemu_x86.

config TEST_ARM_CORTEX_M
	bool
	depends on CPU_CORTEX_M
	depends on TEST
	default y
	select ARM_SECURE_BUSFAULT_HARDFAULT_NMI if ARM_SECURE_FIRMWARE
	help
	  ARM Cortex-M configuration required when testing.

	  This option is used to select stack sizes and enable features for
	  testing.

	  This option is also used to force routing
	  BusFault, HardFault, and NMI exceptions to Secure State,
	  when building a Secure ARMv8-M firmware. This will allow
	  the testing suite to utilize these exceptions, in tests.
	  Note that by default, when building with ARM_SECURE_FIRMWARE
	  set, these exceptions are set to target the Non-Secure state.

config TEST_BUSY_SIM
	bool "Busy simulator"
	depends on TEST
	select ENTROPY_GENERATOR
	select RING_BUFFER if !XOSHIRO_RANDOM_GENERATOR
	select COUNTER
	help
	  It simulates cpu load by using counter device to generate interrupts
	  with random intervals and random busy looping in the interrupt.

endmenu


rsource "Kconfig.coverage"
```

## subsys/testsuite/Kconfig.coverage
```kconfig
# SPDX-License-Identifier: Apache-2.0
# Copyright The Zephyr Project Contributors
#
menu "Coverage"

config HAS_COVERAGE_SUPPORT
	bool
	help
	  The code coverage report generation is only available on boards
	  with enough spare RAM to buffer the coverage data, or on boards
	  based on the POSIX ARCH.

config COVERAGE
	bool "Create coverage data"
	depends on HAS_COVERAGE_SUPPORT
	help
	  This option will build your application with the -coverage option
	  which will generate data that can be used to create coverage reports.
	  For more information see
	  https://docs.zephyrproject.org/latest/guides/coverage.html

choice
	prompt "Coverage mode"
	default COVERAGE_NATIVE_GCOV if NATIVE_BUILD
	default COVERAGE_GCOV if !NATIVE_BUILD
	depends on COVERAGE

config COVERAGE_NATIVE_GCOV
	bool "Host compiler gcov based code coverage"
	depends on NATIVE_BUILD
	help
	  Build natively with the compiler standard `--coverage` options,
	  that is with gcov/GCC-compatible coverage

config COVERAGE_NATIVE_SOURCE
	bool "Host compiler source based code coverage"
	depends on NATIVE_BUILD
	depends on "$(ZEPHYR_TOOLCHAIN_VARIANT)" = "llvm"
	help
	  Build natively with the compiler source based coverage options.
	  Today this is only supported with LLVM

config COVERAGE_GCOV
	bool "Create Coverage data from hardware platform"
	depends on !NATIVE_BUILD
	help
	  This option will select the custom gcov library. The reports will
	  be available over serial. This serial dump can be passed to
	  gen_gcov_files.py which creates the required .gcda files. These
	  can be read by gcov utility. For more details see gcovr.com .

endchoice

config COVERAGE_GCOV_HEAP_SIZE
	int "Size of heap allocated for gcov coverage data dump"
	depends on COVERAGE_GCOV
	default 32768 if X86 || SOC_SERIES_MPS2
	default 16384
	help
	  This option configures the heap size allocated for gcov coverage
	  data to be dumped over serial. If the value is 0, no buffer will be used,
	  data will be dumped directly over serial.

if COVERAGE_GCOV

choice COVERAGE_DUMP_METHOD
	prompt "Method to dump coverage data"
	default COVERAGE_DUMP

config COVERAGE_DUMP
	bool "Dump coverage data to console on exit"
	help
	  Dump collected coverage information to console on exit.

config COVERAGE_SEMIHOST
	bool "Use semihosting to write coverage data"
	depends on SEMIHOST
	help
	  Use semihosting to write coverage data to a file on the host.

endchoice

endif # COVERAGE_GCOV

config FORCE_COVERAGE
	bool "Force coverage"
	select HAS_COVERAGE_SUPPORT
	help
	  Regardless of platform support, it will enable coverage data production.
	  If the platform does not support coverage by default, setting this config
	  does not guarantee that coverage data will be gathered.
	  Application may not fit memory or crash at runtime.

config COVERAGE_DUMP_PATH_EXCLUDE
	string "Exclude files matching this pattern from the coverage data"
	default ""
	help
	  Filenames are matched against the pattern using the POSIX fnmatch
	  function. Filenames are based on their path in the build folder, not the
	  original source tree. The empty string "" disables the pattern
	  matching.

endmenu
```

## subsys/testsuite/arch/Kconfig.v1
```kconfig
# Copyright (c) 2023 Nordic Semiconductor ASA
# SPDX-License-Identifier: Apache-2.0

rsource "unit_testing/Kconfig"
```

## subsys/testsuite/arch/unit_testing/Kconfig
```kconfig
# Copyright (c) 2022 Nordic Semiconductor
#
# SPDX-License-Identifier: Apache-2.0

# Current the use of X86 is for consistency with old testsuite/ztest which
# defined CONFIG_X86 manually. To consider, is NATIVE_POSIX a better choice?
config X86
	bool
	default y
	help
	  The unit_testing architecture identifies itself as X86 for basic
	  ztest and kernel support.

if CONSOLE

config NATIVE_POSIX_CONSOLE
	bool
	default y
	select CONSOLE_HAS_DRIVER
	help
	  The unit testing architecture is expected to always have access to a
	  standard terminal for printing.

endif # CONSOLE
```

## subsys/testsuite/boards/boards_legacy/unit_testing/unit_testing/Kconfig.defconfig
```kconfig
# SPDX-License-Identifier: Apache-2.0
#
# Copyright (c) 2022 Nordic Semiconductor

# Bluetooth unit tests expect this backend
choice BT_HCI_BUS_TYPE
	default BT_NO_DRIVER
endchoice
```

## subsys/testsuite/boards/unit_testing/unit_testing/Kconfig.board
```kconfig
# SPDX-License-Identifier: Apache-2.0
#
# Copyright (c) 2022 Nordic Semiconductor

config BOARD_UNIT_TESTING
	bool "Unit testing board"
	select HAS_COVERAGE_SUPPORT
	select NATIVE_APPLICATION
	help
	  Board for unit testing
```

## subsys/testsuite/boards/unit_testing/unit_testing/Kconfig.defconfig
```kconfig
# SPDX-License-Identifier: Apache-2.0
#
# Copyright (c) 2022 Nordic Semiconductor

# Controller HCI support requires e.g. devicetree, which isn't available
# for unit tests.
config BT_CTLR_HCI
	default n

# Bluetooth unit tests assume HCI vendor extensions are available
config BT_HAS_HCI_VS
	default y
```

## subsys/testsuite/boards/unit_testing/unit_testing/Kconfig.unit_testing
```kconfig
# SPDX-License-Identifier: Apache-2.0
#
# Copyright (c) 2022 Nordic Semiconductor

config BOARD_UNIT_TESTING
	bool "Unit testing board"
	select HAS_COVERAGE_SUPPORT
	select NATIVE_BUILD
	help
	  Board for unit testing
```

## subsys/testsuite/boards/unit_testing/unit_testing/board.yml
```yaml
board:
  name: unit_testing
  full_name: Unit Testing Board
  vendor: zephyr
  socs:
  - name: unit_testing
```

## subsys/testsuite/boards/unit_testing/unit_testing/unit_testing_defconfig
```kconfig
# SPDX-License-Identifier: Apache-2.0
#
# Copyright (c) 2022 Nordic Semiconductor

CONFIG_SYS_CLOCK_HW_CYCLES_PER_SEC=1000000
CONFIG_CONSOLE=y
CONFIG_ZTEST=y
CONFIG_ZTEST_MOCKING=y

# unit testing only build a fraction of code, and hence assert may fail linking.
# Disable default for board. A unit test can still enable asserts.
CONFIG_ASSERT=n
```

## subsys/testsuite/cmock/Kconfig
```kconfig
# SPDX-License-Identifier: Apache-2.0
# Copyright 2022 Martin Schröder <martin.schroder@swedishembedded.com>
# Consulting: https://swedishembedded.com/go
# Training: https://swedishembedded.com/tag/training

config CMOCK
	bool "Use CMock mocking framework"
	select TEST
	depends on UNITY
	help
			This option enables CMock testing.
```
