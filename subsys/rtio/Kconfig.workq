## subsys/shell/modules/Kconfig
```kconfig
# Shell configuration options

# Copyright (c) 2016 Intel Corporation
# SPDX-License-Identifier: Apache-2.0

config DEVICE_SHELL
	bool "Device shell"
	default y if !SHELL_MINIMAL
	help
	  This shell provides access to basic device data.

config DEVICE_SHELL_INIT_CMD
	bool "Device shell init command"
	depends on DEVICE_SHELL
	default y if !SHELL_MINIMAL
	help
	  Add an 'init' command to the device shell module in order
	  to initialize, at runtime and manually, the devices that
	  own the 'zephyr,deferred-init' attribute. Note that if you
	  enable CONFIG_DEVICE_DEPS, it will take dependencies into
	  account.

config DATE_SHELL
	bool "Date shell"
	default y if !SHELL_MINIMAL
	help
	  This shell provides access to date and time based on Unix time.

config DEVMEM_SHELL
	bool "Devmem shell"
	default y if !SHELL_MINIMAL
	select GETOPT
	help
	  This shell command provides read/write access to physical memory.

config APP_VERSION_SHELL
	bool "Application version information shell"
	default y if !SHELL_MINIMAL
	depends on "$(APP_VERSION_EXTENDED_STRING)" != ""
	help
	  This shell command provides read access to application version information.

config ZYCLICTEST_SHELL
	bool "Zyclictest shell"
	select POSIX_C_LIB_EXT
	help
	  This shell command provides latency measurement.
	  Measure latencies of interrupt service routines and threads when
	  woken up by a timer. Collecting data in the background while
	  application of interrest is running in the foreground.
	  It can be switched on by demand and measure the worst case latencies
	  with the exact circumstances of the productive application. Thus one
	  can see if for example interrupts or preemption locks are preventing
	  the application to run.
	  Inspired by Linux cyclictest tool.

rsource "kernel_service/Kconfig"
```

## subsys/shell/modules/kernel_service/Kconfig
```kconfig
# Kernel service configuration options

# Copyright (c) 2016 Intel Corporation
# SPDX-License-Identifier: Apache-2.0

config KERNEL_SHELL
	bool "Kernel shell"
	default y if !SHELL_MINIMAL
	imply INIT_STACKS
	imply THREAD_MONITOR
	imply THREAD_NAME
	imply THREAD_STACK_INFO
	help
	  This shell provides access to basic kernel data like version, uptime
	  and other useful information.

if KERNEL_SHELL

config KERNEL_SHELL_REBOOT_DELAY
	int "Delay between reception of shell reboot command and reboot (ms)"
	depends on REBOOT
	default 0
	help
	  This delay allows time for the shell to successfully echo the reboot
	  command input before the reboot abruptly terminates it. This can help
	  external systems that interact with the shell and require the reboot
	  command's echo to successfully complete to synchronise with the
	  device.

rsource "thread/Kconfig"

endif # KERNEL_SHELL
```

## subsys/shell/modules/kernel_service/thread/Kconfig
```kconfig
# Kernel thread configuration options

# Copyright (c) 2024 Meta Platforms
# SPDX-License-Identifier: Apache-2.0

config KERNEL_THREAD_SHELL
	bool
	depends on THREAD_MONITOR
	help
	  Internal helper macro to determine if the main `thread` command
	  should be compiled.

config KERNEL_THREAD_SHELL_LIST
	bool
	default y
	depends on INIT_STACKS
	depends on THREAD_MONITOR
	depends on THREAD_STACK_INFO
	select KERNEL_THREAD_SHELL
	help
	  Internal helper macro to compile the `list` subcommand

config KERNEL_THREAD_SHELL_STACKS
	bool
	default y
	depends on INIT_STACKS
	depends on THREAD_MONITOR
	depends on THREAD_STACK_INFO
	select KERNEL_THREAD_SHELL
	help
	  Internal helper macro to compile the `stacks` subcommand

config KERNEL_THREAD_SHELL_MASK
	bool
	default y
	depends on SCHED_CPU_MASK
	select KERNEL_THREAD_SHELL
	help
	  Internal helper macro to compile the `mask` subcommand

config KERNEL_THREAD_SHELL_PIN
	bool
	default y
	depends on SCHED_CPU_MASK
	select KERNEL_THREAD_SHELL
	help
	  Internal helper macro to compile the `pin` subcommand

config KERNEL_THREAD_SHELL_UNWIND
	bool
	default y
	depends on ARCH_STACKWALK
	depends on THREAD_MONITOR
	select KERNEL_THREAD_SHELL
	help
	  Internal helper macro to compile the `unwind` subcommand

config KERNEL_THREAD_SHELL_SUSPEND
	bool
	default y
	depends on THREAD_MONITOR
	select KERNEL_THREAD_SHELL
	help
	  Internal helper macro to compile the 'suspend' subcommand

config KERNEL_THREAD_SHELL_RESUME
	bool
	default y
	depends on THREAD_MONITOR
	select KERNEL_THREAD_SHELL
	help
	  Internal helper macro to compile the 'resume' subcommand

config KERNEL_THREAD_SHELL_KILL
	bool
	default y
	depends on THREAD_MONITOR
	select KERNEL_THREAD_SHELL
	help
	  Internal helper macro to compile the 'kill' subcommad

config KERNEL_THREAD_SHELL_TOP
	bool
	default y
	depends on THREAD_MONITOR
	depends on THREAD_RUNTIME_STATS
	depends on SCHED_THREAD_USAGE_ALL
	select KERNEL_THREAD_SHELL
	help
	  Internal helper macro to compile the 'top' subcommand

config KERNEL_THREAD_SHELL_TOP_MAX_THREADS
	int "Maximum number of threads shown by 'kernel thread top'"
	default 20
	range 1 256
	depends on KERNEL_THREAD_SHELL_TOP
	help
	  Size of the static table used by the 'kernel thread top' command to
	  track per-thread execution cycles between refreshes. Threads beyond
	  this count are counted but not shown.
```

## subsys/sip_svc/Kconfig
```kconfig
# ARM SiP service configuration options

# Copyright (c) 2022-2023, Intel Corporation.
# SPDX-License-Identifier: Apache-2.0

menuconfig ARM_SIP_SVC_SUBSYS
	bool "ARM SiP SVC Service"
	depends on ARM_SIP_SVC_HAS_DRIVER
	help
	  Enable Zephyr to communicate with Lower exception levels by
	  implementing the platform-specifics via SIP SVC driver.

if ARM_SIP_SVC_SUBSYS

module = ARM_SIP_SVC_SUBSYS
module-str = arm_sip_svc_subsys
source "subsys/logging/Kconfig.template.log_config"

config ARM_SIP_SVC_SUBSYS_INIT_PRIORITY
	int "ARM SiP service init function priority"
	default 55

config ARM_SIP_SVC_SUBSYS_THREAD_STACK_SIZE
	int "ARM SiP service thread stack size"
	default 4096
	help
	  Stack size of the ARM SiP  service.
	  The thread calls the callbacks of the requestor
	  when operation done.

config ARM_SIP_SVC_SUBSYS_THREAD_PRIORITY
	int "ARM SiP service thread priority"
	default 2
	help
	  Priority of the ARM SiP  service.
	  The thread calls the callbacks of the requestor
	  when operation done.

config ARM_SIP_SVC_SUBSYS_MSGQ_DEPTH
	int "ARM SiP service request message queue depth"
	default 16
	help
	  Depth of msgq used inside sip_svc controller.

config ARM_SIP_SVC_SUBSYS_MAX_CLIENT_COUNT
	int
	default 16
	help
	  Maximum number of clients inside sip_svc subsystem per controller.

config ARM_SIP_SVC_SUBSYS_MAX_TRANSACTION_ID_COUNT
	int
	default 16
	help
	  Maximum number of transaction_id per client.

config ARM_SIP_SVC_SUBSYS_ASYNC_POLLING_DELAY
	int "Delay used for polling asynchronous jobs in micro-seconds"
	default 100
	help
	  Delay for sip_svc thread to sleep during each polling call for
	  ASYNC response.

config ARM_SIP_SVC_SUBSYS_SINGLY_OPEN
	bool "Allow a single client to open a connection at a time"
	help
	  Allow only one client to open a session per controller

config ARM_SIP_SVC_SUBSYS_SHELL
	bool "ARM SiP SVC service shell"
	depends on SHELL
	help
	  Enable ARM SiP SVC service shell support to communicate with EL3/EL2
	  layers using SMC/HVC calls.

endif
```

## subsys/stats/Kconfig
```kconfig
# Copyright (c) 2020 Intel Corp.
# SPDX-License-Identifier: Apache-2.0


config STATS
	bool "Statistics support"
	help
	  Enable per-module event counters for troubleshooting, maintenance,
	  and usage monitoring.  Statistics can be retrieved with the mcumgr
	  management subsystem.

config STATS_NAMES
	bool "Statistic names"
	depends on STATS
	help
	  Include a full name string for each statistic in the build.  If this
	  setting is disabled, statistics are assigned generic names of the
	  form "s0", "s1", etc.  Enabling this setting simplifies debugging,
	  but results in a larger code size.

config STATS_SHELL
	bool "Statistics Shell Command"
	default y
	depends on STATS && SHELL
	imply STATS_NAMES
	help
	  Include a full name string for each statistic in the build.  If this
	  setting is disabled, statistics are assigned generic names of the
	  form "s0", "s1", etc.  Enabling this setting simplifies debugging,
	  but results in a larger code size.
```

## subsys/storage/Kconfig
```kconfig
# Subsystem configuration options

# Copyright (c) 2018 Nordic Semiconductor ASA
# SPDX-License-Identifier: Apache-2.0

menu "Storage"

source "subsys/storage/flash_map/Kconfig"
source "subsys/storage/stream/Kconfig"

endmenu
```

## subsys/storage/flash_map/Kconfig
```kconfig
# Flash map abstraction module

# Copyright (c) 2017 Nordic Semiconductor ASA
# SPDX-License-Identifier: Apache-2.0

#
# Flash map
#

menuconfig FLASH_MAP
	bool "Flash map abstraction module"
	depends on FLASH_HAS_DRIVER_ENABLED
	help
	  Enable support of flash map abstraction.

if FLASH_MAP

config FLASH_MAP_SHELL
	bool "Flash map shell interface"
	depends on SHELL
	imply FLASH_MAP_LABELS
	help
	  This enables shell commands to list and test flash maps.

config FLASH_MAP_CUSTOM
	bool "Custom flash map description"
	help
	  This option enables custom flash map description.
	  User must provide such a description in place of default on
	  if had enabled this option.

config FLASH_AREA_CHECK_INTEGRITY
	bool "Flash check functions"
	select PSA_CRYPTO
	select PSA_WANT_ALG_SHA_256
	help
	  If enabled, there will be available the backend to check flash
	  integrity using SHA-256 verification algorithm.

config FLASH_MAP_LABELS
	bool "Access flash area labels at runtime"
	help
	  If enabled the label property of the flash map can be retrieved
	  at runtime. The available labels will also be displayed in the
	  flash_map list shell command.

endif
```

## subsys/storage/flash_partitions/Kconfig
```kconfig
# Copyright (c) 2024, Laczen
# SPDX-License-Identifier: Apache-2.0

menuconfig FLASH_PARTITIONS
	bool "flash partitions support"
	default y if DT_HAS_ZEPHYR_FLASH_PARTITIONS_ENABLED
	select FLASH
	help
	  Enables support for the flash partitions system, which enables using
	  unified routines to work with partitions defined on flash devices.

if FLASH_PARTITIONS

config FLASH_PARTITIONS_RUNTIME_VERIFY
	bool "runtime verification of erase-block-size"
	select FLASH_PAGE_LAYOUT
	help
	  Enable runtime verification that erase-block-size is a multiple of the
	  flash erase block size.

config FLASH_PARTITIONS_LABELS
	bool "Access flash partition labels at runtime"
	help
	  If enabled the label property of the flash partitions can be retrieved
	  at runtime.

module = FLASH_PARTITIONS
module-str = flash_partitions
source "subsys/logging/Kconfig.template.log_config"

endif #FLASH_PARTITIONS
```
