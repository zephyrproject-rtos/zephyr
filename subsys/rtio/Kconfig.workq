## subsys/rtio/Kconfig.workq
```kconfig
# Copyright (c) 2024 Croxel Inc.
# SPDX-License-Identifier: Apache-2.0

config RTIO_WORKQ
	bool "RTIO Work-queues service to process Sync operations"
	select RTIO_CONSUME_SEM
	help
	  Enable RTIO Work-queues to allow processing synchronous operations
	  in an asynchronous non-blocking fashion.

if RTIO_WORKQ

config RTIO_WORKQ_THREADS_POOL_PRIO
	int "Priority of RTIO Workqueue Threads Pool"
	default MAIN_THREAD_PRIORITY

config RTIO_WORKQ_THREADS_POOL_STACK_SIZE
	int "Stack size of RTIO Workqueue Threads"
	default 1024

config RTIO_WORKQ_THREADS_POOL
	int "Number of threads to use for processing work-items"
	default 2 if SPI_RTIO || I2C_RTIO || I3C_RTIO
	default 1

config RTIO_WORKQ_POOL_ITEMS
	int "Pool of work items to use with the RTIO Work-queues"
	default 4
	help
	  Configure the Pool of work items appropriately to your
	  application, the more simultaneous requests you expect
	  to issue, the bigger this pool should be.

endif # RTIO_WORKQ
```

## subsys/rtk/serial/Kconfig
```kconfig
# Copyright (c) 2025 Croxel Inc.
# Copyright (c) 2025 CogniPilot Foundation
# SPDX-License-Identifier: Apache-2.0

config GNSS_RTK_SERIAL
	bool "Serial GNSS RTK client"
	select SERIAL
	select UART_INTERRUPT_DRIVEN
	help
	  Use RTK Serial client to obtain data-correction.
```

## subsys/sd/Kconfig
```kconfig
# Copyright 2022 NXP
# SPDX-License-Identifier: Apache-2.0

# SD stack configuration options

menu "SD"

config MMC_STACK
	bool "MMC protocol support"
	help
	  Enable MMC protocol support. Required for eMMC cards to function.

config SDMMC_STACK
	bool "SDMMC protocol support"
	help
	  Enable SDMMC protocol support. Required for SD memory cards to
	  function.

config SDIO_STACK
	bool "SDIO protocol support"
	help
	  Enable SDIO protocol support. Required for SD I/O cards to function.

config SD_STACK
	bool
	default y if MMC_STACK || SDMMC_STACK || SDIO_STACK
	select SDHC
	help
	  Enable SD card support.

if SD_STACK

module = SD
module-str = SD stack
source "subsys/logging/Kconfig.template.log_config"

config SD_INIT_TIMEOUT
	int "Timeout while initializing SD card"
	default 1500
	help
	  Maximum time to wait, in milliseconds, for the SD card to initialize.

config SD_RETRY_COUNT
	int "Number of times to retry initialization commands"
	default 10
	help
	  Number of times to retry initialization commands in case of failure

config SD_OCR_RETRY_COUNT
	int "Number of times to retry SD OCR read"
	default 1000
	help
	  Number of times to retry SD OCR read command. OCR reads typically
	  require more retries than general SD commands

config SD_CMD_TIMEOUT
	int "Timeout for SD commands (in ms)"
	default 200
	help
	  Default timeout in milliseconds for SD commands

config SD_DATA_TIMEOUT
	int "Timeout for SD data transfer (in ms)"
	default 10000
	help
	  Default timeout in milliseconds for SD data transfer commands

config SD_BUFFER_SIZE
	int
	# If SDHC required buffer alignment, we need a full block size in
	# internal buffer
	default 512 if SDHC_BUFFER_ALIGNMENT != 1
	# If MMC is being used, need 512 bytes to read EXT_CSD
	default 512 if MMC_STACK
	# If SDIO is being used, need 512 bytes to read FUNC0 CIS
	default 512 if SDIO_STACK
	# Otherwise, we only need 64 bytes to read SD switch function
	default 64
	help
	  Size in bytes of internal buffer SD card uses for unaligned reads and
	  internal data reads during initialization

config SD_CMD_RETRIES
	int "Number of times to retry sending command to card"
	default 0
	help
	  Number of times to retry sending command to SD card in case of failure

config SD_DATA_RETRIES
	int "Number of times to retry sending data to card"
	default 3
	help
	  Number of times to retry sending data to SD card in case of failure


config SD_UHS_PROTOCOL
	bool "Ultra high speed SD card protocol support"
	default y if SDHC_SUPPORTS_UHS
	help
	  Enable support for ultra high speed SD cards. This can be disabled to
	  reduce code size, at the cost of data transfer speeds.

config MMC_RCA
	hex "MMC Relative card address"
	default 2
	help
	  Relative card address to publish to MMC card.

endif # SD_STACK

endmenu
```

## subsys/sd_dev/Kconfig
```kconfig
# SPDX-License-Identifier: Apache-2.0
#
# SD/SDIO/MMC device framework (device-side)
#

menuconfig SD_DEV
    bool "SD Device Framework (SDIO/MMC device-side)"
    help
      Enable the SD device-side framework including:
        * SDIO device-side protocol model
        * MMC optional protocol model
        * RX FIFO per SDIO function
        * Core runtime worker threads
        * Optional PM state machine
      This framework is used for SDIO-Slave and MMC-Slave style devices.

if SD_DEV

config SDIO_DEV
    bool "Enable SDIO device protocol stack"
    default y
    help
      Enable SDIO device-side support. This includes:
        - struct sdio_func / struct sdio_dev
        - block size / bus width setters
        - per-function RX FIFO
        - rx_handler (provided by HAL) and set_rx_handler (provided by subsys)
        - RX worker threads dispatching data

config SDMMC_DEV
    bool "Enable MMC device protocol stack"
    default n
    help
      Enable MMC device-side protocol support.
      Currently only has basic placeholders.

config SDIO_DEV_MAX_FUNCS
    int "Maximum SDIO functions supported"
    default 3
    range 1 7
    help
      The number of SDIO functions your device implements.
      E.g. FN0 + FN1 + FN2 = 3.

config SDEV_PKT_POOL_SIZE
    int "SDEV packet pool size"
    default 16
    help
      Number of packets in the pool.

config SDEV_PKT_BUF_SIZE
    int "SDEV packet buffer size"
    default 4096
    help
      Size of each packet buffer in bytes.

config SDEV_DMA_ALIGN
    int "SDEV DMA alignment"
    default 32
    help
      DMA alignment size (typically cache line size).

endif # SD_DEV
```

## subsys/sdio/Kconfig
```kconfig
# Copyright 2026 Nordic Semiconductor ASA
# SPDX-License-Identifier: Apache-2.0

# Role-neutral SDIO subsystem configuration

menuconfig SDIO
	bool "Role-neutral SDIO subsystem"
	help
	  Enable the standalone, role-neutral SDIO subsystem. Unlike the
	  SD-card centered SDIO protocol support (SDIO_STACK), this subsystem
	  models SDIO as a general transport with explicit host and
	  device/slave roles, decoupled from struct sd_card.

if SDIO

module = SDIO
module-str = SDIO subsystem
source "subsys/logging/Kconfig.template.log_config"

config SDIO_LOCK_TIMEOUT_MS
	int "SDIO bus lock timeout (ms)"
	default 500
	help
	  Maximum time to wait for the per-endpoint bus lock when issuing a
	  function I/O operation.

config SDIO_HOST
	bool "SDIO host role"
	depends on SDHC
	help
	  Enable the host-role transport backend. An SDIO host endpoint drives
	  the bus through a Zephyr SD host controller (SDHC).

if SDIO_HOST

config SDIO_HOST_CMD_TIMEOUT_MS
	int "SDIO host command timeout (ms)"
	default 200

config SDIO_HOST_DATA_TIMEOUT_MS
	int "SDIO host data timeout (ms)"
	default 5000

endif # SDIO_HOST

config SDIO_DEVICE
	bool "SDIO device/slave role"
	depends on SDIO_DC
	help
	  Enable the device/slave-role subsystem. An SDIO device endpoint
	  exposes function I/O space, register windows and FIFOs to a remote
	  SDIO host through an SDIO device controller (SDIO_DC).

endif # SDIO
```

## subsys/secure_storage/Kconfig.its_store
```kconfig
# Copyright (c) 2024 Nordic Semiconductor
# SPDX-License-Identifier: Apache-2.0

choice SECURE_STORAGE_ITS_STORE_IMPLEMENTATION
	prompt "ITS store module implementation"

DT_ITS_PARTITION := $(dt_chosen_path,secure_storage_its_partition)
DT_CHOSEN_Z_SETTINGS_PARTITION := zephyr,settings-partition
DT_SETTINGS_PARTITIION := $(dt_chosen_path,$(DT_CHOSEN_Z_SETTINGS_PARTITION))
DT_STORAGE_PARTITION := $(dt_nodelabel_path,storage_partition)

config SECURE_STORAGE_ITS_STORE_IMPLEMENTATION_ZMS
	bool "ITS store module implementation using ZMS for storage"
	depends on FLASH_HAS_DRIVER_ENABLED \
	 && $(dt_path_enabled,$(DT_ITS_PARTITION)) \
	 && $(dt_node_has_compat,$(dt_node_parent,$(DT_ITS_PARTITION)),fixed-partitions)
	depends on ZMS
	help
	  This implementation of the ITS store module makes direct use of ZMS for storage.
	  It needs a secure_storage_its_partition devicetree chosen property that points
	  to a fixed storage partition that will be dedicated to the ITS. It has lower
	  overhead compared to the settings-based implementation, both in terms of runtime
	  execution and storage space, and also ROM footprint if the settings subsystem is disabled.
	  As this implementations directly maps the PSA storage UIDs to ZMS entry IDs, it limits
	  their values to the first 30 bits.

config SECURE_STORAGE_ITS_STORE_IMPLEMENTATION_SETTINGS
	bool "ITS store module implementation using the settings subsystem for storage"
	depends on FLASH_HAS_DRIVER_ENABLED \
	 && (($(dt_path_enabled,$(DT_SETTINGS_PARTITIION)) \
	     && $(dt_node_has_compat,$(dt_node_parent,$(DT_SETTINGS_PARTITIION)),fixed-partitions))\
	  || ($(dt_path_enabled,$(DT_STORAGE_PARTITION)) \
	      && $(dt_node_has_compat,$(dt_node_parent,$(DT_STORAGE_PARTITION)),fixed-partitions)))
	depends on SETTINGS

config SECURE_STORAGE_ITS_STORE_IMPLEMENTATION_NONE
	bool "No ITS store module implementation"

config SECURE_STORAGE_ITS_STORE_IMPLEMENTATION_CUSTOM
	bool "Custom ITS store module implementation"
	help
	  Implement the functions declared in <zephyr/secure_storage/its/store.h>.
	  The header is made available when this Kconfig option is enabled.

endchoice # SECURE_STORAGE_ITS_STORE_IMPLEMENTATION

if SECURE_STORAGE_ITS_STORE_IMPLEMENTATION_ZMS

config SECURE_STORAGE_ITS_STORE_ZMS_SECTOR_SIZE
	int "Sector size of the ZMS partition"
	default 4096
	help
	  The sector size impacts the runtime behavior of ZMS and restricts the maximum
	  ITS entry data size (which is the sector size minus ZMS and ITS overhead).
	  Changing it will result in loss of existing data stored on a partition.
	  It must be a multiple of the flash page size on devices that require an erase.
	  See the ZMS documentation for more information.

endif # SECURE_STORAGE_ITS_STORE_IMPLEMENTATION_ZMS

if SECURE_STORAGE_ITS_STORE_IMPLEMENTATION_SETTINGS

config SECURE_STORAGE_ITS_STORE_SETTINGS_NAME_CUSTOM
	bool "Custom naming scheme for the stored settings"
	help
	  This allows to use custom names for the settings that the implementation uses
	  instead of the default naming scheme.
	  When enabling this, implement the secure_storage_its_store_settings_get_name()
	  function declared in <zephyr/secure_storage/its/store/settings_get.h>
	  and set CONFIG_SECURE_STORAGE_ITS_STORE_SETTINGS_NAME_MAX_LEN appropriately.
	  The header file is made available when this Kconfig option is enabled.

config SECURE_STORAGE_ITS_STORE_SETTINGS_PREFIX
	string "Subtree in which to store the settings, with a trailing slash. Can be empty."
	default "its/"
	depends on !SECURE_STORAGE_ITS_STORE_SETTINGS_NAME_CUSTOM

config SECURE_STORAGE_ITS_STORE_SETTINGS_NAME_MAX_LEN
	int "Maximum setting name length"
	range 2 64
	default 0 if SECURE_STORAGE_ITS_STORE_SETTINGS_NAME_CUSTOM
	default 22 if SECURE_STORAGE_64_BIT_UID
	default 14

endif # SECURE_STORAGE_ITS_STORE_IMPLEMENTATION_SETTINGS
```
