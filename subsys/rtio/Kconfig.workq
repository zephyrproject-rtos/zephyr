## subsys/secure_storage/Kconfig.its_transform
```kconfig
# Copyright (c) 2024 Nordic Semiconductor
# SPDX-License-Identifier: Apache-2.0

choice SECURE_STORAGE_ITS_TRANSFORM_IMPLEMENTATION
	prompt "ITS transform module implementation"

config SECURE_STORAGE_ITS_TRANSFORM_IMPLEMENTATION_AEAD
	bool "ITS transform module implementation using AEAD to protect the data"
	imply HWINFO # for HWINFO_HAS_DRIVER

config SECURE_STORAGE_ITS_TRANSFORM_IMPLEMENTATION_CUSTOM
	bool "Custom ITS transform module implementation"
	help
	  Implement the functions declared in <zephyr/secure_storage/its/transform.h>
	  and set CONFIG_SECURE_STORAGE_ITS_TRANSFORM_OUTPUT_OVERHEAD appropriately.
	  The header is made available when this Kconfig option is enabled.

endchoice # SECURE_STORAGE_ITS_TRANSFORM_IMPLEMENTATION

config SECURE_STORAGE_ITS_TRANSFORM_OUTPUT_OVERHEAD
	int "Overhead, in bytes, associated with the transformation of an entry's data for storage"
	range 0 1000
	# authentication tag (16) + nonce (12)
	default 28 if SECURE_STORAGE_ITS_TRANSFORM_IMPLEMENTATION_AEAD \
		   && SECURE_STORAGE_ITS_TRANSFORM_AEAD_NONCE_SIZE = 12
	default -1
	help
	  This indicates how many more bytes an ITS entry's data will be once it
	  has been processed by the secure_storage_its_transform_to_store() function.

if SECURE_STORAGE_ITS_TRANSFORM_IMPLEMENTATION_AEAD

choice SECURE_STORAGE_ITS_TRANSFORM_AEAD_SCHEME
	prompt "AEAD ITS transform module scheme"
	default SECURE_STORAGE_ITS_TRANSFORM_AEAD_SCHEME_AES_GCM
	help
	  The AEAD scheme used to encrypt and authenticate the data.

config SECURE_STORAGE_ITS_TRANSFORM_AEAD_SCHEME_AES_GCM
	bool "AES-GCM AEAD scheme"
	select PSA_WANT_KEY_TYPE_AES
	select PSA_WANT_ALG_GCM

config SECURE_STORAGE_ITS_TRANSFORM_AEAD_SCHEME_CHACHA20_POLY1305
	bool "ChaCha20-Poly1305 AEAD scheme"
	depends on SECURE_STORAGE_ITS_TRANSFORM_AEAD_NONCE_SIZE = 12
	select PSA_WANT_KEY_TYPE_CHACHA20
	select PSA_WANT_ALG_CHACHA20_POLY1305

config SECURE_STORAGE_ITS_TRANSFORM_AEAD_SCHEME_CUSTOM
	bool "Custom AEAD scheme"
	help
	  Implement the secure_storage_its_transform_aead_get_scheme() function
	  declared in <zephyr/secure_storage/its/transform/aead_get.h>
	  and set CONFIG_SECURE_STORAGE_ITS_TRANSFORM_AEAD_NONCE_SIZE appropriately.
	  The header is made available when this Kconfig option is enabled.

endchoice # SECURE_STORAGE_ITS_TRANSFORM_AEAD_SCHEME

choice SECURE_STORAGE_ITS_TRANSFORM_AEAD_KEY_PROVIDER
	prompt "AEAD ITS transform module encryption key provider"
	default SECURE_STORAGE_ITS_TRANSFORM_AEAD_KEY_PROVIDER_DEVICE_ID_HASH if HWINFO_HAS_DRIVER
	default SECURE_STORAGE_ITS_TRANSFORM_AEAD_KEY_PROVIDER_ENTRY_UID_HASH if !HWINFO_HAS_DRIVER

config SECURE_STORAGE_ITS_TRANSFORM_AEAD_KEY_PROVIDER_DEVICE_ID_HASH
	bool "Hash of the device ID returned by the HW info API (not necessarily secure)"
	depends on HWINFO_HAS_DRIVER
	select PSA_WANT_ALG_SHA_256
	help
	  This key provider generates keys by hashing the following:
	  - the device EUI64 as returned by hwinfo_get_device_eui64() as first choice;
	  - the device ID as returned by hwinfo_get_device_uuid() as second choice.
	  In addition to the device ID, it adds the UID of the ITS entry
	  for which it is generating a key to the data hashed as a salt.
	  This is not necessarily secure as the device ID may be easily readable
	  by an attacker, not unique, and/or guessable, depending on the device.

config SECURE_STORAGE_ITS_TRANSFORM_AEAD_KEY_PROVIDER_ENTRY_UID_HASH
	bool "Hash of the ITS entry UID (not secure)"
	select PSA_WANT_ALG_SHA_256
	help
	  This key provider generates keys by hashing the UID of the ITS entry for which it is
	  generating a key. This is not secure, and only intended for functional support,
	  because the UIDs are easily guessable and even stored in clear by the store module.
	  Use a secure key provider if possible.

config SECURE_STORAGE_ITS_TRANSFORM_AEAD_KEY_PROVIDER_CUSTOM
	bool "Custom key provider"
	help
	  Implement the secure_storage_its_transform_aead_get_key() function
	  declared in <zephyr/secure_storage/its/transform/aead_get.h>.
	  The header is made available when this Kconfig option is enabled.

endchoice # SECURE_STORAGE_ITS_TRANSFORM_AEAD_KEY_PROVIDER

config SECURE_STORAGE_ITS_TRANSFORM_AEAD_KEY_SIZE
	int "AEAD ITS transform module encryption key size in bytes"
	default 32

if !SECURE_STORAGE_ITS_TRANSFORM_AEAD_KEY_PROVIDER_CUSTOM

config SECURE_STORAGE_ITS_TRANSFORM_AEAD_NO_INSECURE_KEY_WARNING
	bool "Silence the insecure ITS encryption key warnings"

endif

choice SECURE_STORAGE_ITS_TRANSFORM_AEAD_NONCE_PROVIDER
	prompt "AEAD ITS transform module nonce provider"

config SECURE_STORAGE_ITS_TRANSFORM_AEAD_NONCE_PROVIDER_DEFAULT
	bool "Default nonce provider"
	help
	  The default nonce provider generates a random number for the first nonce with
	  psa_generate_random(), then increments it for every subsequent nonce. A random
	  source that doesn't repeat values between reboots is required for this to be secure.

config SECURE_STORAGE_ITS_TRANSFORM_AEAD_NONCE_PROVIDER_CUSTOM
	bool "Custom nonce provider"
	help
	  Implement the secure_storage_its_transform_aead_get_nonce() function
	  declared in <zephyr/secure_storage/its/transform/aead_get.h>.
	  The header is made available when this Kconfig option is enabled.

endchoice # SECURE_STORAGE_ITS_TRANSFORM_AEAD_NONCE_PROVIDER

config SECURE_STORAGE_ITS_TRANSFORM_AEAD_NONCE_SIZE
	int "AEAD ITS transform module nonce size in bytes"
	range 4 24
	default 12
	help
	  Make sure to update CONFIG_SECURE_STORAGE_ITS_TRANSFORM_OUTPUT_OVERHEAD
	  appropriately when changing the value of this option.

endif # SECURE_STORAGE_ITS_TRANSFORM_IMPLEMENTATION_AEAD
```

## subsys/sensing/Kconfig
```kconfig
# Copyright (c) 2023 Intel Corporation
# SPDX-License-Identifier: Apache-2.0

config SENSING
	bool "Sensing Subsystem"
	default y
	depends on DT_HAS_ZEPHYR_SENSING_ENABLED
	select RTIO
	select RTIO_CONSUME_SEM
	select SENSOR
	select SENSOR_ASYNC_API
	help
	  Enable Sensing Subsystem.

if SENSING

module = SENSING
module-str = sensing
source "subsys/logging/Kconfig.template.log_config"

config SENSING_RTIO_SQE_NUM
	int "Number of the sensing RTIO SQE"
	default 32

config SENSING_RTIO_CQE_NUM
	int "Number of the sensing RTIO SQE"
	default 32

config SENSING_RTIO_BLOCK_SIZE
	int "Block size of the RTIO context"
	default 64

config SENSING_RTIO_BLOCK_COUNT
	int "Number of memory blocks of the RTIO context"
	default 32

config SENSING_MAX_SENSITIVITY_COUNT
	int "maximum sensitivity count one sensor could support"
	depends on SENSING
	default 6
	help
	  This is the maximum sensitivity count one sensor could support,
	  some sensors such as ALS sensor could define different sensitivity for each data filed,
	  So, maximum sensitivity count is needed for sensors
	  Typical values are 6

config SENSING_RUNTIME_THREAD_STACK_SIZE
	int "stack size for sensing subsystem runtime thread"
	depends on SENSING
	default 4096
	help
	  This is the stack size for sensing subsystem runtime thread
	  Typical values are 4096

config SENSING_RUNTIME_THREAD_PRIORITY
	int "priority for sensing subsystem runtime thread"
	depends on SENSING
	default 7
	help
	  This is the thread priority for sensor subsystem runtime thread
	  Ring buffer data is stored by runtime thread, and then give semaphore
	  to notify dispatch thread, runtime thread priority should lower than
	  dispatch thread priority to ensure dispatch thread could fetch data as
	  soon as runtime thread give semaphore. Take for example, if runtime
	  priority is higher than dispatch thread, and runtime running in full
	  loading with no sleep, then dispatch thread has no change to fetch
	  data, then ring buf will always be put into data until overflow.
	  Typical values are 9

config SENSING_DISPATCH_THREAD_STACK_SIZE
	int "stack size for sensor dispatch thread"
	depends on SENSING
	default 1024
	help
	  This is the stack size for sensor dispatch thread
	  Typical values are 1024

config SENSING_DISPATCH_THREAD_PRIORITY
	  int "priority for sensor dispatch thread"
	  depends on SENSING
	  default 8
	  help
	    This is the thread priority for sensing subsystem dispatch thread
	    Ring buffer data should be fetched ASAP, so Dispatch
	    thread priority should be higher than runtime thread
	    Typical values are 8

source "subsys/sensing/sensor/phy_3d_sensor/Kconfig"
source "subsys/sensing/sensor/hinge_angle/Kconfig"

endif # SENSING
```

## subsys/sensing/sensor/hinge_angle/Kconfig
```kconfig
# Copyright (c) 2023 Intel Corporation
# SPDX-License-Identifier: Apache-2.0

config SENSING_SENSOR_HINGE_ANGLE
	bool "Sensing hinge angle sensor"
	default y
	depends on DT_HAS_ZEPHYR_SENSING_HINGE_ANGLE_ENABLED
	help
	  Enable sensing hinge angle sensor.
```

## subsys/sensing/sensor/phy_3d_sensor/Kconfig
```kconfig
# Copyright (c) 2023 Intel Corporation
# SPDX-License-Identifier: Apache-2.0

config SENSING_SENSOR_PHY_3D_SENSOR
	bool "sensing subsystem physical 3d sensors(accel, gyro, mag)"
	default y
	depends on DT_HAS_ZEPHYR_SENSING_PHY_3D_SENSOR_ENABLED
	help
	  Enable sensing subsystem physical 3d sensors(accel, gyro, mag).
```

## subsys/sensing/vsensors/Kconfig
```kconfig
config SENSING_ACCEL_BASED_ANGLE
	bool
	default y
	depends on DT_HAS_SENSING_ACCEL_BASED_ANGLE_ENABLED
	select DSP

config SENSING_EMUL
	bool
	default y
	depends on DT_HAS_SENSING_EMUL_ENABLED
```
