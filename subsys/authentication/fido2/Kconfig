## subsys/authentication/fido2/Kconfig
```kconfig
# Copyright (c) 2026 Siratul Islam <email@sirat.me>
# SPDX-License-Identifier: Apache-2.0

menuconfig FIDO2
	bool "FIDO2 authenticator"
	select ZCBOR
	select ZCBOR_CANONICAL
	select PSA_CRYPTO
	select SECURE_STORAGE if !BUILD_WITH_TFM
	select PSA_WANT_KEY_TYPE_ECC_KEY_PAIR_GENERATE
	select PSA_WANT_KEY_TYPE_ECC_PUBLIC_KEY
	select PSA_WANT_ALG_ECDSA
	select PSA_WANT_ALG_SHA_256
	select PSA_WANT_ALG_GCM
	select PSA_WANT_ECC_SECP_R1_256
	help
	  Enable the FIDO2/CTAP2 authenticator subsystem.

if FIDO2

module = FIDO2
module-str = fido2
source "subsys/logging/Kconfig.template.log_config"

config FIDO2_THREAD_STACK_SIZE
	int "FIDO2 processing thread stack size"
	default 4096

config FIDO2_THREAD_PRIORITY
	int "FIDO2 processing thread priority"
	default 7

config FIDO2_CBOR_MAX_SIZE
	int "Maximum CBOR message buffer size"
	default 1024
	range 1024 4096
	help
	  Maximum size of CBOR encoded CTAP2 request and response messages.

config FIDO2_MAX_CREDENTIALS
	int "Maximum number of resident credentials"
	default 16
	range 1 256
	help
	  Maximum number of discoverable (resident) credentials that
	  can be stored on the device.

config FIDO2_EXT_CRED_PROTECT
	bool "credProtect extension"
	help
	  Enable the CTAP2 credProtect extension.

config FIDO2_EXT_HMAC_SECRET
	bool "hmac-secret extension"
	select PSA_WANT_ALG_HMAC
	help
	  Enable the CTAP2 hmac-secret extension.

config FIDO2_EXT_LARGE_BLOB_KEY
	bool "largeBlobKey extension"
	help
	  Enable the CTAP2 largeBlobKey extension for per-credential
	  large blob storage. Not yet implemented.

config FIDO2_EXT_CRED_BLOB
	bool "credBlob extension"
	depends on FIDO2_EXT_CRED_PROTECT
	help
	  Enable the CTAP2 credBlob extension. Requires credProtect support.
	  Authenticators supporting credBlob MUST also support credProtect.

config FIDO2_EXT_THIRD_PARTY_PAYMENT
	bool "thirdPartyPayment extension"
	help
	  Enable the CTAP2 thirdPartyPayment extension.

config FIDO2_CREDENTIAL_MANAGEMENT
	bool "Credential management command"
	help
	  Enable the CTAP 2.1 authenticatorCredentialManagement (0x0A)
	  command. Requires PIN protocol support since all credMgmt
	  subcommands require a pinUvAuthToken with CM permission.

config FIDO2_AAGUID
	string "Authenticator AAGUID (32 hex chars)"
	help
	  Authenticator AAGUID encoded as 32 hexadecimal characters with no
	  separators (16 bytes).

config FIDO2_ALWAYS_UV
	bool "Always require user verification"
	help
	  When enabled, this forces user verification for every MakeCredential
	  and GetAssertion operation regardless of what the Relying Party requests,
	  including when userVerification is set to "discouraged".

	  This overrides makeCredUvNotRqd

rsource "attestation/Kconfig"
rsource "transport/Kconfig"
rsource "up/Kconfig"
rsource "storage/Kconfig"

endif # FIDO2
```

## subsys/authentication/fido2/attestation/Kconfig
```kconfig
# Copyright (c) 2026 Siratul Islam <email@sirat.me>
# SPDX-License-Identifier: Apache-2.0

menu "Attestation"

choice FIDO2_ATTESTATION_BACKEND
	prompt "Attestation backend"
	default FIDO2_ATTESTATION_SELF

config FIDO2_ATTESTATION_SELF
	bool "Self (packed, credential key)"
	help
	  Use self attestation. This is the simplest form of attestation
	  and does not require any additional keys or certificates.

config FIDO2_ATTESTATION_CUSTOM
	bool "Custom (application-provided)"
	help
	  Use a custom attestation backend, where the authenticator uses
	  application-provided keys or certificates for attestation.

config FIDO2_ATTESTATION_NONE
	bool "None"
	help
	  Do not provide any attestation.

endchoice

endmenu
```

## subsys/authentication/fido2/up/Kconfig
```kconfig
# Copyright (c) 2026 Siratul Islam <email@sirat.me>
# SPDX-License-Identifier: Apache-2.0

menu "User Presence"

choice FIDO2_UP_BACKEND
	prompt "User presence backend"
	default FIDO2_UP_INPUT

config FIDO2_UP_INPUT
	bool "Input device"
	depends on INPUT
	help
	  Check user presence using the INPUT subsystem. Uses the devicetree chosen property
	  zephyr,fido2-up-input.

config FIDO2_UP_ALWAYS
	bool "Always approve"
	select NOT_SECURE
	help
	  Bypass user presence and always return success. This reduces security
	  and should only be used for testing or in very specific use cases.

config FIDO2_UP_CUSTOM
	bool "Custom (application-provided)"
	help
	  No UP source is compiled from the subsystem. The application
	  must provide its own implementation.

endchoice

config FIDO2_UP_TIMEOUT_MS
	int "User presence timeout in milliseconds"
	default 30000
	help
	  Time to wait for user presence confirmation before timing out.
	  Default 30 seconds, as per FIDO2 specification.

endmenu
```

## subsys/bindesc/Kconfig
```kconfig
# Copyright (c) 2023 Yonatan Schachter
# SPDX-License-Identifier: Apache-2.0

menuconfig BINDESC
	bool "Binary Descriptors"
	depends on ARCH_SUPPORTS_ROM_START || ARCH_POSIX
	help
	  Binary Descriptors - constant data accessible outside of the executable image

if BINDESC

config BINDESC_DEFINE
	bool "Binary Descriptors Define"
	help
	  Enable the app to define its own binary descriptors

if BINDESC_DEFINE

source "subsys/bindesc/Kconfig.version"
source "subsys/bindesc/Kconfig.build_time"
source "subsys/bindesc/Kconfig.host_info"

config BINDESC_DEFINE_MAX_DATA_SIZE
	int "Bindesc max data size"
	range 4 $(UINT16_MAX)
	default 128
	help
	  Determines the maximum size of a binary descriptor's data. The theoretical
	  limit to this value is the maximum value of a uint16_t (65535), in practice
	  it's recommened to keep this value much smaller for easier handling of the data.

endif # BINDESC_DEFINE

config BINDESC_READ
	bool "Binary Descriptors Read"
	help
	  Enable the app to read the binary descriptors of another image

if BINDESC_READ

module = BINDESC_READ
module-str = Binary Descriptor read
source "subsys/logging/Kconfig.template.log_config"

config BINDESC_READ_RAM
	bool "Bindesc read from RAM"
	help
	  Enable reading and parsing binary descriptors from RAM.

config BINDESC_READ_MEMORY_MAPPED_FLASH
	bool "Bindesc read from memory mapped flash"
	help
	  Enable reading and parsing binary descriptors from memory mapped flash.

config BINDESC_READ_FLASH
	bool "Bindesc read from flash"
	help
	  Enable reading and parsing binary descriptors from non memory mapped flash
	  (e.g. external flash).

if BINDESC_READ_FLASH

config BINDESC_READ_FLASH_MAX_DATA_SIZE
	int "Bindesc read flash max data size"
	range 4 $(UINT16_MAX)
	default 128
	help
	  The maximum expected size of the descriptors' data. This should be set to
	  the value set to BINDESC_DEFINE_MAX_DATA_SIZE by the read image.
	  Any descriptor that exceeds this size will be ignored.

endif # BINDESC_READ_FLASH

endif # BINDESC_READ

endif # BINDESC
```

## subsys/bindesc/Kconfig.build_time
```kconfig
# Copyright (c) 2023 Yonatan Schachter
# SPDX-License-Identifier: Apache-2.0

menuconfig BINDESC_DEFINE_BUILD_TIME
	bool "Build Time binary descriptors"
	help
	  Add the build time binary descriptors

if BINDESC_DEFINE_BUILD_TIME

config BINDESC_BUILD_TIME_USE_LOCAL_TIME
	bool "Use local time"
	help
	  If enabled, the build time used for the descriptors will express
	  the local time, rather than UTC.

config BINDESC_BUILD_TIME_ALWAYS_REBUILD
	bool "Always rebuild"
	default y
	help
	  If enabled, the file containing the build time definitions will
	  always be rebuilt. This results in the timestamp always being
	  accurate, but also in slightly longer build times.

config BINDESC_BUILD_TIME_YEAR
	bool "Year of build"
	help
	  The year the image was compiled, such as 2023

config BINDESC_BUILD_TIME_MONTH
	bool "Month of build"
	help
	  The month the image was compiled, such as 5 (May)

config BINDESC_BUILD_TIME_DAY
	bool "Day of build"
	help
	  The day of the month the image was compiled, such as 9

config BINDESC_BUILD_TIME_HOUR
	bool "Hour of build"
	help
	  The hour of the day the image was compiled, such as 13 in 13:34:52

config BINDESC_BUILD_TIME_MINUTE
	bool "Minute of build"
	help
	  The minute the image was compiled, such as 34 in 13:34:52

config BINDESC_BUILD_TIME_SECOND
	bool "Second of build"
	help
	  The second the image was compiled, such as 52 in 13:34:52

config BINDESC_BUILD_TIME_UNIX
	bool "Build time as UNIX time"
	help
	  The UNIX time at which the image was compiled. This is an integer
	  counting the seconds since midnight of January 1st 1970

config BINDESC_BUILD_DATE_TIME_STRING
	bool "Build date and time as string"
	help
	  The date and time of compilation as a string, such as "2023-09-29T17:43:14+0000"

config BINDESC_BUILD_DATE_STRING
	bool "Build date as string"
	help
	  The date of compilation as a string, such as "2023-09-29"

config BINDESC_BUILD_TIME_STRING
	bool "Build time as string"
	help
	  The time of compilation as a string, such as "T17:43:14+0000"

config BINDESC_BUILD_DATE_TIME_STRING_FORMAT
	string "Date-Time format"
	default "%Y-%m-%dT%H:%M:%S%z"
	help
	  Format of the build time string. This value is passed to cmake's string(TIMESTAMP ...)
	  function, so refer to string's documentation for more info on the different formats.
	  This can also be used to set a specific time, when trying to reproduce an image. For
	  example, setting the format to "2023-02-05T00:07:04+0000" will set it as the build time,
	  regardless of the actual build time.
	  If BINDESC_BUILD_TIME_USE_LOCAL_TIME is enabled, the time is the local time, else
	  it is UTC time.
	  Example of the default format: 2023-09-29T17:43:14+0000.
	  Note: the default format complies with ISO-8601.

config BINDESC_BUILD_DATE_STRING_FORMAT
	string "Date format"
	default "%Y-%m-%d"
	help
	  Format of the build date string. This value is passed to cmake's string(TIMESTAMP ...)
	  function, so refer to string's documentation for more info on the different formats.
	  This can also be used to set a specific time, when trying to reproduce an image. For
	  example, setting the format to "2023-02-05" will set it as the build time,
	  regardless of the actual build time.
	  Example of the default format: 2023-02-05
	  Note: the default format complies with ISO-8601.

config BINDESC_BUILD_TIME_STRING_FORMAT
	string "Time format"
	default "T%H:%M:%S%z"
	help
	  Format of the build time string. This value is passed to cmake's string(TIMESTAMP ...)
	  function, so refer to string's documentation for more info on the different formats.
	  This can also be used to set a specific time, when trying to reproduce an image. For
	  example, setting the format to "T00:07:04+0000" will set it as the build time,
	  regardless of the actual build time.
	  Example of the default format: T00:07:04+0000.
	  Note: the default format complies with ISO-8601.

endif # BINDESC_DEFINE_BUILD_TIME
```

## subsys/bindesc/Kconfig.checksums
```kconfig
# Copyright (c) 2023 Yonatan Schachter
# SPDX-License-Identifier: Apache-2.0

menuconfig BINDESC_DEFINE_CHECKSUMS
	bool "Checksum binary descriptors"
	help
	  Add checksum binary descriptors

if BINDESC_DEFINE_CHECKSUMS

config BINDESC_CHECKSUM_MD5_BYTES
	bool "MD5 checksum as bytes"
	help
	  MD5 checksum as bytes

config BINDESC_CHECKSUM_MD5_STRING
	bool "MD5 checksum as a string"
	help
	  MD5 checksum as a string

endif # BINDESC_DEFINE_CHECKSUMS
```

## subsys/bindesc/Kconfig.host_info
```kconfig
# Copyright (c) 2023 Yonatan Schachter
# SPDX-License-Identifier: Apache-2.0

menuconfig BINDESC_DEFINE_HOST_INFO
	bool "Host info binary descriptors"
	help
	  Add the host info binary descriptors

if BINDESC_DEFINE_HOST_INFO

config BINDESC_HOST_NAME
	bool "Host name"
	help
	  The name of the host that the image was compiled on

config BINDESC_C_COMPILER_NAME
	bool "C compiler name"
	help
	  The C compiler name, such as "GNU"

config BINDESC_C_COMPILER_VERSION
	bool "C compiler version"
	help
	  The C compiler version, such as "12.3.0"

config BINDESC_CXX_COMPILER_NAME
	bool "C++ compiler name"
	help
	  The C++ compiler name, such as "GNU"

config BINDESC_CXX_COMPILER_VERSION
	bool "C++ compiler version"
	help
	  The C++ compiler version, such as "12.3.0"

endif # BINDESC_DEFINE_HOST_INFO
```

## subsys/bindesc/Kconfig.version
```kconfig
# Copyright (c) 2023 Yonatan Schachter
# SPDX-License-Identifier: Apache-2.0

menuconfig BINDESC_DEFINE_VERSION
	bool "Version binary descriptors"
	help
	  Add the version binary descriptors

if BINDESC_DEFINE_VERSION

config BINDESC_KERNEL_VERSION_STRING
	bool "Kernel version string"
	help
	  The kernel version string, such as "3.4.0"

config BINDESC_KERNEL_VERSION_MAJOR
	bool "Kernel version major"
	help
	  The major version number, such as 3 in 3.4.0

config BINDESC_KERNEL_VERSION_MINOR
	bool "Kernel version minor"
	help
	  The minor version number, such as 4 in 3.4.0

config BINDESC_KERNEL_VERSION_PATCHLEVEL
	bool "Kernel version patchlevel"
	help
	  The patchlevel version number, such as 0 in 3.4.0

config BINDESC_KERNEL_VERSION_NUMBER
	bool "Kernel version number"
	help
	  The kernel version as binary coded decimal, computed as
	  (major << 16 | minor << 8 | patchlevel). For example,
	  3.4.0 would be represented as 0x30400

config BINDESC_KERNEL_BUILD_VERSION
	bool "Kernel git reference"
	help
	  The kernel git reference, such as "v3.3.0-18-g2c85d9224fca",
	  or overridden at build time - see BUILD_VERSION

config BINDESC_APP_VERSION_STRING
	bool "App version string"
	help
	  The app version string, such as "1.0.0"

config BINDESC_APP_VERSION_MAJOR
	bool "App version major"
	help
	  The app major version number, such as 1 in 1.0.0

config BINDESC_APP_VERSION_MINOR
	bool "App version minor"
	help
	  The app minor version number, such as 0 in 1.0.0

config BINDESC_APP_VERSION_PATCHLEVEL
	bool "App version patchlevel"
	help
	  The app patchlevel version number, such as 0 in 1.0.0

config BINDESC_APP_VERSION_NUMBER
	bool "App version number"
	help
	  The app version as binary coded decimal, computed as
	  (major << 16 | minor << 8 | patchlevel). For example,
	  1.0.0 would be represented as 0x10000

config BINDESC_APP_BUILD_VERSION
	bool "App git reference"
	help
	  The application git reference, such as "v3.3.0-18-g2c85d9224fca"

endif # BINDESC_DEFINE_VERSION
```
