## subsys/bluetooth/audio/Kconfig.csis
```kconfig
# Bluetooth Audio - Broadcast Assistant configuration options
#
# Copyright (c) 2020 Bose Corporation
# Copyright (c) 2021 Nordic Semiconductor ASA
#
# SPDX-License-Identifier: Apache-2.0
#

#################### Coordinated Set Identification Service ####################

config BT_CSIS
	bool "Coordinated Set Identification Service Support [EXPERIMENTAL]"
	imply BT_EXT_ADV if BT_PRIVACY
	select EXPERIMENTAL
	help
	  This option enables support for Coordinated Set Identification
	  Service.

if BT_CSIS

config BT_CSIS_TEST_SAMPLE_DATA
	bool "Coordinated Set Identification Service Test Sample Data"
	help
	  Enable the use of the sample data defined by the CSIS spec SIRK.
	  This will use the sample SIRK, prand and LTK.

	  WARNING: This option enables anyone to track and decrypt the SIRK
	  (if encrypted) using public sample data.
	  Should not be used for production builds.

config BT_CSIS_ENC_SIRK_SUPPORT
	bool "Support for encrypted SIRK"
	default y
	select BT_SMP_SC_PAIR_ONLY
	help
	  Enables support encrypting the SIRK.

config BT_CSIS_MAX_INSTANCE_COUNT
	int "Coordinated Set Identification Service max instance count"
	default 1
	range 1 255
	help
	  This option sets the maximum number of instances of Coordinated Set
	  Identification Services. If the service is declared as primary service
	  then only a single instance is possible.

############### DEBUG ###############

config BT_DEBUG_CSIS
	bool "Coordinated Set Identification Service debug"
	help
	  Use this option to enable Coordinated Set Identification Service debug
	  logs for the Bluetooth Audio functionality.

endif # BT_CSIS

#################### Coordinated Set Identification Client ####################

config BT_CSIS_CLIENT
	bool "Coordinated Set Identification Profile Support [EXPERIMENTAL]"
	select BT_GATT_CLIENT
	select BT_GATT_AUTO_DISCOVER_CCC
	select EXPERIMENTAL
	help
	  This option enables support for Coordinated Set Identification
	  Profile.

if BT_CSIS_CLIENT

config BT_CSIS_CLIENT_TEST_SAMPLE_DATA
	bool "Coordinated Set Identification Service Test Sample Data"
	help
	  Enable the use of the sample data defined by the CSIS spec.
	  This will use the sample SIRK, prand and LTK.

	  WARNING: This option enables the client to use the sample data
	  to locate members and decrypt the SIRK, and thus won't work
	  with set members that are not using the sample data.
	  Should not be used for production builds.

config BT_CSIS_CLIENT_MAX_CSIS_INSTANCES
	int "Coordinated Set Identification Service Count"
	default 1
	range 1 3
	help
	  Sets the number of service instances, which corresponds to the number
	  of different sets the peer device may be in.

config BT_CSIS_CLIENT_ENC_SIRK_SUPPORT
	bool "Support for encrypted SIRK"
	default y
	select BT_SMP_SC_PAIR_ONLY
	help
	  Enables support encrypting the SIRK.

############### DEBUG ###############

config BT_DEBUG_CSIS_CLIENT
	bool "Coordinated Set Identification Profile debug"
	help
	  Use this option to enable Coordinated Set Identification Profile debug
	  logs for the Bluetooth Audio functionality.

endif # BT_CSIS_CLIENT

config BT_DEBUG_CSIS_CRYPTO
	bool "Coordinated Set Identification Service crypto functions debug"
	depends on BT_CSIS_CLIENT || BT_CSIS
	help
	  Use this option to enable Coordinated Set Identification Service
	  crypto functions debug logs for the Bluetooth Audio functionality.
```

## subsys/bluetooth/audio/Kconfig.gmap
```kconfig
# Bluetooth Audio - Gaming Audio Profile (GMAP) options
#
# Copyright (c) 2023 Nordic Semiconductor ASA
#
# SPDX-License-Identifier: Apache-2.0
#

config BT_GMAP_UGG_SUPPORTED
	def_bool BT_CAP_INITIATOR && BT_BAP_UNICAST_CLIENT && BT_VCP_VOL_CTLR

config BT_GMAP_UGT_SUPPORTED
	def_bool BT_CAP_ACCEPTOR && BT_BAP_UNICAST_SERVER

config BT_GMAP_BGS_SUPPORTED
	def_bool BT_CAP_INITIATOR && BT_BAP_BROADCAST_SOURCE

config BT_GMAP_BGR_SUPPORTED
	def_bool BT_CAP_ACCEPTOR && BT_BAP_BROADCAST_SINK && BT_VCP_VOL_REND

config BT_GMAP
	bool "Gaming Audio Profile [EXPERIMENTAL]"
	depends on BT_CAP_ACCEPTOR || BT_CAP_INITIATOR
	select EXPERIMENTAL
	help
	  Enabling this will enable GMAP.

parent-module = BT
module = BT_GMAP
module-str = "Bluetooth Gaming Audio Profile"
source "subsys/logging/Kconfig.template.log_config_inherit"
```

## subsys/bluetooth/audio/Kconfig.hap
```kconfig
# Bluetooth Audio - Hearing Access Profile options
#
# Copyright (c) 2023 Codecoup
#
# SPDX-License-Identifier: Apache-2.0

config BT_HAP_HARC
	bool "HAP Hearing Access Remote Controller support [EXPERIMENTAL]"
	depends on BT_HAS_CLIENT
	depends on BT_CSIP_SET_COORDINATOR
	depends on BT_VCP_VOL_CTLR
	help
	  This option enables support for HAP Hearing Access Remote Controller.
```

## subsys/bluetooth/audio/Kconfig.has
```kconfig
# Bluetooth Audio - Hearing Access Service options
#
# Copyright (c) 2022 Codecoup
#
# SPDX-License-Identifier: Apache-2.0

menuconfig BT_HAS
	bool "Hearing Access Service support"
	depends on UTF8
	depends on BT_GATT_DYNAMIC_DB
	depends on BT_BAP_UNICAST_SERVER
	help
	  This option enables support for Hearing Access Service.

if BT_HAS

config BT_HAS_FEATURES_NOTIFIABLE
	bool "Hearing Aid Features Notifiable Support"
	help
	  This option enables support for clients to subscribe for notifications
	  on the Hearing Aid Features characteristic.

config BT_HAS_PRESET_COUNT
	int "Preset record list size"
	default 2
	range 0 $(UINT8_MAX)
	help
	  This option sets the number of Hearing Access Service Presets
	  that can be registered. Setting this value to 0 disables Presets support.

config BT_HAS_PRESET_SUPPORT
	def_bool BT_HAS_PRESET_COUNT > 0

if BT_HAS_PRESET_SUPPORT

config BT_HAS_PRESET_NAME_DYNAMIC
	bool "Allow to set preset name on runtime"
	help
	  Enabling this option allows for runtime configuration of preset name.

config BT_HAS_PRESET_CONTROL_POINT_NOTIFIABLE
	bool "Preset Control Point Notifiable support"
	depends on BT_EATT
	help
	  This option enables support for clients to subscribe for notifications
	  on the Hearing Aid Preset Control Point characteristic.

config BT_HAS_ACTIVE_PRESET_INDEX
	def_bool BT_HAS_PRESET_SUPPORT
	help
	  This option enables the Hearing Aid Active Preset Index characteristic.

endif # BT_HAS_PRESET_SUPPORT

endif # BT_HAS

config BT_HAS_CLIENT
	bool "Hearing Access Service Client support"
	depends on UTF8
	depends on BT_GATT_CLIENT
	depends on BT_GATT_AUTO_DISCOVER_CCC
	depends on BT_GATT_AUTO_UPDATE_MTU
	depends on BT_SMP
	help
	  This option enables support for Hearing Access Service Client.
```

## subsys/bluetooth/audio/Kconfig.mcp
```kconfig
# Bluetooth Audio - Media player configuration options

#
# Copyright (c) 2022 Nordic Semiconductor
#
# SPDX-License-Identifier: Apache-2.0
#

config BT_MCP_MEDIA_CONTROL_SERVER
	bool "Support for MCP Media Server"
	depends on BT_MCS
	help
	  Enables support for MCP Media Server

if BT_MCP_MEDIA_CONTROL_SERVER

config BT_MCP_MEDIA_CONTROL_SERVER_MEDIA_PLAYER_NAME
	string "Media Player Name"
	default "Player0"
	help
	  Use this option to set the name of the media player.

config BT_MCP_MEDIA_CONTROL_SERVER_MEDIA_PLAYER_NAME_MAX
	int "Max length of media player name"
	default 20
	range 1 $(UINT8_MAX)
	help
	  Sets the maximum number of bytes (including the null termination) of
	  the name of the media player.

config BT_MCP_MEDIA_CONTROL_SERVER_ICON_URL
	string "Media player Icon URL"
	default "http://server.some.where/path/icon.png"
	help
	  Use this option to set the URL of the Media Player Icon.

config BT_MCP_MEDIA_CONTROL_SERVER_ICON_URL_MAX
	int "Max length of media player icon URL"
	default 40
	range 1 $(UINT8_MAX)
	help
	  Sets the maximum number of bytes (including the null termination) of
	  the media player icon URL.

config BT_MCP_MEDIA_CONTROL_SERVER_TRACK_TITLE_MAX
	int "Max length of the title of a track"
	default 40
	range 1 $(UINT8_MAX)
	help
	  Sets the maximum number of bytes (including the null termination) of
	  the title of any track in the media player.

config BT_MCP_MEDIA_CONTROL_SERVER_SEGMENT_NAME_MAX
	int "Max length of the name of a track segment"
	default 25
	range 1 $(UINT8_MAX)
	help
	  Sets the maximum number of bytes (including the null termination)
	  of the name of any track segment in the media player.

config BT_MCP_MEDIA_CONTROL_SERVER_GROUP_TITLE_MAX
	int "Max length of the title of a group of tracks"
	default BT_MCP_MEDIA_CONTROL_SERVER_TRACK_TITLE_MAX
	range 1 $(UINT8_MAX)
	help
	  Sets the maximum number of bytes (including the null termination) of
	  the title of any group in the media player.

config BT_MCP_MEDIA_CONTROL_SERVER_OBJECTS
	bool "Support for media player objects"
	depends on BT_OTS
	# TODO: Temporarily depends also on BT_MCS, to avoid issues with the
	# bt_mcs_get_ots() call
	depends on BT_MCS
	help
	  Enables support for objects in the media player
	  Objects are used to give/get more information about e.g. media tracks.
	  Requires the Object Transfer Service

if BT_MCP_MEDIA_CONTROL_SERVER_OBJECTS

config BT_MCP_MEDIA_CONTROL_SERVER_MAX_OBJ_SIZE
	int "Total memory size to use for storing the content of objects"
	default 127
	range 0 65536
	help
	  Sets the total memory size (in octets) to use for storing the content of objects.
	  This is used for the total memory pool buffer size from which memory
	  is allocated when sending object content.

config BT_MCP_MEDIA_CONTROL_SERVER_ICON_BITMAP_SIZE
	int "Media player Icon bitmap object size"
	default 127
	help
	  This option sets the maximum size (in octets) of the icon object.

config BT_MCP_MEDIA_CONTROL_SERVER_TRACK_MAX_SIZE
	int "Maximum size for a track object"
	default 127
	help
	  This option sets the maximum size (in octets) of a track object.

endif # BT_MCP_MEDIA_CONTROL_SERVER_OBJECTS

endif # BT_MCP_MEDIA_CONTROL_SERVER
```
