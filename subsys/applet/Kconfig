## subsys/applet/Kconfig
```kconfig
# Copyright (c) 2026 Intel Corporation
# SPDX-License-Identifier: Apache-2.0

menuconfig APPLET
	bool "Zephyr Applet"
	select THREAD_NAME
	select SCHED_CPU_MASK if SMP
	select DYNAMIC_OBJECTS if USERSPACE
	help
	  Enable the Zephyr applet subsystem.

	  The applet model groups one or more Zephyr threads into a logical
	  sub-application, called an "applet". An applet may optionally:

	    - Load its code from an ELF binary at runtime (LLEXT)
	    - Use memory domains for per-applet hardware memory isolation
	      (requires CONFIG_USERSPACE)
	    - Run none or all of its threads in unprivileged mode

if APPLET

config APPLET_LLEXT
	bool "Support LLEXT-backed applets"
	depends on LLEXT
	default y if LLEXT
	help
	  When enabled, applets can be loaded from ELF binaries via the
	  LLEXT subsystem. When disabled, only "native" applets (whose threads
	  run code already linked into the main image) are supported.

config APPLET_NAME_MAX_LEN
	int "Maximum length of a applet name"
	default 15
	range 8 31
	help
	  Maximum number of characters in a applet name, not counting the
	  null terminator. Truncation is silent.

config APPLET_HEAP_SIZE
	int "Heap (bytes) used for per-thread bookkeeping slots"
	default 1024
	help
	  The applet subsystem allocates one applet_thread slot from a
	  dedicated kernel heap each time applet_add_thread() is called.
	  Each slot is roughly the size of a struct k_thread plus a
	  k_mem_partition, so a 1024-byte heap typically holds 4-6 threads.

	  Increase this value if your application creates many concurrent
	  applet threads and applet_add_thread() starts returning
	  -ENOMEM.

config APPLET_THREAD_STACK_SIZE_DEFAULT
	int "Default applet thread stack size (bytes)"
	default 2048
	help
	  Suggested stack size for an applet thread. The applet subsystem never
	  allocates stacks itself; applications use this value to size the
	  stacks they pass to applet_add_thread() and applet_add_thread_sym().

config APPLET_THREAD_PRIORITY_DEFAULT
	int "Default applet thread scheduling priority"
	default 5
	range -16 14
	help
	  Scheduling priority applied to a new applet thread when
	  applet_opts.thread_priority is not overridden.

config APPLET_FATAL_HANDLER
	bool "Install a fatal error handler for applet threads"
	help
	  When enabled, the applet subsystem installs a custom
	  k_sys_fatal_error_handler() that, depending on the value of
	  opts.halt_on_fault, does one of the following:

	    - Halts the whole system via `k_fatal_halt()`
		- Aborts all threads of the offending applet
	    - Aborts only the offending thread

	  Do not enable this option if your application already provides its
	  own k_sys_fatal_error_handler().

module = APPLET
module-str = applet
source "subsys/logging/Kconfig.template.log_config"

endif # APPLET
```

## subsys/authentication/fido2/storage/Kconfig
```kconfig
# Copyright (c) 2026 Siratul Islam <siratul.islam@linux.dev>
# SPDX-License-Identifier: Apache-2.0

menu "Credential Storage"

choice FIDO2_STORAGE_BACKEND
	prompt "Credential storage backend"
	default FIDO2_STORAGE_SETTINGS

config FIDO2_STORAGE_SETTINGS
	bool "Zephyr settings subsystem"
	depends on SETTINGS
	help
	  Store FIDO2 credentials using the Zephyr settings subsystem.

config FIDO2_STORAGE_PSA_PROTECTED_STORAGE
	bool "PSA Protected Storage"
	depends on TFM_PARTITION_PROTECTED_STORAGE || SECURE_STORAGE
	help
	  Store FIDO2 credentials using the PSA Protected Storage.
	  When using SECURE_STORAGE, CONFIG_SECURE_STORAGE_ITS_MAX_DATA_SIZE
	  must be at least the credential size. 600 bytes recommended.

config FIDO2_STORAGE_NONE
	bool "No persistent storage"
	help
	  No credentials are stored on-device. Suitable when only
	  non-discoverable credentials are issued.

config FIDO2_STORAGE_CUSTOM
	bool "Custom (application-provided)"
	help
	  No storage backend is compiled from the subsystem. The application
	  must provide its own implementation.

endchoice

endmenu
```

## subsys/authentication/fido2/transport/Kconfig
```kconfig
# Copyright (c) 2026 Siratul Islam <email@sirat.me>
# SPDX-License-Identifier: Apache-2.0

menu "Transport"

config FIDO2_TRANSPORT_USB_HID
	bool "CTAP over USB HID"
	depends on USB_DEVICE_STACK_NEXT
	select USBD_HID_SUPPORT
	help
	  Enable FIDO2 communication over USB HID (CTAPHID).

config FIDO2_CTAPHID_TIMEOUT_MS
	int "CTAPHID message reassembly timeout in milliseconds"
	default 1000
	range 100 2000
	depends on FIDO2_TRANSPORT_USB_HID
	help
	  Maximum time to wait for continuation packets during CTAPHID
	  message reassembly. If a complete message is not received within
	  this timeout, the authenticator sends an error response and
	  aborts the transaction.

config FIDO2_CTAPHID_KEEPALIVE_INTERVAL_MS
	int "CTAPHID keepalive interval in milliseconds"
	default 100
	range 20 100
	depends on FIDO2_TRANSPORT_USB_HID
	help
	  Interval for CTAPHID keepalive packets. The specification requires
	  this to be at most 100ms for USB HID to prevent host timeouts.

config FIDO2_HID_RX_WORKQ_STACK_SIZE
	int "USB HID RX workqueue stack size"
	default 4096
	range 1024 16384
	depends on FIDO2_TRANSPORT_USB_HID
	help
	  Stack size for the dedicated USB HID RX workqueue used to
	  process incoming CTAPHID reports.

menuconfig FIDO2_TRANSPORT_BLE
	bool "CTAP over Bluetooth LE"
	depends on BT_PERIPHERAL
	depends on BT_GATT_ENFORCE_SUBSCRIPTION
	depends on BT_SMP
	depends on BT_DIS
	depends on BT_DIS_MANUF_NAME
	depends on BT_DIS_MODEL_NUMBER
	depends on BT_DIS_FW_REV
	imply BT_BONDING_REQUIRED
	help
	  Enable FIDO2 communication over Bluetooth LE (CTAP).

if FIDO2_TRANSPORT_BLE

config FIDO2_BLE_REQUIRE_AUTHENTICATED_LINK
	bool "Require authenticated Bluetooth LE pairing"
	help
	  Require Bluetooth Security Level 3 instead of the minimum
	  encrypted Security Level 2.

config FIDO2_BLE_RX_WORKQ_STACK_SIZE
	int "Bluetooth LE RX workqueue stack size"
	default 4096
	range 1024 16384
	help
	  Stack size for the dedicated Bluetooth LE RX workqueue used to
	  process incoming FIDO Bluetooth LE fragments.

config FIDO2_BLE_CONTROL_POINT_LENGTH
	int "Maximum FIDO Control Point write length"
	range 20 512
	default 20
	help
	  Maximum size, in bytes, of a single write to the FIDO Control
	  Point characteristic over Bluetooth LE. Values greater than 20 require a
	  correspondingly large negotiated ATT MTU and Bluetooth buffers.

config FIDO2_BLE_RX_QUEUE_DEPTH
	int "Receive Bluetooth LE queue depth"
	range 1 32
	default 8
	help
	  Number of Control Point fragments that can wait for processing.

config FIDO2_BLE_TX_FRAME_COUNT
	int "FIDO Bluetooth LE transmit frame count"
	range 2 8
	default 4
	help
	  Number of complete FIDO frames that can be queued for
	  asynchronous transmission over Bluetooth LE.

config FIDO2_BLE_KEEPALIVE_INTERVAL_MS
	int "FIDO2 Bluetooth LE keepalive interval"
	range 10 500
	default 500
	help
	  Interval, in milliseconds, between KEEPALIVE notifications sent
	  while the authenticator is processing a request or waiting for
	  user presence.

	  The maximum and default value correspond to the CTAP Bluetooth LE
	  kKeepAliveMillis value of 500 milliseconds.

config FIDO2_BLE_RX_TIMEOUT_MS
	int "RX reassembly timeout in milliseconds"
	default 1500
	range 1500 10000
	help
	  Minimum time in milliseconds to wait for the next fragment of an
	  incomplete FIDO Bluetooth LE message. The effective timeout is at
	  least the current Bluetooth LE connection interval.

	  The default corresponds to the CTAP Bluetooth LE
	  kMaxCommandTransmitDelayMillis value.

config FIDO2_BLE_TX_RETRY_DELAY_MS
	int "TX retry delay in milliseconds"
	default 5
	range 1 100
	help
	  Minimum delay in milliseconds before retrying a Bluetooth LE
	  notification that could not be submitted due to a transient error.
	  The effective delay is at least the current Bluetooth LE connection
	  interval.

endif # FIDO2_TRANSPORT_BLE

endmenu
```

## subsys/bluetooth/profiles/Kconfig
```kconfig
# Bluetooth LE profiles

# Copyright (c) 2026 Xiaomi Corporation
# SPDX-License-Identifier: Apache-2.0

menu "Bluetooth LE Profiles"
	depends on BT_CONN

rsource "hogp/Kconfig"

endmenu
```

## subsys/bluetooth/profiles/hogp/Kconfig
```kconfig
# Bluetooth HID over GATT Profile (HOGP)

# Copyright (c) 2026 Xiaomi Corporation
# SPDX-License-Identifier: Apache-2.0

menuconfig BT_HOGP_REPORT_HOST
	bool "HID over GATT Profile (HOGP) Report Host [EXPERIMENTAL]"
	depends on BT_CENTRAL
	depends on BT_GATT_CLIENT
	depends on BT_SMP
	select EXPERIMENTAL
	help
	  Enable part of the Report Host role of the HID over GATT Profile v1.2:
	  discover the HID Service of a HID Device, hand its Report Map and HID
	  Information to the application, subscribe to its Input Reports, and
	  read and write its Reports. The API documentation lists what is not
	  supported yet. The Boot Host role is not supported.

	  HOGP requires the Report Host to use the GAP Central role and to bond
	  with the HID Device.

if BT_HOGP_REPORT_HOST

config BT_HOGP_REPORT_HOST_MAX_REPORTS
	int "Number of Report characteristics of a HID Service"
	default 8
	range 1 255
	help
	  The discovery fails on a HID Device with more Report characteristics.
	  Each connection holds this many Report entries.

config BT_HOGP_REPORT_HOST_MAX_REPORT_LEN
	int "Maximum length of a Report read with bt_hogp_report_host_report_read()"
	default 64
	range 1 512
	help
	  A longer Report fails the read with -ENOMEM. Each connection holds a
	  buffer of this size. Input Report notifications do not use it.

endif # BT_HOGP_REPORT_HOST
```

## subsys/bluetooth/services/hids/Kconfig
```kconfig
# Bluetooth HID Service (HIDS)

# Copyright (c) 2026 Xiaomi Corporation
# SPDX-License-Identifier: Apache-2.0

menuconfig BT_HIDS
	bool "HID Service (HIDS) [EXPERIMENTAL]"
	depends on BT_GATT_DYNAMIC_DB
	select EXPERIMENTAL
	help
	  Enable the HID Service server. Provides a HID Service with a
	  configurable Report Map and Input, Output and Feature reports.

if BT_HIDS

choice BT_HIDS_SECURITY
	prompt "Security required by the HID Service characteristics"
	default BT_HIDS_SECURITY_ENCRYPT if BT_SMP
	help
	  Security level required to read, write and subscribe to the HID
	  Service characteristics. The HID Service sets no requirement of its
	  own. The HID over GATT Profile requires an encrypted link, so a HID
	  Device role implementation selects BT_HIDS_SECURITY_ENCRYPT or
	  BT_HIDS_SECURITY_AUTHEN.

config BT_HIDS_SECURITY_NONE
	bool "No requirements"

config BT_HIDS_SECURITY_ENCRYPT
	bool "Encryption required"
	depends on BT_SMP

config BT_HIDS_SECURITY_AUTHEN
	bool "Encryption and authentication required"
	depends on BT_SMP

endchoice # BT_HIDS_SECURITY

config BT_HIDS_INPUT_REPORT_COUNT
	int "Number of Input Report characteristics"
	default 1
	range 0 16
	help
	  Number of Input Report characteristics in the HID Service. The
	  application has to register exactly this many Input Reports.

config BT_HIDS_OUTPUT_REPORT_COUNT
	int "Number of Output Report characteristics"
	default 0
	range 0 16
	help
	  Number of Output Report characteristics in the HID Service. The
	  application has to register exactly this many Output Reports.

config BT_HIDS_FEATURE_REPORT_COUNT
	int "Number of Feature Report characteristics"
	default 0
	range 0 16
	help
	  Number of Feature Report characteristics in the HID Service. The
	  application has to register exactly this many Feature Reports.

config BT_HIDS_MAX_REPORT_LEN
	int "Maximum single report data length (bytes)"
	default 64
	range 8 256
	help
	  Maximum length of a single HID report data payload, in both
	  directions. It is the upper bound the service enforces on a Host write
	  before calling set_report, and on the value the application sets with
	  bt_hids_report_set(). One buffer of this size is held per Report
	  characteristic.

endif # BT_HIDS
```

## subsys/bluetooth/services/nus/Kconfig.nus
```kconfig
# Copyright (c) 2024 Croxel, Inc.
# SPDX-License-Identifier: Apache-2.0

menuconfig BT_ZEPHYR_NUS
	bool "GATT Nordic UART Service"

if BT_ZEPHYR_NUS

config BT_ZEPHYR_NUS_DEFAULT_INSTANCE
	bool "Use default NUS Service instance"
	default y if !UART_BT
	help
	  Enable default Nordic UART Service Instance. Allows using the NUS as
	  the other services, where the Service is hosted by the subsystem itself.
	  If the user wishes to declare NUS instances externally by using
	  BT_NUS_INST_DEFINE(), it may not be beneficial having an internal
	  instance as well.

config BT_ZEPHYR_NUS_AUTO_START_BLUETOOTH
	bool "Auto-enable Bluetooth stack and start LE advertisements"
	help
	  Auto-Enable the Bluetooth stack and start advertising with the NUS
	  UUID. Useful to run applications that inherently do not deal with
	  Bluetooth (e.g: Non-Bluetooth samples using UART over Bluetooth LE).

choice BT_ZEPHYR_NUS_SECURITY
	prompt "Security requirements"
	default BT_ZEPHYR_NUS_SECURITY_NONE
	help
	  Select security requirements for enabling notifications on the NUS TX
	  characteristic and for writing to the NUS RX characteristic. A peer
	  whose link does not meet them is refused those writes, and
	  notifications are not sent to it.

config BT_ZEPHYR_NUS_SECURITY_NONE
	bool "No requirements"

config BT_ZEPHYR_NUS_SECURITY_ENCRYPT
	bool "Encryption required"
	depends on BT_SMP

config BT_ZEPHYR_NUS_SECURITY_AUTHEN
	bool "Encryption and authentication required"
	depends on BT_SMP

endchoice

endif # BT_ZEPHYR_NUS
```

## subsys/bootmode/Kconfig
```kconfig
# Copyright (c) 2026, Nordic Semiconductor ASA
# SPDX-License-Identifier: Apache-2.0

DT_CHOSEN_Z_BOOT_MODE := zephyr,boot-mode

menuconfig BOOT_MODE
	bool "Boot mode"
	depends on $(dt_chosen_enabled,$(DT_CHOSEN_Z_BOOT_MODE))
	help
	  Adds a boot mode subsystem that allows for changing execution flow
	  depending upon the value of a boot mode parameter. Can be used for
	  e.g. entering a bootloader serial recovery mode.

	  The backend is selected by the compatible of the "zephyr,boot-mode"
	  chosen node.

if BOOT_MODE

# zephyr-keep-sorted-start
rsource "Kconfig.retention"
# zephyr-keep-sorted-stop

config BOOT_MODE_SHELL
	bool "Boot mode shell"
	depends on SHELL
	help
	  Adds the bootmode shell command to check, set and clear the boot mode.

endif # BOOT_MODE
```

## subsys/bootmode/Kconfig.retention
```kconfig
# Copyright (c) 2026 Nordic Semiconductor ASA
# SPDX-License-Identifier: Apache-2.0

DT_COMPAT_Z_RETENTION := zephyr,retention
DT_BOOT_MODE_IS_RETENTION := $(dt_chosen_has_compat,$(DT_CHOSEN_Z_BOOT_MODE),$(DT_COMPAT_Z_RETENTION))

config BOOT_MODE_RETENTION
	bool "Retention area backend"
	default y
	depends on $(DT_BOOT_MODE_IS_RETENTION) && RETENTION
	help
	  Store the boot mode in the retention area that the "zephyr,boot-mode"
	  chosen node points at. Any value from 0 to 255 is kept across a
	  reboot. The area needs at least 1 usable user byte.
```
