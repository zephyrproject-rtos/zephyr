## subsys/canbus/canopen/Kconfig
```kconfig
# SPDX-FileCopyrightText: Copyright (c) 2026 Linumiz
#
# SPDX-License-Identifier: Apache-2.0

menuconfig CANOPEN
	bool "CANopen protocol stack"
	depends on CAN
	select POLL
	help
	  Enable the native CANopen protocol stack (CiA 301).

if CANOPEN

module = CANOPEN
module-str = CANOPEN
source "subsys/logging/Kconfig.template.log_config"

config CANOPEN_THREAD_STACK_SIZE
	int "CANopen thread stack size"
	default 1024 if CAN_MCP2515 || CAN_MCP251XFD || CAN_TCAN4X5X || LOG_MODE_IMMEDIATE
	default 896
	help
	  Stack size of the thread running the protocol of a CANopen node. The thread also runs
	  the CAN driver's send and filter functions and the application callbacks, so SPI
	  attached CAN controllers and immediate logging get a larger default. Increase it for
	  application callbacks with large stack frames.

config CANOPEN_THREAD_PRIORITY
	int "CANopen thread priority"
	default 2
	help
	  Priority of the thread running the protocol of a CANopen node.

config CANOPEN_RX_QUEUE_SIZE
	int "CANopen receive queue size"
	default 8
	range 1 256
	help
	  Number of received CAN frames buffered per node before frames are dropped.

config CANOPEN_TX_QUEUE_SIZE
	int "CANopen transmit queue size"
	default 8
	range 1 256
	help
	  Number of CAN frames buffered per node while all CAN transmit mailboxes are busy.

config CANOPEN_SDO_BUFFER_SIZE
	int "SDO server buffer size"
	default 64
	range 8 65535
	help
	  Largest object dictionary value in bytes transferred by the SDO server.

config CANOPEN_SDO_SERVER_TIMEOUT_MS
	int "SDO server timeout in milliseconds"
	default 1000
	range 1 65535
	help
	  Time without a request from the SDO client after which a segmented transfer is aborted.

config CANOPEN_DEVICE_TYPE
	hex "Device type"
	default 0x0
	range 0x0 0xffffffff
	help
	  Value of object 1000h.

config CANOPEN_VENDOR_ID
	hex "Vendor-ID"
	default 0x0
	range 0x0 0xffffffff
	help
	  Value of object 1018h sub-index 1, assigned by CAN in Automation.

config CANOPEN_PRODUCT_CODE
	hex "Product code"
	default 0x0
	range 0x0 0xffffffff
	help
	  Value of object 1018h sub-index 2.

config CANOPEN_REVISION_NUMBER
	hex "Revision number"
	default 0x0
	range 0x0 0xffffffff
	help
	  Value of object 1018h sub-index 3.

config CANOPEN_DEVICE_NAME
	string "Manufacturer device name"
	default "Zephyr"
	help
	  Value of object 1008h. The object is omitted if the string is empty.

config CANOPEN_HW_VERSION
	string "Manufacturer hardware version"
	help
	  Value of object 1009h. The object is omitted if the string is empty.

config CANOPEN_SW_VERSION
	string "Manufacturer software version"
	help
	  Value of object 100Ah. The object is omitted if the string is empty.

config CANOPEN_HEARTBEAT_PRODUCER_MS
	int "Default producer heartbeat time in milliseconds"
	default 0
	range 0 65535
	help
	  Power-on value of object 1017h. 0 disables the heartbeat producer.

config CANOPEN_TIME
	bool "TIME producer and consumer"
	help
	  Provide the COB-ID time stamp object (1012h), the TIME consumer callback and
	  canopen_time_send(). The node consumes TIME messages on CAN-ID 100h after power-on; the
	  producer is enabled by setting bit 30 of 1012h.

config CANOPEN_TPDO_COUNT
	int "Number of TPDOs"
	default 4
	range 1 512
	help
	  Number of transmit PDOs of a CANopen node.

config CANOPEN_RPDO_COUNT
	int "Number of RPDOs"
	default 4
	range 1 512
	help
	  Number of receive PDOs of a CANopen node.

config CANOPEN_PDO_MAPPED_MAX
	int "Maximum number of objects mapped into a PDO"
	default 8
	range 1 64
	help
	  Number of mapping entries of each PDO mapping parameter object.

config CANOPEN_EMCY_HISTORY_SIZE
	int "Error history size"
	default 8
	range 1 254
	help
	  Number of entries of the pre-defined error field (1003h).

config CANOPEN_EMCY_ACTIVE_MAX
	int "Maximum number of active errors"
	default 8
	range 1 255
	help
	  Number of errors that can be active at the same time.

config CANOPEN_EMCY_QUEUE_SIZE
	int "Emergency message queue size"
	default 4
	range 1 255
	help
	  Number of emergency messages held back during the EMCY inhibit time (1015h) or while
	  the node is in NMT state Stopped. When the queue is full the oldest message is
	  dropped.

config CANOPEN_HB_CONSUMER_COUNT
	int "Number of heartbeat consumer entries"
	default 4
	range 1 127
	help
	  Number of entries of the consumer heartbeat time object (1016h). Each configured
	  entry uses one CAN RX filter.

endif # CANOPEN
```

## subsys/dap/Kconfig
```kconfig
# Copyright (c) 2018-2019 PHYTEC Messtechnik GmbH
# SPDX-License-Identifier: Apache-2.0

menuconfig DAP
	bool "Debug Access Port support [EXPERIMENTAL]"
	select EXPERIMENTAL
	select DP_DRIVER
	help
	  Debug Access Port support (currently CMSIS DAP only)

if DAP

config CMSIS_DAP_PACKET_COUNT
	int "Maximum packet buffers for request and response data."
	default 4
	range 1 $(UINT8_MAX)
	help
	  Maximum packet buffers for request and response data.

config CMSIS_DAP_SWJ_PINS_MAX_WAIT_MS
	int "Upper bound for the DAP_SWJ_Pins wait, in milliseconds"
	default 3000
	range 1 10000
	help
	  DAP_SWJ_Pins takes a 32-bit microsecond wait from the host, so a
	  conformant host may legally ask the probe to wait over an hour.
	  That wait is served on the thread that dispatches endpoint
	  completions, so for its whole duration no other USB function of
	  the device is serviced.

	  The default matches the ARM CMSIS-DAP reference implementation,
	  which caps this wait at 3 000 000 us in DAP.c. Composite devices
	  that share the transport with other functions should set it far
	  lower: a device buffering one 512-byte ring of a 115200-baud
	  stream loses data after about 44 ms of stall, and 40 ms measured
	  clean where 50 ms did not.

config CMSIS_DAP_PROBE_VENDOR
	string "Probe vendor"
	default "Zephyr"

config CMSIS_DAP_PROBE_NAME
	string "Probe name"
	default "CMSIS-DAP"

config CMSIS_DAP_BOARD_VENDOR
	string "Target board vendor"
	default ""

config CMSIS_DAP_BOARD_NAME
	string "Target board name"
	default ""

config CMSIS_DAP_DEVICE_VENDOR
	string "Target device vendor"
	default ""

config CMSIS_DAP_DEVICE_NAME
	string "Target device name"
	default ""

config DAP_BACKEND_USB
	bool "USB backend"
	depends on USB_DEVICE_STACK_NEXT
	help
	  DAP USB backend using bulk endpoints.

module = DAP
module-str = dap
source "subsys/logging/Kconfig.template.log_config"

endif # DAP
```

## subsys/debug/critical_section_monitor/Kconfig
```kconfig
# Copyright (c) Qualcomm Technologies, Inc. and/or its subsidiaries.
# SPDX-License-Identifier: Apache-2.0

menuconfig CRITICAL_SECTION_MONITOR
	bool "Critical section monitor"
	depends on SYSTEM_CLOCK_LOCK_FREE_COUNT
	depends on !SMP || ATOMIC_OPERATIONS_BUILTIN
	select CRITICAL_SECTION_HOOKS
	select NONZERO_SPINLOCK_SIZE
	help
	  Track the longest periods spent with interrupts locked and the
	  longest spinlock wait and hold times on each CPU.

	  The monitor records cycles, call site, associated spinlock, the
	  thread at interval start, and whether the code ran in an ISR.
	  It instruments the public interrupt locking APIs and the k_spin_lock()
	  family. Calls made directly to the architecture interrupt locking API
	  are not tracked. Use matching public or architecture IRQ lock/unlock
	  pairs; mixing them bypasses the monitor's interval boundaries.

	  Spinlocks need distinct addresses for tracking. On uniprocessor
	  builds without spinlock validation, this gives otherwise empty
	  spinlock objects a non-zero size.

	  Timing uses the system clock's 32-bit lock-free cycle counter.
	  Therefore, a single measured interval must be shorter than one
	  complete counter wrap.

	  SMP snapshots require compiler atomic builtins for payload accesses
	  and memory ordering.

if CRITICAL_SECTION_MONITOR

config CRITICAL_SECTION_MONITOR_MAX_SPINLOCKS
	int "Maximum simultaneously tracked spinlocks"
	range 1 16
	default 4
	help
	  Maximum number of spinlock hold intervals tracked on each CPU.
	  Tracking supports releases in any order. When all slots are in use,
	  further acquisitions increment an overflow counter and their hold
	  times are not recorded. Releasing a tracked lock frees a slot;
	  interrupt-locked and spinlock-wait measurements always continue.

endif # CRITICAL_SECTION_MONITOR
```

## subsys/disk/Kconfig
```kconfig
# Copyright (c) 2016 Intel Corporation
# SPDX-License-Identifier: Apache-2.0

config DISK_PARTITION
	bool "MBR/GPT partition table parsing"
	help
	  Transport-neutral layout scan (@ref disk_partition_walk): MBR, extended
	  logical partitions, and GPT. Does not identify filesystem types or
	  select mount targets. Enable when a block backend or adapter needs
	  partition descriptors from a sector read callback.

config DISK_ACCESS
	bool "Disk Interface"
	select DISK_DRIVERS
	help
	  Enable disk access over a supported media backend like FLASH or RAM

if DISK_ACCESS || DISK_PARTITION

module = DISK
module-str = disk
source "subsys/logging/Kconfig.template.log_config"

endif
```

## subsys/display_console/Kconfig
```kconfig
# SPDX-FileCopyrightText: 2026 Muhammad Waleed Badar
# SPDX-License-Identifier: Apache-2.0

menuconfig DISPLAY_CONSOLE
	bool "Text console on the chosen display"
	depends on DISPLAY
	depends on UART_EMUL
	help
	  Text console on the display selected by the zephyr,display chosen
	  node, showing the data transmitted by the zephyr,uart-emul device
	  selected by the zephyr,console chosen node, so that printk and the
	  logging subsystem appear on the display; selecting that UART as
	  zephyr,shell-uart as well puts the shell there too. The text is kept
	  in a grid of character cells and drawn by the selected renderer.

if DISPLAY_CONSOLE

module = DISPLAY_CONSOLE
module-str = display_console
source "subsys/logging/Kconfig.template.log_config"

config DISPLAY_CONSOLE_INIT_PRIORITY
	int "Init priority at which the console attaches to the UART"
	default 99
	help
	  Priority at the POST_KERNEL level at which the console takes over
	  the display. It must be greater than DISPLAY_INIT_PRIORITY.

config DISPLAY_CONSOLE_MAX_ROWS
	int "Maximum number of text rows"
	default 32
	help
	  Upper bound for the text grid; the display size and the font decide
	  the number of rows actually used.

config DISPLAY_CONSOLE_MAX_COLS
	int "Maximum number of text columns"
	default 64
	help
	  Upper bound for the text grid; the display size and the font decide
	  the number of columns actually used.

config DISPLAY_CONSOLE_FLUSH_DELAY_MS
	int "Delay before the display is redrawn"
	default 50
	help
	  Output is coalesced so that a burst of writes causes one redraw.
	  The display is updated at most this long after the last write.

config DISPLAY_CONSOLE_KBD
	bool "Keyboard input"
	default y
	depends on INPUT
	help
	  Queue the key events of every input device on the receive side of
	  the console UART as the bytes a terminal keyboard sends: the
	  characters of the US layout with the shift and control modifiers
	  applied, the control characters of Enter, Backspace, Tab and Escape,
	  and the escape sequences of the cursor and editing keys.

choice DISPLAY_CONSOLE_RENDERER
	prompt "Renderer"
	default DISPLAY_CONSOLE_RENDERER_CFB

config DISPLAY_CONSOLE_RENDERER_CFB
	bool "Character framebuffer font"
	select CHARACTER_FRAMEBUFFER
	select LOG_OUTPUT if LOG
	help
	  Draw the cells with a character framebuffer font, directly in the
	  pixel format the display is configured for. Monochrome, greyscale
	  and colour displays are supported. With logging enabled, fault
	  reports are drawn from the fatal error handler, which needs a
	  display driver that can write with interrupts locked.

config DISPLAY_CONSOLE_RENDERER_LVGL
	bool "LVGL text rendering"
	depends on LVGL
	select LV_Z_LVGL_MUTEX
	imply LV_Z_AUTO_INIT
	imply LV_Z_RUN_LVGL_ON_WORKQUEUE
	help
	  Draw the rows with the LVGL text renderer in the default LVGL font,
	  which must be monospaced, such as LV_FONT_DEFAULT_UNSCII_8, from the
	  draw event of the active screen.
	  No LVGL object is created per row, so the LVGL memory pool does not
	  grow with the size of the display. The rows appear once LVGL is
	  initialized, which must happen before the APPLICATION level init
	  priority DISPLAY_CONSOLE_LVGL_INIT_PRIORITY, as LV_Z_AUTO_INIT does.
	  They cannot be drawn from a fatal error handler.

endchoice

if DISPLAY_CONSOLE_RENDERER_CFB

config DISPLAY_CONSOLE_CFB_FONT_IDX
	int "Character framebuffer font index"
	default 0

config DISPLAY_CONSOLE_CFB_BUFFER_SIZE
	int "Pixel buffer size in bytes"
	default 2048
	help
	  Buffer used to render text before it is written to the display. It
	  must hold at least one character cell (font width x height x bytes
	  per pixel), or one full-width row of tiles on a monochrome display.
	  A larger buffer means fewer, larger display writes.

endif # DISPLAY_CONSOLE_RENDERER_CFB

if DISPLAY_CONSOLE_RENDERER_LVGL

config DISPLAY_CONSOLE_LVGL_INIT_PRIORITY
	int "Init priority at which the console is drawn on the LVGL screen"
	default 95
	help
	  Priority at the APPLICATION level, greater than LV_Z_INIT_PRIORITY,
	  at which the console starts drawing on the active LVGL screen and
	  the text written so far is drawn.

endif # DISPLAY_CONSOLE_RENDERER_LVGL

endif # DISPLAY_CONSOLE
```

## subsys/fs/Kconfig.virtual_fat
```kconfig
# Copyright (c) 2026 Leica Geosystems AG
# SPDX-License-Identifier: Apache-2.0

menuconfig VIRTUAL_FAT
	bool "Virtual FAT support"
	help
	  Enables Virtual FAT file system support (FAT12/FAT16).

if VIRTUAL_FAT

config FAT_SECTORS_PER_CLUSTER
	int "Sectors per cluster"
	default 4
	range 1 128
	help
	  Must be a power of two, and the resulting cluster size must not
	  exceed 32 KiB.

config VIRTUAL_FAT_DATE_DAY
	int "Last access day for root directory"
	default 1
	range 1 31

config VIRTUAL_FAT_DATE_MONTH
	int "Last access month for root directory"
	default 1
	range 1 12

config VIRTUAL_FAT_DATE_YEAR
	int "Last access year for root directory"
	default 2022
	range 1980 2107

module = VIRTUAL_FAT
module-str = virtual_fat
source "subsys/logging/Kconfig.template.log_config"

endif # VIRTUAL_FAT
```

## subsys/fs/fcb/Kconfig
```kconfig
# Flash Circular Buffer module

# Copyright (c) 2017-2023 Nordic Semiconductor ASA
# SPDX-License-Identifier: Apache-2.0

#
# Flash Circular Buffer
#

config FCB
	bool "Flash Circular Buffer support"
	depends on FLASH_MAP
	select CRC
	depends on FLASH_PAGE_LAYOUT
	help
	  Enable support of Flash Circular Buffer.

if FCB

config FCB_ALLOW_FIXED_ENDMARKER
	bool "Allow FCB instances to have a fixed endmarker"
	help
	  This allows the FCB instances to disable CRC checks in
	  favor of increased write throughput.

config FCB_ENDMARKER_NEVER_ERASED
	bool "Never use the erased value as an entry's end marker"
	help
	  The end marker of an entry is the CRC-8 of its length and data, written
	  after the data. When that CRC-8 equals the erased value of the flash,
	  a finished entry cannot be told from one whose write was cut short by
	  a power loss before its end marker was written: both read back as
	  valid, and the cut-short one hands half-written data to the reader.
	  With this option such a CRC-8 is written as its complement instead, so
	  an end marker that is still erased never validates an entry.

	  Entries written without this option whose CRC-8 is the erased value
	  (one in 256) read as invalid with it, so turn it on before data is
	  first written, or accept losing those entries once.

endif
```
