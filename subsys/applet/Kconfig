## subsys/fs/virtiofs/Kconfig
```kconfig
# Copyright (c) 2025 Antmicro <www.antmicro.com>
# SPDX-License-Identifier: Apache-2.0

config FILE_SYSTEM_VIRTIOFS
	bool "Virtiofs file system support"
	depends on FILE_SYSTEM
	select FUSE_CLIENT
	select VIRTIO
	help
	  Enable virtiofs file system support.

config VIRTIOFS_DEBUG
	bool "Print virtiofs verbose debug information"
	help
	  Enables printing of virtiofs verbose debug information

config VIRTIOFS_MAX_FILES
	int "Virtiofs max open files"
	default 1024
	help
	  Virtiofs max simultaneously open files

config VIRTIOFS_MAX_VQUEUE_SIZE
	int "Virtiofs max virtqueue size"
	default 1024
	help
	  Maximum size of virtqueue

config VIRTIOFS_ASYNC_FORGET_BUFFERS
	int "Virtiofs asynchronous FORGET buffers"
	default 8
	range 0 32
	help
	  Number of preallocated request buffers used to submit FUSE_FORGET
	  requests without waiting for their completion. FUSE_FORGET has no
	  reply, so the caller does not have to wait; the preallocated buffer
	  keeps the request valid while the device owns it. When the pool is
	  empty or the queue has no free descriptor, the driver falls back to
	  the synchronous path. Set to 0 to disable asynchronous FORGET
	  entirely.

config VIRTIOFS_READDIR_BUFSIZE
	int "Virtiofs READDIR response buffer size"
	default 1024
	range 512 4096
	help
	  Size in bytes of the per-directory buffer used to receive a
	  FUSE_READDIR response. A larger buffer lets a single request return
	  more directory entries. Must be a multiple of 8; the value must also
	  be large enough for a maximum-length directory entry.

config VIRTIOFS_READDIR_BUFFERS
	int "Virtiofs READDIR response buffers"
	default 4
	range 0 16
	help
	  Number of per-directory READDIR response buffers. Directories that
	  get a buffer batch directory entries; once the pool is exhausted the
	  driver falls back to one entry per request. The static RAM cost is
	  VIRTIOFS_READDIR_BUFSIZE * VIRTIOFS_READDIR_BUFFERS bytes.

config VIRTIOFS_NO_NOTIFICATION_QUEUE_SLOT
	bool "Omit notification queue (idx 1) and assume that idx 1 is the first request queue"
	default y
	help
	  According to virtio specification v1.3 section 5.11.2 queue at idx 1 is notification queue and
	  request queues start at idx 2, however on qemu+virtiofsd that's not true and idx 1 is
	  the first request queue

config VIRTIOFS_VIRTIOFSD_UNLINK_QUIRK
	bool "Fix unlink() with some virtiofsd versions"
	default y
	help
	  Some virtiofsd versions (at least Debian 1:7.2+dfsg-7+deb12u7)
	  will fail with EIO on unlink if the file wasn't looked up before

config VIRTIOFS_CREATE_MODE_VALUE
	int "Virtiofs mode value used during file/directory creation"
	default 438 #0666
	help
	  During creation of file or directory we have to set mode, this config allows
	  configuring that value. This determines access permissions for created files and directories.

module = VIRTIOFS
module-str = virtiofs
source "subsys/logging/Kconfig.template.log_config"
```

## subsys/instrumentation/Kconfig
```kconfig
# Copyright 2023 Linaro
# Copyright (c) 2026 Antmicro <www.antmicro.com>
# Copyright (c) 2026 Analog Devices
# SPDX-License-Identifier: Apache-2.0

# Instrumentation configuration options

config INSTRUMENTATION
	bool "Compiler Instrumentation Support"
	select REBOOT
	help
	  Enable compiler-managed runtime system instrumentation. This requires
	  a compiler that supports function instrumentation, and a backend for
	  capturing and processing those instrumentation events from the target,
	  like a serial port.

if INSTRUMENTATION

choice INSTRUMENTATION_BACKEND
	prompt "Instrumentation Data Backend"
	default INSTRUMENTATION_BACKEND_UART
endchoice

rsource "transport/Kconfig.uart"
rsource "transport/Kconfig.tracing"

config INSTRUMENTATION_MODE_CALLGRAPH
	bool "Call graph mode (Tracing)"
	default y
	select THREAD_NAME
	select TRACING
	select TIMING_FUNCTIONS
	help
	  Enables reconstruction of function call graphs and the observation
	  of context switches (threads), within the limits of the trace buffer
	  size.

config INSTRUMENTATION_MODE_STATISTICAL
	bool "Statistical mode (Profiling)"
	select TIMING_FUNCTIONS
	default y
	help
	  Enables statistical profiling of the runtime system, tracking total
	  execution time of the number of functions equal to
	  INSTRUMENTATION_MODE_STATISTICAL_MAX_NUM_FUNC.

config INSTRUMENTATION_MODE_STATISTICAL_MAX_NUM_FUNC
	int "Maximum number of functions to collect statistics from"
	depends on INSTRUMENTATION_MODE_STATISTICAL
	default 256
	range 1 4096
	help
	  Maximum number of functions to collect statistics from. Set the
	  maximum number of functions to collect the total execution time for
	  each function called in the region defined by 'trigger' and 'stopper'
	  instrumentation points.

config INSTRUMENTATION_MODE_STATISTICAL_MAX_CALL_DEPTH
	int "Maximum call depth"
	depends on INSTRUMENTATION_MODE_STATISTICAL
	default 65535
	range 1 65535
	help
	  The maximum number of times a function can be recursively called
	  before profile data (delta time) stops being collected.

config INSTRUMENTATION_TRIGGER_FUNCTION
	string "Default trigger function used to turn on instrumentation"
	default "main"
	help
	  Sets the trigger function. Instrumentation is only turned on when
	  this function is called.

config INSTRUMENTATION_STOPPER_FUNCTION
	string "Default stopper function used to turn off instrumentation"
	default "main"
	help
	  Sets the stopper function. Instrumentation is only turned off when
	  this function returns.

config INSTRUMENTATION_DYNAMIC_TRIGGER
	bool "Dynamic trigger/stopper functions configuration"
	select RETAINED_MEM
	select RETAINED_MEM_ZEPHYR_RAM
	select RETAINED_MEM_MUTEX_FORCE_DISABLE
	select RETENTION
	select RETENTION_MUTEX_FORCE_DISABLE
	default y
	depends on DT_HAS_ZEPHYR_RETAINED_RAM_ENABLED
	help
	  Enables configuration of trigger/stopper functions in runtime.
	  Enabling this option requires configuration of the 'instrumentation_triggers'
	  retained memory region in the device tree. When enabled, trigger/stopper
	  functions can be changed at runtime via the 'zaru' CLI tool.

config INSTRUMENTATION_EXCLUDE_FUNCTION_LIST
	string "Exclude function list"
	depends on INSTRUMENTATION_MODE_CALLGRAPH || INSTRUMENTATION_MODE_STATISTICAL
	help
	  Set the list of function names to be excluded from instrumentation.
	  The function name to be matched is its user-visible name. The match is
	  done on substrings: if the function name in the list is a substring of
	  a function name, it is considered to be a match. The function names in
	  the list are separate by a comma, for instance: sym0, sym1, ...

config INSTRUMENTATION_EXCLUDE_FILE_LIST
	string "Exclude file list"
	depends on INSTRUMENTATION_MODE_CALLGRAPH || INSTRUMENTATION_MODE_STATISTICAL
	help
	  Set the list of files that are excluded from instrumentation. The
	  match is done on substrings: if the file parameter is a substring of
	  the file name, it is considered to be a match. The files in the list
	  are separate by a comma, for instance: file0, file1, ...

config INSTRUMENTATION_CTF_TIMER
	bool "Use the same time measuring mechanism as in CTF events"
	help
	  Use timer based on kernel cycles to measure time - the same as for CTF events.
	  Otherwise, the time measurement API will be used.

choice TRACING_FORMAT_CHOICE
	default TRACING_CTF if INSTRUMENTATION_CTF_TIMER
endchoice

choice INSTRUMENTATION_CMD_OUTPUT
	prompt "Instrumentation Command Output Backend"
	default INSTR_CMD_OUT_STDOUT

config INSTR_CMD_OUT_STDOUT
	bool "Standard Output"
	help
	  Routes command responses to stdout.

config INSTR_CMD_OUT_DEDICATED_HW
	bool "Dedicated HW Channel"
	help
	  Routes command responses to a specific hardware interface
	  defined by the 'zephyr,instrumentation-uart' chosen node.

config INSTR_CMD_OUT_SILENT
	bool "Silent Mode"
	help
	  Disables all text responses from command handler.
endchoice

config INSTRUMENTATION_CTF_THREAD_NAME_LENGTH
	int "Expected CTF metadata thread name length"
	default 20
	help
	  Specifies the expected length of the thread name field in the
	  instrumentation metadata CTF. This MUST be updated when the length
	  of that field changes. This is only used for ensuring that
	  instrumentation outputs CTF traces compatible with the metadata file.

endif
```

## subsys/instrumentation/transport/Kconfig.tracing
```kconfig
# Copyright (c) 2026 Antmicro <www.antmicro.com>
# Copyright (c) 2026 Analog Devices
# SPDX-License-Identifier: Apache-2.0

choice INSTRUMENTATION_BACKEND

config INSTRUMENTATION_BACKEND_TRACING_CORE
	bool "Zephyr Tracing Core"
	select TRACING
	select INSTRUMENTATION_CTF_TIMER
	help
	  Instantly stream traces through Zephyr's global tracing
	  infrastructure.

endchoice
```

## subsys/instrumentation/transport/Kconfig.uart
```kconfig
# Copyright (c) 2026 Antmicro <www.antmicro.com>
# Copyright (c) 2026 Analog Devices
# SPDX-License-Identifier: Apache-2.0

choice INSTRUMENTATION_BACKEND

config INSTRUMENTATION_BACKEND_UART
	bool "Standalone RAM Buffer"
	select UART_INTERRUPT_DRIVEN
	help
	  Store traces in a local RAM ring-buffer managed by the instrumentation
	  subsystem. Data is extracted via manual dump commands over UART.

endchoice

if INSTRUMENTATION_BACKEND_UART

config INSTRUMENTATION_MODE_CALLGRAPH_TRACE_BUFFER_SIZE
	int "Size of the trace buffer (bytes)"
	depends on INSTRUMENTATION_MODE_CALLGRAPH
	default 12000
	# Lower limit (in bytes) must match the biggest record item size. For
	# details about the sizes, please see instrumentation.h for the record
	# struct sizes.
	range 20 4294967296
	help
	  Size of the trace buffer. The trace buffer is used to buffer the
	  tracing events and has two working modes: it can be configure either
	  as a simple buffer or as a ring buffer (overwriting mode).

choice INSTRUMENTATION_BUFFER_FULL_ACTION
	prompt "Choose an action done when buffer is full"
	depends on INSTRUMENTATION_MODE_CALLGRAPH
	default INSTRUMENTATION_MODE_CALLGRAPH_BUFFER_OVERWRITE
	optional
	help
	  Choice of a policy defining how to react to a full buffer,
	  if none is selected instrumentation will be disabled
	  when buffer is filled.

config INSTRUMENTATION_MODE_CALLGRAPH_BUFFER_OVERWRITE
	bool "Trace buffer overwriting mode"
	help
	  If the trace buffer is set as overwriting it works as a ring buffer.
	  In this working mode if the buffer gets full old records will be
	  overwritten by the newer records. This mode allows recording the most
	  recent tracing events at the expense of losing the old ones. If this
	  mode is not selected, then once the buffer is full tracing stops.

config INSTRUMENTATION_MODE_CALLGRAPH_DUMP_ON_FULL
	bool "Dump events when buffer is full"
	help
	  Instead of disabling instrumentation when a buffer is full, dump
	  its content via UART and empty the buffer. This allows to
	  continuously gather events without disabling instrumentation.
	  Currently the zaru script may not work properly when events are being
	  dumped, therefore it is suggested to use it after the application end.

endchoice

endif # INSTRUMENTATION_BACKEND_UART
```

## subsys/ipc/ipc_service/backends/Kconfig.link
```kconfig
# SPDX-FileCopyrightText: Copyright (c) 2026 Basalte bv
# SPDX-License-Identifier: Apache-2.0

menuconfig IPC_SERVICE_BACKEND_LINK
	bool "IPC link backend"
	select IPC_SERVICE_LINK
	help
	  IPC service backend over a transport that exchanges frames between
	  two processors. Selected by the transports.

if IPC_SERVICE_BACKEND_LINK

config IPC_SERVICE_BACKEND_LINK_INIT_PRIORITY
	int "Initialization priority"
	default 80
	help
	  Initialization priority of the link instances, after the UART, SPI
	  and GPIO drivers they use.

config IPC_SERVICE_BACKEND_LINK_NUM_EP
	int "Endpoints per instance"
	range 1 254
	default 8
	help
	  Number of endpoints an instance can register.

config IPC_SERVICE_BACKEND_LINK_EPT_NAME_MAX
	int "Longest endpoint name"
	range 1 64
	default 32
	help
	  Longest endpoint name in bytes, carried in the bind messages.

config IPC_SERVICE_BACKEND_LINK_RX_BUFFERS
	int "Receive buffers per instance"
	range 2 8
	default 3
	help
	  Frame buffers to receive into. One is always armed for the next
	  frame, the others hold received frames until their messages are
	  delivered and released: they are the credits given to the peer.
	  One less than this is also the number of payloads sent before the
	  first is acknowledged, as a peer configured alike has no credits
	  for more.

config IPC_SERVICE_BACKEND_LINK_MAX_RETRANSMITS
	int "Timeouts before the session ends"
	range 0 255
	default 10
	help
	  Timeouts in a row without an answer from the peer, while a
	  payload waits for its acknowledgment or for credits, before the
	  session ends, the endpoints are unbound and the link announces
	  its boot again. 0 keeps sending.

config IPC_SERVICE_BACKEND_LINK_WQ_ENABLE
	bool "Dedicated work queue"
	default y
	help
	  Call the endpoint callbacks from a work queue of the backend,
	  shared by all instances, rather than from the system work queue.

if IPC_SERVICE_BACKEND_LINK_WQ_ENABLE

config IPC_SERVICE_BACKEND_LINK_WQ_STACK_SIZE
	int "Work queue stack size"
	default 2048
	help
	  Stack of the work queue calling the endpoint callbacks.

config IPC_SERVICE_BACKEND_LINK_WQ_PRIORITY
	int "Work queue priority"
	default 2
	help
	  Priority of the work queue calling the endpoint callbacks.

endif # IPC_SERVICE_BACKEND_LINK_WQ_ENABLE

module = IPC_SERVICE_BACKEND_LINK
module-str = IPC link backend
module-help = Sets log level for the IPC link backend
source "subsys/logging/Kconfig.template.log_config"

endif # IPC_SERVICE_BACKEND_LINK
```

## subsys/ipc/ipc_service/lib/Kconfig.rpmsg
```kconfig
# SPDX-FileCopyrightText: Copyright (c) 2021 Carlo Caione <ccaione@baylibre.com>
# SPDX-FileCopyrightText: Copyright 2025-2026 Arm Limited and/or its affiliates
# SPDX-License-Identifier: Apache-2.0

config IPC_SERVICE_RPMSG_NUM_ENDPOINTS_PER_INSTANCE
	int "Max number of registered endpoints per instance"
	default IPC_SERVICE_BACKEND_RPMSG_NUM_ENDPOINTS_PER_INSTANCE if IPC_SERVICE_BACKEND_RPMSG
	default 2
	help
	  Maximum number of endpoints that can be registered for one RPMsg
	  library instance.
```

## subsys/jwt/Kconfig
```kconfig
# Copyright (c) 2018 Linaro
# Copyright (c) 2024 BayLibre SAS
# SPDX-License-Identifier: Apache-2.0

config JWT
	bool "JSON Web Token generation"
	select JSON_LIBRARY
	select PSA_CRYPTO
	help
	  Enable creation of JWT tokens
```
