## subsys/mgmt/mcumgr/transport/Kconfig.bluetooth
```kconfig
# Copyright Runtime.io 2018. All rights reserved.
# Copyright Nordic Semiconductor ASA 2020-2022. All rights reserved.
# SPDX-License-Identifier: Apache-2.0

# The Kconfig file is dedicated to Bluetooth transport of MCUmgr
# subsystem and provides Kconfig options to control aspects of
# the transport.
#
# Options defined in this file should be prefixed:
#  MCUMGR_TRANSPORT_BT_

menuconfig MCUMGR_TRANSPORT_BT
	bool "Bluetooth mcumgr SMP transport"
	depends on BT_PERIPHERAL
	help
	  Enables handling of SMP commands received over Bluetooth.

if MCUMGR_TRANSPORT_BT

config MCUMGR_TRANSPORT_BT_REASSEMBLY
	bool "Reassemble packets in Bluetooth SMP transport"
	select MCUMGR_TRANSPORT_REASSEMBLY
	help
	  When enabled, the SMP BT transport will buffer and reassemble received
	  packet fragments before passing it for further processing.

config MCUMGR_TRANSPORT_BT_AUTHEN
	bool "Authenticated requirement for Bluetooth mcumgr SMP transport"
	depends on BT_SMP
	default y
	help
	  Enables encrypted and authenticated connection requirement to
	  Bluetooth SMP transport.

config MCUMGR_TRANSPORT_BT_CONN_PARAM_CONTROL
	bool "Request specific connection parameters for SMP packet exchange"
	depends on SYSTEM_WORKQUEUE_PRIORITY < 0
	depends on BT_GAP_PERIPHERAL_PREF_PARAMS
	help
	  Enables support for requesting specific connection parameters when
	  SMP commands are handled. This option allows to speed up the command
	  exchange process.
	  Its recommended to enable this if SMP is used for DFU.

if MCUMGR_TRANSPORT_BT_CONN_PARAM_CONTROL

config MCUMGR_TRANSPORT_BT_CONN_PARAM_CONTROL_MIN_INT
	int "Minimum connection interval for SMP packet exchange"
	default 6
	range 6 3200
	help
	  Minimum connection interval in 1.25ms units used during the exchange of SMP packets.

config MCUMGR_TRANSPORT_BT_CONN_PARAM_CONTROL_MAX_INT
	int "Maximum connection interval for SMP packet exchange"
	default 9
	range MCUMGR_TRANSPORT_BT_CONN_PARAM_CONTROL_MIN_INT 3200
	help
	  Maximum connection interval in 1.25ms units used during the exchange of SMP packets.

config MCUMGR_TRANSPORT_BT_CONN_PARAM_CONTROL_LATENCY
	int "Peripheral latency for SMP packet exchange"
	default 0
	range 0 499
	help
	  Peripheral latency in Connection Intervals used during the exchange of SMP packets.

config MCUMGR_TRANSPORT_BT_CONN_PARAM_CONTROL_TIMEOUT
	int "Supervision timeout for SMP packet exchange"
	default 42
	range 10 3200
	help
	  Supervision timeout in 10ms used during the exchange of SMP packets.

config MCUMGR_TRANSPORT_BT_CONN_PARAM_CONTROL_RESTORE_TIME
	int "Connection parameters restore time in milliseconds"
	default 5000
	range 1000 65535
	help
	  The value is a time of inactivity on the SMP characteristic after which
	  connection parameters are restored to peripheral preferred values
	  (BT_GAP_PERIPHERAL_PREF_PARAMS).

config MCUMGR_TRANSPORT_BT_CONN_PARAM_CONTROL_RETRY_TIME
	int "Connection parameters update retry time in milliseconds"
	default 1000
	range 1 5000
	help
	  In case connection parameters update fails due to an error, this
	  option specifies the time of the next update attempt.

endif # MCUMGR_TRASNPORT_BT_CONN_PARAM_CONTROL

config MCUMGR_TRANSPORT_BT_DYNAMIC_SVC_REGISTRATION
	bool "Register SMP service at runtime"
	select BT_GATT_DYNAMIC_DB
	default y
	help
	  When enabled, the SMP service will be automatically registered at boot time
	  and can then be dynamically registered/unregistered using a dedicated API.
	  Otherwise, the SMP service will be statically defined and registered.

endif # MCUMGR_TRANSPORT_BT
```

## subsys/mgmt/mcumgr/transport/Kconfig.common
```kconfig
#
# Copyright (c) 2026, Nordic Semiconductor ASA
#
# SPDX-License-Identifier: Apache-2.0
#

menu "Common transport configuration"

config MCUMGR_TRANSPORT_SERIAL_HAS_SMP_OVER_CONSOLE
	bool
	help
	  Hidden Kconfig selected by transports that implement the SMP over console transport and
	  need this functionality to be available in the serial_util.c file.

config MCUMGR_TRANSPORT_SERIAL_HAS_RAW_BINARY_NON_SMP_OVER_CONSOLE
	bool
	help
	  Hidden Kconfig selected by transports that implement the raw binary non-SMP over console
	  serial transport and need this functionality to be available in the serial_util.c file.

if (MCUMGR_TRANSPORT_UART || MCUMGR_TRANSPORT_RAW_UART) && UART_ASYNC_API

menuconfig MCUMGR_TRANSPORT_UART_ASYNC
	bool "Use async UART API when available"
	help
	  The option enables use of UART async API when available for selected MCUmgr UART port.

if MCUMGR_TRANSPORT_UART_ASYNC

config MCUMGR_TRANSPORT_UART_ASYNC_BUFS
	int "Number of async RX UART buffers"
	range 2 8
	default 2
	help
	  The asynchronous UART API requires registering RX buffers for received data; when the RX
	  reaches the end of a buffer, it will send event requesting next buffer, to be able to
	  receive data without stopping due to running out of buffer space. At least two buffers
	  area required for smooth RX operation.

config MCUMGR_TRANSPORT_UART_ASYNC_BUF_SIZE
	int "Size of single async RX UART buffer"
	default 64
	help
	  The size of single buffer for asynchronous RX.

endif # MCUMGR_TRANSPORT_UART_ASYNC

endif # (MCUMGR_TRANSPORT_UART || MCUMGR_TRANSPORT_RAW_UART) && UART_ASYNC_API

endmenu
```

## subsys/mgmt/mcumgr/transport/Kconfig.dummy
```kconfig
# Copyright Laird Connectivity 2021. All rights reserved.
# Copyright Nordic Semiconductor ASA 2022. All rights reserved.
# SPDX-License-Identifier: Apache-2.0

# The Kconfig file is dedicated to Dummy transport of MCUmgr
# subsystem and provides Kconfig options to control aspects of
# the transport.
#
# Options defined in this file should be prefixed:
#  MCUMGR_TRANSPORT_DUMMY_

menuconfig MCUMGR_TRANSPORT_DUMMY
	bool "Dummy SMP backend"
	select BASE64
	help
	  Enables the dummy SMP backend which can be used for unit testing
	  SMP functionality without needing a real interface or driver.

if MCUMGR_TRANSPORT_DUMMY

config MCUMGR_TRANSPORT_DUMMY_RX_BUF_SIZE
	int "Size of receive buffer for dummy interface mcumgr fragments"
	default 128
	help
	  Specifies the size of the mcumgr dummy backend receive buffer,
	  in bytes. This value must be large enough to accommodate any
	  line sent by an mcumgr client.

endif # MCUMGR_TRANSPORT_DUMMY
```

## subsys/mgmt/mcumgr/transport/Kconfig.lorawan
```kconfig
#
# Copyright (c) 2024, Jamie McCrae
#
# SPDX-License-Identifier: Apache-2.0
#

# The Kconfig file is dedicated to the LoRaWAN transport of MCUmgr
# subsystem and provides Kconfig options to control aspects of
# the transport.
#
# Options defined in this file should be prefixed:
#  MCUMGR_TRANSPORT_LORAWAN_

menuconfig MCUMGR_TRANSPORT_LORAWAN
	bool "LoRaWAN MCUmgr SMP transport"
	depends on LORAWAN
	help
	  Enables handling of SMP commands received over LoRaWAN.

if MCUMGR_TRANSPORT_LORAWAN

config MCUMGR_TRANSPORT_LORAWAN_FRAME_PORT
	int "LoRaWAN SMP frame port"
	range 1 223
	default 2
	help
	  LoRaWAN download and uplink frame port used for communication. All messages received on
	  this port will be treated as SMP packets.

config MCUMGR_TRANSPORT_LORAWAN_CONFIRMED_UPLINKS
	bool "Use confirmed packets for uplinks"
	default y
	help
	  Will use confirmed uplink packets for responses if enabled, otherwise will use
	  unconfirmed packets.

config MCUMGR_TRANSPORT_LORAWAN_REASSEMBLY
	bool "Reassemble LoRaWAN SMP messages"
	select MCUMGR_TRANSPORT_REASSEMBLY
	default y
	help
	  Will reassemble downlink LoRaWAN messages together to allow for messages larger than a
	  single message to be received, otherwise will support messages up to a single packet in
	  size.

menuconfig MCUMGR_TRANSPORT_LORAWAN_POLL_FOR_DATA
	bool "Send empty packet if partial packet received"
	depends on MCUMGR_TRANSPORT_LORAWAN_REASSEMBLY
	default y
	help
	  Will send an empty packet if a partial (fragmented) message has been received from the
	  server, this will allow the next packet to be received without waiting for next
	  transmission window.

	  Note: this requires a dedicated thread in order to prevent blocking the system workqueue.

if MCUMGR_TRANSPORT_LORAWAN_POLL_FOR_DATA

config MCUMGR_TRANSPORT_LORAWAN_POLL_FOR_DATA_STACK_SIZE
	int "Poll thread stack size"
	default 1800
	help
	  Stack size of the thread that will poll for empty additional packets when a partial
	  frame is received.

config MCUMGR_TRANSPORT_LORAWAN_POLL_FOR_DATA_THREAD_PRIORITY
	int "Poll thread priority"
	default 3
	help
	  Priority of the thread for polling for empty additional packets when a partial frame
	  is received.

config MCUMGR_TRANSPORT_LORAWAN_POLL_FOR_DATA_RETRIES
	int "Poll thread retries"
	default 3
	help
	  Number of LoRaWAN message send retries if sending fails for the thread for polling for
	  empty additional packets when a partial frame is received.

endif # MCUMGR_TRANSPORT_LORAWAN_POLL_FOR_DATA

config MCUMGR_TRANSPORT_LORAWAN_FRAGMENTED_UPLINKS
	bool "Fragment uplink messages"
	default y
	help
	  Will fragment messages into multiple uplink messages if they are too big to fit into a
	  single uplink message. If disabled then uplinks that are too large will not be sent.

module = MCUMGR_TRANSPORT_LORAWAN
module-str = LoRaWAN MCUmgr SMP transport
source "subsys/logging/Kconfig.template.log_config"

endif # MCUMGR_TRANSPORT_LORAWAN
```

## subsys/mgmt/mcumgr/transport/Kconfig.raw_dummy
```kconfig
# Copyright Laird Connectivity 2021. All rights reserved.
# Copyright Nordic Semiconductor ASA 2022-2026. All rights reserved.
# SPDX-License-Identifier: Apache-2.0

# The Kconfig file is dedicated to Dummy transport of MCUmgr
# subsystem and provides Kconfig options to control aspects of
# the transport.
#
# Options defined in this file should be prefixed:
#  MCUMGR_TRANSPORT_RAW_DUMMY_

menuconfig MCUMGR_TRANSPORT_RAW_DUMMY
	bool "Dummy raw UART MCUmgr (non-SMP over console) backend"
	help
	  Enables the dummy MCUmgr UART backend which does not use SMP over console and does not
	  have base64 encoding over the data, which can be used for unit testing SMP
	  functionality without needing a real interface or driver.

if MCUMGR_TRANSPORT_RAW_DUMMY

config MCUMGR_TRANSPORT_RAW_DUMMY_RX_BUF_SIZE
	int "Size of receive buffer for dummy interface MCUmgr fragments"
	default 128
	help
	  Specifies the size of the raw MCUmgr dummy backend receive buffer, in bytes. This value
	  must be large enough to accommodate any line sent by an MCUmgr client.

endif # MCUMGR_TRANSPORT_RAW_DUMMY
```

## subsys/mgmt/mcumgr/transport/Kconfig.spi
```kconfig
#
# Copyright (c) 2026 Zephyr Project Contributors
#
# SPDX-License-Identifier: Apache-2.0
#

# The Kconfig file is dedicated to the SPI transport of the MCUmgr
# subsystem and provides Kconfig options to control aspects of
# the transport.
#
# Options defined in this file should be prefixed with:
#  MCUMGR_TRANSPORT_SPI_

menuconfig MCUMGR_TRANSPORT_SPI
	bool "SPI MCUmgr SMP transport"
	depends on MULTITHREADING
	depends on SPI_SLAVE && SPI && GPIO
	select SPI_ASYNC
	depends on DT_HAS_ZEPHYR_SMP_SPI_ENABLED
	select MCUMGR_TRANSPORT_REASSEMBLY
	help
	  Enables handling of SMP commands received over SPI. The device operates
	  as an SPI peripheral and exchanges raw SMP packets with the SPI
	  controller. A data-ready GPIO signals when a response is available for
	  the controller to read.

if MCUMGR_TRANSPORT_SPI

config MCUMGR_TRANSPORT_SPI_MTU
	int "SPI SMP MTU"
	range 8 MCUMGR_TRANSPORT_NETBUF_SIZE
	default 256
	help
	  Maximum size of a raw SMP chunk sent and received in one SPI
	  transaction, in bytes.
	  This value must satisfy the following relation:
	  MCUMGR_TRANSPORT_SPI_MTU <= MCUMGR_TRANSPORT_NETBUF_SIZE

module = MCUMGR_TRANSPORT_SPI
module-str = SPI MCUmgr SMP transport
source "subsys/logging/Kconfig.template.log_config"

endif # MCUMGR_TRANSPORT_SPI
```

## subsys/mgmt/mcumgr/transport/Kconfig.udp
```kconfig
# Copyright Runtime.io 2018. All rights reserved.
# Copyright Nordic Semiconductor ASA 2020-2022. All rights reserved.
# SPDX-License-Identifier: Apache-2.0

# The Kconfig file is dedicated to UDP transport of MCUmgr
# subsystem and provides Kconfig options to control aspects of
# the transport.
#
# Options defined in this file should be prefixed:
#  MCUMGR_TRANSPORT_UDP_

menuconfig MCUMGR_TRANSPORT_UDP
	bool "UDP mcumgr SMP transport"
	depends on NET_UDP
	depends on NET_SOCKETS
	select NET_CONNECTION_MANAGER
	help
	  Enables handling of SMP commands received over UDP.
	  Will start a thread for listening on the configured UDP port.

if MCUMGR_TRANSPORT_UDP

config MCUMGR_TRANSPORT_UDP_IPV4
	bool "UDP SMP using IPv4"
	depends on NET_IPV4
	default y
	help
	  Enable SMP UDP using IPv4 addressing.
	  Can be enabled alongside IPv6 addressing.

config MCUMGR_TRANSPORT_UDP_IPV6
	bool "UDP SMP using IPv6"
	depends on NET_IPV6
	help
	  Enable SMP UDP using IPv6 addressing.
	  Can be enabled alongside IPv4 addressing.

config MCUMGR_TRANSPORT_UDP_PORT
	int "UDP SMP port"
	default 1337
	help
	  UDP port that SMP server will listen for SMP commands on.

config MCUMGR_TRANSPORT_UDP_STACK_SIZE
	int "UDP SMP stack size"
	default 1024
	help
	  Stack size of the SMP UDP listening thread

config MCUMGR_TRANSPORT_UDP_THREAD_PRIO
	int "UDP SMP thread priority"
	default 0
	help
	  Scheduling priority of the SMP UDP listening thread.

config MCUMGR_TRANSPORT_UDP_MTU
	int "UDP SMP MTU"
	default 1500
	help
	  Maximum size of SMP frames sent and received over UDP, in bytes.
	  This value must satisfy the following relation:
	  MCUMGR_TRANSPORT_UDP_MTU <= MCUMGR_TRANSPORT_NETBUF_SIZE + SMP msg overhead - address size
	  where address size is determined by IPv4/IPv6 selection.

config MCUMGR_TRANSPORT_UDP_DTLS
	bool "DTLS"
	select MBEDTLS
	select MBEDTLS_ENABLE_HEAP
	select NET_SOCKETS_SOCKOPT_TLS
	select NET_SOCKETS_ENABLE_DTLS
	select TLS_CREDENTIALS
	help
	  Enable DTLS for UDP transport, this means normal non-authenticated connections will not
	  be supported and the transport will not be started automatically at boot-up, the
	  application will need to add the certificates to the system and set them up before
	  opening the transport using the `smp_udp_open` function.

config MCUMGR_TRANSPORT_UDP_DTLS_TLS_TAG
	int "TLS credential tag"
	default 1
	depends on MCUMGR_TRANSPORT_UDP_DTLS
	help
	  The TLS tag which the application must add the certificates to before starting the UDP
	  transport.

config MCUMGR_TRANSPORT_UDP_AUTOMATIC_INIT
	bool "UDP SMP autostart"
	default y
	depends on !MCUMGR_TRANSPORT_UDP_DTLS
	help
	  Enable starting the UDP SMP transport at boot time without needing
	  any code in the application to do this, otherwise will need the user
	  application to manually start and stop the transport using
	  `smp_udp_open` and `smp_udp_close`.

endif # MCUMGR_TRANSPORT_UDP
```

## subsys/mgmt/mcumgr/zephyr_grp/Kconfig
```kconfig
# Copyright (c) 2022 Nordic Semiconductor ASA
# SPDX-License-Identifier: Apache-2.0

menuconfig MCUMGR_GRP_ZEPHYR_BASIC
	bool "Zephyr specific basic group of commands"
	help
	  Enables mcumgr to processing of Zephyr specific groups.

if MCUMGR_GRP_ZEPHYR_BASIC
config MCUMGR_GRP_BASIC_CMD_STORAGE_ERASE
	bool "Storage erase command"
	help
	  Enables command that allows to erase storage partition.

module=MGMT_SETTINGS
module-dep=LOG
module-str=SETTINGS
source "subsys/logging/Kconfig.template.log_config"

endif
```
