## subsys/mgmt/osdp/Kconfig
```kconfig
#
# Copyright (c) 2020 Siddharth Chandrasekaran <siddharth@embedjournal.com>
#
# SPDX-License-Identifier: Apache-2.0
#

menuconfig OSDP
	bool "Open Supervised Device Protocol (OSDP) driver"
	select RING_BUFFER
	imply SERIAL_SUPPORT_INTERRUPT
	imply UART_INTERRUPT_DRIVEN
	imply UART_USE_RUNTIME_CONFIGURE
	select CRC
	help
	  Add support for Open Supervised Device Protocol (OSDP)

if OSDP

choice
	prompt "OSDP Mode of Operation"
	config OSDP_MODE_PD
		bool "Configure OSDP in Peripheral Device mode"
		help
		  Configure this device to operate as a PD (Peripheral Device)
	config OSDP_MODE_CP
		bool "Configure OSDP in Control Panel mode"
		help
		  Configure this device to operate as a CP (Control Panel)
endchoice

config OSDP_UART_BAUD_RATE
	int "OSDP UART baud rate"
	default 115200
	help
	  OSDP defines that baud rate can be either 9600 or 38400 or
	  115200.

config OSDP_LOG_LEVEL
	int "OSDP Logging Level"
	default 1
	help
	  Set the logging level for the OSDP driver

config OSDP_UART_BUFFER_LENGTH
	int "OSDP UART buffer length"
	default 256
	help
	  OSDP RX and TX buffer FIFO length.

config OSDP_THREAD_STACK_SIZE
	int "OSDP Thread stack size"
	default 1024
	help
	  Thread stack size for osdp refresh thread

config OSDP_PACKET_TRACE
	bool "Print bytes sent/received over OSDP to console"
	help
	  Prints bytes sent/received over OSDP to console for debugging.
	  LOG_HEXDUMP_DBG() is used to achieve this and can be very verbose.

config OSDP_SKIP_MARK_BYTE
	bool "Skip sending the initial marking byte (0xFF)"
	help
	  As per the OSDP specification, the first byte in the channel has
	  to be a MARK byte which is 0xFF. Since this is not stated in the
	  packet structure definition, some commercial CPs and PDs do not
	  handle the initial mark byte correctly. This option can be used to
	  completely disable sending/expecting a mark byte to work with
	  such non-conforming devices.

config OSDP_SC_ENABLED
	bool "OSDP Secure Channel"
	depends on CSPRNG_ENABLED
	default y
	select CRYPTO
	select CRYPTO_MBEDTLS_SHIM
	select MBEDTLS
	select MBEDTLS_CIPHER_CCM_ENABLED
	help
	  Secure the OSDP communication channel with encryption and mutual
	  authentication.

if OSDP_SC_ENABLED

config OSDP_SC_RETRY_WAIT_SEC
	int "Retry wait time in seconds after a Secure Channel error"
	default 600
	help
	  Time in seconds to wait after a secure channel failure, and before
	  retrying to establish it.

config OSDP_CRYPTO_DRV_NAME
	string "Crypto driver to use with OSDP"
	default "CRYPTO_MTLS"
	help
	  OSDP Secure Channel uses AES-128 to secure communication between
	  CP and PD. Provide an available crypto driver name here.

endif # OSDP_SC_ENABLED

if OSDP_MODE_PD
source "subsys/mgmt/osdp/Kconfig.pd"
endif

if OSDP_MODE_CP
source "subsys/mgmt/osdp/Kconfig.cp"
endif

endif # OSDP
```

## subsys/mgmt/osdp/Kconfig.pd
```kconfig
#
# Copyright (c) 2020 Siddharth Chandrasekaran <siddharth@embedjournal.com>
#
# SPDX-License-Identifier: Apache-2.0
#

# OSDP_NUM_CONNECTED_PD is used in CP mode. It is a constant set to 1 when
# operating as a PD.
config OSDP_NUM_CONNECTED_PD
	int
	default 1
	help
	  In PD mode, number of connected PDs is always 1 and cannot
	  be configured.

config OSDP_PD_COMMAND_QUEUE_SIZE
	int "OSDP Peripheral Device command queue size"
	default 16
	help
	  The number of commands that can be queued to a given PD. In CP mode,
	  the queue size is multiplied by number of connected PD so this can grow
	  very quickly.

config OSDP_PD_ADDRESS
	int "Peripheral Device Address"
	default 1
	range 1 126
	help
	  The 7 least significant bits represent the address of the PD to which
	  the message is directed, or the address of the PD sending the reply.
	  Address 0x7F is reserved as a broadcast address to which all PDs would
	  respond.

if OSDP_SC_ENABLED

config OSDP_PD_SCBK
	string "Secure Channel Base Key (SCBK)"
	default "NONE"
	help
	  Hexadecimal string representation of the 16 byte OSDP PD Secure
	  Channel Base Key. When this field is sent to "NONE", the PD is set to
	  "Install Mode". In this mode, the PD would allow a CP to setup a secure
	  channel with default SCBK. Once as secure channel is active with the
	  default key, the CP can send a KEYSET command to set new keys to the PD.
	  It is up to the user to make sure that the PD enters the "Install Mode"
	  only during provisioning time (controlled environment).

endif # OSDP_SC_ENABLED

menu "Peripheral Device ID Information"

config OSDP_PD_ID_VENDOR_CODE
	hex "PD Vendor Code"
	default 0x001A2B3C
	range 0 0x00FFFFFF
	help
	  IEEE assigned OUI. Least 24 bits are valid.

config OSDP_PD_ID_MODEL
	int "PD Product Model Number"
	default 1
	range 0 $(UINT8_MAX)
	help
	  Manufacturer's model number. Least 8 bits are valid.

config OSDP_PD_ID_VERSION
	int "PD Product Version"
	default 1
	range 0 $(UINT8_MAX)
	help
	  Manufacturer's version of this product. Least 8 bits are valid.

config OSDP_PD_ID_SERIAL_NUMBER
	hex "PD Serial Number"
	default 0xCAFEBABE
	range 0 0xFFFFFFFF
	help
	  A 4-byte serial number for the PD.

config OSDP_PD_ID_FIRMWARE_VERSION
	hex "PD Firmware Version"
	default 0x00010100
	range 0 0x00FFFFFF
	help
	  Firmware revision code.
	    - Bit 0-7  : build version number;
	    - Bit 8-15 : minor version number;
	    - Bit 16-23: major version number;

endmenu # "PD ID Information"

menu "OSDP PD Capabilities"

menu "Contact Status Monitoring"

config OSDP_PD_CAP_CONTACT_STATUS_MONITORING_COMP_LEVEL
	int "Compliance Level"
	default 0
	range 0 4
	help
	  Possible values:
	  - 01: PD monitors and reports the state of the circuit without any
	  supervision. The PD encodes the circuit status per its default
	  interpretation of contact state to active/inactive status.
	  - 02: Like 01, plus: The PD accepts configuration of the encoding of the
	  open/closed circuit status to the reported active/inactive status. (User
	  may configure each circuit as "normally closed" or "normally open".)
	  - 03: Like 02, plus: PD supports supervised monitoring. The operating mode
	  for each circuit is determined by configuration settings.
	  - 04: Like 03, plus: the PD supports custom End-Of-Line settings within
	  the Manufacturer's guidelines.

config OSDP_PD_CAP_CONTACT_STATUS_MONITORING_NUM_ITEMS
	int "Number of items"
	default 0
	help
	  The number of Inputs

endmenu # "Contact Status Monitoring"

menu "Output Control"

config OSDP_PD_CAP_OUTPUT_CONTROL_COMP_LEVEL
	int "Compliance Level"
	default 0
	range 0 4
	help
	  Possible values:
	  - 01: The PD is able to activate and deactivate the Output per direct
	  command from the CP.
	  - 02: Like 01, plus: The PD is able to accept configuration of the Output
	  driver to set the inactive state of the Output. The typical state of an
	  inactive Output is the state of the Output when no power is applied to the
	  PD and the output device (relay) is not energized. The inverted drive
	  setting causes the PD to energize the Output during the inactive state and
	  de-energize the Output during the active state. This feature allows the
	  support of "fail-safe/fail-secure" operating modes.
	  - 03: Like 01, plus: The PD is able to accept timed commands to the
	  Output. A timed command specifies the state of the Output for the
	  specified duration.
	  - 04: Like 02 and 03 - normal/inverted drive and timed operation.

config OSDP_PD_CAP_OUTPUT_CONTROL_NUM_ITEMS
	int "Number of items"
	default 0
	help
	  The number of Outputs.

endmenu # "Output Control"

menu "LED Control"

config OSDP_PD_CAP_READER_LED_CONTROL_COMP_LEVEL
	int "Compliance Level"
	default 0
	range 0 4
	help
	  Possible values:
	  - 01: the PD support on/off control only
	  - 02: the PD supports timed commands
	  - 03: like 02, plus bi-color LEDs
	  - 04: like 02, plus tri-color LEDs

config OSDP_PD_CAP_READER_LED_CONTROL_NUM_ITEMS
	int "Number of items"
	default 0
	help
	  The number of LEDs per reader.

endmenu # "LED Control"

menu "Audible Output"

config OSDP_PD_CAP_READER_AUDIBLE_OUTPUT_COMP_LEVEL
	int "Compliance Level"
	default 0
	range 0 2
	help
	  Possible values:
	  - 01: the PD support on/off control only
	  - 02: the PD supports timed commands

config OSDP_PD_CAP_READER_AUDIBLE_OUTPUT_NUM_ITEMS
	int "Number of items"
	default 0
	help
	  The number of audible annunciators per reader

endmenu # "Audible Output"

menu "Text Output"

config OSDP_PD_CAP_READER_TEXT_OUTPUT_COMP_LEVEL
	int "Compliance Level"
	default 0
	range 0 4
	help
	  Possible values:
	  - 00: The PD has no text display support
	  - 01: The PD supports 1 row of 16 characters
	  - 02: the PD supports 2 rows of 16 characters
	  - 03: the PD supports 4 rows of 16 characters
	  - 04: TBD.

config OSDP_PD_CAP_READER_TEXT_OUTPUT_NUM_ITEMS
	int "Number of items"
	default 0
	help
	  Number of textual displays per reader

endmenu # "Text Output"

menu "Card Data Format"

config OSDP_PD_CAP_CARD_DATA_FORMAT_COMP_LEVEL
	int "Compliance Level"
	default 0
	range 0 3
	help
	  Possible values:
	  - 01: the PD sends card data to the CP as array of bits, not exceeding
	  1024 bits.
	  - 02: the PD sends card data to the CP as array of BCD characters, not
	  exceeding 256 characters.
	  - 03: the PD can send card data to the CP as array of bits, or as an
	  array of BCD characters.

endmenu # "Card Data Format"

menu "Time Keeping"

config OSDP_PD_CAP_TIME_KEEPING_COMP_LEVEL
	int "Compliance Level"
	default 0
	range 0 2
	help
	  Possible values:
	  - 00: The PD does not support time/date functionality
	  - 01: The PD understands time/date settings per Command osdp_TDSET
	  - 02: The PD is able to locally update the time and date

endmenu # "Time Keeping"

endmenu # "OSDP PD Capabilities"
```

## subsys/mgmt/updatehub/Kconfig
```kconfig
# Copyright (c) 2018-2023 O.S.Systems
# SPDX-License-Identifier: Apache-2.0

menuconfig UPDATEHUB
	bool "UpdateHub Firmware Over-the-Air support"
	depends on FLASH
	depends on REBOOT
	depends on IMG_MANAGER
	depends on BOOTLOADER_MCUBOOT
	depends on NETWORKING
	depends on NET_UDP
	depends on NET_SOCKETS
	depends on COAP
	depends on DNS_RESOLVER
	depends on JSON_LIBRARY
	depends on HWINFO
	select REQUIRES_FULL_LIBC
	select IMG_ENABLE_IMAGE_CHECK
	select MPU_ALLOW_FLASH_WRITE
	select MBEDTLS if !BUILD_WITH_TFM
	select MBEDTLS_SHA256 if !PSA_CRYPTO_CLIENT
	help
	  UpdateHub is an enterprise-grade solution which makes simple to
	  remotely update all your embedded devices in the field. It
	  handles all aspects related to sending Firmware Over-the-Air
	  (FOTA) updates with maximum security and efficiency, while you
	  focus in adding value to your product.

if UPDATEHUB
config UPDATEHUB_POLL_INTERVAL
	int "Time to poll interval (in minutes)"
	default 1440
	range 0 43200
	help
	  Set the interval that the UpdateHub update server will be polled.
	  This time interval is zero and 43200 minutes(30 days).

config UPDATEHUB_PRODUCT_UID
	string "Product Unique Identifier (UID)"
	help
	  The product unique identifier is used when communicating
	  with the UpdateHub server.

config UPDATEHUB_SUPPORTED_HARDWARE_MAX
	int "Max number of supported hardware"
	default 1
	range 1 100
	help
	  Configure the max number of supported hardware
	  by the same image.

config UPDATEHUB_CE
	bool "Use UpdateHub Community Edition Sever"
	help
	  Allow the use of UpdateHub Community
	  Server (updatehub-ce) as alternative to the
	  updatehub.io enterprise server.

config UPDATEHUB_SERVER
	string "User address for the updatehub-ce-server"
	depends on UPDATEHUB_CE
	help
	  This configuration is default, if need to use
	  other address, must be set on the UpdateHub shell

config UPDATEHUB_SHELL
	bool "UpdateHub shell utilities"
	depends on SHELL
	select KERNEL_SHELL
	help
	  Activate shell module that provides UpdateHub commands like

config UPDATEHUB_DTLS
	bool "Activate communication CoAPS/DTLS"
	select MBEDTLS
	select MBEDTLS_ENABLE_HEAP
	select NET_SOCKETS_SOCKOPT_TLS
	select NET_SOCKETS_ENABLE_DTLS
	help
	  Enables DTLS communication between the UpdateHub
	  client and the server

config UPDATEHUB_COAP_CONN_TIMEOUT
	int "CoAP connection timeout in seconds"
	default 10
	range 1 360
	help
	  Set the CoAP connection timeout value.

config UPDATEHUB_COAP_MAX_RETRY
	int "Maximum retries attempts to download a packet"
	default 10
	range 3 10
	help
	  Set the maximum number of retries attempts to download a packet
	  before abort a current update.

config UPDATEHUB_COAP_BLOCK_SIZE_EXP
	int "Max CoAP block size defined as 2^(4 + EXP)"
	default 6
	range 0 6
	help
	  Configure the max size of a data payload were value:
	    0 - COAP_BLOCK_16
	    1 - COAP_BLOCK_32
	    2 - COAP_BLOCK_64
	    3 - COAP_BLOCK_128
	    4 - COAP_BLOCK_256
	    5 - COAP_BLOCK_512
	    6 - COAP_BLOCK_1024

	  This value is mapped directly to enum coap_block_size.

choice
	prompt "Firmware verification"
	default UPDATEHUB_DOWNLOAD_STORAGE_SHA256_VERIFICATION

config UPDATEHUB_DOWNLOAD_SHA256_VERIFICATION
	bool "SHA-256 on download"
	help
	  Enables SHA-256 verification of data stream while downloading.
	  Notice that it does not check whether the image written to a
	  storage is still valid, it only confirms that what has been
	  downloaded matches the server side SHA.

	  To check if the data written to permanent storage matches the SHA
	  simultaneously, enable "Both download and flash verifications"
	  option.

config UPDATEHUB_STORAGE_SHA256_VERIFICATION
	bool "SHA-256 from flash"
	help
	  Enables SHA-256 verification of stored data stream.  When this
	  option is enabled, the data stream will be read back from the
	  storage and verified with SHA to make sure that it has been
	  correctly written.

	  To check if the download data stream matches the SHA simultaneously,
	  enable "Both download and flash verifications" option.

config UPDATEHUB_DOWNLOAD_STORAGE_SHA256_VERIFICATION
	bool "SHA-256 from both download and flash"
	help
	  Enables SHA-256 verification on both data stream while downloading
	  and stored data stream on flash.

	  It is advised to leave this option enabled.

endchoice

module = UPDATEHUB
module-str = Log level for UpdateHub
module-help = Enables logging for UpdateHub code.
source "subsys/logging/Kconfig.template.log_config"

endif
```
