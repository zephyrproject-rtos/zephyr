## subsys/mgmt/mcumgr/lib/cmd/shell_mgmt/Kconfig
```kconfig
# Copyright Runtime.io 2018. All rights reserved.
# Copyright Nordic Semiconductor ASA 2020-2022. All rights reserved.
# SPDX-License-Identifier: Apache-2.0

config MCUMGR_CMD_SHELL_MGMT
	bool "Mcumgr handlers for shell management"
	depends on SHELL
	select SHELL_BACKEND_DUMMY
	select MGMT_MIN_DECODING_LEVEL_2
	help
	  Enables mcumgr handlers for shell management. The handler will utilize
	  the dummy backend to execute shell commands and capture the output to
	  an internal memory buffer. This way, there is no interaction with
	  physical interfaces outside of the scope of the user.
	  It is possible to use additional shell backends in coordination
	  with this handler and they will not interfere.
	  The SHELL_BACKEND_DUMMY_BUF_SIZE will affect how many characters
	  will be returned from command output, if your output gets cut, then
	  increase the value. Remember to set MCUMGR_BUF_SIZE accordingly.
	  Note that maximum length of shell command accepted is regulated by
	  the CONFIG_SHELL_CMD_BUFF_SIZE, and a buffer for a command is allocated
	  on a stack, by the mcumgr, so enabling MCUMGR_CMD_SHELL_MGMT and
	  changes to the CONFIG_SHELL_CMD_BUFF_SIZE may increase stack size
	  requirements.
```

## subsys/mgmt/mcumgr/lib/cmd/stat_mgmt/Kconfig
```kconfig
# Copyright Runtime.io 2018. All rights reserved.
# Copyright Nordic Semiconductor ASA 2020-2022. All rights reserved.
# SPDX-License-Identifier: Apache-2.0

menuconfig MCUMGR_CMD_STAT_MGMT
	bool "Mcumgr handlers for statistics management"
	depends on STATS
	select MGMT_MIN_DECODING_LEVEL_2
	help
	  Enables mcumgr handlers for statistics management.

config STAT_MGMT_MAX_NAME_LEN
	int "Maximum stat group name length"
	default 32
	depends on MCUMGR_CMD_STAT_MGMT
	help
	  Limits the maximum stat group name length in mcumgr requests, in bytes.
	  A buffer of this size gets allocated on the stack during handling of all
	  stat read commands.  If a stat group's name exceeds this limit, it will
	  be impossible to retrieve its values with a stat show command.
```

## subsys/mgmt/mcumgr/lib/transport/Kconfig
```kconfig
# Copyright Runtime.io 2018. All rights reserved.
# Copyright Nordic Semiconductor ASA 2020-2022. All rights reserved.
# SPDX-License-Identifier: Apache-2.0

config MCUMGR_SMP_REASSEMBLY
	bool
	help
	  Enable structures and functions needed for packet reassembly by SMP backend.

config MCUMGR_BUF_COUNT
	int "Number of mcumgr buffers"
	default 2 if MCUMGR_SMP_UDP
	default 4
	help
	  The number of net_bufs to allocate for mcumgr.  These buffers are
	  used for both requests and responses.

config MCUMGR_BUF_SIZE
	int "Size of each mcumgr buffer"
	default 2048 if MCUMGR_SMP_UDP
	default 384
	help
	  The size, in bytes, of each mcumgr buffer.  This value must satisfy
	  the following relation:
	  MCUMGR_BUF_SIZE >= transport-specific-MTU + transport-overhead
	  In case when MCUMGR_SMP_SHELL is enabled this value should be set to
	  at least SHELL_BACKEND_DUMMY_BUF_SIZE + 32.

config MCUMGR_BUF_USER_DATA_SIZE
	int "Size of mcumgr buffer user data"
	default 24 if MCUMGR_SMP_UDP && MCUMGR_SMP_UDP_IPV6
	default 8 if MCUMGR_SMP_UDP && MCUMGR_SMP_UDP_IPV4
	default 4
	help
	  The size, in bytes, of user data to allocate for each mcumgr buffer.

	  Different mcumgr transports impose different requirements for this
	  setting. A value of 4 is sufficient for UART, shell, and bluetooth.
	  For UDP, the userdata must be large enough to hold a IPv4/IPv6 address.

rsource "Kconfig.dummy"

rsource "Kconfig.bluetooth"

rsource "Kconfig.shell"

rsource "Kconfig.uart"

rsource "Kconfig.udp"
```

## subsys/mgmt/mcumgr/mgmt/Kconfig
```kconfig
# Copyright Runtime.io 2018. All rights reserved.
# Copyright Nordic Semiconductor ASA 2020-2022. All rights reserved.
# SPDX-License-Identifier: Apache-2.0

# The Kconfig is dedicated to mgmt subsystem of MCUmgr. Kconfig options defined
# here affect behaviour of services provided by source code of mcumgr/mgmt/
# directory, like management group registration or overall hooks support.
#
# All Kconfig options defined with this file should begin with prefix:
#  MCUMGR_MGMT_

config MCUMGR_MGMT_NOTIFICATION_HOOKS
	bool "MCUmgr notification hook support"
	help
	  With this enabled, applications and parts of code can register for MCUmgr event
	  notifications which will result in callbacks when a registered event occurs. Note that
	  this enables the base notification functionality but itself does not enable any
	  notifications, which must be enabled by selecting other Kconfig options.

	  To enable notifications in code, mgmt_callback_register() must be called with the
	  callback function and events that want to be received. Multiple handlers can be
	  registered and will all be called when registered events occur.

	  Some callbacks support notifying the calling function of a status, in which to accept
	  or decline the current operation, by returning false this will signal to the calling
	  function that the request should be denied, for informal-only notifications or
	  acceptable, true must be returned by all the registered notification handlers.

config MCUMGR_MGMT_HANDLER_USER_DATA
	bool "MCUmgr mgmt handler user data support"
	help
	  This will add an extra field to the struct mgmt_handler that will allow a user
	  to pass user_data when the defined handler is called.

config MCUMGR_MGMT_CUSTOM_PAYLOAD
	bool "MCUmgr custom payload"
	help
	  When this config is enabled, a user can use the field `custom_payload` in `mgmt_handler` to
	  skip the generation of the cbor start- and end byte in `smp_handle_single_payload` and
	  instead use a user defined payload in SMP messages.
```

## subsys/mgmt/mcumgr/smp/Kconfig
```kconfig
# Copyright Runtime.io 2018. All rights reserved.
# Copyright Nordic Semiconductor ASA 2020-2022. All rights reserved.
# SPDX-License-Identifier: Apache-2.0

# The Kconfig file is dedicated to smp subdirectory of MCUmgr
# subsystem and provides Kconfig options to control aspects of
# Simple Management Protocol (SMP) processing source code provided
# under the subdirectory.
#
# Options defined in this file should be prefixed:
#  MCUMGR_SMP_ -- for general SMP options;
#  MCUMGR_SMP_CBOR -- for CBOR encoding specific options;

config MCUMGR_SMP_CBOR_MAX_MAIN_MAP_ENTRIES
	int "Number of predicted maximum entries to main response map"
	default 15
	help
	  This is number of predicted entries in main response map,
	  the one that encapsulates everything within response.
	  This value is used by zcbor to predict needed map encoding,
	  and does not affect memory allocation or usage.
	  Builtin command processors rarely add large amounts of
	  data directly to main map, creating sub-maps instead so
	  the default value works fine with them.
	  If your app directly adds fields to main map, without
	  encapsulating them, you may want to increase this value
	  in case when encoding starts to fail.

config MCUMGR_SMP_CBOR_MIN_DECODING_LEVELS
	int
	help
	  Minimal decoding levels, map/list encapsulation, required
	  to be supported by zcbor decoding of SMP responses
	  is auto genereated from MCUMGR_SMP_CBOR_MIN_DECODING_LEVEL_? options.
	  A group or command that adds additional maps/lists above the
	  base map, which is already taken into account, should
	  select one of the MCUMGR_SMP_CBOR_MIN_DECODING_LEVEL_?.
	default 7 if MCUMGR_SMP_CBOR_MIN_DECODING_LEVEL_7
	default 6 if MCUMGR_SMP_CBOR_MIN_DECODING_LEVEL_6
	default 5 if MCUMGR_SMP_CBOR_MIN_DECODING_LEVEL_5
	default 4 if MCUMGR_SMP_CBOR_MIN_DECODING_LEVEL_4
	default 3 if MCUMGR_SMP_CBOR_MIN_DECODING_LEVEL_3
	default 2 if MCUMGR_SMP_CBOR_MIN_DECODING_LEVEL_2
	default 1 if MCUMGR_SMP_CBOR_MIN_DECODING_LEVEL_1
	default 0

config MCUMGR_SMP_CBOR_MIN_DECODING_LEVEL_1
	bool

config MCUMGR_SMP_CBOR_MIN_DECODING_LEVEL_2
	bool

config MCUMGR_SMP_CBOR_MIN_DECODING_LEVEL_3
	bool

config MCUMGR_SMP_CBOR_MIN_DECODING_LEVEL_4
	bool

config MCUMGR_SMP_CBOR_MIN_DECODING_LEVEL_5
	bool

config MCUMGR_SMP_CBOR_MIN_DECODING_LEVEL_6
	bool

config MCUMGR_SMP_CBOR_MIN_DECODING_LEVEL_7
	bool

config MCUMGR_SMP_CBOR_MAX_DECODING_LEVELS
	int "Number of map/list encapsulations allowed for SMP decoding"
	range MCUMGR_SMP_CBOR_MIN_DECODING_LEVELS 15
	default MCUMGR_SMP_CBOR_MIN_DECODING_LEVELS
	help
	  This is a maximum number of levels of maps/lists that will
	  be expected to be decoded within different command groups.
	  SMP commands/groups that provide no CBOR encoded payload
	  have no requirements.
	  Commands that provide CBOR payload require at least 1 level,
	  and additional levels for each map/list encapsulation.
	  For example if command accepts payload of map of parameters
	  it will need 2 levels.
	  This number translates to zcbor backup states, it increases
	  size of cbor_nb_reader structure by zcbor_state_t size per
	  one unit selected here.

config MCUMGR_SMP_CBOR_MIN_ENCODING_LEVELS
	int
	help
	  Minimal encoding levels, map/list encapsulation, required
	  to be supported by zcbor encoding of SMP responses
	  is auto genereated from MCUMGR_SMP_CBOR_MIN_ENCODING_LEVEL_? options.
	  A group or command that adds additional maps/lists above the
	  base map, which is already taken into account, should
	  select one of the MCUMGR_SMP_CBOR_MIN_ENCODING_LEVEL_?.
	default 7 if MCUMGR_SMP_CBOR_MIN_ENCODING_LEVEL_7
	default 6 if MCUMGR_SMP_CBOR_MIN_ENCODING_LEVEL_6
	default 5 if MCUMGR_SMP_CBOR_MIN_ENCODING_LEVEL_5
	default 4 if MCUMGR_SMP_CBOR_MIN_ENCODING_LEVEL_4
	default 3 if MCUMGR_SMP_CBOR_MIN_ENCODING_LEVEL_3
	default 2 if MCUMGR_SMP_CBOR_MIN_ENCODING_LEVEL_2
	default 1 if MCUMGR_SMP_CBOR_MIN_ENCODING_LEVEL_1 || ZCBOR_CANONICAL
	default 0

config MCUMGR_SMP_CBOR_MIN_ENCODING_LEVEL_1
	bool

config MCUMGR_SMP_CBOR_MIN_ENCODING_LEVEL_2
	bool

config MCUMGR_SMP_CBOR_MIN_ENCODING_LEVEL_3
	bool

config MCUMGR_SMP_CBOR_MIN_ENCODING_LEVEL_4
	bool

config MCUMGR_SMP_CBOR_MIN_ENCODING_LEVEL_5
	bool

config MCUMGR_SMP_CBOR_MIN_ENCODING_LEVEL_6
	bool

config MCUMGR_SMP_CBOR_MIN_ENCODING_LEVEL_7
	bool

config MCUMGR_SMP_CBOR_MAX_ENCODING_LEVELS
	int "Number of map/list encapsulations allowed for SMP encoding"
	range MCUMGR_SMP_CBOR_MIN_ENCODING_LEVELS 15
	default MCUMGR_SMP_CBOR_MIN_ENCODING_LEVELS
	help
	  This is a maximum number of levels of maps/lists that will
	  be encoded within different comm&& groups.
	  This number translates to zcbor backup states, it increases
	  size of cbor_nb_writer structure by zcbor_state_t size per
	  one unit selected here.

config MCUMGR_SMP_COMMAND_STATUS_HOOKS
	bool "SMP command status hooks"
	depends on MCUMGR_MGMT_NOTIFICATION_HOOKS
	help
	  This will enable SMP command status notification hooks for when an SMP message is
	  received or processed.

config MCUMGR_SMP_SUPPORT_ORIGINAL_PROTOCOL
	bool "Support original protocol"
	default y
	help
	  This option will enable supporting the original SMP protocol whereby
	  all errors are returned in the "rc" field as well as the new protocol
	  whereby there is a dedicated entry for command error/result codes.
	  The protocol selection is indicated by the request header sent by the
	  client.

config MCUMGR_SMP_VERBOSE_ERR_RESPONSE
	bool "Support verbose error response"
	depends on MCUMGR_SMP_SUPPORT_ORIGINAL_PROTOCOL
	help
	  Support for encoding "rc" code explanation in form of "rsn"
	  text string.  This is useful, when returning MGMT_ERR_EUNKNOWN,
	  to add additional information on the source of an error.
	  Note that the "rsn" is string additional to "rc" code,
	  so MCUMGR_TRANSPORT_NETBUF_SIZE should be large enough to be able
	  to encode both.
```

## subsys/mgmt/mcumgr/smp_client/Kconfig
```kconfig
# Copyright Nordic Semiconductor ASA 2023. All rights reserved.
# SPDX-License-Identifier: Apache-2.0

# The Kconfig file is dedicated to smp_client subdirectory of MCUmgr
# subsystem and provides Kconfig options to control aspects of
# Simple Management Protocol Client (SMP) processing source code provided
# under the subdirectory.

config SMP_CLIENT
	bool "SMP Client support"
	help
	  This will enable SMP Request generation and response handling.

if SMP_CLIENT || ZTEST

config SMP_CMD_DEFAULT_LIFE_TIME
	int "SMP command lifetime in seconds"
	range 2 30
	default 5
	help
	  This define lifetime for SMP client send request. This configure is used if a request
	  with a timeout of 0 is used.

config SMP_CMD_RETRY_TIME
	int "SMP command re-send period in ms"
	range 100 1000
	default 500
	help
	  The time (in ms) which the SMP client will wait for a response before re-sending
	  a command.

config SMP_CLIENT_CMD_MAX
	int "SMP client max buffer count"
	default 4
	help
	  Define how many active requests that the client can handle

module = MCUMGR_SMP_CLIENT
module-str = mcumgr_smp_client
source "subsys/logging/Kconfig.template.log_config"

endif # SMP_CLIENT
```

## subsys/mgmt/mcumgr/transport/Kconfig
```kconfig
# Copyright Runtime.io 2018. All rights reserved.
# Copyright Nordic Semiconductor ASA 2020-2022. All rights reserved.
# SPDX-License-Identifier: Apache-2.0

# The Kconfig file is dedicated to transport subdirectory of MCUmgr
# subsystem and provides Kconfig options to control aspects of
# transport, in general, that are not otherwise controlled by
# options belonging to transport specifically.
#
# Options defined in this file should be prefixed:
#  MCUMGR_TRANSPORT_ -- general transport options;
#  MCUMGR_TRANSPORT_WORKQUEUE -- for workqueue configuration;
#  MCUMGR_TRANSPORT_NETBUF -- for Net Buf related configuration.

config MCUMGR_TRANSPORT_WORKQUEUE_STACK_SIZE
	int "MCUmgr transport workqueue stack size"
	default 2048
	help
	  Stack size of the MCUmgr for transport subsystem work queue.

config MCUMGR_TRANSPORT_WORKQUEUE_THREAD_PRIO
	int "MCUmgr transport workqueue thread priority"
	default 3
	help
	  Scheduling priority of the MCUmgr transport subsystem work queue.

config MCUMGR_TRANSPORT_REASSEMBLY
	bool
	help
	  Enable structures and functions needed for packet reassembly by SMP backend.

config MCUMGR_TRANSPORT_NETBUF_COUNT
	int "Number of mcumgr buffers"
	default 2 if MCUMGR_TRANSPORT_UDP
	default 4
	help
	  The number of net_bufs to allocate for mcumgr.  These buffers are
	  used for both requests and responses.

config MCUMGR_TRANSPORT_NETBUF_SIZE
	int "Size of each mcumgr buffer"
	default 2048 if MCUMGR_TRANSPORT_UDP
	default 384
	help
	  The size, in bytes, of each mcumgr buffer.  This value must satisfy
	  the following relation:
	  MCUMGR_TRANSPORT_NETBUF_SIZE >= transport-specific-MTU + transport-overhead
	  In case when MCUMGR_TRANSPORT_SHELL is enabled this value should be set to
	  at least MCUMGR_GRP_SHELL_BACKEND_DUMMY_BUF_SIZE + 32.

config MCUMGR_TRANSPORT_NETBUF_MIN_USER_DATA_SIZE
	int
	default 24 if MCUMGR_TRANSPORT_UDP && NET_IPV6
	default 20 if MCUMGR_TRANSPORT_UDP && MCUMGR_TRANSPORT_UDP_IPV4 && NET_SOCKETS_PACKET
	default 8 if MCUMGR_TRANSPORT_UDP && MCUMGR_TRANSPORT_UDP_IPV4
	default 8 if MCUMGR_TRANSPORT_BT
	default 4
	help
	  Hidden option to determine minimum user data size.

config MCUMGR_TRANSPORT_NETBUF_USER_DATA_SIZE
	int "Size of mcumgr buffer user data"
	range MCUMGR_TRANSPORT_NETBUF_MIN_USER_DATA_SIZE 128
	default MCUMGR_TRANSPORT_NETBUF_MIN_USER_DATA_SIZE
	help
	  The size, in bytes, of user data to allocate for each mcumgr buffer.

	  Different mcumgr transports impose different requirements for this
	  setting. A value of 4 is sufficient for UART and shell, a value of 8
	  is sufficient for Bluetooth. For UDP, the userdata must be large
	  enough to hold IPv4/IPv6 addresses.

module = MCUMGR_TRANSPORT
module-str = mcumgr_transport
source "subsys/logging/Kconfig.template.log_config"

rsource "Kconfig.dummy"

rsource "Kconfig.bluetooth"

rsource "Kconfig.lorawan"

rsource "Kconfig.shell"

rsource "Kconfig.uart"

rsource "Kconfig.udp"
```
