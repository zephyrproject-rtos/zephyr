## subsys/modbus/Kconfig
```kconfig
# Copyright (c) 2020 PHYTEC Messtechnik GmbH
# SPDX-License-Identifier: Apache-2.0

menuconfig MODBUS
	bool "Modbus support"
	select CRC

if MODBUS

config MODBUS_BUFFER_SIZE
	int "Modbus buffer size"
	default 256
	range 64 256
	help
	  Modbus buffer size.

choice
	prompt "Supported node roles"
	default MODBUS_ROLE_CLIENT_SERVER
	help
	  Specify the type of supported node roles.

config MODBUS_ROLE_CLIENT
	bool "Client support"

config MODBUS_ROLE_SERVER
	bool "Server support"

config MODBUS_ROLE_CLIENT_SERVER
	bool "Client and server support"

endchoice

config MODBUS_SERVER
	bool
	default y if MODBUS_ROLE_SERVER || MODBUS_ROLE_CLIENT_SERVER

config MODBUS_CLIENT
	bool
	default y if MODBUS_ROLE_CLIENT || MODBUS_ROLE_CLIENT_SERVER

config MODBUS_SERIAL
	bool "Modbus over serial line support"
	default y
	depends on SERIAL && SERIAL_HAS_DRIVER
	depends on DT_HAS_ZEPHYR_MODBUS_SERIAL_ENABLED
	imply UART_USE_RUNTIME_CONFIGURE
	help
	  Enable Modbus over serial line support.

config MODBUS_ASCII_MODE
	depends on MODBUS_SERIAL
	bool "Modbus transmission mode ASCII"
	help
	  Enable ASCII transmission mode.

config MODBUS_RAW_ADU
	bool "Modbus raw ADU support"
	help
	  Enable Modbus raw ADU support.

config MODBUS_NUMOF_RAW_ADU
	int "Number of raw ADU instances"
	depends on MODBUS_RAW_ADU
	range 1 4
	help
	  Number of raw ADU instances.

config MODBUS_FP_EXTENSIONS
	bool "Floating-Point extensions"
	default y
	help
	  Enable Floating-Point extensions

config MODBUS_FC08_DIAGNOSTIC
	bool "FC08 Diagnostic support"
	depends on MODBUS_SERVER
	default y
	help
	  Enable function code 08 Diagnostic support

config MODBUS_FC01_COIL_RD
	bool "FC01 single coil read support"
	depends on MODBUS_SERVER
	default y
	help
	  Enable function code 01 single coil read support

config MODBUS_FC02_DI_RD
	bool "FC02 single discrete input read support"
	depends on MODBUS_SERVER
	default y
	help
	  Enable function code 02 single discrete input read support

config MODBUS_FC03_HOLDING_REG_RD
	bool "FC03 multiple holding register read support"
	depends on MODBUS_SERVER
	default y
	help
	  Enable function code 03 multiple holding register read support

config MODBUS_FC04_IN_REG_RD
	bool "FC04 multiple input register read support"
	depends on MODBUS_SERVER
	default y
	help
	  Enable function code 04 multiple input register read support

config MODBUS_FC05_COIL_WR
	bool "FC05 single coil write support"
	depends on MODBUS_SERVER
	default y
	help
	  Enable function code 05 single coil write support

config MODBUS_FC06_HOLDING_REG_WR
	bool "FC06 single holding register write support"
	depends on MODBUS_SERVER
	default y
	help
	  Enable function code 06 single holding register write support

config MODBUS_FC15_COILS_WR
	bool "FC15 multiple coils write support"
	depends on MODBUS_SERVER
	default y
	help
	  Enable function code 15 multiple coils write support

config MODBUS_FC16_HOLDING_REGS_WR
	bool "FC16 multiple holding register write support"
	depends on MODBUS_SERVER
	default y
	help
	  Enable function code 16 multiple holding register write support

module = MODBUS
module-str = Modbus Support
module-help = Sets log level for Modbus support
source "subsys/logging/Kconfig.template.log_config"

endif
```

## subsys/modem/Kconfig
```kconfig
# Copyright (c) 2023 Trackunit Corporation
# SPDX-License-Identifier: Apache-2.0

menuconfig MODEM_MODULES
	bool "Modem modules"

if MODEM_MODULES

config MODEM_DEDICATED_WORKQUEUE
	bool "Use a dedicated workqueue for modem operations"

if MODEM_DEDICATED_WORKQUEUE

config MODEM_DEDICATED_WORKQUEUE_STACK_SIZE
	int "Modem dedicated workqueue stack size"
	default 1024

config MODEM_DEDICATED_WORKQUEUE_PRIORITY
	int "Modem dedicated workqueue priority"
	default SYSTEM_WORKQUEUE_PRIORITY

endif # MODEM_DEDICATED_WORKQUEUE

config MODEM_CHAT
	bool "Modem chat module"
	select RING_BUFFER
	select MODEM_PIPE

if MODEM_CHAT

config MODEM_CHAT_LOG_BUFFER_SIZE
	int "Modem chat log buffer size in bytes"
	default 128

endif

config MODEM_CMUX
	bool "Modem CMUX module"
	select MODEM_PIPE
	select RING_BUFFER
	select EVENTS
	select CRC

if MODEM_CMUX

config MODEM_CMUX_DEFAULT_MTU_127
	bool
	help
	  Hint that the default MODEM_CMUX_MTU size should be 127 bytes.

config MODEM_CMUX_MTU
	int "CMUX MTU size in bytes"
	range 16 1500
	default 127 if MODEM_CMUX_DEFAULT_MTU_127
	default 31
	help
	  Maximum Transmission Unit (MTU) size for the CMUX module.
	  Linux ldattach defaults to 127 bytes, 3GPP TS 27.010 to 31.

config MODEM_CMUX_WORK_BUFFER_SIZE_EXTRA
	int "CMUX module extra work buffer size in bytes"
	default 0
	help
	  Extra bytes to add to the work buffers used by the CMUX module.
	  The default size of these buffers is MODEM_CMUX_MTU + 7 (CMUX header size).

config MODEM_CMUX_MSC_FC_THRESHOLD
	int "Enable flow control when the DLCI ring buffer has less than this many bytes free"
	range 0 MODEM_CMUX_MTU
	default MODEM_CMUX_MTU if MODEM_CMUX_WORK_BUFFER_SIZE_EXTRA > 0
	default 0
	help
	  When the available space in a DLCI receive ring buffer is less than this
	  value, the CMUX module will send Modem Status Command frame with the
	  flow control bit set to indicate that the sender should stop sending data.
	  Flow control is released once the incoming buffer has at least MODEM_CMUX_MTU
	  bytes free again.
	  This only works if the peer supports MSC messages.
	  Disable flow control by setting this value to 0.

module = MODEM_CMUX
module-str = modem_cmux
source "subsys/logging/Kconfig.template.log_config"

config MODEM_CMUX_LOG_FRAMES
	bool "Log CMUX frames"
	depends on MODEM_CMUX_LOG_LEVEL_DBG
	help
	  Enable logging of CMUX frames. This can produce a lot of log data.

endif

config MODEM_PIPE
	bool "Modem pipe module"
	select EVENTS

config MODEM_PIPELINK
	bool "Modem pipelink module"
	depends on MODEM_PIPE

config MODEM_PPP
	bool "Modem PPP module"
	depends on NET_L2_PPP
	select MODEM_PIPE
	select RING_BUFFER
	select CRC
	select PM_DEVICE_RUNTIME_ASYNC if PM_DEVICE_RUNTIME

if MODEM_PPP

config MODEM_PPP_NET_BUF_FRAG_SIZE
	int "Network buffer fragment size"
	default NET_BUF_DATA_SIZE if NET_BUF_FIXED_DATA_SIZE
	default 128

endif

config MODEM_STATS
	bool "Modem statistics"
	depends on SHELL
	help
	  Enables modem statistics shell commands which track the usage of
	  buffers across the modem modules. The statistics are useful for
	  scaling buffer sizes, as these are application specific.

config MODEM_STATS_BUFFER_NAME_SIZE
	int "Maximum string size of modem stats buffer name"
	default 32
	range 8 64

config MODEM_UBX
	bool "Modem U-BLOX module"
	select RING_BUFFER
	select MODEM_PIPE
	help
	  Enable Modem U-BLOX module.

if MODEM_UBX

config MODEM_UBX_LOG_BUFFER
	int "Modem U-BLOX log buffer size"
	default 128

endif

module = MODEM_MODULES
module-str = modem_modules
source "subsys/logging/Kconfig.template.log_config"

rsource "backends/Kconfig"

endif
```

## subsys/modem/backends/Kconfig
```kconfig
# Copyright (c) 2023 Trackunit Corporation
# SPDX-License-Identifier: Apache-2.0

config MODEM_BACKEND_TTY
	bool "Modem TTY backend module"
	select MODEM_PIPE
	depends on ARCH_POSIX

config MODEM_BACKEND_UART
	bool "Modem UART backend module"
	select MODEM_PIPE
	select RING_BUFFER
	depends on UART_INTERRUPT_DRIVEN || UART_ASYNC_API

if MODEM_BACKEND_UART

config MODEM_BACKEND_UART_ASYNC_API
	bool

choice MODEM_BACKEND_UART_IMPL
	prompt "Modem UART backend implementation"

config MODEM_BACKEND_UART_ASYNC
	bool "Modem UART backend module async implementation"
	depends on UART_ASYNC_API
	select MODEM_BACKEND_UART_ASYNC_API

config MODEM_BACKEND_UART_ASYNC_HWFC
	bool "Modem UART backend module async implementation with Hardware flow control (HWFC)"
	depends on UART_ASYNC_API
	select MODEM_BACKEND_UART_ASYNC_API
	select EXPERIMENTAL

config MODEM_BACKEND_UART_ISR
	bool "Modem UART backend module interrupt driven implementation"
	depends on UART_INTERRUPT_DRIVEN

endchoice # MODEM_BACKEND_UART_IMPL

if MODEM_BACKEND_UART_ISR

config MODEM_BACKEND_UART_ISR_RECEIVE_IDLE_TIMEOUT_MS
	int "Modem ISR UART delay between first byte received and RECEIVE_READY pipe event"
	default 20
	help
	  This defines the delay, in milliseconds, that the backend waits
	  when receiving a byte before sending the RECEIVE_READY pipe event.
	  The backend will anyway send the event before this delay if buffer space runs out.
	  A good value is ~90% the time it takes to fill half the receive buffer.
	  It can be calculated as follows:
	  (<UART receive_buf_size> / 2) / (<UART baud rate> / <UART bits per byte>) * <ms per sec>
	  By default (for the modem_cellular driver): (512 / 2) / (115200 / 10) * 1000 = 22,222 => 20

endif # MODEM_BACKEND_UART_ISR

if MODEM_BACKEND_UART_ASYNC_API

config MODEM_BACKEND_UART_ASYNC_TRANSMIT_TIMEOUT_MS
	int "Modem async UART transmit timeout in milliseconds"
	default 1000

config MODEM_BACKEND_UART_ASYNC_RECEIVE_IDLE_TIMEOUT_MS
	int "Modem async UART receive idle timeout in milliseconds"
	default 30

endif # MODEM_BACKEND_UART_ASYNC_API

if MODEM_BACKEND_UART_ASYNC_HWFC

config MODEM_BACKEND_UART_ASYNC_HWFC_BUFFER_COUNT
	int "Modem async UART HWFC buffer count"
	range 2 4
	default 3

endif # MODEM_BACKEND_UART_ASYNC_HWFC

endif # MODEM_BACKEND_UART
```

## subsys/modules/Kconfig
```kconfig
# Copyright (c) 2023 Intel Corporation
# SPDX-License-Identifier: Apache-2.0

menuconfig MODULES
	bool "Dynamic module loading"
	help
	  Enable dynamic module loading

if MODULES

config MODULES_HEAP_SIZE
	int "Module loading heap memory size in kilobytes"
	default 8
	help
	  Memory size used to load dynamic modules

config MODULES_SHELL
	bool "Modules shell commands"
	depends on SHELL
	help
	  Manage modules with shell commands

module = MODULES
module-str = modules
source "subsys/logging/Kconfig.template.log_config"

endif
```

## subsys/morse/Kconfig
```kconfig
# Copyright (c) 2024-2025 Freedom Veiculos Eletricos
# Copyright (c) 2024-2025 O.S. Systems Software LTDA.
# SPDX-License-Identifier: Apache-2.0

menuconfig MORSE
	bool "Morse Code support [EXPERIMENTAL]"
	select COUNTER
	depends on DT_HAS_ZEPHYR_MORSE_ENABLED
	select EXPERIMENTAL
	help
	  This option enables Morse Code support.

if MORSE

module = MORSE
module-str = Morse Code
source "subsys/logging/Kconfig.template.log_config"

config MORSE_SHELL
	bool "Morse Code shell"
	depends on SHELL
	help
	  Enable Morse Code related shell commands.

config MORSE_SHELL_RX_BUF_SIZE
	int "Morse Code shell receive buffer size"
	depends on MORSE_SHELL
	default 64
	help
	  Define the maximum number of characters to be accomulate till the end
	  of the transmission.

endif # MORSE
```

## subsys/mp/Kconfig
```kconfig
#
# Copyright 2025 NXP
#
# SPDX-License-Identifier: Apache-2.0
#

menuconfig MP
	bool "Media Pipe subsystem"
	select NET_BUF
	help
	  Enable Media Pipe subsystem.

if MP

module = MP
module-str = mp
source "subsys/logging/Kconfig.template.log_config"

config MP_RPC
	bool "RPC support"

# Load core configurations
source "subsys/mp/core/Kconfig"

# Load all plugin configurations
source "subsys/mp/plugins/Kconfig"

endif # MP
```

## subsys/mp/base/Kconfig
```kconfig
#
# Copyright 2026 NXP
#
# SPDX-License-Identifier: Apache-2.0
#

config MP_BASE
	bool "Base optional elements (e.g. capsfilter, queue, tee. etc.)"
	help
	  Enable the base elements plugin.

if MP_BASE

config MP_BASE_CAPSFILTER
	bool "Capsfilter element"
	help
	  Enable the capsfilter element. Capsfilter restricts the media
	  format flowing between two elements by filtering on capabilities
	  such as sample rate, pixel format, etc. This allows forcing a
	  specific format at a given point in the pipeline.

config MP_BASE_QUEUE
	bool "Queue element (for pipeline-level threading)"
	help
	  Enable the queue element which decouples pipeline segments
	  into separate threads for parallel processing. The queue
	  deposits buffers into a FIFO and spawns a dedicated thread
	  to drive the downstream segment.

config MP_BASE_QUEUE_MAX_SIZE
	int "Max size of a queue element"
	range 1 255
	default 2
	depends on MP_BASE_QUEUE
	help
	  Maximum number of buffers that can be queued into a queue element

config MP_BASE_TEE
	bool "Tee element"
	help
	  Enable the tee element which splits a single input branch
	  into multiple output branches.

config MP_BASE_TEE_MAX_SRCPADS_NUM
	int "Maximum number of source pads of a tee element"
	range 2 8
	default 2
	depends on MP_BASE_TEE

endif # MP_BASE
```
