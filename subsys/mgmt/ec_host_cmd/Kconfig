## subsys/net/lib/tailscale/Kconfig
```kconfig
# SPDX-FileCopyrightText: Copyright The Zephyr Project Contributors
# SPDX-License-Identifier: Apache-2.0

menuconfig TAILSCALE
	bool "Native Tailscale client [EXPERIMENTAL]"
	depends on WIREGUARD_MULTI_PEER && SETTINGS
	depends on MBEDTLS_BUILTIN && TF_PSA_CRYPTO_BUILTIN
	depends on POSIX_THREADS && POSIX_TIMERS && TF_PSA_CRYPTO_USER_CONFIG
	depends on NET_NATIVE && NET_TCP && NET_UDP && NET_IPV4 && NET_IPV6
	depends on NET_IPV4_ROUTE && NET_IPV6_ROUTE
	depends on NET_SOCKETS_SOCKOPT_TLS && NET_INTERFACE_NAME
	depends on HTTP_SERVER_VERSION_2 && DNS_RESOLVER && JSON_LIBRARY && UTF8
	select EXPERIMENTAL
	select TAILSCALE_CONTROL_STREAM
	select TAILSCALE_CLIENT_INGRESS
	select TAILSCALE_DNS_RESOLVER
	select TAILSCALE_POLICY
	select WIREGUARD_PEER_POLICY
	select WIREGUARD_USE_REALTIME
	help
	  Join a Tailscale or Headscale network with one local node identity.
	  The application supplies the physical interface, trusted UTC and TLS
	  trust anchor. Applications use standard sockets.
	  Enable the native IPv4 and IPv6 unicast route tables.
	  Enable MBEDTLS_THREADING_C and MBEDTLS_THREADING_PTHREAD in the
	  TF-PSA-Crypto user configuration header.

if TAILSCALE

config TAILSCALE_CONTROL_HOST
	string "Control server hostname or IPv4 address"
	default "controlplane.tailscale.com"
	help
	  Verify the TLS certificate against this server name and the trust
	  anchor supplied by the application.

config TAILSCALE_CONTROL_PORT
	int "Control server TLS port"
	range 1 65535
	default 443

config TAILSCALE_DISCO
	bool "Discover and use direct UDP paths to Tailscale peers"
	default y
	help
	  Exchange authenticated DISCO probes over UDP to establish direct
	  paths. Direct paths can operate without DERP when peers can reach
	  each other's UDP endpoints.

config TAILSCALE_DERP
	bool "Use authenticated DERP relay connections"
	default y
	select TAILSCALE_DERP_MAP
	select NET_SOCKETS_TLS_CERT_VERIFY_CALLBACK
	help
	  Relay encrypted traffic when a direct path is unavailable. When
	  direct discovery is enabled, DERP can also relay discovery messages.

config TAILSCALE_TRANSPORT
	def_bool TAILSCALE_DISCO || TAILSCALE_DERP

if TAILSCALE_DISCO

config TAILSCALE_DISCOVER_ENDPOINT
	bool "Advertise the UDP mapping discovered by STUN"
	default y if TAILSCALE_DERP
	select CRC
	select TAILSCALE_DERP_MAP
	help
	  Use the control server's relay map to find STUN servers. This
	  does not require connections to DERP relay servers.

config TAILSCALE_DERP_UDP_PORT
	int "Direct transport UDP port"
	range 1 65535
	default 41641
	help
	  Use a port distinct from the native WireGuard listener.

endif # TAILSCALE_DISCO

# Keep the proxy selection visible so the build can reject a conflict with DERP.
config TAILSCALE_REQUIRED_PROXY
	bool "Require HTTP CONNECT for control and DERP"
	select MBEDTLS_SSL_SERVER_NAME_INDICATION
	help
	  Verify origin TLS through the proxy. Direct UDP is disabled unless a
	  SOCKS5 UDP association is also configured.
	  The build requires TAILSCALE_DERP when this option is enabled.

if TAILSCALE_REQUIRED_PROXY

config TAILSCALE_PROXY_IPV4
	string "Proxy server IPv4 address"

config TAILSCALE_HTTP_PROXY_PORT
	int "HTTP CONNECT port"
	range 1 65535
	default 3128

config TAILSCALE_SOCKS_UDP_PORT
	int "SOCKS5 UDP ASSOCIATE control port (zero disables direct UDP)"
	range 0 65535
	default 0

endif # TAILSCALE_REQUIRED_PROXY

endif # TAILSCALE

config TAILSCALE_CLIENT_INGRESS
	bool
	select TAILSCALE_ROUTE_POLICY
	select NET_CONTEXT_LINGER

config TAILSCALE_DNS_RESOLVER
	bool

config TAILSCALE_MAP_STREAM
	bool "Tailscale control map response framing" if ZTEST && !TAILSCALE
	help
	  Build the incremental decoder for an uncompressed Tailscale control
	  map response body. The control client supplies the payload buffer and
	  handles complete messages.

config TAILSCALE_CONTROL_STREAM
	bool "Persistent Tailscale control map session" if ZTEST && !TAILSCALE
	select TAILSCALE_MAP_STREAM
	help
	  Run a map stream over an application-provided authenticated response
	  transport and reconnect on recoverable session errors.

config TAILSCALE_PEER_INVENTORY
	bool "Tailscale control peer inventory" if ZTEST && !TAILSCALE
	help
	  Maintain a bounded snapshot of peers from Tailscale control maps.

config TAILSCALE_PEER_INVENTORY_MAX_PEERS
	int "Maximum peers in a control map"
	depends on TAILSCALE_PEER_INVENTORY
	range 1 256
	default 16
	help
	  Each inventory reserves two snapshots of this many peers so a failed
	  update cannot expose a partial map. Parsing a peer list also uses one
	  64-bit identifier per configured peer on the control worker's stack.

config TAILSCALE_POLICY
	bool "Transactional Tailscale forwarding policy" if ZTEST && !TAILSCALE
	depends on UTF8
	select TAILSCALE_PEER_INVENTORY
	help
	  Stage bounded peer and packet filter snapshots together and publish
	  them through an application-provided installer. The direct ingress
	  filter supports explicit TCP and UDP rules.

config TAILSCALE_PEER_STABLE_ID
	string "Limit the client to one control-assigned peer ID"
	depends on TAILSCALE_POLICY
	default ""
	help
	  An empty selection admits all peers within the configured capacity.

config TAILSCALE_POLICY_LEASE_SECONDS
	int "Maximum age of the installed client policy in seconds"
	depends on TAILSCALE_POLICY
	range 1 3600
	default 180
	help
	  Withdraw peers and owned addresses after this interval without a valid
	  map or keepalive on the installed generation.

config TAILSCALE_DERP_MAP
	bool "Accept DERP relay maps in forwarding policy" if ZTEST && !TAILSCALE
	depends on TAILSCALE_POLICY
	help
	  Publish relay definitions with the peer and packet filter snapshot.
	  The DERP client selects and connects to regions from the installed map.

config TAILSCALE_DERP_MAX_NODES
	int "Maximum relay nodes in a map"
	depends on TAILSCALE_DERP_MAP
	range 1 256
	default 128
	help
	  Bound relay storage in policy and transport snapshots. The default
	  accommodates the hosted relay map. An oversized update leaves the
	  previous map and forwarding policy intact.

config TAILSCALE_ROUTE_POLICY
	bool "Decode approved subnet and exit route policy" if ZTEST && !TAILSCALE
	depends on TAILSCALE_POLICY
	help
	  Allow multiple routers to advertise a prefix and retain control's
	  primary route designations and exit node suggestion capability.
	  The installer must choose a single owner for each effective prefix.
```

## subsys/net/lib/utils/Kconfig
```kconfig
# SPDX-FileCopyrightText: 2026 Muhammad Waleed Badar
# SPDX-License-Identifier: Apache-2.0

config NET_URL
	bool "URL components"
	select HTTP_PARSER_URL
	help
	  Split a URL into its scheme, host, port, path and other components
	  with net_url_parse() and copy them out with the net_url helpers.
```

## subsys/net/lib/wireguard/Kconfig
```kconfig
# Wireguard VPN service for Zephyr

# Copyright (c) 2026 Nordic Semiconductor
# SPDX-License-Identifier: Apache-2.0

config WIREGUARD
	bool "Wireguard VPN service [EXPERIMENTAL]"
	depends on NET_UDP
	select NET_VPN
	select NET_IPV4_MAPPING_TO_IPV6 if NET_IPV4 && NET_IPV6
	select NET_MGMT
	select NET_MGMT_EVENT
	select NET_MGMT_EVENT_INFO
	select NET_MGMT_EVENT_OWNED_INFO
	select NET_L2_DUMMY
	select NET_L2_VIRTUAL
	select NET_L2_VIRTUAL_MGMT
	select NET_IP_DSCP_ECN
	select BASE64
	select EXPERIMENTAL
	help
	  Select 'y' if you want to enable Wireguard VPN service.

if WIREGUARD

config WIREGUARD_CRYPTO
	bool
	default y
	imply PSA_WANT_ALG_CHACHA20_POLY1305
	imply PSA_WANT_ALG_ECDH
	imply PSA_WANT_ECC_MONTGOMERY_255
	imply PSA_WANT_ALG_HMAC
	imply PSA_WANT_ALG_SHA_256
	imply PSA_WANT_KEY_TYPE_CHACHA20
	imply PSA_WANT_KEY_TYPE_ECC_KEY_PAIR_IMPORT
	imply PSA_WANT_KEY_TYPE_ECC_KEY_PAIR_EXPORT
	imply PSA_WANT_KEY_TYPE_ECC_KEY_PAIR_DERIVE
	imply PSA_WANT_KEY_TYPE_ECC_KEY_PAIR_GENERATE
	select PSA_CRYPTO
	help
	  Use PSA Crypto API for cryptographic operations where available.
	  This enables hardware acceleration on platforms that support it.
	  Note:  BLAKE2s and XChaCha20-Poly1305 are not available in PSA
	  yet and will continue to use the reference implementation.
	  XChaCha20 is found in PSA 1.2 but Zephyr does not have it yet.
	  The following operations will use PSA when enabled:
	  - X25519 key exchange
	  - ChaCha20-Poly1305 AEAD encryption/decryption
	  - Random number generation

config WIREGUARD_SHELL
	bool
	depends on NET_SHELL
	select GETOPT_LONG
	select SHELL_GETOPT
	default y

config WIREGUARD_BUF_COUNT
	int "WireGuard receive buffer count"
	default 2
	range 1 256
	help
	  Reserve this many buffers and packet descriptors for decrypted
	  incoming packets. Each receive buffer holds WIREGUARD_BUF_LEN bytes
	  and stays allocated until the network stack consumes the packet.
	  The private receive pool uses fixed-size buffers.

config WIREGUARD_BUF_LEN
	int "WireGuard message buffer length"
	default 1500
	range 1328 1500
	help
	  Reserve this many bytes for each private receive buffer and one
	  transmit scratch buffer shared by all peers. The space includes the
	  WireGuard header, authentication tag, and padding.

config WIREGUARD_MAX_PEER
	int "Maximum number of peer connections"
	default 1
	range 1 256
	help
	  How many Wireguard VPN connections are possible.

config WIREGUARD_MULTI_PEER
	bool "WireGuard peers sharing a local identity"
	help
	  Allow an application to add several peers to one WireGuard virtual
	  interface and share its provisioned key. The core selects a peer by the
	  longest matching allowed prefix for each plaintext packet.

config WIREGUARD_PEER_POLICY
	bool "Managed WireGuard peer-set policy"
	depends on WIREGUARD_MULTI_PEER
	help
	  Allow an application to replace a complete interface peer set and
	  install a plaintext admission callback at the same time. Peer keys
	  are prepared in unused peer slots before publication.

config WIREGUARD_POLICY_STAGING_PEERS
	int "Extra peer slots for atomic policy updates"
	depends on WIREGUARD_PEER_POLICY
	default 0
	range 0 WIREGUARD_MAX_PEER
	help
	  Reserve additional peer slots to prepare new identities and keys
	  while all active connections are in use. Each replacement needs
	  one unused slot until the complete policy is published. This
	  does not increase the number of active peer connections.

config WIREGUARD_USE_REALTIME
	bool
	help
	  Use the system realtime clock for handshake timestamps. A consumer
	  selects this when it provisions a clock that survives a node restart.

config WIREGUARD_HANDSHAKE_WORKQ_STACK_SIZE
	int "Managed WireGuard handshake work queue stack size"
	depends on WIREGUARD_PEER_POLICY && PREEMPT_ENABLED
	depends on MBEDTLS_BUILTIN && TF_PSA_CRYPTO_BUILTIN
	depends on POSIX_THREADS && POSIX_TIMERS && TF_PSA_CRYPTO_USER_CONFIG
	default 0
	help
	  A positive size enables a low-priority queue for native UDP
	  handshakes and managed peer initiations. Established traffic can
	  progress while a managed handshake performs X25519 calculations.
	  Enable the Mbed TLS pthread backend in the TF-PSA-Crypto user
	  configuration header.

config WIREGUARD_MAX_INTERFACES
	int "Maximum number of WireGuard virtual interfaces"
	depends on WIREGUARD_MULTI_PEER
	default WIREGUARD_MAX_PEER
	range 1 WIREGUARD_MAX_PEER
	help
	  Set how many local WireGuard identities can be provisioned. The peer
	  limit is independent of this limit. Multiple peers can use the same
	  virtual interface.

config WIREGUARD_MAX_SRC_IPS
	int "Maximum number of peer source IP addresses"
	default 2
	range 1 256
	help
	  How many IP addresses are allowed / peer.

config WIREGUARD_INTERFACE
	string "Network interface to use"
	help
	  Leave empty if you want to use all network interfaces
	  for the VPN connections. If set, then all VPN traffic
	  is routed via this interface.

config WIREGUARD_PORT
	int "UDP port to use"
	range 0 $(UINT16_MAX)
	default 51820
	help
	  What UDP port to use when listening connections (in server role)
	  or when connecting to other hosts.
	  If set to 0, then let Wireguard code to select the port.

config WIREGUARD_WORKQ_STACK_SIZE
	int "Stack size of the Wireguard work queue"
	default 0
	help
	  The periodic timer of the peers (handshake initiation, keepalive,
	  rekey) runs on a work queue. With 0 it is the system work queue.
	  A positive value starts a work queue of its own with this stack
	  size, so that the X25519 computation of a handshake initiation does
	  not set the stack size of the system work queue. The first
	  initiation to a peer, started by the first packet sent to it or by
	  wireguard_peer_keepalive(), then runs there too instead of in the
	  calling thread. Native UDP handshakes received from a peer run on
	  the network RX thread unless the managed interface uses
	  WIREGUARD_HANDSHAKE_WORKQ_STACK_SIZE.

config WIREGUARD_WORKQ_PRIORITY
	int "Priority of the Wireguard work queue"
	depends on WIREGUARD_WORKQ_STACK_SIZE > 0
	default SYSTEM_WORKQUEUE_PRIORITY
	help
	  Thread priority of the Wireguard work queue.

module = WIREGUARD
module-dep = NET_LOG
module-str = Log level for Wireguard VPN service
module-help = Enables Wireguard to output debug messages
source "subsys/net/Kconfig.template.log_config.net"

config WIREGUARD_TXRX_DEBUG
	bool "Debug received and sent virtual interface packets"
	depends on WIREGUARD_LOG_LEVEL_DBG
	help
	  Enables printing of received and sent network packets.
	  This can produce lot of output so it is disabled by default.
	  This prints data in the virtual interface (wg0) level.

endif # WIREGUARD
```

## subsys/nvmem/Kconfig
```kconfig
# Copyright (c) 2025 Basalte bv
# SPDX-License-Identifier: Apache-2.0

menuconfig NVMEM
	bool "Non Volatile Memory (NVMEM)"

if NVMEM

config NVMEM_BBRAM
	bool "NVMEM support for Battery Backed RAM"
	default y
	depends on BBRAM

config NVMEM_EEPROM
	bool "NVMEM support for EEPROM devices"
	default y
	depends on EEPROM

config NVMEM_FLASH
	bool "NVMEM (read) support for flash devices"
	default y
	depends on FLASH

config NVMEM_FLASH_WRITE
	bool "NVMEM write support for flash devices"
	depends on NVMEM_FLASH
	help
	  Allow writing to NVMEM cells in flash devices.

	  An explicit option is added for this as it's non-trivial
	  to write to flash devices requiring out-of-bands erase or
	  taking write-block sizes into account.

config NVMEM_OTP
	bool "NVMEM (read) support for OTP memory handling devices"
	default y
	depends on OTP

config NVMEM_OTP_WRITE
	bool "NVMEM (write) support for OTP memory handling devices"
	depends on NVMEM_OTP && OTP_PROGRAM

config NVMEM_REVERSED_WRITE_BUF_SIZE
	int "Buffer size for writes to cells in reversed byte order"
	default 16
	range 1 1024
	help
	  Size in bytes of the stack buffer used to reverse the data written
	  to an NVMEM cell with the zephyr,reversed-byte-order devicetree
	  property.

	  A write of at most this size reaches the underlying device as a
	  single write. A longer write is split in multiple writes of this
	  size, which is not suited for devices with write alignment or
	  program-once constraints. Set this to at least the largest write
	  to such a cell.

module = NVMEM
module-str = nvmem
source "subsys/logging/Kconfig.template.log_config"

endif # NVMEM
```
