## subsys/profiling/perf/event/Kconfig
```kconfig
# Copyright 2026 Arm Limited and/or its affiliates <open-source-office@arm.com>
#
# SPDX-License-Identifier: Apache-2.0

menuconfig PROFILING_PERF_EVENTS
	bool "Performance event subsystem"
	depends on MULTITHREADING
	help
	  Enable provider-based performance event discovery and counter
	  session management. Applications can resolve named events and
	  capture counter snapshots through the C API.

	  Providers and shell commands are enabled separately. This
	  subsystem does not require stack-sampling support.

if PROFILING_PERF_EVENTS

config PROFILING_PERF_EVENTS_MAX_EVENTS
	int "Maximum events in a stat session"
	default 8
	range 1 32
	help
	  Maximum number of events that can be measured in one stat session.

config PROFILING_PERF_EVENTS_NAME_MAX
	int "Maximum shell event name length"
	default 64
	range 8 128
	help
	  Maximum canonical event name length, including the NUL terminator,
	  retained by the perf stat shell frontend.

config PROFILING_PERF_EVENTS_SHELL
	bool "Performance event shell commands"
	depends on SHELL
	depends on CBPRINTF_FULL_INTEGRAL
	help
	  Enable perf list and perf stat for event discovery and counter
	  sessions. Printing 64-bit event counts requires full integer formatting.
	  SHELL_ARGC_MAX must be at least 3 + 2 * PROFILING_PERF_EVENTS_MAX_EVENTS
	  to accept all event selections in perf stat start.

config PROFILING_PERF_EVENT_PROVIDER_CPU
	bool "CPU performance counter providers"
	depends on ARM64_PMUV3
	depends on !SMP || SCHED_IPI_SUPPORTED
	help
	  Register cpuN providers for events described by the PMU backend.
	  Operations run synchronously on each owning CPU, directly with
	  interrupts locked for the current CPU or through IPI work for a
	  remote CPU. SMP requires scheduler IPI support.
	  Each selected CPU's PMU must be reserved exclusively for perf, and
	  CPUs must remain online throughout a session.

endif
```

## subsys/profiling/pmu_sampling/Kconfig
```kconfig
# Copyright (c) 2026 Advanced Micro Devices, Inc.
# SPDX-License-Identifier: Apache-2.0

config PROFILING_PMU_SAMPLING
	bool "PMU overflow PC sampling profiler (ARM64)"
	depends on PROFILING
	depends on ARM64
	depends on ARM64_PMUV3
	depends on GEN_SW_ISR_TABLE
	depends on MULTITHREADING
	depends on TIMER_HAS_64BIT_CYCLE_COUNTER
	select SCHED_CPU_MASK if SMP
	help
	  Enable periodic program-counter sampling using a programmable PMU counter
	  overflow interrupt (PMINTENSET_EL1). Requires a GIC interrupt line for
	  the PMU on your SoC: either an enabled arm,armv8-pmu devicetree node with
	  interrupts, or CONFIG_ARM64_PMU_OVERFLOW_IRQ set to the correct INTID.

	  On SMP systems, per-CPU work queues are created at init time to program
	  each CPU's PMU counter independently when sampling starts.

	  Sampling is driven through the public API in
	  include/zephyr/profiling/pmu_sampling.h.

	  Design, devicetree, and limitations: subsys/profiling/pmu_sampling/README.rst

if PROFILING_PMU_SAMPLING

config PROFILING_PMU_SAMPLE_BUFFER_LEN
	int "Number of PC samples to retain in RAM"
	default 512
	help
	  Per-CPU ring buffer capacity. When full, new samples overwrite the
	  oldest entries. Must be a power of two: the ring index is the free-running
	  sample sequence modulo this value, and only a power-of-two capacity keeps
	  that mapping consistent when the 32-bit sequence wraps.

	  The caller sizes its own export buffer with pmu_sampling_export_zperf_size()
	  (header + 24 bytes per stored sample); there is no separate maximum.

config ARM64_PMU_OVERFLOW_IRQ
	int "PMU overflow GIC IRQ (INTID) when no devicetree node"
	default -1
	help
	  When negative, the interrupt number is taken from the first enabled
	  arm,armv8-pmu devicetree node. Otherwise this INTID is used (board-specific).

endif # PROFILING_PMU_SAMPLING
```

## subsys/rc/protocols/Kconfig
```kconfig
# SPDX-FileCopyrightText: Copyright (c) 2026 Linumiz
# SPDX-License-Identifier: Apache-2.0

menu "Protocols"

config RC_PROTOCOL_NEC
	bool "NEC protocol"
	default y
	help
	  Decoder and encoder for NEC, extended NEC and 32 bit NEC.

config RC_PROTOCOL_RC5
	bool "RC5 protocol"
	default y
	help
	  Decoder and encoder for Philips RC5 and 20 bit RC5X.

config RC_PROTOCOL_RC6
	bool "RC6 protocol"
	default y
	help
	  Decoder and encoder for Philips RC6 mode 0, mode 6A with 20, 24 and
	  32 bits, and the MCE variant of 6A 32 bit.

endmenu
```

## subsys/testsuite/Kconfig.coverage
```kconfig
# SPDX-License-Identifier: Apache-2.0
# Copyright The Zephyr Project Contributors
#
menu "Coverage"

config HAS_COVERAGE_SUPPORT
	bool
	help
	  The code coverage report generation is only available on boards
	  with enough spare RAM to buffer the coverage data, or on boards
	  based on the POSIX ARCH.

config COVERAGE
	bool "Create coverage data"
	depends on HAS_COVERAGE_SUPPORT
	help
	  This option will build your application with the -coverage option
	  which will generate data that can be used to create coverage reports.
	  For more information see
	  https://docs.zephyrproject.org/latest/develop/test/coverage.html

choice
	prompt "Coverage mode"
	default COVERAGE_NATIVE_GCOV if NATIVE_BUILD
	default COVERAGE_GCOV if !NATIVE_BUILD
	depends on COVERAGE

config COVERAGE_NATIVE_GCOV
	bool "Host compiler gcov based code coverage"
	depends on NATIVE_BUILD
	help
	  Build natively with the compiler standard `--coverage` options,
	  that is with gcov/GCC-compatible coverage

config COVERAGE_NATIVE_SOURCE
	bool "Host compiler source based code coverage"
	depends on NATIVE_BUILD
	depends on "$(TOOLCHAIN_VARIANT_COMPILER)" = "llvm"
	help
	  Build natively with the compiler source based coverage options.
	  Today this is only supported with LLVM

config COVERAGE_GCOV
	bool "Create Coverage data from hardware platform"
	depends on !NATIVE_BUILD
	help
	  This option will select the custom gcov library. The reports will
	  be available over serial. This serial dump can be passed to
	  gen_gcov_files.py which creates the required .gcda files. These
	  can be read by gcov utility. For more details see gcovr.com .

endchoice

config COVERAGE_GCOV_HEAP_SIZE
	int "Size of heap allocated for gcov coverage data dump"
	depends on COVERAGE_GCOV
	default 65536 if X86 || SOC_SERIES_MPS2
	default 16384
	help
	  This option configures the heap size allocated for gcov coverage
	  data to be dumped over serial. If the value is 0, no buffer will be used,
	  data will be dumped directly over serial. With clang only the semihost
	  dump uses this heap and it must not be 0, the console dump always
	  prints directly.

if COVERAGE_GCOV

config COVERAGE_GCOV_LLVM
	bool
	default y if "$(TOOLCHAIN_VARIANT_COMPILER)" = "llvm"
	default y if "$(ZEPHYR_TOOLCHAIN_VARIANT)" = "llvm"
	default y if "$(ZEPHYR_TOOLCHAIN_VARIANT)" = "xt-clang"
	select STATIC_INIT_GNU
	help
	  Use the gcov runtime for code built with clang, which implements the
	  llvm_gcda_*() hooks that clang --coverage calls instead of the GCC gcov
	  interface. Objects register themselves from constructors, so this
	  needs STATIC_INIT_GNU.

config COVERAGE_GCOV_LLVM_MAX_OBJECTS
	int "Maximum number of instrumented objects with clang"
	depends on COVERAGE_GCOV_LLVM
	default 256
	help
	  Clang registers every object built with --coverage, including objects
	  excluded with -fprofile-filter-files, which contribute no data.
	  Objects past this limit are left out of the coverage data and a
	  warning is printed at the start of the dump.

choice COVERAGE_DUMP_METHOD
	prompt "Method to dump coverage data"
	default COVERAGE_DUMP

config COVERAGE_DUMP
	bool "Dump coverage data to console on exit"
	help
	  Dump collected coverage information to console on exit.

config COVERAGE_SEMIHOST
	bool "Use semihosting to write coverage data"
	depends on SEMIHOST
	help
	  Use semihosting to write coverage data to a file on the host.

endchoice

endif # COVERAGE_GCOV

config FORCE_COVERAGE
	bool "Force coverage"
	select HAS_COVERAGE_SUPPORT
	help
	  Regardless of platform support, it will enable coverage data production.
	  If the platform does not support coverage by default, setting this config
	  does not guarantee that coverage data will be gathered.
	  Application may not fit memory or crash at runtime.

config COVERAGE_DUMP_PATH_EXCLUDE
	string "Exclude files matching this pattern from the coverage data"
	default ""
	help
	  Filenames are matched against the pattern using the POSIX fnmatch
	  function. Filenames are based on their path in the build folder, not the
	  original source tree. The empty string "" disables the pattern
	  matching.

endmenu
```

## subsys/usb/device_next/class/Kconfig.cdc_acm
```kconfig
# Copyright (c) 2022 Nordic Semiconductor ASA
#
# SPDX-License-Identifier: Apache-2.0

config USBD_CDC_ACM_CLASS
	bool "USB CDC ACM implementation"
	depends on SERIAL
	depends on DT_HAS_ZEPHYR_CDC_ACM_UART_ENABLED
	select SERIAL_HAS_DRIVER
	select SERIAL_SUPPORT_INTERRUPT
	select UART_INTERRUPT_DRIVEN
	default y
	help
	  USB device CDC ACM class implementation.

if USBD_CDC_ACM_CLASS

config USBD_CDC_ACM_WORKQUEUE
	bool "Use dedicated workqueue in CDC ACM"
	help
	  Use the dedicated queue in CDC ACM implementation if the system work
	  queue cannot be used due to performance issues or other conflicts.

config USBD_CDC_ACM_STACK_SIZE
	int "USB CDC ACM workqueue stack size"
	depends on USBD_CDC_ACM_WORKQUEUE
	default 1024
	help
	  USB CDC ACM workqueue stack size.

config USBD_CDC_ACM_WORKQUEUE_PRIORITY
	int "USB CDC ACM workqueue priority"
	depends on USBD_CDC_ACM_WORKQUEUE
	default SYSTEM_WORKQUEUE_PRIORITY
	help
	  USB CDC ACM workqueue thread priority. A preemptible priority below
	  that of the threads writing to the port lets their writes accumulate
	  into fewer, larger USB transfers.

config USBD_CDC_ACM_TX_BUF_SIZE
	int "Size of one TX FIFO buffer"
	default 512 if USBD_MAX_SPEED_HIGH
	default 64
	help
	  Size in bytes of one buffer of the TX FIFO. Each buffer is sent in
	  one bulk IN transfer. The default is the bulk endpoint maximum packet
	  size. A larger buffer lets the device controller driver send several
	  packets in one transfer, which reduces the processing time per byte,
	  mostly on full-speed devices. The value must be a multiple of the
	  bulk endpoint maximum packet size. The tx-fifo-size property must
	  hold at least two buffers.

config USBD_CDC_ACM_TX_DELAY_MS
	int
	default 100
	help
	  Time in milliseconds to wait before sending actual payload to host.
	  This is needed to prevent tty ECHO on Linux.

module = USBD_CDC_ACM
module-str = usbd cdc_acm
default-count = 1
source "subsys/logging/Kconfig.template.log_config"

endif
```

## subsys/usb/host/Kconfig
```kconfig
# Copyright (c) 2022 Nordic Semiconductor ASA
#
# SPDX-License-Identifier: Apache-2.0

menuconfig USB_HOST_STACK
	bool "USB host stack [EXPERIMENTAL]"
	select EXPERIMENTAL
	select UHC_DRIVER
	help
	  New experimental USB host stack.

if USB_HOST_STACK

module = USBH
module-str = usbh
source "subsys/logging/Kconfig.template.log_config"

config USBH_USB_DEVICE_MAX
	int "Maximum number of USB devices supported."
	default 4
	range 2 127
	help
	  Maximum number of USB devices supported for all controllers.

config USBH_USB_DEVICE_HEAP
	int "Memory used to cache device descriptors"
	default 1024
	range 256 16384
	help
	  Memory used to cache device descriptors.

config USBH_SHELL
	bool "USB host shell"
	depends on SHELL
	help
	  Shell commands for USB host support.

config USBH_INIT_PRIO
	int
	default 90
	help
	  USB host thread initialization priority level.

config USBH_MAX_UHC_MSG
	int "Maximum number of UHC events"
	default 10
	help
	  Maximum number of UHC events that can be queued.

rsource "Kconfig.usbip"
rsource "Kconfig.msc"
rsource "class/Kconfig"

config USBH_STACK_SIZE
	int "USB host stack thread stack size"
	default 8192 if USBH_MSC_DISK_PARTITION
	default 4096 if USBH_MSC_DISK
	default 1024
	help
	  Stack size in bytes for the USB host worker threads (main and bus).

	  MSC storage bringup with partition discovery runs on the host thread
	  and calls disk_partition helpers; that path needs roughly 1.5 KiB for
	  the partition table plus a sector buffer on top of SCSI/BOT frames.
	  Keep at least 8192 when USBH_MSC_DISK_PARTITION is enabled.

config USBH_USB2_ENUM_SCHEME
	bool "USB2 enumeration (64-byte GET_DESCRIPTOR before SET_ADDRESS)"
	default n
	help
	  USB2 enumeration order in usbh_device_init() with optional HCD
	  uhc_device_address instead of legacy SET_ADDRESS.

config USBH_USB2_ENUM_SECOND_RESET
	bool "Second bus reset after first GET_DESCRIPTOR"
	default n
	depends on USBH_USB2_ENUM_SCHEME

config USBH_POST_SET_ADDRESS_MS
	int "Milliseconds to delay after SET_ADDRESS"
	default 10
	range 0 500
	depends on USBH_USB2_ENUM_SCHEME

config USBH_GET_DESCRIPTOR_TRIES
	int "GET_DESCRIPTOR retry count"
	default 2
	range 1 5
	depends on USBH_USB2_ENUM_SCHEME

config USBH_SET_ADDRESS_TRIES
	int "SET_ADDRESS retry count"
	default 2
	range 1 5
	depends on USBH_USB2_ENUM_SCHEME

config USBH_ENUM_RETRY_DELAY_MS
	int "Milliseconds between GET_DESCRIPTOR retries"
	default 100
	range 0 500
	depends on USBH_USB2_ENUM_SCHEME

config USBH_GET_DESCRIPTOR_ROOT_RESET
	bool "Root default-state reset before retrying GET_DESCRIPTOR"
	default y
	depends on USBH_USB2_ENUM_SCHEME
	help
	  On the root tier, after bounded delay-only retries of the initial
	  64-byte GET_DESCRIPTOR fail with a retryable transfer error, call
	  uhc_root_default_state_reset() once, reapply the EP0 MPS0 guess, and
	  issue one final initial GET_DESCRIPTOR. Hub children use delay-only
	  retries without a root default-state transition. Does not recover the
	  full 18-byte device descriptor after SET_ADDRESS.

config USBH_SET_ADDRESS_RETRY_DELAY_MS
	int "Milliseconds between SET_ADDRESS retries"
	default 200
	range 0 500
	depends on USBH_USB2_ENUM_SCHEME

config USBH_POST_SET_CONFIGURATION_MS
	int "Milliseconds to delay after SET_CONFIGURATION before full cfg read"
	default 0
	range 0 500

endif # USB_HOST_STACK
```

## subsys/usb/host/class/Kconfig.bt_hci
```kconfig
# SPDX-FileCopyrightText: Copyright The Zephyr Project Contributors
# SPDX-License-Identifier: Apache-2.0

config USBH_BT_HCI
	bool "USB host Bluetooth HCI transport [EXPERIMENTAL]"
	default y
	depends on DT_HAS_ZEPHYR_BT_HCI_USBH_ENABLED
	depends on BT_HCI
	select EXPERIMENTAL
	help
	  Bluetooth HCI driver for a USB Bluetooth controller (Wireless
	  Controller class 0xE0/0x01/0x01) attached to the USB host. HCI
	  commands, events and ACL data are supported, synchronous data
	  over the isochronous endpoints is not.

if USBH_BT_HCI

config USBH_BT_HCI_OPEN_TIMEOUT
	int "Time to wait for a controller when opening the transport (ms)"
	default 5000
	help
	  Opening the HCI transport waits this long for a USB Bluetooth
	  controller to be connected and enumerated before it fails.

config USBH_BT_HCI_RX_STACK_SIZE
	int "RX thread stack size"
	default 1024
	help
	  Stack size of the thread that reassembles HCI events and ACL data
	  from the IN endpoints and delivers them to the Bluetooth host.

module = USBH_BT_HCI
module-str = usbh bt hci
source "subsys/logging/Kconfig.template.log_config"

endif # USBH_BT_HCI
```
