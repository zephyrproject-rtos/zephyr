## subsys/mgmt/ec_host_cmd/Kconfig
```kconfig
# Host command handler functionality

# Copyright (c) 2020 Google LLC
# SPDX-License-Identifier: Apache-2.0

menu "Host command handler subsystem"

config EC_HOST_CMD
	bool "Support Embedded Controller host command handler subsystem"
	help
	  Enable host command processing for embedded controllers on notebook
	  computers.

if EC_HOST_CMD

module = EC_HC
module-str = ec-host-commands
source "subsys/logging/Kconfig.template.log_config"

config EC_HOST_CMD_HANDLER_STACK_SIZE
	int "Stack size for the EC host command handler thread"
	default 800

config EC_HOST_CMD_HANDLER_TX_BUFFER_SIZE
	int "Buffer size in bytes for TX buffer shared by all EC host commands"
	default 0 if EC_HOST_CMD_BACKEND_ESPI
	default 0 if EC_HOST_CMD_BACKEND_SHI
	default 256 if EC_HOST_CMD_BACKEND_UART
	default 552 if EC_HOST_CMD_BACKEND_SPI
	default 256
	help
	  Buffer size in bytes for TX buffer defined by the host command handler.
	  Some backend layers can define their own buffer, so the size can be zero to
	  avoid duplicating buffers. If multiple backends are used, the size has to be
	  set by user to the largest one.

config EC_HOST_CMD_HANDLER_RX_BUFFER_SIZE
	int "Buffer size in bytes for RX buffer shared by all EC host commands"
	default 256 if EC_HOST_CMD_BACKEND_ESPI
	default 0 if EC_HOST_CMD_BACKEND_SHI
	default 544 if EC_HOST_CMD_BACKEND_UART
	default 544 if EC_HOST_CMD_BACKEND_SPI
	default 256
	help
	  Buffer size in bytes for TX buffer defined by the host command handler.
	  Some backend layers can define their own buffer, so the size can be zero to
	  avoid duplicating buffers. If multiple backends are used, the size has to be
	  set by user to the largest one.

config EC_HOST_CMD_HANDLER_BUFFER_ALIGN
	int "Memory alignment for the tx/rx buffers"
	default DCACHE_LINE_SIZE if (DCACHE_LINE_SIZE > 0) && EC_HOST_CMD_BACKEND_USB
	default 4
	help
	  Some interfaces need a special memory alignment to work properly. Use that config
	  to specify the alignment.

config EC_HOST_CMD_HANDLER_PRIO
	int "Priority of host command task"
	default 13
	help
	  Priority of the kernel task that handles the host commands.
	  If the priority is too low (high in value), the host commands handler may be unable to
	  process the command on time and the AP will abort the waiting for response and be unable
	  to boot the system properly.

config EC_HOST_CMD_INIT_PRIORITY
	int "Initialization priority"
	default 80
	range 0 99
	help
	  Initialization priority for Host Command. It must be higher than the initialization
	  priority of the used backend device.

config EC_HOST_CMD_HANDLER_TX_BUFFER_DEF
	bool
	default y if EC_HOST_CMD_HANDLER_TX_BUFFER_SIZE > 0
	help
	  The handler defines common tx buffer

config EC_HOST_CMD_HANDLER_RX_BUFFER_DEF
	bool
	default y if EC_HOST_CMD_HANDLER_RX_BUFFER_SIZE > 0
	help
	  The handler defines common rx buffer

config EC_HOST_CMD_NOCACHE_BUFFERS
	bool "Place RX and TX buffers in __nocache section"
	default y if DCACHE && DMA
	depends on EC_HOST_CMD_HANDLER_TX_BUFFER_DEF || EC_HOST_CMD_HANDLER_RX_BUFFER_DEF
	help
	  DMA is often use for communication, however it usually requires
	  uncached memory. Add possibility to place the RX and TX buffers in the
	  __nocache section.

config EC_HOST_CMD_INITIALIZE_AT_BOOT
	bool "Initialize the host command subsystem automacitlly"
	default y
	help
	  Automatically initialize the host command subsystem with the chosen backend.
	  The ec_host_cmd_init function is called by the chosen backend.

config EC_HOST_CMD_DEDICATED_THREAD
	bool "Create a new task for host command"
	help
	  The ec_host_cmd_init function creates a new thread dedicated for Host Command.
	  Otherwise the ec_host_cmd_task function has to be called within another thread.

config EC_HOST_CMD_IN_PROGRESS_STATUS
	bool "Save status of last IN_PROGRESS command"
	default y if EC_HOST_CMD_BACKEND_SHI
	help
	  Enable support for saving final status of a last command that has sent
	  EC_HOST_CMD_IN_PROGRESS status. The saved status can be get with the
	  ec_host_cmd_send_in_progress_status function.

menuconfig EC_HOST_CMD_RATE_LIMITING
	bool "Rate limit continuous host command bursts"
	default y
	help
	  Limit continuous bursts of host commands by inserting a short recess
	  delay before sending a response once commands have been processed
	  continuously without a sufficient idle gap. This allows lower-priority
	  threads (such as watchdog feeders) to run during host command storms.

if EC_HOST_CMD_RATE_LIMITING

config EC_HOST_CMD_RATE_LIMITING_PERIOD_MS
	int "Continuous burst period before recess (ms)"
	default 500
	range 1 60000
	help
	  Duration in milliseconds of continuous host command processing without
	  an idle gap exceeding EC_HOST_CMD_RATE_LIMITING_MIN_REST_MS before
	  inserting a recess delay.

config EC_HOST_CMD_RATE_LIMITING_MIN_REST_MS
	int "Minimum idle gap to reset burst window (ms)"
	default 3
	range 1 60000
	help
	  Minimum idle time in milliseconds between the completion of the
	  previous host command response and the reception of the next host
	  command required to reset the continuous burst window.

config EC_HOST_CMD_RATE_LIMITING_RECESS_MS
	int "Recess delay inserted on sustained bursts (ms)"
	default 20
	range 1 1000
	help
	  Duration in milliseconds to sleep before sending the response when
	  continuous host command processing exceeds
	  EC_HOST_CMD_RATE_LIMITING_PERIOD_MS.

endif # EC_HOST_CMD_RATE_LIMITING

source "subsys/mgmt/ec_host_cmd/Kconfig.logging"
source "subsys/mgmt/ec_host_cmd/backends/Kconfig"

endif # EC_HOST_CMD

endmenu
```

## subsys/micro_core/Kconfig
```kconfig
# Copyright (c) 2026 Mahdi Sahebi
# SPDX-License-Identifier: Apache-2.0

menuconfig MC
	bool "Micro Core communication"
	default n
	help
	  Enable the experimental Micro Core communication service.

if MC

config MC_COMM
	bool "Reliable framed communication"
	select CRC
	default y
	help
	  Enable framed, acknowledged payload transfer using application-owned
	  storage and application-provided transport callbacks.

endif
```

## subsys/net/lib/ice/Kconfig
```kconfig
# SPDX-FileCopyrightText: 2026 Muhammad Waleed Badar
# SPDX-License-Identifier: Apache-2.0

menuconfig ICE_LITE
	bool "ICE-lite agent [EXPERIMENTAL]"
	select EXPERIMENTAL
	select STUN
	select CSPRNG_NEEDED
	help
	  Lite implementation of ICE (RFC 8445): answers the connectivity
	  checks of a full ICE agent and reports the address it nominates.
	  The agent does no I/O.

if ICE_LITE

config ICE_LITE_UFRAG_LEN
	int "Length of the username fragment"
	default 8
	range 4 256
	help
	  Number of characters of the username fragment of an agent, 6 bits of
	  randomness each. RFC 8445 section 5.3 asks for 24 bits at least, 4
	  characters, and the SDP grammar allows 256 at most.

config ICE_LITE_PWD_LEN
	int "Length of the password"
	default 24
	range 22 32
	help
	  Number of characters of the password of an agent, 6 bits of
	  randomness each. RFC 8445 section 5.3 asks for 128 bits at least, 22
	  characters. The password is the HMAC key of the integrity checks, and
	  a PSA key slot holds 32 bytes when the key material is stored
	  statically (MBEDTLS_PSA_STATIC_KEY_SLOTS), hence the upper bound.

module = ICE_LITE
module-dep = NET_LOG
module-str = Log level for ICE-lite
module-help = Enable the log of the ICE-lite agent.
source "subsys/net/Kconfig.template.log_config.net"

endif # ICE_LITE
```

## subsys/net/lib/stun/Kconfig
```kconfig
# SPDX-FileCopyrightText: Copyright The Zephyr Project Contributors
# SPDX-FileCopyrightText: Copyright (c) 2026 Kirill Shypachov
# SPDX-License-Identifier: Apache-2.0

menuconfig STUN
	bool "STUN (Session Traversal Utilities for NAT) library [EXPERIMENTAL]"
	select EXPERIMENTAL
	select PSA_CRYPTO
	select CRC
	select UTF8
	imply PSA_WANT_ALG_HMAC
	imply PSA_WANT_KEY_TYPE_HMAC
	imply PSA_WANT_ALG_SHA_1
	imply PSA_WANT_ALG_SHA_256
	help
	  STUN message codec as defined in RFC 8489: parsing and building of
	  messages, the MESSAGE-INTEGRITY and MESSAGE-INTEGRITY-SHA256
	  attributes (computed through the PSA Crypto API), FINGERPRINT and
	  the attributes ICE (RFC 8445) adds. The library does no I/O.

	  Both integrity attributes need HMAC of the PSA Crypto API,
	  MESSAGE-INTEGRITY with SHA-1 and MESSAGE-INTEGRITY-SHA256 with
	  SHA-256. All of it is enabled by default. The functions that
	  compute or verify an attribute return -EIO if the backend lacks
	  what the attribute needs.

if STUN

module = STUN
module-dep = NET_LOG
module-str = Log level for STUN
module-help = Enable the log of the STUN library.
source "subsys/net/Kconfig.template.log_config.net"

config STUN_CLIENT
	bool "STUN client over UDP sockets"
	depends on NET_SOCKETS && NET_UDP
	select CSPRNG_NEEDED
	help
	  The Binding transaction, which does no I/O, and blocking calls that
	  run it over a UDP socket to ask a STUN server for the address it
	  sees this device at, on a socket of the caller or on one opened for
	  the purpose. The transaction id of a request has to be unpredictable
	  (RFC 8489 section 5), so the client needs a cryptographically
	  secure random number generator. A server given by host name, not
	  by literal address, also needs DNS_RESOLVER.

if STUN_CLIENT

config STUN_CLIENT_SOFTWARE
	string "SOFTWARE attribute of the client's requests"
	default "Zephyr"
	help
	  What the client describes itself as to the server (RFC 8489
	  sections 6.1 and 14.14), at most 96 bytes. Leave it empty to send
	  no SOFTWARE attribute; a version number here tells an observer what
	  to attack.

config STUN_CLIENT_RX_BUF_SIZE
	int "Size of the client's receive buffer"
	default 576
	range 128 1500
	help
	  The client receives into a buffer of this size on the stack of its
	  caller. A STUN message over UDP is meant to stay below 576 bytes
	  (RFC 8489 section 6.1); a response to a Binding request is some
	  100 to 200 bytes with the attributes servers add to it. A datagram
	  that does not fit is not taken for an answer, and the query ends
	  with a timeout.

config STUN_BINDING_RTO_MS
	int "Initial retransmission timeout of a Binding request, in milliseconds"
	default 500
	range 500 60000
	help
	  How long a Binding transaction waits for the answer before it sends
	  the request a second time. The wait doubles with every further
	  transmission (RFC 8489 section 6.2.1, which asks for 500 ms or
	  more).

config STUN_BINDING_MAX_TRANSMITS
	int "Number of times a Binding request is sent"
	default 7
	range 1 16
	help
	  Rc of RFC 8489 section 6.2.1: how many times a Binding transaction
	  sends its request, the first transmission included, while no answer
	  arrives.

config STUN_BINDING_FINAL_WAIT_RTO
	int "Wait after the last transmission, in initial timeouts"
	default 16
	range 1 255
	help
	  Rm of RFC 8489 section 6.2.1: after its last transmission a Binding
	  transaction waits this many times STUN_BINDING_RTO_MS for the
	  answer and then fails. With the defaults of the three options a
	  transaction that gets no answer lasts 39.5 seconds.

endif # STUN_CLIENT

config STUN_SHELL
	bool "STUN shell commands"
	depends on STUN_CLIENT && NET_SHELL
	help
	  Add "net stun" to the network shell: "net stun server" names the
	  STUN server to ask, "net stun query" asks it for the address it
	  sees this device at and prints the answer. The query runs in the
	  thread of the shell and takes some 2.5 KB of its stack on a 32-bit
	  target, so SHELL_STACK_SIZE defaults to 4096 with this option.

endif # STUN
```
