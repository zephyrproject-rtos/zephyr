## subsys/usb/host/class/Kconfig.msc
```kconfig
# Copyright (c) 2026 Espressif Systems (Shanghai) Co., Ltd.
# SPDX-License-Identifier: Apache-2.0

config USBH_MSC
	bool "USB host mass storage class support [EXPERIMENTAL]"
	select EXPERIMENTAL
	help
	  Enable the USB host Mass Storage class driver. It implements the
	  Bulk-Only Transport and the SCSI commands needed for block access
	  to the first logical unit of an attached device.

if USBH_MSC

config USBH_MSC_DEVICE_COUNT
	int "Number of mass storage devices supported at once"
	default $(dt_compat_enabled_num,$(DT_COMPAT_ZEPHYR_USB_MSC_DISK)) if $(dt_compat_enabled,$(DT_COMPAT_ZEPHYR_USB_MSC_DISK))
	default 1
	range 1 8
	help
	  Number of attached mass storage devices the host can use
	  simultaneously. The buffer pool is split between them.

config USBH_MSC_MAX_BLOCK_SIZE
	int "Largest supported logical block size"
	default FS_FATFS_MAX_SS if FAT_FILESYSTEM_ELM
	default 512
	range 512 4096
	help
	  Media that report a larger logical block size are not used.
	  The default follows the largest sector size of the FAT file
	  system when it is enabled.

config USBH_MSC_STACK_SIZE
	int "Mass storage work queue stack size"
	default 1536
	help
	  Stack size of the work queue that identifies attached media and
	  polls removable ones.

config USBH_MSC_THREAD_PRIORITY
	int "Mass storage work queue priority"
	default 9
	help
	  Priority of the work queue that identifies attached media and
	  polls removable ones.

config USBH_MSC_XFER_TIMEOUT_MS
	int "Bulk transfer timeout in milliseconds"
	default 5000
	help
	  Time to wait for a bulk transfer of a command, data or status
	  wrapper to complete before the command fails.

config USBH_MSC_UNIT_READY_INTERVAL_MS
	int "Medium ready poll interval in milliseconds"
	default 100
	range 10 10000
	help
	  Interval between TEST UNIT READY commands while the medium of
	  an attached device is becoming ready. A device without a
	  medium is also polled at this interval when
	  USBH_MSC_MEDIUM_POLL_INTERVAL_MS is 0.

config USBH_MSC_MEDIUM_POLL_INTERVAL_MS
	int "Removable medium poll interval in milliseconds"
	default 1000
	range 0 60000
	help
	  Interval between TEST UNIT READY commands sent to a ready
	  removable medium to detect that it was removed or changed,
	  and to a device without a medium to detect that one was
	  inserted. 0 disables polling of a ready medium, a change is
	  then detected by the next command that fails, and a device
	  without a medium is polled at USBH_MSC_UNIT_READY_INTERVAL_MS.

module = USBH_MSC
module-str = usbh msc
source "subsys/logging/Kconfig.template.log_config"

endif # USBH_MSC
```

## subsys/usb/usb_c/pdfu/Kconfig
```kconfig
# Copyright (c) 2026 Meta Platforms, Inc.
# SPDX-License-Identifier: Apache-2.0

config USBC_PDFU_RESPONDER
	bool "USB PD Firmware Update responder"
	depends on USBC_CHUNKING
	help
	  The PDFU Responder role from the USB Power Delivery Firmware Update
	  Specification, Revision 1.0: the device being updated. Firmware
	  arrives over the PD connection as Extended Messages, so chunking is
	  required. Storage and identity are left to the application, through
	  struct pdfu_ops in <zephyr/usb_c/pdfu.h>.

config USBC_PDFU_INITIATOR
	bool "USB PD Firmware Update initiator"
	depends on USBC_CHUNKING
	help
	  The PDFU Initiator role: pushes an image to a PDFU Responder on the
	  other end of the PD connection, from a source the application
	  provides through struct pdfu_image_src in
	  <zephyr/usb_c/pdfu_initiator.h>. It can also inject faults, for
	  testing a responder's error paths.

if USBC_PDFU_RESPONDER || USBC_PDFU_INITIATOR

module = USBC_PDFU
module-str = usbc pdfu
source "subsys/logging/Kconfig.template.log_config"

endif # USBC_PDFU_RESPONDER || USBC_PDFU_INITIATOR
```

## tests/arch/arm/arm_stack_overflow/Kconfig
```kconfig
# Copyright The Zephyr Project Contributors
# SPDX-License-Identifier: Apache-2.0

mainmenu "Cortex-A/R stack overflow report test"

choice TEST_OVERFLOW
	prompt "What hits the stack guard"

config TEST_OVERFLOW_PUSH
	bool "A push in thread code, then the data abort entry"

config TEST_OVERFLOW_PUSH_PARTIAL
	bool "A push in thread code, then two data abort entries after their SRS"

config TEST_OVERFLOW_PUSH_FRAME
	bool "A push in thread code, then the data abort entry after its frame push"

config TEST_OVERFLOW_SVC
	bool "The SVC entry"

config TEST_OVERFLOW_IRQ
	bool "The IRQ entry"

config TEST_OVERFLOW_IRQ_PARTIAL
	bool "The IRQ entry after its SRS, then the data abort entry"

config TEST_OVERFLOW_IRQ_FRAME
	bool "The IRQ entry after its frame push"

config TEST_OVERFLOW_UNDEF
	bool "The undefined instruction entry"

config TEST_OVERFLOW_PABT
	bool "The prefetch abort entry"

endchoice

source "Kconfig.zephyr"
```

## tests/arch/arm64/arm64_gicv3_its/Kconfig
```kconfig
# SPDX-FileCopyrightText: Copyright (c) 2026 Process Mission
# SPDX-License-Identifier: Apache-2.0

config TEST_GICV3_ITS_SMALL_LPI_POOL
	bool "Test concurrent allocation from a small LPI pool"
	select SCHED_CPU_MASK if SMP

config NUM_IRQS
	default 8200 if TEST_GICV3_ITS_SMALL_LPI_POOL

source "Kconfig.zephyr"
```

## tests/arch/riscv/soc_reset_hook/Kconfig
```kconfig
# Copyright (c) Qualcomm Technologies, Inc. and/or its subsidiaries.
# SPDX-License-Identifier: Apache-2.0

config TEST_RISCV_SOC_RESET_HOOK
	bool
	default y
	select SOC_RESET_HOOK
	help
	  Enable the soc_reset_hook() call in the RISC-V startup code. The hook
	  is provided by the test.

source "Kconfig.zephyr"
```

## tests/bluetooth/classic/discovery/dts/bindings/zephyr,bt-hci-test.yaml
```yaml
# Copyright 2026 Xiaomi Corporation
# SPDX-License-Identifier: Apache-2.0

description: |
  Bluetooth HCI for test purposes, with a controller emulated by the test.

compatible: "zephyr,bt-hci-test"

include: bt-hci.yaml

properties:
  bt-hci-name:
    default: "test"
  bt-hci-bus:
    default: "virtual"
```

## tests/bluetooth/classic/l2cap_br_timeouts/dts/bindings/zephyr,bt-hci-test.yaml
```yaml
description: Scripted Bluetooth HCI controller for L2CAP timeout tests

compatible: "zephyr,bt-hci-test"

include: bt-hci.yaml

properties:
  bt-hci-name:
    default: "test"
  bt-hci-bus:
    default: "virtual"
  bt-hci-quirks:
    default: ["no-reset"]
```

## tests/bluetooth/classic/rfcomm_rx_completion/dts/bindings/zephyr,bt-hci-test.yaml
```yaml
description: Simulated Bluetooth HCI controller for RFCOMM receive tests

compatible: "zephyr,bt-hci-test"

include: bt-hci.yaml

properties:
  bt-hci-name:
    default: "test"
  bt-hci-bus:
    default: "virtual"
```

## tests/bluetooth/host_keys_br/dts/bindings/zephyr,bt-hci-test.yaml
```yaml
# SPDX-FileCopyrightText: Copyright 2026 NXP
# SPDX-License-Identifier: Apache-2.0

description: Bluetooth HCI for link key tests

compatible: "zephyr,bt-hci-test"

include: bt-hci.yaml

properties:
  bt-hci-name:
    default: "test"
  bt-hci-bus:
    default: "virtual"
  bt-hci-quirks:
    default: ["no-reset"]
```
