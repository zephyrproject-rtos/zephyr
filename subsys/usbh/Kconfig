## subsys/usbh/Kconfig
```kconfig
# Copyright (c) 2020 PHYTEC Messtechnik GmbH
# SPDX-License-Identifier: Apache-2.0

menuconfig USBH
	bool "USB Host Support"
	help
	  Enable USB host support.

if USBH

module = USBH
module-str = usbh
source "subsys/logging/Kconfig.template.log_config"

config USBH_MSC
	bool "USB Host Mass Storage Class Support"
	help
	  Enable USB Host Mass Storage Class Support.

endif # USBH
```

## subsys/uwb/uci_lib/Kconfig
```kconfig
# Copyright 2026 NXP
# SPDX-License-Identifier: Apache-2.0

if UWB

config UCI_FRAME_LEN
	int "Maximum buffer size of single UCI packet"
	default 259
	help
		Maximum buffer size of single UCI packet.

config UWB_READER_STACK_SIZE
	int "Stack size of UWB reader task"
	default 1500
	help
		Stack size of UWB reader task

config UWB_READER_PRIO
	int "UWB reader task priority"
	default 4
	help
		UWB reader task priority

config UCI_RESPONSE_TIMEOUT_MS
	int "Timeout to receive response after sending UCI command"
	default 200
	help
		Timeout to receive response after sending UCI command.

config UCI_CREDIT_NTF_TIMEOUT_MS
	int "Timeout to receive credit available notification after sending data packet"
	default 500
	help
		Timeout to receive credit available notification after sending data packet.

endif
```

## subsys/video/Kconfig
```kconfig
# Copyright The Zephyr Project Contributors
# SPDX-License-Identifier: Apache-2.0

menuconfig VIDEO
	bool "Video subsystem"
	select VIDEO_DRIVERS
	help
	  Enable support for the video subsystem as well as video drivers.

if VIDEO

module = VIDEO
module-str = video
source "subsys/logging/Kconfig.template.log_config"

config VIDEO_SHELL
	bool "Video shell"
	depends on SHELL
	depends on VIDEO
	help
	  This shell provides control and query commands for video drivers.

if VIDEO_SHELL

config VIDEO_SHELL_CTRL_NAME_SIZE
	int "Maximum size for the control string identifier"
	default 40
	help
	  Video controls have a human-friendly name that is converted into a string identifier.
	  This Kconfig controls the maximum size of the string identifier after which the name
	  would be truncated. The default value is enough for all standard control names.

endif # VIDEO_SHELL

endif # VIDEO
```

## subsys/wakeup_source/Kconfig
```kconfig
# Copyright (c) 2023 Bjarki Arge Andreasen
# SPDX-License-Identifier: Apache-2.0

menuconfig WAKEUP_SOURCE
	bool "Wakeup source"
	select EXPERIMENTAL

if WAKEUP_SOURCE

config WAKEUP_SOURCE_ID_SUPPORTED
	bool

config WAKEUP_SOURCE_IRQ_SUPPORTED
	bool

config WAKEUP_SOURCE_GPIO_SUPPORTED
	bool

module = WAKEUP_SOURCE
module-str = wakeup_source
source "subsys/logging/Kconfig.template.log_config"

endif
```

## subsys/wifi/Kconfig
```kconfig
# Kconfig - WiFi configuration options
#
# Copyright (c) 2018 UNISOC Corporation
#
# SPDX-License-Identifier: Apache-2.0
#

menu "WiFi"

config WIFIMGR
	bool "WiFi Manager"
	select WIFI
	select POSIX_API
	select PTHREAD_IPC
	select POSIX_MQUEUE
	help
	  Enable the WiFi Manager.
	  By default, WiFi manger is build as only a library.

if WIFIMGR

source "subsys/wifi/common/Kconfig"
source "subsys/wifi/ap/Kconfig"
source "subsys/wifi/sta/Kconfig"
source "subsys/wifi/shell/Kconfig"

config WIFIMGR_AUTORUN
	bool "WiFi Manager Autorun"
	select SHELL
	select NEWLIB_LIBC
	default n
	help
	  A example program that can autorun WiFi manger.

module = WIFIMGR
module-str = Log for wifi manager
source "subsys/logging/Kconfig.template.log_config"

endif # WIFIMGR

endmenu
```

## subsys/wifi/ap/Kconfig
```kconfig
# Kconfig - WiFi SoftAP configuration options
#
# Copyright (c) 2018 UNISOC Corporation
#
# SPDX-License-Identifier: Apache-2.0
#

config WIFIMGR_AP
	bool "Enable AP mode"
	default n
	help
	  Enable AP mode.

if WIFIMGR_AP

config WIFIMGR_LED_AP
	int "AP LED"
	default 3
	depends on WIFIMGR_LED
	help
	  Specify the AP LED.

endif # WIFIMGR_AP
```

## subsys/wifi/common/Kconfig
```kconfig
# Kconfig - WiFi common configuration options
#
# Copyright (c) 2018 UNISOC Corporation
#
# SPDX-License-Identifier: Apache-2.0
#

config WIFIMGR_CONFIG_SAVING
	bool "Enable Saving Config"
	select FCB
	select SETTINGS
	help
	  Enable Saving & Cleaning WiFi Configuration.

config WIFIMGR_PSK
	bool "Enable PSK calculation"
	depends on MBEDTLS
	depends on MBEDTLS_BUILTIN
	help
	  Enable PSK calculation.

config WIFIMGR_LED
	bool "Enable LED indiction"
	depends on LED
	help
	  Enable LED indiction of WiFi manger.

config WIFIMGR_LED_NAME
	string "LED device name"
	default "led"
	depends on WIFIMGR_LED
	help
	  Specify the LED device name.
```

## subsys/wifi/shell/Kconfig
```kconfig
# Kconfig - WiFi shell configuration options
#
# Copyright (c) 2018 UNISOC Corporation
#
# SPDX-License-Identifier: Apache-2.0
#

config WIFIMGR_SHELL
	bool "WiFi Manager SHELL"
	select SHELL
	select NEWLIB_LIBC
	default n
	help
	  A shell module that can interact with WiFi manger,
	  which provides corresponding commands to the console.
```

## subsys/wifi/sta/Kconfig
```kconfig
# Kconfig - WiFi Station configuration options
#
# Copyright (c) 2018 UNISOC Corporation
#
# SPDX-License-Identifier: Apache-2.0
#

config WIFIMGR_STA
	bool "Enable STA mode"
	default n
	help
	  Enable STA mode.

if WIFIMGR_STA

config WIFIMGR_LED_STA
	int "STA LED"
	default 2
	depends on WIFIMGR_LED
	help
	  Specify the STA LED.

config WIFIMGR_DHCPC
	bool "Enable DHCP client"
	select NETWORKING
	select NET_IPV4
	select NET_DHCPV4
	help
	  Start DHCP client by WiFi manger.

endif # WIFIMGR_STA
```

## subsys/zbus/Kconfig
```kconfig
# Copyright (c) 2022 Rodrigo Peixoto <rodrigopex@gmail.com>
# SPDX-License-Identifier: Apache-2.0

menuconfig ZBUS
	bool "ZBus support"
	depends on MULTITHREADING
	help
	  Enables support for Zephyr message bus.

if ZBUS

config ZBUS_PREFER_DYNAMIC_ALLOCATION
	bool "Set zbus to work with dynamic allocation using the system heap"
	default y

config ZBUS_CHANNELS_SYS_INIT_PRIORITY
	default 5
	int "The priority used during the SYS_INIT procedure."

config ZBUS_CHANNEL_NAME
	bool "Channel name field"

config ZBUS_CHANNEL_ID
	bool "Channel identifier field"

config ZBUS_OBSERVER_NAME
	bool "Observer name field"

config ZBUS_CHANNEL_PUBLISH_STATS
	bool "Channel publishing statistics (Timestamp and count)"

config ZBUS_MSG_SUBSCRIBER
	select NET_BUF
	bool "Message subscribers will receive all messages in sequence."

if ZBUS_MSG_SUBSCRIBER

choice ZBUS_MSG_SUBSCRIBER_BUF_ALLOC
	prompt "ZBus msg_subscribers buffer allocation"
	default ZBUS_MSG_SUBSCRIBER_BUF_ALLOC_DYNAMIC if ZBUS_PREFER_DYNAMIC_ALLOCATION
	default ZBUS_MSG_SUBSCRIBER_BUF_ALLOC_STATIC

config ZBUS_MSG_SUBSCRIBER_BUF_ALLOC_DYNAMIC
	bool "Use heap to allocate msg_subscriber buffers data"

config ZBUS_MSG_SUBSCRIBER_BUF_ALLOC_STATIC
	bool "Use fixed data size for msg_subscriber buffers pool"

endchoice

config ZBUS_MSG_SUBSCRIBER_NET_BUF_POOL_ISOLATION
	default n
	bool "Use isolated pools instead of only using the global pool."

config ZBUS_MSG_SUBSCRIBER_NET_BUF_POOL_SIZE
	default 16
	int "The count of net_buf available to be used simultaneously."

if ZBUS_MSG_SUBSCRIBER_BUF_ALLOC_STATIC

config ZBUS_MSG_SUBSCRIBER_NET_BUF_STATIC_DATA_SIZE
	int "The size of the biggest message used with ZBus."

endif # ZBUS_MSG_SUBSCRIBER_BUF_ALLOC_STATIC

endif # ZBUS_MSG_SUBSCRIBER

config ZBUS_RUNTIME_OBSERVERS
	bool "Runtime observers support."

if ZBUS_RUNTIME_OBSERVERS

choice ZBUS_RUNTIME_OBSERVERS_NODE_ALLOC
	prompt "ZBus runtime observers node allocation"
	default ZBUS_RUNTIME_OBSERVERS_NODE_ALLOC_DYNAMIC if ZBUS_PREFER_DYNAMIC_ALLOCATION
	default ZBUS_RUNTIME_OBSERVERS_NODE_ALLOC_STATIC

config ZBUS_RUNTIME_OBSERVERS_NODE_ALLOC_DYNAMIC
	bool "Use heap to allocate runtime observers node"

config ZBUS_RUNTIME_OBSERVERS_NODE_ALLOC_STATIC
	bool "Use a pool of runtime observers nodes"

config ZBUS_RUNTIME_OBSERVERS_NODE_ALLOC_NONE
	bool "Use user-provided runtime observers nodes"

endchoice

config ZBUS_RUNTIME_OBSERVERS_NODE_POOL_SIZE
	int "Runtime observer pool size"
	depends on ZBUS_RUNTIME_OBSERVERS_NODE_ALLOC_STATIC
	default 8

endif # ZBUS_RUNTIME_OBSERVERS

config ZBUS_PRIORITY_BOOST
	bool "ZBus priority boost algorithm"
	default y
	help
	  ZBus implements the Highest Locker Protocol that relies on the observers’ thread priority
	  to determine a temporary publisher priority.

config ZBUS_ASSERT_MOCK
	bool "ZBus assert mock for test purposes."
	help
	  This configuration enables the developer to change the _ZBUS_ASSERT behavior. When this configuration is
	  enabled, _ZBUS_ASSERT returns -EFAULT instead of assert. It makes it more straightforward to test invalid
	  parameters.


config HEAP_MEM_POOL_ADD_SIZE_ZBUS
	int "ZBus requested heap pool size."
	default 2048 if ZBUS_MSG_SUBSCRIBER_BUF_ALLOC_DYNAMIC && !ZBUS_RUNTIME_OBSERVERS_NODE_ALLOC_DYNAMIC
	default 1024 if !ZBUS_MSG_SUBSCRIBER_BUF_ALLOC_DYNAMIC && ZBUS_RUNTIME_OBSERVERS_NODE_ALLOC_DYNAMIC
	default 3072 if ZBUS_MSG_SUBSCRIBER_BUF_ALLOC_DYNAMIC && ZBUS_RUNTIME_OBSERVERS_NODE_ALLOC_DYNAMIC
	default 0
	help
	  Configures the available heap memory pool for ZBus.
	  The heap is used for various ZBus operations (especially required for dynamic buffer allocation for
	  message subscribers and runtime observers).
	  In case of dynamic net buffer allocation the heap must fit all data distributed via message subscribers.
	  Can be set manual, if more heap is required, or default heap size is too big for the soc.

module = ZBUS
module-str = zbus
source "subsys/logging/Kconfig.template.log_config"

endif # ZBUS
```

## subsys/zbus/multidomain/Kconfig
```kconfig
#
# Copyright (c) 2025 Nordic Semiconductor ASA
#
# SPDX-License-Identifier: Apache-2.0
#

menu "ZBus multidomain support"

config ZBUS_MULTIDOMAIN_MESSAGE_SIZE
	int "ZBus multidomain message size"
	default 256
	help
	  Configures the size of messages used in ZBus multidomain communication.
	  This setting affects the maximum size of messages that can be sent between domains.

config ZBUS_MULTIDOMAIN_CHANNEL_NAME_SIZE
	int "ZBus multidomain channel name size"
	default 32
	help
	  Configures the maximum size of channel names used in ZBus multidomain communication.
	  This setting affects how long channel names can be when communicating between domains.

config ZBUS_MULTIDOMAIN_PROXY_STACK_SIZE
	int "ZBus multidomain proxy stack size"
	default 1024
	help
	  Configures the stack size (in bytes) for the ZBus multidomain proxy agent thread.
	  This setting affects the memory allocation for the proxy agent's operations.

config ZBUS_MULTIDOMAIN_PROXY_PRIORITY
	int "ZBus multidomain proxy thread priority"
	default 7
	help
	  Configures the priority of the ZBus multidomain proxy agent thread.
	  This setting affects the scheduling of the proxy agent in relation to other threads.

config ZBUS_MULTIDOMAIN_SENT_MSG_POOL_SIZE
	int "ZBus multidomain sent message history size"
	default 4
	help
	  Configures the number of sent messages to keep simultaneously in the history pool for
	  tracking acknowledgments and retransmissions in the ZBus multidomain. If more messages
	  than this number are sent without acknowledgment, the new messages will be dropped.

config ZBUS_MULTIDOMAIN_SENT_MSG_ACK_TIMEOUT
	int "ZBus multidomain sent message initial acknowledgment timeout (ms)"
	default 10
	help
	  Configures the initial timeout (in milliseconds) to wait for an acknowledgment
	  of a sent message in the ZBus multidomain proxy agent. If an acknowledgment is
	  not received within this time, the message may be retransmitted with a exponential backoff

config ZBUS_MULTIDOMAIN_SENT_MSG_ACK_TIMEOUT_MAX
	int "ZBus multidomain sent message acknowledgment timeout maximum (ms)"
	default 1000
	help
	  Configures the maximum timeout (in milliseconds) for waiting for an acknowledgment
	  of a sent message in the ZBus multidomain proxy agent. This setting limits the exponential
	  backoff for retransmissions to prevent excessively long wait times.

config ZBUS_MULTIDOMAIN_MAX_TRANSMIT_ATTEMPTS
	int "ZBus multidomain maximum transmit attempts"
	default 10
	help
	  Configures the maximum number of attempts to transmit a message in the ZBus multidomain
	  proxy agent. If an acknowledgment is not received after this many attempts, the message
	  will be dropped. Setting this to 1 means no retransmissions will be attempted.

config ZBUS_MULTIDOMAIN_UART
	bool "ZBus multidomain UART backend"
	depends on UART_ASYNC_API
	help
	  Enables the ZBus multidomain UART backend, allowing for ZBus between domains over UART.
	  This feature is useful for systems that require inter-domain communication via UART.

if ZBUS_MULTIDOMAIN_UART

config ZBUS_MULTIDOMAIN_UART_BUF_COUNT
	int "ZBus multidomain UART buffer count"
	default 2
	range 2 128
	help
	  Configures the number of buffers used for the ZBus multidomain UART backend.
	  A minimum of 2 buffers is required for proper operation.

endif # ZBUS_MULTIDOMAIN_UART

config ZBUS_MULTIDOMAIN_IPC
	bool "ZBus multidomain IPC backend"
	depends on IPC_SERVICE
	help
	  Enables the ZBus multidomain IPC backend, allowing communication between domains over IPC.
	  This feature is useful for systems that require inter-domain communication via IPC.

module = ZBUS_MULTIDOMAIN
module-str = zbus_multidomain
source "subsys/logging/Kconfig.template.log_config"

endmenu # ZBus multidomain support
```

## subsys/zbus/proxy_agent/Kconfig
```kconfig
#
# Copyright (c) 2026 Nordic Semiconductor ASA
#
# SPDX-License-Identifier: Apache-2.0
#

config ZBUS_PROXY_AGENT_MAX_MESSAGE_SIZE
	int "Maximum message size"
	default 128
	help
	  Maximum size of a message in the ZBus proxy agent.

config ZBUS_PROXY_AGENT_MAX_CHANNEL_NAME_SIZE
	int "Maximum channel name size"
	default 32
	help
	  Maximum size of a channel name in the ZBus proxy agent.

config ZBUS_PROXY_AGENT_INIT_PRIORITY
	int "Proxy agent initialization priority"
	default 99
	help
	  Initialization priority for the ZBus proxy agent.

config ZBUS_PROXY_AGENT_WORK_QUEUE_STACK_SIZE
	int "Receive work queue stack size"
	default 1024
	help
	  Stack size for the ZBus proxy agent work queue thread. This thread is responsible for
	  publishing forwarded messages locally. If using listeners on the shadow channels, this stack
	  size should be large enough to accommodate the listener callbacks.

config ZBUS_PROXY_AGENT_WORK_QUEUE_PRIORITY
	int "Receive work queue priority"
	default 5
	help
	  Priority for the ZBus proxy agent work queue thread.

config ZBUS_PROXY_AGENT_RX_QUEUE_DEPTH
	int "Receive queue depth"
	default 4
	help
	  Number of proxy messages buffered per proxy agent before incoming
	  messages are dropped.

menuconfig ZBUS_PROXY_AGENT_IPC
	bool "ZBus proxy agent IPC backend"
	select IPC_SERVICE
	select MBOX
	help
	  Enables the ZBus proxy agent IPC backend, allowing communication between domains over IPC.

if ZBUS_PROXY_AGENT_IPC

config ZBUS_PROXY_AGENT_IPC_BIND_TIMEOUT_MS
	int "IPC endpoint bind timeout (milliseconds)"
	default 5000
	help
	  Maximum time to wait for the remote IPC endpoint to bind during initialization.

module = ZBUS_PROXY_AGENT_IPC
module-str = zbus_proxy_agent_ipc
source "subsys/logging/Kconfig.template.log_config"

endif # ZBUS_PROXY_AGENT_IPC

module = ZBUS_PROXY_AGENT
module-str = zbus_proxy_agent
source "subsys/logging/Kconfig.template.log_config"
```

## subsys/zio/Kconfig
```kconfig
#
# Copyright (c) 2019 Thomas Burdick
#
# SPDX-License-Identifier: Apache-2.0
#
menuconfig ZIO
	bool "Enable ZIO Driver Subsystem"
	help
	  Enable ZIO Driver Subsystem
```
