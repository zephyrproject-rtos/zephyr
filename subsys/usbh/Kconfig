## subsys/zvm/Kconfig
```kconfig
# Copyright 2024-2025 HNU-ESNL: Guoqi Xie, Chenglai Xiong, Xingyu Hu and etc.
# Copyright 2024-2025 openEuler SIG-Zephyr
# SPDX-License-Identifier: Apache-2.0

menuconfig ZVM
	bool "Zephyr Based Virtual Machine"
	default n
	select USERSPACE
	help
	  Enable Zephyr virtualization support.

if ZVM

source "subsys/zvm/vdev/Kconfig"

config ZVM_INIT_PRIORITY
	int "ZVM Initialization Priority"
	default 80
	help
	  Set the initialization priority for the ZVM module.

config MAX_VM_NUM
	int "Maximum Number of Simultaneous VMs"
	range 0 32
	default 2
	help
	  Define the maximum number of VMs that can run simultaneously in the ZVM hypervisor.

config MAX_VCPU_PER_VM
	int "Maximum Number of vCPUs per VM"
	range 1 4
	default 1
	help
	  Specify the maximum number of vCPUs that each VM can possess.

config ZVM_DEBUG_LOG_INFO
	bool "System Boot Info Logging"
	help
	  Enable logging of system boot information for debugging purposes.

config VM_DTB_FILE_INPUT
	bool "Parse DTB File for Linux VM"
	help
	  Enable parsing of the Device Tree Blob (DTB) file for Linux VMs.

endif # ZVM
```

## subsys/zvm/vdev/Kconfig
```kconfig
# Copyright 2024-2025 HNU-ESNL: Guoqi Xie, Chenglai Xiong, Xingyu Hu and etc.
# Copyright 2024-2025 openEuler SIG-Zephyr
# SPDX-License-Identifier: Apache-2.0

menuconfig ENABLE_ZVM_DEVICE_SUPPORT
	bool "Zephyr Based Virtualization Device Menu"
	default y
	help
		Enable support for Zephyr-based virtualization devices.
if ENABLE_ZVM_DEVICE_SUPPORT

config ENABLE_VIRT_DEVICE_INTERRUPT_DRIVEN
	bool "ZVM Virtualization Device Interrupt Support"
	default y
	help
		Enable interrupt support for ZVM virtualization devices.
		This option must be selected to set the callback function
		when VM devices require interrupts.

config ENABLE_VM_VGICV3
	bool "VGICv3 Device Support"
	help
		Enable support for the VGICv3 device, which is used
		when setting up a VM.

if ENABLE_VM_VGICV3

config VM_VGICV3_INIT_PRIORITY
	int "VGICv3 Initialization Priority"
	default 52
	help
		Set the initialization priority for the VGICv3 device.
		This is evaluated at the POST_KERNEL level.

endif

config ENABLE_VM_VSERIAL
	bool "VM VSERIAL that get from vm."
	help
		This option is used for building memory that get from overlay.

if ENABLE_VM_VSERIAL

config VM_VSERIAL_INIT_PRIORITY
	int "VM virt serial init priority."
	default 53
	help
		When serial is init, it judge the initialization priority in POST_KERNLE.

config vserial_ctrl_BLOCK_INIT_PRIORITY
	int "VM virt serial ctrl block init priority."
	default 51
	help
		Initialization priority for the virtual serial control block in POST_KERNEL.

endif

endif
```

## tests/Kconfig
```kconfig
#
# Copyright (c) 2016 Intel Corporation
#
# SPDX-License-Identifier: Apache-2.0
#

menu Testing

source "tests/ztest/Kconfig"

config TEST
	bool "Mark project as a test"
	help
	  Mark a project or an application as a test. This will enable a few
	  test defaults.

config TEST_SHELL
	bool "Enable various shells for testing"
	select GPIO_SHELL if GPIO
	select PCI_SHELL if PCI
	help
	  Enable various platform and driver related shells for testing.

config TEST_EXTRA_STACKSIZE
	int "Test function extra thread stack size"
	default 1024 if COVERAGE_GCOV
	default 768 if XTENSA
	default 0
	help
	  Additional stack for tests on some platform where default is not
	  enough.

config HAS_COVERAGE_SUPPORT
	bool
	help
	  The code coverage report generation is only available on boards
	  with enough spare RAM to buffer the coverage data, or on boards
	  based on the POSIX ARCH.

config COVERAGE
	bool "Create coverage data"
	depends on HAS_COVERAGE_SUPPORT
	default n
	help
	  This option will build your application with the -coverage option
	  which will generate data that can be used to create coverage reports.
	  Currently this is fully supported only on the native POSIX port.

if COVERAGE
config COVERAGE_GCOV
	bool "Create Coverage data from hardware platform"
	depends on !NATIVE_APPLICATION
	default y
	help
	  This option will select the custom gcov library. The reports will
	  be available over serial. This serial dump can be passed to
	  gen_gcov_files.py which creates the required .gcda files. These
	  can be read by gcov utility. For more details see gcovr.com .
endif

config TEST_USERSPACE
	bool "Enable userspace if available"
	depends on ARCH_HAS_USERSPACE
	depends on TEST
	select USERSPACE
	select APP_SHARED_MEM
	select DYNAMIC_OBJECTS
	default y
	help
	  This option will help test the userspace mode. This can be enabled
	  only when CONFIG_ARCH_HAS_USERSPACE is set.

config TEST_HW_STACK_PROTECTION
	bool "Enable hardware-based stack overflow detection if available"
	depends on ARCH_HAS_STACK_PROTECTION
	depends on TEST
	select HW_STACK_PROTECTION
	default y
	help
	  This option will enable hardware-based stack protection by default
	  for all test cases if the hardware supports it.

config TEST_FLASH_DRIVERS
	bool "Test flash drivers"
	depends on BOARD_QEMU_X86
	select FLASH_HAS_DRIVER_ENABLED
	select FLASH_HAS_PAGE_LAYOUT
	help
	  This option will help test the flash drivers. This should be enabled
	  only when using qemu_x86.
endmenu
```

## tests/application_development/code_relocation/boards/adp_xc7k_ae350_clic.conf
```kconfig
CONFIG_MINIMAL_LIBC=y
CONFIG_RELOCATE_TO_ITCM=y
CONFIG_CUSTOM_LINKER_SCRIPT="linker_riscv_qemu_sram2.ld"
```

## tests/application_development/code_relocation/testcase.yaml
```yaml
common:
  tags: linker
tests:
  buildsystem.app_dev.code_relocation:
    filter: not CONFIG_CPU_HAS_NXP_SYSMPU and CONFIG_MINIMAL_LIBC and
            dt_chosen_enabled("zephyr,itcm")
    arch_allow: arm
    extra_configs:
      - CONFIG_RELOCATE_TO_ITCM=y
    platform_allow:
      - mimxrt1060_evk/mimxrt1062/qspi
  buildsystem.app_dev.code_relocation_kinetis:
    filter: CONFIG_CPU_HAS_NXP_SYSMPU
    arch_allow: arm
    extra_configs:
      - CONFIG_MPU_ALLOW_FLASH_WRITE=y
    platform_allow:
      - frdm_k64f
  buildsystem.app_dev.code_relocation.no_itcm:
    filter: not CONFIG_CPU_HAS_NXP_SYSMPU and not dt_chosen_enabled("zephyr,itcm")
    arch_allow: arm
    extra_sections:
      - _SRAM2_RODATA_SECTION_NAME
      - _SRAM_TEXT_SECTION_NAME
      - _SRAM_RODATA_SECTION_NAME
      - _SRAM_DATA_SECTION_NAME
      - _CUSTOM_SECTION_NAME2
    platform_allow:
      - qemu_cortex_m3
      - mps2/an385
      - sam_e70_xplained/same70q21
    integration_platforms:
      - qemu_cortex_m3
  buildsystem.app_dev.code_relocation.riscv:
    extra_args: CONF_FILE="prj_riscv.conf"
    platform_allow:
      - qemu_riscv32
      - qemu_riscv64
  buildsystem.app_dev.code_relocation.xtensa:
    extra_args: CONF_FILE="prj_xtensa.conf"
    platform_allow: qemu_xtensa/dc233c
```

## tests/application_development/cpp/cpp_compile/testcase.yaml
```yaml
tests:
  misc.app_dev.cpp.cpp_compile:
    arch_exclude: posix
    build_only: true
    tags: cpp
```

## tests/application_development/cpp/libcxx/testcase.yaml
```yaml
tests:
  misc.app_dev.cpp.libcxx:
    arch_exclude: posix
    platform_exclude: qemu_x86_coverage
    toolchain_exclude: xcc
    min_flash: 54
    tags: cpp
  misc.app_dev.cpp.libcxx.exceptions:
    arch_exclude: posix
    platform_exclude: qemu_x86_coverage
    toolchain_exclude: xcc
    min_flash: 54
    tags: cpp
    extra_configs:
        - CONFIG_EXCEPTIONS=y
```

## tests/application_development/cpp/static_vars/testcase.yaml
```yaml
tests:
  misc.app_dev.cpp.static_vars:
    arch_exclude: posix
    platform_exclude: qemu_x86_coverage
    tags: cpp
  misc.app_dev.cpp.static_vars.libcxx:
    arch_exclude: posix
    platform_exclude: qemu_x86_coverage
    tags: cpp
    extra_configs:
        - CONFIG_LIB_CPLUSPLUS=y
```

## tests/application_development/cpp/testcase.yaml
```yaml
tests:
  application_development.cpp.main:
    platform_exclude: qemu_x86_coverage
    tags: cpp
```

## tests/application_development/gen_binary_embed_inc_file/testcase.yaml
```yaml
tests:
  buildsystem.binary_embed_include_file:
    integration_platforms:
      - native_sim
      - qemu_x86
      - qemu_cortex_a9
      - qemu_cortex_a53
      - qemu_cortex_m3
      - qemu_cortex_r5
      - qemu_riscv32
      - qemu_riscv64
      - qemu_xtensa/dc233c
      - qemu_arc/qemu_arc_hs
    tags:
      - gen_binary_embed_inc_file

  buildsystem.binary_embed_include_file.linker_generator:
    platform_allow:
      - qemu_cortex_m3
    tags:
      - gen_binary_embed_inc_file
      - linker_generator
    extra_configs:
      - CONFIG_CMAKE_LINKER_GENERATOR=y
```

## tests/application_development/gen_inc_file/testcase.yaml
```yaml
tests:
  buildsystem.include_file:
    integration_platforms:
      - native_sim/native
    tags: gen_inc_file
```

## tests/application_development/libcxx/testcase.yaml
```yaml
common:
  filter: TOOLCHAIN_HAS_NEWLIB == 1
tests:
  application_development.cpp.libcxx:
    platform_exclude: qemu_x86_coverage
    toolchain_exclude: xcc
    min_flash: 54
    tags: cpp
  application_development.cpp.libcxx.exceptions:
    platform_exclude: qemu_x86_coverage
    toolchain_exclude: xcc
    min_flash: 54
    tags: cpp
    extra_configs:
        - CONFIG_EXCEPTIONS=y
```
