## subsys/rfid/Kconfig.iso14443
```kconfig
# RFID ISO14443 configuration options

# Copyright (c) 2023 Basalte bv
# Copyright (c) 2025 Conny Marco Menebröcker
# SPDX-License-Identifier: Apache-2.0

menuconfig RFID_ISO14443
	bool "RFID ISO/IEC 14443"
	select EXPERIMENTAL
	help
	  Configuration options for ISO/IEC 14443.

if RFID_ISO14443

module = RFID_ISO14443
module-str = RFID_ISO14443
source "subsys/logging/Kconfig.template.log_config"

config RFID_ISO14443A
	bool "RFID ISO/IEC 14443 Type A"
	default y
	help
	  Enable ISO/IEC 14443 Type A support for RFID.

choice RFID_ISO14443_FSC
	prompt "Type 4A Tag Maximum Frame Size in Listen Mode"
	default RFID_ISO14443_FSC_32
	help
	  The FSC defines the maximum size of a frame accepted
	  by the RFID Forum Device in Listen Mode. FSC is expressed
	  in number of data bytes included in the frame.

config RFID_ISO14443_FSC_16
	bool "FSC 16"
config RFID_ISO14443_FSC_24
	bool "FSC 24"
config RFID_ISO14443_FSC_32
	bool "FSC 32"
config RFID_ISO14443_FSC_40
	bool "FSC 40"
config RFID_ISO14443_FSC_48
	bool "FSC 48"
config RFID_ISO14443_FSC_64
	bool "FSC 64"
config RFID_ISO14443_FSC_96
	bool "FSC 96"
config RFID_ISO14443_FSC_128
	bool "FSC 128"
config RFID_ISO14443_FSC_256
	bool "FSC 256"

endchoice # RFID_ISO14443_FSC

config RFID_ISO14443_FSC_MAX
	int
	default 16 if RFID_ISO14443_FSC_16
	default 24 if RFID_ISO14443_FSC_24
	default 32 if RFID_ISO14443_FSC_32
	default 40 if RFID_ISO14443_FSC_40
	default 48 if RFID_ISO14443_FSC_48
	default 64 if RFID_ISO14443_FSC_64
	default 96 if RFID_ISO14443_FSC_96
	default 128 if RFID_ISO14443_FSC_128
	default 256 if RFID_ISO14443_FSC_256

config RFID_ISO14443_FSCI
	hex
	default 0x00 if RFID_ISO14443_FSC_16
	default 0x01 if RFID_ISO14443_FSC_24
	default 0x02 if RFID_ISO14443_FSC_32
	default 0x03 if RFID_ISO14443_FSC_40
	default 0x04 if RFID_ISO14443_FSC_48
	default 0x05 if RFID_ISO14443_FSC_64
	default 0x06 if RFID_ISO14443_FSC_96
	default 0x07 if RFID_ISO14443_FSC_128
	default 0x08 if RFID_ISO14443_FSC_256
	help
	  Frame Size for proximity Card Integer in Listen Mode

choice RFID_ISO14443_FSD
	prompt "Type 4A Tag Maximum Frame Size in Poll Mode"
	default RFID_ISO14443_FSD_24
	help
	  The FSD defines the maximum size of a frame that the RFID Forum Device
	  in Poll Mode is able to receive. FSD is expressed in number of data bytes
	  included in the frame.

config RFID_ISO14443_FSD_16
	bool "FSC 16"
config RFID_ISO14443_FSD_24
	bool "FSC 24"
config RFID_ISO14443_FSD_32
	bool "FSC 32"
config RFID_ISO14443_FSD_40
	bool "FSC 40"
config RFID_ISO14443_FSD_48
	bool "FSC 48"
config RFID_ISO14443_FSD_64
	bool "FSC 64"
config RFID_ISO14443_FSD_96
	bool "FSC 96"
config RFID_ISO14443_FSD_128
	bool "FSC 128"
config RFID_ISO14443_FSD_256
	bool "FSC 256"

endchoice # RFID_ISO14443_FSD

config RFID_ISO14443_FSD_MAX
	int
	default 16 if RFID_ISO14443_FSD_16
	default 24 if RFID_ISO14443_FSD_24
	default 32 if RFID_ISO14443_FSD_32
	default 40 if RFID_ISO14443_FSD_40
	default 48 if RFID_ISO14443_FSD_48
	default 64 if RFID_ISO14443_FSD_64
	default 96 if RFID_ISO14443_FSD_96
	default 128 if RFID_ISO14443_FSD_128
	default 256 if RFID_ISO14443_FSD_256

config RFID_ISO14443_FSDI
	hex
	default 0x00 if RFID_ISO14443_FSD_16
	default 0x10 if RFID_ISO14443_FSD_24
	default 0x20 if RFID_ISO14443_FSD_32
	default 0x30 if RFID_ISO14443_FSD_40
	default 0x40 if RFID_ISO14443_FSD_48
	default 0x50 if RFID_ISO14443_FSD_64
	default 0x60 if RFID_ISO14443_FSD_96
	default 0x70 if RFID_ISO14443_FSD_128
	default 0x80 if RFID_ISO14443_FSD_256
	help
	  Frame Size for proximity Card Integer in Poll Mode

endif # RFID_ISO14443
```

## subsys/rtio/Kconfig
```kconfig
# Copyright (c) 2022 Intel Corporation
# SPDX-License-Identifier: Apache-2.0

menuconfig RTIO
	bool "RTIO"

if RTIO

config RTIO_SUBMIT_SEM
	bool "Use a semaphore when waiting for completions in rtio_submit"
	default n if !MULTITHREADING
	default y
	help
	  When calling rtio_submit a semaphore is available to sleep the calling
	  thread for each completion queue event until the wait count is met. This
	  adds a small RAM overhead for a single semaphore. By default wait_for will
	  use polling on the completion queue with a k_yield() in between iterations.

	  Enabled by default unless !MULTITHREADING

config RTIO_CONSUME_SEM
	bool "Use a semaphore when waiting for completions in rtio_cqe_consume_block"
	default n if !MULTITHREADING
	default y
	help
	  When calling rtio_cqe_consume_block a semaphore is available to sleep the
	  calling thread for each completion queue event until the wait count is met.
	  This adds a small RAM overhead for a single semaphore. By default the call
	  will use polling on the completion queue with a k_yield() in between
	  iterations.

	  Enabled by default unless !MULTIHREADING

config RTIO_SYS_MEM_BLOCKS
	bool "Include system memory blocks as an optional backing read memory pool"
	select SYS_MEM_BLOCKS
	help
	  Enable the RTIO_DEFINE_WITH_MEMPOOL macro which allows queueing reads
	  without a pre-allocated memory buffer. Instead the buffer will be taken
	  from the allocated memory pool associated with the RTIO context.

config RTIO_OP_DELAY
	bool "Delay Operation"
	default y
	help
	  Enable OP_DELAY which allows for, in chains of operations, delaying using a
	  kernel timer. Note this makes the size of the submission queue entries
	  typically larger than a dcache line and may have performance implications.

config RTIO_SQE_CACHELINE_CHECK
	bool "SQE Cacheline size check"
	help
	  At build time check the size of struct rtio_sqe to ensure it is less than a
	  cache line otherwise the build will fail. This ensures high performance on
	  systems that are sensitive to data cache effects.

choice RTIO_BLOCK_POOL_PLACEMENT
	prompt "RTIO block pool placement"
	default RTIO_BLOCK_POOL_PLACEMENT_DTCM if $(dt_chosen_enabled,$(DT_CHOSEN_Z_DTCM))
	default RTIO_BLOCK_POOL_PLACEMENT_NOCACHE if NOCACHE_MEMORY
	default RTIO_BLOCK_POOL_PLACEMENT_DEFAULT
	help
	  Select where the RTIO block pool is placed.

	  - Default: placed in normal data/BSS
	  - DTCM: placed in DTCM sections (uncached)
	  - No-cache: placed in explicitly non-cacheable sections

config RTIO_BLOCK_POOL_PLACEMENT_DEFAULT
	bool "Default data memory"
	help
	  Place RTIO block pool in the default data/BSS memory region.

config RTIO_BLOCK_POOL_PLACEMENT_DTCM
	bool "DTCM (uncached)"
	depends on $(dt_chosen_enabled,$(DT_CHOSEN_Z_DTCM))
	help
	  Place RTIO block pool in DTCM. On supported architectures DTCM is
	  inherently uncached and typically needs no extra cache maintenance.

config RTIO_BLOCK_POOL_PLACEMENT_NOCACHE
	bool "Non-cacheable memory (NOCACHE)"
	depends on NOCACHE_MEMORY
	help
	  Place RTIO block pool in a non-cacheable memory region. This assumes
	  the board/linker provides corresponding no-cache data/bss sections.

endchoice

choice RTIO_SQE_PLACEMENT
	prompt "RTIO SQE placement"
	default RTIO_SQE_PLACEMENT_DTCM if $(dt_chosen_enabled,$(DT_CHOSEN_Z_DTCM))
	default RTIO_SQE_PLACEMENT_NOCACHE if NOCACHE_MEMORY
	default RTIO_SQE_PLACEMENT_DEFAULT

config RTIO_SQE_PLACEMENT_DEFAULT
	bool "Default data memory"

config RTIO_SQE_PLACEMENT_DTCM
	bool "DTCM (uncached)"
	depends on $(dt_chosen_enabled,$(DT_CHOSEN_Z_DTCM))
	help
	  Place SQE ring in a linker memory region named DTCM (uncached,
	  low-latency)

config RTIO_SQE_PLACEMENT_NOCACHE
	bool "Non-cacheable memory (NOCACHE)"
	depends on NOCACHE_MEMORY
	help
	  Place SQE ring in Zephyr's no-cache region to avoid D-cache
	  coherency side effects for tiny transfers.

endchoice

rsource "Kconfig.workq"

module = RTIO
module-str = RTIO
module-help = Sets log level for RTIO support
source "subsys/logging/Kconfig.template.log_config"

endif
```
