## subsys/portability/posix/options/Kconfig.timer
```kconfig
# Copyright (c) 2018 Intel Corporation
# Copyright (c) 2024 Tenstorrent AI ULC
#
# SPDX-License-Identifier: Apache-2.0

menuconfig POSIX_TIMERS
	bool "POSIX timers, clocks, and sleep functions"
	help
	  Select 'y' here and Zephyr will provide implementations of clock_getres(), clock_gettime(),
	  clock_settime(), nanosleep(), timer_create(), timer_delete(), timer_getoverrun(),
	  timer_settime(), and timer_gettime().

	  For more information, please see
	  https://pubs.opengroup.org/onlinepubs/9699919799/xrat/V4_subprofiles.html

if POSIX_TIMERS

config POSIX_THREAD_CPUTIME
	bool "POSIX per-thread CPU-time clocks"
	help
	  This enables CLOCK_THREAD_CPUTIME_ID.

	  For more information, please see
	  https://pubs.opengroup.org/onlinepubs/9699919799/xrat/V4_port.html
	  https://pubs.opengroup.org/onlinepubs/9699919799/basedefs/V1_chap03.html#tag_03_118
	  https://pubs.opengroup.org/onlinepubs/9699919799/functions/V2_chap02.html#tag_15_08_05_04

config POSIX_MONOTONIC_CLOCK
	bool "POSIX Monotonic clock support"
	help
	  This enables CLOCK_MONOTONIC.

	  For more information, please see
	  https://pubs.opengroup.org/onlinepubs/9699919799/xrat/V4_port.html
	  https://pubs.opengroup.org/onlinepubs/9699919799/functions/V2_chap02.html#tag_15_08_05_03

config POSIX_CPUTIME
	bool "POSIX per-process CPU-time clocks"
	help
	  This enables CLOCK_PROCESS_CPUTIME_ID.

	  For more information, please see
	  https://pubs.opengroup.org/onlinepubs/9699919799/xrat/V4_port.html
	  https://pubs.opengroup.org/onlinepubs/9699919799/basedefs/V1_chap03.html#tag_03_118
	  https://pubs.opengroup.org/onlinepubs/9699919799/functions/V2_chap02.html#tag_15_08_05_04

config POSIX_CLOCK_SELECTION
	bool "POSIX Clock selection"
	help
	  This enables POSIX clock selection.

	  For more information, please see
	  https://pubs.opengroup.org/onlinepubs/9699919799/xrat/V4_port.html
	  https://pubs.opengroup.org/onlinepubs/9699919799/xrat/V4_port.html#tag_24_03_04

config POSIX_DELAYTIMER_MAX
	int "Maximum count returned my timer_getoverrun() in POSIX application"
	default 32
	help
	  This controls the maximum number of times a timer can overrun before
	  timer_getoverrun() in POSIX compliant application.

	  For more information, please see
	  https://pubs.opengroup.org/onlinepubs/9699919799/basedefs/limits.h.html

config POSIX_TIMER_MAX
	int "Maximum number of POSIX timers per process"
	default 32
	help
	  Maximum simultaneously active timer_t in a POSIX application.

	  For more information, please see
	  https://pubs.opengroup.org/onlinepubs/9699919799/basedefs/limits.h.html

config POSIX_TIMEOUTS
	bool "Support timeouts for some blocking POSIX services"
	help
	  Enable mandatory timeouts for some blocking operations.

	  For more information, please see
	  https://pubs.opengroup.org/onlinepubs/9699919799/xrat/V4_port.html
	  https://pubs.opengroup.org/onlinepubs/9699919799/xrat/V4_xbd_chap02.html

config TIMER_CREATE_WAIT
	int "Time to wait for timer availability (in msec) in POSIX application"
	default 100
	range 0 1000
	help
	  This controls how long to wait for resources to come available to create
	  a new timer in POSIX compliant application

module = TIMER
module-str = POSIX Timers
source "subsys/logging/Kconfig.template.log_config"

endif # POSIX_TIMERS
```

## subsys/portability/posix/options/Kconfig.xsi_realtime
```kconfig
# Copyright (c) 2024 Tenstorrent AI ULC
#
# SPDX-License-Identifier: Apache-2.0

config XSI_REALTIME
	bool "X/Open realtime"
	select POSIX_FSYNC
	select POSIX_MEMLOCK
	select POSIX_MEMLOCK_RANGE
	select POSIX_MESSAGE_PASSING
	# Not yet implemented, but optional
	# imply POSIX_PRIORITIZED_IO
	select POSIX_PRIORITY_SCHEDULING
	select POSIX_SHARED_MEMORY_OBJECTS
	select POSIX_SYNCHRONIZED_IO
	help
	  Select 'y' here and the following functions will be provided:

	  fsync(), mlockall(), munlockall(), mlock(), munlock(), mq_close(), mq_getattr(), mq_notify(),
	  mq_open(), mq_receive(), mq_send(), mq_setattr(), mq_unlink(), sched_get_priority_max(),
	  sched_get_priority_min(), sched_getparam(), sched_getscheduler(), sched_rr_get_interval(),
	  sched_setparam(), sched_setscheduler(), sched_yield(), mmap(), munmap(), shm_open(),
	  shm_unlink()

	  The functions fsync(), fdatasync(), and open() will provide synchronized I/O capability.

	  For more information, please see
	  https://pubs.opengroup.org/onlinepubs/9699919799/basedefs/V1_chap02.html
```

## subsys/portability/posix/options/Kconfig.xsi_single_process
```kconfig
# Copyright (c) 2024 Tenstorrent AI ULC
#
# SPDX-License-Identifier: Apache-2.0

config XSI_SINGLE_PROCESS
	bool "X/Open single process"
	select HWINFO
	help
	  Select 'y' here and Zephyr will provide implementations of
	  gethostid(), gettimeofday(), and putenv().

	  For more information, please see
	  https://pubs.opengroup.org/onlinepubs/9699919799/xrat/V4_subprofiles.html

module = XSI_SINGLE_PROCESS
module-str = XSI Single Process
source "subsys/logging/Kconfig.template.log_config"
```

## subsys/portability/posix/options/Kconfig.xsi_system_logging
```kconfig
# Copyright (c) 2024 Tenstorrent AI ULC
#
# SPDX-License-Identifier: Apache-2.0

config XSI_SYSTEM_LOGGING
	bool "X/Open system logging"
	help
	  This option provides support for closelog(), openlog(), syslog(),
	  setlogmask(), and vsyslog().

	  For more information, please see
	  https://pubs.opengroup.org/onlinepubs/9699919799/xrat/V4_subprofiles.html
```

## subsys/portability/posix/options/Kconfig.xsi_threads_ext
```kconfig
# Copyright (c) 2024 Tenstorrent AI ULC
#
# SPDX-License-Identifier: Apache-2.0

config XSI_THREADS_EXT
	bool "X/Open threads extensions"
	help
	  This option provides support for pthread_attr_getstack(), pthread_attr_setstack(),
	  pthread_getconcurrency(), and pthread_setconcurrency().

	  For more information, please see
	  https://pubs.opengroup.org/onlinepubs/9699919799/xrat/V4_subprofiles.html
```

## subsys/post/Kconfig
```kconfig
# Copyright (c) 2026 Aerlync Labs Inc.
# SPDX-License-Identifier: Apache-2.0

menuconfig POST
	bool "Power On Self Test (POST) subsystem"
	help
	  Enable the POST subsystem for hardware and software self-testing.
	  This provides a framework for registering and executing tests at
	  boot time and runtime.

if POST

config POST_EARLY_TESTS
	bool "Enable EARLY level tests"
	default y
	help
	  Run POST tests at the EARLY init level, before any kernel
	  services are available. Only minimal tests can run at this level.

config POST_HALT_ON_FAILURE
	bool "Halt on critical test failure"
	default y
	help
	  If a test marked with POST_FLAG_CRITICAL fails during boot,
	  halt the system instead of continuing. This is recommended
	  for safety-critical applications.

config POST_RESULT_BUFFER_SIZE
	int "Number of test results to buffer"
	default 32
	range 8 256
	help
	  Maximum number of test results stored for later query.
	  Each result uses approximately 24 bytes of RAM.

config POST_RUNTIME_TESTS
	bool "Enable runtime test execution"
	default y
	help
	  Allow tests marked with POST_FLAG_RUNTIME_OK to be executed
	  after boot via API calls. Disable to save code size if only
	  boot-time tests are needed.

config POST_USERSPACE
	bool "Enable userspace POST API"
	depends on USERSPACE
	default y if USERSPACE
	help
	  Enable syscall interface for POST test execution and
	  result queries from userspace. Only tests marked with
	  POST_FLAG_USERSPACE_OK can be executed from userspace.

config POST_SHELL
	bool "POST shell commands"
	depends on SHELL
	default y if SHELL
	help
	  Enable shell commands for POST test execution and status.
	  Commands include: post list, post run, post status.

config POST_LOG_LEVEL
	int "POST log level"
	depends on LOG
	default 3
	range 0 4
	help
	  Log level for POST subsystem.
	  0 = off, 1 = error, 2 = warning, 3 = info, 4 = debug

config POST_MAX_FAILURE_HOOKS
	int "Maximum number of failure hooks"
	default 4
	range 1 16
	help
	  Maximum number of failure callbacks that can be registered.

endif # POST
```

## subsys/power/Kconfig
```kconfig
# Copyright 2026 NXP
# SPDX-License-Identifier: Apache-2.0

menu "Power"

config POWER
	bool

config POWER_QOS
	bool "Power QoS constraints"
	select POWER
	help
	  Enable common power constraint aggregation helpers. The first supported
	  constraints are CPU P-state minimum and maximum requests. The helper only
	  aggregates requests and reports conflicts; resource policies remain
	  responsible for selecting and applying hardware states.

config POWER_ENERGY_MODEL
	bool "Power energy model helper"
	depends on CPU_FREQ
	select POWER
	help
	  Enable common energy-score helpers for power and CPU frequency policies.
	  The helper computes comparable active, transition and idle scores from
	  already collected workload, P-state and PM idle-state facts. It does not
	  choose P-states or idle states.

endmenu
```

## subsys/power/policy/Kconfig
```kconfig
# SPDX-License-Identifier: Apache-2.0

choice
	prompt "Idle State Power Management Policy"
	help
	  Select the idle state power management policy.

config PM_POLICY_RESIDENCY
	bool "PM Policy based on CPU residency"
	select PM_POLICY_RESIDENCY_DEFAULT if !SOC_SERIES_CC13X2_CC26X2
	select PM_POLICY_RESIDENCY_CC13X2_CC26X2 if SOC_SERIES_CC13X2_CC26X2
	help
	  Select this option for PM policy based on CPU residencies.

config PM_POLICY_DUMMY
	bool "Dummy PM Policy"
	help
	  Dummy PM Policy which simply returns next PM state in a loop.

config PM_POLICY_APP
	bool "Application PM Policy"
	help
	  When this option is selected, the application must provide PM policy.

endchoice

config PM_POLICY_RESIDENCY_DEFAULT
	bool
	help
	  Use the default residency policy implementation

config PM_POLICY_RESIDENCY_CC13X2_CC26X2
	bool
	help
	  Use the residency policy implementation for TI CC13x2/CC26x2

if PM_POLICY_RESIDENCY

config PM_MIN_RESIDENCY_SLEEP_1
	int "Sleep State 1 minimum residency"
	depends on HAS_POWER_STATE_SLEEP_1
	default 5000
	help
	  Minimum residency in milliseconds to enter POWER_STATE_SLEEP_1
	  state.

config PM_MIN_RESIDENCY_SLEEP_2
	int "Sleep State 2 minimum residency"
	depends on HAS_POWER_STATE_SLEEP_2
	default 10000
	help
	  Minimum residency in milliseconds to enter POWER_STATE_SLEEP_2
	  state.

config PM_MIN_RESIDENCY_SLEEP_3
	int "Sleep State 3 minimum residency"
	depends on HAS_POWER_STATE_SLEEP_3
	default 30000
	help
	  Minimum residency in milliseconds to enter POWER_STATE_SLEEP_3
	  state.

config PM_MIN_RESIDENCY_DEEP_SLEEP_1
	int "Deep Sleep State 1 minimum residency"
	depends on HAS_POWER_STATE_DEEP_SLEEP_1
	default 60000
	help
	  Minimum residency in milliseconds to enter POWER_STATE_DEEP_SLEEP_1
	  state.

config PM_MIN_RESIDENCY_DEEP_SLEEP_2
	int "Deep Sleep State 2 minimum residency"
	depends on HAS_POWER_STATE_DEEP_SLEEP_2
	default 90000
	help
	  Minimum residency in milliseconds to enter POWER_STATE_DEEP_SLEEP_2
	  state.

config PM_MIN_RESIDENCY_DEEP_SLEEP_3
	int "Deep Sleep State 3 minimum residency"
	depends on HAS_POWER_STATE_DEEP_SLEEP_3
	default 120000
	help
	  Minimum residency in milliseconds to enter POWER_STATE_DEEP_SLEEP_3
	  state.

endif # PM_POLICY_RESIDENCY
```

## subsys/process/Kconfig
```kconfig
# Copyright (c) 2025 Nordic Semiconductor ASA
# SPDX-License-Identifier: Apache-2.0

config PROCESS
	bool "Kernel process support"
	depends on MULTITHREADING

if PROCESS

config PROCESS_POOL_SIZE
	int "Kernel process pool size"
	default 2

config PROCESS_STACK_SIZE
	int "Kernel process thread stack size"
	default 2048

config PROCESS_PARTITION_SIZE
	int "Kernel process partition size in bytes"
	default 256
	range 32 1024

config PROCESS_PARTITION_ALIGN
	int "Kernel process partition aligment in bytes"
	default 32 if USERSPACE
	default 4

endif # PROCESS
```

## subsys/profiling/Kconfig
```kconfig
# Copyright (c) 2023 KNS Group LLC (YADRO)
#
# SPDX-License-Identifier: Apache-2.0

menuconfig PROFILING
	bool "Profiling tools"
	help
	  Enable profiling tools, such as perf

if PROFILING

source "subsys/profiling/perf/Kconfig"

endif
```

## subsys/profiling/perf/Kconfig
```kconfig
# Copyright (c) 2023 KNS Group LLC (YADRO)
#
# SPDX-License-Identifier: Apache-2.0

config PROFILING_PERF
	bool "Perf support"
	depends on !SMP
	depends on SHELL
	depends on PROFILING_PERF_HAS_BACKEND
	help
	  Enable perf shell command.

if PROFILING_PERF

config PROFILING_PERF_BUFFER_SIZE
	int "Perf buffer size"
	default 2048
	help
	  Size of buffer used by perf to save stack trace samples.

endif

rsource "backends/Kconfig"
```

## subsys/profiling/perf/backends/Kconfig
```kconfig
# Copyright (c) 2024 Meta Platforms
# Copyright 2026 Arm Limited and/or its affiliates <open-source-office@arm.com>
#
# SPDX-License-Identifier: Apache-2.0

config PROFILING_PERF_HAS_BACKEND
	bool
	help
	  Selected when there's an implementation for
	  `arch_perf_current_stack_trace()`

config PROFILING_PERF_BACKEND_RISCV
	bool
	default y
	depends on RISCV
	depends on ARCH_STACKWALK
	select PROFILING_PERF_HAS_BACKEND

config PROFILING_PERF_BACKEND_ARM_CORTEX_M
	bool
	default y
	depends on CPU_CORTEX_M
	depends on CORTEX_M_SYSTICK
	depends on THREAD_STACK_INFO
	depends on FRAME_POINTER
	depends on ARCH_STACKWALK
	depends on !TRUSTED_EXECUTION_NONSECURE
	select PROFILING_PERF_HAS_BACKEND

config PROFILING_PERF_BACKEND_X86
	bool
	default y
	depends on X86 && !X86_64
	depends on THREAD_STACK_INFO
	depends on FRAME_POINTER
	select PROFILING_PERF_HAS_BACKEND

config PROFILING_PERF_BACKEND_X86_64
	bool
	default y
	depends on X86_64
	depends on THREAD_STACK_INFO
	depends on FRAME_POINTER
	select PROFILING_PERF_HAS_BACKEND

config PROFILING_PERF_BACKEND_ARM64
	bool
	default y
	depends on ARM64
	depends on ARCH_STACKWALK
	select PROFILING_PERF_HAS_BACKEND
```

## subsys/psa/Kconfig
```kconfig
#
# Copyright (c) 2026 Nordic Semiconductor ASA
#
# SPDX-License-Identifier: Apache-2.0
#

# Indicates that there is a PSA Protected Storage API implementation enabled in
# the system. External implementations should select this symbol to enable
# Kconfig options that define reserved UID ranges.
config PSA_PS
	bool
	default y if SECURE_STORAGE || TFM_PARTITION_PROTECTED_STORAGE

# Indicates that there is a PSA Internal Truster Storage API implementation
# enabled in the system. External implementations should select this symbol to
# enable Kconfig options that define reserved UID ranges.
config PSA_ITS
	bool
	default y if SECURE_STORAGE || TFM_PARTITION_INTERNAL_TRUSTED_STORAGE

# Indicates that there is a support for PSA Crypto persistent keys enabled in
# the system. External implementations should select this symbol to enable
# Kconfig options that define reserved persistent key ID ranges.
config PSA_CRYPTO_PERSISTENT_KEYS
	bool
	default y if MBEDTLS_PSA_CRYPTO_STORAGE_C
	default y if TFM_CRYPTO_KEY_MODULE_ENABLED && TFM_PARTITION_INTERNAL_TRUSTED_STORAGE

if PSA_PS

rsource "Kconfig.ps_uids"

endif # PSA_PS

if PSA_ITS

rsource "Kconfig.its_uids"

endif # PSA_ITS

if PSA_CRYPTO_PERSISTENT_KEYS

rsource "Kconfig.key_ids"

endif # PSA_CRYPTO_PERSISTENT_KEYS
```

## subsys/psa/Kconfig.its_uids
```kconfig
#
# Copyright (c) 2026 Nordic Semiconductor ASA
#
# SPDX-License-Identifier: Apache-2.0
#

# Defines PSA Internal Trusted Storage UID ranges reserved for different
# subsystems.
#
# A user or external components may define additional ranges by adding a pair
# of Kconfig options using the following naming pattern:
# - PSA_ITS_UID_<range-name>_RANGE_START
# - PSA_ITS_UID_<range-name>_RANGE_SIZE.
#
# An accompanying CMake check ensures there is no overlap between any defined
# ranges preventing from UID collisions across subsystems.

menu "PSA Internal Trusted Storage UID ranges"

config PSA_ITS_UID_SETTINGS_TFM_RANGE_START
	hex "Range start for TF-M Settings backend"
	default 0x28000000

config PSA_ITS_UID_SETTINGS_TFM_RANGE_SIZE
	hex "Range size for TF-M Settings backend"
	default 0x10000 # 64Ki

endmenu
```
