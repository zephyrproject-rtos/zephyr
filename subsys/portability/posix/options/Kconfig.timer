## subsys/psa/Kconfig.key_ids
```kconfig
#
# Copyright (c) 2026 Nordic Semiconductor ASA
#
# SPDX-License-Identifier: Apache-2.0
#

# Defines PSA Crypto persistent key ID ranges reserved for different subsystems.
#
# A user or external components may define additional ranges by adding a pair
# of Kconfig options using the following naming pattern:
# - PSA_KEY_ID_<range-name>_RANGE_START
# - PSA_KEY_ID_<range-name>_RANGE_SIZE.
#
# An accompanying CMake check ensures there is no overlap between any defined
# ranges preventing from persistent key ID collisions across subsystems.

menu "PSA Crypto persistent key ID ranges"

config PSA_KEY_ID_OPENTHREAD_RANGE_START
	hex "Range start for OpenThread"
	default 0x20000
	help
	  Base key ID for OpenThread. Matches the default value upstream:
	  https://github.com/openthread/openthread/blob/thread-reference-20230706/src/core/config/platform.h#L138

config PSA_KEY_ID_OPENTHREAD_RANGE_SIZE
	hex "Range size for OpenThread"
	default 0x10000 # 64Ki

config PSA_KEY_ID_MATTER_RANGE_START
	hex "Range start for Matter"
	default 0x30000
	help
	  Base key ID for Matter. Matches the default value upstream:
	  https://github.com/project-chip/connectedhomeip/blob/v1.4.0.0/src/crypto/CHIPCryptoPALPSA.h#L55

config PSA_KEY_ID_MATTER_RANGE_SIZE
	hex "Range size for Matter"
	default 0x10000 # 64Ki

config PSA_KEY_ID_BT_MESH_RANGE_START
	hex "Range start for Bluetooth Mesh"
	default 0x20000000

config PSA_KEY_ID_BT_MESH_RANGE_SIZE
	hex "Range size for Bluetooth Mesh"
	default 0xC000 # 48Ki

config PSA_KEY_ID_WIFI_CREDENTIALS_RANGE_START
	hex "Range start for Wi-Fi credentials management"
	default 0x20010000

config PSA_KEY_ID_WIFI_CREDENTIALS_RANGE_SIZE
	hex "Range size for Wi-Fi credentials management"
	default 0x100 # 256

config PSA_KEY_ID_APPLICATION_RANGE_START
	hex "Range start for application-specific keys"
	default 0x30000000

config PSA_KEY_ID_APPLICATION_RANGE_SIZE
	hex "Range size for application-specific keys"
	default 0x100000 # 1Mi

endmenu
```

## subsys/psa/Kconfig.ps_uids
```kconfig
#
# Copyright (c) 2026 Nordic Semiconductor ASA
#
# SPDX-License-Identifier: Apache-2.0
#

# Defines PSA Protected Storage UID ranges reserved for different subsystems.
#
# A user or external components may define additional ranges by adding a pair
# of Kconfig options using the following naming pattern:
# - PSA_PS_UID_<range-name>_RANGE_START
# - PSA_PS_UID_<range-name>_RANGE_SIZE.
#
# An accompanying CMake check ensures there is no overlap between any defined
# ranges preventing from UID collisions across subsystems.

menu "PSA Protected Storage UID ranges"

config PSA_PS_UID_SETTINGS_TFM_RANGE_START
	hex "Range start for TF-M Settings backend"
	default 0x2C000000

config PSA_PS_UID_SETTINGS_TFM_RANGE_SIZE
	hex "Range size for TF-M Settings backend"
	default 0x10000 # 64Ki

config PSA_PS_UID_APPLICATION_RANGE_START
	hex "Range start for application-specific data"
	default 0x30000000

config PSA_PS_UID_APPLICATION_RANGE_SIZE
	hex "Range size for application-specific data"
	default 0x100000 # 1Mi

endmenu
```

## subsys/radio_cal/Kconfig
```kconfig
# Copyright (c) 2026 Espressif Systems (Shanghai) Co., Ltd.
# SPDX-License-Identifier: Apache-2.0

config RADIO_CAL
	bool "Radio RF calibration data persistence"
	depends on SETTINGS
	depends on SETTINGS_NVS || SETTINGS_ZMS || SETTINGS_FCB || SETTINGS_FILE
	help
	  Persist radio RF calibration data across reboots through the settings
	  subsystem. Radios that cache their calibration in host flash can use
	  this to skip a full RF calibration on warm boots and only run a
	  partial one, which improves the reliability of the first connection
	  after a cold boot or reflash. With this disabled, a full calibration
	  is performed on every boot. The same calibration typically serves
	  Wi-Fi, Bluetooth and 802.15.4, so this facility is protocol-neutral.

	  The data is stored under the "radio_cal" settings subtree, on whatever
	  storage backend the settings subsystem is configured to use.

if RADIO_CAL

module = RADIO_CAL
module-str = Radio calibration
source "subsys/logging/Kconfig.template.log_config"

endif # RADIO_CAL
```

## subsys/random/Kconfig
```kconfig
# Random configuration options

# Copyright (c) 2017 Intel Corporation
# SPDX-License-Identifier: Apache-2.0

menu "Random Number Generators"

config TEST_RANDOM_GENERATOR
	bool "Allow non-random number generator"
	help
	  This option signifies that a non-random number generator is allowed to
	  be used and the kernel's random number APIs are permitted to return
	  values that are not truly random.

	  This capability is provided for testing purposes when a truly random
	  number generator is not available. The non-random number generator
	  should not be used in a production environment.

	  This option is intended to be selected only by application-level
	  configurations (e.g. in tests and samples) to indicate that the
	  application is allowed to run with a random number generator that is not
	  truly random. Board-level configurations must not select this option
	  unless the sole purpose of the board is testing (e.g. QEMU emulation
	  boards).

	  Note that this option does not imply that a non-random number generator
	  is selected -- that is indicated by RNG_GENERATOR_CHOICE. An entropy
	  device-backed random number generator, if available, will be selected by
	  default even when CONFIG_TEST_RANDOM_GENERATOR=y.

config TIMER_RANDOM_INITIAL_STATE
	int "Initial state used by clock based number generator"
	default 123456789
	help
	  Initial state value used by TIMER_RANDOM_GENERATOR and
	  early random number genenator.


choice RNG_GENERATOR_CHOICE
	prompt "Random generator"
	default ENTROPY_DEVICE_RANDOM_GENERATOR if ENTROPY_HAS_DRIVER
	default TIMER_RANDOM_GENERATOR if TEST_RANDOM_GENERATOR
	depends on ENTROPY_HAS_DRIVER || TEST_RANDOM_GENERATOR
	help
	  Platform dependent non-cryptographically secure random number support.

	  If the entropy support of the platform has sufficient performance
	  to support random request then select that. Otherwise, select the
	  XOSHIRO algorithm

config TIMER_RANDOM_GENERATOR
	bool "System timer clock based number generator"
	depends on TEST_RANDOM_GENERATOR
	help
	  This options enables number generator based on system timer
	  clock. This number generator is not random and used for
	  testing only.

config ENTROPY_DEVICE_RANDOM_GENERATOR
	bool "Use entropy driver to generate random numbers"
	depends on ENTROPY_HAS_DRIVER
	help
	  Enables a random number generator that uses the enabled hardware
	  entropy gathering driver to generate random numbers. Should only be
	  selected if hardware entropy driver is designed to be a random
	  number generator source.

config XOSHIRO_RANDOM_GENERATOR
	bool "Use Xoshiro128++ as PRNG"
	depends on ENTROPY_HAS_DRIVER
	help
	  Enables the Xoshiro128++ pseudo-random number generator, that uses
	  the entropy driver as a seed source. This is a fast general-purpose
	  non-cryptographically secure random number generator.

endchoice # RNG_GENERATOR_CHOICE


DT_CHOSEN_Z_ENTROPY := zephyr,entropy
config CSPRNG_AVAILABLE
	bool
	default y if $(dt_chosen_enabled,$(DT_CHOSEN_Z_ENTROPY))
	help
	  Helper that can be used to check if the platform is capable of generating
	  CS random values. For this to be enabled, there must be the "zephyr,entropy"
	  chosen property defined in the devicetree. This means that there is an
	  HW entropy generator that can be used for this purpose.
	  Once CONFIG_CSPRNG_AVAILABLE is set, then CONFIG_ENTROPY_GENERATOR can
	  be enabled to enable the platform specific entropy driver.

#
# Implied dependency on a cryptographically secure entropy source when
# enabling CS generators. ENTROPY_HAS_DRIVER is the flag indicating the
# CS entropy source.
#
config CSPRNG_ENABLED
	bool
	default y
	depends on ENTROPY_HAS_DRIVER

choice CSPRNG_GENERATOR_CHOICE
	prompt "Cryptographically secure random generator"
	default HARDWARE_DEVICE_CS_GENERATOR
	default TEST_CSPRNG_GENERATOR
	help
	  Platform dependent cryptographically secure random number support.

	  If the hardware entropy support of the platform has sufficient
	  performance to support CSRNG then select that. Otherwise, select
	  CTR-DRBG CSPRNG as that is a FIPS140-2 recommended CSPRNG.

config HARDWARE_DEVICE_CS_GENERATOR
	bool "Use hardware random driver for CS random numbers"
	depends on ENTROPY_HAS_DRIVER
	help
	  Enables a cryptographically secure random number generator that
	  uses the enabled hardware random number driver to generate
	  random numbers.

config CTR_DRBG_CSPRNG_GENERATOR
	bool "Use CTR-DRBG CSPRNG"
	depends on MBEDTLS
	depends on ENTROPY_HAS_DRIVER
	select MBEDTLS_CIPHER_AES_ENABLED
	help
	  Enables the CTR-DRBG pseudo-random number generator. This CSPRNG
	  shall use the entropy API for an initialization seed. The CTR-DRBG
	  is a FIPS140-2 recommended cryptographically secure random number
	  generator.

config TEST_CSPRNG_GENERATOR
	bool "Use insecure CSPRNG for testing purposes"
	depends on TEST_RANDOM_GENERATOR
	help
	  Route calls to `sys_csrand_get` through `sys_rand_get` to enable
	  libraries that use the former to be tested with ZTEST.

endchoice # CSPRNG_GENERATOR_CHOICE

config CS_CTR_DRBG_PERSONALIZATION
	string "CTR-DRBG Personalization string"
	default "zephyr ctr-drbg seed"
	depends on CTR_DRBG_CSPRNG_GENERATOR
	help
	  Personalization data can be provided in addition to the entropy
	  source to make the initialization of the CTR-DRBG as unique as
	  possible.

endmenu
```

## subsys/retention/Kconfig
```kconfig
# Copyright (c) 2023, Nordic Semiconductor ASA
# SPDX-License-Identifier: Apache-2.0

menuconfig RETENTION
	bool "Retention support"
	imply CRC
	depends on RETAINED_MEM
	depends on DT_HAS_ZEPHYR_RETENTION_ENABLED
	help
	  Enables support for the retention system, which uses retained memory
	  drivers.

if RETENTION

config RETENTION_INIT_PRIORITY
	int "Retention devices init priority"
	default 86
	help
	  Retention device initialization priority (must be higher than init
	  priorities for retained memory drivers).

config RETENTION_MUTEXES
	bool
	default y
	depends on MULTITHREADING
	depends on !RETENTION_MUTEX_FORCE_DISABLE

config RETENTION_MUTEX_FORCE_DISABLE
	bool "Disable retention mutex support"
	depends on MULTITHREADING
	help
	  Disable use of mutexes which prevent issues with concurrent retention
	  device access. This option should only be enabled when retention
	  access is required in an ISR or for special use cases.

config RETENTION_BUFFER_SIZE
	int "Retention stack buffer sizes"
	default 16
	range 1 4096
	help
	  Size of buffers (stack based) used when reading and writing data
	  from/to the retention device.

menu "Retention modules"

config RETENTION_BOOT_MODE
	bool "Boot mode"
	help
	  Adds a boot mode system that allows for changing execution flow
	  depending upon the value of a boot mode parameter. Can be used for
	  e.g. button-less bootloader serial recovery mode entering from the
	  application.

	  In order to use this, a retention area with at least 1 usable user
	  byte must be created and set as the "zephyr,boot-mode" chosen node
	  via device tree.

source "subsys/retention/Kconfig.blinfo"

endmenu

module = RETENTION
module-str = retention
source "subsys/logging/Kconfig.template.log_config"

endif # RETENTION
```

## subsys/retention/Kconfig.blinfo
```kconfig
# Copyright (c) 2023, Nordic Semiconductor ASA
# SPDX-License-Identifier: Apache-2.0

menuconfig RETENTION_BOOTLOADER_INFO
	bool "Bootloader info"
	help
	  Adds a bootloader information sharing system which allows for
	  retrieving data from the bootloader when data sharing is enabled.

if RETENTION_BOOTLOADER_INFO

# Workaround for not being able to have commas in macro arguments
DT_CHOSEN_BOOTLOADER_INFO := zephyr,bootloader-info

config RETENTION_BOOTLOADER_INFO_TYPE_MCUBOOT
	bool "MCUboot"
	depends on !MCUBOOT && BOOTLOADER_MCUBOOT
	depends on $(dt_chosen_enabled,$(DT_CHOSEN_BOOTLOADER_INFO))
	select MCUBOOT_BOOTUTIL_LIB
	help
	  Adds a bootloader information sharing system for MCUboot and
	  applications which allows applications to read the configuration of
	  MCUboot and the running image. This can be used by applications so
	  that they know how to e.g. handle firmware updates and place them
	  into the correct slot.

	  In order to use this, a retention area must be created and set as
	  the "zephyr,bootloader-info" chosen node via device tree, MCUboot
	  must be built with the same "zephyr,bootloader-info" DTS node and
	  have CONFIG_BOOT_SHARE_DATA, CONFIG_BOOT_SHARE_DATA_BOOTINFO and
	  CONFIG_BOOT_SHARE_BACKEND_RETENTION enabled, or the shared
	  information will not be accessible.

config RETENTION_BOOTLOADER_INFO_INIT_PRIORITY
	int "Bootloader info init priority"
	default 87
	help
	  Bootloader info initialization priority (must be higher than init
	  priorities for for retention subsystem).

config RETENTION_BOOTLOADER_INFO_OUTPUT_FUNCTION
	bool "Function"
	default y
	help
	  Allows bootloader settings to be fetched by calling a function which
	  will update a buffer with the requested data.

config RETENTION_BOOTLOADER_INFO_OUTPUT_SETTINGS
	bool "Settings"
	depends on SETTINGS
	help
	  Allows bootloader settings to be fetched using settings with the
	  "blinfo" prefix.

endif
```

## subsys/retention/Kconfig.device_state
```kconfig
# Copyright (c) 2024 SILA Embedded Solutions GmbH
# SPDX-License-Identifier: Apache-2.0

menuconfig RETENTION_DEVICE_STATE_MODULE
	bool "Device state retention module"
	depends on DT_HAS_ZEPHYR_DEVICE_STATE_RETENTION_ENABLED
	help
	  Adds a system which can be used by drivers to retain their state.
	  This allows for instance a bootloader to configure a port expander
	  and hand over this state to the firmware.

	  It is strongly recommended for the retention partition which is used
	  for the driver state to include a header and a checksum.

if RETENTION_DEVICE_STATE_MODULE

config RETENTION_DEVICE_STATE_MODULE_INIT_PRIORITY
	int "Device state retention module init priority"
	default 87
	help
	  This defines the driver state retention initialization priority.
	  It is important that the initialization of the driver state retention
	  happens before the initialization of the drivers which should be
	  retained.

endif
```

## subsys/retention/Kconfig.driver_state
```kconfig
# Copyright (c) 2024 SILA Embedded Solutions GmbH
# SPDX-License-Identifier: Apache-2.0

menuconfig RETENTION_DRIVER_STATE
	bool "Driver state retention"
	depends on DT_HAS_ZEPHYR_RETENTION_DRIVER_STATE_ENABLED
	help
	  Adds a system which can be used by drivers to retain their state.
	  This allows for instance a bootloader to configure a port expander
	  and hand over this state to the firmware.

	  It is strongly recommended for the retention partition which is used
	  for the driver state to include a header and a checksum.

if RETENTION_DRIVER_STATE

config RETENTION_DRIVER_STATE_INIT_PRIORITY
	int "Driver state retention init priority"
	default 87
	help
	  This defines the driver state retention initialization priority.
	  It is important that the initialization of the driver state retention
	  happens before the initialization of the drivers which should be
	  retained.

endif
```

## subsys/rfid/Kconfig
```kconfig
# RFID Subsystem configuration options

# Copyright (c) 2023 Basalte bv
# Copyright (c) 2025 Conny Marco Menebröcker
# SPDX-License-Identifier: Apache-2.0

menu "Radio-Frequency Identification (RFID) subsystem [EXPERIMENTAL]"

source "subsys/rfid/Kconfig.iso14443"

endmenu
```
