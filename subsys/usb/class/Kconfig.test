## subsys/usb/class/Kconfig.test
```kconfig
# Copyright (c) 2016 Wind River Systems, Inc.
# SPDX-License-Identifier: Apache-2.0

config USB_DEVICE_LOOPBACK
	bool "USB Loopback Function Driver"
	help
	  USB Loopback Function Driver

config LOOPBACK_BULK_EP_MPS
	int
	depends on USB_DEVICE_LOOPBACK
	default 64
	help
	  Loopback Function bulk endpoint size
```

## subsys/usb/class/audio/Kconfig
```kconfig
# USB AUDIO configuration options

# Copyright (c) 2019 Nordic Semiconductor ASA
# SPDX-License-Identifier: Apache-2.0

config USB_DEVICE_AUDIO
	bool "USB Audio Device Class Driver"
	help
	  USB audio device class driver

if USB_DEVICE_AUDIO

endif #USB_DEVICE_AUDIO
```

## subsys/usb/class/dfu/Kconfig
```kconfig
# Copyright (c) 2020 Intel Corporation
# SPDX-License-Identifier: Apache-2.0

menuconfig USB_DFU_CLASS
	bool "USB DFU Class Driver"
	select MPU_ALLOW_FLASH_WRITE
	select POLL
	depends on IMG_MANAGER
	select IMG_ERASE_PROGRESSIVELY if SOC_FLASH_NRF
	help
	  USB DFU class driver

if USB_DFU_CLASS

config USB_DEVICE_DFU_PID
	hex "USB DFU Product ID"
	default 0xFFFF
	help
	  USB device product ID in DFU mode. MUST be configured by vendor.

config USB_DFU_DETACH_TIMEOUT
	int
	default 1000

config USB_DFU_DEFAULT_POLLTIMEOUT
	int "Default value for bwPollTimeout"
	default 256
	range 0 1000
	help
	  Default value for bwPollTimeout (in ms)

endif # USB_DFU_CLASS
```

## subsys/usb/class/hid/Kconfig
```kconfig
# USB HID configuration options

# Copyright (c) 2018 Intel Corp.
# SPDX-License-Identifier: Apache-2.0

menuconfig USB_DEVICE_HID
	bool "USB Human Interface Device support"
	help
	  Enables USB Human Interface Device support. Default device name
	  is "HID_0".

if USB_DEVICE_HID

config USB_HID_DEVICE_NAME
	string "USB HID device name template"
	default "HID"
	help
	  Device name template for the HID Devices. First device would have
	  name $(USB_HID_DEVICE_NAME)_0, etc.

module = USB_HID
default-count = 1
source "subsys/usb/class/Kconfig.template.composite_device_number"

module = USB_HID
module-str = usb hid
source "subsys/logging/Kconfig.template.log_config"

config ENABLE_HID_INT_OUT_EP
	bool "Enable USB HID Device Interrupt OUT Endpoint"
	help
	  Enable USB HID Device Interrupt OUT Endpoint.

config HID_INTERRUPT_EP_MPS
	int "USB HID Device Interrupt Endpoint size"
	default 16
	help
	  USB HID Device interrupt endpoint size

config USB_HID_POLL_INTERVAL_MS
	int "Polling interval"
	default 9
	help
	  Polling interval in ms selected by the USB HID Device.

config USB_HID_REPORTS
	int "HID reports in the instance"
	default 1
	range 1 256
	help
	  Number of HID reports in the instance.
	  Must be equal or higher than highest report ID (if they are not consecutive).

config USB_HID_BOOT_PROTOCOL
	bool "Enable USB HID Boot Protocol handling"
	help
	  Sets bInterfaceSubClass to 1 and enables Set_Protocol and Get_Protocol
	  requests handling.
	  See Chapter 4.2 of Device Class Definition for Human Interface Devices 1.11
	  for more information.

config USB_HID_PROTOCOL_CODE
	int "HID protocol code"
	default 0
	range 0 2
	depends on USB_HID_BOOT_PROTOCOL
	help
	  Sets bIntefaceProtocol in HID instance.
	  0 = None
	  1 = Keyboard
	  2 = Mouse
	  See Chapter 4.3 of Device Class Definition for Human Interface Devices 1.11
	  for more information.

endif # USB_DEVICE_HID
```

## subsys/usb/class/netusb/Kconfig
```kconfig
# Kconfig - netusb configuration options

#
# Copyright (c) 2017 Intel Corp.
#
# SPDX-License-Identifier: Apache-2.0
#

menu "USB Device Networking support"

config USB_DEVICE_NETWORK
	bool
	select NET_L2_ETHERNET

config USB_DEVICE_NETWORK_ECM
	bool "USB Ethernet Control Model (ECM) Networking device"
	select USB_DEVICE_NETWORK
	help
	  Ethernet Control Model (ECM) is a part of  Communications Device
	  Class (CDC) USB protocol specified by USB-IF.

config USB_DEVICE_NETWORK_EEM
	bool "USB Ethernet Emulation Model (EEM) Networking device"
	select USB_DEVICE_NETWORK
	help
	  Ethernet Emulation Model (EEM) is part of  Communications Device
	  Class (CDC) USB protocol and can be used to encapsulate Ethernet
	  frames for transport over USB.

config USB_DEVICE_NETWORK_RNDIS
	bool "USB Remote NDIS (RNDIS) Networking device"
	select USB_DEVICE_NETWORK
	select USB_COMPOSITE_DEVICE
	help
	  Remote NDIS (RNDIS) is commonly used Microsoft vendor protocol with
	  Specification available from Microsoft web site.

if USB_DEVICE_NETWORK_ECM

config CDC_ECM_INTERRUPT_EP_MPS
	int
	default 16
	help
	  CDC ECM class interrupt endpoint size

config CDC_ECM_BULK_EP_MPS
	int
	default 64
	help
	  CDC ECM class bulk endpoint size

config USB_DEVICE_NETWORK_ECM_MAC
	string
	default "00005E005301"
	help
	  MAC Host OS Address string.
	  MAC Address which would be assigned to network device, created in
	  the Host's Operating System. Use RFC 7042 Documentation values as
	  default MAC.

endif # USB_DEVICE_NETWORK_ECM

if USB_DEVICE_NETWORK_EEM

config CDC_EEM_BULK_EP_MPS
	int
	default 64

endif #USB_DEVICE_NETWORK_EEM

if USB_DEVICE_NETWORK_RNDIS

config RNDIS_INTERRUPT_EP_MPS
	int
	default 16
	help
	  RNDIS interrupt endpoint size

config RNDIS_BULK_EP_MPS
	int
	default 64
	help
	  RNDIS bulk endpoint size

endif # USB_DEVICE_NETWORK_RNDIS

if USB_DEVICE_NETWORK

module = USB_DEVICE_NETWORK
module-dep = LOG
module-str = USB Device Network log level
source "subsys/net/Kconfig.template.log_config.net"

endif # USB_DEVICE_NETWORK

endmenu # USB Device Networking support
```

## subsys/usb/common/Kconfig
```kconfig
# SPDX-FileCopyrightText: Copyright Nordic Semiconductor ASA
# SPDX-License-Identifier: Apache-2.0

if (USBD_VIDEO_CLASS || USBH_VIDEO_CLASS)

config USB_VIDEO_MAX_FRMIVAL
	int "Max number of video output stream per USB Video interface"
	range 1 255
	default 8
	help
	  Max number of Frame Interval listed on a frame descriptor. The
	  default value is selected arbitrarily to fit most situations without
	  requiring too much RAM.

endif
```

## subsys/usb/device/Kconfig
```kconfig
# USB device stack configuration options

# Copyright (c) 2016 Wind River Systems, Inc.
# SPDX-License-Identifier: Apache-2.0

menuconfig USB_DEVICE_STACK
	bool "USB Device Support"
	select USB_DEVICE_DRIVER
	select HWINFO
	select DEPRECATED
	help
	  Enable USB device stack.

if USB_DEVICE_STACK

module = USB_DEVICE
module-str = usb device
source "subsys/logging/Kconfig.template.log_config"

config USB_DEVICE_VID
	hex "USB Vendor ID"
	default 0x2FE3
	help
	  USB device vendor ID. MUST be configured by vendor.

config USB_DEVICE_PID
	hex "USB Product ID"
	default 0x0100
	help
	  USB device product ID. MUST be configured by vendor.

config USB_DEVICE_MANUFACTURER
	string "USB manufacturer name"
	default "ZEPHYR"
	help
	  USB device Manufacturer string. MUST be configured by vendor.

config USB_DEVICE_PRODUCT
	string "USB product name"
	default "USB-DEV"
	help
	  USB device Product string. MUST be configured by vendor.

config USB_DEVICE_SN
	string "USB device Serial Number String"
	default "0123456789ABCDEF"
	help
	  Placeholder for USB device Serial Number String.
	  Serial Number String will be derived from
	  Hardware Information Driver (HWINFO).

config USB_CONFIGURATION_STRING_DESC_ENABLE
	bool "USB configuration string descriptor support"
	help
	  Enable string descriptor that describes the default configuration.
	  Since there is only one configuration, this string descriptor may not
	  provide much useful information.

if USB_CONFIGURATION_STRING_DESC_ENABLE

config USB_CONFIGURATION_STRING_DESC
	string "USB configuration string descriptor"
	default "Default Configuration"
	help
	  String descriptor that describes the default configuration.

endif # USB_CONFIGURATION_STRING_DESC_ENABLE

config USB_COMPOSITE_DEVICE
	bool "Use Interface Association Descriptor code triple"
	help
	  This option modifies the code triple in the device descriptor
	  to signal that one of the functions has two or more interfaces and
	  uses the Interface Association Descriptor.

config USB_MAX_NUM_TRANSFERS
    int "Set number of USB transfer data buffers"
    range 1 32
    default 4
    help
        Allocates buffers used for parallel transfers. Increase this number
        according to USB devices count.

config USB_DEVICE_BLUETOOTH_BIG_BUF
	bool
	# Hidden option to simplify bluetooth buffer requirement
	# TODO: Add BUF reserve in H4 mode and ISO?
	default y if BT_BUF_ACL_RX_SIZE > 123 # 4 byte header
	default y if BT_BUF_ACL_TX_SIZE > 123 # 4 byte header
	default y if BT_BUF_EVT_RX_SIZE > 125 # 2 byte header
	default y if BT_BUF_CMD_TX_SIZE > 124 # 3 byte header

config USB_REQUEST_BUFFER_SIZE
	int "Set buffer size for Standard, Class and Vendor request handlers"
	range 64 512 if USB_DEVICE_NETWORK_RNDIS
	range 8 65536
	default 256 if USB_DEVICE_NETWORK_RNDIS
	default 266 if (USB_DEVICE_BLUETOOTH && USB_DEVICE_BLUETOOTH_BIG_BUF)
	default 128

config USB_MAX_ALT_SETTING
	int "Size of the array where alternate settings are stored"
	range 0 16
	default 8
	help
	  Size of the array where alternate settings are stored.
	  Should not be smaller than the number of interfaces.

config USB_NUMOF_EP_WRITE_RETRIES
	int "Number of endpoint write retries"
	default 3
	help
	  Number of endpoint write retries.

config USB_DEVICE_SOF
	bool "Start of Frame processing in events"
	default y if (USB_DEVICE_AUDIO && NRF_USBD_COMMON)

config USB_DEVICE_BOS
	bool "USB Binary Device Object Store (BOS)"

config USB_DEVICE_OS_DESC
	bool "MS OS Descriptors support"

config USB_SELF_POWERED
	bool "Set Self-powered characteristic"
	default y
	help
	  Set Self-powered characteristic in bmAttributes to indicate
	  self powered USB device.

config USB_MAX_POWER
	int "Set bMaxPower value"
	default 50
	range 0 250
	help
	  Set bMaxPower value in the Standard Configuration Descriptor,
	  the result is 2mA times the value provided.

config USB_WORKQUEUE
	bool "Use a dedicate work queue in the USB subsystem"
	default y if USB_CDC_ACM
	help
	  This option provides a dedicated work queue that is used for
	  all offloaded operations initiated by the USB subsystem.
	  This prevents deadlock situations where tasks on the system
	  workqueue inadvertently initiate operations that block, such
	  as UART transmission on CDC-ACM, preventing the system work
	  queue from making progress on the USB tasks that would
	  release the task.

	  Without this the system work queue is used for all USB
	  offloaded transfers.

config USB_WORKQUEUE_STACK_SIZE
	int "USB workqueue stack size"
	depends on USB_WORKQUEUE
	default 4096 if COVERAGE_GCOV
	default 1024

config USB_WORKQUEUE_PRIORITY
	int "USB workqueue priority"
	depends on USB_WORKQUEUE
	default -2 if COOP_ENABLED && !PREEMPT_ENABLED
	default  0 if !COOP_ENABLED
	default -1
	help
	  By default, USB work queue priority is the lowest cooperative
	  priority. This means that any work handler, once started, won't
	  be preempted by any other thread until finished.

config USB_DEVICE_INITIALIZE_AT_BOOT
	bool "Initialize USB device support at boot"
	depends on USB_CDC_ACM
	help
	  Use CDC ACM UART as backend for console, shell, or logging.

source "subsys/usb/device/class/Kconfig"

endif # USB_DEVICE_STACK
```

## subsys/usb/device/class/Kconfig
```kconfig
# USB class drivers configuration options

# Copyright (c) 2016 Wind River Systems, Inc.
# SPDX-License-Identifier: Apache-2.0

source "subsys/usb/device/class/Kconfig.cdc"

source "subsys/usb/device/class/Kconfig.msc"

source "subsys/usb/device/class/Kconfig.bt"

source "subsys/usb/device/class/netusb/Kconfig"

source "subsys/usb/device/class/hid/Kconfig"

source "subsys/usb/device/class/audio/Kconfig"

source "subsys/usb/device/class/dfu/Kconfig"

menuconfig USB_DEVICE_PRINTER
	bool "USB Printer Device Class Driver"
	select USB_COMPOSITE_DEVICE
	help
	  USB Printer device class driver. Implements support for USB
	  printer devices according to USB Printer Class v1.1 specification.

if USB_DEVICE_PRINTER

config USB_PRINTER_BULK_EP_MPS
	int "Bulk Endpoint size"
	default 64
	range 8 64 if USB_DC_HAS_FS_SUPPORT
	range 8 512 if USB_DC_HAS_HS_SUPPORT
	help
	  Bulk endpoint size for the USB printer class driver.

config USB_PRINTER_DEVICE_NAME
	string "USB printer device name"
	default "USB_PRINTER"
	help
	  USB printer device name as used in device naming.

config USB_PRINTER_LOG_LEVEL
	int "USB printer class driver log level"
	depends on LOG
	default 0
	range 0 4
	help
	  Sets log level for USB printer device class driver.
	  Levels are:
	  0 OFF, do not write
	  1 ERROR, only write LOG_ERR
	  2 WARNING, write LOG_WRN in addition to previous level
	  3 INFO, write LOG_INF in addition to previous levels
	  4 DEBUG, write LOG_DBG in addition to previous levels

endif # USB_DEVICE_PRINTER
```

## subsys/usb/device/class/Kconfig.bt
```kconfig
# Copyright (c) 2016 Wind River Systems, Inc.
# SPDX-License-Identifier: Apache-2.0

config USB_DEVICE_BLUETOOTH
	bool "USB Bluetooth Device Class support"
	select BT
	select BT_HCI_RAW
	help
	  USB Bluetooth device class support
```

## subsys/usb/device/class/Kconfig.msc
```kconfig
# Copyright (c) 2016 Wind River Systems, Inc.
# SPDX-License-Identifier: Apache-2.0

menuconfig USB_MASS_STORAGE
	bool "USB Mass Storage Device Class support"
	select DISK_ACCESS
	help
	  USB Mass Storage device class support

if USB_MASS_STORAGE

config MASS_STORAGE_DISK_NAME
	string "Mass storage disk or drive name"
	default "RAM"
	help
	  Mass storage device disk or drive name

config MASS_STORAGE_INQ_VENDOR_ID
	string "T10 assigned vendor ID for inquiry (must be 8 characters)"
	default "ZEPHYR  "
	help
	  Vendor ID used for enquiry requests.
	  Spaces must be added to bring the string to 8 bytes.

config MASS_STORAGE_INQ_PRODUCT_ID
	string "Product ID for inquiry (must be 16 characters)"
	default "ZEPHYR USB DISK "
	help
	  Product ID used for enquiry requests.
	  Spaces must be added to bring the string to 16 bytes.

config MASS_STORAGE_INQ_REVISION
	string "Revision for inquiry (must be 4 characters)"
	default "0.01"
	help
	  Revision used for enquiry requests.
	  Spaces must be added to bring the string to 4 bytes.

config MASS_STORAGE_BULK_EP_MPS
	int
	default 512 if USB_DC_HAS_HS_SUPPORT
	default 64
	help
	  Mass storage device class bulk endpoints size

config MASS_STORAGE_STACK_SIZE
	int "Set stack size for mass storage thread"
	default 786 if SD_STACK
	default 512
	help
	  Stack size for mass storage disk operations thread

module = USB_MASS_STORAGE
module-str = usb mass storage
source "subsys/logging/Kconfig.template.log_config"
endif
```

## subsys/usb/device/class/Kconfig.test
```kconfig
# Copyright (c) 2016 Wind River Systems, Inc.
# SPDX-License-Identifier: Apache-2.0

config USB_DEVICE_LOOPBACK
	bool "USB Loopback Function Driver"
	help
	  USB Loopback Function Driver

config LOOPBACK_BULK_EP_MPS
	int
	depends on USB_DEVICE_LOOPBACK
	default 512 if USB_DC_HAS_HS_SUPPORT
	default 64
	help
	  Loopback Function bulk endpoint size
```

## subsys/usb/device/class/audio/Kconfig
```kconfig
# USB AUDIO configuration options

# Copyright (c) 2020 Nordic Semiconductor ASA
# SPDX-License-Identifier: Apache-2.0

config USB_DEVICE_AUDIO
	bool "USB Audio Device Class Driver"
	select EXPERIMENTAL
	select USB_COMPOSITE_DEVICE
	help
	  USB Audio Device Class driver.
	  Zephyr USB Audio Class is considered experimental
	  and not full.
	  Device configuration is done via dt overlay.

if USB_DEVICE_AUDIO

module = USB_AUDIO
module-str = USB Audio
source "subsys/logging/Kconfig.template.log_config"

endif #USB_DEVICE_AUDIO
```
