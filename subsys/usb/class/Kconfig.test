## subsys/usb/device/class/dfu/Kconfig
```kconfig
# Copyright (c) 2020 Intel Corporation
# SPDX-License-Identifier: Apache-2.0

menuconfig USB_DFU_CLASS
	bool "USB DFU Class Driver"
	select MPU_ALLOW_FLASH_WRITE
	select POLL
	depends on IMG_MANAGER
	select IMG_ERASE_PROGRESSIVELY if (SOC_FLASH_NRF || FLASH_MCUX_FLEXSPI_NOR)
	help
	  USB DFU class driver

if USB_DFU_CLASS

config USB_DEVICE_DFU_PID
	hex "USB DFU Product ID"
	default 0xFFFF
	help
	  USB device product ID in DFU mode. MUST be configured by vendor.

config USB_DFU_WILL_DETACH
	bool "Generate detach-attach sequence on DFU detach"
	default y
	help
	  Enabling this option makes the device responsible for detaching
	  itself from the bus after the DFU_DETACH request. Select this
	  for compatibility with host drivers that cannot issue USB reset.
	  DFU fails on Windows with WinUSB driver if this is not enabled.

config USB_DFU_DETACH_TIMEOUT
	int
	default 100 if USB_DFU_WILL_DETACH
	default 1000

config USB_DFU_DEFAULT_POLLTIMEOUT
	int "Default value for bwPollTimeout"
	default 8
	range 0 1000
	help
	  Default value for bwPollTimeout (in ms)

config USB_DFU_ENABLE_UPLOAD
	bool "Firmware uploading to the host"
	select HAS_SECURITY_RISK
	help
	  Enabling this option allows to upload firmware image to the host.
	  Be aware that upload capability can be a security risk because
	  the executable image is always decrypted despite the image
	  encryption is enabled.

config USB_DFU_REBOOT
	bool "Reboot after download"
	select REBOOT
	help
	  When enabled the device will automatically reboot after a download
	  so the bootloader can swap the images.

config USB_DFU_PERMANENT_DOWNLOAD
	bool "Mark slot 1 as permanent after download"
	help
	  When enabled the image written to slot 1 will be marked as permanent.
	  WARNING: This bypasses Mcuboot's test-confirm mechanism!
	  Downloading the wrong image will cause a bricked device.
	  Make sure there is some kind of recovery mechanism.


endif # USB_DFU_CLASS
```

## subsys/usb/device/class/hid/Kconfig
```kconfig
# USB HID configuration options

# Copyright (c) 2018 Intel Corp.
# SPDX-License-Identifier: Apache-2.0

menuconfig USB_DEVICE_HID
	bool "USB Human Interface Device support"
	default y
	depends on DT_HAS_ZEPHYR_USB_HID_ENABLED
	help
	  Enables USB Human Interface Device support.

if USB_DEVICE_HID

module = USB_HID
default-count = 1
source "subsys/usb/device/class/Kconfig.template.composite_device_number"

module = USB_HID
module-str = usb hid
source "subsys/logging/Kconfig.template.log_config"

config USB_HID_REPORTS
	int "Number of HID idle reports in the instance"
	default 1
	range 1 256
	help
	  This configuration is only necessary if the application must
	  support USB HID idle rate and Set/Get Idle Requests.
	  The application can use Report ID to identify data fields
	  in the report descriptor and report itself.
	  This configuration value should correspond to the number of Input
	  Report IDs, the gaps and offset in Report IDs can not be supported.
	  Set this configuration value to 1 if Report IDs are not used but
	  idle rate must be supported.

endif # USB_DEVICE_HID
```

## subsys/usb/device_next/Kconfig
```kconfig
# Copyright (c) 2022 Nordic Semiconductor ASA
#
# SPDX-License-Identifier: Apache-2.0

menuconfig USB_DEVICE_STACK_NEXT
	bool "New USB device stack [EXPERIMENTAL]"
	select EXPERIMENTAL
	select UDC_DRIVER
	imply HWINFO
	help
	  New experimental USB device stack.

if USB_DEVICE_STACK_NEXT

module = USBD
module-str = usbd
source "subsys/logging/Kconfig.template.log_config"

choice USBD_MAX_SPEED_CHOICE
	prompt "Max supported connection speed"
	default USBD_MAX_SPEED_HIGH if UDC_DRIVER_HAS_HIGH_SPEED_SUPPORT
	default USBD_MAX_SPEED_FULL

config USBD_MAX_SPEED_HIGH
	bool "High-Speed"
	depends on UDC_DRIVER_HAS_HIGH_SPEED_SUPPORT

config USBD_MAX_SPEED_FULL
	bool "Full-Speed"
	depends on !UDC_DRIVER_HIGH_SPEED_SUPPORT_ENABLED

endchoice

config USBD_MAX_SPEED
	int
	default 0 if USBD_MAX_SPEED_FULL
	default 1 if USBD_MAX_SPEED_HIGH

config USBD_SHELL
	bool "USB device shell"
	depends on SHELL
	help
	  Enable USB device shell.

config USBD_THREAD_INIT_PRIO
	int
	default 90
	help
	  USB device thread initialization priority level.

config USBD_THREAD_STACK_SIZE
	int "USB device stack thread stack size"
	default 1024
	help
	  USB device stack thread stack size in bytes.

config USBD_MAX_UDC_MSG
	int "Maximum number of UDC events"
	default 10
	help
	  Maximum number of USB device controller events that can be queued.

config USBD_MSG_SLAB_COUNT
	int "Maximum number of USB device notification messages"
	range 4 64
	default 8
	help
	  Maximum number of USB device notification messages that can be queued.

config USBD_MSG_WORK_DELAY
	int "USB device notification messages work delay"
	range 1 100
	default 1
	help
	  Message work may need to be delayed because the device stack is not
	  yet ready to publish the message. The delay unit is milliseconds.

rsource "class/Kconfig"
rsource "app/Kconfig.cdc_acm_serial"

endif # USB_DEVICE_STACK_NEXT
```

## subsys/usb/device_next/app/Kconfig.cp210x_serial
```kconfig
# Copyright (c) 2025 Sergey Matsievskiy
# SPDX-License-Identifier: Apache-2.0

# This file contains Kconfig options and defaults for configuring the USB
# device stack and CP210X instance to be used as the default serial backend
# for logging or shell.


menuconfig CP210X_SERIAL_INITIALIZE_AT_BOOT
	bool "Initialize USB device and CP210X UART at boot"
	depends on USBD_CP210X_CLASS
	help
	  This is intended for use with cp210x-snippet or as a default serial
	  backend only in applications where no other USB features are
	  required, configured, and enabled.

if CP210X_SERIAL_INITIALIZE_AT_BOOT

config CP210X_SERIAL_ENABLE_AT_BOOT
	bool "USB device will be enabled at boot"
	default y
	help
	  When disabled, the application is responsible for enabling/disabling
	  the USB device.

config CP210X_SERIAL_MANUFACTURER_STRING
	string "USB device manufacturer string descriptor"
	default "Zephyr Project"
	help
	  USB device manufacturer string descriptor.

config CP210X_SERIAL_PRODUCT_STRING
	string "USB device product string descriptor"
	default "CP210X serial backend"
	help
	  USB device product string descriptor.

config CP210X_SERIAL_VID
	hex "USB device Vendor ID"
	default 0x2fe3
	help
	  You must use your own VID for samples and applications outside of
	  Zephyr Project. Additional configuration of the operation system
	  for proper device binding (i.e. udev) may be required.

config CP210X_SERIAL_PID
	hex "USB device Product ID"
	default 0x0002
	help
	  You must use your own PID for samples and applications outside of
	  Zephyr Project. Additional configuration of the operation system
	  for proper device binding (i.e. udev) may be required.

config CP210X_SERIAL_SELF_POWERED
	bool "USB device Self-powered attribute"
	help
	  Set the Self-powered attribute in the configuration.

config CP210X_SERIAL_MAX_POWER
	int "USB device bMaxPower value"
	default 125
	range 0 250
	help
	  bMaxPower value in the configuration in 2 mA units.

endif #CP210X_SERIAL_INITIALIZE_AT_BOOT
```

## subsys/usb/device_next/app/Kconfig.usbd_fastbootd
```kconfig
# Copyright (c) 2026 jeck chen <baidxi404629@gmail.com>
#
# SPDX-License-Identifier: Apache-2.0

config USBD_FASTBOOTD
	bool "USB fastboot device"
	help
	  Automatically initializes a USB Fastboot class via SYS_INIT.
	  Use this for bootloader applications that need firmware update
	  over USB.

if USBD_FASTBOOTD

config USBD_FASTBOOTD_VID
	hex "USB Vendor ID"
	default 0x2FE3
	help
	  You must use your own VID for samples and applications outside of
	  Zephyr Project.

config USBD_FASTBOOTD_PID
	hex "USB Product ID"
	default 0x1001
	help
	  You must use your own PID for samples and applications outside of
	  Zephyr Project.

config USBD_FASTBOOTD_MANUFACTURER_STRING
	string "Manufacturer string"
	default "ART-Pi2"
	help
	  USB device manufacturer string descriptor.

config USBD_FASTBOOTD_PRODUCT_STRING
	string "Product string"
	default "ART-Pi2 Bootloader"
	help
	  USB device product string descriptor.

config USBD_FASTBOOTD_MAX_POWER
	int "Max power (2mA units)"
	default 250
	range 0 500
	help
	  bMaxPower value in the configuration in 2 mA units.

config USBD_FASTBOOTD_SELF_POWERED
	bool "Self-powered"
	default n
	help
	  Set the Self-powered attribute in the configuration.

endif
```

## subsys/usb/device_next/class/Kconfig
```kconfig
# Copyright (c) 2022 Nordic Semiconductor ASA
#
# SPDX-License-Identifier: Apache-2.0

rsource "Kconfig.loopback"
rsource "Kconfig.cdc_acm"
rsource "Kconfig.cdc_ecm"
rsource "Kconfig.cdc_ncm"
rsource "Kconfig.bt"
rsource "Kconfig.msc"
rsource "Kconfig.uac2"
rsource "Kconfig.hid"
```

## subsys/usb/device_next/class/Kconfig.bt
```kconfig
# Copyright (c) 2023 Nordic Semiconductor ASA
# SPDX-License-Identifier: Apache-2.0

config USBD_BT_HCI
	bool "Bluetooth HCI USB Transport Layer"
	select BT
	select BT_HCI_RAW
	help
	  Bluetooth HCI USB Transport Layer

if USBD_BT_HCI

config USBD_BT_HCI_TX_THREAD_PRIORITY
	int "TX thread priority"
	default 8
	help
	  Bluetooth HCI USB Transport Layer TX thread priority.

config USBD_BT_HCI_TX_STACK_SIZE
	int "TX thread stack size"
	default 512
	help
	  Bluetooth HCI USB Transport Layer TX thread stack size.

config USBD_BT_HCI_RX_THREAD_PRIORITY
	int "RX thread priority"
	default 8
	help
	  Bluetooth HCI USB Transport Layer RX thread priority.

module = USBD_BT_HCI
module-str = usbd bt hci
source "subsys/logging/Kconfig.template.log_config"

endif
```

## subsys/usb/device_next/class/Kconfig.cp210x
```kconfig
# Copyright (c) 2025 Sergey Matsievskiy
#
# SPDX-License-Identifier: Apache-2.0

config USBD_CP210X_CLASS
	bool "USB CP210X implementation [EXPERIMENTAL]"
	depends on SERIAL
	depends on DT_HAS_ZEPHYR_CP210X_UART_ENABLED
	select SERIAL_HAS_DRIVER
	select SERIAL_SUPPORT_INTERRUPT
	select RING_BUFFER
	select UART_INTERRUPT_DRIVEN
	default y
	help
	  USB device CP210X class implementation.

if USBD_CP210X_CLASS

config USBD_CP210X_WORKQUEUE
	bool "Use dedicated workqueue in CP210X"
	help
	  Use the dedicated queue in CP210X implementation if the systemwork
	  queue cannot be used due to performance issues or other conflicts.

config USBD_CP210X_STACK_SIZE
	int "USB CP210X workqueue stack size"
	depends on USBD_CP210X_WORKQUEUE
	default 1024
	help
	  USB CDC ACM workqueue stack size.

config USBD_CP210X_BUF_POOL
	bool "Use dedicated buffer pool"
	default y if !USBD_MAX_SPEED_FULL
	help
	  Use a dedicated buffer pool whose size is based on the number of
	  CP210X instances and the size of the bulk endpoints. When
	  disabled, the implementation uses the UDC driver's pool.

module = USBD_CP210X
module-str = usbd cp210x
default-count = 1
source "subsys/logging/Kconfig.template.log_config"

endif
```

## subsys/usb/device_next/class/Kconfig.dfu
```kconfig
# Copyright (c) 2024 Nordic Semiconductor ASA
# SPDX-License-Identifier: Apache-2.0

menuconfig USBD_DFU
	bool "USB DFU Class support"
	help
	  USB DFU Class support

if USBD_DFU

config USBD_DFU_NUMOF_IMAGES
	int "Number of possible DFU images"
	range 1 256
	default 4
	help
	  Number of possible DFU images.

config USBD_DFU_ENABLE_UPLOAD
	bool "Allow images to be uploaded to the host"
	default y
	help
	  This option sets the bitCanUpload flag in the DFU attributes and
	  allows images to be uploaded to the host.

config USBD_DFU_MANIFESTATION_TOLERANT
	bool "Device is manifestation tolerant"
	default y
	help
	  This option sets the bitManifestationTolerant flag in the DFU
	  attributes and means that the device can communicate over USB after the
	  manifestation phase.

config USBD_DFU_TRANSFER_SIZE
	int "Maximum number of bytes the device can accept per transfer"
	default 512
	range 64 1024
	help
	  This option sets the wTransferSize in the DFU functional descriptor.

config USBD_DFU_POLLTIMEOUT
	int "bwPollTimeout value (in ms)"
	default 10
	range 0 1000
	help
	  This option sets the bwPollTimeout field in DFU_GETSTATUS response.

module = USBD_DFU
module-str = usbd dfu
source "subsys/logging/Kconfig.template.log_config"

config USBD_DFU_FLASH
	depends on FLASH && FLASH_MAP && STREAM_FLASH
	depends on IMG_MANAGER && IMG_ERASE_PROGRESSIVELY
	bool "Built-in flash backend"
	help
	  Enable the built-in flash backend, which can serve up to two image
	  slots, which is the common configuration of in-tree boards.

if USBD_DFU_FLASH

config USBD_DFU_FLASH_SLOT0
	bool "Flash backend for the slot-0 partition"
	default y
	help
	  This option enables download or upload for the slot-0 partition, if
	  one is defined.

config USBD_DFU_FLASH_SLOT1
	bool "Flash backend for the slot-1 partition"
	help
	  This option enables download or upload for the slot-1 partition, if
	  one is defined.

endif # USBD_DFU_FLASH

endif
```

## subsys/usb/device_next/class/Kconfig.fastboot
```kconfig
# Copyright (c) 2026 jeck chen <baidxi404629@gmail.com>
#
# SPDX-License-Identifier: Apache-2.0

config USBD_FASTBOOT_CLASS
	bool "USB Fastboot class"
	help
	  USB device Fastboot class implementation.
	  Implements Android Fastboot protocol for firmware download via USB.

if USBD_FASTBOOT_CLASS

config USBD_FASTBOOT_DOWNLOAD_BUF_SIZE
	int "Download buffer size (bytes)"
	default 32768
	range 4096 262144
	help
	  Size of the download buffer for receiving firmware images.

module = USBD_FASTBOOT
module-str = usbd fastboot
source "subsys/logging/Kconfig.template.log_config"

endif
```

## subsys/usb/device_next/class/Kconfig.hid
```kconfig
# Copyright (c) 2023 Nordic Semiconductor ASA
# SPDX-License-Identifier: Apache-2.0

menuconfig USBD_HID_SUPPORT
	bool "USB Human Interface Device support"
	default y
	depends on DT_HAS_ZEPHYR_HID_DEVICE_ENABLED
	help
	  Enables USB Human Interface Device support.

if USBD_HID_SUPPORT

config USBD_HID_IN_BUF_COUNT
	int "Number of buffers in the IN pool"
	range 1 256
	default 2
	help
	  Number of buffers in the IN pool per HID instance.

config USBD_HID_OUT_BUF_COUNT
	int "Number of buffers in the OUT pool"
	range 1 256
	default 2
	help
	  Number of buffers in the OUT pool per HID instance.

config USBD_HID_INIT_PRIORITY
	int "HID device init priority"
	default KERNEL_INIT_PRIORITY_DEVICE
	help
	  HID device initialization priority

module = USBD_HID
module-str = usbd hid
source "subsys/logging/Kconfig.template.log_config"

endif # USBD_HID_SUPPORT
```

## subsys/usb/device_next/class/Kconfig.mctp
```kconfig
# Copyright 2025 NXP
#
# SPDX-License-Identifier: Apache-2.0

config USBD_MCTP_CLASS
	bool "USB MCTP implementation"
	default y
	help
	  USB device MCTP class implementation.

if USBD_MCTP_CLASS

module = USBD_MCTP
module-str = usbd mctp
default-count = 1
source "subsys/logging/Kconfig.template.log_config"

rsource "Kconfig.template.instances_count"
endif
```
