## subsys/usb/device_next/class/Kconfig.midi
```kconfig
# Copyright (c) 2024 Titouan Christophe
#
# SPDX-License-Identifier: Apache-2.0

config USBD_MIDI_CLASS
	bool "USB MIDI 2.0 class support [EXPERIMENTAL]"
	select RING_BUFFER
	help
	  Enable the USB MIDI 2.0 device class support.

if USBD_MIDI_CLASS

module = USBD_MIDI
module-str = usbd midi
source "subsys/logging/Kconfig.template.log_config"

endif
```

## subsys/usb/device_next/class/Kconfig.midi2
```kconfig
# Copyright (c) 2024 Titouan Christophe
#
# SPDX-License-Identifier: Apache-2.0

config USBD_MIDI2_CLASS
	bool "USB MIDI 2.0 class support [EXPERIMENTAL]"
	select RING_BUFFER
	help
	  Enable the USB MIDI 2.0 device class support.

if USBD_MIDI2_CLASS

module = USBD_MIDI2
module-str = usbd midi2
source "subsys/logging/Kconfig.template.log_config"

endif
```

## subsys/usb/device_next/class/Kconfig.mtp
```kconfig
# Copyright (c) 2025 Mohamed ElShahawi (extremegtx@hotmail.com)
#
# SPDX-License-Identifier: Apache-2.0

config USBD_MTP_CLASS
	bool "USB MTP Class"
	depends on FILE_SYSTEM
	help
	  USB Media Transfer Protocol Device Class support.
	  Allow file transfer independent of storage file system.

if USBD_MTP_CLASS

config USBD_MTP_MAX_HANDLES
	int "Max number of Object handles per Storage"
	default 10
	range 1 254
	help
	  Maximum number of objects to be handled by MTP, including
	  stored, removed and added objects.

config USBD_MTP_STORAGES_PER_INSTANCE
	int "Max number of MTP storages"
	default 1
	range 1 254
	help
	  Maximum number of filesystem mount points that can be registered
	  through USBD_MTP_DEFINE_INSTANCE().

config USBD_MTP_DISABLE_WRITE_ACCESS
	bool "Disable write access"
	default n
	help
	  Disable write access MTP commands only. This means that the
	  host will not be able to add, remove or modify objects on the
	  device. Good for reducing code size if the device is only used for data retrieval.

config USBD_MTP_DISABLE_DIRECTORIES
	bool "Disable directory support"
	default n
	help
	  Disable support for directories. This means that the host will not be able to
	  create or remove directories on the device.
	  Good for reducing code size if the device is only used for flat file storage.

module = USBD_MTP
module-str = usbd mtp
default-count = 1
source "subsys/logging/Kconfig.template.log_config"

source "subsys/usb/common/Kconfig.template.instances_count"

endif
```

## subsys/usb/device_next/class/Kconfig.tmc
```kconfig
config USBD_TMC_CLASS
	bool "USB Test and Measurement Class (USBTMC)"
	depends on USB_DEVICE_STACK_NEXT
	default n
	help
	  Enables USB Test and Measurement Class (USBTMC) device support.

	  This class allows communication with test and measurement
	  equipment using message-based protocols such as SCPI.
```

## subsys/usb/device_next/class/Kconfig.uac2
```kconfig
# Copyright (c) 2022 Nordic Semiconductor ASA
#
# SPDX-License-Identifier: Apache-2.0

config USBD_AUDIO2_CLASS
	bool "USB Audio 2 class support"
	select UDC_ENABLE_SOF
	help
	  USB Audio 2 device class support.

if USBD_AUDIO2_CLASS

config USBD_UAC2_FS_WINDOWS_WORKAROUND
	bool "Workaround Windows Full-Speed wMaxPacketSize bug"
	help
	  Sets the feedback endpoint size for UAC2 on Full-Speed USB link to be 4 bytes.
	  USB2.0 specification mandates length of 3, non-compliant Windows UAC2 driver expects 4.

module = USBD_UAC2
module-str = usbd uac2
source "subsys/logging/Kconfig.template.log_config"

endif
```

## subsys/usb/device_next/class/Kconfig.uvc
```kconfig
# Copyright (c) 2025 tinyVision.ai Inc.
#
# SPDX-License-Identifier: Apache-2.0

config USBD_VIDEO_CLASS
	bool "USB Video Class implementation [EXPERIMENTAL]"
	depends on DT_HAS_ZEPHYR_UVC_DEVICE_ENABLED
	select EXPERIMENTAL
	help
	  USB Device Video Class (UVC) implementation.

if USBD_VIDEO_CLASS

config USBD_VIDEO_MAX_FORMATS
	int "Max number of format descriptors"
	range 1 254
	default 32
	help
	  The table of format descriptors are generated at runtime. This options plans the
	  storage at build time to allow enough descriptors to be generated. The default value
	  aims a compromise between enough descriptors for most devices, but not too much memory
	  being used.

config USBD_VIDEO_MAX_FRMIVAL
	int "Max number of video output stream per USB Video interface"
	range 1 255
	default 8
	help
	  Max number of Frame Interval listed on a frame descriptor. The
	  default value is selected arbitrarily to fit most situations without
	  requiring too much RAM.

config USBD_VIDEO_NUM_BUFS
	int "Max number of buffers the UVC class can allocate"
	default 16
	help
	  Control the number of buffer UVC can allocate in parallel.
	  The default is a compromise to allow enough concurrent buffers but not too much
	  memory usage.

module = USBD_VIDEO
module-str = usbd uvc
default-count = 1
source "subsys/logging/Kconfig.template.log_config"

endif # USBD_VIDEO_CLASS
```

## subsys/usb/host/Kconfig.usbip
```kconfig
# Copyright (c) 2024 Nordic Semiconductor ASA
#
# SPDX-License-Identifier: Apache-2.0

menuconfig USBIP
	bool "USB USBIP support"
	select EXPERIMENTAL
	select EVENTS
	depends on NETWORKING
	depends on NET_IPV4
	depends on NET_TCP
	depends on NET_SOCKETS
	help
	  Experimental USB USBIP support.

if USBIP

config USBIP_THREAD_STACK_SIZE
	int "USBIP thread stack size"
	default 2048
	help
	  USBIP thread stack size in bytes.

config USBIP_SUBMIT_BACKLOG_COUNT
	int "Number of submit commands in the backlog"
	range 32 128
	default 48
	help
	  Number of submit commands that can be stored in the backlog.

config USBIP_BUF_COUNT
	int "Number of buffers in the USBIP pool"
	range 16 256
	default 64
	help
	  Number of USBIP request buffers in the pool.

config USBIP_BUF_POOL_SIZE
	int "Memory available for USBIP buffers"
	range 4096 $(UINT32_MAX)
	default 16777216 if BOARD_NATIVE_SIM
	default 65536
	help
	  Total amount of memory available for USBIP buffers.

config USBIP_DEVICES_COUNT
	int "Number of devices that can be exported"
	range 1 255
	default 1
	help
	  Number of devices that can be exported.

module = USBIP
module-str = usbip
source "subsys/logging/Kconfig.template.log_config"

endif # USBIP
```

## subsys/usb/host/class/Kconfig
```kconfig
# SPDX-FileCopyrightText: Copyright Nordic Semiconductor ASA
# SPDX-FileCopyrightText: Copyright 2025 - 2026 NXP
# SPDX-License-Identifier: Apache-2.0

rsource "Kconfig.uvc"
rsource "Kconfig.hub"
```

## subsys/usb/host/class/Kconfig.cdc_acm
```kconfig
# Copyright Nordic Semiconductor ASA
#
# SPDX-License-Identifier: Apache-2.0

config USBH_CDC_ACM_CLASS
	bool "USB host CDC ACM implementation [EXPERIMENTAL]"
	depends on SERIAL
	select SERIAL_HAS_DRIVER
	select SERIAL_SUPPORT_ASYNC
	select UART_ASYNC_API
	default y
	help
	  USB host CDC ACM class implementation.

if USBH_CDC_ACM_CLASS

config USBH_CDC_ACM_STACK_SIZE
	int "USB host CDC ACM workqueue stack size"
	default 1024
	help
	  USB host CDC ACM workqueue stack size.

config USBH_CDC_ACM_BOUNCE
	bool "Bounce buffers that are not DMA-able"
	default y
	help
	  Use a bounce buffer when a buffer submitted to the UART asynchronous
	  API is not DMA-able. When disabled, non DMA-able buffers are rejected
	  and no bounce buffer pool is allocated.

config USBH_CDC_ACM_BOUNCE_POOL_SIZE
	int "USB host CDC ACM bounce buffer pool size per instance"
	depends on USBH_CDC_ACM_BOUNCE
	default 1024
	help
	  Size in bytes of the bounce buffer pool per instance, used when a
	  buffer submitted to the UART asynchronous API is not DMA-able.

config USBH_CDC_ACM_ALLOW_NO_NOTIF_EP
	bool "Accept devices without a notification endpoint"
	help
	  The CDC ACM communication interface is required by the specification
	  to provide a notification (interrupt IN) endpoint. Enable this option
	  to also accept non-compliant devices that omit it. Such devices can
	  transfer data and accept line coding and control line state, but do
	  not provide the SerialState notification, so DCD and DSR are not
	  available.

module = USBH_CDC_ACM
module-str = usbh-cdc-acm
default-count = 1
source "subsys/logging/Kconfig.template.log_config"
source "subsys/usb/common/Kconfig.template.instances_count"

endif
```

## subsys/usb/host/class/Kconfig.hub_host
```kconfig
# Copyright 2025 NXP
# SPDX-License-Identifier: Apache-2.0

config USBH_HUB_CLASS
	bool "USB Host Hub Class Driver"
	default n
	help
	  Enable USB Host Hub Class driver support.
	  This allows connecting USB hubs and managing downstream devices.

if USBH_HUB_CLASS

config USBH_HUB_MAX_LEVELS
	int "Maximum Hub chain depth"
	default 5
	range 1 5
	help
	  Maximum number of non-root hubs allowed in a single communication path
	  between the host and any device. USB specification allows up to five
	  non-root hubs per path, which means the deepest path can include 5 hubs.

config USBH_HUB_MAX_COUNT
	int "Maximum Hub count"
	default 7
	range 1 16
	help
	  Maximum number of hub devices supported in the entire USB topology.

config USBH_HUB_PORT_RESET_TIMES
	int "Hub port reset retry count"
	default 2
	range 1 10
	help
	  Maximum number of port reset retries before giving up.

config USBH_HUB_INIT_PRIORITY
	int "Hub manager initialization priority"
	default 85
	help
	  Initialization priority for the Hub manager. Should be
	  higher than the USB host stack but lower than device drivers

module = USBH_HUB
module-str = usbh hub
default-count = 1
source "subsys/logging/Kconfig.template.log_config"

endif # USBH_HUB_CLASS
```

## subsys/usb/host/class/Kconfig.serial
```kconfig
#
# Copyright (c) 2026 Linumiz
#
# SPDX-License-Identifier: Apache-2.0
#

config USBH_SERIAL
	bool "USB Host Vendor-Specific Serial Support"
	depends on USB_HOST_STACK
	select SERIAL_SUPPORT_ASYNC
	help
	  Support for vendor-specific USB serial devices (GSM modems, etc.)
	  similar to Linux's option driver. Matches interfaces with
	  bInterfaceClass=0xFF and provides bulk endpoint communication.

if USBH_SERIAL

config USBH_SERIAL_LOG_LEVEL
	int
	default 4

module = USBH_SERIAL
module-str = USB Host Serial
source "subsys/logging/Kconfig.template.log_config"

endif # USBH_SERIAL
```

## subsys/usb/host/class/Kconfig.testusb
```kconfig
# Copyright Nordic Semiconductor ASA
#
# SPDX-License-Identifier: Apache-2.0

config USBH_TESTUSB
	bool "USB host test function support [EXPERIMENTAL]"
	depends on USB_HOST_STACK
	select EXPERIMENTAL
	help
	  USB host test function driver, the counterpart to the device side
	  loopback function (subsys/usb/device_next/class/loopback.c) exercised
	  by the samples/subsys/usb/testusb sample. It binds the loopback device
	  by vendor and product ID and exercises bulk, control and interrupt
	  transfers, similar to the Linux usbtest driver.

if USBH_TESTUSB

config USBH_TESTUSB_QUEUE_DEPTH
	int "Number of transfers kept in flight"
	default 16
	help
	  Number of transfers the test driver enqueues at once on an endpoint
	  and the number of buffers in the driver buffer pool per instance.

config USBH_TESTUSB_BUF_SIZE
	int "Maximum transfer length"
	default 1024
	help
	  Maximum length of a single transfer and size of each buffer in the
	  driver buffer pool.

module = USBH_TESTUSB
module-str = usbh-testusb
default-count = 1
source "subsys/logging/Kconfig.template.log_config"
source "subsys/usb/common/Kconfig.template.instances_count"

endif
```

## subsys/usb/host/class/Kconfig.uac2
```kconfig
# Copyright 2025 Nordic Semiconductor ASA
# SPDX-License-Identifier: Apache-2.0

config USBH_UAC2_CLASS
	bool "USB host Audio Class 2.0 support [EXPERIMENTAL]"
	select EXPERIMENTAL
	help
	  USB Host Audio Class 2.0 implementation.

if USBH_UAC2_CLASS

config USBH_UAC2_INSTANCES_COUNT
	int "Number of UAC2 host instances"
	default 4
	range 1 8
	help
	  Maximum number of UAC2 devices that can be connected simultaneously.

config USBH_UAC2_STREAM_IN_CONCURRENT_TRANSFERS
	int "Number of concurrent isochronous transfers for audio stream in"
	default 4
	range 1 8
	help
	  Number of concurrent transfers for audio input (device to host).

config USBH_UAC2_STREAM_OUT_CONCURRENT_TRANSFERS
	int "Number of concurrent isochronous transfers for audio stream out"
	default 4
	range 1 8
	help
	  Number of concurrent transfers for audio output (host to device).

config USBH_UAC2_AUDIO_EFFECT_CONTROLS
	bool "Include audio effect control mappings"
	default n
	help
	  Include control mappings for audio effect processing: parametric
	  equalizer, reverberation, modulation delay (chorus/flanger), and
	  dynamic range compressor. Enable this option when connecting to USB
	  audio devices that expose effect processing controls. Disabling
	  reduces the size of the control mapping table in read-only data.

config USBH_UAC2_AUDIO_PROCESSING_CONTROLS
	bool "Include audio spatial processing control mappings"
	default n
	help
	  Include control mappings for audio spatial and mixing processing:
	  up/down-mix, Dolby Prologic, and stereo extender. Enable this
	  option when connecting to USB audio devices that expose these
	  processing controls. Disabling reduces the size of the control
	  mapping table in read-only data.

config USBH_UAC2_COMPRESSED_AUDIO_CONTROLS
	bool "Include compressed audio decoder control mappings"
	default n
	help
	  Include control mappings for compressed audio decoder units:
	  MPEG, AC-3, WMA, and DTS. Enable this option when connecting to
	  USB audio devices that expose compressed audio decoder controls.
	  Disabling reduces the size of the control mapping table in
	  read-only data.

config USBH_UAC2_MAX_RANGE_SUBRANGES
	int "Maximum number of subranges in RANGE requests"
	default 8
	range 1 16
	help
	  Maximum number of subranges when querying control ranges.
	  Devices may report multiple discrete values as subranges.
	  Higher values increase stack usage.

module = USBH_UAC2
module-str = usbh_uac2
source "subsys/logging/Kconfig.template.log_config"

endif # USBH_UAC2_CLASS
```

## subsys/usb/host/class/Kconfig.uvc
```kconfig
# SPDX-FileCopyrightText: Copyright Nordic Semiconductor ASA
# SPDX-License-Identifier: Apache-2.0

config USBH_VIDEO_CLASS
	bool "USB host Video Class support [EXPERIMENTAL]"
	select EXPERIMENTAL
	help
	  USB Host Video Class (UVC) implementation.

if USBH_VIDEO_CLASS

config USBH_VIDEO_MAX_FRMIVAL
	int "Max number of video frame interval per descriptor supported"
	range 1 255
	default 16
	help
	  Max number of Frame Interval listed on a frame descriptor. The
	  default value is selected arbitrarily to fit most situations.

module = USBH_UVC
module-str = usbh uvc
default-count = 1
source "subsys/logging/Kconfig.template.log_config"
source "subsys/usb/common/Kconfig.template.instances_count"

endif # USBH_VIDEO_CLASS
```
