## subsys/usb/host/class/Kconfig.uvc_host
```kconfig
#
# Copyright 2025 NXP
#
# SPDX-License-Identifier: Apache-2.0
#

config USBH_VIDEO_CLASS
	bool "USB Host Video Class implementation"
	depends on DT_HAS_ZEPHYR_UVC_HOST_ENABLED
	help
	  USB Host Video Class (UVC) implementation.
	  This allows the system to act as a USB host and communicate
	  with USB video devices such as webcams and other UVC-compliant
	  video capture devices.

if USBH_VIDEO_CLASS

config USBH_VIDEO_NUM_BUFS
	int "Max number of buffers the UVC class can allocate"
	default 16
	help
	  Control the number of buffer UVC can allocate in parallel.
	  The default is a compromise to allow enough concurrent buffers
	  but not too much memory usage.

config USBH_VIDEO_MAX_FRMIVAL
	int "Max number of video input stream per USB Video interface"
	range 1 255
	default 8
	help
	  Max number of Frame Interval listed on a frame descriptor. The
	  default value is selected arbitrarily to fit most situations without
	  requiring too much RAM.

config USBH_VIDEO_MAX_STREAM_INTERFACE
	int "Max number of USB Video stream interface"
	range 1 255
	default 32
	help
	  Max number of Video stream interface listed on descriptors. The default
	  value is selected arbitrarily to fit most situations without requiring
	  too much RAM.

config USBH_VIDEO_MAX_FORMATS
	int "Max number of format descriptors"
	range 1 254
	default 8
	help
	  The table of format descriptors are generated at runtime. This options plans the
	  storage at build time to allow enough descriptors to be generated. The default value
	  aims a compromise between enough descriptors for most devices, but not too much memory
	  being used. TThe maximum count for each format type (e.g., MJPEG, uncompressed), not the
	  total number of all formats.

config USBH_VIDEO_MULTIPLE_PRIME_COUNT
	int "Number of concurrent USB transfers to initiate when starting stream"
	range 1 16
	default 1
	help
	  Number of concurrent USB isochronous transfers initiated when video
	  streaming starts. Higher values improve throughput but use more resources.
	  Lower values (1-2) suit low frame rates, higher values (4-8) suit high
	  frame rates.

module = USBH_VIDEO
module-str = usbh uvc
default-count = 1
source "subsys/logging/Kconfig.template.log_config"

endif # USBH_VIDEO_CLASS
```

## subsys/usb/host/class/Kconfig.vendor_serial
```kconfig
#
# Copyright (c) 2026 Linumiz
#
# SPDX-License-Identifier: Apache-2.0
#

config USBH_VENDOR_SERIAL
	bool "USB Host Vendor Serial Class Support"
	depends on USB_HOST_STACK
	depends on SERIAL
	select UART_ASYNC_API
	select SERIAL_SUPPORT_ASYNC
	help
	  USB host class driver for vendor-specific serial devices
	  that use bulk endpoints for data transfer. Targets modem
	  devices such as the Quectel EG916Q which expose vendor-class
	  interfaces for AT/PPP communication.

	  Exposes the Zephyr UART async API so that higher-level
	  subsystems (modem, PPP) can use the device transparently.

if USBH_VENDOR_SERIAL

config USBH_VENDOR_SERIAL_INSTANCES_COUNT
	int "Number of USB host vendor serial instances"
	default 1
	range 1 4
	help
	  Maximum number of vendor serial devices that can be
	  connected simultaneously.

config USBH_VENDOR_SERIAL_LOG_LEVEL
	int
	default 4

module = USBH_VENDOR_SERIAL
module-str = USB Host Vendor Serial
source "subsys/logging/Kconfig.template.log_config"

endif # USBH_VENDOR_SERIAL
```

## subsys/usb/usb_c/Kconfig
```kconfig
# USB-C stack configuration options

# Copyright (c) 2022 The Chromium OS Authors
# SPDX-License-Identifier: Apache-2.0

menuconfig USBC_STACK
	bool "USB-C Stack Support"
	select SMF
	select SMF_ANCESTOR_SUPPORT
	select USBC_TCPC_DRIVER
	select USBC_VBUS_DRIVER
	help
	  Enable the USB-C Stack. Note that each USB-C port gets its own thread.

if USBC_STACK

config USBC_STACK_INIT_PRIORITY
	int "USB-C stack init priority"
	default 90
	help
	  Initialization priority of the USB-C connector driver in POST_KERNEL.
	  This driver must be initialized after devices referenced by USB-C connectors
	  like VBUS and TCPC.

config USBC_THREAD_PRIORITY
	int "USB-C thread priority"
	default 0
	help
	  Set thread priority of the USB-C

config USBC_STACK_SIZE
	int "USB-C thread stack size"
	default 1024
	help
	  Stack size of thread created for each instance.

config USBC_STATE_MACHINE_CYCLE_TIME
	int "USB-C state machine cycle time in milliseconds"
	default 5
	help
	  The USB-C state machine is run in a loop and the cycle time is the
	  delay before running the loop again.

config BUILD_OUTPUT_VIF
	bool "Generate VIF policies of USB-C in XML format"
	depends on DT_HAS_USB_C_CONNECTOR_ENABLED
	help
	  Generate XML file containing VIF policies during project build.

config GENVIF_INPUT_VIF_XML_PATH
	string "Path to input VIF file"
	depends on BUILD_OUTPUT_VIF
	help
	  Absolute path or relative path (w.r.to the application source
	  directory) of the GenVIF input VIF XML file.

choice USBC_CSM_TYPE
	prompt "USB-C Connection State Machine"
	default USBC_CSM_SINK_ONLY

config USBC_CSM_SINK_ONLY
	bool "Sink USB-C Connection State Machine"
	help
	  Allows the USB-C state machine to function as a Sink

config USBC_CSM_SOURCE_ONLY
	bool "Source USBC Connection State Machine"
	help
	  Allow the USB-C state machine to function as a Source

endchoice

module = USBC_STACK
module-str = usbc stack
source "subsys/logging/Kconfig.template.log_config"

endif # USBC_STACK
```

## subsys/usb/usbd/Kconfig
```kconfig
# Copyright (c) 2016 Wind River Systems, Inc.
# Copyright (c) 2020 PHYTEC Messtechnik GmbH
#
# SPDX-License-Identifier: Apache-2.0

if USBD_DEVICE_STACK

module = USBD
module-str = usbd
source "subsys/logging/Kconfig.template.log_config"

config NET_BUF
	default y

config USBD_SHELL
	bool "Enable USB device shell"
	default y
	depends on SHELL
	help
	  Enable USB device shell.

config USBD_DEVICE_VID
	hex "USB Vendor ID"
	default 0x2FE3
	help
	  USB device vendor ID. MUST be configured by vendor.

config USBD_DEVICE_PID
	hex "USB Product ID"
	default 0xFFFF
	help
	  USB device product ID. MUST be configured by vendor.

config USBD_DEVICE_MANUFACTURER
	string "USB manufacturer name"
	default "ZEPHYR"
	help
	  USB device Manufacturer string. MUST be configured by vendor.

config USBD_DEVICE_PRODUCT
	string "USB product name"
	default "USB-DEV"
	help
	  USB device Product string. MUST be configured by vendor.

config USBD_DEVICE_SN
	string "USB device Serial Number String"
	default "0123456789ABCDEF"
	help
	  Placeholder for USB device Serial Number String.
	  Serial Number String will be derived from
	  Hardware Information Driver (HWINFO).

config USBD_REQUEST_BUFFER_SIZE
	int "Set buffer size for Standard, Class and Vendor request handlers"
	range 8 65536
	default 256

config USB_DEVICE_DISABLE_ZLP_EPIN_HANDLING
	bool
	help
	  Stack should not handle ZLP for Variable-length Data Stage
	  because it is taken over by the hardware.

config USBD_SELF_POWERED
	bool "Set Self-powered characteristic"
	default y
	help
	  Set Self-powered characteristic in bmAttributes to indicate
	  self powered USB device.

config USBD_MAX_POWER
	int "Set bMaxPower value"
	default 50
	range 0 250
	help
	  Set bMaxPower value in the Standard Configuration Descriptor,
	  the result is 2mA times the value provided.

source "subsys/usb/usbd/class/Kconfig"

endif # USBD_DEVICE_STACK
```

## subsys/usb/usbd/class/Kconfig
```kconfig
# Copyright (c) 2020 PHYTEC Messtechnik GmbH
#
# SPDX-License-Identifier: Apache-2.0

# USB device classes configuration options

source "subsys/usb/usbd/class/Kconfig.loopback"
```

## subsys/usb/usbd/class/Kconfig.loopback
```kconfig
# Copyright (c) 2020 PHYTEC Messtechnik GmbH
#
# SPDX-License-Identifier: Apache-2.0

# USB device classes configuration options

config USBD_LOOPBACK_CLASS
	bool "USB Loopback Class"
	help
	  USB device loopback class.
	  Primarily used for test and development purposes.

if USBD_LOOPBACK_CLASS
module = USBD_LOOPBACK
module-str = usbd loopback
default-count = 1
source "subsys/usb/class/Kconfig.template.composite_device_number"
source "subsys/logging/Kconfig.template.log_config"
endif
```

## subsys/usb/usbh_quectel_driver/Kconfig
```kconfig
# Copyright (c) 2025 Quectel Corporation
# SPDX-License-Identifier: Apache-2.0

config USBH_QUECTEL_DRIVER
	bool "USB subsys controller drivers"
	default y if DT_HAS_USBH_QUECTEL_DRIVER_ENABLED
	default n
	help
	  USB subsys controller drivers
	  
source "subsys/usb/usbh_quectel_driver/driver/Kconfig.stm32"
```

## subsys/usb/usbh_quectel_driver/driver/Kconfig.stm32
```kconfig
# Copyright (c) 2025 Quectel Corporation
# SPDX-License-Identifier: Apache-2.0

config USBH_STM32_DRIVE_QUECTEL
	bool "STM32 USB host controller driver"
	depends on DT_HAS_USBH_QUECTEL_DRIVER_ENABLED
	select USE_STM32_LL_USB
	select USE_STM32_HAL_HCD
	select PINCTRL
	default y
	help
	  STM32 USBH controller driver.
```

## subsys/usb/userial/quectel/Kconfig
```kconfig
# Copyright (c) 2025 Quectel Corporation
# SPDX-License-Identifier: Apache-2.0
# Users can define other mcu to drive quectel moodules here

config USERIAL_QUECTEL
	bool "USB serial port using MCU as host and quectel as device"
	default y if USERIAL_STM32_DRIVE_QUECTEL
	default n
	help
	  USB subsys userial drivers
	  
source "subsys/usb/userial/quectel/driver/Kconfig.stm32"
```

## subsys/usb/userial/quectel/driver/Kconfig.stm32
```kconfig
# Copyright (c) 2025 Quectel Corporation
# SPDX-License-Identifier: Apache-2.0

config USERIAL_STM32_DRIVE_QUECTEL
	bool "USB serial port using stm32 as host and quectel as device"
	depends on DT_HAS_QUECTEL_STM32_USERIAL_DRIVER_ENABLED
	select USE_STM32_LL_USB
	select USE_STM32_HAL_HCD
	select PINCTRL
	default y
	help
	  STM32 USBH controller driver.
```
