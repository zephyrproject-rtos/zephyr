## subsys/usb/host/class/hid/Kconfig
```kconfig
# Copyright (c) 2026 Renesas Electronics Corporation
# SPDX-License-Identifier: Apache-2.0

config USBH_HID_CLASS
	bool "USB host HID Class support [EXPERIMENTAL]"
	select EXPERIMENTAL
	depends on USB_HOST_STACK
	help
	  USB Host HID Class implementation.

if USBH_HID_CLASS

config USBH_HID_INIT_PRIORITY
	int "Init priority"
	default 91
	help
	  Device driver initialization priority.

config USBH_HID_WORKQUEUE_STACK_SIZE
	int "Stack size of the USB host HID work queue"
	default 1024
	help
	  Size of the stack for the dedicated work queue thread used to recover a
	  stalled input endpoint outside of the USB host thread's context.

config USBH_HID_WORKQUEUE_PRIORITY
	int "Priority of the USB host HID work queue"
	default 10
	help
	  Priority of the USB host HID work queue thread used to recover a
	  stalled input endpoint outside of the USB host thread's context.

config USBH_HID_REPORT_MAX_USAGES
	int "Maximum usages to be found in a HID report descriptor"
	default 16
	help
	  HID report descriptor fields have usages associated with them.
	  Usages are specified sequentially and are assigned to fields
	  with FIFO order. This option declares how big the usage stack
	  can get.

config USBH_HID_REPORT_MAX_VARIANTS
	int "Maximum number of report variants for HID devices"
	default 32
	range 0 255
	help
	  HID devices can specify multiple reports, each distinguished by
	  a report ID. This option declares how many the driver can allocate.

config USBH_HID_REPORT_MAX_COLLECTIONS
	int "Maximum number of report collections for HID devices"
	default 16
	help
	  HID report descriptors are organized in logical group called
	  collections. This option declares how many the driver can allocate.

config USBH_HID_REPORT_MAX_FIELDS
	int "Maximum number of report fields for HID devices"
	default 32
	help
	  HID report descriptors are a list of input/output fields with which
	  the device communicates. This option declares how many the driver
	  can allocate.

config USBH_HID_REPORT_MAX_STATE_STACK
	int "Maximum size of the report state stack for HID devices"
	default 8
	help
	  HID report descriptors work with a global state that can be pushed
	  and popped from a stack. This option declares how bit the state stack
	  can get.

config USBH_HID_ROUTE_TO_INPUT
	bool "Route the HID events directly to the input subsystem"
	default n
	select INPUT
	help
	  A HID device generates some events that can be handled by the input
	  subsystem. By flagging this option they are reported through the
	  USB host device.

config USBH_HID_MAX_INPUT_REPORT_SIZE
	int "Maximum input report size"
	default 16
	depends on USBH_HID_ROUTE_TO_INPUT
	help
	  In order to properly route HID events to the input subsystem the
	  input reports must be stored and compared against the ones following.
	  This is the maximum allowed report input size.


module = USBH_HID
module-str = usbh hid
source "subsys/logging/Kconfig.template.log_config"

endif # USBH_HID_CLASS
```

## subsys/uwb/Kconfig
```kconfig
# Copyright 2026 NXP
# SPDX-License-Identifier: Apache-2.0

menuconfig UWB
	bool "Ultra-Wideband subsystem"
	default n
	help
	  Enable Ultra wideband subsystem

if UWB

choice "UWB_LOG_LEVEL_CHOICE"
	prompt "Max compiled-in log level for UWB"
	default UWB_LOG_LEVEL_DEFAULT
	depends on LOG

config UWB_LOG_LEVEL_OFF
	bool "UWB logging level Off"

config UWB_LOG_LEVEL_ERR
	bool "UWB logging level Error"

config UWB_LOG_LEVEL_WRN
	bool "UWB logging level Warning"

config UWB_LOG_LEVEL_INF
	bool "UWB logging level Info"

config UWB_LOG_LEVEL_DBG
	bool "UWB logging level Debug"

config UWB_LOG_LEVEL_DEFAULT
	bool "UWB logging level Default"

endchoice

config UWB_LOG_LEVEL
	int
	depends on LOG
	default 0 if UWB_LOG_LEVEL_OFF
	default 1 if UWB_LOG_LEVEL_ERR
	default 2 if UWB_LOG_LEVEL_WRN
	default 3 if UWB_LOG_LEVEL_INF
	default 4 if UWB_LOG_LEVEL_DBG
	default LOG_DEFAULT_LEVEL if UWB_LOG_LEVEL_DEFAULT

rsource "uci_lib/Kconfig"
rsource "uwb_api/Kconfig"

endif # UWB
```

## subsys/uwb/uwb_api/Kconfig
```kconfig
# Copyright 2026 NXP
# SPDX-License-Identifier: Apache-2.0

if UWB

config UWB_INITIALIZATION_POST_KERNEL
	bool "Post kernel initialization of UWB"
	default y
	help
	  Configure if initialization of UWB should be done during post kernel boot

config UWB_NOTIFICATION_CALLBACK_STACK_SIZE
	int "Size of default notification callback handler"
	default 10000
	help
	  Size of default notification callback handler

config UWB_NOTIFICATION_HANDLER_THREAD_PRIO
	int "Priority of default notification callback handler"
	default 5
	help
	  Priority of default notification callback handler

config UWB_NUM_SUPPORTED_ALIRO_PROTOCOL_VERSIONS
	int "Maximum number of Aliro supported protocol versions accepted from UWB device"
	default 2
	help
	  Maximum number of Aliro supported protocol versions accepted from UWB device

config UWB_NUM_SUPPORTED_CCC_PROTOCOL_VERSIONS
	int "Maximum number of CCC supported protocol versions accepted from UWB device"
	default 2
	help
	  Maximum number of CCC supported protocol versions accepted from UWB device

config UWB_NUM_SUPPORTED_CCC_UWB_CONFIG_ID
	int "Maximum number of CCC UWB Config IDs accepted from UWB device"
	default 2
	help
	  Maximum number of CCC UWB Config IDs accepted from UWB device

config UWB_NUM_SUPPORTED_CCC_PULSESHAPE_COMBO
	int "Maximum number of CCC pulseshape combo values accepted from UWB device"
	default 9
	help
	  Maximum number of CCC pulseshape combo values accepted from UWB device

endif
```

## subsys/zfence/Kconfig
```kconfig
# SPDX-FileCopyrightText: Copyright The Zephyr Project Contributors
# SPDX-License-Identifier: Apache-2.0

menuconfig ZFENCE
	bool "Zfence"
	select EVENTS
	help
	  Enable the Zfence synchronization primitive.

if ZFENCE

config ZFENCE_PER_FENCE_WAIT_CTX
	bool "Per-fence synchronous wait context pool"
	help
	  When enabled, each fence instance maintains its own pool of wait
	  contexts instead of drawing from a single global pool.  This
	  removes the system-wide limit of ZFENCE_MAX_SYNC_WAITERS concurrent
	  wait contexts.  When the wait context is not pre-bound to a fence
	  via zfence_wait_ctx_init(), a wait context initialization equivalent
	  is performed on every zfence_wait() call instead of once per context
	  across the system.

endif # ZFENCE
```

## tests/application_development/code_relocation/Kconfig
```kconfig
# Copyright (c) 2022, NXP
# SPDX-License-Identifier: Apache-2.0

config RELOCATE_TO_ITCM
	bool "test with code relocate to itcm"

config TEST_SPLIT_RAM_LOAD_DATA
	bool "Test split RAM-load data initialization"
	select ARCH_DATA_COPY_FOR_RAM_LOAD_SPLIT

source "Kconfig.zephyr"
```

## tests/application_development/romstart_flash_base/testcase.yaml
```yaml
common:
  tags: linker
  harness: ztest
  platform_allow:
    - nucleo_f401re
  integration_platforms:
    - nucleo_f401re
tests:
  application_development.romstart_flash_base:
    filter: CONFIG_CPU_CORTEX_M_HAS_VTOR
```

## tests/arch/arm/arm_irq_vector_table/testcase.yaml
```yaml
common:
  filter: CONFIG_ARMV6_M_ARMV8_M_BASELINE or CONFIG_ARMV7_M_ARMV8_M_MAINLINE
  tags:
    - arm
    - interrupt
    - vector_table
  arch_allow: arm
tests:
  arch.arm.irq_vector_table:
    filter: not CONFIG_TRUSTED_EXECUTION_NONSECURE and
            not CONFIG_GEN_ISR_TABLES
    platform_exclude:
      - mr_canhubk3
      - imx95_evk/mimx9596/m7
      - imx95_evk_15x15/mimx9596/m7
      - imx95_evk/mimx9596/m7/ddr
      - imx95_evk/mimx9596/m7/flash
      - lp_em_cc2745r10_q1/cc2745r10_q1
      - lp_em_cc2745r10_q1/cc2755r10
      - lp_em_cc2755p10
      - lp_em_cc2340r5
      - lp_em_cc2340r5moda
      - lp_em_cc2340r53
      - lp_em_cc2340r53_wcsp
```

## tests/arch/arm/arm_sw_vector_relay/Kconfig
```kconfig
# Copyright (c) 2026 NXP
# SPDX-License-Identifier: Apache-2.0

source "Kconfig.zephyr"

config SKIP_IRQS
	string "Vector-table entries excluded from relay verification"
	default ""
	help
	  Comma-separated vector-table entry numbers that the relay test must
	  not verify. Use this for board-required vector-table contents that
	  cannot contain the vector relay handler.
```

## tests/arch/arm64/arm64_gicv3_its/boards/qemu_cortex_a53_qemu_cortex_a53_smp.conf
```kconfig
# SPDX-FileCopyrightText: Copyright (c) 2026 Process Mission
# SPDX-License-Identifier: Apache-2.0

CONFIG_GIC_V3_ITS_MAX_DEVICES=256
```
