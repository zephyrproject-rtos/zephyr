## subsys/usb/host/Kconfig.msc
```kconfig
# Copyright (c) 2026 AMD
# SPDX-License-Identifier: Apache-2.0

config USBH_MSC
	bool "USB Mass Storage host descriptor helpers"
	default n
	help
	  Parse the configuration descriptor to find the MSC interface and bulk
	  IN/OUT endpoints (MSC class bind/probe).

config USBH_MSC_CLASS
	bool "USB MSC host class driver (automatic class probe)"
	depends on USBH_MSC && SCSI
	default n
	help
	  Register a USB host class instance that matches Mass Storage interfaces
	  and runs storage bringup from usbh_class_probe_device() after
	  enumeration completes.

config USBH_MSC_AUTO_BRINGUP
	bool "Auto-run MSC storage bringup from class probe"
	depends on USBH_MSC_CLASS
	default n
	help
	  When enabled, the MSC host class probe handler calls
	  usbh_msc_storage_bringup() (SCSI probe + optional scsi_disk attach).
	  Disable to bind descriptors only and call bringup from the application.

config USBH_MSC_LUN_SLOTS
	int "Maximum concurrent USB MSC LUN contexts"
	depends on USBH_MSC
	default 4
	range 1 16
	help
	  Number of struct usb_msc_lun objects (transport + scsi_device
	  [+ scsi_disk]). Covers transport bindings, probe-only bringup, and
	  registered scsi_disk volumes in one registry.

config USBH_MSC_DISK
	bool "Register USB MSC LUNs as scsi_disk volumes"
	depends on USBH_MSC_CLASS && DISK_DRIVER_SCSI
	default n
	help
	  USB host MSC integration only: after BOT/SCSI bringup, register a
	  scsi_disk volume for disk_access / FatFs. UFS and other SCSI
	  transports use CONFIG_DISK_DRIVER_SCSI and their own subsystem
	  Kconfig; they do not use this symbol.

if USBH_MSC_DISK

config USBH_MSC_DISK_NAME
	string "Base disk_access name for auto-attached MSC volumes"
	default "USB"
	help
	  Prefix for scsi_disk_register() volume names when auto-attach is enabled.
	  The first MSC LUN on any port uses this name exactly (e.g. ``USB``); each
	  additional attached LUN across all devices gets a numeric suffix (``USB1``,
	  ``USB2``, …) up to @kconfig:option:`CONFIG_USBH_MSC_LUN_SLOTS`.

config USBH_MSC_DISK_AUTO_ATTACH
	bool "Auto-attach LUN0 scsi_disk during storage bringup"
	default y
	help
	  When enabled, usbh_msc_storage_bringup() registers LUN0 as a
	  disk_access volume using CONFIG_USBH_MSC_DISK_NAME.

config USBH_MSC_DISK_ATTACH_ALL_LUNS
	bool "Auto-attach every probed MSC LUN as a scsi_disk volume"
	default n
	depends on USBH_MSC_DISK_AUTO_ATTACH
	help
	  When enabled, each probed LUN is attached during bringup (names: USB,
	  USB1, USB2, …). Requires CONFIG_USBH_MSC_LUN_SLOTS large enough for
	  the device.

config USBH_MSC_DISK_PARTITION
	bool "Discover FAT/exFAT partition before registering LUN0"
	default y
	help
	  Run scsi_partition_discover_fat() before scsi_disk_register(). When
	  no FAT volume is found the full LUN is still registered (whole-disk
	  fallback).

endif # USBH_MSC_DISK

config USBH_MSC_STRICT_PROBE
	bool "Strict MSC descriptor probe rules"
	depends on USBH_MSC
	default y
	help
	  Apply descriptor gates per the USB Mass Storage class specification:

	  bDeviceClass must be 0 (definitions at interface), interface subclass
	  in the RBC..SCSI range, protocol CB/CBI/BBB, alternate setting 0 only,
	  bulk IN+OUT, interrupt endpoint required for CBI, and subclass must be
	  UFI, 8070, or SCSI for the SCSI command path.

	  Disable for non-standard devices that still expose a valid MSC bulk pair.

config USBH_MSC_LOG_PROBE
	bool "Log MSC bulk interface probe when configuration completes"
	depends on USBH_MSC
	default n
	help
	  Emit one INFO line from the host stack right after USB_STATE_CONFIGURED.

config USBH_MSC_BOT_CBW_CDB_LOG
	bool "Log MSC BOT CBW and SCSI CDB at INFO before each bulk OUT"
	depends on USBH_MSC
	default n
	help
	  Emit one INFO line plus a 31-byte CBW hexdump for every BOT command
	  (CBW bulk OUT). Decodes READ(10) and WRITE(10) CDB LBA and block count.

config USBH_MSC_FLOW_LOG
	bool "MSC host bringup and BOT phase flow logs at INFO"
	depends on USBH_MSC
	default n
	help
	  Step-by-step INFO logs during usbh_msc_storage_bringup and each BOT
	  phase (CBW / DATA / CSW), including errno names on failures. Use with
	  CONFIG_USBH_LOG_LEVEL_DBG and CONFIG_UHC_DRIVER_LOG_LEVEL_DBG for full
	  UHC detail.
```

## subsys/usb/host/class/Kconfig.billboard
```kconfig
# Copyright (c) 2026 Renesas Electronics Corporation
# SPDX-License-Identifier: Apache-2.0

config USBH_BILLBOARD_CLASS
	bool "USB Billboard Class support [EXPERIMENTAL]"
	select EXPERIMENTAL
	help
	  USB Host billboard Class implementation.

if USBH_BILLBOARD_CLASS

# USBH_BILLBOARD_INIT_PRIORITY = USBH_INIT_PRIO + 1
config USBH_BILLBOARD_INIT_PRIORITY
	int "Init priority for Billboard class"
	default 91
	help
	  Driver initialization priority.

module = USBH_BILLBOARD
module-str = usbh billboard
source "subsys/logging/Kconfig.template.log_config"

endif # USBH_BILLBOARD_CLASS
```

## subsys/usb/host/class/Kconfig.cdc_ecm
```kconfig
# SPDX-FileCopyrightText: Copyright 2025 - 2026 NXP
# SPDX-License-Identifier: Apache-2.0

config USBH_CDC_ECM_CLASS
	bool "USB Communication Device Class (ECM) support [EXPERIMENTAL]"
	depends on NETWORKING
	select EXPERIMENTAL
	select NET_L2_ETHERNET
	help
	  USB Host Communication Device Class - Ethernet Control Model (CDC-ECM)
	  implementation.

	  Enables support for USB CDC-ECM devices (for example, USB Ethernet
	  adapters) and exposes them as Ethernet network interfaces.

if USBH_CDC_ECM_CLASS

config USBH_CDC_ECM_ETH_DRV_NAME
	string "Ethernet interface name"
	default "usbh_cdc_ecm_eth"
	help
	  This option sets the driver name and name of the network interface
	  in your host system. If there are multiple network interfaces
	  defined, then this value is used as a prefix and the interface names
	  will be usbh_cdc_ecm_eth0, usbh_cdc_ecm_eth1, etc.

config USBH_CDC_ECM_TX_PIPELINE_DEPTH
	int "Number of bulk OUT transfers that may be queued"
	default 1
	range 1 16
	help
	  Number of bulk OUT transfers a driver instance can keep queued at the
	  same time. Every queued transfer holds one transmit buffer, so this
	  also bounds the memory used for transmission.

	  Using more than one allows several packets to be in flight at once and
	  keeps the USB bus busy while a completed transfer is being processed.

config USBH_CDC_ECM_RX_PIPELINE_DEPTH
	int "Number of bulk IN transfers that may be queued"
	default 1
	range 1 16
	help
	  Number of bulk IN transfers a driver instance can keep queued at the
	  same time. Every queued transfer holds one receive buffer, so this
	  also bounds the memory used for reception.

	  Using more than one reduces the chance of dropping packets while a
	  completed transfer is being handed to the network stack.

module = USBH_CDC_ECM
module-str = "usbh cdc_ecm"
default-count = 1
source "subsys/logging/Kconfig.template.log_config"
source "subsys/usb/common/Kconfig.template.instances_count"

endif # USBH_CDC_ECM_CLASS
```

## subsys/usb/host/class/Kconfig.cdc_ecm_host
```kconfig
# Copyright (c) 2026 Linumiz
# SPDX-License-Identifier: Apache-2.0

config USBH_CDC_ECM
	bool "USB host CDC ECM class driver"
	depends on USB_HOST_STACK
	depends on NET_L2_ETHERNET
	help
	  USB host class driver for CDC Ethernet Control Model (ECM) devices.

if USBH_CDC_ECM

module = USBH_CDC_ECM
module-str = usbh cdc_ecm
default-count = 1
source "subsys/logging/Kconfig.template.log_config"
source "subsys/usb/common/Kconfig.template.instances_count"

endif # USBH_CDC_ECM
```

## subsys/usb/host/class/Kconfig.cdc_ncm
```kconfig
# SPDX-FileCopyrightText: Copyright 2026 NXP
# SPDX-License-Identifier: Apache-2.0

config USBH_CDC_NCM_CLASS
	bool "USB Communication Device Class (NCM) support [EXPERIMENTAL]"
	select EXPERIMENTAL
	select NET_L2_ETHERNET
	help
	  USB Host Communication Device Class - Network Control Model (CDC-NCM)
	  implementation.

	  Enables support for USB CDC-NCM devices (for example, USB Ethernet
	  adapters) and exposes them as Ethernet network interfaces.

if USBH_CDC_NCM_CLASS

config USBH_CDC_NCM_ETH_DRV_NAME
	string "Ethernet interface name"
	default "usbh_cdc_ncm_eth"
	help
	  This option sets the driver name and name of the network interface
	  in your host system. If there are multiple network interfaces
	  defined, then this value is used as a prefix and the interface names
	  will be usbh_cdc_ncm_eth0, usbh_cdc_ncm_eth1, etc.

config USBH_CDC_NCM_MAX_NTB_SIZE
	int "Maximum NTB size"
	default 2048
	range 2048 16384
	help
	  Size of the buffers used to build and receive the NCM Transfer Blocks
	  (NTB).

	  This is also used as the initial value for the maximum NTB size the
	  device is allowed to send to the host (SetNtbInputSize), clamped to
	  the maximum size reported by the device. The host shall select at
	  least 2048 bytes (NCM100.pdf, 7.2.7).

config USBH_CDC_NCM_RX_DOUBLE_BUFFERING
	bool "NCM receive double buffering"
	default y
	help
	  Allocate two bulk IN transfers instead of one to increase throughput by
	  receiving the next NTB while the previous one is handed to the network
	  stack. Without it the receive path leaves a short gap between NTBs.

	  Enabling this costs one additional receive buffer of
	  USBH_CDC_NCM_MAX_NTB_SIZE bytes per driver instance.

config USBH_CDC_NCM_TX_WINDOW_US
	int "Aggregation window in microseconds"
	default 200
	range 0 10000
	help
	  Maximum time in microseconds the driver waits for additional packets
	  before transmitting the NTB it is building. A longer window
	  aggregates more packets per NTB at the cost of latency. With 0 the
	  NTB is transmitted as soon as the queue is non-empty.

	  This is the equivalent of the Linux cdc_ncm "tx_timer_usecs" module
	  parameter.

module = USBH_CDC_NCM
module-str = "usbh cdc_ncm"
default-count = 1
source "subsys/logging/Kconfig.template.log_config"
source "subsys/usb/common/Kconfig.template.instances_count"

endif # USBH_CDC_NCM_CLASS
```

## subsys/usb/host/class/Kconfig.dfu
```kconfig
# Copyright (c) 2026 Renesas Electronics Corporation
# SPDX-License-Identifier: Apache-2.0

config USBH_DFU_CLASS
	bool "USB DFU Class support [EXPERIMENTAL]"
	select EXPERIMENTAL
	help
	  USB Host Device Firmware Update Class implementation.

if USBH_DFU_CLASS

config USBH_DFU_MAX_ALTERNATE_NR
	int "Maximum number of alternate settings"
	default 32
	range 1 32
	help
	  Maximum number of alternate settings that
	  driver accepts from device

config USBH_DFU_LIMIT_DATA_ALLOC_BYTES
	int "Upper memory limit in bytes allocated for USB Host data transfers"
	default 512
	range 1 65535
	help
	  The driver won't allocate more than LIMIT_DATA_ALLOC_BYTES for data transfers.
	  This prevents a malicious device from requesting a full 64K space from host.

# USBH_DFU_INIT_PRIORITY = USBH_INIT_PRIO + 1
config USBH_DFU_INIT_PRIORITY
	int "Init priority for DFU class"
	default 91
	help
	  Driver initialization priority.

module = USBH_DFU
module-str = usbh dfu
source "subsys/logging/Kconfig.template.log_config"

endif # USBH_DFU_CLASS
```

## subsys/usb/host/class/Kconfig.hid_boot
```kconfig
# Copyright (c) 2026 Antmicro <www.antmicro.com>
# SPDX-License-Identifier: Apache-2.0

config USBH_HID_BOOT_CLASS
	bool "USB host HID Boot class [EXPERIMENTAL]"
	select EXPERIMENTAL
	depends on INPUT
	help
	  USB Host HID Boot Class implementation.

config USBH_HID_BOOT_INIT_PRIORITY
	int "Host HID Boot initialization priority"
	default 60
	depends on USBH_HID_BOOT_CLASS
	help
	  priority used for initialization of HID Boot device class in the USB host subsystem.

module = USBH_HID_BOOT
module-str = usbh hid boot
default-count = 1
source "subsys/logging/Kconfig.template.log_config"
source "subsys/usb/common/Kconfig.template.instances_count"
```

## subsys/usb/host/class/Kconfig.hub
```kconfig
# SPDX-FileCopyrightText: Copyright The Zephyr Project Contributors
# SPDX-License-Identifier: Apache-2.0

config USBH_HUB_CLASS
	bool "USB host Hub Class support [EXPERIMENTAL]"
	select EXPERIMENTAL
	help
	  USB Host Hub Class implementation. Devices connected to the
	  downstream ports of a hub are enumerated by the host stack.

if USBH_HUB_CLASS

config USBH_HUB_MAX_PORTS
	int "Maximum number of downstream ports per hub"
	range 1 15
	default 8
	help
	  Downstream ports above this number are ignored.

module = USBH_HUB
module-str = usbh hub
default-count = 1
source "subsys/logging/Kconfig.template.log_config"
source "subsys/usb/common/Kconfig.template.instances_count"

endif # USBH_HUB_CLASS
```

## subsys/usb/host/class/Kconfig.msc
```kconfig
# SPDX-FileCopyrightText: Copyright 2026 NXP
# SPDX-License-Identifier: Apache-2.0

config USBH_MSC_CLASS
	bool "USB host Mass Storage Class support"
	select DISK_ACCESS
	help
	  USB Host Mass Storage Class (MSC) implementation.

if USBH_MSC_CLASS

config USBH_MSC_MAX_INTERFACE
	int "Maximum number of MSC interfaces"
	default 4
	range 1 16
	help
	  Maximum number of MSC interfaces that can be supported.
	  This defines the array size for storing interface descriptors

module = USBH_MSC_CLASS
module-str = usbh msc
default-count = 4
source "subsys/logging/Kconfig.template.log_config"
source "subsys/usb/common/Kconfig.template.instances_count"

endif # USBH_MSC_CLASS
```

## subsys/usb/host/class/Kconfig.vendor
```kconfig
# Copyright (c) 2026 Renesas Electronics Corporation
# SPDX-License-Identifier: Apache-2.0

config USBH_VENDOR_CLASS
	bool "USB Vendor Class support [EXPERIMENTAL]"
	select EXPERIMENTAL
	help
	  USB Host Vendor Class implementation.

if USBH_VENDOR_CLASS

# USBH_VENDOR_INIT_PRIORITY = USBH_INIT_PRIO + 1
config USBH_VENDOR_INIT_PRIORITY
	int "Init priority for Vendor class"
	default 91
	help
	  Driver initialization priority.

config USBH_VENDOR_MAX_EPTS
	int "Maximum number of supported endpoints"
	range 2 32
	default 6
	help
	  Maximum number of supported endpoints

module = USBH_VENDOR
module-str = usbh vendor
source "subsys/logging/Kconfig.template.log_config"

endif # USBH_VENDOR_CLASS
```
