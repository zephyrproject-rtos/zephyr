## subsys/net/Kconfig.template.log_config.default.net
```kconfig
# Kconfig template file for setting networking log level for
# various network related components. This template variant
# allows user to specify the default log level.
#
# Copyright (c) 2018 Intel Corporation.
#
# SPDX-License-Identifier: Apache-2.0
#

choice
	prompt "$(module-str)"
	default $(module)_$(module-def)
	depends on $(module-dep)
# If we ever get help text macro expansion, then just uncomment
# the following lines.
#	help
#	  $(module-help)

config $(module)_LOG_LEVEL_OFF
	bool "Off"
	help
	  Do not write to log.

config $(module)_LOG_LEVEL_ERR
	bool "Error"
	help
	  Only write to log when NET_ERR or LOG_ERR is used.

config $(module)_LOG_LEVEL_WRN
	bool "Warning"
	help
	  Write to log with NET_WARN or LOG_WRN in addition to previous level.

config $(module)_LOG_LEVEL_INF
	bool "Info"
	help
	  Write to log with NET_INFO or LOG_INF in addition to previous levels.

config $(module)_LOG_LEVEL_DBG
	bool "Debug"
	help
	  Write to log with NET_DBG or LOG_DBG in addition to previous levels.

endchoice

config $(module)_LOG_LEVEL
	int
	default 0 if $(module)_LOG_LEVEL_OFF || !$(module-dep)
	default 1 if $(module)_LOG_LEVEL_ERR
	default 2 if $(module)_LOG_LEVEL_WRN
	default 3 if $(module)_LOG_LEVEL_INF
	default 4 if $(module)_LOG_LEVEL_DBG
```

## subsys/net/Kconfig.template.log_config.net
```kconfig
# Kconfig template file for setting networking log level for
# various network related components.

# Copyright (c) 2018 Intel Corporation.
# SPDX-License-Identifier: Apache-2.0

choice
	prompt "$(module-str)"
	default $(module)_LOG_LEVEL_DEFAULT
	depends on $(module-dep)
# If we ever get help text macro expansion, then just uncomment
# the following lines.
#	help
#	  $(module-help)

config $(module)_LOG_LEVEL_OFF
	bool "Off"
	help
	  Do not write to log.

config $(module)_LOG_LEVEL_ERR
	bool "Error"
	help
	  Only write to log when NET_ERR or LOG_ERR is used.

config $(module)_LOG_LEVEL_WRN
	bool "Warning"
	help
	  Write to log with NET_WARN or LOG_WRN in addition to previous level.

config $(module)_LOG_LEVEL_INF
	bool "Info"
	help
	  Write to log with NET_INFO or LOG_INF in addition to previous levels.

config $(module)_LOG_LEVEL_DBG
	bool "Debug"
	help
	  Write to log with NET_DBG or LOG_DBG in addition to previous levels.

config $(module)_LOG_LEVEL_DEFAULT
	bool "Default"
	help
	  Use default log level.

endchoice

config $(module)_LOG_LEVEL
	int
	default 0 if $(module)_LOG_LEVEL_OFF || !$(module-dep)
	default 1 if $(module)_LOG_LEVEL_ERR
	default 2 if $(module)_LOG_LEVEL_WRN
	default 3 if $(module)_LOG_LEVEL_INF
	default 4 if $(module)_LOG_LEVEL_DBG
	default LOG_DEFAULT_LEVEL if $(module)_LOG_LEVEL_DEFAULT
```

## subsys/net/conn_mgr/Kconfig
```kconfig
# Copyright (c) 2019 Intel Corporation
# SPDX-License-Identifier: Apache-2.0

menuconfig NET_CONNECTION_MANAGER
	bool "Network connection manager [EXPERIMENTAL]"
	depends on NET_IPV6 || NET_IPV4
	select NET_MGMT
	select NET_MGMT_EVENT
	select NET_MGMT_EVENT_INFO
	select EXPERIMENTAL
	help
	  When enabled, this will start the connection manager that will
	  listen to network interface and IP events in order to verify
	  whether an interface is connected or not. It will then raise
	  L4 events "connected" or "disconnected" depending on the result.

if NET_CONNECTION_MANAGER

module = NET_CONNECTION_MANAGER
module-dep = NET_LOG
module-str = Log level for connection manager
module-help = Enables connection manager code to output debug messages.
source "subsys/net/Kconfig.template.log_config.net"

config NET_CONNECTION_MANAGER_MONITOR_STACK_SIZE
	int "Size of the stack allocated for the conn_mgr_monitor thread"
	default 2048 if NET_CONNECTION_MANAGER_ONLINE_CONNECTIVITY_CHECK
	default 512
	help
	  Sets the stack size which will be used by the connection manager for connectivity monitoring.

config NET_CONNECTION_MANAGER_MONITOR_PRIORITY
	int "Monitoring thread starting priority"
	default 1
	range 1 99
	help
	  This sets the starting priority of the conn_mgr_monitor thread.

config NET_CONNECTION_MANAGER_AUTO_IF_DOWN
	bool "Automatically call net_if_down on ifaces that have given up on connecting"
	default y

config NET_CONNECTION_MANAGER_CONNECTIVITY_WIFI_MGMT
	bool "Generic WiFi management connectivity implementation"
	depends on NET_L2_WIFI_MGMT
	help
	  Enable CONNECTIVITY_WIFI_MGMT connectivity bindings on WiFi drivers.
	  Which implementation is compiled is controlled via CONNECTIVITY_WIFI_MGMT_IMPL.

choice CONNECTIVITY_WIFI_MGMT_IMPL
	prompt "Implementation of the generic wifi_mgmt connectivity backend"
	depends on NET_CONNECTION_MANAGER_CONNECTIVITY_WIFI_MGMT
	default CONNECTIVITY_WIFI_MGMT_APPLICATION

config CONNECTIVITY_WIFI_MGMT_APPLICATION
	bool "Application specific implementation of the connectivity backend"
	help
	  The application defines its own implementation of CONNECTIVITY_WIFI_MGMT.

endchoice

config NET_CONNECTION_MANAGER_ONLINE_CONNECTIVITY_CHECK
	bool "Try to connect to Internet to check the connectivity status [EXPERIMENTAL]"
	select EXPERIMENTAL
	help
	  If enabled, then we try to connect to a user defined host in order to
	  verify that we have connectivity to at least to that host. If the host
	  is connected to Internet, then this verifies that we can have an Internet
	  connectivity. This is disabled by default as it requires that user configures
	  the host to connect to.

config NET_CONNECTION_MANAGER_ONLINE_CHECK_PING
	bool "Use Ping (ICMPv4/6 Echo-Request) for connectivity check"
	default y
	depends on NET_CONNECTION_MANAGER_ONLINE_CONNECTIVITY_CHECK
	help
	  Do a connectivity check using an ICMPv4/6 Echo-Request (both IPv4 and
	  IPv6 are supported).

config NET_CONNECTION_MANAGER_ONLINE_CHECK_PING_HOST
	string "Ping request to host"
	depends on NET_CONNECTION_MANAGER_ONLINE_CHECK_PING
	help
	  Do a connectivity check by a ping request to a host.
	  The host can be either a IP address or a hostname.
	  If hostname is set here, you need to enable DNS resolving by setting DNS_RESOLVER option.

config NET_CONNECTION_MANAGER_ONLINE_CHECK_HTTP
	bool "Use HTTP(S) GET request for connectivity check"
	depends on NET_CONNECTION_MANAGER_ONLINE_CONNECTIVITY_CHECK
	select HTTP_CLIENT
	help
	  Do a connectivity check by a HTTP or HTTPS GET request to a server.

config NET_CONNECTION_MANAGER_ONLINE_CHECK_HTTP_URL
	string "HTTP(S) GET request URL"
	depends on NET_CONNECTION_MANAGER_ONLINE_CHECK_HTTP
	help
	  Do a connectivity check by a HTTP GET request to a server.

config NET_CONNECTION_MANAGER_ONLINE_CHECK_MAX_HOSTNAME_LEN
	int "Max hostname length to use for online check"
	default 64
	depends on NET_CONNECTION_MANAGER_ONLINE_CONNECTIVITY_CHECK
	help
	  Size of the hostname buffer if user supplies a hostname instead
	  if IP address. We need to resolve the address and the result is
	  placed into this size buffer.

config NET_CONNECTION_MANAGER_ONLINE_CHECK_TIMEOUT
	int "Online check timeout (ms)"
	default 5000
	depends on NET_CONNECTION_MANAGER_ONLINE_CONNECTIVITY_CHECK
	help
	  How long to wait for a HTTP GET or ping response in milliseconds.

config NET_CONNECTION_MANAGER_ONLINE_VERIFY
	bool "Check periodically whether we are online or not [EXPERIMENTAL]"
	default y
	depends on NET_CONNECTION_MANAGER_ONLINE_CONNECTIVITY_CHECK
	select NET_TRICKLE
	select EXPERIMENTAL
	help
	  Check incoming data packets and notice if we have received
	  data that could be considered originating from Internet (no private
	  address space, no link local address etc). Then use the Trickle
	  algorithm https://www.rfc-editor.org/rfc/rfc6206 to drive the
	  logic that determines when to re-do the online check.

config NET_CONNECTION_MANAGER_ONLINE_VERIFY_PERIOD
	int "How often to trigger Trickle unconsistency check (minutes)"
	default 60
	range 1 525600
	depends on NET_CONNECTION_MANAGER_ONLINE_VERIFY
	help
	  How often to check whether we are unconsistent, the value is
	  in minutes. If we receive data from online sources, we mark the
	  Trickle status as consistent for each packet. This value is
	  used to periodically check whether we received online packets or not.
	  If we did not receive packets, then we mark the link unconsistent
	  and tell Trickle about it. The Trickle algorithm then can decide
	  when we do the actual online check. Default value is every 60 min.

config NET_CONNECTION_MANAGER_ONLINE_VERIFY_PRIV_ADDR_CHECK
	bool "Check if the incoming data is from private address space"
	default y
	depends on NET_CONNECTION_MANAGER_ONLINE_VERIFY
	help
	  Check if the incoming network traffic from private address space
	  range is considered when determining if the device is online or not.
	  The default (y) is to ignore packets from private address range.
	  Turning this off is mainly useful in testing where it might be
	  difficult to send test packets from non private addresses.

config NET_CONNECTION_MANAGER_ONLINE_VERIFY_IMIN
	int "Trickle min interval size in minutes (Imin)"
	default 1440
	depends on NET_CONNECTION_MANAGER_ONLINE_VERIFY
	help
	  How often do the online verification if we cannot verify
	  the online status in other way. Default is once / day.
	  See RFC 6206 for details how the Trickle algorithm works.

config NET_CONNECTION_MANAGER_ONLINE_VERIFY_IMAX
	int "Trickle max number of doublings (Imax)"
	default 5
	depends on NET_CONNECTION_MANAGER_ONLINE_VERIFY
	help
	  See RFC 6206 for details how the Trickle algorithm works.

config NET_CONNECTION_MANAGER_ONLINE_VERIFY_K
	int "Trickle redundancy constant (K)"
	default 20
	depends on NET_CONNECTION_MANAGER_ONLINE_VERIFY
	help
	  See RFC 6206 for details how the Trickle algorithm works.

endif # NET_CONNECTION_MANAGER
```
