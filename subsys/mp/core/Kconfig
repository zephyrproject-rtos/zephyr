## subsys/mp/core/Kconfig
```kconfig
#
# Copyright 2025-2026 NXP
#
# SPDX-License-Identifier: Apache-2.0
#

config MP_THREADS_NUM
	int "Number of mp_thread wrappers used by the whole application"
	range 0 255
	default 1

config MP_THREAD_STACK_SIZE
	int "Stack size of a thread"
	default 1024

config MP_THREAD_DEFAULT_PRIORITY
	int "Priority of a thread"
	default 5

config MP_WORKQUEUE
	bool "Element-level work offload (P4WQ)"
	select SCHED_DEADLINE
	help
	  Enable element-level work offloading via a shared P4WQ
	  (Pooled Parallel Preemptible Priority-based Work Queue)
	  thread pool. Elements can submit finite work items (e.g.,
	  decode, inference) to be processed on pool threads with
	  configurable priority.

config MP_WORKQUEUE_THREADS_NUM
	int "Number of threads in MP workqueue pool"
	default 1
	depends on MP_WORKQUEUE
	help
	  Number of threads in the shared P4WQ pool used for
	  element-level work offload.

config MP_WORKQUEUE_STACK_SIZE
	int "Stack size for MP workqueue pool threads"
	default 4096
	depends on MP_WORKQUEUE
	help
	  Stack size in bytes for each thread in the MP workqueue pool.

config MP_NET_BUF_POOL_COUNT
	int "Number of buffers in the MP shared net_buf pool"
	default 1
	help
	  Number of buffers needed in the shared MP net_buf pool across pipelines.
	  This is sum of the maximum number of in-flight net_buf buffers of each
	  pipeline at any given time

config MP_BIN_MAX_CHILDREN
	int "Maximum number of elements in a bin/pipeline"
	range 2 64
	default 10
	help
	  Maximum number of child elements that can be added to a single
	  bin or pipeline. This is used to size the bin's internal arrays for
	  topological sort during state changes.

config MP_FAKE_SRC
	bool "Fake source element"
	help
	  Emulated source element for pipeline testing.

config MP_FAKE_SRC_BUF_SZ
	int "Buffer size of the fake source element (in bytes)"
	range 1 1024
	default 1
	depends on MP_FAKE_SRC

config MP_BUS_QUEUE_DEPTH
	int "Message bus queue depth"
	default 2
	help
	  Bus queue depth

config MP_RPC
	bool "RPC support"
```

## subsys/mp/disp/Kconfig
```kconfig
#
# Copyright 2025 NXP
#
# SPDX-License-Identifier: Apache-2.0
#

config MP_DISP
	bool "Display plugin support"
	select DISPLAY
```

## subsys/mp/img/Kconfig
```kconfig
# Copyright 2026 NXP
# SPDX-License-Identifier: Apache-2.0

config MP_IMG
	bool "Image codec plugin support"

if MP_IMG

config MP_IMG_JPEG_PARSER_MAX_FRAME_SIZE
	int "Maximum JPEG frame size in bytes"
	default 0
	help
	  Maximum size of a single JPEG frame that the parser can accumulate when
	  downstream does not provide a usable pool.
	  Default value is set to 0 to disable the internal staging pool entirely
	  (no memory reserved).

config MP_IMG_JPEG_PARSER_POOL_NUM
	int "Staging pool buffer count"
	range 1 255
	default 2
	help
	  Number of buffers in the parser's internal staging pool.
	  2 is usually enough (one partial, one output).

config MP_IMG_JPEG_DECODER_POOL_NUM
	int "Number of buffers in the jpeg decoder's output pool"
	range 1 255
	default 1

config MP_IMG_JPEG_DECODER_MAX_OUT_FRAME_SIZE
	int "Maximum decoded output frame size in bytes"
	default 153600
	help
	  Maximum decoded output frame size in bytes for the SW JPEG decoder internal pool.
	  Default value is set for 320x240 RGB565 format.

endif # MP_IMG
```

## subsys/mp/plugins/Kconfig
```kconfig
#
# Copyright 2025 NXP
#
# SPDX-License-Identifier: Apache-2.0
#

menu "Media Pipe plugins"

osource "subsys/mp/plugins/*/Kconfig"

endmenu
```

## subsys/mp/plugins/ipc/Kconfig
```kconfig
#Copyright (c) 2026 Qualcomm Innovation Center, Inc. All rights reserved.
#SPDX-License-Identifier: Apache-2.0


config MP_PLUGIN_IPC
	bool "IPC Source and Sink plugins"
	default n
	depends on IPC_SERVICE
	help
	  Enable IPC plugins for Multi-Processor framework to bridge the
	  pipeline across processors using Zephyr IPC Service.
```

## subsys/mp/plugins/zaud/Kconfig
```kconfig
#
# Copyright 2025 NXP
#
# SPDX-License-Identifier: Apache-2.0
#

config MP_PLUGIN_ZAUD
	bool "Audio plugin support"
	select AUDIO

if MP_PLUGIN_ZAUD

config MP_ZAUD_BUFFER_POOL_SZ_MAX
	int "Size of the largest buffer in the buffer pool"
	default 98304

config MP_ZAUD_BUFFER_POOL_NUM_MAX
	int "Number of maximum sized buffers in the buffer pool"
	default 10

config MP_ZAUD_I2S_CODEC_SINK_SILENCE_PRIME
	bool "Prime the I2S TX with silence and start it at PLAYING"
	help
	  Start the I2S TX with silence buffers when the pipeline reaches
	  PLAYING instead of waiting for buffers from upstream. Needed when the
	  capture source's receiver is clock-synced to this sink's transmitter,
	  for example a codec whose ADC shares the DAC frame clock: the source
	  produces nothing until the transmitter runs, so a source-first
	  pipeline would deadlock. Leave this off for self-clocked sources such
	  as a DMIC.

config MP_ZAUD_I2S_CODEC_SINK_SILENCE_PRIME_COUNT
	int "Number of silence buffers to prime the TX with"
	default 6
	depends on MP_ZAUD_I2S_CODEC_SINK_SILENCE_PRIME
	help
	  How many silence buffers to queue before starting the transmitter.
	  These bridge the startup latency until the capture source delivers
	  its first block; too few and the transmitter underruns before real
	  audio arrives. Must not exceed the I2S TX queue depth, and the buffer
	  pool has to hold this many on top of the capture ring.

config MP_ZAUD_I2S_CODEC_SINK_SET_OUTPUT_VOLUME
	bool "Set codec output volume in the I2S codec sink"
	help
	  When enabled, the I2S codec sink programs the codec output volume
	  after configuring it. Without this, the codec keeps its driver
	  default (typically 0 dB / unity), which can overdrive the analog
	  output stage and sound distorted on boards with a fixed line/speaker
	  amplifier.

config MP_ZAUD_I2S_CODEC_SINK_OUTPUT_VOLUME
	int "Codec output volume (codec-specific units)"
	default 106
	depends on MP_ZAUD_I2S_CODEC_SINK_SET_OUTPUT_VOLUME
	help
	  Output volume value passed to audio_codec_set_property() as the
	  AUDIO_PROPERTY_OUTPUT_VOLUME for AUDIO_CHANNEL_ALL. The units are
	  codec specific. For the WM8962 the field is 7 bits where 121 (0x79)
	  is 0 dB, each step is 1 dB and values up to and including 47 (0x2F)
	  mute the output. The default of 106 is approximately -15 dB.

endif # MP_PLUGIN_ZAUD
```

## subsys/mp/plugins/zbase/Kconfig
```kconfig
#
# Copyright 2026 NXP
#
# SPDX-License-Identifier: Apache-2.0
#

config MP_PLUGIN_ZBASE
	bool "Base elements (capsfilter, queue, tee)"
	default y
	help
	  Enable the base elements plugin.

if MP_PLUGIN_ZBASE

config MP_CAPSFILTER
	bool "Capsfilter element"
	help
	  Enable the capsfilter element. Capsfilter restricts the media
	  format flowing between two elements by filtering on capabilities
	  such as sample rate, pixel format, etc. This allows forcing a
	  specific format at a given point in the pipeline.

config MP_QUEUE
	bool "Queue element (for pipeline-level threading)"
	help
	  Enable the queue element which decouples pipeline segments
	  into separate threads for parallel processing. The queue
	  deposits buffers into a FIFO and spawns a dedicated thread
	  to drive the downstream segment.

config MP_QUEUE_MAX_SIZE
	int "Max size of a queue element"
	range 1 255
	default 2
	depends on MP_QUEUE
	help
	  Maximum number of buffers that can be queued into a queue element

config MP_TEE
	bool "Tee element"
	help
	  Enable the tee element which splits a single input branch
	  into multiple output branches.

config MP_TEE_MAX_SRCPADS_NUM
	int "Maximum number of source pads of a tee element"
	range 2 8
	default 2
	depends on MP_TEE

endif # MP_PLUGIN_ZBASE
```

## subsys/mp/plugins/zdisp/Kconfig
```kconfig
#
# Copyright 2025 NXP
#
# SPDX-License-Identifier: Apache-2.0
#

config MP_PLUGIN_ZDISP
	bool "Display plugin support"
	select DISPLAY
```

## subsys/mp/plugins/zfs/Kconfig
```kconfig
# Copyright 2026 NXP
# SPDX-License-Identifier: Apache-2.0

config MP_PLUGIN_ZFS
	bool "Filesystem plugin support"
	depends on FILE_SYSTEM

if MP_PLUGIN_ZFS

config MP_PLUGIN_ZFS_BLOCK_SIZE
	int "Size of a buffer to read/write from/to a file"
	default 4096
	help
	  Default blocksize (read/write chunk size) used when the element blocksize
	  property is not set.
	  Also used as the size of each internal buffer when zfilesrc falls back to
	  its own static buffer pool.

config MP_PLUGIN_ZFS_NUM_BUFS
	int "Number of buffers in the internal output pool"
	range 1 255
	default 1
	help
	  Number of static buffers in zfilesrc's internal net_buf pool.
	  1 may be enough for fully synchronous pipelines; use >1 if downstream can
	  retain buffers asynchronously.
	  If downstream proposes a pool, zfilesrc uses it instead.

endif # MP_PLUGIN_ZFS
```

## subsys/mp/plugins/zjpeg/Kconfig
```kconfig
# Copyright 2026 NXP
# SPDX-License-Identifier: Apache-2.0

config MP_PLUGIN_ZJPEG
	bool "JPEG plugin support"

if MP_PLUGIN_ZJPEG

config MP_ZJPEG_PARSER_MAX_FRAME_SIZE
	int "Maximum JPEG frame size in bytes"
	default 0
	help
	  Maximum size of a single JPEG frame that the parser can accumulate when
	  downstream does not provide a usable pool.
	  Default value is set to 0 to disable the internal staging pool entirely
	  (no memory reserved).

config MP_ZJPEG_PARSER_POOL_NUM
	int "Staging pool buffer count"
	range 1 255
	default 2
	help
	  Number of buffers in the parser's internal staging pool.
	  2 is usually enough (one partial, one output).

config MP_ZJPEG_DECODER_POOL_NUM
	int "Number of buffers in the jpeg decoder's output pool"
	range 1 255
	default 1

config MP_ZJPEG_DECODER_MAX_OUT_FRAME_SIZE
	int "Maximum decoded output frame size in bytes"
	default 153600
	help
	  Maximum decoded output frame size in bytes for the SW JPEG decoder internal pool.
	  Default value is set for 320x240 RGB565 format.

config MP_ZJPEG_ENCODER
	bool "Software JPEG encoder element"
	help
	  Build the software JPEG encoder element (mp_zjpeg_encoder) and the
	  vendored bitbank JPEGENC library (jpeg_enc.c). The encoder accepts RGB565
	  frames on its sink pad and produces JPEG frames on its source pad.

config MP_ZJPEG_ENCODER_POOL_NUM
	int "Number of buffers in the jpeg encoder's output pool"
	depends on MP_ZJPEG_ENCODER
	range 1 255
	default 2
	help
	  Number of buffers in the SW JPEG encoder's internal output pool.
	  2-3 buffers allow pipelining (one being filled, one in flight).

config MP_ZJPEG_ENCODER_MAX_OUT_FRAME_SIZE
	int "Maximum encoded output frame size in bytes"
	depends on MP_ZJPEG_ENCODER
	default 153600
	help
	  Maximum encoded JPEG frame size in bytes for the SW JPEG encoder internal
	  pool. JPEG output is variable in size; this is a safe upper bound sized to
	  the raw RGB565 frame (W * H * 2), since the compressed output is smaller
	  than the raw input at these quality levels. Default is set for 320x240
	  RGB565. The library reserves a 512-byte high-water margin and requires a
	  buffer of at least 1024 bytes.

endif # MP_PLUGIN_ZJPEG
```

## subsys/mp/plugins/znet/Kconfig
```kconfig
# Copyright 2026 NXP
# SPDX-License-Identifier: Apache-2.0

config MP_PLUGIN_ZNET
	bool "Network plugin support (TCP server sink and source)"
	depends on NETWORKING && NET_TCP && NET_SOCKETS
	select NET_IPV4_MAPPING_TO_IPV6 if NET_IPV6
	help
	  Enable the znet plugin which provides TCP server sink and source
	  elements. Each element listens on a configurable port, accepts one
	  client connection, and streams pipeline buffers as raw bytes over TCP.
	  When IPv6 is enabled, a single socket accepts both IPv4 and IPv6
	  clients via IPv4-mapped addresses.

if MP_PLUGIN_ZNET

config MP_PLUGIN_ZNET_DEFAULT_PORT
	int "Default TCP port for the TCP sink element (mp_ztcpsink)"
	default 5000
	range 1 65535
	help
	  Default TCP port number the mp_ztcpsink element binds to when no
	  PROP_ZTCPSINK_PORT property is set by the application.

config MP_PLUGIN_ZNET_DEFAULT_SRC_PORT
	int "Default TCP port for the TCP source element (mp_ztcpsrc)"
	default 5001
	range 1 65535
	help
	  Default TCP port number the mp_ztcpsrc element binds to when no
	  PROP_ZTCPSRC_PORT property is set by the application.

config MP_PLUGIN_ZNET_SRC_BUF_SIZE
	int "Receive buffer size for the TCP source element (bytes)"
	default 4096
	range 64 65536
	help
	  Size in bytes of each receive buffer allocated by mp_ztcpsrc.

config MP_PLUGIN_ZNET_SRC_NUM_BUFS
	int "Number of receive buffers for the TCP source element"
	default 4
	range 1 32
	help
	  Number of net_buf entries in the mp_ztcpsrc receive pool.

endif # MP_PLUGIN_ZNET
```

## subsys/mp/plugins/zvid/Kconfig
```kconfig
#
# Copyright 2025 NXP
#
# SPDX-License-Identifier: Apache-2.0
#

config MP_PLUGIN_ZVID
	bool "Video plugin support"
	select VIDEO

if MP_PLUGIN_ZVID

config MP_ZVID_CONVERT
	bool "Software-based pixel format converter"
	help
	  Convert video frame between different pixel formats based on SW

endif # MP_PLUGIN_ZVID
```

## subsys/mp/utils/Kconfig
```kconfig
#
# Copyright 2026 NXP
#
# SPDX-License-Identifier: Apache-2.0
#

config MP_PLAYER
	bool "MultimediaPipe player helper"
	depends on MP
	select POLL
	imply SHELL
	imply SERIAL
	imply UART_CONSOLE
	help
	  Enable the mp_player control layer: a reusable, media-player-like
	  helper that owns the run-time lifecycle of a pipeline (play, pause,
	  stop, replay, quit). When SHELL is enabled it also registers
	  interactive shell commands ("player play|pause|stop|replay|status"
	  and the single-letter shortcuts p/s/r/q).

if MP_PLAYER

config MP_PLAYER_WORKER_STACK_SIZE
	int "Player worker thread stack size"
	default 2048
	help
	  Stack size (in bytes) for the player worker thread that serializes
	  pipeline state changes.

config MP_PLAYER_WORKER_PRIORITY
	int "Player worker thread priority"
	default 5
	help
	  Scheduling priority for the player worker thread.

config MP_PLAYER_CMD_QUEUE_DEPTH
	int "Player command queue depth"
	default 8
	help
	  Number of pending commands the player can buffer before a caller
	  blocks while enqueueing a new command.

endif # MP_PLAYER
```

## subsys/mp/vid/Kconfig
```kconfig
#
# Copyright 2025 NXP
#
# SPDX-License-Identifier: Apache-2.0
#

config MP_VID
	bool "Video plugin support"
	select VIDEO

if MP_VID

config MP_VID_CONVERT
	bool "Software-based pixel format converter"
	help
	  Convert video frame between different pixel formats based on SW

endif # MP_VID
```

## subsys/net/Kconfig.hostname
```kconfig
# Hostname config

# Copyright (c) 2017 Intel Corporation.
# SPDX-License-Identifier: Apache-2.0

config NET_HOSTNAME_ENABLE
	bool "Add hostname to the device"
	help
	  This is used for example in mDNS to respond to <hostname>.local
	  mDNS queries.

if NET_HOSTNAME_ENABLE

config NET_HOSTNAME
	string "The hostname of this device"
	default "zephyr"
	help
	  The string should be a valid hostname.

config NET_HOSTNAME_DYNAMIC
	bool "Allow the hostname to be set by the application"
	depends on !NET_HOSTNAME_UNIQUE_UPDATE
	help
	  This will enable the net_hostname_set() function. NET_HOSTNAME
	  will be used as default hostname.

config NET_HOSTNAME_MAX_LEN
	int "The maximum allowed hostname length"
	depends on NET_HOSTNAME_DYNAMIC
	range 1 63
	default 63
	help
	  This will set the number of bytes allocateed for the hostname.

config NET_HOSTNAME_UNIQUE
	bool "Make hostname unique"
	help
	  This will append link address to NET_HOSTNAME to create a unique
	  hostname. For example, zephyr00005e005357 could be the hostname
	  if this setting is enabled.

config NET_HOSTNAME_UNIQUE_UPDATE
	bool "Update unique hostname"
	depends on NET_HOSTNAME_UNIQUE
	help
	  This will update the unique hostname on link address changes. By
	  default, this option is disabled, which means the unique hostname
	  is set once at start-up and is not updated afterwards.

module = NET_HOSTNAME
module-dep = NET_LOG
module-str = Log level for hostname configuration
module-help = Enables hostname configuration code to output debug messages.
source "subsys/net/Kconfig.template.log_config.net"

endif
```
