// SPDX-FileCopyrightText: 2021 Larry Bank <bitbank@pobox.com>
// SPDX-License-Identifier: Apache-2.0
//
// JPEG Encoder
//
// Arduino port started 7/22/2021
// Original JPEG code written 20+ years ago :)
// The goal of this code is to encode JPEG images on embedded systems
//
// Copyright 2021 BitBank Software, Inc. All Rights Reserved.
// Licensed under the Apache License, Version 2.0 (the "License");
// you may not use this file except in compliance with the License.
// You may obtain a copy of the License at
//    http://www.apache.org/licenses/LICENSE-2.0
// Unless required by applicable law or agreed to in writing, software
// distributed under the License is distributed on an "AS IS" BASIS,
// WITHOUT WARRANTIES OR CONDITIONS OF ANY KIND, either express or implied.
// See the License for the specific language governing permissions and
// limitations under the License.
//===========================================================================
//
// Provenance:
//   Ported from the bitbank JPEGENC library (https://github.com/bitbank2/JPEGENC).
//   by Chema Gonzalez (chemag@meta.com).
//   Upstream version: 1.1.0 (git describe 1.1.0-7-gf51421b,
//                     commit f51421bdaba8e098dc82130a17adaae6d61c3377, 2025-06-11).
//   De-C++'d into pure C for the Zephyr Media Pipe (libMP) zjpeg plugin, mirroring
//   the existing JPEGDEC port (jpeg_dec.c). The C++ class wrapper (JPEGENC.cpp) and
//   the Arduino dependency were removed; the C entry points are exposed directly. The
//   addFrame() loop is exposed as JPEGEncodeFrame(); a JPEGOpenRAM() helper mirrors the
//   decoder's RAM-open path. This provenance note is tracking metadata, not a copyright
//   claim.
//===========================================================================
//

#include <stdint.h>
#include <stddef.h>
#include <string.h>

#include <zephyr/mp/zjpeg/jpeg_enc.h>
//
// Returns the magnitude and fixes negative values for JPEG encoding
// Upper 16 bits is the new delta value, lower 16 is the magnitude
static const uint32_t ulMagnitudeFix[2048] = {
    0x03ff000b, 0x0000000a, 0x0001000a, 0x0002000a, 0x0003000a, 0x0004000a, 0x0005000a, 0x0006000a,
    0x0007000a, 0x0008000a, 0x0009000a, 0x000a000a, 0x000b000a, 0x000c000a, 0x000d000a, 0x000e000a,
    0x000f000a, 0x0010000a, 0x0011000a, 0x0012000a, 0x0013000a, 0x0014000a, 0x0015000a, 0x0016000a,
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    0x03f8000a, 0x03f9000a, 0x03fa000a, 0x03fb000a, 0x03fc000a, 0x03fd000a, 0x03fe000a, 0x03ff000a};

// zigzag ordering of DCT coefficients
static const unsigned char cZigZag[64] = {0,1,5,6,14,15,27,28,
    2,4,7,13,16,26,29,42,
    3,8,12,17,25,30,41,43,
    9,11,18,24,31,40,44,53,
    10,19,23,32,39,45,52,54,
    20,22,33,38,46,51,55,60,
    21,34,37,47,50,56,59,61,
    35,36,48,49,57,58,62,63};
static const unsigned char cZigZag2[64] = {0,1,8,16,9,2,3,10,
    17,24,32,25,18,11,4,5,
    12,19,26,33,40,48,41,34,
    27,20,13,6,7,14,21,28,
    35,42,49,56,57,50,43,36,
    29,22,15,23,30,37,44,51,
    58,59,52,45,38,31,39,46,
    53,60,61,54,47,55,62,63};
//
// Typical DC difference huffman tables for luminance and chrominance
//
static const unsigned char huffl_dc[28] = {0,1,5,1,1,1,1,1,1,0,0,0,0,0,0,0,
    0,1,2,3,4,5,6,7,8,9,0xa,0xb};
static const unsigned char huffcr_dc[28] = {0,3,1,1,1,1,1,1,1,1,1,0,0,0,0,0,
    0,1,2,3,4,5,6,7,8,9,0xa,0xb};
//
// Typical AC difference huffman tables for luminance and chrominance
//
static const unsigned char huffl_ac[256] = {0,2,1,3,3,2,4,3,5,5,4,4,0,0,1,0x7d,
    1,2,3,0,4,0x11,5,0x12,0x21,0x31,0x41,6,0x13,0x51,0x61,7,
    0x22,0x71,0x14,0x32,0x81,0x91,0xa1,8,0x23,0x42,0xb1,0xc1,0x15,0x52,0xd1,0xf0,
    0x24,0x33,0x62,0x72,0x82,9,0xa,0x16,0x17,0x18,0x19,0x1a,0x25,0x26,0x27,0x28,
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    0xf9,0xfa};
static const unsigned char huffcr_ac[256] = {0,2,1,2,4,4,3,4,7,5,4,4,0,1,2,0x77,
    0,1,2,3,0x11,4,5,0x21,0x31,6,0x12,0x41,0x51,7,0x61,0x71,
    0x13,0x22,0x32,0x81,0x8,0x14,0x42,0x91,0xa1,0xb1,0xc1,9,0x23,0x33,0x52,0xf0,
    0x15,0x62,0x72,0xd1,0xa,0x16,0x24,0x34,0xe1,0x25,0xf1,0x17,0x18,0x19,0x1a,0x26,
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    0xf9,0xfa};
// Sample quantization table which can be divided by 2 or 4 or multiplied by 2
// to give different quality levels
static const unsigned char quant_lum[64] =
{16,11,12,14,12,10,16,14,13,14,18,17,16,19,24,
    40,26,24,22,22,24,49,35,37,29,40,58,51,61,60,
    57,51,56,55,64,72,92,78,64,68,87,69,55,56,80,
    109,81,87,95,98,103,104,103,62,77,113,121,112,
    100,120,92,101,103,99};
static const unsigned char quant_color[64] =
{17,18,18,24,21,24,47,26,26,47,99,66,56,66,99,99,
    99,99,99,99,99,99,99,99,99,99,99,99,99,99,99,99,
    99,99,99,99,99,99,99,99,99,99,99,99,99,99,99,99,
    99,99,99,99,99,99,99,99,99,99,99,99,99,99,99,99};


// For AA&N IDCT method, multipliers are equal to quantization
// coefficients scaled by scalefactor[row]*scalefactor[col], where
// scalefactor[0] = 1
// scalefactor[k] = cos(k*PI/16) * sqrt(2)    for k=1..7
// For integer operation, the multiplier table is to be scaled by
// IFAST_SCALE_BITS.
static const int iScaleBits[64] = {16384, 22725, 21407, 19266, 16384, 12873,  8867,  4520,
    22725, 31521, 29692, 26722, 22725, 17855, 12299,  6270,
    21407, 29692, 27969, 25172, 21407, 16819, 11585,  5906,
    19266, 26722, 25172, 22654, 19266, 15137, 10426,  5315,
    16384, 22725, 21407, 19266, 16384, 12873,  8867,  4520,
    12873, 17855, 16819, 15137, 12873, 10114,  6967,  3552,
    8867, 12299, 11585, 10426,  8867,  6967,  4799,  2446,
    4520,  6270,  5906,  5315,  4520,  3552,  2446,  1247};

// Pre-calculated Huffman encode tables (4K bytes)
static const uint8_t hufftable[] = {
    0x00,0x00,0x02,0x00,0x03,0x00,0x04,0x00,0x05,0x00,0x06,0x00,0x0e,0x00,0x1e,0x00,
    0x3e,0x00,0x7e,0x00,0xfe,0x00,0xfe,0x01,0x00,0x00,0x00,0x00,0x00,0x00,0x00,0x00,
    0x00,0x00,0x00,0x00,0x00,0x00,0x00,0x00,0x00,0x00,0x00,0x00,0x00,0x00,0x00,0x00,
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    0x10,0x00,0x10,0x00,0x10,0x00,0x00,0x00,0x00,0x00,0x00,0x00,0x00,0x00,0x00,0x00};
static void JPEGFixQuantE(JPEGE_IMAGE *pJPEG)
{
    int iTable, iTableOffset;
    signed short sTemp[DCTSIZE];
    int i, iCount;
    signed short *p;
    unsigned short *pus;
    
    if (pJPEG->ucNumComponents == 1)
        iCount = 1;
    else
        iCount = 2;
    
    for (iTable = 0; iTable < iCount; iTable++)
    {
        iTableOffset = iTable * DCTSIZE;
        p = (signed short *) &pJPEG->sQuantTable[iTableOffset];
        for (i = 0; i < DCTSIZE; i++)
        {
            sTemp[i] = p[cZigZag[i]];
        }
        memcpy(&pJPEG->sQuantTable[iTableOffset], sTemp, DCTSIZE*sizeof(short)); // copy back to original spot
        
        // Prescale for DCT multiplication
        p = (signed short *) &pJPEG->sQuantTable[iTableOffset];
        for (i = 0; i < DCTSIZE; i++)
        {
            p[i] = (short) ((p[i] * iScaleBits[i]) >> 11);
        }
        // Create "inverted" values for quicker multiplication instead of division
        pus = (unsigned short *) &pJPEG->sQuantTable[iTableOffset];
        for (i = 0; i < DCTSIZE; i++)
        {
            int j;
            if (pus[i] != 0)
                j = 65536 / pus[i];
            else
                j = 0;
            pus[i+(DCTSIZE*2)] = (unsigned short)j;
        }
    } // for iTable
} /* JPEGFixQuantE() */

static void JPEGMakeHuffE(JPEGE_IMAGE *pJPEG)
{
#ifdef USE_RAM_FOR_TABLES
    int code, iLen, iTable;
    unsigned short *pTable;
    int iBitNum; // current code bit length
    int n_bits; // number of bits to do
    int cc; // code
    unsigned char *p, *pBits;
    int iTableCount;

    if (pJPEG->ucNumComponents == 1)
        iTableCount = 1;
    else
        iTableCount = 2;

    // first do DC components (up to 12-bit codes)
    for (iTable = 0; iTable < iTableCount; iTable++)
    {
        pJPEG->huffdc[iTable] = (int *)&pJPEG->ucHuffACDCBuf[iTable*0x800]; // each table gets 2K
        pTable = (unsigned short *)pJPEG->huffdc[iTable];
        if (iTable == 0)
            pBits = (unsigned char *)huffl_dc;
        else
            pBits = (unsigned char *)huffcr_dc;
        p = (unsigned char *)pBits;
        p += 16; // point to bit data
        iBitNum = 1;
        cc = 0; // start with a code of 0
        for (n_bits = 0; n_bits < 16; n_bits++)
        {
            iLen = *pBits++; // get number of codes for this bit length
            while (iLen)
            {
                code = *p++;  // get actual huffman code
                pTable[code] = (unsigned short)cc;
                pTable[code+256] = (unsigned short)iBitNum; // store the length here
                cc++;
                iLen--;
            }
            iBitNum++;
            cc <<= 1;
        }
    }
    // now do AC components (up to 16-bit codes)
    for (iTable = 0; iTable < iTableCount; iTable++)
    {
        pTable = (unsigned short *)pJPEG->huffdc[iTable];
        if (iTable == 0)
            pBits = (unsigned char *)huffl_ac;
        else
            pBits = (unsigned char *)huffcr_ac;
        p = (unsigned char *)pBits;
        p += 16; // point to bit data
        iBitNum = 1;
        cc = 0; // start with a code of 0
        for (n_bits = 0; n_bits < 16; n_bits++)
        {
            iLen = *pBits++; // get number of codes for this bit length
            while (iLen)
            {
                code = *p++;  // get actual huffman code
                pTable[512+code] = (unsigned short)cc;
                pTable[768+code] = (unsigned short)iBitNum;
                cc++;
                iLen--;
            }
            iBitNum++;
            cc <<= 1;
        }
    }
    // write it to a file
//    {
//        FILE *ohandle = fopen("/Users/laurencebank/Downloads/hufftable.bin", "w+b");
//        if (ohandle) {
//            fwrite(pJPEG->ucHuffACDCBuf, 1, 4096, ohandle);
//            fclose(ohandle);
//        }
//    }
#else // read it from FLASH
    pJPEG->huffdc[0] = (int *)&hufftable[0];
    pJPEG->huffdc[1] = (int *)&hufftable[2048];
#endif // USE_RAM_FOR_TABLES
} /* JPEGMakeHuffE() */
//
// Finish the file
//
int JPEGEncodeEnd(JPEGE_IMAGE *pJPEG)
{
    if (pJPEG->iError == JPEGE_SUCCESS)
    {
        if (pJPEG->pOutput == NULL) { // file I/O
            int iLen;
            *pJPEG->pc.pOut++ = 0xff; // end of image (EOI)
            *pJPEG->pc.pOut++ = 0xd9;
            iLen = (int)(pJPEG->pc.pOut - pJPEG->ucFileBuf);
            pJPEG->pfnWrite(&pJPEG->JPEGFile, pJPEG->ucFileBuf, iLen);
            pJPEG->iDataSize += iLen;
        } else { // user-supplied buffer
            uint8_t *pBuf = pJPEG->pOutput; // DEBUG - check for non-buffer option
            int iOutSize = pJPEG->iDataSize;
            pBuf[iOutSize++] = 0xff;
            pBuf[iOutSize++] = 0xd9;  // end of image (EOI)
            pJPEG->iDataSize = iOutSize;
        }
        return pJPEG->iDataSize; // return the size of the compressed data
    }
    return 0; // something went wrong
} /* JPEGEncodeEnd() */
//
// Initialize the encoder
//
int JPEGEncodeBegin(JPEGE_IMAGE *pJPEG, JPEGENCODE *pEncode, int iWidth, int iHeight, uint8_t ucPixelType, uint8_t ucSubSample, uint8_t ucQFactor)
{
    uint8_t *pBuf;
    int i;
    int iOffset = 0;
    if (pEncode == NULL || pJPEG == NULL) {
        return JPEGE_INVALID_PARAMETER;
    }
    if (iWidth < 1 || iHeight < 1) {
        return JPEGE_INVALID_PARAMETER;
    }
    if (ucPixelType >= JPEGE_PIXEL_COUNT || (ucSubSample != JPEGE_SUBSAMPLE_444 && ucSubSample != JPEGE_SUBSAMPLE_420) || ucQFactor > JPEGE_Q_LOW) {
        return JPEGE_INVALID_PARAMETER;
    }
    pJPEG->iDCPred0 = pJPEG->iDCPred1 = pJPEG->iDCPred2 = 0; // DC predictor values reset to 0
    pJPEG->iWidth = iWidth;
    pJPEG->iHeight = iHeight;
    pJPEG->ucPixelType = ucPixelType;
    pJPEG->ucSubSample = ucSubSample;
    pEncode->x = pEncode->y = 0; // starting point
    if (ucSubSample == JPEGE_SUBSAMPLE_444) {
        pEncode->cx = pEncode->cy = 8;
    } else {
        pEncode->cx = pEncode->cy = 16; // MCU size
    }
    // Number of MCUs in each dimension
    pJPEG->iMCUWidth = (pJPEG->iWidth + pEncode->cx - 1) / pEncode->cx;
    pJPEG->iMCUHeight = (pJPEG->iHeight + pEncode->cy - 1) / pEncode->cy;
    
    // Set up the output buffer
    pJPEG->pc.iLen = pJPEG->pc.ulAcc = 0;
    if (pJPEG->pOutput) {
        pBuf = pJPEG->pOutput;
    } else {
        pBuf = pJPEG->ucFileBuf;
    }
    // Write the JPEG header
    if (pJPEG->ucPixelType == JPEGE_PIXEL_GRAYSCALE)
        pJPEG->ucNumComponents = 1;
    else
        pJPEG->ucNumComponents = 3;
    WRITEMOTO32(pBuf, iOffset, 0xffd8ffe0); // write app0 marker
    iOffset += 4;
    WRITEMOTO32(pBuf, iOffset, 0x00104a46); // JFIF
    iOffset += 4;
    WRITEMOTO32(pBuf, iOffset, 0x49460001);
    iOffset += 4;
    WRITEMOTO16(pBuf, iOffset, 0x0101); // resolution units = dots per inch
    iOffset += 2;
    WRITEMOTO16(pBuf, iOffset, 0); // DEBUG - store spacial resolution as 0 for now
    iOffset += 2;
    WRITEMOTO16(pBuf, iOffset, 0);
    iOffset += 2;
    WRITEMOTO16(pBuf, iOffset, 0); // add 2 zeros
    iOffset += 2;
    // define quantization tables
    WRITEMOTO16(pBuf, iOffset, 0xffdb); // quantization table marker
    iOffset += 2;
    WRITEMOTO16(pBuf, iOffset, 0x0043); // table size
    iOffset += 2;
    pBuf[iOffset++] = 0; // table type and number 0,8 bit
    for (i=0; i<64; i++)
    {
        switch (ucQFactor) // adjust table depending on quality factor
        {
            default:
            case JPEGE_Q_BEST: // best quality, divide by 4
                pBuf[iOffset++] = quant_lum[i] >> 2;
                break;
            case JPEGE_Q_HIGH: // high quality, divide by 2
                pBuf[iOffset++] = quant_lum[i] >> 1;
                break;
            case JPEGE_Q_MED: // medium quality factor, use values unchanged
                pBuf[iOffset++] = quant_lum[i];
                break;
            case JPEGE_Q_LOW: // low quality, use values * 2
                pBuf[iOffset++] = quant_lum[i] << 1;
                break;
//            case 4: // ridiculously high quality
//                pBuf[iOffset++] = quant95_lum[i];
//                break;
        }
    }
    if (pJPEG->ucPixelType != JPEGE_PIXEL_GRAYSCALE) // add color quant tables
    {
        WRITEMOTO16(pBuf, iOffset, 0xffdb); // quantization table
        iOffset += 2;
        WRITEMOTO16(pBuf, iOffset, 0x0043); // table size
        iOffset += 2;
        pBuf[iOffset++] = 1;  // table 1, 8 bit
        for (i=0; i<64; i++)
        {
            switch (ucQFactor) // adjust table depending on quality factor
            {
                case JPEGE_Q_BEST: // best quality, divide by 4
                    pBuf[iOffset++] = quant_color[i] >> 2;
                    break;
                case JPEGE_Q_HIGH: // high quality, divide by 2
                    pBuf[iOffset++] = quant_color[i] >> 1;
                    break;
                case JPEGE_Q_MED: // medium quality factor, use values unchanged
                    pBuf[iOffset++] = quant_color[i];
                    break;
                case JPEGE_Q_LOW: // low quality, use values * 2
                    pBuf[iOffset++] = quant_color[i] << 1;
                    break;
//                case 4: // ridiculously high quality
//                    pBuf[iOffset++] = quant95_color[i];
//                    break;
            }
        }
    }
    // store the restart interval
    // use an interval of one MCU row
    if (pJPEG->ucPixelType != JPEGE_PIXEL_GRAYSCALE && pJPEG->ucSubSample == JPEGE_SUBSAMPLE_420)
        i = (pJPEG->iWidth + 15) / 16; // number of MCUs in a row
    else
        i = (pJPEG->iWidth + 7) / 8;
    WRITEMOTO16(pBuf, iOffset, 0xffdd); // DRI marker
    iOffset += 2;
    WRITEMOTO16(pBuf, iOffset, 4); // fixed length of 4
    iOffset += 2;
    WRITEMOTO16(pBuf, iOffset, i); // restart interval count
    iOffset += 2;
    
    // store the frame header
    WRITEMOTO16(pBuf, iOffset, 0xffc0); // SOF0 marker
    iOffset += 2;
    if (pJPEG->ucPixelType == JPEGE_PIXEL_GRAYSCALE)
    {
        pBuf[iOffset++] = 0;
        pBuf[iOffset++] = 11; // length = 11
        pBuf[iOffset++] = 8;   // sample precision
        WRITEMOTO16(pBuf, iOffset, pJPEG->iHeight); // image height
        iOffset += 2;
        WRITEMOTO16(pBuf, iOffset, pJPEG->iWidth); // image width
        iOffset += 2;
        pBuf[iOffset++] = 1; // number of components = 1 (grayscale)
        pBuf[iOffset++] = 0; // component number
        WRITEMOTO16(pBuf, iOffset, 0x1100); // subsampling and quant table selector
        iOffset += 2;
    }
    else  // set up color stuff
    {
        pBuf[iOffset++] = 0;
        pBuf[iOffset++] = 17; // length = 17
        pBuf[iOffset++] = 8;   // sample precision
        WRITEMOTO16(pBuf, iOffset, pJPEG->iHeight); // image height
        iOffset += 2;
        WRITEMOTO16(pBuf, iOffset, pJPEG->iWidth); // image width
        iOffset += 2;
        pBuf[iOffset++] = 3; // number of components = 3 (Ycc)
        pBuf[iOffset++] = 0; // component number 0 (Y)
        if (pJPEG->ucSubSample == JPEGE_SUBSAMPLE_420)
        {
            WRITEMOTO16(pBuf, iOffset, 0x2200); // 2:1 subsampling and quant table selector
        }
        else
        {
            WRITEMOTO16(pBuf, iOffset, 0x1100); // no subsampling and quant table selector
        }
        iOffset += 2;
        pBuf[iOffset++] = 1; // component number 1 (Cb)
        WRITEMOTO16(pBuf, iOffset, 0x1101); // subsampling and quant table selector
        iOffset += 2;
        pBuf[iOffset++] = 2; // component number 2 (Cr)
        WRITEMOTO16(pBuf, iOffset, 0x1101); // subsampling and quant table selector
        iOffset += 2;
    }
    // define Huffman tables
    WRITEMOTO16(pBuf, iOffset, 0xffc4); // Huffman DC table
    iOffset += 2;
    WRITEMOTO16(pBuf, iOffset, 0x1f); // Table length = 31
    iOffset += 2;
    pBuf[iOffset++] = 0; // table class = 0 (DC), id = 0
    memcpy(&pBuf[iOffset], huffl_dc, 28); // copy DC table
    iOffset += 28;
    // now the AC table
    WRITEMOTO16(pBuf, iOffset, 0xffc4); // Huffman AC table
    iOffset += 2;
    WRITEMOTO16(pBuf, iOffset, 0xb5); // Table length = 181
    iOffset += 2;
    pBuf[iOffset++] = 0x10; // table class = 1 (AC), id = 0
    memcpy(&pBuf[iOffset], huffl_ac, 178); // copy AC table
    iOffset += 178;
    if (pJPEG->ucPixelType != JPEGE_PIXEL_GRAYSCALE) // define a second set of tables for color
    {
        WRITEMOTO16(pBuf, iOffset, 0xffc4); // Huffman DC table
        iOffset += 2;
        WRITEMOTO16(pBuf, iOffset, 0x1f); // Table length = 31
        iOffset += 2;
        pBuf[iOffset++] = 1; // table class = 0 (DC), id = 1
        memcpy(&pBuf[iOffset], huffcr_dc, 28); // copy DC table
        iOffset += 28;
        // now the AC table
        WRITEMOTO16(pBuf, iOffset, 0xffc4); // Huffman AC table
        iOffset += 2;
        WRITEMOTO16(pBuf, iOffset, 0xb5); // Table length = 181
        iOffset += 2;
        pBuf[iOffset++] = 0x11; // table class = 1 (AC), id = 1
        memcpy(&pBuf[iOffset], huffcr_ac, 178); // copy AC table
        iOffset += 178;
    }
    // Define the start of scan header (SOS)
    WRITEMOTO16(pBuf, iOffset, 0xffda); // SOS
    iOffset += 2;
    if (pJPEG->ucPixelType == JPEGE_PIXEL_GRAYSCALE)
    {
        WRITEMOTO16(pBuf, iOffset, 0x8); // Table length = 8
        iOffset += 2;
        pBuf[iOffset++] = 1;            // number of components in scan = 1 (grayscale)
        pBuf[iOffset++] = 0; // component id = 0
        pBuf[iOffset++] = 0; // dc/ac huffman table = 0/0
    }
    else // color
    {
        WRITEMOTO16(pBuf, iOffset, 0xc); // Table length = 12
        iOffset += 2;
        pBuf[iOffset++] = 3;            // number of components in scan = 3 (color)
        pBuf[iOffset++] = 0; // component id = 0
        pBuf[iOffset++] = 0; // dc/ac huffman table = 0/0
        pBuf[iOffset++] = 1; // component id = 1
        pBuf[iOffset++] = 0x11; // dc/ac huffman table = 1/1
        pBuf[iOffset++] = 2; // component id = 2
        pBuf[iOffset++] = 0x11; // dc/ac huffman table = 1/1
    }
    pBuf[iOffset++] = 0; // start of spectral selection
    pBuf[iOffset++] = 63; // end of spectral selection
    pBuf[iOffset++] = 0; // successive approximation bit
    // Set the output pointer for writing the variable length codes
    pJPEG->pc.pOut = &pBuf[iOffset];
    
    // prepare the luma & chroma quantization tables
    for (i = 0; i<64; i++)
    {
        switch (ucQFactor)
        {
            case JPEGE_Q_BEST:
                pJPEG->sQuantTable[i] = quant_lum[i] >> 2;
                pJPEG->sQuantTable[i + 64] = quant_color[i] >> 2;
                break;
            case JPEGE_Q_HIGH:
                pJPEG->sQuantTable[i] = (quant_lum[i] >> 1);
                pJPEG->sQuantTable[i + 64] = (quant_color[i] >> 1);
                break;
            case JPEGE_Q_MED:
                pJPEG->sQuantTable[i] = quant_lum[i];
                pJPEG->sQuantTable[i + 64] = quant_color[i];
                break;
            case JPEGE_Q_LOW:
                pJPEG->sQuantTable[i] = (quant_lum[i] << 1);
                pJPEG->sQuantTable[i + 64] = (quant_color[i] << 1);
                break;
//            case 4: // ridiculous quality
//                pJPEG->sQuantTable[i] = quant95_lum[i];
//                pJPEG->sQuantTable[i + 64] = quant95_color[i];
//                break;
        }
    }
    JPEGFixQuantE(pJPEG); // reorder and scale quant table(s)
    JPEGMakeHuffE(pJPEG); // create the Huffman tables to encode
    pJPEG->iError = JPEGE_SUCCESS;
    return JPEGE_SUCCESS;
} /* JPEGEncodeBegin() */

static int JPEGQuantize(JPEGE_IMAGE *pJPEG, signed short *pMCUSrc, int iTable)
{
    signed int d, sQ1, sQ2, sum;
    int i;
    signed short *pQuant;
    
    pQuant = (signed short *)&pJPEG->sQuantTable[iTable * DCTSIZE];
    for (i=0; i<33; i++) // do first half and then check for second half being all 0's
    {
        sQ1 = pQuant[i];
        sQ2 = sQ1 >> 1;
        d = *pMCUSrc;
        // Avoid doing divides; the second half of the quantization table has 65536/Q values
        // so that we can use multiplies in this step
        if (d < 0)
        {
            *pMCUSrc++ = 0 - (((sQ2 - d) * pQuant[i + 128]) >> 16);
        }
        else
        {
            *pMCUSrc++ = (((sQ2 + d) * pQuant[i + 128]) >> 16);
        }
    } // for
    sum = 0;
    for (i=33; i<64; i++) // second half; check for 'sparseness'
    {
        sQ1 = pQuant[i];
        sQ2 = sQ1 >> 1;
        d = *pMCUSrc;
        // Avoid doing divides; the second half of the quantization table has 65536/Q values
        // so that we can use multiplies in this step
        if (d < 0)
        {
            d = 0 - (((sQ2 - d) * pQuant[i + 128]) >> 16);
            sum -= d;
        }
        else
        {
            d = (((sQ2 + d) * pQuant[i + 128]) >> 16);
            sum += d;
        }
        *pMCUSrc++ = d;
    } // for
    return (sum == 0); // if the last half of the quantized results was 0, call it 'sparse'
} /* JPEGQuantize() */

static int JPEGEncodeMCU(int iDCTable, JPEGE_IMAGE *pJPEG, signed short *pMCUData, int iDCPred, int bSparse)
{
    //int iOff, iBitnum; // faster access
    unsigned char cMagnitude;
    unsigned char ucCode, *pZig, *pZigEnd, *pZigStart;
    int iZeroCount;
    BIGINT iDelta;
    BIGUINT iLen, iNewLen;
    unsigned short *pHuff;
    BIGUINT ulCode;
    unsigned char *pOut;
    BIGUINT ulAcc;
    uint32_t ulMagVal;
    uint32_t *pMagFix = (uint32_t *)&ulMagnitudeFix[1024]; // allows indexing positive and negative values - speeds up total encode time by 15%
    
    // Put in local vars to allow compiler to do a better job of optimization using registers
    ulAcc = pJPEG->pc.ulAcc;
    pOut = pJPEG->pc.pOut;
    iLen = pJPEG->pc.iLen;
    
    // compress the DC component
    iDelta = pMCUData[0] - iDCPred;
    iDCPred = pMCUData[0]; // this is the new DC value
    pHuff = (unsigned short *) pJPEG->huffdc[iDCTable];
    ulMagVal = pMagFix[iDelta]; // get magnitude and new delta in one table read
    iDelta = (ulMagVal >> 16);
    cMagnitude = ulMagVal & 0xf;
    // Old way of dealing with negative and positive magnitudes; faster to use a lookup table once
    //   if (iDelta < 0)
    //      {
    //      iDelta = 0 - iDelta;
    //      cMagnitude = cMagnitudes[iDelta];
    //      iDelta = iBitMasks[cMagnitude] - iDelta;
    //      }
    //   else
    //      {
    //      cMagnitude = cMagnitudes[iDelta];
    //      }
    ulCode = (BIGUINT) pHuff[cMagnitude];
    iNewLen = pHuff[cMagnitude + 256];
    ulCode = (ulCode << cMagnitude) | iDelta; // code in msb, followed by delta
    iNewLen += cMagnitude; // add lengths together
    STORECODE(pOut, iLen, ulCode, ulAcc, iNewLen)
    // Encode the AC components
    pZig = (unsigned char *)&cZigZag2[1];
    if (bSparse)
        pZigEnd = (unsigned char *)&cZigZag2[33]; // second half is all zeros
    else
        pZigEnd = (unsigned char *)&cZigZag2[64];
    pHuff += 512; // point to AC table
    while (pZig < pZigEnd)
    {
        // count the number of leading zeros
        pZigStart = pZig;
        while (pZig < pZigEnd && (iDelta = pMCUData[pZig[0]]) == 0) {
            pZig++;
        }
        if (pZig == pZigEnd) // special case, no more coefficients
        { // encode EOB (end of block)
            ulCode = (BIGUINT) pHuff[0];
            iNewLen = pHuff[256];
            STORECODE(pOut, iLen, ulCode, ulAcc, iNewLen)
            goto encodemcuz;
        }
        else // Encode a zero count and AC coefficient
        {
            iZeroCount = (int)(pZig - pZigStart);
            while (iZeroCount >= 16)  // maximum that can be encoded at once
            { // 16 zeros is called ZRL (f0)
                ulCode = (uint32_t)pHuff[0xf0];
                iNewLen = pHuff[256 + 0xf0];
                STORECODE(pOut, iLen, ulCode, ulAcc, iNewLen)
                iZeroCount -= 16;
            }
            // Encode a normal RRRR/SSSS pair
            ulMagVal = pMagFix[iDelta]; // get magnitude and new delta in one table read
            iDelta = (ulMagVal >> 16);
            cMagnitude = ulMagVal & 0xf;
            ucCode = (unsigned char)((iZeroCount << 4) | cMagnitude); // combine zero count and 'extra' size
            // store the huffman code
            ulCode = (uint32_t)pHuff[ucCode];
            iNewLen = pHuff[256 + ucCode];
            ulCode = (ulCode << cMagnitude) | iDelta; // code followed by magnitude
            pZig++;  // skip to next coefficient
            iNewLen += cMagnitude;
            STORECODE(pOut, iLen, ulCode, ulAcc, iNewLen)
        }
    }
    
encodemcuz:
    pJPEG->pc.ulAcc = ulAcc; // place local copies back in the object pointer version
    pJPEG->pc.pOut = pOut;
    pJPEG->pc.iLen = iLen;
    return iDCPred;
    
} /* JPEGEncodeMCU() */

static void JPEGGetMCU(unsigned char *pSrc, int iPitch, signed char *pMCU)
{
    int cy;
    
    for (cy = 0; cy < 8; cy++) {
        *(uint32_t *)pMCU = *(uint32_t *)pSrc ^ 0x80808080;
        *(uint32_t *)&pMCU[4] = *(uint32_t *)&pSrc[4] ^ 0x80808080;
        pMCU += 8;
        pSrc += iPitch; // - 8; // skip to next line
    }
} /* JPEGGetMCU() */

static void JPEGSubSample24(unsigned char *pSrc, signed char *pLUM, signed char *pCb, signed char *pCr, int lsize, int cx, int cy)
{
    int x;
    unsigned char cRed, cGreen, cBlue;
    int iY1, iY2, iY3, iY4, iCr1, iCr2, iCr3, iCr4, iCb1, iCb2, iCb3, iCb4;
    int y;
    
    cx = (cx + 1)>>1; // do pixels in 2x2 blocks
    cy = (cy + 1)>>1;
    
    for (y=0; y<cy; y++)
    {
        for (x = 0; x<cx; x++) // do 8x8 pixels in 2x2 blocks
        {
            cBlue = pSrc[0];
            cGreen = pSrc[1];
            cRed = pSrc[2];
            iY1 = (((cRed * 1225) + (cGreen * 2404) + (cBlue * 467)) >> 12) - 0x80;
            iCb1 = (cBlue << 11) + (cRed * -691) + (cGreen * -1357);
            iCr1 = (cRed << 11) + (cGreen * -1715) + (cBlue * -333);
            
            cBlue = pSrc[3];
            cGreen = pSrc[4];
            cRed = pSrc[5];
            iY2 = (((cRed * 1225) + (cGreen * 2404) + (cBlue * 467)) >> 12) - 0x80;
            iCb2 = (cBlue << 11) + (cRed * -691) + (cGreen * -1357);
            iCr2 = (cRed << 11) + (cGreen * -1715) + (cBlue * -333);
            
            cBlue = pSrc[lsize];
            cGreen = pSrc[lsize+1];
            cRed = pSrc[lsize+2];
            iY3 = (((cRed * 1225) + (cGreen * 2404) + (cBlue * 467)) >> 12) - 0x80;
            iCb3 = (cBlue << 11) + (cRed * -691) + (cGreen * -1357);
            iCr3 = (cRed << 11) + (cGreen * -1715) + (cBlue * -333);
            
            cBlue = pSrc[lsize+3];
            cGreen = pSrc[lsize+4];
            cRed = pSrc[lsize+5];
            iY4 = (((cRed * 1225) + (cGreen * 2404) + (cBlue * 467)) >> 12) - 0x80;
            iCb4 = (cBlue << 11) + (cRed * -691) + (cGreen * -1357);
            iCr4 = (cRed << 11) + (cGreen * -1715) + (cBlue * -333);
            
            // Average the chroma values together
            iCr1 = (iCr1 + iCr2 + iCr3 + iCr4) >> 14;
            iCb1 = (iCb1 + iCb2 + iCb3 + iCb4) >> 14;
            
            // store in the MCUs
            pLUM[0] = (signed char)iY1;
            pLUM[1] = (signed char)iY2;
            pLUM[8] = (signed char)iY3;
            pLUM[9] = (signed char)iY4;
            pLUM += 2;
            pCr[0] = (signed char)iCr1;
            pCb[0] = (signed char)iCb1;
            pCr++;
            pCb++;
            pSrc += 6; // skip 2 pixels to right
        } // for x
        pCr += 8 - cx; // skip to next row;
        pCb += 8 - cx;
        pLUM += 8 + (4-cx)*2; // skip down a row since 2 at a time
        pSrc += lsize*2 - cx*6; // skip 2 lines
    } // for y
    
} /* JPEGSubSample24() */
static void JPEGSubSample16(unsigned char *pSrc, signed char *pLUM, signed char *pCb, signed char *pCr, int lsize, int cx, int cy)
{
    int x, y;
    unsigned short us;
    unsigned short *pUS = (unsigned short *)pSrc;
    unsigned char cRed, cGreen, cBlue;
    int iY1, iY2, iY3, iY4, iCr1, iCr2, iCr3, iCr4, iCb1, iCb2, iCb3, iCb4;
    
    cx = (cx + 1)>>1; // do pixels in 2x2 blocks
    cy = (cy + 1)>>1;
    
    for (y=0; y<cy; y++)
    {
        for (x=0; x<cx; x++) // do 8x8 pixels in 2x2 blocks
        {
            us = pUS[0];
            cBlue = (unsigned char)(((us & 0x1f)<<3) | (us & 7));
            cGreen = (unsigned char)(((us & 0x7e0)>>3) | ((us & 0x60)>>5));
            cRed = (unsigned char)(((us & 0xf800)>>8) | ((us & 0x3800)>>11));
            iY1 = (((cRed * 1225) + (cGreen * 2404) + (cBlue * 467)) >> 12) - 0x80;
            iCb1 = (cBlue << 11) + (cRed * -691) + (cGreen * -1357);
            iCr1 = (cRed << 11) + (cGreen * -1715) + (cBlue * -333);
            
            us = pUS[1];
            cBlue = (unsigned char)(((us & 0x1f)<<3) | (us & 7));
            cGreen = (unsigned char)(((us & 0x7e0)>>3) | ((us & 0x60)>>5));
            cRed = (unsigned char)(((us & 0xf800)>>8) | ((us & 0x3800)>>11));
            iY2 = (((cRed * 1225) + (cGreen * 2404) + (cBlue * 467)) >> 12) - 0x80;
            iCb2 = (cBlue << 11) + (cRed * -691) + (cGreen * -1357);
            iCr2 = (cRed << 11) + (cGreen * -1715) + (cBlue * -333);
            
            us = pUS[lsize>>1];
            cBlue = (unsigned char)(((us & 0x1f)<<3) | (us & 7));
            cGreen = (unsigned char)(((us & 0x7e0)>>3) | ((us & 0x60)>>5));
            cRed = (unsigned char)(((us & 0xf800)>>8) | ((us & 0x3800)>>11));
            iY3 = (((cRed * 1225) + (cGreen * 2404) + (cBlue * 467)) >> 12) - 0x80;
            iCb3 = (cBlue << 11) + (cRed * -691) + (cGreen * -1357);
            iCr3 = (cRed << 11) + (cGreen * -1715) + (cBlue * -333);
            
            us = pUS[(lsize>>1)+1];
            cBlue = (unsigned char)(((us & 0x1f)<<3) | (us & 7));
            cGreen = (unsigned char)(((us & 0x7e0)>>3) | ((us & 0x60)>>5));
            cRed = (unsigned char)(((us & 0xf800)>>8) | ((us & 0x3800)>>11));
            iY4 = (((cRed * 1225) + (cGreen * 2404) + (cBlue * 467)) >> 12) - 0x80;
            iCb4 = (cBlue << 11) + (cRed * -691) + (cGreen * -1357);
            iCr4 = (cRed << 11) + (cGreen * -1715) + (cBlue * -333);
            
            // Average the chroma values together
            iCr1 = (iCr1 + iCr2 + iCr3 + iCr4) >> 14;
            iCb1 = (iCb1 + iCb2 + iCb3 + iCb4) >> 14;
            
            // store in the MCUs
            pLUM[0] = (signed char)iY1;
            pLUM[1] = (signed char)iY2;
            pLUM[8] = (signed char)iY3;
            pLUM[9] = (signed char)iY4;
            pLUM += 2;
            pCr[0] = (signed char)iCr1;
            pCb[0] = (signed char)iCb1;
            pCr++;
            pCb++;
            pUS += 2; // skip 2 pixels to right
        } // for x
        pCr += 8 - cx; // skip to next row;
        pCb += 8 - cx;
        pLUM += 8 + (4-cx)*2; // skip down a row since 2 at a time
        pUS += lsize - cx*2; // skip 2 lines
    } // for y
    
} /* JPEGSubSample16() */

static void JPEGSubSample32(unsigned char *pSrc, signed char *pLUM, signed char *pCb, signed char *pCr, int lsize, int cx, int cy)
{
    int x;
    unsigned char cRed, cGreen, cBlue;
    int iY1, iY2, iY3, iY4, iCr1, iCr2, iCr3, iCr4, iCb1, iCb2, iCb3, iCb4;
    int y;

    cx = (cx + 1)>>1; // do pixels in 2x2 blocks
    cy = (cy + 1)>>1;

    for (y = 0; y<cy; y++)
    {
        for (x=0; x<cx; x++) // do 8x8 pixels in 2x2 blocks
        {
            cRed = pSrc[0];
            cGreen = pSrc[1];
            cBlue = pSrc[2];
            iY1 = (((cRed * 1225) + (cGreen * 2404) + (cBlue * 467)) >> 12) - 0x80;
            iCb1 = (cBlue << 11) + (cRed * -691) + (cGreen * -1357);
            iCr1 = (cRed << 11) + (cGreen * -1715) + (cBlue * -333);

            cRed = pSrc[4];
            cGreen = pSrc[5];
            cBlue = pSrc[6];
            iY2 = (((cRed * 1225) + (cGreen * 2404) + (cBlue * 467)) >> 12) - 0x80;
            iCb2 = (cBlue << 11) + (cRed * -691) + (cGreen * -1357);
            iCr2 = (cRed << 11) + (cGreen * -1715) + (cBlue * -333);

            cRed = pSrc[lsize+0];
            cGreen = pSrc[lsize+1];
            cBlue = pSrc[lsize+2];
            iY3 = (((cRed * 1225) + (cGreen * 2404) + (cBlue * 467)) >> 12) - 0x80;
            iCb3 = (cBlue << 11) + (cRed * -691) + (cGreen * -1357);
            iCr3 = (cRed << 11) + (cGreen * -1715) + (cBlue * -333);

            cRed = pSrc[lsize+4];
            cGreen = pSrc[lsize+5];
            cBlue = pSrc[lsize+6];
            iY4 = (((cRed * 1225) + (cGreen * 2404) + (cBlue * 467)) >> 12) - 0x80;
            iCb4 = (cBlue << 11) + (cRed * -691) + (cGreen * -1357);
            iCr4 = (cRed << 11) + (cGreen * -1715) + (cBlue * -333);

            // Average the chroma values together
            iCr1 = (iCr1 + iCr2 + iCr3 + iCr4) >> 14;
            iCb1 = (iCb1 + iCb2 + iCb3 + iCb4) >> 14;

            // store in the MCUs
            pLUM[0] = (signed char)iY1;
            pLUM[1] = (signed char)iY2;
            pLUM[8] = (signed char)iY3;
            pLUM[9] = (signed char)iY4;
            pLUM += 2;
            pCr[0] = (signed char)iCr1;
            pCb[0] = (signed char)iCb1;
            pCr++;
            pCb++;
            pSrc += 8; // skip 2 pixels to right
        } // for x
        pCr += 8 - cx; // skip to next row;
        pCb += 8 - cx;
        pLUM += 8 + (4-cx)*2; // skip down a row since 2 at a time
        pSrc += lsize*2 - cx*8; // skip 2 lines
    } // for y

} /* JPEGSubSample32() */

static void JPEGSample32(unsigned char *pSrc, signed char *pMCU, int lsize, int cx, int cy)
{
    int x, y;
    unsigned char cRed, cGreen, cBlue;
    int iY, iCr, iCb;
   
    for (y=0; y<cy; y++)
    {
        for (x=0; x<cx; x++) // do 8x8 pixels
        {
            cRed = pSrc[0];
            cGreen = pSrc[1];
            cBlue = pSrc[2];
            pSrc += 4;
            iY = (((cRed * 1225) + (cGreen * 2404) + (cBlue * 467)) >> 12) - 0x80;
            iCb = (cBlue << 11) + (cRed * -691) + (cGreen * -1357);
            iCr = (cRed << 11) + (cGreen * -1715) + (cBlue * -333);

            // store in the MCUs
            pMCU[64]  = (signed char)(iCb >> 12);
            pMCU[128]  = (signed char)(iCr >> 12);
            *pMCU++ = (signed char)iY;
        } // for x
        pMCU += 8 - cx;
        pSrc += lsize - cx*4;
    } // for y

} /* JPEGSample32() */

//
// U0 Y0 V0 Y1 U2 Y2 V2 Y3...
// The bytes coming from the GC0308 are reversed, 0=Y0, 1=U0, 2=Y1, etc
// assumes that the YUV422 will be converted to 4:2:0 subsampling
// YUV422 is horizontally subsampled; this code takes the average of each
// vertical pair of Cb/Cr and creates 4:2:0 from it
//
static void JPEGSubSampleYUV422(uint8_t *pImage, int8_t *pMCUData, int iPitch)
{
int x, y;
uint8_t *pY0, *pY1, *pY2, *pY3;
uint8_t *pCr, *pCb;
uint8_t *s = pImage;
int iCr, iCb;
uint32_t *pU32;

  // output bins for YCbCr 
    pY0 = (uint8_t *)pMCUData; pY1 = (uint8_t *)&pMCUData[64*1];
    pY2 = (uint8_t *)&pMCUData[64*2]; pY3 = (uint8_t *)&pMCUData[64*3];
    pCr = (uint8_t *)&pMCUData[64*4]; pCb = (uint8_t *)&pMCUData[64*5];

  // subsample the UV vertically to get 4:2:0 from 4:2:2
    for (y=0; y<4; y ++) { // do 4 quadrants of 2x2 blocks of pixels at a time
        for (x=0; x<4; x++) {
            pY0[0] = s[0]; pY0[1] = s[2]; // top left
            pY0[8] = s[iPitch]; pY0[9] = s[iPitch+2];

            pY1[0] = s[16]; pY1[1] = s[18]; // top right
            pY1[8] = s[iPitch+16]; pY1[9] = s[iPitch+18];

            pY2[0] = s[(iPitch*8)+0]; pY2[1] = s[(iPitch*8)+2]; // bottom left
            pY2[8] = s[(iPitch*9)+0]; pY2[9] = s[(iPitch*9)+2];

            pY3[0] = s[(iPitch*8)+16]; pY3[1] = s[(iPitch*8)+18]; // bottom right
            pY3[8] = s[(iPitch*9)+16]; pY3[9] = s[(iPitch*9)+18];

            iCr = (s[1] + s[iPitch+1] + 1)/2; // subsample vertically
            iCb = (s[3] + s[iPitch+3] + 1)/2;
            pCr[0] = (int8_t)(iCr);
            pCb[0] = (int8_t)(iCb);
            iCr = (s[17] + s[iPitch+17] + 1)/2; // subsample vertically
            iCb = (s[19] + s[iPitch+19] + 1)/2;
            pCr[4] = (int8_t)(iCr);
            pCb[4] = (int8_t)(iCb);

            iCr = (s[(iPitch*8)+1] + s[(iPitch*9)+1] + 1)/2; // subsample vertically
            iCb = (s[(iPitch*8)+3] + s[(iPitch*9)+3] + 1)/2;
            pCr[32] = (int8_t)(iCr);
            pCb[32] = (int8_t)(iCb);
            iCr = (s[(iPitch*8)+17] + s[(iPitch*9)+17] + 1)/2; // subsample vertically
            iCb = (s[(iPitch*8)+19] + s[(iPitch*9)+19] + 1)/2;
            pCr[36] = (int8_t)(iCr);
            pCb[36] = (int8_t)(iCb);

            pCr++; pCb++;
            pY0 += 2; pY1 += 2; pY2 += 2; pY3 += 2;
            s += 4;
        } // for x
        pCr += 4; pCb += 4;
        pY0 += 8; pY1 += 8; pY2 += 8; pY3 += 8;
        s += (iPitch*2) - 16;
    } // for y
    pU32 = (uint32_t *)pMCUData;
    // all of the YUV values need to be adjusted +/-128, so XOR with 0x80
    for (x = 0; x<(6*16);x++) {
        pU32[0] ^= 0x80808080;
        pU32++;
    }
} /* JPEGSubSampleYUV422() */

static void JPEGGetMCU22(unsigned char *pImage, JPEGE_IMAGE *pPage, int iPitch)
{
    int cx, cy, width, height;
    signed char *pMCUData = pPage->MCUc;
//    if (pPage->ucPixelType == JPEGE_PIXEL_RGB565)
//        pSrc = pImage + x*16*2 + (y * 16 * lsize);
//    else if (pPage->ucPixelType == JPEGE_PIXEL_RGB888)
//        pSrc = pImage + x*16*3 + (y * 16 * lsize);
//    else if (pPage->ucPixelType == JPEGE_PIXEL_ARGB8888)
//        pSrc = pImage + x*16*4 + (y * 16 * lsize);
//    else
//        return; // invalid bit depth
    //    pDest = pMCUData;
    cx = cy = 8;
    width = height = 16;
//    if (x*16 + width > pPage->iWidth)
//        width = pPage->iWidth & 15;
//    if (y*16 + height > pPage->iHeight)
//        height = pPage->iHeight & 15;
//    if (width < 8)
//        cx = width;
//    else
//        cx = 8;
//    if (height < 8)
//        cy = height;
//    else
//        cy = 8;
//    if (cy != 8 || cx != 8) // for edge MCUs, make sure all unused slots are 0
//        memset(pMCUData, 0, 6*64*sizeof(short));
    if (pPage->ucPixelType == JPEGE_PIXEL_YUV422) // U0 Y0 V0 Y1 U2 Y2 V2 Y3
    {
        JPEGSubSampleYUV422(pImage, pMCUData, iPitch);
    }
    else if (pPage->ucPixelType == JPEGE_PIXEL_RGB565)
    {
        // upper left
        JPEGSubSample16(pImage, pMCUData, &pMCUData[DCTSIZE*4], &pMCUData[DCTSIZE*5], iPitch, cx, cy);
        // upper right
        if (width > 8)
            JPEGSubSample16(pImage+8*2, &pMCUData[DCTSIZE*1], &pMCUData[4+DCTSIZE*4], &pMCUData[4+DCTSIZE*5], iPitch, width-8, cy);
        if (height > 8)
        {
            // lower left
            JPEGSubSample16(pImage+8*iPitch, &pMCUData[DCTSIZE*2], &pMCUData[32+DCTSIZE*4], &pMCUData[32+DCTSIZE*5], iPitch, cx, height - 8);
            // lower right
            if (width > 8)
                JPEGSubSample16(pImage+8*iPitch + 8*2, &pMCUData[DCTSIZE*3], &pMCUData[36+DCTSIZE*4], &pMCUData[36+DCTSIZE*5], iPitch, width - 8, height - 8);
        }
    }
    else if (pPage->ucPixelType == JPEGE_PIXEL_RGB888)
    {
        // upper left
        JPEGSubSample24(pImage, pMCUData, &pMCUData[DCTSIZE*4], &pMCUData[DCTSIZE*5], iPitch, cx, cy);
        // upper right
        if (width > 8)
            JPEGSubSample24(pImage+8*3, &pMCUData[DCTSIZE*1], &pMCUData[4+DCTSIZE*4], &pMCUData[4+DCTSIZE*5], iPitch, width-8, cy);
        if (height > 8)
        {
            // lower left
            JPEGSubSample24(pImage+8*iPitch, &pMCUData[DCTSIZE*2], &pMCUData[32+DCTSIZE*4], &pMCUData[32+DCTSIZE*5], iPitch, cx, height - 8);
            // lower right
            if (width > 8)
                JPEGSubSample24(pImage+8*iPitch + 8*3, &pMCUData[DCTSIZE*3], &pMCUData[36+DCTSIZE*4], &pMCUData[36+DCTSIZE*5], iPitch, width - 8, height - 8);
        }
    }
    else if (pPage->ucPixelType == JPEGE_PIXEL_ARGB8888)
    {
        // upper left
        JPEGSubSample32(pImage, pMCUData, &pMCUData[DCTSIZE*4], &pMCUData[DCTSIZE*5], iPitch, cx, cy);
        // upper right
        if (width > 8)
            JPEGSubSample32(pImage+8*4, &pMCUData[DCTSIZE*1], &pMCUData[4+DCTSIZE*4], &pMCUData[4+DCTSIZE*5], iPitch, width-8, cy);
        if (height > 8)
        {
            // lower left
            JPEGSubSample32(pImage+8*iPitch, &pMCUData[DCTSIZE*2], &pMCUData[32+DCTSIZE*4], &pMCUData[32+DCTSIZE*5], iPitch, cx, height - 8);
            // lower right
            if (width > 8)
                JPEGSubSample32(pImage+8*iPitch + 8*4, &pMCUData[DCTSIZE*3], &pMCUData[36+DCTSIZE*4], &pMCUData[36+DCTSIZE*5], iPitch, width - 8, height - 8);
        }
    }
} /* JPEGGetMCU22() */

/****************************************************************************
 *                                                                          *
 *  FUNCTION   : JPEGSample16()                                             *
 *                                                                          *
 *  PURPOSE    : Sample a 8x8 color block                                   *
 *                                                                          *
 ****************************************************************************/
static void JPEGSample16(unsigned char *pSrc, signed char *pMCU, int lsize, int cx, int cy)
{
    int x, y;
    unsigned short us;
    unsigned short *pUS = (unsigned short *)pSrc;
    unsigned char cRed, cGreen, cBlue;
    int iY, iCr, iCb;
    
    for (y=0; y<cy; y++)
    {
        for (x=0; x<cx; x++) // do 8x8 pixels
        {
            us = *pUS++;
            cBlue = (unsigned char)(((us & 0x1f)<<3) | (us & 7));
            cGreen = (unsigned char)(((us & 0x7e0)>>3) | ((us & 0x60)>>5));
            cRed = (unsigned char)(((us & 0xf800)>>8) | ((us & 0x3800)>>11));
            iY = (((cRed * 1225) + (cGreen * 2404) + (cBlue * 467)) >> 12) - 0x80;
            iCb = (cBlue << 11) + (cRed * -691) + (cGreen * -1357);
            iCr = (cRed << 11) + (cGreen * -1715) + (cBlue * -333);
            
            // store in the MCUs
            pMCU[64]  = (signed char)(iCb >> 12);
            pMCU[128]  = (signed char)(iCr >> 12);
            *pMCU++ = (signed char)iY;
        } // for x
        pMCU += 8 - cx;
        pUS += (lsize>>1) - cx;
    } // for y
    
} /* JPEGSample16() */

/****************************************************************************
 *                                                                          *
 *  FUNCTION   : JPEGSample24()                                             *
 *                                                                          *
 *  PURPOSE    : Sample a 8x8 color block                                   *
 *                                                                          *
 ****************************************************************************/
static void JPEGSample24(unsigned char *pSrc, signed char *pMCU, int lsize, int cx, int cy)
{
    int x;
    unsigned char cRed, cGreen, cBlue;
    int iY, iCr, iCb;
    int y;
    
    for (y=0; y<cy; y++)
    {
        for (x=0; x<cx; x++) // do 8x8 pixels
        {
            cBlue = *pSrc++;
            cGreen = *pSrc++;
            cRed = *pSrc++;
            iY = (((cRed * 1225) + (cGreen * 2404) + (cBlue * 467)) >> 12) - 0x80;
            iCb = (cBlue << 11) + (cRed * -691) + (cGreen * -1357);
            iCr = (cRed << 11) + (cGreen * -1715) + (cBlue * -333);
            
            // store in the MCUs
            pMCU[64]  = (signed char)(iCb >> 12);
            pMCU[128]  = (signed char)(iCr >> 12);
            *pMCU++ = (signed char)iY;
        } // for x
        pMCU += 8 - cx;
        pSrc += lsize - cx*3;
    } // for y
    
} /* JPEGSample24() */

static void JPEGGetMCU11(unsigned char *pImage, JPEGE_IMAGE *pPage, int iPitch)
{
    int cx, cy;
    signed char *pMCUData = pPage->MCUc;
//    if (x*8 + 8 > pPage->iWidth)
//        cx = pPage->iWidth & 7;
//    else
        cx = 8;
//    if (y*8 + 8 > pPage->iHeight)
//        cy = pPage->iHeight & 7;
//    else
        cy = 8;
//    if (cy != 8 || cx != 8)
//        memset(pMCUData, 0, 3*64*sizeof(short)); // make sure unused pixels are 0
    if (pPage->ucPixelType == JPEGE_PIXEL_RGB888)
        JPEGSample24(pImage, pMCUData, iPitch, cx, cy);
    else if (pPage->ucPixelType == JPEGE_PIXEL_RGB565)
        JPEGSample16(pImage, pMCUData, iPitch, cx, cy);
    else // must be 32-bpp
        JPEGSample32(pImage, pMCUData, iPitch, cx, cy);
    
} /* JPEGGetMCU11() */

static void JPEGFDCT(signed char *pMCUSrc, signed short *pMCUDest)
{
    int iCol;
    int iRow;
    signed int tmp0,tmp1,tmp2,tmp3,tmp4,tmp5,tmp6,tmp7,tmp10,tmp11,tmp12,tmp13;
    signed int z1,z2,z3,z4,z5,z11,z13;
    signed char *s = pMCUSrc;
    signed short *d = pMCUDest;
    // do rows first
    for (iRow=0; iRow<64; iRow+=8, s += 8, d += 8)
    {
        tmp0 = s[0] + s[7];
        tmp7 = s[0] - s[7];
        tmp1 = s[1] + s[6];
        tmp6 = s[1] - s[6];
        tmp2 = s[2] + s[5];
        tmp5 = s[2] - s[5];
        tmp3 = s[3] + s[4];
        tmp4 = s[3] - s[4];
        // even part
        tmp10 = tmp0 + tmp3;
        tmp13 = tmp0 - tmp3;
        tmp11 = tmp1 + tmp2;
        tmp12 = tmp1 - tmp2;
        d[0] = (short)(tmp10 + tmp11);
        d[4] = (short)(tmp10 - tmp11);
        z1 = (((tmp12 + tmp13) * 181) >> 8);  // 181>>8 = 0.7071
        d[2] = (short)(tmp13 + z1);
        d[6] = (short)(tmp13 - z1);
        // odd part
        tmp10 = tmp4 + tmp5;
        tmp11 = tmp5 + tmp6;
        tmp12 = tmp6 + tmp7;
        z5 = ((tmp10 - tmp12) * 98); // 98 >>8 = 0.3826
        z2 = ((z5 + tmp10 * 139) >> 8); // 139 >>8 = 0.541196
        z4 = ((z5 + tmp12 * 334) >> 8); // 334 >>8 = 1.3065
        z3 = ((tmp11 * 181) >> 8);
        z11 = tmp7 + z3;
        z13 = tmp7 - z3;
        d[5] = (short)(z13 + z2);
        d[3] = (short)(z13 - z2);
        d[1] = (short)(z11 + z4);
        d[7] = (short)(z11 - z4);
    } // for each row
    // now do the columns
    d = pMCUDest;
    for (iCol=0; iCol < 8; iCol++, d++)
    {
        tmp0 = d[0*8] + d[7*8];
        tmp7 = d[0*8] - d[7*8];
        tmp1 = d[1*8] + d[6*8];
        tmp6 = d[1*8] - d[6*8];
        tmp2 = d[2*8] + d[5*8];
        tmp5 = d[2*8] - d[5*8];
        tmp3 = d[3*8] + d[4*8];
        tmp4 = d[3*8] - d[4*8];
        // even part
        tmp10 = tmp0 + tmp3;
        tmp13 = tmp0 - tmp3;
        tmp11 = tmp1 + tmp2;
        tmp12 = tmp1 - tmp2;
        d[0] = (short)(tmp10 + tmp11);
        d[4*8] = (short)(tmp10 - tmp11);
        z1 = (((tmp12 + tmp13) * 181) >> 8);
        d[2*8] = (short)(tmp13 + z1);
        d[6*8] = (short)(tmp13 - z1);
        // odd part
        tmp10 = tmp4 + tmp5;
        tmp11 = tmp5 + tmp6;
        tmp12 = tmp6 + tmp7;
        z5 = ((tmp10 - tmp12) * 98);
        z2 = ((z5 + tmp10 * 139) >> 8);
        z4 = ((z5 + tmp12 * 334) >> 8);
        z3 = (tmp11 * 181) >> 8;
        z11 = tmp7 + z3;
        z13 = tmp7 - z3;
        d[5*8] = (short)(z13 + z2);
        d[3*8] = (short)(z13 - z2);
        d[1*8] = (short)(z11 + z4);
        d[7*8] = (short)(z11 - z4);
    } // for each column
} /* JPEGFDCT() */

static void FlushCode(PIL_CODE *pPC)
{
    unsigned char c;
   
    while (pPC->iLen > 0)
    {
        c = (unsigned char) (pPC->ulAcc >> (REGISTER_WIDTH-8));
        *pPC->pOut++ = c;
        if (c == 0xff) // stuffed 0
            *pPC->pOut++ = 0;
        pPC->ulAcc <<= 8;
        pPC->iLen -= 8;
    }
    pPC->iLen = 0;
} /* FlushCode() */

int JPEGAddMCU(JPEGE_IMAGE *pJPEG, JPEGENCODE *pEncode, uint8_t *pPixels, int iPitch)
{
    int bSparse;
    
    if (pEncode->y >= pJPEG->iHeight) {
        // the image is already complete or was not initialized properly
        pJPEG->iError = JPEGE_INVALID_PARAMETER;
        return JPEGE_INVALID_PARAMETER;
    }
    if (pJPEG->ucPixelType == JPEGE_PIXEL_GRAYSCALE) {
        JPEGGetMCU(pPixels, iPitch, pJPEG->MCUc);
        JPEGFDCT(pJPEG->MCUc, pJPEG->MCUs);
        bSparse = JPEGQuantize(pJPEG, pJPEG->MCUs, 0);
        pJPEG->iDCPred0 = JPEGEncodeMCU(0, pJPEG, pJPEG->MCUs, pJPEG->iDCPred0, bSparse);
        if (pEncode->x >= (pJPEG->iWidth - pEncode->cx)) { // end of the row?
            // Store the restart marker
            FlushCode(&pJPEG->pc);
            *(pJPEG->pc.pOut)++ = 0xff; // store restart marker
            *(pJPEG->pc.pOut)++ = (unsigned char) (0xd0 + (pJPEG->iRestart & 7));
            pJPEG->iRestart++;
            pJPEG->iDCPred0 = 0; // reset the DC predictor
            pEncode->x = 0;
            pEncode->y += pEncode->cy;
            if (pEncode->y >= pJPEG->iHeight && pJPEG->pOutput != NULL) {
                pJPEG->iDataSize = (int)(pJPEG->pc.pOut - pJPEG->pOutput);
            }
        } else {
            pEncode->x += pEncode->cx;
        } // grayscale
    } else { // color
        if (pJPEG->ucSubSample == JPEGE_SUBSAMPLE_444) {
            JPEGGetMCU11(pPixels, pJPEG, iPitch);
            JPEGFDCT(&pJPEG->MCUc[0*DCTSIZE], pJPEG->MCUs);
            // Y
            bSparse = JPEGQuantize(pJPEG, pJPEG->MCUs, 0);
            pJPEG->iDCPred0 = JPEGEncodeMCU(0, pJPEG, pJPEG->MCUs, pJPEG->iDCPred0, bSparse);
            JPEGFDCT(&pJPEG->MCUc[1*DCTSIZE], pJPEG->MCUs);
            // Cb
            bSparse = JPEGQuantize(pJPEG, pJPEG->MCUs, 1);
            pJPEG->iDCPred1 = JPEGEncodeMCU(1, pJPEG, pJPEG->MCUs, pJPEG->iDCPred1, bSparse);
            JPEGFDCT(&pJPEG->MCUc[2*DCTSIZE], pJPEG->MCUs);
            // Cr
            bSparse = JPEGQuantize(pJPEG, pJPEG->MCUs, 1);
            pJPEG->iDCPred2 = JPEGEncodeMCU(1, pJPEG, pJPEG->MCUs, pJPEG->iDCPred2, bSparse);
        } else { // must be 420
            JPEGGetMCU22(pPixels, pJPEG, iPitch);
            JPEGFDCT(&pJPEG->MCUc[0*DCTSIZE], pJPEG->MCUs); // Y0
            bSparse = JPEGQuantize(pJPEG, pJPEG->MCUs, 0);
            pJPEG->iDCPred0 = JPEGEncodeMCU(0, pJPEG, pJPEG->MCUs, pJPEG->iDCPred0, bSparse);
            JPEGFDCT(&pJPEG->MCUc[1*DCTSIZE], pJPEG->MCUs); // Y1
            bSparse = JPEGQuantize(pJPEG, pJPEG->MCUs, 0);
            pJPEG->iDCPred0 = JPEGEncodeMCU(0, pJPEG, pJPEG->MCUs, pJPEG->iDCPred0, bSparse);
            JPEGFDCT(&pJPEG->MCUc[2*DCTSIZE], pJPEG->MCUs); // Y2
            bSparse = JPEGQuantize(pJPEG, pJPEG->MCUs, 0);
            pJPEG->iDCPred0 = JPEGEncodeMCU(0, pJPEG, pJPEG->MCUs, pJPEG->iDCPred0, bSparse);
            JPEGFDCT(&pJPEG->MCUc[3*DCTSIZE], pJPEG->MCUs); // Y3
            bSparse = JPEGQuantize(pJPEG, pJPEG->MCUs, 0);
            pJPEG->iDCPred0 = JPEGEncodeMCU(0, pJPEG, pJPEG->MCUs, pJPEG->iDCPred0, bSparse);
            JPEGFDCT(&pJPEG->MCUc[4*DCTSIZE], pJPEG->MCUs); // Cb
            bSparse = JPEGQuantize(pJPEG, pJPEG->MCUs, 1);
            pJPEG->iDCPred1 = JPEGEncodeMCU(1, pJPEG, pJPEG->MCUs, pJPEG->iDCPred1, bSparse);
            JPEGFDCT(&pJPEG->MCUc[5*DCTSIZE], pJPEG->MCUs); // Cr
            bSparse = JPEGQuantize(pJPEG, pJPEG->MCUs, 1);
            pJPEG->iDCPred2 = JPEGEncodeMCU(1, pJPEG, pJPEG->MCUs, pJPEG->iDCPred2, bSparse);
        } // 420 subsample
        if (pEncode->x >= (pJPEG->iWidth - pEncode->cx)) { // end of the row?
            // Store the restart marker
            FlushCode(&pJPEG->pc);
            *(pJPEG->pc.pOut)++ = 0xff; // store restart marker
            *(pJPEG->pc.pOut)++ = (unsigned char) (0xd0 + (pJPEG->iRestart & 7));
            pJPEG->iRestart++;
            pJPEG->iDCPred0 = pJPEG->iDCPred1 = pJPEG->iDCPred2 = 0; // reset the DC predictors
            pEncode->x = 0;
            pEncode->y += pEncode->cy;
            if (pEncode->y >= pJPEG->iHeight && pJPEG->pOutput) {
                pJPEG->iDataSize = (int)(pJPEG->pc.pOut - pJPEG->pOutput);
            }
        } else {
            pEncode->x += pEncode->cx;
        } // grayscale
    }
    if (pJPEG->pc.pOut >= pJPEG->pHighWater) { // out of space or need to write incremental buffer
        if (pJPEG->pOutput) { // the user-supplied buffer is not big enough
            pJPEG->iError = JPEGE_NO_BUFFER;
            return JPEGE_NO_BUFFER;
        } else { // write current block of data
            int iLen = (int)(pJPEG->pc.pOut - pJPEG->ucFileBuf);
            pJPEG->pfnWrite(&pJPEG->JPEGFile, pJPEG->ucFileBuf, iLen);
            pJPEG->iDataSize += iLen;
            pJPEG->pc.pOut = pJPEG->ucFileBuf;
        }
    }
    return JPEGE_SUCCESS;
} /* JPEGAddMCU() */

int JPEGEncodeFrame(JPEGE_IMAGE *pJPEG, JPEGENCODE *pEncode, uint8_t *pPixels, int iPitch)
{
int x, y;
uint8_t *s;
int rc = JPEGE_SUCCESS;
int iBPMCU;

    iBPMCU = pEncode->cx;
    switch (pJPEG->ucPixelType) {
        case JPEGE_PIXEL_GRAYSCALE:
           break; // 1 byte per pixel
        case JPEGE_PIXEL_RGB565:
           iBPMCU *= 2;
           break;
        case JPEGE_PIXEL_RGB888:
           iBPMCU *= 3;
           break;
        case JPEGE_PIXEL_ARGB8888:
           iBPMCU *= 4;
           break;
        case JPEGE_PIXEL_YUV422:
           iBPMCU *= 2; // average 2 bytes per pixel
           break;
    }
    for (y = 0; y < pJPEG->iMCUHeight && rc == JPEGE_SUCCESS; y++) {
        s = &pPixels[y * pEncode->cy * iPitch];
        for (x = 0; x<pJPEG->iMCUWidth && rc == JPEGE_SUCCESS; x++) {
            rc = JPEGAddMCU(pJPEG, pEncode, s, iPitch);
            s += iBPMCU;
        } // for x
    } // for y
    return rc;
} /* JPEGEncodeFrame() */


/*
 * Open a user-supplied RAM output buffer for encoding. Mirrors the decoder's
 * JPEG_openRAM(): clears the state, stores the output buffer pointer/size and
 * reserves a 512-byte high-water margin at the end of the buffer.
 */
int JPEGOpenRAM(JPEGE_IMAGE *pJPEG, uint8_t *pOutput, int iBufferSize)
{
	if (pOutput == NULL || iBufferSize < 1024) {
		return JPEGE_INVALID_PARAMETER;
	}
	memset(pJPEG, 0, sizeof(JPEGE_IMAGE));
	pJPEG->pOutput = pOutput;
	pJPEG->iBufferSize = iBufferSize;
	pJPEG->pHighWater = &pOutput[iBufferSize - 512];

	return JPEGE_SUCCESS;
} /* JPEGOpenRAM() */

/*
 * Return the last error (if any) recorded in the encoder state.
 */
int JPEGGetLastError(JPEGE_IMAGE *pJPEG)
{
	return pJPEG->iError;
} /* JPEGGetLastError() */
