## subsys/mgmt/mcumgr/grp/os_mgmt/Kconfig
```kconfig
# Copyright Runtime.io 2018. All rights reserved.
# Copyright Nordic Semiconductor ASA 2020-2022. All rights reserved.
# SPDX-License-Identifier: Apache-2.0

# The Kconfig file is dedicated to OS management group of
# of MCUmgr subsystem and provides Kconfig options to configure
# group commands behaviour and other aspects.
#
# Options defined in this file should be prefixed:
#  MCUMGR_GRP_OS_ -- general group options;
#
# When adding Kconfig options, that control the same feature,
# try to group them together by the same stem after prefix.

menuconfig MCUMGR_GRP_OS
	bool "Mcumgr handlers for OS management"
	imply REBOOT
	help
	  Enables MCUmgr handlers for OS management

if MCUMGR_GRP_OS

if REBOOT

config MCUMGR_GRP_OS_RESET_MS
	int "Delay before executing reset command (ms)"
	default 250
	depends on REBOOT
	help
	  When a reset command is received, the system waits this many milliseconds
	  before performing the reset.  This delay allows time for the MCUmgr
	  response to be delivered.

config MCUMGR_GRP_OS_RESET_HOOK
	bool "Reset hook"
	depends on REBOOT
	depends on MCUMGR_MGMT_NOTIFICATION_HOOKS
	help
	  Allows applications to control and get notifications of when a reset
	  command has been issued via an MCUmgr command. With this option
	  disabled, modules will reboot when the command is received without
	  notification, when this is enabled and a handler is registered, the
	  application will be notified that a reset command has been received
	  and will allow the application to perform any required operations
	  before accepting or declining the reset request.

endif

config MCUMGR_GRP_OS_TASKSTAT
	bool "Support for taskstat command"
	select MCUMGR_SMP_CBOR_MIN_ENCODING_LEVEL_3 if ZCBOR_CANONICAL
	depends on THREAD_MONITOR

if MCUMGR_GRP_OS_TASKSTAT

config MCUMGR_GRP_OS_TASKSTAT_ONLY_SUPPORTED_STATS
	bool "Send only data gathered by Zephyr"
	default y
	help
	  Response will not include fields the Zephyr does not collect statistic for.
	  Enable this if your client software is able to process "taskstat" response
	  that would be missing "runtime", "cswcnt", "last_checkin" and "next_checkin"
	  map entries for each listed task.
	  Enabling this option will slightly reduce code size.

choice MCUMGR_GRP_OS_TASKSTAT_THREAD_NAME_CHOICE
	prompt "Characteristic used as thread name in taskstat"
	default MCUMGR_GRP_OS_TASKSTAT_USE_THREAD_NAME_FOR_NAME if THREAD_NAME
	default MCUMGR_GRP_OS_TASKSTAT_USE_THREAD_PRIO_FOR_NAME
	help
	  Select what will serve as thread name in "taskstat" response.
	  By default taskstat responses use thread priority, when THREAD_NAME is disabled,

	config MCUMGR_GRP_OS_TASKSTAT_USE_THREAD_NAME_FOR_NAME
		bool "Thread name"
		depends on THREAD_NAME

	config MCUMGR_GRP_OS_TASKSTAT_USE_THREAD_IDX_FOR_NAME
		bool "Thread index"

	config MCUMGR_GRP_OS_TASKSTAT_USE_THREAD_PRIO_FOR_NAME
		bool "Thread priority"

endchoice

config MCUMGR_GRP_OS_TASKSTAT_MAX_NUM_THREADS
	int "Predicted maximum number of threads to return on taskstat list"
	default 50
	help
	  This is used for defining CBOR map holding thread info.
	  The value does not affect memory allocation, it is used by zcbor
	  to figure out how to encode map depending on its predicted size.

config MCUMGR_GRP_OS_TASKSTAT_THREAD_NAME_LEN
	int "Length of thread name to return in response"
	default THREAD_MAX_NAME_LEN if THREAD_NAME
	default 5 if !THREAD_NAME
	range 3 THREAD_MAX_NAME_LEN if THREAD_NAME
	range 3 6 if !THREAD_NAME
	help
	  The length of the string that is sent in response to taskstat command,
	  as a thread name.
	  When THREAD_NAME is enabled then this defaults to THREAD_MAX_NAME_LEN.
	  When THREAD_NAME is disabled the name is generated from thread priority,
	  signed integer, and this number regulates how many digits will be used;
	  in such case this value should also take into account possible '-'
	  sign.

config MCUMGR_GRP_OS_TASKSTAT_SIGNED_PRIORITY
	bool "Signed priorities"
	default y
	help
	  Zephyr uses int8_t as thread priorities, but in taskstat response it encodes
	  them as unsigned.  Enabling this option will use signed int for priorities in
	  responses, which is more natural for Zephyr.
	  Disable this option if your client software is unable to properly decode and
	  accept signed integers as priorities.

config MCUMGR_GRP_OS_TASKSTAT_STACK_INFO
	bool "Include stack info in taskstat responses"
	depends on THREAD_STACK_INFO
	help
	  Enabling this option adds stack information into "taskstat" command
	  responses, this is default when THREAD_STACK_INFO is selected.
	  Disable this option only when your client application is able to
	  process "taskstat" response without the "stksiz" and "stkuse" fields.
	  It is worth disabling this option when THREAD_STACK_INFO is disabled,
	  as it will prevent sending zeroed stack information just to fill
	  all the fields in "taskstat" responses, and it will slightly reduce code size.

endif

config MCUMGR_GRP_OS_ECHO
	bool "Support for echo command"
	default y
	select MCUMGR_SMP_CBOR_MIN_DECODING_LEVEL_2

config MCUMGR_GRP_OS_DATETIME
	bool "Support for datetime command"
	depends on RTC
	depends on $(dt_alias_enabled,rtc)
	select MCUMGR_SMP_CBOR_MIN_DECODING_LEVEL_2
	help
	  Enables support for the datetime get and set functions, this allows for using the
	  `rtc` alias device as a timesource from which the current time can be written or read.

config MCUMGR_GRP_OS_DATETIME_MS
	bool "Support millisecond field in datetime commands"
	depends on MCUMGR_GRP_OS_DATETIME

config MCUMGR_GRP_OS_DATETIME_HOOK
	bool "Datetime hook"
	depends on MCUMGR_GRP_OS_DATETIME
	depends on MCUMGR_MGMT_NOTIFICATION_HOOKS
	help
	  Allows applications to control and get notifications of when a datetime set/get
	  command has been issued via an MCUmgr command.

config MCUMGR_GRP_OS_MCUMGR_PARAMS
	bool "MCUMGR Parameters retrieval command"

config MCUMGR_GRP_OS_INFO
	bool "Support for info command"
	help
	  Can be used similarly to the unix/linux uname command for retrieving system information
	  including kernel version, processor architecture and board name.

if MCUMGR_GRP_OS_INFO

config MCUMGR_GRP_OS_INFO_MAX_RESPONSE_SIZE
	int "Maximum response size for info command"
	default 256
	range 32 512
	help
	  The maximum size of the response to the info command, will use a stack buffer of this
	  size to store the data in. If the output response is too big then the output will not be
	  present in the response, which will just contain the result code (rc) of memory error.

config MCUMGR_GRP_OS_INFO_CUSTOM_HOOKS
	bool "Custom info hooks"
	depends on MCUMGR_MGMT_NOTIFICATION_HOOKS
	help
	  Supports adding custom command/character processing to the info command by using
	  registered callbacks. Data can be appended to the struct provided in the callback.

config MCUMGR_GRP_OS_INFO_BUILD_DATE_TIME
	bool "Show build date and time"
	help
	  Will allow returning the build date and time of the firmware by using the info with
	  format option 'b' (will also be returned with all responses by using 'a').

	  Note: This will invalidate reproducible builds of the firmware as it will embed the
	  build date/time in the output firmware image.

endif

if BOOTLOADER_MCUBOOT

config MCUMGR_GRP_OS_BOOTLOADER_INFO
	bool "Bootloader information"
	help
	  Allows to query MCUmgr about bootloader used by device and various bootloader
	  parameters.

endif # BOOTLOADER_MCUBOOT

module = MCUMGR_GRP_OS
module-str = mcumgr_grp_os
source "subsys/logging/Kconfig.template.log_config"

endif
```

## subsys/mgmt/mcumgr/grp/os_mgmt_client/Kconfig
```kconfig
# Copyright Nordic Semiconductor ASA 2023. All rights reserved.
# SPDX-License-Identifier: Apache-2.0

# The Kconfig file is dedicated to OS management group of
# of MCUmgr client subsystem and provides Kconfig options to configure
# group commands behaviour and other aspects.
#
# Options defined in this file should be prefixed:
#  MCUMGR_GRP_OS_CLIENT_ -- general group options;
#
# When adding Kconfig options, that control the same feature,
# try to group them together by the same stem after prefix.

menuconfig MCUMGR_GRP_OS_CLIENT
	bool "MCUmgr client request and response handlers for OS management"
	depends on SMP_CLIENT
	select MCUMGR_SMP_CBOR_MIN_DECODING_LEVEL_3
	help
	  Enables MCUmgr client request and response handlers for OS management.

if MCUMGR_GRP_OS_CLIENT

config MCUMGR_GRP_OS_CLIENT_ECHO
	default y
	bool "Support for echo command request"

config MCUMGR_GRP_OS_CLIENT_RESET
	default y
	bool "support for reset command request"

module = MCUMGR_GRP_OS_CLIENT
module-str = mcumgr_grp_os_client
source "subsys/logging/Kconfig.template.log_config"

endif
```

## subsys/mgmt/mcumgr/grp/settings_mgmt/Kconfig
```kconfig
# Copyright Nordic Semiconductor ASA 2023. All rights reserved.
# SPDX-License-Identifier: Apache-2.0

menuconfig MCUMGR_GRP_SETTINGS
	bool "MCUmgr handlers for settings management"
	depends on SETTINGS
	depends on SETTINGS_RUNTIME
	select MCUMGR_SMP_CBOR_MIN_DECODING_LEVEL_2
	select MCUMGR_SMP_CBOR_MIN_ENCODING_LEVEL_2 if ZCBOR_CANONICAL
	select MCUMGR_SMP_CBOR_MIN_ENCODING_LEVEL_1
	help
	  Enables MCUmgr handlers for settings manipulation.

if MCUMGR_GRP_SETTINGS

choice MCUMGR_GRP_SETTINGS_BUFFER_TYPE
	prompt "Buffer type"
	default MCUMGR_GRP_SETTINGS_BUFFER_TYPE_STACK
	help
	  Selects if the stack or heap will be used for variables that are
	  needed when processing requests.

config MCUMGR_GRP_SETTINGS_BUFFER_TYPE_STACK
	bool "Stack (fixed size)"
	help
	  Use a fixed size stack buffer, any user-supplied values longer than
	  this will be rejected.

	  Note that stack usage for parameter storage alone will be
	  MCUMGR_GRP_SETTINGS_NAME_LEN + MCUMGR_GRP_SETTINGS_VALUE_LEN,
	  therefore the MCUmgr stack should be appropriately sized.

config MCUMGR_GRP_SETTINGS_BUFFER_TYPE_HEAP
	bool "Heap (dynamic size)"
	depends on COMMON_LIBC_MALLOC_ARENA_SIZE > 0
	help
	  Use dynamic heap memory allocation through malloc, if there is
	  insufficient heap memory for the allocation then the request will be
	  rejected.

endchoice

config MCUMGR_GRP_SETTINGS_NAME_LEN
	int "Maximum setting name length"
	default 32
	help
	  Maximum length of a key to lookup, this will be the size of the
	  variable if placed on the stack or the maximum allocated size of the
	  variable if placed on the heap.

config MCUMGR_GRP_SETTINGS_VALUE_LEN
	int "Maximum setting value length"
	default 32
	help
	  Maximum length of a value to read, this will be the size of the
	  variable if placed on the stack or the allocated size of the
	  variable if placed on the heap (settings does not support getting
	  the size of a value prior to looking it up).

config MCUMGR_GRP_SETTINGS_ACCESS_HOOK
	bool "Settings access hook"
	depends on MCUMGR_MGMT_NOTIFICATION_HOOKS
	help
	  Allows applications to control settings management access by
	  registering for a callback which is then triggered whenever a
	  settings read or write attempt is made.

endif
```

## subsys/mgmt/mcumgr/grp/shell_mgmt/Kconfig
```kconfig
# Copyright Runtime.io 2018. All rights reserved.
# Copyright Nordic Semiconductor ASA 2020-2022. All rights reserved.
# SPDX-License-Identifier: Apache-2.0

# The Kconfig file is dedicated to Shell management group of
# of MCUmgr subsystem and provides Kconfig options to configure
# group commands behaviour and other aspects.
#
# Options defined in this file should be prefixed:
#  MCUMGR_GRP_SHELL_ -- general group options;
#
# When adding Kconfig options, that control the same feature,
# try to group them together by the same stem after prefix.

menuconfig MCUMGR_GRP_SHELL
	bool "Mcumgr handlers for shell management"
	depends on SHELL
	depends on SHELL_BACKEND_DUMMY
	select MCUMGR_SMP_CBOR_MIN_DECODING_LEVEL_2
	help
	  Enables mcumgr handlers for shell management. The handler will utilize
	  the dummy backend to execute shell commands and capture the output to
	  an internal memory buffer. This way, there is no interaction with
	  physical interfaces outside of the scope of the user.
	  It is possible to use additional shell backends in coordination
	  with this handler and they will not interfere.
	  The MCUMGR_GRP_SHELL_BACKEND_DUMMY_BUF_SIZE will affect how many characters
	  will be returned from command output, if your output gets cut, then
	  increase the value. Remember to set MCUMGR_TRANSPORT_NETBUF_SIZE accordingly.
	  Note that maximum length of shell command accepted is regulated by
	  the CONFIG_SHELL_CMD_BUFF_SIZE, and a buffer for a command is allocated
	  on a stack, by the mcumgr, so enabling MCUMGR_GRP_SHELL and
	  changes to the CONFIG_SHELL_CMD_BUFF_SIZE may increase stack size
	  requirements.

if MCUMGR_GRP_SHELL

# Show dummy shell buffer size here, will show help text of original prompt so
# nothing extra is needed here, nor a default value.
config SHELL_BACKEND_DUMMY_BUF_SIZE
	int "Shell output buffer size (Size of dummy buffer size)"

config MCUMGR_GRP_SHELL_LEGACY_RC_RETURN_CODE
	bool "Legacy behaviour: Use rc field for shell function return code"
	help
	  Enabling this options brings back legacy behaviour where the shell
	  return code is returned, incorrectly, in the rc field that was
	  originally designated for returning SMP processing errors. When
	  disabled, there will be an additional ret field which contains the
	  shell command exit code, and rc will be used for SMP processing
	  error codes.

module = MCUMGR_GRP_SHELL
module-str = mcumgr_grp_shell
source "subsys/logging/Kconfig.template.log_config"

endif # MCUMGR_GRP_SHELL
```

## subsys/mgmt/mcumgr/grp/stat_mgmt/Kconfig
```kconfig
# Copyright Runtime.io 2018. All rights reserved.
# Copyright Nordic Semiconductor ASA 2020-2022. All rights reserved.
# SPDX-License-Identifier: Apache-2.0

# The Kconfig file is dedicated to Stat management group of
# of MCUmgr subsystem and provides Kconfig options to configure
# group commands behaviour and other aspects.
#
# Options defined in this file should be prefixed:
#  MCUMGR_GRP_STAT_ -- general group options;
#
# When adding Kconfig options, that control the same feature,
# try to group them together by the same stem after prefix.

menuconfig MCUMGR_GRP_STAT
	bool "Mcumgr handlers for statistics management"
	depends on STATS
	select MCUMGR_SMP_CBOR_MIN_DECODING_LEVEL_2
	select MCUMGR_SMP_CBOR_MIN_ENCODING_LEVEL_3 if ZCBOR_CANONICAL
	help
	  Enables MCUmgr handlers for statistics management.

if MCUMGR_GRP_STAT

config MCUMGR_GRP_STAT_MAX_NAME_LEN
	int "Maximum stat group name length"
	default 32
	depends on MCUMGR_GRP_STAT
	help
	  Limits the maximum stat group name length in MCUmgr requests, in bytes.
	  For stat group names. a buffer of this size gets allocated on the stack
	  during handling of all stat read commands. If a stat group's name
	  exceeds this limit, it will be impossible to retrieve its values with
	  a stat show command.
	  For stat names s_name and snm_name, this is the maximum length when
	  encoding the name to cbor.

module = MCUMGR_GRP_STAT
module-str = mcumgr_grp_stat
source "subsys/logging/Kconfig.template.log_config"

endif # MCUMGR_GRP_STAT
```

## subsys/mgmt/mcumgr/grp/zephyr_basic/Kconfig
```kconfig
# Copyright (c) 2022 Nordic Semiconductor ASA
# SPDX-License-Identifier: Apache-2.0

menuconfig MCUMGR_GRP_ZBASIC
	bool "Zephyr specific basic group of commands"
	help
	  Enables MCUmgr to processing of Zephyr specific groups.

if MCUMGR_GRP_ZBASIC

config MCUMGR_GRP_ZBASIC_STORAGE_ERASE
	bool "Storage erase command"
	depends on FLASH_MAP
	help
	  Enables command that allows to erase storage partition.

module = MCUMGR_GRP_ZBASIC
module-str = mcumgr_grp_zbasic
source "subsys/logging/Kconfig.template.log_config"

endif
```
