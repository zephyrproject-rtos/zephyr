## subsys/mem_mgmt/demand_paging/backing_store/Kconfig
```kconfig
# Copyright (c) 2020 Intel Corporation
# SPDX-License-Identifier: Apache-2.0

choice BACKING_STORE_CHOICE
	prompt "Backing store algorithms"
	default BACKING_STORE_RAM

config BACKING_STORE_CUSTOM
	bool "Custom backing store implementation"
	help
	  This option is chosen when the backing store will be implemented in
	  the application. This will be typical as these tend to be very
	  hardware-dependent.

config BACKING_STORE_RAM
	bool "RAM-based test backing store"
	help
	  This implements a backing store using physical RAM pages that the
	  Zephyr kernel is otherwise unaware of. It is intended for
	  demonstration and testing of the demand paging feature.

config BACKING_STORE_QEMU_X86_TINY_FLASH
	bool "Flash-based backing store on qemu_x86_tiny"
	depends on BOARD_QEMU_X86_TINY
	help
	  This uses the "flash" memory area (in DTS) as the backing store
	  for demand paging. The qemu_x86_tiny.ld linker script puts
	  the symbols outside of boot and pinned sections into the flash
	  area, allowing testing of the demand paging mechanism on
	  code and data.

config BACKING_STORE_ONDEMAND_SEMIHOST
	bool "Backing store for on-demand linker section using semihosting"
	depends on SEMIHOST && LINKER_USE_ONDEMAND_SECTION
	help
	  This is used to do on-demand paging of code and data marked with
	  __ondemand_func and __ondemand_rodata tags respectively. The compiled
	  zephyr.bin on the host is used to retrieve needed data with the
	  semihosting I/O facility.

endchoice

if BACKING_STORE_RAM
config BACKING_STORE_RAM_PAGES
	int "Number of pages for RAM backing store"
	default 16
	help
	  Number of pages of backing store memory to reserve in RAM. All test
	  cases for demand paging assume that there are at least 16 pages of
	  backing store storage available.

endif # BACKING_STORE_RAM
```

## subsys/mgmt/Kconfig
```kconfig
# Management configuration options

# SPDX-License-Identifier: Apache-2.0

menu "Device Management"

source "subsys/mgmt/ec_host_cmd/Kconfig"

source "subsys/mgmt/mcumgr/Kconfig"

source "subsys/mgmt/hawkbit/Kconfig"

source "subsys/mgmt/updatehub/Kconfig"

source "subsys/mgmt/osdp/Kconfig"

endmenu
```

## subsys/mgmt/Kconfig.mcumgr
```kconfig
# Copyright Runtime.io 2018. All rights reserved.
# SPDX-License-Identifier: Apache-2.0

config MCUMGR
	bool "mcumgr Support"
	select NET_BUF
	select TINYCBOR
	help
	  This option enables the mcumgr management library.

if MCUMGR

menu "Command handlers"

menuconfig MCUMGR_CMD_FS_MGMT
	bool "Enable mcumgr handlers for file management"
	depends on FILE_SYSTEM
	help
	  Enables mcumgr handlers for file management

if MCUMGR_CMD_FS_MGMT
config FS_MGMT_UL_CHUNK_SIZE
	int "Maximum chunk size for file uploads"
	default 512
	help
	  Limits the maximum chunk size for file uploads, in bytes.  A buffer of
	  this size gets allocated on the stack during handling of a file upload command.

config FS_MGMT_DL_CHUNK_SIZE
	int "Maximum chunk size for file downloads"
	default 512
	help
	  Limits the maximum chunk size for file downloads, in bytes.  A buffer of
	  this size gets allocated on the stack during handling of a file download
	  command.

config FS_MGMT_PATH_SIZE
	int "Maximum file path length"
	default 64
	help
	  Limits the maximum path length for file operations, in bytes.  A buffer
	  of this size gets allocated on the stack during handling of file upload
	  and download commands.
endif

menuconfig MCUMGR_CMD_IMG_MGMT
	bool "Enable mcumgr handlers for image management"
	select FLASH
	select MPU_ALLOW_FLASH_WRITE if CPU_HAS_MPU
	select IMG_MANAGER
	help
	  Enables mcumgr handlers for image management

config IMG_MGMT_UL_CHUNK_SIZE
	int "Maximum chunk size for image uploads"
	default 512
	depends on MCUMGR_CMD_IMG_MGMT
	help
	  Limits the maximum chunk size for image uploads, in bytes.  A buffer of
	  this size gets allocated on the stack during handling of a image upload
	  command.

menuconfig MCUMGR_CMD_OS_MGMT
	bool "Enable mcumgr handlers for OS management"
	select REBOOT
	help
	  Enables mcumgr handlers for OS management

if MCUMGR_CMD_OS_MGMT
config OS_MGMT_RESET_MS
	int "Delay before executing reset command (ms)"
	default 250
	help
	  When a reset command is received, the system waits this many milliseconds
	  before performing the reset.  This delay allows time for the mcumgr
	  response to be delivered.

config OS_MGMT_TASKSTAT
	bool "Support for taskstat command"
	default y

config OS_MGMT_ECHO
	bool "Support for echo command"
	default y
endif


menuconfig MCUMGR_CMD_STAT_MGMT
	bool "Enable mcumgr handlers for statistics management"
	depends on STATS
	help
	  Enables mcumgr handlers for statistics management.

config STAT_MGMT_MAX_NAME_LEN
	int "Maximum stat group name length"
	default 32
	depends on MCUMGR_CMD_STAT_MGMT
	help
	  Limits the maximum stat group name length in mcumgr requests, in bytes.
	  A buffer of this size gets allocated on the stack during handling of all
	  stat read commands.  If a stat group's name exceeds this limit, it will
	  be impossible to retrieve its values with a stat show command.

endmenu

config APP_LINK_WITH_MCUMGR
	bool "Link 'app' with MCUMGR"
	default y
	help
	  Add MCUMGR header files to the 'app' include path. It may be
	  disabled if the include paths for MCUMGR are causing aliasing
	  issues for 'app'.

endif
```

## subsys/mgmt/delta/Kconfig
```kconfig
# Delta Firmware Update
#
# Copyright (c) 2026 Clovis Corde
# SPDX-License-Identifier: Apache-2.0

menuconfig DELTA_UPDATE
	bool "Delta Firmware Update"
	help
	  Enable support for Delta Firmware Update.
	  This allows applying binary delta patches to update firmware,
	  significantly reducing the data transfer size compared to full
	  firmware updates.

if DELTA_UPDATE

module = DELTA_UPDATE
module-str = delta_update
source "subsys/logging/Kconfig.template.log_config"

choice DELTA_ALGORITHM
	prompt "Delta patch algorithm"
	default BSDIFF_HS_ALGO
	help
	  Select the algorithm used to apply delta patches.

config BSDIFF_HS_ALGO
	bool "bsdiff algorithm and heatshrink compression"
	select HEATSHRINK
	help
	  Use the bsdiff algorithm and heatshrink compression for applying
	  delta patches.

endchoice

config DELTA_INPUT_BUFFER_SIZE
	int "Input buffer size for delta patch decompression"
	default 64
	depends on BSDIFF_HS_ALGO
	help
	  Size in bytes of the buffer used to read compressed patch data
	  from storage before sinking into the heatshrink decoder.

endif # DELTA_UPDATE
```

## subsys/mgmt/ec_host_cmd/Kconfig
```kconfig
# Host command handler functionality

# Copyright (c) 2020 Google LLC
# SPDX-License-Identifier: Apache-2.0

menu "Host command handler subsystem"

config EC_HOST_CMD
	bool "Support Embedded Controller host command handler subsystem"
	help
	  Enable host command processing for embedded controllers on notebook
	  computers.

if EC_HOST_CMD

module = EC_HC
module-str = ec-host-commands
source "subsys/logging/Kconfig.template.log_config"

config EC_HOST_CMD_HANDLER_STACK_SIZE
	int "Stack size for the EC host command handler thread"
	default 800

config EC_HOST_CMD_HANDLER_TX_BUFFER_SIZE
	int "Buffer size in bytes for TX buffer shared by all EC host commands"
	default 0 if EC_HOST_CMD_BACKEND_ESPI
	default 0 if EC_HOST_CMD_BACKEND_SHI
	default 256 if EC_HOST_CMD_BACKEND_UART
	default 552 if EC_HOST_CMD_BACKEND_SPI
	default 256
	help
	  Buffer size in bytes for TX buffer defined by the host command handler.
	  Some backend layers can define their own buffer, so the size can be zero to
	  avoid duplicating buffers. If multiple backends are used, the size has to be
	  set by user to the largest one.

config EC_HOST_CMD_HANDLER_RX_BUFFER_SIZE
	int "Buffer size in bytes for RX buffer shared by all EC host commands"
	default 256 if EC_HOST_CMD_BACKEND_ESPI
	default 0 if EC_HOST_CMD_BACKEND_SHI
	default 544 if EC_HOST_CMD_BACKEND_UART
	default 544 if EC_HOST_CMD_BACKEND_SPI
	default 256
	help
	  Buffer size in bytes for TX buffer defined by the host command handler.
	  Some backend layers can define their own buffer, so the size can be zero to
	  avoid duplicating buffers. If multiple backends are used, the size has to be
	  set by user to the largest one.

config EC_HOST_CMD_HANDLER_PRIO
	int "Priority of host command task"
	default 13
	help
	  Priority of the kernel task that handles the host commands.
	  If the priority is too low (high in value), the host commands handler may be unable to
	  process the command on time and the AP will abort the waiting for response and be unable
	  to boot the system properly.

config EC_HOST_CMD_INIT_PRIORITY
	int "Initialization priority"
	default 80
	range 0 99
	help
	  Initialization priority for Host Command. It must be higher than the initialization
	  priority of the used backend device.

config EC_HOST_CMD_HANDLER_TX_BUFFER_DEF
	bool
	default y if EC_HOST_CMD_HANDLER_TX_BUFFER_SIZE > 0
	help
	  The handler defines common tx buffer

config EC_HOST_CMD_HANDLER_RX_BUFFER_DEF
	bool
	default y if EC_HOST_CMD_HANDLER_RX_BUFFER_SIZE > 0
	help
	  The handler defines common rx buffer

config EC_HOST_CMD_NOCACHE_BUFFERS
	bool "Place RX and TX buffers in __nocache section"
	default y if DCACHE && DMA
	depends on EC_HOST_CMD_HANDLER_TX_BUFFER_DEF || EC_HOST_CMD_HANDLER_RX_BUFFER_DEF
	help
	  DMA is often use for communication, however it usually requires
	  uncached memory. Add possibility to place the RX and TX buffers in the
	  __nocache section.

config EC_HOST_CMD_INITIALIZE_AT_BOOT
	bool "Initialize the host command subsystem automacitlly"
	default y
	help
	  Automatically initialize the host command subsystem with the chosen backend.
	  The ec_host_cmd_init function is called by the chosen backend.

config EC_HOST_CMD_DEDICATED_THREAD
	bool "Create a new task for host command"
	help
	  The ec_host_cmd_init function creates a new thread dedicated for Host Command.
	  Otherwise the ec_host_cmd_task function has to be called within another thread.

config EC_HOST_CMD_IN_PROGRESS_STATUS
	bool "Save status of last IN_PROGRESS command"
	default y if EC_HOST_CMD_BACKEND_SHI
	help
	  Enable support for saving final status of a last command that has sent
	  EC_HOST_CMD_IN_PROGRESS status. The saved status can be get with the
	  ec_host_cmd_send_in_progress_status function.

source "subsys/mgmt/ec_host_cmd/Kconfig.logging"
source "subsys/mgmt/ec_host_cmd/backends/Kconfig"

endif # EC_HOST_CMD

endmenu
```

## subsys/mgmt/ec_host_cmd/Kconfig.logging
```kconfig
# Host command logging configs

# Copyright (c) 2023 Google LLC
# SPDX-License-Identifier: Apache-2.0

config EC_HOST_CMD_LOG_DBG_BUFFERS
	bool "Log full params and response buffers in debug log level"
	depends on EC_HC_LOG_LEVEL_DBG
	help
	  Every command is logged with the debug logging level. Use this config
	  to decide, if full reqest and response buffers are logged alongside
	  other command parameters.

config EC_HOST_CMD_LOG_SUPPRESSED_NUMBER
	int "Maximum number of suppressed commands"
	default 8
	help
	  Suppressed commands are not logged on host command reception. Set
	  the maximum number of the suppressed commands. Set 0 to disable
	  suppressing commands.

config EC_HOST_CMD_LOG_SUPPRESSED_INTERVAL_SECS
	int "Interval of logging suppressed commands"
	default 3600
	help
	  Once every interval the suppressed commands are logged with the
	  suppression number.

config EC_HOST_CMD_LOG_SUPPRESSED
	bool
	default y if (EC_HOST_CMD_LOG_SUPPRESSED_NUMBER > 0)
```

## subsys/mgmt/ec_host_cmd/backends/Kconfig
```kconfig
# Host Command backend configs

# Copyright (c) 2020 Google LLC
# SPDX-License-Identifier: Apache-2.0

DT_CHOSEN_ESPI_BACKEND := zephyr,host-cmd-espi-backend
DT_CHOSEN_SHI_BACKEND := zephyr,host-cmd-shi-backend
DT_CHOSEN_UART_BACKEND := zephyr,host-cmd-uart-backend
DT_CHOSEN_SPI_BACKEND := zephyr,host-cmd-spi-backend

config EC_HOST_CMD_BACKEND_SIMULATOR
	bool "Embedded Controller Host Command Backend Simulator"
	depends on SOC_POSIX
	help
	  Enable the EC host command simulator.

config EC_HOST_CMD_BACKEND_ESPI
	bool "Host commands support using eSPI bus"
	default $(dt_chosen_enabled,$(DT_CHOSEN_ESPI_BACKEND))
	depends on ESPI_PERIPHERAL_EC_HOST_CMD
	depends on ESPI_PERIPHERAL_CUSTOM_OPCODE
	help
	  Enable support for Embedded Controller host commands using
	  the eSPI bus.

config EC_HOST_CMD_BACKEND_SHI
	bool "Host commands support using SHI"
	default $(dt_chosen_enabled,$(DT_CHOSEN_SHI_BACKEND))
	help
	  Enable support for Embedded Controller host commands using
	  the Serial Host Interface.

config EC_HOST_CMD_BACKEND_UART
	bool "Host commands support using UART"
	default $(dt_chosen_enabled,$(DT_CHOSEN_UART_BACKEND))
	depends on UART_ASYNC_API
	help
	  Enable support for Embedded Controller host commands using
	  the UART.

config EC_HOST_CMD_BACKEND_SPI
	bool "Host commands support using SPI"
	help
	  Enable support for Embedded Controller host commands using
	  the SPI.

if EC_HOST_CMD_BACKEND_SHI

choice EC_HOST_CMD_BACKEND_SHI_DRIVER
	prompt "SHI driver"
	default EC_HOST_CMD_BACKEND_SHI_NPCX if SOC_FAMILY_NPCX
	default EC_HOST_CMD_BACKEND_SHI_ITE if SOC_IT8XXX2

config EC_HOST_CMD_BACKEND_SHI_NPCX
	bool "SHI by Nuvoton"
	depends on DT_HAS_NUVOTON_NPCX_SHI_ENABLED || \
		   DT_HAS_NUVOTON_NPCX_SHI_ENHANCED_ENABLED
	help
	  This option enables the driver for SHI backend in the
	  Nuvoton NPCX chip.

config EC_HOST_CMD_BACKEND_SHI_ITE
	bool "SHI by ITE"
	depends on DT_HAS_ITE_IT8XXX2_SHI_ENABLED
	select PINCTRL
	help
	  This option enables the driver for SHI backend in the
	  ITE IT8xxx2 chips family.

endchoice

config EC_HOST_CMD_BACKEND_SHI_NPCX_ENHANCED_BUF_MODE
	def_bool DT_HAS_NUVOTON_NPCX_SHI_ENHANCED_ENABLED
	help
	  In this mode, besides the original 128-bytes FIFO, an additional
	  single-byte output buffer can be selected/switched to generate a
	  response to simultaneous Read/Write transactions.

config EC_HOST_CMD_BACKEND_SHI_NPCX_CS_DETECT_WORKAROUND
	bool
	default y if SOC_NPCX9M7FB
	help
	  Workaround the issue "CSnFE and CSnRE bits of EVSTATS2 Register (SHI)"
	  in the npcx9m7fb SoC errata.

config EC_HOST_CMD_BACKEND_SHI_MAX_REQUEST
	int "Max data size for the version 3 request packet"
	default 544 if EC_HOST_CMD_BACKEND_SHI_NPCX
	default 256 if EC_HOST_CMD_BACKEND_SHI_ITE
	help
	  This option indicates maximum data size for a version 3 request
	  packet. This must be big enough to handle the biggest possible
	  request.

config EC_HOST_CMD_BACKEND_SHI_MAX_RESPONSE
	int "Max data size for the version 3 response packet"
	default 544 if EC_HOST_CMD_BACKEND_SHI_NPCX
	default 248 if EC_HOST_CMD_BACKEND_SHI_ITE
	help
	  This option indicates maximum data size for a version 3 response
	  packet. This must be big enough to handle the biggest possible
	  response.

endif # EC_HOST_CMD_BACKEND_SHI

if EC_HOST_CMD_BACKEND_SPI

choice EC_HOST_CMD_BACKEND_SPI_DRIVER
	prompt "SHI driver"
	default EC_HOST_CMD_BACKEND_SPI_STM32 if DT_HAS_ST_STM32_SPI_HOST_CMD_ENABLED

config EC_HOST_CMD_BACKEND_SPI_STM32
	bool "SPI by STM32"
	select PINCTRL
	help
	  This option enables the driver for SPI backend in the
	  STM32 chip family.

endchoice

endif # EC_HOST_CMD_BACKEND_SPI
```
