## subsys/mgmt/hawkbit/Kconfig
```kconfig
# Copyright (c) 2020 Linumiz
# SPDX-License-Identifier: Apache-2.0

menuconfig HAWKBIT
	bool "Eclipse hawkBit Firmware Over-the-Air support"
	depends on SETTINGS
	depends on FLASH
	depends on REBOOT
	depends on NET_TCP
	depends on NET_SOCKETS
	depends on IMG_MANAGER
	depends on NETWORKING
	depends on HTTP_CLIENT
	depends on DNS_RESOLVER
	depends on JSON_LIBRARY
	depends on BOOTLOADER_MCUBOOT
	depends on SMF
	depends on SMF_ANCESTOR_SUPPORT
	select MPU_ALLOW_FLASH_WRITE
	select IMG_ENABLE_IMAGE_CHECK
	select IMG_ERASE_PROGRESSIVELY
	imply HWINFO if !HAWKBIT_CUSTOM_DEVICE_ID
	help
	  hawkBit is a domain independent back-end framework for polling out
	  software updates to constrained edge devices as well as more powerful
	  controllers and gateways connected to IP based networking infrastructure.

if HAWKBIT
config HAWKBIT_POLL_INTERVAL
	int "Time to poll interval (in minutes)"
	default 5
	range 1 43200
	help
	  Set the interval that the hawkbit update server will be polled.
	  This time interval is zero and 43200 minutes(30 days). This will be overridden
	  by the value configured in the settings of the hawkBit server.

config HAWKBIT_AUTOHANDLER
	bool "hawkBit autohandler"
	select EVENTS
	default y
	help
	  Activate autohandler to handle the update process automatically.

config HAWKBIT_SHELL
	bool "hawkBit shell utilities"
	depends on SHELL
	depends on HAWKBIT_AUTOHANDLER
	help
	  Activate shell module that provides hawkBit commands.

config HAWKBIT_TENANT
	string "Tenant name for the hawkbit server"
	default "default"
	help
	  Configure the tenant name for the hawkbit server.

config HAWKBIT_SERVER
	string "User address for the hawkbit server"
	help
	  Configure the hawkbit server address.

config HAWKBIT_PORT
	int "Port number for the hawkbit server"
	default 8080
	help
	  Configure the hawkbit port number.

config HAWKBIT_SET_SETTINGS_RUNTIME
	bool "Set hawkbit settings at runtime"
	help
	  Enable to set hawkbit settings at runtime.

choice HAWKBIT_DDI_SECURITY
	prompt "hawkBit DDI API authentication modes"
	default HAWKBIT_DDI_NO_SECURITY

config HAWKBIT_DDI_NO_SECURITY
	bool "No authentication security"
	help
	  No authentication security for the hawkBit DDI API.

config HAWKBIT_DDI_TARGET_SECURITY
	bool "Use target security token authentication"
	help
	  Use target security token authentication for the hawkBit DDI API.

config HAWKBIT_DDI_GATEWAY_SECURITY
	bool "Use gateway security token authentication"
	help
	  Use gateway security token authentication for the hawkBit DDI API.

endchoice

config HAWKBIT_DDI_SECURITY_TOKEN
	string "Authentication security token"
	depends on HAWKBIT_DDI_TARGET_SECURITY || HAWKBIT_DDI_GATEWAY_SECURITY
	default ""
	help
	  Authentication security token for the configured hawkBit DDI
	  authentication mode.

config HAWKBIT_CUSTOM_ATTRIBUTES
	bool "Custom device attributes"
	help
	  Use custom definition of device attributes.

config HAWKBIT_STATUS_BUFFER_SIZE
	int "hawkBit status buffer size"
	default 200
	help
	  Set the size of the buffer, which is used to store the
	  json strings, that are sent to the hawkBit server. It might
	  be increased if the custom attributes are used extensively.

config HAWKBIT_CUSTOM_DEVICE_ID
	bool "Custom device id through callback function"
	help
	  Be able to customize the device id during runtime to a custom value,
	  by configuring the callback function. See `hawkbit_set_device_identity_cb`

config HAWKBIT_DEVICE_ID_MAX_LENGTH
	int "Maximum length of the device id"
	depends on HAWKBIT_CUSTOM_DEVICE_ID
	range 1 128
	default 32
	help
	  Maximum length of the device id.

config HAWKBIT_USE_TLS
	bool "Use TLS for hawkBit server connection"
	depends on NET_SOCKETS_SOCKOPT_TLS
	help
	  Use TLS for hawkBit connection.

if HAWKBIT_USE_TLS

choice HAWKBIT_CERT_TAG
	prompt "hawkBit certificate tag"
	default HAWKBIT_USE_STATIC_CERT_TAG

config HAWKBIT_USE_STATIC_CERT_TAG
	bool "Use static certificate tag"
	help
	  Use static certificate tag for TLS connection to the hawkBit server.

config HAWKBIT_USE_DYNAMIC_CERT_TAG
	bool "Use dynamic certificate tag"
	depends on HAWKBIT_SET_SETTINGS_RUNTIME
	help
	  Use dynamic certificate tag for TLS connection to the hawkBit server.

endchoice

config HAWKBIT_STATIC_CERT_TAG
	int "Static certificate tag"
	depends on HAWKBIT_USE_STATIC_CERT_TAG
	default 1
	help
	  Static certificate tag for TLS connection to the hawkBit server.

endif

choice HAWKBIT_REBOOT_MODE
	prompt "Reboot mode after update"
	default HAWKBIT_REBOOT_WARM

config HAWKBIT_REBOOT_WARM
	bool "Warm reboot after update"
	help
	  Do a warm reboot after the update.

config HAWKBIT_REBOOT_COLD
	bool "Cold reboot after update"
	help
	  Do a cold reboot after the update.

endchoice

config HEAP_MEM_POOL_ADD_SIZE_HAWKBIT
	int "Heap memory pool size for hawkBit"
	default 4096
	help
	  Set the size of the heap memory pool for hawkBit.

config HAWKBIT_EVENT_CALLBACKS
	bool "Set hawkBit event callbacks"
	help
	  Be able to set event callbacks for hawkBit.

config HAWKBIT_SAVE_PROGRESS
	bool "Save the hawkBit update download progress"
	depends on STREAM_FLASH_PROGRESS
	help
	  Regularly save progress of hawkBit update download operation.
	  When enabled, the download progress is periodically saved to
	  non-volatile storage. If a download is interrupted, it can be resumed from
	  the last saved point rather than starting over, saving bandwidth and time.
	  This is especially useful for large updates over unreliable networks or in
	  resource-constrained environments.

config HAWKBIT_SAVE_PROGRESS_INTERVAL
	int "Save the hawkBit update download progress interval"
	default 5
	range 0 100
	depends on HAWKBIT_SAVE_PROGRESS
	help
	  Set the interval (in percent) that the hawkBit update download progress will be saved.
	  0 means that the progress will be saved every time a new chunk is downloaded.

module = HAWKBIT
module-str = Log Level for hawkbit
module-help = Enables logging for hawkBit code.
source "subsys/logging/Kconfig.template.log_config"

endif
```

## subsys/mgmt/mcumgr/Kconfig
```kconfig
# Copyright Runtime.io 2018. All rights reserved.
# Copyright Nordic Semiconductor ASA 2020-2022. All rights reserved.
# SPDX-License-Identifier: Apache-2.0

menuconfig MCUMGR
	bool "mcumgr Support"
	depends on NET_BUF
	depends on ZCBOR
	help
	  This option enables the mcumgr management library.

if MCUMGR

module = MCUMGR
module-str = mcumgr
source "subsys/logging/Kconfig.template.log_config"

rsource "mgmt/Kconfig"

rsource "smp/Kconfig"

config MCUMGR_SMP_LEGACY_RC_BEHAVIOUR
	bool "Legacy rc (result code) response behaviour"
	depends on MCUMGR_SMP_SUPPORT_ORIGINAL_PROTOCOL
	help
	  This will enable legacy result code response behaviour of having rc
	  present in responses when the status is 0. With this option disabled,
	  mcumgr acts with new behaviour and will only return rc is the result
	  code is non-zero (i.e. an error occurred).

	  If a command only returns a result code, this will mean that the
	  response will be empty with the new behaviour enabled, as opposed to
	  the old behaviour where the rc field will be present in the response.

menu "SMP Client"

rsource "smp_client/Kconfig"

endmenu

menu "Command Handlers"

rsource "grp/Kconfig"

endmenu

menu "Transports and Transport Related Configuration Options"

rsource "transport/Kconfig"

endmenu

endif # MCUMGR
```

## subsys/mgmt/mcumgr/grp/Kconfig
```kconfig
# Copyright Runtime.io 2018. All rights reserved.
# Copyright Nordic Semiconductor ASA 2020-2022. All rights reserved.
# SPDX-License-Identifier: Apache-2.0

rsource "fs_mgmt/Kconfig"

rsource "img_mgmt/Kconfig"

rsource "os_mgmt/Kconfig"

rsource "shell_mgmt/Kconfig"

rsource "stat_mgmt/Kconfig"

rsource "zephyr_basic/Kconfig"
```

## subsys/mgmt/mcumgr/grp/enum_mgmt/Kconfig
```kconfig
# Copyright Nordic Semiconductor ASA 2024. All rights reserved.
# SPDX-License-Identifier: Apache-2.0

# The Kconfig file is dedicated to enumeration management group of
# of MCUmgr subsystem and provides Kconfig options to configure
# group commands behaviour and other aspects.
#
# Options defined in this file should be prefixed:
#  MCUMGR_GRP_ENUM_ -- general group options;
#
# When adding Kconfig options, that control the same feature,
# try to group them together by the same stem after prefix.

menuconfig MCUMGR_GRP_ENUM
	bool "MCUmgr handlers for enumeration management"
	select MCUMGR_SMP_CBOR_MIN_DECODING_LEVEL_2
	select MCUMGR_SMP_CBOR_MIN_DECODING_LEVEL_3 if ZCBOR_CANONICAL
	help
	  Enables MCUmgr handlers for enumeration management. This allows
	  for listing supported command groups.

if MCUMGR_GRP_ENUM

menuconfig MCUMGR_GRP_ENUM_DETAILS
	bool "Group details command"
	select MCUMGR_SMP_CBOR_MIN_DECODING_LEVEL_3
	select MCUMGR_SMP_CBOR_MIN_DECODING_LEVEL_4 if ZCBOR_CANONICAL
	help
	  Implements functionality for listing details about groups.

	  Note: responses to this command can be very large

if MCUMGR_GRP_ENUM_DETAILS

config MCUMGR_GRP_ENUM_DETAILS_NAME
	bool "Include group names in detail response"
	default y
	help
	  Will include the name of groups in the detail command response.

config MCUMGR_GRP_ENUM_DETAILS_HANDLERS
	bool "Include group names in detail response"
	default y
	help
	  Will include the number of handlers of groups in the detail command response.

choice MCUMGR_GRP_ENUM_DETAILS_BUFFER_TYPE
	prompt "Buffer type"
	default MCUMGR_GRP_ENUM_DETAILS_BUFFER_TYPE_STACK
	help
	  Selects if the stack or heap will be used for variables that are needed when processing
	  requests.

menuconfig MCUMGR_GRP_ENUM_DETAILS_BUFFER_TYPE_STACK
	bool "Stack (fixed size)"
	help
	  Use a fixed size stack buffer, any user-supplied values longer than this will be
	  rejected.

	  Note that stack usage for parameter storage alone will be
	  MCUMGR_GRP_ENUM_DETAILS_BUFFER_TYPE_STACK * 2, therefore the MCUmgr stack should
	  be appropriately sized.

if MCUMGR_GRP_ENUM_DETAILS_BUFFER_TYPE_STACK

config MCUMGR_GRP_ENUM_DETAILS_BUFFER_TYPE_STACK_ENTRIES
	int "Maximum list item entries"
	range 1 65535
	default 16
	help
	  The number of maximum values in the list for the details command to support, each value
	  occupies 2 bytes on the stack.

endif # MCUMGR_GRP_ENUM_DETAILS_BUFFER_TYPE_STACK

config MCUMGR_GRP_ENUM_DETAILS_BUFFER_TYPE_HEAP
	bool "Heap (dynamic size)"
	depends on COMMON_LIBC_MALLOC_ARENA_SIZE > 0
	help
	  Use dynamic heap memory allocation through malloc, if there is insufficient heap memory
	  for the allocation then the request will be rejected.

endchoice

config MCUMGR_GRP_ENUM_DETAILS_HOOK
	bool "Callback hook"
	depends on MCUMGR_MGMT_NOTIFICATION_HOOKS
	help
	  Allows applications to add additional fields to responses for the details of supported
	  command groups.

config MCUMGR_GRP_ENUM_DETAILS_STATES
	int
	prompt "Predicted maximum number of entries per group" if MCUMGR_GRP_ENUM_DETAILS_HOOK
	range 3 32
	default 3
	help
	  This is used for defining CBOR map holding group data. The value does not affect memory
	  allocation, it is used by zcbor to figure out how to encode map depending on its
	  predicted size. This value should be increased from the default value by the number of
	  additional fields that are returned by hooks.

endif # MCUMGR_GRP_ENUM_DETAILS

module = MCUMGR_GRP_ENUM
module-str = mcumgr_grp_enum
source "subsys/logging/Kconfig.template.log_config"

endif # MCUMGR_GRP_ENUM
```
