## subsys/ipc/ipc_service/backends/Kconfig.rpmsg_mi
```kconfig
# Copyright (c) 2020-2021 Nordic Semiconductor (ASA)
# SPDX-License-Identifier: Apache-2.0

if IPC_SERVICE_BACKEND_RPMSG_MI

choice IPC_SERVICE_BACKEND_RPMSG_MI_ROLE
	prompt "IPC service device role"

config IPC_SERVICE_BACKEND_RPMSG_MI_REMOTE
	bool "Remote"

config IPC_SERVICE_BACKEND_RPMSG_MI_MASTER
	bool "Master"

endchoice

config IPC_SERVICE_BACKEND_RPMSG_MI_WQ_STACK_SIZE
	int "Size of RX work queue stack"
	default 1024
	help
	  Size of stack used by work queue RX thread. This work queue is
	  created in the multi-instance / multi-core RPMsg backend module to
	  prevent notifying service users about received data from the system
	  work queue. Size is the same for all instances.

config IPC_SERVICE_BACKEND_RPMSG_MI_SHM_BASE_ADDRESS
	hex
	default "$(dt_chosen_reg_addr_hex,$(DT_CHOSEN_Z_IPC_SHM))"
	help
	  This option specifies base address of the memory region to
	  be used for the OpenAMP IPC shared memory.

config IPC_SERVICE_BACKEND_RPMSG_MI_SHM_SIZE
	hex
	default "$(dt_chosen_reg_size_hex,$(DT_CHOSEN_Z_IPC_SHM))"
	help
	  This option specifies size of the memory region to be used
	  for the OpenAMP IPC shared memory.

config IPC_SERVICE_BACKEND_RPMSG_MI_NUM_INSTANCES
	int "Number of RPMsg instances"
	default 2
	range 1 8
	help
	  How many instances are to be used.

ipm_name_instance_num = 0
rsource "Kconfig.ipm_name_instance"
ipm_name_instance_num = 1
rsource "Kconfig.ipm_name_instance"
ipm_name_instance_num = 2
rsource "Kconfig.ipm_name_instance"
ipm_name_instance_num = 3
rsource "Kconfig.ipm_name_instance"
ipm_name_instance_num = 4
rsource "Kconfig.ipm_name_instance"
ipm_name_instance_num = 5
rsource "Kconfig.ipm_name_instance"
ipm_name_instance_num = 6
rsource "Kconfig.ipm_name_instance"
ipm_name_instance_num = 7
rsource "Kconfig.ipm_name_instance"

endif # IP_SERVICE_BACKEND_RPMSG_MI
```

## subsys/ipc/ipc_service/backends/Kconfig.serial
```kconfig
# SPDX-FileCopyrightText: 2026 Basalte bv
# SPDX-License-Identifier: Apache-2.0

config IPC_SERVICE_BACKEND_SERIAL
	bool "IPC service backend over serial (UART) with COBS framing"
	default y
	depends on UART_INTERRUPT_DRIVEN
	depends on DT_HAS_ZEPHYR_IPC_SERIAL_ENABLED
	select COBS
	select RING_BUFFER
	select EVENTS
	help
	  Enables the IPC service backend over a serial (UART) link.
	  Uses COBS framing for reliable byte-stream transport and
	  supports multiple IPC endpoints multiplexed on a single
	  serial connection.

if IPC_SERVICE_BACKEND_SERIAL

config IPC_SERVICE_BACKEND_SERIAL_NUM_EP
	int "Maximum number of endpoints per serial IPC instance"
	range 1 32
	default 8
	help
	  Maximum number of IPC endpoints that can be registered on a
	  single serial IPC backend instance.

config IPC_SERVICE_BACKEND_SERIAL_RX_BUF_SIZE
	int "Receive ring buffer size"
	default 512
	help
	  Size of the UART receive ring buffer in bytes. Must be large
	  enough to hold at least one complete COBS-encoded frame.

config IPC_SERVICE_BACKEND_SERIAL_FRAME_BUF_SIZE
	int "Decoded frame buffer size"
	default 256
	range 4 $(UINT16_MAX)
	help
	  Maximum size of a decoded frame (after COBS decoding). This limits
	  the maximum payload size for a single IPC send operation including
	  the endpoint ID header.

config IPC_SERVICE_BACKEND_SERIAL_CRC
	bool "CRC-16 frame integrity check"
	select CRC
	help
	  Append a CRC-16 checksum to every transmitted frame and verify it
	  on reception. Frames with a CRC mismatch are discarded.

	  Both ends of the link must have this option set identically;
	  mixing will cause discarded or faulty frames.

endif # IPC_SERVICE_BACKEND_SERIAL
```

## subsys/ipc/ipc_service/lib/Kconfig
```kconfig
# Copyright (c) 2022 Nordic Semiconductor (ASA)
# SPDX-License-Identifier: Apache-2.0

config IPC_SERVICE_RPMSG
	bool "RPMsg support library"
	help
	  "RPMsg library"

config IPC_SERVICE_STATIC_VRINGS
	bool "Static VRINGs support library"
	help
	  "Static VRINGs library"

config IPC_SERVICE_STATIC_VRINGS_MEM_ALIGNMENT
	int "VRINGs alignment"
	depends on IPC_SERVICE_STATIC_VRINGS
	default 4
	help
	  Static VRINGs alignment. This should take into account the cache line
	  alignment if the cache is enabled.

menuconfig IPC_SERVICE_ICMSG
	bool "icmsg IPC library"
	select PBUF
	help
	  Icmsg library

if IPC_SERVICE_ICMSG
	rsource "Kconfig.icmsg"
endif

config IPC_SERVICE_ICMSG_ME
	bool "icmsg IPC library with multi-endpoint functionality"
	select IPC_SERVICE_ICMSG
	select EVENTS
	help
	  Multi-endpoint functionality for the icmsg library
```

## subsys/ipc/ipc_service/lib/Kconfig.bitpool
```kconfig
# Copyright (c) 2025 Nordic Semiconductor (ASA)
# SPDX-License-Identifier: Apache-2.0

config IPC_SERVICE_BITPOOL
	bool "IPC Service atomic bitpool library"
	help
	  Atomic bitpool implementation library.
```

## subsys/ipc/ipc_service/lib/Kconfig.icmsg
```kconfig
# Copyright (c) 2022 Nordic Semiconductor (ASA)
# SPDX-License-Identifier: Apache-2.0

config IPC_SERVICE_ICMSG_SHMEM_ACCESS_SYNC
	bool "Synchronize access to shared memory"
	depends on MULTITHREADING
	default y
	help
	  Provide synchronization access to shared memory at a library level.
	  This option is enabled by default to allow to use sending API from
	  multiple contexts. Mutex is used to guard access to the memory.
	  This option can be safely disabled if an application ensures data
	  are sent from single context.

config IPC_SERVICE_ICMSG_SHMEM_ACCESS_TO_MS
	int "Mutex lock timeout in milliseconds"
	depends on IPC_SERVICE_ICMSG_SHMEM_ACCESS_SYNC
	range 1 5
	default 1
	help
	  Maximum time to wait, in milliseconds, for access to send data with
	  backends basing on icmsg library. This time should be relatively low.

config IPC_SERVICE_ICMSG_BOND_NOTIFY_REPEAT_TO_MS
	int "Bond notification timeout in miliseconds"
	range 1 100
	default 1
	help
	  Time to wait for remote bonding notification before the
	  notification is repeated.

config IPC_SERVICE_BACKEND_ICMSG_WQ_ENABLE
	bool "Use dedicated workqueue"
	depends on MULTITHREADING
	default y
	help
	  Enable dedicated workqueue thread for the ICMsg backend.
	  Disabling this configuration will cause the ICMsg backend to
	  process incoming data through the system workqueue context, and
	  therefore reduces the RAM footprint of the backend.
	  Disabling this config may result in deadlocks in certain usage
	  scenarios, such as when synchronous IPC is executed from the system
	  workqueue context.
	  The callbacks coming from the backend are executed from the workqueue
	  context.
	  When the option is disabled, the user must obey the restrictions
	  imposed by the system workqueue, such as never performing blocking
	  operations from within the callback.

if IPC_SERVICE_BACKEND_ICMSG_WQ_ENABLE

config IPC_SERVICE_BACKEND_ICMSG_WQ_STACK_SIZE
	int "Size of RX work queue stack"
	default 1024
	help
	  Size of stack used by work queue RX thread. This work queue is
	  created to prevent notifying service users about received data
	  from the system work queue. The queue is shared among instances.

config IPC_SERVICE_BACKEND_ICMSG_WQ_PRIORITY
	int "Priority of RX work queue thread"
	default -1
	range -256 -1
	help
	  Priority of the ICMSG RX work queue thread.
	  The ICMSG library in its simplicity requires the workqueue to execute
	  at a cooperative priority.

endif

# The Icmsg library in its simplicity requires the system workqueue to execute
# at a cooperative priority.
config SYSTEM_WORKQUEUE_PRIORITY
	range -256 -1 if !IPC_SERVICE_BACKEND_ICMSG_WQ_ENABLE

config PBUF
	bool "Packed buffer support library"
	help
	  The packet buffer implements lightweight unidirectional packet buffer
	  with read/write semantics on top of a memory region shared by the
	  reader and writer. It optionally embeds cache and memory barrier
	  management to ensure correct data access.
```

## subsys/ipc/ipc_service_backend/Kconfig.rpmsg_mi
```kconfig
# Copyright (c) 2020-2021 Nordic Semiconductor (ASA)
# SPDX-License-Identifier: Apache-2.0

config IPC_BACKEND_RPMSG_MI_WORK_QUEUE_STACK_SIZE
int "Size of RX work queue stack"
	default 1024
	help
	  Size of stack used by work queue RX thread. This work queue is
	  created in the multi-instance RPMsg backend module to prevent notifying
	  service users about received data from the system work queue.
	  Size is the same for all instances.

config IPC_BACKEND_RPMSG_MI_NUM_ENDPOINTS_PER_INSTANCE
	int "Max number of registered endpoints per instance"
	default 2
	help
	  Maximal number of endpoints that can be registered for one instance.
```

## subsys/ipc/open-amp/Kconfig
```kconfig
#
# Copyright (c) 2020, STMicroelectronics
# Copyright 2025 NXP
#
# SPDX-License-Identifier: Apache-2.0
#

config OPENAMP_RSC_TABLE
	bool "coprocessor resource table"
	imply OPENAMP
	help
	  add the resource table in the generated binary. This table is
	  compatible with linux remote proc framework and OpenAMP library.

config OPENAMP_VENDOR_RSC_TABLE
	bool "Vendor specific resource table"
	depends on OPENAMP_RSC_TABLE
	help
	  Enable vendor-specific resource table with features
	  supported by remote processor.

config OPENAMP_RSC_TABLE_NUM_RPMSG_BUFF
	int "Resource table number of rpmsg buffers"
	default 0
	depends on OPENAMP_RSC_TABLE
	help
	  This option specifies the number of buffer used in a Vring for
	  interprocessor communication

config OPENAMP_RSC_TABLE_IPM_RX_ID
	int "IPM RX channel ID"
	default 0
	depends on OPENAMP_RSC_TABLE
	help
	   This option specifies the IPM RX channel ID used in a VRING
	   for interprocessor communication

config OPENAMP_RSC_TABLE_IPM_TX_ID
	int "IPM TX channel ID"
	default 1
	depends on OPENAMP_RSC_TABLE
	help
	   This option specifies the IPM TX channel ID used in a VRING
	   for interprocessor communication

config OPENAMP_COPY_RSC_TABLE
	bool "Copy resource table section"
	depends on OPENAMP_RSC_TABLE
	help
	  The .resource_table section must be placed in a specific location
	  known by both this core and the remote core. If this is not taken
	  care of by the remote then this firmware has the ability to copy
	  the table to a specific location. This memory region can be declared
	  in the device tree by the "zephyr,ipc_rsc_table" node.

	  This is not needed if the remote loads this firmware and has control
	  over the placement of the .resource_table section such as remoteproc.

config OPENAMP_VENDOR_RSC_TABLE_FILE
	string "Source file containing vendor-specific resource table"
	default "resource_table.c"
	depends on OPENAMP_VENDOR_RSC_TABLE
	help
	  Name of a source file containing vendor-specific
	  resource table.

config OPENAMP_VENDOR_ADDR_TRANSLATION
	bool "Address translation support for OpenAMP"
	depends on OPENAMP_RSC_TABLE
	help
	  Enable support for address translation from remote driver to device

config OPENAMP_VENDOR_ADDR_TRANSLATION_FILE
	string "Header file containing vendor-specific address translation table"
	default "addr_translation.h"
	depends on OPENAMP_VENDOR_ADDR_TRANSLATION
	help
	  Name of a header file containing vendor-specific
	  address translation table.
```

## subsys/ipc/rpmsg_multi_instance/Kconfig
```kconfig
# Copyright (c) 2021 Nordic Semiconductor (ASA)
# SPDX-License-Identifier: Apache-2.0

# Workaround for not being able to have commas in macro arguments
DT_CHOSEN_Z_IPC_SHM := zephyr,ipc_shm

menuconfig RPMSG_MULTI_INSTANCE
	bool "RPMsg multiple instance"
	select IPM
	select OPENAMP
	help
	  Enables support for RPMsg multiple instance.

if RPMSG_MULTI_INSTANCE

choice RPMSG_ROLE
	prompt "RPMSG device role"
	default RPMSG_MULTI_INSTANCE_REMOTE

config RPMSG_MULTI_INSTANCE_REMOTE
	bool "Remote"

config RPMSG_MULTI_INSTANCE_MASTER
	bool "Master"
endchoice

config RPMSG_MULTI_INSTANCES_NO
	int "Number of RPMSG instances."
	default 2
	range 1 8
	help
	  How many instances are to be used.

ipm_name_instance_num = 1
rsource "Kconfig.ipm_name_instance"
ipm_name_instance_num = 2
rsource "Kconfig.ipm_name_instance"
ipm_name_instance_num = 3
rsource "Kconfig.ipm_name_instance"
ipm_name_instance_num = 4
rsource "Kconfig.ipm_name_instance"
ipm_name_instance_num = 5
rsource "Kconfig.ipm_name_instance"
ipm_name_instance_num = 6
rsource "Kconfig.ipm_name_instance"
ipm_name_instance_num = 7
rsource "Kconfig.ipm_name_instance"
ipm_name_instance_num = 8
rsource "Kconfig.ipm_name_instance"

config RPMSG_MULTI_INSTANCE_SHM_BASE_ADDRESS
	hex
	default "$(dt_chosen_reg_addr_hex,$(DT_CHOSEN_Z_IPC_SHM))"
	help
	  This option specifies base address of the memory region to
	  be used for the OpenAMP IPC shared memory.

config RPMSG_MULTI_INSTANCE_SHM_SIZE
	hex
	default "$(dt_chosen_reg_size_hex,$(DT_CHOSEN_Z_IPC_SHM))"
	help
	  This option specifies size of the memory region to be used
	  for the OpenAMP IPC shared memory.

config RPMSG_MULTI_INSTANCE_INIT_PRIORITY
	int "Initialization priority of RPMsg muliple instances"
	default 46
	help
	  If in doubt, do not modify this value.

config IPM_MSG_ID
	int "IPM message identifier."
	default 0
	help
	  Values are constrained by ipm_max_data_size_get since many boards
	  only allow for a subset of bits in a 32-bit register to store the ID.

module = RPMSG_MULTI_INSTANCE
module-str = RPMsg multi instance
source "${ZEPHYR_BASE}/subsys/logging/Kconfig.template.log_config"

endif # RPMSG_MULTI_INSTANCE
```

## subsys/ipc/rpmsg_multi_instance/Kconfig.ipm_name_instance
```kconfig
# Copyright (c) 2021 Nordic Semiconductor (ASA)
# SPDX-License-Identifier: Apache-2.0

config RPMSG_MULTI_INSTANCE_$(ipm_name_instance_num)_IPM_TX_NAME
	string "TX IPM channel name for instance $(ipm_name_instance_num)"
	help
	  This option specifies the IPM device name to be used for
	  TX communication.

config RPMSG_MULTI_INSTANCE_$(ipm_name_instance_num)_IPM_RX_NAME
	string "RX IPM channel name for instance $(ipm_name_instance_num)"
	help
	  This option specifies the IPM device name to be used for
	  RX communication.
```
