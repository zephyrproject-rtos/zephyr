## subsys/input/Kconfig
```kconfig
# Copyright 2023 Google LLC
# SPDX-License-Identifier: Apache-2.0

menuconfig INPUT
	bool "Input"
	help
	  Include input subsystem and drivers in the system config.

if INPUT

module = INPUT
module-str = input
source "subsys/logging/Kconfig.template.log_config"

config INPUT_INIT_PRIORITY
	int "Input subsystem and drivers init priority"
	default 90
	help
	  Input subsystem and drivers initialization priority.

choice INPUT_MODE
	prompt "Input event processing mode"
	default INPUT_MODE_THREAD

config INPUT_MODE_SYNCHRONOUS
	bool "Process input events synchronously"
	help
	  Input events callbacks are processed synchronously in the context of
	  the code that is reporting the event.

config INPUT_MODE_THREAD
	bool "Process input events in a dedicated thread"
	depends on MULTITHREADING
	help
	  Input events are added to a message queue and the callbacks are
	  processed asynchronously in a dedicated thread.

endchoice

if INPUT_MODE_THREAD

config INPUT_THREAD_PRIORITY_OVERRIDE
	bool "Override default input thread priority"
	help
	  Option to change the default value of input thread priority.

if INPUT_THREAD_PRIORITY_OVERRIDE
config INPUT_THREAD_PRIORITY
	int "Input thread priority"
	default 0
	help
	  Set thread priority of the input
endif

config INPUT_QUEUE_MAX_MSGS
	int "Input queue max messages"
	default 16
	help
	  Maximum number of messages in the input event queue.

config INPUT_THREAD_STACK_SIZE
	int "Input thread stack size"
	default 512
	help
	  Stack size for the thread processing the input events, must have
	  enough space for executing the registered callbacks.

endif # INPUT_MODE_THREAD

config INPUT_EVENT_DUMP
	bool "Log all input events"
	depends on LOG
	help
	  Dump all input devents using log info messages, has to be enabled
	  with "input dump on" if INPUT_SHELL is used.

config INPUT_SHELL
	bool "Input shell"
	depends on SHELL
	help
	  Enable the input shell, for interacting with the input subsystem
	  through the shell interface.

config INPUT_LONGPRESS
	bool "Input longpress"
	default y
	depends on DT_HAS_ZEPHYR_INPUT_LONGPRESS_ENABLED
	help
	  Enable the input longpress driver.

config INPUT_KEYMAP
	bool "Input keymap"
	default y
	depends on DT_HAS_INPUT_KEYMAP_ENABLED
	help
	  Enable the input keymap driver.

endif # INPUT
```

## subsys/iommu/Kconfig
```kconfig
# Copyright (c) 2023 Arm Limited (or its affiliates). All rights reserved.
# SPDX-License-Identifier: Apache-2.0

menuconfig IOMMU
	bool "IOMMU"
	help
	  Include iommu subsystem and drivers in the system config.

if IOMMU

module = IOMMU
module-str = iommu
source "subsys/logging/Kconfig.template.log_config"

endif # IOMMU
```

## subsys/ipc/Kconfig
```kconfig
# IPC subsystem configuration options

# Copyright (c) 2021 Nordic Semiconductor
# SPDX-License-Identifier: Apache-2.0

menu "Inter Processor Communication"

source "subsys/ipc/rpmsg_service/Kconfig"
source "subsys/ipc/ipc_service/Kconfig"

endmenu
```

## subsys/ipc/ipc_msg_service/Kconfig
```kconfig
#
# Copyright (c) 2021 Nordic Semiconductor (ASA)
# Copyright (c) 2025 Intel Corporation
#
# SPDX-License-Identifier: Apache-2.0
#

menuconfig IPC_MSG_SERVICE
	bool "IPC message service support multiple backends [EXPERIMENTAL]"
	select EXPERIMENTAL
	help
	  Enables support for a service that can be shared by multiple
	  users. Ability to work in different backends. The backend
	  should be registered before application starts using
	  the IPC Message Service.

if IPC_MSG_SERVICE

rsource "backends/Kconfig"

module = IPC_MSG_SERVICE
module-str = IPC message service and backend
source "subsys/logging/Kconfig.template.log_config"

endif # IPC_MSG_SERVICE
```

## subsys/ipc/ipc_msg_service/backends/Kconfig
```kconfig
#
# Copyright (c) 2021 Nordic Semiconductor (ASA)
# Copyright (c) 2025 Intel Corporation
#
# SPDX-License-Identifier: Apache-2.0
#

config IPC_MSG_SERVICE_REG_BACKEND_PRIORITY
	int "Initialization priority of modules registering IPC message service backend"
	default 46
	help
	  The backend must be registered before the endpoint register.

rsource "Kconfig.intel_adsp"
```

## subsys/ipc/ipc_msg_service/backends/Kconfig.intel_adsp
```kconfig
#
# Copyright (c) 2025 Intel Corporation
#
# SPDX-License-Identifier: Apache-2.0
#

config IPC_MSG_BACKEND_INTEL_ADSP_IPC
	bool "Backend for the Intel Audio DSP IPC"
	default DT_HAS_INTEL_ADSP_HOST_IPC_ENABLED
	help
	  Backend for Intel Audio DSP IPC.

	  Note that this is currently not used SOF as its own driver for this hardware.
```

## subsys/ipc/ipc_service/Kconfig
```kconfig
# Copyright (c) 2021 Nordic Semiconductor (ASA)
# SPDX-License-Identifier: Apache-2.0

menuconfig IPC_SERVICE
	bool "IPC service support multiple backends"
	help
	  Enables support for a service that can be shared by multiple
	  users. Ability to work in different backends. The backend
	  should be registered before application starts using
	  the IPC Service.

if IPC_SERVICE

rsource "backends/Kconfig"

module = IPC_SERVICE
module-str = IPC service and backend
source "subsys/logging/Kconfig.template.log_config"

endif # IPC_SERVICE
```

## subsys/ipc/ipc_service/backends/Kconfig
```kconfig
# Copyright (c) 2021 Nordic Semiconductor (ASA)
# SPDX-License-Identifier: Apache-2.0

config IPC_SERVICE_REG_BACKEND_PRIORITY
	int "Initialization priority of modules registering IPC backend"
	default 46
	help
	  The backend must be registered before the endpoint register.

config IPC_SERVICE_BACKEND_RPMSG
	bool "OpenAMP RPMSG backend with static VRINGs"
	default y
	depends on MBOX
	depends on DT_HAS_ZEPHYR_IPC_OPENAMP_STATIC_VRINGS_ENABLED
	select IPC_SERVICE_RPMSG
	select IPC_SERVICE_STATIC_VRINGS
	select OPENAMP

config IPC_SERVICE_BACKEND_ICMSG
	bool "ICMSG backend with SPSC packet buffer"
	default y
	depends on MBOX
	depends on DT_HAS_ZEPHYR_IPC_ICMSG_ENABLED
	select IPC_SERVICE_ICMSG
	help
	  Chosing this backend results in single endpoint implementation based
	  on circular packet buffer.

config IPC_SERVICE_BACKEND_ICMSG_ME_INITIATOR
	bool "ICMSG backend with multi-endpoint support in initiator role"
	default y
	depends on MBOX
	depends on DT_HAS_ZEPHYR_IPC_ICMSG_ME_INITIATOR_ENABLED
	select IPC_SERVICE_ICMSG_ME
	help
	  Chosing this backend results in multi endpoint implementation based
	  on circular packet buffer. This enables enpoint discovery initiator
	  role.

config IPC_SERVICE_BACKEND_ICMSG_ME_FOLLOWER
	bool "ICMSG backend with multi-endpoint support in follower role"
	default y
	depends on MBOX
	depends on DT_HAS_ZEPHYR_IPC_ICMSG_ME_FOLLOWER_ENABLED
	select IPC_SERVICE_ICMSG_ME
	help
	  Chosing this backend results in multi endpoint implementation based
	  on circular packet buffer. This enables enpoint discovery follower
	  role.

rsource "Kconfig.icmsg_me"
rsource "Kconfig.icbmsg"
rsource "Kconfig.rpmsg"
```

## subsys/ipc/ipc_service/backends/Kconfig.icbmsg
```kconfig
# Copyright (c) 2023 Nordic Semiconductor ASA
# SPDX-License-Identifier: Apache-2.0

menuconfig IPC_SERVICE_BACKEND_ICBMSG
	bool "ICMSG backend with dynamically allocated buffers"
	default y
	depends on MBOX
	depends on DT_HAS_ZEPHYR_IPC_ICBMSG_ENABLED
	select SYS_HASH_FUNC32
	select SYS_HASH_FUNC32_DJB2
	help
	  Choosing this backend results in multi endpoint implementation based
	  on dynamically allocated buffers. References to them are send over
	  ICMsg circular buffer.

if IPC_SERVICE_BACKEND_ICBMSG

config IPC_SERVICE_BACKEND_ICBMSG_NUM_EP
	int "Endpoints count"
	range 1 254
	default 4
	help
	  Number of endpoints supported by the ICBMsg IPC service
	  backend. The number of endpoints are applied to all the instances,
	  so this value should be maximum number among all the instances.

config IPC_SERVICE_BACKEND_ICBMSG_MAX_ACTIVE_COUNT
	int "Maximum number of active buffers"
	range 16 32
	default 16
	help
	  Maximum number of concurrently active buffers in the message queues.

config IPC_SERVICE_BACKEND_ICBMSG_DEINIT
	bool "Support closing and deregistering endpoints"
	help
	  Enable support for closing and deregistering endpoints. Disabled by
	  by default to reduce the code size.

config IPC_SERVICE_BACKEND_ICBMSG_SHELL
	bool "ICBMsg shell commands"
	depends on SHELL
	select STATS
	select STATS_NAMES
	help
	  Enable shell commands for the ICBMsg IPC backend. When enabled,
	  the "icbmsg stats" command prints human-readable IPC statistics.

module = IPC_SERVICE_BACKEND_ICBMSG
module-str = ICMSG backend with separate buffers
module-help = Sets log level for ICMsg backend with buffers
source "subsys/logging/Kconfig.template.log_config"

endif # IPC_SERVICE_BACKEND_ICBMSG
```

## subsys/ipc/ipc_service/backends/Kconfig.icmsg
```kconfig
# Copyright (c) 2022 Nordic Semiconductor ASA
# SPDX-License-Identifier: Apache-2.0

if IPC_SERVICE_BACKEND_ICMSG

config IPC_SERVICE_BACKEND_ICMSG_CB_BUF_SIZE
	int "Size of static callback buffer size"
	range 1 65535
	default 255
	help
	  Size of callback buffer used for processing received data in work
	  queue thread. If you are sure that your application never sends data
	  data bigger than some size, you can safely change this option to
	  reduce RAM consumption in your application.

endif # IPC_SERVICE_BACKEND_ICMSG
```

## subsys/ipc/ipc_service/backends/Kconfig.icmsg_me
```kconfig
# Copyright (c) 2022 Nordic Semiconductor ASA
# SPDX-License-Identifier: Apache-2.0

if IPC_SERVICE_BACKEND_ICMSG_ME_INITIATOR || IPC_SERVICE_BACKEND_ICMSG_ME_FOLLOWER

config IPC_SERVICE_BACKEND_ICMSG_ME_SEND_BUF_SIZE
	int "Size of sending buffer size"
	range 1 $(UINT16_MAX)
	default $(UINT8_MAX)
	help
	  Size of a static buffer used for preparring data to send in sending
	  function. If you are sure that your application never sends data
	  data bigger than some size, you can safely change this option to
	  reduce RAM consumption in your application.

config IPC_SERVICE_BACKEND_ICMSG_ME_NUM_EP
	int "Endpoints number"
	range 1 254
	default 2
	help
	  Number of endpoints supported by the multi endpoint ICMSG library.

config IPC_SERVICE_BACKEND_ICMSG_ME_EP_NAME_LEN
	int "Endpoint name length"
	range 1 252
	default 32
	help
	  Maximal length of a string used to discover endpoints between the
	  initiator and the follower.

endif # IPC_SERVICE_BACKEND_ICMSG_ME_INITIATOR || IPC_SERVICE_BACKEND_ICMSG_ME_FOLLOWER
```

## subsys/ipc/ipc_service/backends/Kconfig.intel_adsp
```kconfig
#
# Copyright (c) 2025 Intel Corporation
#
# SPDX-License-Identifier: Apache-2.0
#

config IPC_SERVICE_BACKEND_INTEL_ADSP_HOST_IPC
	bool "Backend for the Intel Audio DSP Host IPC"
	default DT_HAS_INTEL_ADSP_HOST_IPC_ENABLED
	help
	  IPC Service Backend for Intel Audio DSP Host IPC.
```

## subsys/ipc/ipc_service/backends/Kconfig.ipm_name_instance
```kconfig
# Copyright (c) 2021 Nordic Semiconductor (ASA)
# SPDX-License-Identifier: Apache-2.0

config IPC_SERVICE_BACKEND_RPMSG_MI_$(ipm_name_instance_num)_IPM_TX_NAME
	string "TX IPM channel name for instance $(ipm_name_instance_num)"
	help
	  This option specifies the IPM device name to be used for
	  TX communication.

config IPC_SERVICE_BACKEND_RPMSG_MI_$(ipm_name_instance_num)_IPM_RX_NAME
	string "RX IPM channel name for instance $(ipm_name_instance_num)"
	help
	  This option specifies the IPM device name to be used for
	  RX communication.
```

## subsys/ipc/ipc_service/backends/Kconfig.rpmsg
```kconfig
# Copyright (c) 2021 Carlo Caione <ccaione@baylibre.com>
# SPDX-License-Identifier: Apache-2.0

if IPC_SERVICE_BACKEND_RPMSG

config IPC_SERVICE_BACKEND_RPMSG_WQ_STACK_SIZE
	int "Size of RX work queue stack"
	default 1024
	help
	  Size of stack used by work queue RX thread. This work queue is
	  created in the multi-instance / multi-core RPMsg backend module to
	  prevent notifying service users about received data from the system
	  work queue. Size is the same for all instances.

config IPC_SERVICE_BACKEND_RPMSG_SHMEM_RESET
	bool "Reset shared memory state"
	help
	  Some platforms retain the memory content upon reset. This is
	  problematic because the backend expects a zero-ed memory to be
	  able to correctly setup instances and endpoints at init time.
	  When this parameter is set to 'y' the status region of the shared
	  memory is reset on kernel initialization.

config IPC_SERVICE_BACKEND_RPMSG_NUM_ENDPOINTS_PER_INSTANCE
	int "Max number of registered endpoints per instance"
	default 2
	help
	  Maximal number of endpoints that can be registered for one instance
	  for RPMSG backend.

endif # IPC_SERVICE_BACKEND_RPMSG
```

## subsys/ipc/ipc_service/backends/Kconfig.rpmsg-lite
```kconfig
#
# Copyright 2026 NXP
#
# SPDX-License-Identifier: Apache-2.0
#

if IPC_SERVICE_BACKEND_RPMSG_LITE

config IPC_SERVICE_BACKEND_RPMSG_LITE_WQ_STACK_SIZE
	int "Size of RX work queue stack"
	default 1024
	help
	  Size of stack used by work queue RX thread. This work queue is
	  created in the multi-instance / multi-core RPMSG-Lite backend module to
	  prevent notifying service users about received data from the system
	  work queue. Size is the same for all instances.

config IPC_SERVICE_BACKEND_RPMSG_LITE_NUM_ENDPOINTS_PER_INSTANCE
	int "Max number of registered endpoints per instance"
	default 2
	help
	  Maximal number of endpoints that can be registered for one instance
	  for RPMSG-Lite backend.

choice IPC_SERVICE_BACKEND_RPMSG_LITE_NOTIFY_MODE
	prompt "MBOX notification processing mode"
	default IPC_SERVICE_BACKEND_RPMSG_LITE_NOTIFY_DIRECT
	help
	  Select how MBOX notifications are processed.

config IPC_SERVICE_BACKEND_RPMSG_LITE_NOTIFY_QUEUE
	bool "Queue-based notification (more reliable)"
	help
	  Use message queue to buffer incoming MBOX notifications.
	  This significantly reduces the risk of lost notifications
	  during high message rates by queuing up to 4 pending signals.

	  Pros:
	  - Greatly reduced notification loss (not eliminated)
	  - Better handling of burst traffic
	  - More predictable behavior under load

	  Cons:
	  - Slightly higher latency (~5-15%)
	  - Additional RAM: 40 bytes per IPC instance
	  - Extra k_msgq overhead

config IPC_SERVICE_BACKEND_RPMSG_LITE_NOTIFY_DIRECT
	bool "Direct notification (lower latency)"
	help
	  Store only the latest notification without queuing.
	  This minimizes latency and RAM usage but notifications
	  can be lost if multiple MBOX interrupts arrive before
	  the work handler runs.

	  Pros:
	  - Lowest possible latency
	  - Minimal RAM usage (4 bytes vs 44 bytes)
	  - Simpler code path

	  Cons:
	  - Higher notification loss under heavy load
	  - Only latest notification preserved
	  - May coalesce multiple signals into one

	  Recommended for low-to-moderate traffic where latency
	  is critical and occasional notification loss is acceptable.

endchoice

endif # IPC_SERVICE_BACKEND_RPMSG_LITE
```
