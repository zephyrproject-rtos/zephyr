## subsys/dfu/Kconfig
```kconfig
# DFU support configuration options

# Copyright (c) 2017 Nordic Semiconductor ASA
# SPDX-License-Identifier: Apache-2.0

#
# DFU
#

menuconfig IMG_MANAGER
	bool "DFU image manager"
	depends on STREAM_FLASH
	help
	  Enable support for managing DFU image.

if IMG_MANAGER

choice
	prompt "Image manager"
	default MCUBOOT_IMG_MANAGER
	help
	  Choice support for managing DFU image.
	  So far only mcuboot support is available.

config MCUBOOT_IMG_MANAGER
	bool "Image manager for mcuboot"
	depends on FLASH_MAP
	select MCUBOOT_BOOTUTIL_LIB
	help
	  Enable support for managing DFU image downloaded using mcuboot.

endchoice

if MCUBOOT_IMG_MANAGER

config MCUBOOT_SHELL
	bool "MCUboot shell"
	depends on SHELL
	help
	  Enable shell module, which provides information about image slots and
	  allows to perform such operations as: confirm, erase and request
	  upgrade.

config MCUBOOT_TRAILER_SWAP_TYPE
	bool "use trailer's swap_type field"
	default y
	help
	  Enables usage swap type field which is required after
	  "Fix double swap on interrupted revert"  mcuboot patch
	  (https://github.com/JuulLabs-OSS/mcuboot/pull/485)
	  Disable this option if need to be compatible with earlier version
	  of MCUBoot.

config MCUBOOT_UPDATE_FOOTER_SIZE
	hex "Estimated update footer size"
	default 0x0
	help
	  Estimated size of update image data, which is used to prevent loading of firmware updates
	  that MCUboot cannot update due to being too large. This should be set from sysbuild, only
	  used when MCUMGR_GRP_IMG_TOO_LARGE_SYSBUILD is enabled.

config IMG_BLOCK_BUF_SIZE
	int "Image writer buffer size"
	default 512
	help
	  Size (in Bytes) of buffer for image writer. Must be a multiple of
	  the access alignment required by used flash driver.

config IMG_ERASE_PROGRESSIVELY
	bool "Erase flash progressively when receiving new firmware"
	select STREAM_FLASH_ERASE
	depends on FLASH_HAS_EXPLICIT_ERASE
	help
	  If enabled, flash is erased as necessary when receiving new firmware,
	  instead of erasing the whole image slot at once. This is necessary
	  on some hardware that has long erase times, to prevent long wait
	  times at the beginning of the DFU process.

config IMG_ENABLE_IMAGE_CHECK
	bool "Image check functions"
	select FLASH_AREA_CHECK_INTEGRITY
	help
	  If enabled, there will be available the function to check flash
	  integrity.  It can be used to verify flash integrity after received
	  a new firmware.  This is useful to avoid firmware reboot and test.
	  Another use is to ensure that firmware upgrade routines from internet
	  server to flash slot are performing properly.

endif # MCUBOOT_IMG_MANAGER

module = IMG_MANAGER
module-str = image manager
source "subsys/logging/Kconfig.template.log_config"

if !MCUBOOT
config UPDATEABLE_IMAGE_NUMBER
	int "Number of updateable images"
	default 1
	range 1 3
	help
	  If value is set to 2 or greater then, this enables support needed when
	  application is combined with MCUboot multi-image boot.
endif

endif # IMG_MANAGER
```

## subsys/dmx/Kconfig
```kconfig
# SPDX-FileCopyrightText: Copyright (c) 2026 Perry Naseck, MIT Media Lab <pnaseck@media.mit.edu>
# SPDX-License-Identifier: Apache-2.0

menuconfig DMX
	bool "DMX512-A support"
	help
	  Enable support for the ANSI E1.11 DMX512-A protocol.

if DMX

config DMX_RX_BUF_SIZE
	int "Default RX packet buffer size in bytes"
	default 2048
	range 256 8192
	help
	  Size of the per-interface SPSC ring buffer used for received
	  DMX frames. Each buffered frame uses approximately
	  9 + slot_count bytes (plus ring buffer overhead). With the
	  default of 2048 bytes, roughly 3 full-universe frames can
	  be buffered simultaneously.

config DMX_INIT_PRIORITY
	int "DMX device init priority"
	default 90
	help
	  Initialization priority for DMX devices. Must be after the
	  UART / PIO drivers they depend on.

config DMX_UART_ISR
	bool "DMX over UART (interrupt-driven, byte-by-byte)"
	default y
	depends on SERIAL && SERIAL_HAS_DRIVER && UART_INTERRUPT_DRIVEN
	depends on DT_HAS_ZEPHYR_DMX_UART_ISR_ENABLED
	imply UART_USE_RUNTIME_CONFIGURE
	help
	  Enable DMX512 reception using a standard UART peripheral with
	  interrupt-driven byte-by-byte reception. Break conditions are
	  detected via framing-error reporting in the UART IRQ callback,
	  making this backend portable across all platforms with
	  interrupt-driven UART support.

module = DMX
module-str = DMX512
module-help = Sets log level for DMX512 subsystem
source "subsys/logging/Kconfig.template.log_config"

endif # DMX
```

## subsys/dsp/Kconfig
```kconfig
# Copyright (c) 2022 Google LLC
# SPDX-License-Identifier: Apache-2.0

menuconfig DSP
	bool "DSP subsystem"
	help
	  Include the DSP (Digital Signal Processing) subsystem as a part of the
	  Zephyr build. This enables applications to include and call into the
	  <zephyr/dsp/dsp.h> header.

if DSP

config DSP_BACKEND_HAS_STATIC
	bool

choice DSP_BACKEND
	prompt "DSP library backend selection"
	default DSP_BACKEND_CMSIS if CMSIS_DSP
	default DSP_BACKEND_CUSTOM

config DSP_BACKEND_CMSIS
	bool "Use the CMSIS-DSP library as the math backend"
	depends on CMSIS_DSP
	select DSP_BACKEND_HAS_STATIC
	help
	  Implement the various zephyr DSP functions using the CMSIS-DSP library. This feature
	  requires the CMSIS module to be selected.

config DSP_BACKEND_CUSTOM
	bool "Do not use any Zephyr backends for DSP"
	help
	  Rely on the application to provide a custom DSP backend. The implementation should be
	  added to the 'zdsp' build target by the application or one of its modules.

endchoice

endif # DSP
```

## subsys/ebpf/Kconfig
```kconfig
# SPDX-FileCopyrightText: Copyright 2026 NXP
# SPDX-License-Identifier: Apache-2.0

menuconfig EBPF
	bool "eBPF (extended Berkeley Packet Filter) subsystem"
	help
	  Enable the eBPF subsystem for kernel observability.
	  Provides a lightweight bytecode interpreter with tracepoint
	  attachment for runtime-programmable kernel instrumentation.

if EBPF

config EBPF_STACK_SIZE
	int "Per-program stack size (bytes)"
	default 512
	range 128 4096
	help
	  Size of the stack available to each eBPF program invocation.
	  Allocated on the calling thread's kernel stack.

config EBPF_MAX_PROG_INSNS
	int "Maximum instructions per program"
	default 4096
	range 64 65536
	help
	  Maximum number of instructions allowed in a single eBPF program.
	  Programs exceeding this limit will fail verification.

config EBPF_MAX_INSNS_PER_RUN
	int "Maximum instructions executed per invocation"
	default 4096
	range 256 65536
	help
	  Safety limit on the number of instructions executed in a single
	  eBPF program run. Prevents infinite loops.

config EBPF_RUNTIME_BOUNDS_CHECK
	bool "Runtime memory bounds checking"
	default y
	help
	  Enable runtime validation of all memory accesses from eBPF
	  programs. This adds overhead but prevents wild pointer access.
	  Recommended for development; can be disabled for production
	  on verified programs.

config EBPF_TRACING
	bool "eBPF tracing integration"
	default y if TRACING_CUSTOM
	depends on TRACING_CUSTOM
	select INSTRUMENT_THREAD_SWITCHING
	help
	  Integrate eBPF programs with the Zephyr tracing subsystem.
	  This enables attaching eBPF programs to kernel tracepoints
	  such as context switches, syscalls, and scheduler events.
	  This requires CONFIG_TRACING=y and CONFIG_TRACING_CUSTOM=y.

config EBPF_SHELL
	bool "eBPF shell commands"
	default y
	depends on SHELL
	help
	  Enable shell commands for listing, enabling, disabling eBPF
	  programs and dumping map contents at runtime.

config EBPF_STATS
	bool "eBPF program execution statistics"
	default y
	help
	  Track per-program execution count and cumulative run time.
	  Accessible via the shell 'ebpf stats' command.

rsource "Kconfig.maps"
rsource "Kconfig.progs"

module = EBPF
module-str = ebpf
module-help = Sets log level for eBPF subsystem
source "subsys/logging/Kconfig.template.log_config"

endif # EBPF
```

## subsys/ebpf/Kconfig.maps
```kconfig
# SPDX-FileCopyrightText: Copyright 2026 NXP
# SPDX-License-Identifier: Apache-2.0

config EBPF_MAP_HASH
	bool "Hash map support"
	default y
	depends on EBPF
	help
	  Enable the hash map type for eBPF programs.

config EBPF_MAP_ARRAY
	bool "Array map support"
	default y
	depends on EBPF
	help
	  Enable the array map type for eBPF programs.
	  Array maps are always available as a basic requirement.

config EBPF_MAP_RINGBUF
	bool "Ring buffer map support"
	default y
	depends on EBPF
	select RING_BUFFER
	help
	  Enable the ring buffer map type for event output.

config EBPF_MAP_PER_CPU_ARRAY
	bool "Per-CPU array map support"
	default y
	depends on EBPF && SMP
	help
	  Enable per-CPU array maps. Only available on SMP systems.
```

## subsys/ebpf/Kconfig.progs
```kconfig
# SPDX-FileCopyrightText: Copyright 2026 NXP
# SPDX-License-Identifier: Apache-2.0

config EBPF_TRACEPOINT_PROGS
	bool "Tracepoint programs"
	default y
	depends on EBPF
	help
	  Enable support for TRACEPOINT-class eBPF programs that attach
	  to kernel trace macros.

config EBPF_SCHED_PROGS
	bool "Scheduler programs"
	default y
	depends on EBPF
	help
	  Enable support for scheduler-oriented eBPF programs used for
	  context switch and scheduler events.

config EBPF_SYSCALL_PROGS
	bool "Syscall programs"
	default y
	depends on EBPF && TRACING_SYSCALL
	help
	  Enable support for syscall-oriented eBPF programs used for
	  syscall entry and exit tracing.

config EBPF_ISR_PROGS
	bool "ISR programs"
	default y
	depends on EBPF && TRACING_ISR
	help
	  Enable support for ISR-oriented eBPF programs used for
	  interrupt entry and exit tracing.
```

## subsys/elfloader/Kconfig
```kconfig
# Copyright (c) 2022 Intel Corporation
# SPDX-License-Identifier: Apache-2.0

menuconfig DYNAMIC_MODULE
	bool "Dynamic module loading"
	depends on FILE_SYSTEM
	depends on HEAP_MEM_POOL_SIZE > 0
	help
	  Enable dynamic module loading

if DYNAMIC_MODULE

config DYNAMIC_MODULE_MEM_SIZE
	int "Module memory size in kilobytes"
	default 1024
	help
	  Memory size used to load dynamic modules

endif
```

## subsys/emul/Kconfig
```kconfig
# Emulator configuration options

# Copyright 2020 Google LLC
# SPDX-License-Identifier: Apache-2.0

#
# Emulator options
#
menuconfig EMUL
	bool "Emulation drivers"
	help
	  Enable Emulation Driver Configuration
	  These drivers are used to emulate hardware devices, to support testing
	  of various subsystems. For example, it is possible to write an
	  emulator for an I2C compass such that it appears on the I2C bus and
	  can be used just like a real hardware device.

	  Emulators often implement special features for testing. For example
	  a compass may support returning bogus data if the I2C bus speed is
	  too high, or may return invalid measurements if calibration has not
	  yet been completed. This allows for testing that high-level code can
	  handle these situations correctly. Test coverage can therefore
	  approach 100% if all failure conditions are emulated.

if EMUL

config EMUL_INIT_PRIORITY
	int "Init priority"
	default 60
	help
	  Emulation device driver initialisation priority.

module = EMUL
module-str = emul
source "subsys/logging/Kconfig.template.log_config"

config EMUL_BMI160
	bool "Emulate a Bosch BMI160 accelerometer"
	help
	  This is an emulator for the Bosch BMI160 accelerometer.

	  It provides readings which follow a simple sequence, thus allowing
	  test code to check that things are working as expected.

	  It supports both I2C and SPI which is why it is not in one of the
	  i2c/ or spi/ directories.

config EMUL_SBS_GAUGE
	bool "Emulate an SBS 1.1 compliant smart battery fuel gauge"
	help
	  It provides readings which follow a simple sequence, thus allowing
	  test code to check that things are working as expected.

source "subsys/emul/i2c/Kconfig"
source "subsys/emul/espi/Kconfig"

endif
```

## subsys/emul/espi/Kconfig
```kconfig
# Configuration options for eSPI emulators

# Copyright 2020 Google LLC
# SPDX-License-Identifier: Apache-2.0

config EMUL_ESPI_HOST
	bool "Emulate an eSPI host"
	help
	  This is an emulator of the generic eSPI host. The emulator supports basic host operations
	  - virtual wires and writing to port 80. It can be extended. Note: Because this emulator is
	  not tied to a particular DT node, it does not make use of the DT_HAS_<compat>_ENABLED
	  macro.

if EMUL_ESPI_HOST

config EMUL_ESPI_HOST_ACPI_SHM_REGION_SIZE
	int "Host I/O peripheral port size for shared memory in emulator"
	depends on ESPI_PERIPHERAL_ACPI_SHM_REGION
	default 256
	help
	  This is the port size used to mimic the Host and EC communication
	  over the shared memory region which returns the ACPI response data.

endif # EMUL_ESPI_HOST
```

## subsys/emul/i2c/Kconfig
```kconfig
# Configuration options for I2C emulators

# Copyright 2020 Google LLC
# SPDX-License-Identifier: Apache-2.0

config EMUL_EEPROM_AT2X
	bool "Emulate an Atmel AT24 I2C chip"
	help
	  This is an emulator for the Atmel AT24 series of I2C-attached EEPROMs.

	  At present it only supports 8-bit addressing. The size of the EEPROM
	  is given by the 'size' property. See the binding for further details.
```

## subsys/event_manager/Kconfig
```kconfig
#
# Copyright (c) 2021 Nordic Semiconductor
#
# SPDX-License-Identifier: Apache-2.0
#

menuconfig EVENT_MANAGER
	bool
	prompt "Event Manager"
	depends on LINKER_ORPHAN_SECTION_PLACE
	help
	  Enable Event Manager.
	  Note that Event Manager uses orphan sections to handle its
	  data structures.

if EVENT_MANAGER

config EVENT_MANAGER_SHOW_EVENTS
	bool "Show events"
	depends on LOG
	default y
	help
	  This option controls if events are printed to console.

config EVENT_MANAGER_SHOW_EVENT_HANDLERS
	bool "Show event handlers"
	depends on EVENT_MANAGER_SHOW_EVENTS
	help
	  This option controls if event handlers are printed to console.

module = EVENT_MANAGER
module-str = Event Manager
source "${ZEPHYR_BASE}/subsys/logging/Kconfig.template.log_config"

config EVENT_MANAGER_EVENT_LOG_BUF_LEN
	int "Length of buffer for processing event message"
	default 128
	range 2 1024

config EVENT_MANAGER_LOG_EVENT_TYPE
	bool "Include event type in the event log output"
	default y

config EVENT_MANAGER_MAX_EVENT_CNT
	int "Maximum number of event types"
	default 32
	help
	  Maximum number of declared event types in Event Manager.

config EVENT_MANAGER_PROFILER_TRACER
	bool "Create void pointer for each event type, which can be used for profiling"
	default n

endif # EVENT_MANAGER
```
