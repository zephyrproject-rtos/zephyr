## subsys/debug/coredump/Kconfig
```kconfig
# Copyright (c) 2020 Intel Corporation.
# SPDX-License-Identifier: Apache-2.0

menuconfig DEBUG_COREDUMP
	bool "Core Dump"
	depends on ARCH_SUPPORTS_COREDUMP
	help
	  Enable core dump so it can be used for offline debugging.

if DEBUG_COREDUMP

choice DEBUG_COREDUMP_BACKEND
	prompt "Coredump backend"
	default DEBUG_COREDUMP_BACKEND_LOGGING

config DEBUG_COREDUMP_BACKEND_LOGGING
	bool "Use Logging subsystem for coredump"
	select LOG
	help
	  Core dump is done via logging subsystem.

config DEBUG_COREDUMP_BACKEND_FLASH_PARTITION
	bool "Use flash partition for coredump"
	depends on FLASH
	select FLASH_MAP
	select STREAM_FLASH
	help
	  Core dump is saved to a flash partition with DTS alias
	  "coredump-partition".

config DEBUG_COREDUMP_BACKEND_IN_MEMORY
	bool "Use memory to store the coredump"
	help
	  Core dump (or part of it) is saved in a dedicated area in
	  memory. Such memory is protected at boot time so it could be
	  read after a warm reboot. This is obviously NOT a valid solution
	  when a full hardware reboot cycle occurs (on/off etc..) where
	  the RAM will most likely loose its data.
	  See DEBUG_COREDUMP_BACKEND_IN_MEMORY_SIZE on how much space to
	  reserve.

config DEBUG_COREDUMP_BACKEND_INTEL_ADSP_MEM_WINDOW
	bool "Use memory window for coredump on Intel ADSP"
	depends on DT_HAS_INTEL_ADSP_MEM_WINDOW_ENABLED
	help
	  Core dump is done via memory window slot[1].
	  It is Intel ADSP memory region shared with xtensa DSP.
	  Window 2 slot [1] is reserved for debuging information.

config DEBUG_COREDUMP_BACKEND_OTHER
	bool "Backend subsystem for coredump defined out of tree"
	help
	  Core dump is done via custom mechanism defined out of tree

endchoice

choice DEBUG_COREDUMP_MEMORY_DUMP
	prompt "Memory dump"
	default DEBUG_COREDUMP_MEMORY_DUMP_LINKER_RAM

config DEBUG_COREDUMP_MEMORY_DUMP_MIN
	bool "Minimal"
	select THREAD_STACK_INFO
	help
	  Only dumps the bare minimum memory content.
	  For example, the thread struct and stack of
	  the exception thread will be dumped.

	  Don't use this unless you want absolutely
	  minimum core dump.

config DEBUG_COREDUMP_MEMORY_DUMP_THREADS
	bool "Threads"
	depends on !SMP
	depends on ARCH_SUPPORTS_COREDUMP_THREADS
	select THREAD_STACK_INFO
	select DEBUG_THREAD_INFO
	select DEBUG_COREDUMP_THREADS_METADATA
	help
	  Dumps the thread struct and stack of all
	  threads and all data required to debug threads.

config DEBUG_COREDUMP_MEMORY_DUMP_LINKER_RAM
	bool "RAM defined by linker section"
	help
	  Dumps the memory region between _image_ram_start[]
	  and _image_ram_end[]. This includes at least data,
	  noinit, and BSS sections.

	  This is the default.

endchoice

if DEBUG_COREDUMP_BACKEND_FLASH_PARTITION

config DEBUG_COREDUMP_FLASH_CHUNK_SIZE
	int "Chunk size for flash write operations"
	default 64
	help
	  Larger values can speed up writing due to fewer write operations
	  being performed in total, but consume more memory.


endif # DEBUG_COREDUMP_BACKEND_FLASH_PARTITION

config DEBUG_COREDUMP_SHELL
	bool "Coredump shell"
	depends on SHELL
	help
	  This shell provides access to coredump and its backends.

config DEBUG_COREDUMP_THREADS_METADATA
	bool "Threads metadata"
	depends on !SMP
	depends on ARCH_SUPPORTS_COREDUMP_THREADS
	select DEBUG_THREAD_INFO
	help
	  Core dump will contain the threads metadata section containing
	  any necessary data to enable debugging threads

config DEBUG_COREDUMP_DUMP_THREAD_PRIV_STACK
	bool "Dump privilege stack of user threads"
	default y
	depends on ARCH_SUPPORTS_COREDUMP_PRIV_STACKS
	depends on USERSPACE
	help
	  Dump the privilege stack of user threads.

	  Say n to conserve space on coredump backend or if you will never
	  need to look into the privilege stacks.

config DEBUG_COREDUMP_BACKEND_IN_MEMORY_SIZE
	int "In-memory coredump size"
	default 128
	depends on DEBUG_COREDUMP_BACKEND_IN_MEMORY
	help
	  Sets the dedicated memory area where a coredump can be stored
	  and accessed after a warm reboot. It has to be able to hold at
	  least the info dumped by arch_coredump_info_dump().
	  Extra memory region will silently be ignored if there isn't
	  enough space.

module = DEBUG_COREDUMP
module-str = coredump
source "subsys/logging/Kconfig.template.log_config"

endif # DEBUG_COREDUMP
```

## subsys/debug/dap/Kconfig
```kconfig
# Kconfig - cmsis dap controller configuration options

#
# Copyright (c) 2018-2019 PHYTEC Messtechnik GmbH
#
# SPDX-License-Identifier: Apache-2.0
#

menuconfig CMSIS_DAP
	bool "CMSIS DAP compatible controller"
	default n
	select SWD_DRIVER
	help
	  Enable CMSIS DAP.

if CMSIS_DAP

config CMSIS_DAP_PACKET_COUNT
	int "Maximum packet buffers for request and response data."
	default 4
	range 1 255
	help
	  Maximum packet buffers for request and response data.

config CMSIS_DAP_STACK_SIZE
	int "DAP controller thread stack size"
	default 512
	help
	  Thread stack size

config CMSIS_DAP_USB_HID_INTERFACE
	bool "Enable USB HID interface"
	depends on USB_DEVICE_DRIVER
	default y
	help
	  Enable USB HID interface to host.

config CMSIS_DAP_USB_HID_DEVICE_NAME
	string "USB HID device name"
	depends on CMSIS_DAP_USB_HID_INTERFACE
	default "HID_0"
	help
	  USB HID device name

config CMSIS_DAP_USB_HID_STACK_SIZE
	int "DAP USB HID interface thread stack size"
	depends on CMSIS_DAP_USB_HID_INTERFACE
	default 512
	help
	  Thread stack size

module = CMSIS_DAP
module-str = cmsis dap
source "subsys/logging/Kconfig.template.log_config"

endif # CMSIS_DAP
```

## subsys/debug/debugpoint/Kconfig
```kconfig
# Copyright (c) Qualcomm Technologies, Inc. and/or its subsidiaries.
# SPDX-License-Identifier: Apache-2.0

config DEBUGPOINT
	bool
	depends on ARCH_HAS_DEBUGPOINT
	depends on MULTITHREADING
	depends on !SMP || SCHED_IPI_SUPPORTED
	depends on !SMP_BOOT_DELAY
	help
	  Internal hardware debugpoint framework.

config DEBUGPOINT_MAX_SLOTS
	int "Maximum number of logical debugpoints"
	default 4
	range 1 32
	depends on DEBUGPOINT
	help
	  Maximum number of debugpoints tracked by the generic core.
	  Backends may use this to size per-CPU state and may provide fewer
	  usable hardware slots.
```

## subsys/debug/gdbstub/Kconfig
```kconfig
# Copyright (c) 2020 Intel Corporation.
# SPDX-License-Identifier: Apache-2.0

menuconfig GDBSTUB
	bool "GDB remote serial protocol support [EXPERIMENTAL]"
	depends on ARCH_HAS_GDBSTUB
	select UART_USE_RUNTIME_CONFIGURE
	select EXPERIMENTAL
	help
	  This option enable support the target using GDB, or any other
	  application that supports GDB protocol.

if GDBSTUB

choice
	prompt "GDB backend"

config GDBSTUB_SERIAL_BACKEND
	bool "Use serial backend"
	depends on SERIAL
	help
	  Use serial as backend for GDB

config GDBSTUB_CUSTOM_BACKEND
	bool "Use a custom backend"
	help
	  Use a custom backend for GDB

endchoice

config GDBSTUB_BUF_SZ
	int "GDB backend send/receive buffer size (in bytes)"
	default 256
	help
	  This specifies the size (in bytes) of the send/receive buffer
	  for GDB backend. This needs to be big enough to hold one
	  full GDB packet at a time.

config GDBSTUB_TRACE
	bool "GDB backend extra logging"
	help
	  Enable extra debug logging for the GDB backend, including
	  breakpoint interrupts and remote commands it receives.

endif # GDBSTUB
```

## subsys/debug/symtab/Kconfig
```kconfig
# Copyright (c) 2024 Meta Platforms
# SPDX-License-Identifier: Apache-2.0

config SYMTAB
	bool "Generate symbol table"
	help
	  Generate the symbol table with the offset and name of every
	  function.
	  The symbol table can be accessed by including the
	  <zephyr/debug/symtab.h> header.

	  Choose N if you have no idea what is this.

if SYMTAB

config SYMTAB_SHELL
	bool "Symbol table shell commands"
	depends on SHELL
	help
	  Shell commands to access the symbol table.

endif # SYMTAB
```

## subsys/debug/thread_analyzer/Kconfig
```kconfig
# Thread analyzer configuration options

# Copyright (c) 2015 Wind River Systems, Inc.
# SPDX-License-Identifier: Apache-2.0

menuconfig THREAD_ANALYZER
	bool "Thread analyzer"
	depends on !ARCH_POSIX
	select INIT_STACKS
	select THREAD_MONITOR
	select THREAD_STACK_INFO
	select THREAD_RUNTIME_STATS
	help
	  Enable thread analyzer functionality and all the required modules.
	  This module may be used to debug thread configuration issues, e.g.
	  stack size configuration to find stack overflow or to find stacks
	  which may be optimized.

if THREAD_ANALYZER
module = THREAD_ANALYZER
module-str = thread analyzer
source "subsys/logging/Kconfig.template.log_config"

choice
	prompt "Thread analysis print mode"
	default THREAD_ANALYZER_USE_PRINTK

config THREAD_ANALYZER_USE_LOG
	bool "Use logger output"
	select LOG
	help
	  Use logger output to print thread information.

config THREAD_ANALYZER_USE_PRINTK
	bool "Use printk function"
	help
	  Use kernel printk function to print thread information.

endchoice

config THREAD_ANALYZER_ISR_STACK_USAGE
	bool "Analyze interrupt stacks usage"
	default y

config THREAD_ANALYZER_PRIV_STACK_USAGE
	bool "Analyze privileged stacks usage"
	depends on USERSPACE
	depends on ARCH_HAS_THREAD_PRIV_STACK_SPACE_GET
	help
	  Print privileged stack usage for user threads.

config THREAD_ANALYZER_RUN_UNLOCKED
	bool "Run analysis with interrupts unlocked"
	default y
	help
	  The thread analysis takes quite a long time.
	  Every thread it finds is analyzed word by word to find any that
	  does not match the magic number.
	  Normally while thread are analyzed the k_thread_foreach function
	  is used.
	  While this is a safe run from the thread list perspective it may lock
	  the interrupts for a long time - long enough to disconnect when
	  Bluetooth communication is used.
	  Setting this flag will force thread analyzer to use
	  the k_thread_foreach_unlocked function.
	  This will allow the interrupts to be processed while the thread is
	  analyzed.
	  For the limitation of such configuration see the k_thread_foreach
	  documentation.

config THREAD_ANALYZER_AUTO
	bool "Run periodic thread analysis in a thread"
	help
	  Run the thread analyzer automatically, without the need to add
	  any code to the application.
	  Thread analysis would be called periodically.

if THREAD_ANALYZER_AUTO

config THREAD_ANALYZER_AUTO_SEPARATE_CORES
	bool "Run thread analyzer separately on each core"
	default y if KERNEL_COHERENCE
	depends on SCHED_CPU_MASK
	help
	  Run the thread analyzer auto thread on each core and report
	  cores separately. This feature is needed for platforms running
	  on cache-incoherent architectures.

config THREAD_ANALYZER_AUTO_INTERVAL
	int "Thread analysis interval"
	default 60
	range 5 3600
	help
	  The time in seconds to call thread analyzer periodic printing function.

config THREAD_ANALYZER_AUTO_STACK_SIZE
	int "Stack size for the periodic thread analysis thread"
	default 2048 if THREAD_ANALYZER_USE_LOG && LOG_MODE_IMMEDIATE && NO_OPTIMIZATIONS
	default 1024

config THREAD_ANALYZER_AUTO_THREAD_PRIORITY_OVERRIDE
	bool "Override default thread analysis thread priority"
	help
	  Option to change the default value of thread analysis thread priority.

if THREAD_ANALYZER_AUTO_THREAD_PRIORITY_OVERRIDE
config THREAD_ANALYZER_AUTO_THREAD_PRIORITY
	int "Thread analysis thread priority"
	default 0
	help
	  Set thread priority of the thread analysis
endif # THREAD_ANALYZER_AUTO_THREAD_PRIORITY_OVERRIDE

endif # THREAD_ANALYZER_AUTO

endif # THREAD_ANALYZER
```

## subsys/debug/watchpoint/Kconfig
```kconfig
# Copyright (c) Qualcomm Technologies, Inc. and/or its subsidiaries.
# SPDX-License-Identifier: Apache-2.0

menuconfig WATCHPOINT
	bool "Memory watchpoints [EXPERIMENTAL]"
	depends on MULTITHREADING
	depends on ARCH_HAS_WATCHPOINT
	depends on !SMP || SCHED_IPI_SUPPORTED
	depends on !SMP_BOOT_DELAY
	select DEBUGPOINT
	select EXPERIMENTAL
	help
	  Enable callbacks for monitored memory reads and writes. Events report
	  the triggering PC and, when available, the accessed address.

	  Watchpoints use on-chip debug resources and are limited by the
	  capabilities and number of comparators provided by each CPU.

if WATCHPOINT

config WATCHPOINT_CALLSTACK
	bool "Capture call stack on watchpoint hit"
	depends on ARCH_STACKWALK
	help
	  Capture a bounded call stack when a watchpoint fires and expose it
	  through the watchpoint callback event.

config WATCHPOINT_CALLSTACK_DEPTH
	int "Maximum watchpoint call stack depth"
	default 8
	range 1 32
	depends on WATCHPOINT_CALLSTACK
	help
	  Maximum number of return addresses captured for each watchpoint hit.

endif # WATCHPOINT
```

## subsys/demand_paging/Kconfig
```kconfig
# Copyright (c) 2020 Intel Corporation
# SPDX-License-Identifier: Apache-2.0

menu "Demand Paging modules"
	depends on DEMAND_PAGING

source "subsys/demand_paging/eviction/Kconfig"

source "subsys/demand_paging/backing_store/Kconfig"

endmenu
```

## subsys/demand_paging/backing_store/Kconfig
```kconfig
# Copyright (c) 2020 Intel Corporation
# SPDX-License-Identifier: Apache-2.0

choice BACKING_STORE_CHOICE
	prompt "Backing store algorithms"
	default BACKING_STORE_CUSTOM

config BACKING_STORE_CUSTOM
	bool "Custom backing store implementation"
	help
	  This option is chosen when the backing store will be implemented in
	  the application. This will be typical as these tend to be very
	  hardware-dependent.

endchoice
```

## subsys/demand_paging/eviction/Kconfig
```kconfig
# Copyright (c) 2020 Intel Corporation
# SPDX-License-Identifier: Apache-2.0
#
# Demand paging sample eviction algorithms

choice EVICTION_CHOICE
	prompt "Page frame eviction algorithms"
	default EVICTION_NRU
	depends on DEMAND_PAGING

config EVICTION_CUSTOM
	bool "Custom eviction algorithm"
	help
	  This option is chosen when the eviction algorithm will be implemented
	  by the application, instead of using one included in Zephyr.

config EVICTION_NRU
	bool "Not Recently Used (NRU) page eviction algorithm"
	help
	  This implements a Not Recently Used page eviction algorithm.
	  A periodic timer will clear the accessed state of all virtual pages.
	  When a page frame needs to be evicted, the algorithm will prefer to
	  evict page frames using an ascending order of priority:

	   - recently accessed, dirty
	   - recently accessed, clean
	   - not recently accessed, dirty
	   - not recently accessed, clean

config EVICTION_LRU
	bool "Least Recently Used (LRU) page eviction algorithm"
	help
	  This implements a Least Recently Used page eviction algorithm.
	  Usage is tracked based on MMU protection making pages unaccessible
	  and causing a fault when actually used, using such event to reorder
	  the page eviction queue. This is more efficient than the NRU
	  algorithm: all operations are O(1), the accessed flag is cleared on
	  one page at a time and only when there is a page eviction request.

endchoice

if EVICTION_NRU
config EVICTION_NRU_PERIOD
	int "Recently accessed period, in milliseconds"
	default 100
	help
	  A periodic timer will fire that clears the accessed state of all virtual
	  pages that are capable of being paged out. At eviction time, if a page
	  still has the accessed property, it will be considered as recently used.
endif # EVICTION_NRU
```
