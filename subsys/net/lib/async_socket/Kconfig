## subsys/net/lib/coap/Kconfig
```kconfig
# CoAP implementation for Zephyr

# Copyright (c) 2017 Intel Corporation
# SPDX-License-Identifier: Apache-2.0

config COAP
	bool "CoAP Support"
	help
	  This option enables the CoAP implementation.


if COAP

# This setting is only used by unit test. Do not enable it in applications
config COAP_TEST_API_ENABLE
	bool "Test API for CoAP unit tests"
	help
	  Do not enable this for normal use.

config COAP_WELL_KNOWN_BLOCK_WISE
	bool "CoAP ./well-known/core services block wise support"
	help
	  This option enables the block wise support of CoAP response
	  to ./well-known/core request. Without this option all resource's
	  information will be sent in a single IP packet (can be multiple
	  fragments depends on MTU size). This will be useful in mesh kind
	  of networks.

config COAP_WELL_KNOWN_BLOCK_WISE_SIZE
	int "CoAP ./well-known/core services block wise support"
	default 32
	depends on COAP_WELL_KNOWN_BLOCK_WISE
	help
	  Maximum size of CoAP block. Valid values are 16, 32, 64, 128,
	  256, 512 and 1024.

config COAP_EXTENDED_OPTIONS_LEN
	bool "Support for CoAP extended options"
	help
	  This option enables the parsing of extended CoAP options length.
	  CoAP extended options length can be 2 byte value, which
	  requires more memory. User can save memory by disabling this.
	  That means only length of maximum 12 bytes are supported by default.
	  Enable this if length field going to bigger that 12.

config COAP_EXTENDED_OPTIONS_LEN_VALUE
	int "CoAP extended options length value"
	default 13
	depends on COAP_EXTENDED_OPTIONS_LEN
	help
	  This option specifies the maximum value of length field when
	  COAP_EXTENDED_OPTIONS_LEN is enabled. Define the value according to
	  user requirement.

config COAP_INIT_ACK_TIMEOUT_MS
	int "base length of the random generated initial ACK timeout in ms"
	default 2000
	range 1000 100000
	help
	  This value is used as a base value to retry pending CoAP packets.

config COAP_RANDOMIZE_ACK_TIMEOUT
	bool "Randomize initial ACK timeout, as specified in RFC 7252"
	default y
	help
	  If enabled, the initial ACK timeout will be randomized, as specified
	  in RFC 7252, i.e. will be a random number between ACK_TIMEOUT and
	  ACK_TIMEOUT * ACK_RANDOM_FACTOR (where ACK_TIMEOUT is specified by
	  COAP_INIT_ACK_TIMEOUT_MS option). Otherwise, the initial ACK timeout
	  will be fixed to the value of COAP_INIT_ACK_TIMEOUT_MS option.

config COAP_ACK_RANDOM_PERCENT
	int "Random factor for ACK timeout described as percentage"
	default 150
	depends on COAP_RANDOMIZE_ACK_TIMEOUT
	help
	  Factor described as percentage to extend CoAP ACK timeout. A value
	  of 150 means a factor of 1.50.

config COAP_MAX_RETRANSMIT
	int "Max retransmission of a CoAP packet"
	default 4
	range 1 100

config COAP_BACKOFF_PERCENT
	int "Retransmission backoff factor for ACK timeout described as percentage"
	default 200
	help
	  Factor described as percentage to extend CoAP ACK timeout for retransmissions.
	  A value of 200 means a factor of 2.0.

config COAP_URI_WILDCARD
	bool "Wildcards in CoAP resource path"
	default y
	help
	  This option enables MQTT-style wildcards in path. Disable it if
	  resource path may contain plus or hash symbol.

config COAP_KEEP_USER_DATA
	bool "Keeping user data in the CoAP packet"
	help
	  This option enables keeping application-specific user data

config COAP_CLIENT
	bool "CoAP client support [EXPERIMENTAL]"
	select EXPERIMENTAL
	help
	  This option enables the API for CoAP-client for sending CoAP requests

if COAP_CLIENT

config COAP_CLIENT_THREAD_PRIORITY
	int "Coap client thread priority"
	default NUM_PREEMPT_PRIORITIES
	help
	  Priority of receive thread of the CoAP client.

config COAP_CLIENT_BLOCK_SIZE
	int "CoAP block-wise transfer block size"
	default 256
	range 64 1024
	help
	  CoAP block size used by CoAP client when performing block-wise
	  transfers. Possible values: 64, 128, 256, 512 and 1024.

config COAP_CLIENT_MESSAGE_SIZE
	int "Message payload size"
	default COAP_CLIENT_BLOCK_SIZE
	help
	  CoAP client message payload size. Can't be smaller than COAP_CLIENT_BLOCK_SIZE.

config COAP_CLIENT_MESSAGE_HEADER_SIZE
	int "Room for CoAP header data"
	default 48
	range 24 128
	help
	  Extra room allocated to handle CoAP header data

config COAP_CLIENT_MAX_PATH_LENGTH
	int "Maximum length of the path string"
	default 64
	range 1 128

config COAP_CLIENT_MAX_EXTRA_OPTIONS
	int "Maximum number of application-provided extra CoAP options"
	default 2
	range 1 16

config COAP_CLIENT_STACK_SIZE
	int "Stack size of the CoAP client thread"
	default 1024

config COAP_CLIENT_MAX_INSTANCES
	int "Maximum number of CoAP clients"
	default 2
	help
	  Maximum number of CoAP clients

config COAP_CLIENT_MAX_REQUESTS
	int "Maximum number of simultaneous requests per client"
	default 2
	help
	  Maximum number of CoAP requests a single client can handle at a time

config COAP_CLIENT_TRUNCATE_MSGS
	bool "Receive notification when blocks are truncated"
	default y
	help
	  Include ZSOCK_MSG_TRUNC in flags passed to zsock_recvfrom() to
	  receive network stack notifications about block truncation.
	  Otherwise it happens silently.

endif # COAP_CLIENT

config COAP_SERVER
	bool "CoAP server support [EXPERIMENTAL]"
	select EXPERIMENTAL
	select NET_SOCKETS
	select ZVFS
	select ZVFS_EVENTFD
	help
	  This option enables the API for CoAP-services to register resources.

if COAP_SERVER

config COAP_SERVER_STACK_SIZE
	int "CoAP server thread stack size"
	default 4096
	help
	  CoAP server thread stack size for processing RX/TX events.

config COAP_SERVER_BLOCK_SIZE
	int "CoAP server block-wise transfer size"
	default 256
	range 64 1024
	help
	  CoAP block size used by CoAP server resources when performing block-wise
	  transfers. Possible values: 64, 128, 256, 512 and 1024.

config COAP_SERVER_MESSAGE_SIZE
	int "CoAP server message payload size"
	default COAP_SERVER_BLOCK_SIZE
	help
	  CoAP server message payload size. Can't be smaller than COAP_SERVER_BLOCK_SIZE.

config COAP_SERVER_MESSAGE_OPTIONS
	int "CoAP server message options"
	default 16
	help
	  CoAP server message maximum number of options to parse.

config COAP_SERVER_WELL_KNOWN_CORE
	bool "CoAP server support ./well-known/core service"
	default y
	help
	  Enable responding to the ./well-known/core service resource.

config COAP_SERVICE_PENDING_MESSAGES
	int "CoAP service pending messages"
	default 10
	help
	  Maximum number of pending CoAP messages to retransmit per active service.

config COAP_SERVICE_OBSERVERS
	int "CoAP service observers"
	default 3
	help
	  Maximum number of CoAP observers per active service.

choice COAP_SERVER_PENDING_ALLOCATOR
	prompt "Pending data allocator"
	default COAP_SERVER_PENDING_ALLOCATOR_STATIC

config COAP_SERVER_PENDING_ALLOCATOR_NONE
	bool "No pending packets"
	help
	  Never allocate data for pending requests, this disables retransmits for confirmable
	  packets.

config COAP_SERVER_PENDING_ALLOCATOR_STATIC
	bool "Static reserved memory"
	help
	  Static memory will be reserved for pending messages. The total size is equal to
	  COAP_SERVER_PENDING_ALLOCATOR_STATIC_BLOCKS * COAP_SERVER_MESSAGE_SIZE.

config COAP_SERVER_PENDING_ALLOCATOR_SYSTEM_HEAP
	bool "System heap allocator"
	depends on HEAP_MEM_POOL_SIZE > 0
	help
	  Use k_malloc/k_free for pending data.

endchoice

config COAP_SERVER_PENDING_ALLOCATOR_STATIC_BLOCKS
	int "Number of pending data blocks"
	default COAP_SERVICE_PENDING_MESSAGES
	depends on COAP_SERVER_PENDING_ALLOCATOR_STATIC
	help
	  The number of data blocks to reserve for pending messages to retransmit.

config COAP_SERVER_TRUNCATE_MSGS
	bool "Handle truncated messages"
	default y
	help
	  Include ZSOCK_MSG_TRUNC in flags passed to zsock_recvfrom() to
	  receive network stack notifications about block truncation.
	  Otherwise it happens silently.

config COAP_SERVER_SHELL
	bool "CoAP service shell commands"
	depends on SHELL
	help
	  Enable CoAP service shell commands.

config COAP_SERVER_ECHO
	bool "CoAP server Echo option support (RFC 9175)"
	help
	  Enable server-side Echo option support for request freshness
	  verification and amplification mitigation per RFC 9175.

if COAP_SERVER_ECHO

config COAP_SERVER_ECHO_MAX_LEN
	int "Maximum Echo option value length"
	default 8
	range 1 40
	help
	  Maximum length of Echo option values in bytes. RFC 9175 allows
	  values from 1 to 40 bytes. Smaller values use less memory but
	  may be less secure.

config COAP_SERVER_ECHO_LIFETIME_MS
	int "Echo option value lifetime in milliseconds"
	default 60000
	help
	  Time in milliseconds for which an Echo option value remains valid.
	  After this time, the client must obtain a new Echo value.

config COAP_SERVER_ECHO_CACHE_SIZE
	int "Echo cache size per service"
	default 8
	help
	  Number of Echo entries to cache per service endpoint. This limits
	  how many different clients can be tracked simultaneously.

config COAP_SERVER_ECHO_REQUIRE_FOR_UNSAFE
	bool "Require Echo for unsafe methods"
	help
	  When enabled, unsafe methods (PUT, POST, DELETE, PATCH, IPATCH)
	  require Echo option verification per RFC 9175 Section 2.3.
	  This ensures request freshness for state-changing operations.

config COAP_SERVER_ECHO_AMPLIFICATION_MITIGATION
	bool "Use Echo for amplification mitigation"
	default y
	help
	  Apply RFC 9175 Section 2.4 item 3 and Section 2.6 behavior for
	  high-amplification responses. Challenges unauthenticated clients
	  before sending large responses like /.well-known/core.

config COAP_SERVER_ECHO_AMPLIFICATION_FACTOR
	int "Maximum amplification factor"
	default 3
	depends on COAP_SERVER_ECHO_AMPLIFICATION_MITIGATION
	help
	  Maximum ratio between response size and request size before
	  requiring Echo verification. Value of 3 follows RFC 9000 guidance.

config COAP_SERVER_ECHO_MAX_INITIAL_RESPONSE_BYTES
	int "Maximum initial response bytes without verification"
	default 136
	depends on COAP_SERVER_ECHO_AMPLIFICATION_MITIGATION
	help
	  Maximum response size in bytes to send to unverified clients.
	  Default of 136 bytes follows RFC 9175 Section 2.4 item 3 guidance
	  for Ethernet MTU with IP/UDP/CoAP headers.

endif # COAP_SERVER_ECHO

endif # COAP_SERVER

config COAP_OSCORE
	bool "OSCORE support for CoAP (RFC 8613)"
	depends on UOSCORE
	help
	  Enable Object Security for Constrained RESTful Environments (OSCORE)
	  support for CoAP client and server. OSCORE provides end-to-end
	  protection of CoAP messages using COSE (CBOR Object Signing and
	  Encryption).

	  This option requires the uoscore-uedhoc module and PSA Crypto support.
	  When enabled, CoAP messages can be protected with OSCORE by attaching
	  a security context to the client or service.

	  See RFC 8613 for details.

if COAP_OSCORE

config COAP_OSCORE_MAX_PLAINTEXT_LEN
	int "Maximum OSCORE plaintext length"
	default 1024
	help
	  Maximum length of OSCORE plaintext (CoAP message before encryption).
	  This includes the CoAP options and payload that will be encrypted.
	  Adjust based on your application's message size requirements.

config COAP_OSCORE_EXCHANGE_CACHE_SIZE
	int "OSCORE exchange cache size per service"
	default 8
	help
	  Number of OSCORE exchange entries to cache per service endpoint.
	  This tracks which ongoing exchanges require OSCORE-protected responses.
	  Each entry stores client address and token information to match
	  responses to OSCORE requests per RFC 8613 Section 8.3.

config COAP_OSCORE_EXCHANGE_LIFETIME_MS
	int "OSCORE exchange lifetime in milliseconds"
	default 60000
	help
	  Time in milliseconds for which an OSCORE exchange entry remains valid.
	  After this time, the exchange is considered expired and will be removed.
	  This applies to non-Observe exchanges; Observe exchanges are kept until
	  the observation is cancelled.

config COAP_OSCORE_MAX_UNFRAGMENTED_SIZE
	int "Maximum OSCORE unfragmented message size"
	default 4096
	help
	  Maximum size in bytes for reassembled OSCORE messages when using
	  Outer Block-wise transfers (RFC 8613 Section 4.1.3.4.2). If the
	  cumulative size of outer blocks exceeds this limit, the message
	  is discarded per RFC 8613 security requirements. This prevents
	  memory exhaustion attacks via fragmented OSCORE messages.

config COAP_OSCORE_CTX_CACHE_SIZE
	int "OSCORE context cache size per service"
	default 4
	depends on COAP_EDHOC_COMBINED_REQUEST
	help
	  Number of OSCORE security contexts to cache per CoAP service endpoint.
	  Each cached context is keyed by the OSCORE Sender ID (kid) from the
	  client. This cache is used for RFC 9668 EDHOC+OSCORE combined requests
	  to store derived OSCORE contexts after EDHOC message_3 processing.

	  This limits how many concurrent EDHOC-derived OSCORE contexts can be
	  active simultaneously. Contexts are evicted based on age when the
	  cache is full.

config COAP_OSCORE_CTX_LIFETIME_MS
	int "OSCORE derived context lifetime in milliseconds"
	default 3600000
	depends on COAP_EDHOC_COMBINED_REQUEST
	help
	  Time in milliseconds for which a derived OSCORE context remains valid
	  in the cache. After this time, the context is considered expired and
	  will be evicted. Default is 1 hour (3600000 ms). This prevents memory
	  exhaustion from unused contexts.

endif # COAP_OSCORE

config COAP_EDHOC
	bool "EDHOC support for CoAP (RFC 9668)"
	depends on ZCBOR
	help
	  Enable Ephemeral Diffie-Hellman Over COSE (EDHOC) support for CoAP.
	  EDHOC provides lightweight authenticated key exchange for constrained
	  devices, enabling secure session establishment with minimal overhead.

	  This option enables EDHOC option (21) handling and combined payload
	  parsing per RFC 9668. Full EDHOC handshake processing requires the
	  uoscore-uedhoc module (CONFIG_UEDHOC) which provides the EDHOC protocol
	  implementation.

	  See RFC 9668 for details on using EDHOC with CoAP and OSCORE.

if COAP_EDHOC

config COAP_EDHOC_COMBINED_REQUEST
	bool "EDHOC+OSCORE combined request support (RFC 9668)"
	depends on COAP_OSCORE
	help
	  Enable support for EDHOC+OSCORE combined requests per RFC 9668 Section 3.
	  This allows clients to send EDHOC message_3 and the first OSCORE-protected
	  application request in a single CoAP message, reducing round trips.

	  The combined request includes the EDHOC option (21) and a combined payload
	  containing both the EDHOC message_3 and the OSCORE ciphertext.

	  Requires both COAP_EDHOC and COAP_OSCORE to be enabled.

config COAP_EDHOC_MAX_COMBINED_PAYLOAD_LEN
	int "Maximum EDHOC+OSCORE combined payload length"
	default 1024
	depends on COAP_EDHOC_COMBINED_REQUEST
	help
	  Maximum length in bytes for the combined payload in EDHOC+OSCORE
	  combined requests. This includes EDHOC message_3 and the OSCORE
	  ciphertext. If a request exceeds this limit, it will be rejected
	  with 4.00 Bad Request per RFC 9668 Section 3.3.1.

	  This is a fail-closed security measure to prevent resource exhaustion.

config COAP_EDHOC_COMBINED_OUTER_BLOCK_CACHE_SIZE
	int "EDHOC+OSCORE combined request outer Block1 cache size"
	default 4
	depends on COAP_EDHOC_COMBINED_REQUEST
	help
	  Number of concurrent outer Block1 reassemblies to support for
	  EDHOC+OSCORE combined requests per service endpoint. Each entry
	  tracks an in-progress blockwise transfer keyed by client address
	  and token. When the cache is full, the oldest entry is evicted.

	  This limits DoS exposure from clients sending incomplete blockwise
	  transfers per RFC 9668 Section 3.3.2.

config COAP_EDHOC_COMBINED_OUTER_BLOCK_LIFETIME_MS
	int "EDHOC+OSCORE outer Block1 reassembly lifetime in milliseconds"
	default 60000
	depends on COAP_EDHOC_COMBINED_REQUEST
	help
	  Time in milliseconds for which an incomplete outer Block1 reassembly
	  remains valid. After this time, the reassembly is considered expired
	  and will be evicted from the cache. This prevents memory exhaustion
	  from abandoned blockwise transfers.

config COAP_EDHOC_COMBINED_OUTER_BLOCK_MAX_LEN
	int "Maximum EDHOC+OSCORE outer Block1 reassembled payload length"
	default COAP_EDHOC_MAX_COMBINED_PAYLOAD_LEN
	depends on COAP_EDHOC_COMBINED_REQUEST
	help
	  Maximum total length in bytes for reassembled outer Block1 payloads
	  in EDHOC+OSCORE combined requests. If a reassembly would exceed this
	  limit, it is aborted and the client receives 4.13 Request Entity Too
	  Large per RFC 7959.

	  This is a fail-closed security measure to prevent resource exhaustion
	  from malicious blockwise transfers.

config COAP_EDHOC_SESSION_CACHE_SIZE
	int "EDHOC session cache size per service"
	default 4
	help
	  Number of EDHOC sessions to cache per CoAP service endpoint.
	  Each session stores the EDHOC state keyed by the connection
	  identifier C_R (for responder role).

	  This limits how many concurrent EDHOC handshakes can be in
	  progress simultaneously. Sessions are removed after successful
	  completion or timeout.

config COAP_EDHOC_SESSION_LIFETIME_MS
	int "EDHOC session lifetime in milliseconds"
	default 60000
	help
	  Time in milliseconds for which an EDHOC session remains valid.
	  After this time, the session is considered expired and will be
	  evicted from the cache. This prevents memory exhaustion from
	  abandoned EDHOC handshakes.

config COAP_SERVER_WELL_KNOWN_EDHOC
	bool "CoAP server support for /.well-known/edhoc (RFC 9528 Appendix A.2)"
	depends on COAP_SERVER && COAP_EDHOC && COAP_EDHOC_COMBINED_REQUEST
	help
	  Enable support for EDHOC message transfer over CoAP per RFC 9528
	  Appendix A.2 ("Transferring EDHOC over CoAP"). When enabled, the
	  CoAP server will handle POST requests to the /.well-known/edhoc
	  resource for EDHOC message_1 and message_3 processing.

	  This implements the forward flow (message_1 -> message_2,
	  message_3 -> message_4) as specified in RFC 9528 Appendix A.2.1.
	  OSCORE contexts are automatically derived and cached after successful
	  EDHOC completion per RFC 9528 Appendix A.1 and Table 14.

	  Note: This feature requires CONFIG_COAP_EDHOC_COMBINED_REQUEST as it
	  shares the same EDHOC session management and OSCORE context infrastructure.

	  Security recommendation: Enable CONFIG_COAP_SERVER_ECHO_REQUIRE_FOR_UNSAFE
	  to enforce Echo option verification for EDHOC POST requests, providing
	  DoS mitigation per RFC 9528 Appendix A.2 and RFC 9175.

endif # COAP_EDHOC

module = COAP
module-dep = NET_LOG
module-str = Log level for CoAP
module-help = Enables CoAP debug messages.
source "subsys/net/Kconfig.template.log_config.net"

endif # COAP
```
