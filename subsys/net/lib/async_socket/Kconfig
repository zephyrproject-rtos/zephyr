## subsys/net/lib/lwm2m/Kconfig.ipso
```kconfig
# Copyright (c) 2017 Linaro Limited
# SPDX-License-Identifier: Apache-2.0

menuconfig LWM2M_IPSO_SUPPORT
	bool "IPSO Alliance Smart Object Support"
	help
	  This option adds general support for IPSO objects

if LWM2M_IPSO_SUPPORT

config LWM2M_IPSO_TEMP_SENSOR
	bool "IPSO Temperature Sensor Support"
	help
	  This IPSO object should be used with a temperature sensor to
	  report a temperature measurement. It also provides resources for
	  minimum/maximum measured values and the minimum/maximum range
	  that can be measured by the temperature sensor.

config LWM2M_IPSO_TEMP_SENSOR_INSTANCE_COUNT
	int "Maximum # of IPSO Temperature Sensor object instances"
	default 1
	depends on LWM2M_IPSO_TEMP_SENSOR
	help
	  This setting establishes the total count of IPSO Temperature
	  Sensor instances available to the LWM2M client.

choice
	prompt "IPSO Temperature object version"
	depends on LWM2M_IPSO_TEMP_SENSOR
	default LWM2M_IPSO_TEMP_SENSOR_VERSION_1_0
	help
	  Select which version of the IPSO Temperature object should be used.

config LWM2M_IPSO_TEMP_SENSOR_VERSION_1_0
	bool "IPSO Temperature object version 1.0"

config LWM2M_IPSO_TEMP_SENSOR_VERSION_1_1
	bool "IPSO Temperature object version 1.1"

endchoice

config LWM2M_IPSO_GENERIC_SENSOR
	bool "IPSO Generic Sensor Support"
	help
	  This IPSO object can be used to prototype a sensor.

if LWM2M_IPSO_GENERIC_SENSOR

config LWM2M_IPSO_GENERIC_SENSOR_INSTANCE_COUNT
	int "Maximum # of IPSO Generic Sensor object instances"
	default 1
	help
	  This setting establishes the total count of IPSO Generic
	  Sensor instances available to the LWM2M client.

choice
	prompt "IPSO Generic Sensor object version"
	default LWM2M_IPSO_GENERIC_SENSOR_VERSION_1_0
	help
	  Select which version of the IPSO Generic Sensor object should be used.

config LWM2M_IPSO_GENERIC_SENSOR_VERSION_1_0
	bool "IPSO Generic Sensor object version 1.0"

config LWM2M_IPSO_GENERIC_SENSOR_VERSION_1_1
	bool "IPSO Generic Sensor object version 1.1"

endchoice

config LWM2M_IPSO_GENERIC_SENSOR_NAME
	string "Name that will show up in debug output when object is created"
	default "Generic"

config LWM2M_IPSO_GENERIC_SENSOR_TYPE
	string "Sensor type"
	default "Generic sensor"
	help
	  The type of the sensor (for instance PIR type).

endif # LWM2M_IPSO_GENERIC_SENSOR

config LWM2M_IPSO_HUMIDITY_SENSOR
	bool "IPSO Humidity Sensor Support"
	help
	  This IPSO object can be used to prototype a sensor.

if LWM2M_IPSO_HUMIDITY_SENSOR

config LWM2M_IPSO_HUMIDITY_SENSOR_INSTANCE_COUNT
	int "Maximum # of IPSO Humidity Sensor object instances"
	default 1
	help
	  This setting establishes the total count of IPSO Humidity
	  Sensor instances available to the LWM2M client.

choice
	prompt "IPSO Humidity Sensor object version"
	default LWM2M_IPSO_HUMIDITY_SENSOR_VERSION_1_0
	help
	  Select which version of the IPSO Humidity Sensor object should be
	  used.

config LWM2M_IPSO_HUMIDITY_SENSOR_VERSION_1_0
	bool "IPSO Humidity Sensor object version 1.0"

config LWM2M_IPSO_HUMIDITY_SENSOR_VERSION_1_1
	bool "IPSO Humidity Sensor object version 1.1"

endchoice

endif # LWM2M_IPSO_HUMIDITY_SENSOR

config LWM2M_IPSO_PRESSURE_SENSOR
	bool "IPSO Pressure Sensor Support"
	help
	  This IPSO object can be used to prototype a sensor.

if LWM2M_IPSO_PRESSURE_SENSOR

config LWM2M_IPSO_PRESSURE_SENSOR_INSTANCE_COUNT
	int "Maximum # of IPSO Pressure Sensor object instances"
	default 1
	help
	  This setting establishes the total count of IPSO Pressure
	  Sensor instances available to the LWM2M client.

choice
	prompt "IPSO Pressure Sensor object version"
	default LWM2M_IPSO_PRESSURE_SENSOR_VERSION_1_0
	help
	  Select which version of the IPSO Pressure Sensor object should be
	  used.

config LWM2M_IPSO_PRESSURE_SENSOR_VERSION_1_0
	bool "IPSO Pressure Sensor object version 1.0"

config LWM2M_IPSO_PRESSURE_SENSOR_VERSION_1_1
	bool "IPSO Pressure Sensor object version 1.1"

endchoice

endif # LWM2M_IPSO_PRESSURE_SENSOR

config LWM2M_IPSO_LIGHT_CONTROL
	bool "IPSO Light Control Support"
	help
	  This Object is used to control a light source, such as a LED or other
	  light. It allows a light to be turned on or off and its dimmer
	  setting to be controlled as a % between 0 and 100. An optional color
	  setting enables a string to be used to indicate the desired color.

config LWM2M_IPSO_LIGHT_CONTROL_INSTANCE_COUNT
	int "Maximum # of IPSO Light Control object instances"
	default 1
	depends on LWM2M_IPSO_LIGHT_CONTROL
	help
	  This setting establishes the total count of IPSO Light Control
	  instances available to the LWM2M client.

config LWM2M_IPSO_ACCELEROMETER
	bool "IPSO Accelerometer Support"
	help
	  This Object is used to used to represent a 1-3 axis accelerometer.

config LWM2M_IPSO_ACCELEROMETER_INSTANCE_COUNT
	int "Maximum # of IPSO Accelerometer object instances"
	default 1
	depends on LWM2M_IPSO_ACCELEROMETER
	help
	  This setting establishes the total count of IPSO Accelerometer
	  instances available to the LWM2M client.

choice
	prompt "IPSO Accelerometer object version"
	depends on LWM2M_IPSO_ACCELEROMETER
	default LWM2M_IPSO_ACCELEROMETER_VERSION_1_0
	help
	  Select which version of the IPSO Accelerometer object should be used.

config LWM2M_IPSO_ACCELEROMETER_VERSION_1_0
	bool "IPSO Accelerometer object version 1.0"

config LWM2M_IPSO_ACCELEROMETER_VERSION_1_1
	bool "IPSO Accelerometer object version 1.1"

endchoice

config LWM2M_IPSO_BUZZER
	bool "IPSO Buzzer Support"
	help
	  This Object is used to actuate an audible alarm such as a buzzer,
	  beeper, or vibration alarm.

config LWM2M_IPSO_BUZZER_INSTANCE_COUNT
	int "Maximum # of IPSO Buzzer instances"
	default 1
	depends on LWM2M_IPSO_BUZZER
	help
	  This setting establishes the total count of IPSO Buzzer
	  instances available to the LWM2M client.

choice
	prompt "IPSO Buzzer object version"
	depends on LWM2M_IPSO_BUZZER
	default LWM2M_IPSO_BUZZER_VERSION_1_0
	help
	  Select which version of the IPSO Buzzer object should be used.

config LWM2M_IPSO_BUZZER_VERSION_1_0
	bool "IPSO Buzzer object version 1.0"

config LWM2M_IPSO_BUZZER_VERSION_1_1
	bool "IPSO Buzzer object version 1.1"

endchoice

config LWM2M_IPSO_TIMER
	bool "IPSO Light Control Support"
	help
	  This Object is used to time events / actions

config LWM2M_IPSO_TIMER_INSTANCE_COUNT
	int "Maximum # of IPSO Timer object instances"
	default 1
	depends on LWM2M_IPSO_TIMER
	help
	  This setting establishes the total count of IPSO Timer
	  instances available to the LWM2M client.

config LWM2M_IPSO_ONOFF_SWITCH
	bool "IPSO On/Off Switch Support"
	help
	  This object is used with an On/Off switch to report it's state.

config LWM2M_IPSO_ONOFF_SWITCH_INSTANCE_COUNT
	int "Maximum # of IPSO On/Off Switch object instances"
	default 1
	depends on LWM2M_IPSO_ONOFF_SWITCH
	help
	  This setting establishes the total count of IPSO On/Off Switch
	  instances available to the LWM2M client.

choice
	prompt "IPSO On/Off Switch object version"
	depends on LWM2M_IPSO_ONOFF_SWITCH
	default LWM2M_IPSO_ONOFF_SWITCH_VERSION_1_0
	help
	  Select which version of the IPSO On/Off Switch object should be used.

config LWM2M_IPSO_ONOFF_SWITCH_VERSION_1_0
	bool "IPSO On/Off Switch object version 1.0"

config LWM2M_IPSO_ONOFF_SWITCH_VERSION_1_1
	bool "IPSO On/Off Switch object version 1.1"

endchoice

config LWM2M_IPSO_PUSH_BUTTON
	bool "IPSO Push Button Support"
	help
	  This Object is used to report the state of a momentary action push
	  button control and to count the number of times the control has
	  been operated since the last observation.

config LWM2M_IPSO_PUSH_BUTTON_INSTANCE_COUNT
	int "Maximum # of IPSO On/Off Switch object instances"
	default 1
	depends on LWM2M_IPSO_PUSH_BUTTON
	help
	  This setting establishes the total count of IPSO Push Button
	  instances available to the LWM2M client.

choice
	prompt "IPSO Push Button object version"
	depends on LWM2M_IPSO_PUSH_BUTTON
	default LWM2M_IPSO_PUSH_BUTTON_VERSION_1_0
	help
	  Select which version of the IPSO Push Button object should be used.

config LWM2M_IPSO_PUSH_BUTTON_VERSION_1_0
	bool "IPSO Push Button object version 1.0"

config LWM2M_IPSO_PUSH_BUTTON_VERSION_1_1
	bool "IPSO Push Button object version 1.1"

endchoice

config LWM2M_IPSO_CURRENT_SENSOR
	bool "IPSO Current Sensor Support"
	help
	  This IPSO object should be used with a current sensor to
	  report a current measurement. It also provides resources for
	  minimum/maximum measured values and the minimum/maximum range
	  that can be measured by the sensor.

config LWM2M_IPSO_CURRENT_SENSOR_INSTANCE_COUNT
	int "Maximum # of IPSO Current Sensor object instances"
	default 1
	depends on LWM2M_IPSO_CURRENT_SENSOR
	help
	  This setting establishes the total count of IPSO Current
	  Sensor instances available to the LWM2M client.

choice
	prompt "IPSO Current object version"
	default LWM2M_IPSO_CURRENT_SENSOR_VERSION_1_0
	depends on LWM2M_IPSO_CURRENT_SENSOR
	help
	  Select which version of the IPSO Current object should be used.

config LWM2M_IPSO_CURRENT_SENSOR_VERSION_1_0
	bool "IPSO Current object version 1.0"

config LWM2M_IPSO_CURRENT_SENSOR_VERSION_1_1
	bool "IPSO Current object version 1.1"
	help
	  Adds timestamp and measurement quality

endchoice

config LWM2M_IPSO_FILLING_SENSOR
	bool "IPSO Filling sensor Support"
	help
	  This IPSO object can be used with an ultrasonic sensor to
	  report how full a container is.

config LWM2M_IPSO_FILLING_SENSOR_INSTANCE_COUNT
	int "Maximum # of IPSO filling sensor object instances"
	default 1
	depends on LWM2M_IPSO_FILLING_SENSOR
	help
	  This setting establishes the total count of IPSO filling
	  sensor instances available to the LwM2M client.

endif # LWM2M_LWM2M_IPSO_SUPPORT
```

## subsys/net/lib/lwm2m/Kconfig.lpwan
```kconfig
# Copyright (c) 2022 FTP Technologies
# SPDX-License-Identifier: Apache-2.0

config LWM2M_LPWAN_OBJ_SUPPORT
	bool "LPWAN object support"
	help
	  Include support for LWM2M Connectivity Monitoring Object (ID 4)

config LWM2M_LPWAN_INSTANCE_COUNT
	int "Maximum # of LPWAN instances"
	depends on LWM2M_LPWAN_OBJ_SUPPORT
	default 1
	range 1 4
	help
	  This value sets the maximum allowable number of LPWAN instances.

config LWM2M_LPWAN_IPV4_ADDRESS_MAX
	int "Maximum # of IPv4 addresses"
	depends on LWM2M_LPWAN_OBJ_SUPPORT
	default 0
	range 0 20
	help
	  This value sets the maximum number of IPv4 address assigned to a
	  device that can be stored in this object.

config LWM2M_LPWAN_IPV6_ADDRESS_MAX
	int "Maximum # of IPv6 addresses"
	depends on LWM2M_LPWAN_OBJ_SUPPORT
	default 0
	range 0 20
	help
	  This value sets the maximum number of IPv6 addresses assigned to a
	  device that can be stored in this object.

config LWM2M_LPWAN_NETWORK_ADDRESS_MAX
	int "Maximum # of network addresses"
	depends on LWM2M_LPWAN_OBJ_SUPPORT
	default 0
	range 0 20
	help
	  This value sets the maximum number of LPWAN network addresses assigned
	  to a device that can be stored in this object.

config LWM2M_LPWAN_SECONDARY_NETWORK_ADDRESS_MAX
	int "Maximum # of secondary network addresses"
	depends on LWM2M_LPWAN_OBJ_SUPPORT
	default 0
	range 0 20
	help
	  This value sets the maximum number of secondary addresses used to
	  communicate with the device on the LPWAN network assigned that can be
	  stored in this object.

config LWM2M_LPWAN_PEER_ADDRESS_MAX
	int "Maximum # of addresses of peer nodes"
	depends on LWM2M_LPWAN_OBJ_SUPPORT
	default 0
	range 0 64
	help
	  This value sets the maximum number of LPWAN addresses of peer nodes
	  that can be stored in this object.

config LWM2M_LPWAN_MULTICAST_GRP_ADDRESS_MAX
	int "Maximum # of multicast addresses"
	depends on LWM2M_LPWAN_OBJ_SUPPORT
	default 0
	range 0 20
	help
	  This value sets the maximum number of group addresses (from which the
	  device should accept incoming messages and/or commands) that can be
	  stored in this object.

config LWM2M_LPWAN_MULTICAST_GRP_KEY_MAX
	int "Maximum # of multicast group keys"
	depends on LWM2M_LPWAN_OBJ_SUPPORT
	default 0
	range 0 20
	help
	  This value sets the maximum number of security key (e.g. AES128) to
	  be shared with other members to be part of a multicast group that can
	  be stored in this object.
```

## subsys/net/lib/lwm2m/Kconfig.ucifi
```kconfig
# Copyright (c) 2022 Laird Connectivity
# SPDX-License-Identifier: Apache-2.0

menuconfig LWM2M_UCIFI_SUPPORT
	bool "uCIFI Alliance Object Support"
	help
	  This option adds general support for uCIFI objects

if LWM2M_UCIFI_SUPPORT

menuconfig LWM2M_UCIFI_BATTERY
	bool "uCIFI Battery (3411) Monitor Support"
	help
	  The uCIFI battery object provides attributes to monitor battery
	  level and activity.

if LWM2M_UCIFI_BATTERY

config LWM2M_UCIFI_BATTERY_INSTANCE_COUNT
	int "Maximum # of uCIFI Battery object instances"
	default 1
	help
	  This setting establishes the total count of uCIFI Battery
	  instances available to the LWM2M client.

endif # LWM2M_UCIFI_BATTERY

menuconfig LWM2M_UCIFI_LPWAN
	bool "uCIFI LPWAN (3412) Support"
	help
	  The uCIFI LPWAN object provides attributes to monitor and maintain
	  Low-Power Wide Area Networks.

if LWM2M_UCIFI_LPWAN

config LWM2M_UCIFI_LPWAN_INSTANCE_COUNT
	int "Maximum # of uCIFI LPWAN object instances"
	default 1
	range 1 4
	help
	  This value sets the maximum allowable number of LPWAN instances.

config LWM2M_UCIFI_LPWAN_IPV4_ADDRESS_MAX
	int "Maximum # of IPv4 addresses"
	default 0
	range 0 20
	help
	  This value sets the maximum number of IPv4 addresses assigned to a
	  device that can be stored in this object.

config LWM2M_UCIFI_LPWAN_IPV6_ADDRESS_MAX
	int "Maximum # of IPv6 addresses"
	default 0
	range 0 20
	help
	  This value sets the maximum number of IPv6 addresses assigned to a
	  device that can be stored in this object.

config LWM2M_UCIFI_LPWAN_NETWORK_ADDRESS_MAX
	int "Maximum # of network addresses"
	default 0
	range 0 20
	help
	  This value sets the maximum number of LPWAN network addresses assigned
	  to a device that can be stored in this object.

config LWM2M_UCIFI_LPWAN_SECONDARY_NETWORK_ADDRESS_MAX
	int "Maximum # of secondary network addresses"
	default 0
	range 0 20
	help
	  This value sets the maximum number of secondary addresses used to
	  communicate with the device on the LPWAN network assigned that can be
	  stored in this object.

config LWM2M_UCIFI_LPWAN_PEER_ADDRESS_MAX
	int "Maximum # of peer node addresses"
	default 0
	range 0 64
	help
	  This value sets the maximum number of LPWAN addresses of peer nodes
	  that can be stored in this object.

config LWM2M_UCIFI_LPWAN_MULTICAST_GRP_ADDRESS_MAX
	int "Maximum # of multicast group addresses"
	default 0
	range 0 20
	help
	  This value sets the maximum number of multicast group addresses (from
	  which the device should accept incoming messages and/or commands)
	  that can be stored in this object.

config LWM2M_UCIFI_LPWAN_MULTICAST_GRP_KEY_MAX
	int "Maximum # of multicast group keys"
	default 0
	range 0 20
	help
	  This value sets the maximum number of security key (e.g. AES128) to
	  be shared with other members to be part of a multicast group that can
	  be stored in this object.

endif # LWM2M_UCIFI_LPWAN

endif # LWM2M_UCIFI_SUPPORT
```
