## subsys/net/pkt_filter/Kconfig
```kconfig
# Packet filtering config
# Copyright (c) 2021 BayLibre SAS
# SPDX-License-Identifier: Apache-2.0

menu "Network Packet Filtering"

config NET_PKT_FILTER
	bool "Network packet filtering"
	help
	  The Network Packet Filtering facility provides the infrastructure
	  to construct custom rules for accepting and/or denying packet
	  transmission and reception.

if NET_PKT_FILTER

config NET_PKT_FILTER_IPV4_HOOK
	bool "Additional network packet filtering hook inside IPv4 stack"
	depends on NET_IPV4
	help
	  This additional hook provides infrastructure to construct custom
	  rules on the IP packet.

config NET_PKT_FILTER_IPV6_HOOK
	bool "Additional network packet filtering hook inside IPv6 stack"
	depends on NET_IPV6
	help
	  This additional hook provides infrastructure to construct custom
	  rules on the IP packet.

config NET_PKT_FILTER_LOCAL_IN_HOOK
	bool "Additional network packet filtering hook for connection input"
	depends on NET_IP
	help
	  This additional hook provides infrastructure to construct custom
	  rules for e.g. TCP/UDP packets.

module = NET_PKT_FILTER
module-dep = NET_LOG
module-str = Log level for packet filtering
module-help = Enables packet filter output debug messages
source "subsys/net/Kconfig.template.log_config.net"
endif # NET_PKT_FILTER

endmenu
```

## subsys/nsettings/Kconfig
```kconfig
#
# Copyright (c) 2018 Nordic Semiconductor ASA
#
# SPDX-License-Identifier: Apache-2.0
#

menuconfig NSETTINGS
	bool "Enable settings subsystem with non-volatile storage"
	help
	  The settings subsystem allows its users to serialize and
	  deserialize state in memory into and from non-volatile memory.
	  It supports several back-ends to store and load serialized data from
	  and it can do so atomically for all involved modules.

config NSETTINGS_RUNTIME
	bool "Runtime support"
	default y
	depends on NSETTINGS
	help
	  Enables runtime support.

choice
	prompt "Default backend type"
	default NSETTINGS_DEFAULT_FCB
	depends on NSETTINGS
	help
	  Default storage back-end to be used by the settings subsystem.

config NSETTINGS_DEFAULT_FCB
	bool "FCB"
	depends on FCB
	help
	  Use FCB as the default storage back-end.

config NSETTINGS_DEFAULT_FS
	bool "File System"
	depends on FILE_SYSTEM
	help
	  Use a file system as the default storage back-end.

config NSETTINGS_DEFAULT_NVS
	bool "NVS"
	depends on NVS
	help
	  Use NVS as the default storage back-end.

config NSETTINGS_DEFAULT_NONE
	bool "None"
	help
	  Don't use a default storage back-end.
endchoice

config NSETTINGS_DEFAULT_FCB_NUM_AREAS
	int "Number of flash areas used by the settings subsystem"
	default 8
	depends on NSETTINGS && NSETTINGS_DEFAULT_FCB
	help
	  Number of areas to allocate in the settings FCB. A smaller number is
	  used if the flash hardware cannot support this value.

config NSETTINGS_DEFAULT_FCB_MAGIC
	hex "FCB magic for the settings subsystem"
	default 0xc0ffeeee
	depends on NSETTINGS && NSETTINGS_DEFAULT_FCB
	help
	  Magic 32-bit word for to identify valid settings area

config NSETTINGS_DEFAULT_FCB_FLASH_AREA
	int "Flash area id used for settings"
	default 4
	depends on NSETTINGS && NSETTINGS_DEFAULT_FCB
	help
	  Id of the Flash area where FCB instance used for settings is
	  expected to operate.

config NSETTINGS_DEFAULT_FS_MNT
	string "Serialization mount point"
	default "/nffs"
	depends on NSETTINGS && NSETTINGS_DEFAULT_FS
	help
	  Directory where the settings data is stored

config NSETTINGS_DEFAULT_FS_DIR
	string "Serialization directory"
	default "/nffs/settings"
	depends on NSETTINGS && NSETTINGS_DEFAULT_FS
	help
	  Directory where the settings data is stored

config NSETTINGS_DEFAULT_FS_FILE
	string "Default settings file"
	default "/nffs/settings/run"
	depends on NSETTINGS && NSETTINGS_DEFAULT_FS
	help
	  Full path to the default settings file.

config NSETTINGS_DEFAULT_FS_MAX_LINES
	int "Compression threshold"
	default 32
	depends on NSETTINGS && NSETTINGS_DEFAULT_FS
	help
	  Limit how many items stored in a file before compressing

config NSETTINGS_DEFAULT_NVS_SECTOR_SIZE_MULT
	int "Sector size of the NVS settings area"
	default 1
	depends on NSETTINGS && NSETTINGS_DEFAULT_NVS
	help
	  The sector size to use for the NVS settings area as a multiple of
		FLASH_ERASE_BLOCK_SIZE.

config NSETTINGS_DEFAULT_NVS_SECTOR_COUNT
	int "Sector count of the NVS settings area"
	default 3
	depends on NSETTINGS && NSETTINGS_DEFAULT_NVS
	help
	  Number of sectors used for the NVS settings area

config NSETTINGS_DEFAULT_NVS_OFFSET_MULT
	int "Offset of the NVS settings area"
	default 0
	depends on NSETTINGS && NSETTINGS_DEFAULT_NVS
	help
	  The NVS settings area starts at FLASH_STORAGE_OFFSET plus the
		specified multiple of FLASH_ERASE_BLOCK_SIZES.
```

## subsys/osal/Kconfig
```kconfig
# Copyright (c) 2026 Espressif Systems (Shanghai) Co., Ltd.
# SPDX-License-Identifier: Apache-2.0

config OSAL
	bool "Zephyr OS abstraction layer [EXPERIMENTAL]"
	depends on MULTITHREADING
	select EXPERIMENTAL
	select EVENTS
	help
	  Shared translation of a generic OS abstraction (mutex, semaphore,
	  message queue, thread, heap, time and software timer) onto Zephyr
	  kernel APIs. An adapter selects this and maps its own RTOS API onto
	  the osal_* primitives instead of re-implementing the same k_*
	  boilerplate.

	  This is selected by a consumer's Kconfig; it is not meant to be
	  enabled directly by applications.

if OSAL

config OSAL_DYNAMIC_ALLOC
	bool "Allocate control blocks from the heap"
	default y
	select DYNAMIC_THREAD
	select DYNAMIC_THREAD_ALLOC
	select THREAD_STACK_INFO
	help
	  Allocate control blocks (mutex, semaphore, queue, ...) and thread
	  stacks from the system heap with k_malloc / k_thread_stack_alloc.

	  Disable to use fixed-size static pools instead, for environments
	  that create OSAL objects before the heap is available or that
	  forbid dynamic allocation. Pool sizes are then bounded by the
	  OSAL_MAX_* options below.

if !OSAL_DYNAMIC_ALLOC

config OSAL_MAX_OBJECTS
	int "Maximum control blocks per object type (static pools)"
	default 8
	help
	  Size of the fixed pool for each control-block type (mutex,
	  semaphore, queue, event, timer, fifo, mempool). Allocation beyond
	  this count fails. Only used when OSAL_DYNAMIC_ALLOC is disabled.

config OSAL_MAX_THREADS
	int "Maximum OSAL-managed threads (static pools)"
	default 4
	help
	  Size of the fixed thread and stack pool. Only used when
	  OSAL_DYNAMIC_ALLOC is disabled.

config OSAL_THREAD_STACK_SIZE
	int "Static thread stack size (bytes)"
	default 2048
	help
	  Stack size for each statically pooled OSAL thread. The stack size
	  requested at osal_thread_create() must not exceed this. Only used
	  when OSAL_DYNAMIC_ALLOC is disabled.

endif # !OSAL_DYNAMIC_ALLOC

module = OSAL
module-str = osal
source "subsys/logging/Kconfig.template.log_config"

endif # OSAL
```

## subsys/pm/Kconfig
```kconfig
# Copyright (c) 2014-2015 Wind River Systems, Inc.
# Copyright (c) 2016 Intel Corporation
# SPDX-License-Identifier: Apache-2.0

menu "Power Management"

config HAS_PM
	bool
	help
	  This option must be selected by SoCs that provide PM hooks, that is,
	  calls to configure low-power states.

config PM
	bool "System Power Management"
	depends on SYS_CLOCK_EXISTS && HAS_PM
	help
	  This option enables the board to implement extra power management
	  policies whenever the kernel becomes idle. The kernel informs the
	  power management subsystem of the number of ticks until the next kernel
	  timer is due to expire.

rsource "policy/Kconfig"

if PM

module = PM
module-str = System Power Management
source "subsys/logging/Kconfig.template.log_config"

config PM_STATS
	bool "System Power Management Stats"
	depends on STATS
	help
	  Enable System Power Management Stats.

config PM_S2RAM
	bool "Suspend-to-RAM (S2RAM)"
	depends on ARCH_HAS_SUSPEND_TO_RAM
	help
	  This option enables suspend-to-RAM (S2RAM).
	  When enabled on Cortex-M, and a 'zephyr,memory-region' compatible node with nodelabel
	  'pm_s2ram' is defined in DT, _cpu_context symbol (located in arch/arm/core/cortex_m/pm_s2ram.c)
	  is placed in linker section given by 'zephyr,memory-region' property of aforementioned node.

config PM_S2RAM_CUSTOM_MARKING
	bool "Use custom marking functions"
	depends on PM_S2RAM
	help
	  By default a magic word in RAM is used to mark entering suspend-to-RAM. Enabling
	  this option allows custom implementation of functions which handle the marking.

config PM_NEED_ALL_DEVICES_IDLE
	bool "System Low Power Mode Needs All Devices Idle"
	depends on PM_DEVICE && !SMP
	help
	  When this option is enabled, check that no devices are busy before
	  entering into system low power mode.

choice PM_PREWAKEUP_CONV_MODE
	prompt "Pre-wakeup microseconds to ticks conversion method"
	default PM_PREWAKEUP_CONV_MODE_NEAR
	help
	  Exit latency for each power state is given in microseconds. It is converted
	  to ticks and system clock is set to wake up the core earlier before scheduled
	  wake up. This option specifies rounding that is used when converting exit
	  latency from microseconds to system ticks.

config PM_PREWAKEUP_CONV_MODE_NEAR
	bool "Nearest"

config PM_PREWAKEUP_CONV_MODE_CEIL
	bool "Round up"

config PM_PREWAKEUP_CONV_MODE_FLOOR
	bool "Round down"

endchoice

endif # PM

config PM_DEVICE
	bool "Device Power Management"
	help
	  This option enables the device power management interface.  The
	  interface implemented by device drivers are called by the power
	  management subsystem. This allows device drivers to do any
	  necessary power management operations like turning off
	  device clocks and peripherals. Device drivers may also save
	  and restore states in these hook functions.

if PM_DEVICE

module = PM_DEVICE
module-str = Device Power Management
source "subsys/logging/Kconfig.template.log_config"

config PM_DEVICE_POWER_DOMAIN
	bool "Power domain"
	depends on PM_DEVICE
	default y
	help
	  Enable support for Power Domain. With power domain enabled,
	  devices that depend on a domain will be notified when this
	  domain is suspended or resumed.

config PM_DEVICE_POWER_DOMAIN_DYNAMIC
	bool "Dynamically bind devices to a Power Domain"
	depends on PM_DEVICE_POWER_DOMAIN && DEVICE_DEPS_DYNAMIC
	help
	  Enable support for dynamically bind devices to a Power Domain.

config PM_DEVICE_POWER_DOMAIN_DYNAMIC_NUM
	int "Number of devices that can dynamically be bind to a Power Domain"
	depends on PM_DEVICE_POWER_DOMAIN_DYNAMIC
	default 1
	help
	  The number of devices that can dynamically be bind to a Power Domain.

config PM_DEVICE_RUNTIME
	bool "Runtime Device Power Management"
	select EVENTS
	help
	  Enable Runtime Power Management to save power. With device runtime PM
	  enabled, devices can be suspended or resumed based on the device
	  usage even while the CPU or system is running.

if PM_DEVICE_RUNTIME

config PM_DEVICE_DRIVER_NEEDS_DEDICATED_WQ
	bool

config PM_DEVICE_RUNTIME_ASYNC
	bool "Asynchronous device runtime power management"
	default y
	help
	  Use this option to enable support for asynchronous operation
	  in the power management device runtime.

if PM_DEVICE_RUNTIME_ASYNC

choice PM_DEVICE_RUNTIME_WQ
	prompt "Work queue to be used by pm device runtime async"
	default PM_DEVICE_RUNTIME_USE_DEDICATED_WQ if PM_DEVICE_DRIVER_NEEDS_DEDICATED_WQ
	default PM_DEVICE_RUNTIME_USE_SYSTEM_WQ

config PM_DEVICE_RUNTIME_USE_SYSTEM_WQ
	bool "Use the system workqueue"
	help
	  When this option is enabled the power management subsystem will
	  use the system workqueue instead of defining its own queue.

config PM_DEVICE_RUNTIME_USE_DEDICATED_WQ
	bool "Use a dedicated workqueue"
	help
	  When this option is enabled the power management subsystem will
	  use a dedicated workqueue instead of the system work queue.

if PM_DEVICE_RUNTIME_USE_DEDICATED_WQ
config PM_DEVICE_RUNTIME_DEDICATED_WQ_STACK_SIZE
	int "Stack size for pm runtime async workqueue"
	default 1024
	help
	  Defines the size of the stack on the workqueue used for
	  async operations.

config PM_DEVICE_RUNTIME_DEDICATED_WQ_PRIO
	int "PM device runtime workqueue priority. Should be pre-emptible."
	default SYSTEM_WORKQUEUE_PRIORITY if PM_DEVICE_RUNTIME_USE_SYSTEM_WQ
	default 0

config PM_DEVICE_RUNTIME_DEDICATED_WQ_INIT_PRIO
	int "PM device runtime workqueue init priority"
	default 50
	help
	  Init priority level to setup the device runtime workqueue.
endif #PM_DEVICE_RUNTIME_USE_DEDICATED_WQ
endchoice

endif # PM_DEVICE_RUNTIME_ASYNC
endif # PM_DEVICE_RUNTIME

config PM_DEVICE_SHELL
	bool "Device Power Management shell"
	depends on SHELL
	help
	  Enable the device power management shell, for triggering device power
	  management events through the shell interface.

config PM_DEVICE_SYSTEM_MANAGED
	bool "System-Managed Device Power Management"
	default y if !PM_DEVICE_RUNTIME
	help
	  This option enables the system-managed device power
	  management.  The power management subsystem will suspend
	  devices before entering a low power state. Conversely, after
	  the core wakes up from low power mode all suspended devices
	  are resumed.


endif # PM_DEVICE

endmenu
```

## subsys/pm/policy/Kconfig
```kconfig
# Copyright (c) 2024 Nordic Semiconductor ASA
# SPDX-License-Identifier: Apache-2.0

if PM
choice PM_POLICY
	prompt "Idle State Power Management Policy"
	default PM_POLICY_DEFAULT
	help
	  Select the idle state power management policy.

config PM_POLICY_DEFAULT
	bool "Default PM policy"
	help
	  This option selects the default PM policy. Default policy is based
	  on CPU residency times and other constraints imposed by the drivers or
	  application.

config PM_POLICY_CUSTOM
	bool "Custom PM Policy"
	help
	  This options allows applications to override the default policy with
	  a custom implementation.

endchoice

config PM_POLICY_DEVICE_CONSTRAINTS
	bool "Power state constraints per device"
	help
	  This option allows devices to have a list of power states
	  that when the system transition to them, cause power loss in the device.
	  This used to set and release power state constraints when
	  it is needed by the device.

endif # PM

config PM_POLICY_LATENCY_STANDALONE
	bool "Allow gathering latency requirements in standalone mode"
	depends on !PM
	help
	  This option allows using the pm_policy_latency* APIs to gather latency
	  requirements on systems that do not support PM (e.g. systems without
	  CPU idle states). Because the API has a subscription mechanism, it can
	  be useful to perform system-level adjustments based on latency
	  requirements gathered from multiple system components.
```

## subsys/pmci/Kconfig
```kconfig
# PMCI configuration options

# Copyright (c) 2025 Intel Corporation
# SPDX-License-Identifier: Apache-2.0

menu "Platform Management Communications Infrastructure (PMCI)"

# zephyr-keep-sorted-start

source "subsys/pmci/mctp/Kconfig"

# zephyr-keep-sorted-stop

endmenu
```
