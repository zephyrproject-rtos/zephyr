## subsys/pmci/mctp/Kconfig
```kconfig
# Copyright (c) 2024 Intel Corporation
# Copyright 2025 NXP
# SPDX-License-Identifier: Apache-2.0

menuconfig MCTP
	bool "Management Component Transport Protocol [EXPERIMENTAL]"
	select EXPERIMENTAL
	help
	  Enable the MCTP Subsystem and Module Usage

if MCTP

config MCTP_HEAP_SIZE
	int "MCTP Heap Size"
	default 2048
	help
	  MCTP requires a heap for allocating packet buffers. A dedicated
	  heap is provided to MCTP at startup avoiding the need to specify
	  libmctp's allocation operations. This setting defines the size of
	  the dedicated MCTP heap in bytes. Defaults to 1KB for small packets.

	  When multi-packet message reassembly is required, this must be large
	  enough to hold at least one MCTP context struct plus one reassembly
	  buffer of CONFIG_MCTP_MAX_MESSAGE_SIZE bytes per active endpoint.

config MCTP_MAX_MESSAGE_SIZE
	int "Maximum MCTP reassembly message size"
	default 1024
	help
	  Maximum size in bytes of an MCTP message that can be reassembled
	  from multiple MCTP packets. libmctp allocates a buffer of this size
	  from the MCTP heap whenever a multi-packet message begins arriving,
	  so CONFIG_MCTP_HEAP_SIZE must be large enough to hold at least one
	  such buffer per concurrently-active reassembly context.

config MCTP_UART
	bool "MCTP UART Binding"
	depends on UART_ASYNC_API
	help
	  Build the MCTP UART binding to use MCTP over Zephyr's async UART
	  interface.

config MCTP_I2C_GPIO_CONTROLLER
	bool "MCTP I2C+GPIO Controller Binding"
	depends on I2C
	depends on I2C_RTIO
	depends on GPIO
	help
	  Build the MCTP I2C+GPIO controller binding to use MCTP over Zephyr's I2C RTIO
	  interface and GPIO interrupts from targets to signal their request to write.

config MCTP_I2C_GPIO_TARGET
	bool "MCTP I2C+GPIO Target Binding"
	depends on I2C
	depends on GPIO
	help
	  Build the MCTP I2C+GPIO target binding to use MCTP over Zephyr's I2C target
	  interface and GPIO to signal writes to the bus controller.

config MCTP_I3C_CONTROLLER
	bool "MCTP I3C Controller Binding"
	depends on I3C_CONTROLLER
	depends on I3C_USE_IBI
	help
	  Build the MCTP I3C controller binding to use MCTP over Zephyr's I3C
	  interface and IBI to signal from targets to a request to send messages.

config MCTP_I3C_TARGET
	bool "MCTP I3C Target Binding"
	depends on I3C_TARGET
	depends on I3C_USE_IBI
	depends on I3C_TARGET_BUFFER_MODE
	help
	  Build the MCTP I3C target binding to use MCTP over Zephyr's I3C target
	  interface and IBI to signal a request to send messages to the bus controller.

config MCTP_USB
	bool "MCTP USB Binding"
	depends on USB_DEVICE_STACK_NEXT
	help
	  Build the MCTP USB binding to use MCTP over Zephyr's USB device interface.

module = MCTP
module-str = MCTP
source "subsys/logging/Kconfig.template.log_config"

rsource "Kconfig.usb"

endif
```

## subsys/pmci/mctp/Kconfig.usb
```kconfig
# Copyright 2025 NXP
# SPDX-License-Identifier: Apache-2.0

if MCTP_USB

config MCTP_USB_TX_TIMEOUT
	int "MCTP USB transmit timeout (ms)"
	default 1000
	help
	  Set the MCTP USB transmit timeout, in milliseconds.

module = MCTP_USB_CLASS
module-str = mctp usb class
default-count = 1

source "subsys/usb/device_next/class/Kconfig.template.instances_count"

endif
```

## subsys/pmci/pldm/Kconfig
```kconfig
# Copyright (c) 2025 Intel Corporation
# SPDX-License-Identifier: Apache-2.0

menuconfig PLDM
	bool "Platform Level Data Model [EXPERIMENTAL]"
	select EXPERIMENTAL
	help
	  Enable the PLDM Subsystem and Module Usage
```

## subsys/portability/Kconfig
```kconfig
# Copyright (c) 2021 Intel Corporation
# SPDX-License-Identifier: Apache-2.0

menu "Portability"

source "subsys/portability/cmsis_rtos_v1/Kconfig"

source "subsys/portability/cmsis_rtos_v2/Kconfig"

endmenu
```

## subsys/portability/cmsis_rtos_v1/Kconfig
```kconfig
# Copyright (c) 2018 Intel Corporation
# SPDX-License-Identifier: Apache-2.0

config CMSIS_RTOS_V1
	bool "CMSIS RTOS v1 API"
	depends on THREAD_CUSTOM_DATA
	depends on POLL
	depends on THREAD_STACK_INFO
	help
	  This enables CMSIS RTOS v1 API support. This is an OS-integration
	  layer which allows applications using CMSIS RTOS APIs to build on
	  Zephyr.

if CMSIS_RTOS_V1

config CMSIS_THREAD_MAX_STACK_SIZE
	int "Max stack size threads can be allocated in CMSIS RTOS application"
	default 4096 if COVERAGE_GCOV
	default 512
	help
	  Mention max stack size threads can be allocated in CMSIS RTOS application.

config CMSIS_TIMER_MAX_COUNT
	int "Maximum timer count in CMSIS application"
	default 5
	range 0 255
	help
	  Mention maximum number of timers in CMSIS compliant application.

config CMSIS_MUTEX_MAX_COUNT
	int "Maximum mutex count in CMSIS application"
	default 5
	range 0 255
	help
	  Mention maximum number of mutexes in CMSIS compliant application.

config CMSIS_SEMAPHORE_MAX_COUNT
	int "Maximum semaphore count in CMSIS application"
	default 5
	range 0 255
	help
	  Mention maximum number of semaphores in CMSIS compliant application.

endif
```

## subsys/portability/cmsis_rtos_v2/Kconfig
```kconfig
# Copyright (c) 2018 Intel Corporation
# SPDX-License-Identifier: Apache-2.0

config CMSIS_RTOS_V2
	bool "CMSIS RTOS v2 API"
	depends on POLL
	depends on THREAD_NAME
	depends on THREAD_STACK_INFO
	depends on THREAD_MONITOR
	depends on INIT_STACKS
	depends on NUM_PREEMPT_PRIORITIES >= 56
	help
	  This enables CMSIS RTOS v2 API support. This is an OS-integration
	  layer which allows applications using CMSIS RTOS V2 APIs to build
	  on Zephyr.

if CMSIS_RTOS_V2
config CMSIS_V2_THREAD_MAX_COUNT
	int "Maximum thread count in CMSIS RTOS V2 application"
	default 15
	range 0 255
	help
	  Mention max number of threads in CMSIS RTOS V2 compliant application.
	  There's a limitation on the number of threads due to memory
	  related constraints.

config CMSIS_V2_THREAD_DYNAMIC_MAX_COUNT
	int "Maximum dynamic thread count in CMSIS RTOS V2 application"
	default 0
	range 0 255
	help
	  Mention max number of dynamic threads in CMSIS RTOS V2 compliant
	  application. There's a limitation on the number of threads due to memory
	  related constraints. Dynamic threads are a subset of all other CMSIS
	  threads i.e. they also count towards that maximum too.

config CMSIS_V2_THREAD_MAX_STACK_SIZE
	int "Max stack size threads can be allocated in CMSIS RTOS V2 application"
	default 4096 if COVERAGE_GCOV
	default 512
	help
	  Mention max stack size threads can be allocated in CMSIS RTOS V2 application.

config CMSIS_V2_THREAD_DYNAMIC_STACK_SIZE
	int "Dynamic stack size threads are allocated in CMSIS RTOS V2 application"
	default 4096 if COVERAGE_GCOV
	default 512
	help
	  Mention dynamic stack size threads are allocated in CMSIS RTOS V2 application.

config CMSIS_V2_TIMER_MAX_COUNT
	int "Maximum timer count in CMSIS RTOS V2 application"
	default 5
	range 0 255
	help
	  Mention maximum number of timers in CMSIS RTOS V2 compliant application.

config CMSIS_V2_MUTEX_MAX_COUNT
	int "Maximum mutex count in CMSIS RTOS V2 application"
	default 5
	range 0 255
	help
	  Mention max number of mutexes in CMSIS RTOS V2 compliant application.

config CMSIS_V2_SEMAPHORE_MAX_COUNT
	int "Maximum semaphore count in CMSIS RTOS V2 application"
	default 5
	range 0 255
	help
	  Mention max number of semaphores in CMSIS RTOS V2 compliant application.

config CMSIS_V2_MEM_SLAB_MAX_COUNT
	int "Maximum mem slab count in CMSIS RTOS V2 application"
	default 5
	range 0 255
	help
	  Mention maximum number of memory slabs in CMSIS RTOS V2 compliant application.

config CMSIS_V2_MEM_SLAB_MAX_DYNAMIC_SIZE
	int "Maximum dynamic mem slab/pool size in CMSIS RTOS V2 application"
	default 0
	help
	  Mention maximum dynamic size of memory slabs/pools in CMSIS RTOS V2 compliant application.

config CMSIS_V2_MSGQ_MAX_COUNT
	int "Maximum message queue count in CMSIS RTOS V2 application"
	default 5
	range 0 255
	help
	  Mention maximum number of message queues in CMSIS RTOS V2 compliant application.

config CMSIS_V2_MSGQ_MAX_DYNAMIC_SIZE
	int "Maximum dynamic message queue size in CMSIS RTOS V2 application"
	default 0
	help
	  Mention maximum dynamic size of message queues in CMSIS RTOS V2 compliant application.

config CMSIS_V2_EVT_FLAGS_MAX_COUNT
	int "Maximum event flags count in CMSIS RTOS V2 application"
	default 5
	range 0 255
	help
	  Mention maximum number of event flags in CMSIS RTOS V2 compliant application.
endif
```

## subsys/portability/freertos/Kconfig
```kconfig
# SPDX-File-CopyrightText: Copyright The Zephyr Project Contributors
# SPDX-License-Identifier: Apache-2.0

config FREERTOS
	bool "FreeRTOS compatibility layer"
	help
	  Enable FreeRTOS API translation layer allowing integration of FreeRTOS application,
	  libraries, or binaries into Zephyr.

if FREERTOS

config FREERTOS_HEAP_SIZE
	int "Size of the memory heap used internally by the shim"
	default 8192
	help
	  Size in bytes to dedicate to the heap shared across all the FreeRTOS functions,
	  internal data structures or FreeRTOS allocation functions alike.

endif # FREERTOS
```

## subsys/portability/posix/Kconfig
```kconfig
# Copyright (c) 2024 Meta
# Copyright (c) 2025 Tenstorrent AI ULC
#
# SPDX-License-Identifier: Apache-2.0

menu "POSIX API Support"

# POSIX Subprofile Definitions
rsource "Kconfig.profile"

# Toolchain hooks for external implementations
rsource "Kconfig.toolchain"

# POSIX C Library Extensions
# This menu is for POSIX Option Groups that do not require OS support.
menu "POSIX C Library Extensions"
rsource "c_lang_support_r/Kconfig"
rsource "c_lib_ext/Kconfig"
endmenu

# POSIX System Interfaces
menuconfig POSIX_SYSTEM_INTERFACES
	bool "POSIX System Interfaces"
	select NATIVE_LIBC_INCOMPATIBLE
	help
	  Select 'y' here to support POSIX System Interfaces within Zephyr.

	  Options in this menu are organized by POSIX subprofiling Option Group.

	  For more information, see
	  https://pubs.opengroup.org/onlinepubs/9699919799/xrat/V4_subprofiles.html


if POSIX_SYSTEM_INTERFACES
rsource "options/Kconfig"

# POSIX Shell utilities
rsource "shell/Kconfig"
endif

endmenu

# Eventfd Support (not officially POSIX)
rsource "eventfd/Kconfig"
```

## subsys/portability/posix/options/Kconfig.clock_selection
```kconfig
# Copyright (c) 2025 Tenstorrent AI ULC
#
# SPDX-License-Identifier: Apache-2.0

config POSIX_CLOCK_SELECTION
	bool "POSIX Clock Selection"
	help
	  Select 'y' here and Zephyr will provide an implementation of the POSIX_CLOCK_SELECTION Option
	  Group, which includes the functions clock_nanosleep(), pthread_condattr_getclock(),
	  pthread_condattr_setclock().

	  For more information, please see
	  https://pubs.opengroup.org/onlinepubs/9699919799/xrat/V4_subprofiles.html
```

## subsys/portability/posix/options/Kconfig.sched
```kconfig
# Copyright (c) 2023 Intel Corporation
#
# SPDX-License-Identifier: Apache-2.0

menu "POSIX scheduler options"

config POSIX_PRIORITY_SCHEDULING
	bool "POSIX priority-based process scheduling"
	help
	  This enables POSIX scheduling APIs (_POSIX_PRIORITY_SCHEDULING).

	  Since Zephyr does not yet support processes, most of this behaviour is undefined, except for
	  use of sched_get_priority_min() and sched_get_priority_max().

	  For more information, please see
	  https://pubs.opengroup.org/onlinepubs/9699919799/xrat/V4_port.html#tag_24_03_04
	  https://pubs.opengroup.org/onlinepubs/9699919799/functions/sched_get_priority_max.html

endmenu
```

## subsys/portability/posix/options/Kconfig.sync_io
```kconfig
# Copyright (c) 2024 Tenstorrent AI ULC
#
# SPDX-License-Identifier: Apache-2.0

menu "POSIX synchronized I/O"

config POSIX_FSYNC
	bool "Support for fsync()"
	help
	  Select 'y' here and Zephyr will provide an implementation of fsync().

	  For more information, please see
	  https://pubs.opengroup.org/onlinepubs/9699919799/functions/fsync.html


config POSIX_SYNCHRONIZED_IO
	bool "POSIX synchronized I/O"
	select POSIX_FSYNC
	help
	  Select 'y' here and Zephyr will provide an implementation of fdatasync(), fsync(),
	  and msync().

	  For more information, please see
	  https://pubs.opengroup.org/onlinepubs/9699919799/functions/msync.html
	  https://pubs.opengroup.org/onlinepubs/9699919799/functions/fdatasync.html

if POSIX_FSYNC

# These options are intended to be used for compatibility with external POSIX
# implementations such as those in Newlib or Picolibc.

config POSIX_FILE_SYSTEM_ALIAS_FSYNC
	bool
	help
	  Select 'y' here and Zephyr will provide an alias for fsync() as _fsync().

endif # POSIX_FSYNC

endmenu
```
