## subsys/net/lib/tftp/Kconfig
```kconfig
# Socket TFTP Library for Zephyr

# Copyright (c) 2020 InnBlue
# SPDX-License-Identifier: Apache-2.0

config TFTP_LIB
	bool "Socket TFTP Library Support [EXPERIMENTAL]"
	select EXPERIMENTAL
	select NET_SOCKETS
	help
	  Enable the Zephyr TFTP Library

if TFTP_LIB

module=TFTP
module-dep=NET_LOG
module-str=Log level for TFTP
module-help=Enables tftp debug messages.
source "subsys/net/Kconfig.template.log_config.net"

config TFTPC_REQUEST_TIMEOUT
	int "Maximum amount of time the TFTP Client will wait for a response from the server."
	default 5000
	help
	  Maximum amount of time (in msec) that the TFTP Client will wait for
	  data from the TFTP Server. Once this time has elapsed, the TFTP Client
	  will assume that the Server failed and close the connection.

config TFTPC_REQUEST_RETRANSMITS
	int "Number of times the TFTP Client will retransmit the request to the server."
	default 5
	help
	  Once the TFTP Client sends out a request, it will wait
	  TFTPC_REQUEST_TIMEOUT msecs for the data to arrive from the TFTP Server.
	  However, if it doesn't arrive within the given time we will re-transmit
	  the request to the server in hopes that the server will respond within
	  time to this request. This number dictates the number of times we will
	  do re-tx of our request before giving up and exiting.

config TFTPS
	bool "TFTP Server Support [EXPERIMENTAL]"
	select FILE_SYSTEM
	help
	  Enable the Zephyr TFTP Server implementation.
	  The server supports multiple concurrent clients, serves files from
	  all mounted file systems, and supports UDP socket and serial transports.

if TFTPS

config TFTPS_MAX_CLIENTS
	int "Maximum number of concurrent TFTP client connections"
	default 1
	help
	  Maximum number of concurrent client connections the TFTP server
	  can handle simultaneously. Each client connection requires a
	  session structure.

config TFTPS_REQUEST_TIMEOUT
	int "TFTP Server request timeout in milliseconds"
	default 5000
	help
	  Maximum amount of time (in milliseconds) that the TFTP server
	  will wait for client packets before timing out a session.
	  Sessions that timeout are automatically cleaned up.

config TFTPS_POLL_TIMEOUT_MS
	int "TFTP Server polling timeout in milliseconds"
	default 100
	help
	  Interval (in milliseconds) that the server checks for events
	  on active sockets. This also impacts the granularity of session timeouts.

config TFTPS_MAX_RETRIES
	int "Maximum number of retries for TFTP operations"
	default 5
	help
	  Maximum number of times the server will retry failed operations
	  before giving up.

config TFTPS_STACK_SIZE
	int "TFTP Server thread stack size"
	default 2048
	help
	  Stack size for the TFTP server thread. Increase this if you
	  experience stack overflow issues with large file transfers
	  or many concurrent clients.

endif # TFTPS

endif # TFTP_LIB
```

## subsys/net/lib/tls_credentials/Kconfig
```kconfig
# Copyright (c) 2018 Nordic Semiconductor ASA
# SPDX-License-Identifier: Apache-2.0

menuconfig TLS_CREDENTIALS
	bool "TLS credentials management"
	help
	  Enable TLS credentials management subsystem.

if TLS_CREDENTIALS

module = TLS_CREDENTIALS
module-str = tls_credentials
source "subsys/logging/Kconfig.template.log_config"

choice TLS_CREDENTIALS_BACKEND
	prompt "TLS credentials management backend"
	depends on TLS_CREDENTIALS
	default TLS_CREDENTIALS_BACKEND_VOLATILE
	help
	  TLS credentials management backend implementation.

config TLS_CREDENTIALS_BACKEND_VOLATILE
	bool "TLS credentials management volatile backend"
	help
	  TLS credentials management volatile backend implementation,
	  storing credentials in system runtime memory.

config TLS_CREDENTIALS_BACKEND_PROTECTED_STORAGE
	bool "TLS credentials management protected storage backend"
	depends on BUILD_WITH_TFM
	help
	  TLS credentials management backend using the Protected Storage
	  API to store credentials with integrity check against physical
	  attacks and keeps entries across system reboot.

endchoice

config TLS_MAX_CREDENTIALS_NUMBER
	int "Maximum number of TLS credentials"
	default 4
	help
	  Maximum number of TLS credentials that can be registered.

config TLS_CREDENTIAL_FILENAMES
	bool "Specify TLS credential filenames"
	depends on NET_SOCKETS_OFFLOAD
	help
	  Allows clients of the socket APIs to specify filenames
	  of security certificates and private keys
	  to use during subsequent TLS/SSL negotiations.
	  The secure files will have been previously provisioned to the
	  device's secure file system; eg, via a vendor tool or
	  by executing a separate binary.
	  This option is currently only available for secure
	  socket offload devices.

endif # TLS_CREDENTIALS
```

## subsys/net/lib/trickle/Kconfig
```kconfig
# Trickle Library for Zephyr

# Copyright (c) 2016 Intel Corporation.
# SPDX-License-Identifier: Apache-2.0

config NET_TRICKLE
	bool "Trickle library"
	help
	  Normally this is enabled automatically if needed,
	  so say 'n' if unsure.

if NET_TRICKLE
module = NET_TRICKLE
module-dep = NET_LOG
module-str = Log level for Trickle algorithm
module-help = Enables Trickle library output debug messages
source "subsys/net/Kconfig.template.log_config.net"
endif # NET_TRICKLE
```

## subsys/net/lib/websocket/Kconfig
```kconfig
# Copyright (c) 2019 Intel Corporation
#
# SPDX-License-Identifier: Apache-2.0
#

menuconfig WEBSOCKET_CLIENT
	bool "Websocket client support [EXPERIMENTAL]"
	select NET_SOCKETS
	select HTTP_PARSER
	select HTTP_PARSER_URL
	select HTTP_CLIENT
	select MBEDTLS
	select BASE64
	help
	  Enable Websocket client library.

if WEBSOCKET_CLIENT

config WEBSOCKET_MAX_CONTEXTS
	int "Max number of websockets to allocate"
	default 1
	help
	  How many Websockets can be created in the system.

module = NET_WEBSOCKET
module-dep = NET_LOG
module-str = Log level for Websocket
module-help = Enable debug message of Websocket client library.
source "subsys/net/Kconfig.template.log_config.net"

endif
```

## subsys/net/lib/wifi_credentials/Kconfig
```kconfig
#
# Copyright (c) 2024 Nordic Semiconductor ASA
#
# SPDX-License-Identifier: Apache-2.0
#

menuconfig WIFI_CREDENTIALS
	bool "WIFI credentials management"
	select EXPERIMENTAL
	help
	  Enable WiFi credentials management subsystem.

if WIFI_CREDENTIALS

module = WIFI_CREDENTIALS
module-str = wifi_credentials
source "subsys/logging/Kconfig.template.log_config"

choice WIFI_CREDENTIALS_BACKEND
	prompt "WiFi credentials backend"
	default WIFI_CREDENTIALS_BACKEND_PSA if BUILD_WITH_TFM
	default WIFI_CREDENTIALS_BACKEND_SETTINGS
	default WIFI_CREDENTIALS_BACKEND_NONE if WIFI_CREDENTIALS_STATIC
	help
	  Selects whether to use PSA Protected Storage or the Zephyr settings subsystem
	  for credentials storage.

config WIFI_CREDENTIALS_BACKEND_SETTINGS
	bool "Zephyr Settings"
	depends on SETTINGS
	depends on !SETTINGS_NONE

config WIFI_CREDENTIALS_BACKEND_PSA
	bool "PSA Protected Storage"
	depends on BUILD_WITH_TFM

config WIFI_CREDENTIALS_BACKEND_NONE
	bool "No credentials storage"
	depends on WIFI_CREDENTIALS_STATIC

endchoice

config WIFI_CREDENTIALS_MAX_ENTRIES
	int "Number of supported WiFi credentials"
	default 2
	help
	  This detemines how many different WiFi networks can be configured at a time.

config WIFI_CREDENTIALS_SAE_PASSWORD_LENGTH
	int "Max. length of SAE password"
	default 128
	help
	  There is no official limit on SAE password length,
	  but for example Linux 6.0 has a hardcoded limit of 128 bytes.

config WIFI_CREDENTIALS_SHELL
	bool "Shell commands to manage Wi-Fi credentials"
	default y
	depends on SHELL
	select SHELL_GETOPT
	select GETOPT_LONG
	depends on !WIFI_CREDENTIALS_BACKEND_NONE

config WIFI_CREDENTIALS_CONNECT_STORED
	bool "Add command to connect to stored networks directly."
	default y

if WIFI_CREDENTIALS_CONNECT_STORED

config WIFI_CREDENTIALS_CONNECT_STORED_CONNECTION_TIMEOUT
	int "Connection timeout"
	default 30
	help
	   Wait period before falling back to the next entry in the list of stored SSIDs.

endif # WIFI_CREDENTIALS_CONNECT_STORED

endif # WIFI_CREDENTIALS

config WIFI_CREDENTIALS_STATIC
	bool "Static Wi-Fi network configuration"

if WIFI_CREDENTIALS_STATIC

config WIFI_CREDENTIALS_STATIC_SSID
	string "SSID of statically configured WiFi network"

config WIFI_CREDENTIALS_STATIC_PASSWORD
	string "Password of statically configured Wi-Fi network"
	default ""

choice WIFI_CREDENTIALS_STATIC_TYPE
	prompt "Static Wi-Fi network security type"
	default WIFI_CREDENTIALS_STATIC_TYPE_PSK

config WIFI_CREDENTIALS_STATIC_TYPE_OPEN
	bool "OPEN"

config WIFI_CREDENTIALS_STATIC_TYPE_PSK
	bool "WPA2-PSK"

config WIFI_CREDENTIALS_STATIC_TYPE_PSK_SHA256
	bool "WPA2-PSK-SHA256"

config WIFI_CREDENTIALS_STATIC_TYPE_SAE
	bool "SAE"

config WIFI_CREDENTIALS_STATIC_TYPE_WPA_PSK
	bool "WPA-PSK"

endchoice

endif
```

## subsys/net/lib/wireguard/Kconfig
```kconfig
# Wireguard VPN service for Zephyr

# Copyright (c) 2026 Nordic Semiconductor
# SPDX-License-Identifier: Apache-2.0

config WIREGUARD
	bool "Wireguard VPN service [EXPERIMENTAL]"
	depends on NET_UDP
	select NET_VPN
	select NET_IPV4_MAPPING_TO_IPV6 if NET_IPV4 && NET_IPV6
	select NET_MGMT
	select NET_MGMT_EVENT
	select NET_L2_DUMMY
	select NET_L2_VIRTUAL
	select NET_L2_VIRTUAL_MGMT
	select NET_IP_DSCP_ECN
	select BASE64
	select EXPERIMENTAL
	help
	  Select 'y' if you want to enable Wireguard VPN service.

if WIREGUARD

config WIREGUARD_BUF_COUNT
	int "Internal temp network buffer count"
	default 2
	range 1 256
	help
	  How many network buffers to allocate for temporary
	  use. Each buffer occupies WIREGUARD_BUF_LEN amount
	  of bytes. Total amount of bytes needed is
	  WIREGUARD_BUF_COUNT * WIREGUARD_BUF_LEN
	  The temp buffers are used for decrypting (in RX) and
	  encrypting (for TX) the data.

config WIREGUARD_BUF_LEN
	int "Internal temp network buffer length"
	default 1500
	range 1328 1500
	help
	  How long is one network buffer. It varies between
	  minimum IPv6 MTU length and Ethernet MTU (minus Wireguard
	  header length which is 16 bytes, auth tag len (16 bytes)
	  and extra 16 byte padding).

config WIREGUARD_MAX_PEER
	int "Maximum number of peer connections"
	default 1
	range 1 256
	help
	  How many Wireguard VPN connections are possible.

config WIREGUARD_MAX_SRC_IPS
	int "Maximum number of peer source IP addresses"
	default 2
	range 1 256
	help
	  How many IP addresses are allowed / peer.

config WIREGUARD_INTERFACE
	string "Network interface to use"
	help
	  Leave empty if you want to use all network interfaces
	  for the VPN connections. If set, then all VPN traffic
	  is routed via this interface.

config WIREGUARD_PORT
	int "UDP port to use"
	range 0 $(UINT16_MAX)
	default 51820
	help
	  What UDP port to use when listening connections (in server role)
	  or when connecting to other hosts.
	  If set to 0, then let Wireguard code to select the port.

module = WIREGUARD
module-dep = NET_LOG
module-str = Log level for Wireguard VPN service
module-help = Enables Wireguard to output debug messages
source "subsys/net/Kconfig.template.log_config.net"

config WIREGUARD_TXRX_DEBUG
	bool "Debug received and sent virtual interface packets"
	depends on WIREGUARD_LOG_LEVEL_DBG
	help
	  Enables printing of received and sent network packets.
	  This can produce lot of output so it is disabled by default.
	  This prints data in the virtual interface (wg0) level.

endif # WIREGUARD
```

## subsys/net/lib/zoap/Kconfig
```kconfig
# Kconfig - Zoap, CoAP implementation for Zephyr

#
# Copyright (c) 2015 Intel Corporation
#
# SPDX-License-Identifier: Apache-2.0
#

config ZOAP
	bool
	prompt "CoAP Support"
	default n
	help
	  This option enables the Zoap implementation of CoAP.

# This setting is only used by unit test. Do not enable it in applications
config ZOAP_TEST_API_ENABLE
	bool "Enable test API for ZoAP unit tests"
	default n
	depends on ZOAP
	help
	  Do not enable this for normal use.

config ZOAP_WELL_KNOWN_BLOCK_WISE
	bool
	prompt "CoAP ./well-known/core services block wise support"
	default n
	depends on ZOAP
	help
	  This option enables the block wise support of CoAP response
	  to ./well-known/core request. Without this option all resource's
	  information will be sent in a single IP packet (can be multiple
	  fragments depends on MTU size). This will be useful in mesh kind
	  of networks.

config ZOAP_WELL_KNOWN_BLOCK_WISE_SIZE
	int
	prompt "CoAP ./well-known/core services block wise support"
	default 32
	depends on ZOAP_WELL_KNOWN_BLOCK_WISE
	help
	  Maximum size of CoAP block. Valid values are 16, 32, 64, 128,
	  256, 512 and 1024.
```

## subsys/net/lib/zperf/Kconfig
```kconfig
# Copyright (c) 2022 Nordic Semiconductor ASA
# Copyright (c) 2023 Arm Limited (or its affiliates). All rights reserved.
# SPDX-License-Identifier: Apache-2.0

menuconfig NET_ZPERF
	bool "zperf library"
	select NET_CONTEXT_RCVTIMEO if NET_NATIVE_UDP
	select NET_SOCKETS
	help
	  This option enables zperf library, which allows to generate
	  network traffic and evaluate network bandwidth in conjunction
	  with other devices running zperf or a desktop running the
	  iperf2 utility.

if NET_ZPERF

config NET_ZPERF_LEGACY_HEADER_COMPAT
	bool "Legacy iperf UDP header format"
	help
	  iperf 2.0.10 (2017) updated the UDP header format in a
	  backwards incompatible manner that cannot be automatically
	  detected. This option reverts the header format for use with
	  iperf version 2.0.9 and earlier.

config ZPERF_SESSION_PER_THREAD
	bool "Run each session in a separate thread"
	select EVENTS
	help
	  Each session is started in its own thread. This means
	  that the system will use more memory because multiple
	  stack frames are needed, so this is not enabled by default.
	  User is also able to set each thread priority separately and
	  the ZPERF_WORK_Q_THREAD_PRIORITY is a default value if thread
	  priority is not set when starting the session.

config ZPERF_WORK_Q_THREAD_PRIORITY
	int "zperf work queue thread priority"
	default NUM_PREEMPT_PRIORITIES
	help
	  Priority of the thread that handles zperf work queue.

config ZPERF_WORK_Q_STACK_SIZE
	int "zperf work queue thread stack size"
	default 2048
	help
	  Stack size of the thread that handles zperf work queue.

module = NET_ZPERF
module-dep = NET_LOG
module-str = Log level for zperf
module-help = Enable debug message of zperf library.
source "subsys/net/Kconfig.template.log_config.net"

config NET_ZPERF_MAX_PACKET_SIZE
	int "Maximum packet size"
	default 1024
	help
	  Upper size limit for packets sent by zperf.

config NET_ZPERF_SERVER
	bool "zperf server support"
	select NET_SOCKETS_SERVICE
	help
	  Support running a zperf server for testing downloads from the application

config NET_ZPERF_MAX_SESSIONS
	int "Maximum number of zperf sessions"
	depends on NET_ZPERF_SERVER
	default 4
	help
	  Upper size limit for connections handled by zperf.

endif
```
