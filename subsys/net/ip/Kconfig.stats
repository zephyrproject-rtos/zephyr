## subsys/net/l2/ethernet/ptp/Kconfig
```kconfig
# Copyright (c) 2022 Carbon Robotics.
# SPDX-License-Identifier: Apache-2.0

menuconfig NET_PTP
	bool "IEEE 1588-2008 (PTPv2) support [EXPERIMENTAL]"
	select NET_L2_PTP
	select EXPERIMENTAL
	help
	  Enable PTP subsystem that provides time master and time
	  slave capabilities. PTP subsystem runs on the first ETHERNET
	  interface in the system.

if NET_PTP

module = NET_PTP
module-dep = NET_LOG
module-str = Log level for PTP
module-help = Enable logs for the PTP stack.
source "subsys/net/Kconfig.template.log_config.net"

choice NET_PTP_TYPE
	prompt "PTP role"
	default NET_PTP_SLAVE

config NET_PTP_MASTER
	bool "Master"

config NET_PTP_SLAVE
	bool "Slave"

endchoice

endif
```

## subsys/net/l2/ieee802154/Kconfig
```kconfig
# Copyright (c) 2016 Intel Corporation.
# SPDX-License-Identifier: Apache-2.0

menuconfig NET_L2_IEEE802154
	bool "IEEE 802.15.4 Radio"
	select NET_L2_PHY_IEEE802154
	help
	  Add support for low rate WPAN IEEE 802.15.4 technology.

if NET_L2_IEEE802154

config NET_L2_IEEE802154_MGMT
	bool
	select NET_MGMT
	select NET_MGMT_EVENT

module = NET_L2_IEEE802154
module-dep = NET_LOG
module-str = Log level for IEEE 802.15.4
module-help = Enables IEEE 802.15.4 code to output debug messages.
source "subsys/net/Kconfig.template.log_config.net"

config NET_DEBUG_L2_IEEE802154_DISPLAY_PACKET
	bool "IEEE 802.15.4 packet display"
	depends on NET_LOG
	help
	  Enable printing out in/out 802.15.4 packets. This is extremely
	  verbose, do not enable this unless you know what you are doing.

choice
	prompt "Which packet do you want to print-out?"
	default NET_DEBUG_L2_IEEE802154_DISPLAY_PACKET_FULL
	depends on NET_DEBUG_L2_IEEE802154_DISPLAY_PACKET

config NET_DEBUG_L2_IEEE802154_DISPLAY_PACKET_FULL
	bool "Print-out both RX and TX packets"
	help
	  This will print-out both received and transmitted packets.

config NET_DEBUG_L2_IEEE802154_DISPLAY_PACKET_RX
	bool "Print-out only RX packets"
	help
	  This will print-out received packets only.

config NET_DEBUG_L2_IEEE802154_DISPLAY_PACKET_TX
	bool "Print-out only TX packets"
	help
	  This will print-out transmitted packets only.

endchoice

config NET_L2_IEEE802154_ACK_REPLY
	bool
	select DEPRECATED

choice
	prompt "Device features level support"
	default NET_L2_IEEE802154_RFD
	help
	  Select which features level you want on the device. Depending on it,
	  the device might expose more or less 802.15.4 protocol features.
	  Only RFD is supported for now.

config NET_L2_IEEE802154_RFD
	bool "Support Reduced Functionality Device level"
	select NET_L2_IEEE802154_MGMT
	help
	  This is the level for PAN device, not PAN coordinator. This will make
	  possible to do active and/or passive scans, as well as associating
	  and disassociating to/from a PAN. Current support is very fragile,
	  thus it is not set as the default level.
endchoice

config NET_L2_IEEE802154_SHELL
	bool "IEEE 802.15.4 shell module"
	select SHELL
	depends on NET_L2_IEEE802154_RFD
	help
	  This can be used for testing 15.4 through the console via exposing
	  a shell module named "ieee15_4".

config NET_L2_IEEE802154_FRAGMENT
	bool "802.15.4 fragmentation support"
	default y
	depends on NET_6LO
	help
	  If IPv6 packets size more than 802.15.4 MTU, packet is fragmented
	  and reassemble incoming packets according to RFC4944/6282.

if NET_L2_IEEE802154_FRAGMENT

config NET_L2_IEEE802154_FRAGMENT_REASS_CACHE_SIZE
	int "IEEE 802.15.4 Reassembly cache size"
	default 1
	help
	  Simultaneously reassemble 802.15.4 fragments depending on
	  cache size.

config NET_L2_IEEE802154_REASSEMBLY_TIMEOUT
	int "IEEE 802.15.4 Reassembly timeout in seconds"
	default 5
	range 1 60
	help
	  Reassembly timer will start as soon as first packet received
	  from peer. Reassembly should be finished within a given time.
	  Otherwise all accumulated fragments are dropped.

endif # NET_L2_IEEE802154_FRAGMENT

config NET_L2_IEEE802154_SECURITY
	bool "IEEE 802.15.4 security [EXPERIMENTAL]"
	select EXPERIMENTAL
	help
	  Enable 802.15.4 frame security handling, in order to bring data
	  confidentiality and authenticity. The implementation is incomplete
	  (only implicit key mode, no key/device specific state, incoming
	  and outgoing security procedures only partially implemented, etc.).
	  Therefore the feature is to be considered EXPERIMENTAL work in
	  progress.

config NET_L2_IEEE802154_SECURITY_CRYPTO_DEV_NAME
	string "Crypto device name used for <en/de>cryption"
	default ""
	depends on NET_L2_IEEE802154_SECURITY
	help
	  This option should be used to set the crypto device name that
	  IEEE 802.15.4 soft MAC will use to run authentication, encryption and
	  decryption operations on incoming/outgoing frames.

source "subsys/net/l2/ieee802154/Kconfig.radio"

endif
```

## subsys/net/l2/ieee802154/Kconfig.radio
```kconfig
# Copyright (c) 2016 Intel Corporation.
# SPDX-License-Identifier: Apache-2.0

menu "IEEE 802.15.4 Radio"

config NET_L2_IEEE802154_RADIO_DFLT_TX_POWER
	int "Default radio transmission power"
	default 0
	help
	  TX power in dbm. Valid setting are: -18, -7, -4, -2, 0, 1, 2, 3, 5
	  If wrongly set, it will silently fail.

config NET_L2_IEEE802154_RADIO_TX_RETRIES
	int "Radio Retransmission attempts"
	default 3
	range 0 7
	help
	  Number of re-transmission attempts radio driver should do, before
	  replying it could not send the packet (MAC PIB attribute:
	  macMaxFrameRetries).

choice
	prompt "Radio channel access protocol"
	default NET_L2_IEEE802154_RADIO_CSMA_CA
	help
	  Select which medium access protocol to use.

config NET_L2_IEEE802154_RADIO_CSMA_CA
	bool "IEEE 802.15.4 unslotted CSMA-CA medium access protocol"
	help
	  Use CSMA-CA mechanism (listen-before-talk with exponential backoff)
	  to transmit packets. This is the most common way of mediating radio
	  channel access and fits most usage scenarios (see IEEE 802.15.4-2020,
	  sections 6.2.5.1 and 10.2.8).

config NET_L2_IEEE802154_RADIO_ALOHA
	bool "IEEE 802.15.4 Aloha medium access protocol (CCA mode 4)"
	help
	  Use Aloha mechanism (send without any clear channel assessment) to
	  transmit packets. This is a simplistic way of transmitting packets
	  and fits low duty-cycle contexts where the radio spectrum is not
	  too heavily loaded (see IEEE 802.15.4-2020, section 10.2.8). The
	  current implementation does not randomize channel access.

endchoice

if NET_L2_IEEE802154_RADIO_CSMA_CA

config NET_L2_IEEE802154_RADIO_CSMA_CA_MAX_BO
	int "CSMA maximum backoffs"
	default 4
	range 0 5
	help
	  The maximum number of backoffs the CSMA-CA algorithm will attempt
	  before declaring a channel access failure (MAC PIB attribute:
	  macMaxCSMABackoffs).

config NET_L2_IEEE802154_RADIO_CSMA_CA_MIN_BE
	int "CSMA MAC minimum backoff exponent"
	default 3
	range 0 8
	help
	  The minimum value of the backoff exponent (BE) in the CSMA-CA
	  algorithm (MAC PIB attribute: macMinBe). This setting must be less
	  than or equal NET_L2_IEEE802154_RADIO_CSMA_CA_MAX_BE.

config NET_L2_IEEE802154_RADIO_CSMA_CA_MAX_BE
	int "CSMA MAC maximum backoff exponent"
	default 5
	range 3 8
	help
	  The maximum value of the backoff exponent (BE) in the CSMA-CA
	  algorithm (MAC PIB attribute: macMaxBe).

endif # NET_L2_IEEE802154_RADIO_CSMA_CA

endmenu
```

## subsys/net/l2/openthread/Kconfig
```kconfig
# OpenThread driver configuration options

# Copyright (c) 2018 Nordic Semiconductor ASA
# SPDX-License-Identifier: Apache-2.0

menuconfig NET_L2_OPENTHREAD
	bool "OpenThread L2"
	depends on NETWORKING
	select OPENTHREAD

	select NET_L2_PHY_IEEE802154
	imply NET_UDP
	imply NET_IPV6
	imply NET_CONFIG_NEED_IPV6
	help
	  Use Zephyr's implementation of the OpenThread L2.

if NET_L2_OPENTHREAD

menu "Logging"

menuconfig OPENTHREAD_L2_DEBUG
	bool "OpenThread L2 log support"
	help
	  This option enables log support for OpenThread.

if OPENTHREAD_L2_DEBUG

config OPENTHREAD_L2_DEBUG_DUMP_15_4
	bool "Dump 802.15.4 packets"
	help
	  This option enables dumping of 802.15.4 packets.

config OPENTHREAD_L2_DEBUG_DUMP_IPV6
	bool "Dump IPv6 packets"
	help
	  This option enables dumping of IPv6 packets.

endif # OPENTHREAD_L2_DEBUG

module = OPENTHREAD_L2
module-dep = NET_LOG
module-str = Log level for OpenThread driver
module-help = Enables OpenThread driver to output debug messages.
source "subsys/net/Kconfig.template.log_config.net"

endmenu # "Logging"

endif # NET_L2_OPENTHREAD
```

## subsys/net/l2/openthread/Kconfig.features
```kconfig
# OpenThread stack features selection

# Copyright (c) 2020 Nordic Semiconductor ASA
# SPDX-License-Identifier: Apache-2.0

choice
	prompt "OpenThread stack version"
	help
	  This option selects version of Thread stack

config OPENTHREAD_THREAD_VERSION_1_1
	bool "Version 1.1"
config OPENTHREAD_THREAD_VERSION_1_2
	bool "Version 1.2"
endchoice

config OPENTHREAD_THREAD_VERSION
	string
	default "1.1" if OPENTHREAD_THREAD_VERSION_1_1
	default "1.2" if OPENTHREAD_THREAD_VERSION_1_2
	default "unknown"

config OPENTHREAD_BACKBONE_ROUTER
	bool "Enable Backbone Router functionality"

config OPENTHREAD_BORDER_AGENT
	bool "Enable Border Agent support"

config OPENTHREAD_BORDER_ROUTER
	bool "Enable Border Router support"

config OPENTHREAD_COAP
	bool "Enable OpenThread CoAP support"
	help
	  Enable CoAP API for the application with use of OpenThread stack

config OPENTHREAD_COAPS
	bool "Enable Secure CoAP API support"
	depends on OPENTHREAD_COAP

config OPENTHREAD_COAP_BLOCK
	bool "Enable CoAP Block-wise option support"

config OPENTHREAD_COAP_OBSERVE
	bool "Enable CoAP Observe option support"

config OPENTHREAD_COMMISSIONER
	bool "Enable Commissioner functions support"
	help
	  Enable commissioner capability in OpenThread stack. Note, that DTLS
	  handshake used in the commissioning procedure requires a larger
	  mbedTLS heap than the default value. A minimum recommended value of
	  CONFIG_MBEDTLS_HEAP_SIZE for the commissioning is 10KB.

config OPENTHREAD_CHANNEL_MANAGER
	bool "Enable channel manager support"
	depends on OPENTHREAD_CHANNEL_MONITOR

config OPENTHREAD_CHANNEL_MONITOR
	bool "Enable channel monitor support"

config OPENTHREAD_CHILD_SUPERVISION
	bool "Enable child supervision support"

config OPENTHREAD_CSL_RECEIVER
	bool "Enable CSL Receiver support"
	help
	  Enable CSL Receiver support for Thread 1.2

config OPENTHREAD_DHCP6_CLIENT
	bool "Enable DHCPv6 client support"

config OPENTHREAD_DHCP6_SERVER
	bool "Enable DHCPv6 server support"

config OPENTHREAD_DIAG
	bool "Enable Diagnostic functions support"
	help
	  Enable OpenThread CLI diagnostic commands

config OPENTHREAD_DNS_CLIENT
	bool "Enable DNS client support"

config OPENTHREAD_DNSSD_SERVER
	bool "Enable DNS-SD server support"

config OPENTHREAD_DUA
	bool "Enable Domain Unicast Address support"
	help
	  Enable Domain Unicast Address feature for Thread 1.2

config OPENTHREAD_LOG_LEVEL_DYNAMIC
	bool "Enable dynamic log level control"

config OPENTHREAD_ECDSA
	bool "Enable ECDSA support"

config OPENTHREAD_EXTERNAL_HEAP
	bool "Enable external heap support"

config OPENTHREAD_IP6_FRAGM
	bool "Enable IPv6 fragmentation support"

config OPENTHREAD_JAM_DETECTION
	bool "Enable Jam detection support"

config OPENTHREAD_JOINER
	bool "Enable Joiner functions support"
	help
	  Enable joiner capability in OpenThread stack. Note, that DTLS
	  handshake used in the commissioning procedure requires a larger
	  mbedTLS heap than the default value. A minimum recommended value of
	  CONFIG_MBEDTLS_HEAP_SIZE for the commissioning is 10KB.

config OPENTHREAD_LEGACY
	bool "Enable legacy network support"

config OPENTHREAD_RAW
	bool "Enable raw Link support"

config OPENTHREAD_MAC_FILTER
	bool "Enable MAC filter support"

config OPENTHREAD_MLE_LONG_ROUTES
	bool "Enable MLE long routes extension (experimental)"
	help
	  Enable MLE long routes extension (experimental, breaks Thread conformance)

config OPENTHREAD_MLR
	bool "Enable Multicast Listener Registration support"
	help
	  Enable Multicast Listener Registration support for Thread 1.2

config OPENTHREAD_MTD_NETDIAG
	bool "Enable TMF network diagnostics on MTDs"

config OPENTHREAD_MULTIPLE_INSTANCE
	bool "Enable OpenThread multiple instances"

config OPENTHREAD_PLATFORM_UDP
	bool "Enable platform UDP support"

config OPENTHREAD_PLATFORM_NETIF
	bool "Enable platform netif support"

config OPENTHREAD_REFERENCE_DEVICE
	bool "Enable Reference Device support"
	help
	  Enable Thread Certification reference device support in OpenThread stack

config OPENTHREAD_ENABLE_SERVICE
	bool "Enable Service support"
	help
	  Enable Thread Services capability in OpenThread stack

config OPENTHREAD_SLAAC
	bool "Enable SLAAC support"

config OPENTHREAD_SNTP_CLIENT
	bool "Enable SNTP Client support"

config OPENTHREAD_TIME_SYNC
	bool "Enable the time synchronization service feature"

config OPENTHREAD_UDP_FORWARD
	bool "Enable UDP forward support"

config OPENTHREAD_SETTINGS_RAM
	bool "Enable volatile-only storage of settings"

config OPENTHREAD_OTNS
	bool "Enable OTNS support"

config OPENTHREAD_FULL_LOGS
	bool "Enable OpenThread full logs"
```

## subsys/net/l2/openthread/Kconfig.thread
```kconfig
# Thread network configuration options

# Copyright (c) 2020 Nordic Semiconductor ASA
# SPDX-License-Identifier: Apache-2.0

config OPENTHREAD_PANID
	int "Default PAN ID"
	default 43981

config OPENTHREAD_CHANNEL
	int "Default Channel"
	default 11

config OPENTHREAD_NETWORK_NAME
	string "Default network name"
	default "ot_zephyr"
	help
	  Network name for OpenThread

config OPENTHREAD_XPANID
	string "Default Extended PAN ID"
	default "de:ad:00:be:ef:00:ca:fe"
	help
	  Extended PAN ID for OpenThread with
	  format "de:ad:00:be:ef:00:ca:fe"

config OPENTHREAD_MASTERKEY
	string "Default Thread Master Key"
	help
	  Master Key for OpenThread with format
	  "00:11:22:33:44:55:66:77:88:99:aa:bb:cc:dd:ee:ff"

config OPENTHREAD_JOINER_AUTOSTART
	bool "Enable automatic joiner start"
	depends on OPENTHREAD_JOINER

config OPENTHREAD_JOINER_PSKD
	string "Default pre shared key for the Joiner"
	depends on OPENTHREAD_JOINER_AUTOSTART
	default "J01NME"

choice
	prompt "OpenThread device type"
	help
	  This option selects Thread network device type

config OPENTHREAD_FTD
	bool "FTD - Full Thread Device"
config OPENTHREAD_MTD
	bool "MTD - Minimal Thread Device"
endchoice

config OPENTHREAD_MTD_SED
	bool "SED - Sleepy End Device"
	depends on OPENTHREAD_MTD

config OPENTHREAD_POLL_PERIOD
	int "Poll period for sleepy end devices [ms]"
	default 236000
	depends on OPENTHREAD_MTD_SED

config OPENTHREAD_MAX_CHILDREN
	int "The maximum number of children"
	range 10 511
	default 32

config OPENTHREAD_MAX_IP_ADDR_PER_CHILD
	int "The maximum number of IPv6 address registrations per child"
	range 4 255
	default 6

config OPENTHREAD_CONFIG_PLATFORM_INFO
	string "The platform-specific string to insert into the OpenThread version string"
	default "Zephyr"

config OPENTHREAD_RADIO_LINK_IEEE_802_15_4_ENABLE
	bool "Enable support for IEEE802.15.4 radio link"
	default y

config OPENTHREAD_RADIO_LINK_TREL_ENABLE
	bool "Thread Radio Encapsulation Link (TREL)"

config OPENTHREAD_CSL_SAMPLE_WINDOW
	int "CSL sample window in units of 10 symbols"
	default 30

config OPENTHREAD_CSL_RECEIVE_TIME_AHEAD
	int "CSL receiver wake up margin in units of 10 symbols"
	default 3

config OPENTHREAD_SRP_CLIENT
	bool "Enable SRP Client support"

config OPENTHREAD_SRP_SERVER
	bool "Enable SRP Server support"
```
