## subsys/net/l2/dummy/any/Kconfig
```kconfig
# Copyright (c) 2024 Nordic Semiconductor
# SPDX-License-Identifier: Apache-2.0

menuconfig NET_PSEUDO_IFACE
	bool "Pseudo network interface a.k.a any interface"
	depends on NET_L2_DUMMY
	select NET_L2_VIRTUAL
	help
	  This implements a pseudo network interface that does nothing
	  itself. It can be used for example to hook virtual interfaces
	  on top of it that can act as a network packet capture handlers.
	  The option will create an "any" network interface which acts
	  as a packet sink.

if NET_PSEUDO_IFACE

module = NET_PSEUDO_IFACE
module-dep = NET_LOG
module-str = Log level for pseudo network interface
module-help = Enables pseudo interface to output debug messages.
source "subsys/net/Kconfig.template.log_config.net"

endif # NET_PSEUDO_IFACE
```

## subsys/net/l2/ethernet/Kconfig
```kconfig
# Copyright (c) 2018 Intel Corporation.
# SPDX-License-Identifier: Apache-2.0

menuconfig NET_L2_ETHERNET
	bool "Ethernet support"
	help
	  Add support for Ethernet, enabling selecting relevant hardware drivers.
	  If NET_SLIP_TAP is selected, NET_L2_ETHERNET will enable to fully
	  simulate Ethernet through SLIP.

if NET_L2_ETHERNET

module = NET_L2_ETHERNET
module-dep = NET_LOG
module-str = Log level for Ethernet L2 layer
module-help = Enables Ethernet L2 to output debug messages.
source "subsys/net/Kconfig.template.log_config.net"

config NET_L2_ETHERNET_RESERVE_HEADER
	bool "Reserve space for Ethernet header in first net_buf in TX"
	help
	  If enabled, then reserve space for Ethernet header to the first
	  net_buf when sending data. The default is still to have layer 2
	  header in a separate net_buf. In RX side the Ethernet header
	  is always part of the first net_buf.

config NET_L2_ETHERNET_MGMT
	bool "Ethernet network management interface"
	select NET_MGMT
	select NET_MGMT_EVENT
	help
	  Enable support net_mgmt Ethernet interface which can be used to
	  configure at run-time Ethernet drivers and L2 settings.


config NET_L2_ETHERNET_ACCEPT_MISMATCH_L3_L2_ADDR
	bool "Accept mismatched L3 and L2 addresses"
	help
	  If enabled, then accept packets where the L3 and L2 addresses do not
	  conform to RFC1122 section 3.3.6. This is useful in dealing with
	  buggy devices that do not follow the RFC.

config NET_VLAN
	bool "Virtual LAN support"
	select NET_L2_VIRTUAL
	help
	  Enables virtual lan (VLAN) support for Ethernet.

config NET_VLAN_COUNT
	int "Max VLAN tags supported in the system"
	default 1
	range 0 $(UINT8_MAX)
	depends on NET_VLAN
	help
	  How many VLAN tags can be configured. If set to 0, then only
	  priority tagged VLAN frames with tag value 0 can be handled.
	  This is useful if you do not want to receive any other VLAN
	  tagged frames than tag 0. This will save some memory as the
	  VLAN virtual interface is not created in this case.

config NET_VLAN_TXRX_DEBUG
	bool "Debug received and sent packets in VLAN"
	depends on NET_L2_ETHERNET_LOG_LEVEL_DBG && NET_VLAN
	help
	  Enables printing of received and sent network packets.
	  This can produce lot of output so it is disabled by default.

config NET_ARP
	bool "ARP"
	default y
	depends on NET_IPV4
	help
	  Enable ARP support. This is necessary on hardware that requires it to
	  get IPv4 working (like Ethernet devices).

config NET_ARP_TABLE_SIZE
	int "Number of entries in ARP table."
	depends on NET_ARP
	default 2
	help
	  Each entry in the ARP table consumes 48 bytes of memory.

config NET_ARP_GRATUITOUS
	bool "Support gratuitous ARP requests/replies."
	depends on NET_ARP
	default y
	help
	  Gratuitous in this case means a ARP request or reply that is not
	  normally needed according to the ARP specification but could be used
	  in some cases. A gratuitous ARP request is a ARP request packet where
	  the source and destination IP are both set to the IP of the machine
	  issuing the packet and the destination MAC is the broadcast address
	  ff:ff:ff:ff:ff:ff. Ordinarily, no reply packet will occur.
	  A gratuitous ARP reply is a reply to which no request has been made.

config NET_ARP_GRATUITOUS_TRANSMISSION
	bool "Transmit gratuitous ARP requests"
	depends on NET_ARP_GRATUITOUS
	depends on NET_MGMT_EVENT
	depends on NET_MGMT_EVENT_INFO
	help
	  Transmit gratuitous ARP requests, as defined in RFC 5227.

config NET_ARP_GRATUITOUS_INTERVAL
	int "Time interval (in seconds) between sending gratuitous ARP requests"
	depends on NET_ARP_GRATUITOUS_TRANSMISSION
	default 60

if NET_ARP
module = NET_ARP
module-dep = NET_LOG
module-str = Log level for IPv4 ARP
module-help = Enables core ARP code to output debug messages.
source "subsys/net/Kconfig.template.log_config.net"
endif # NET_ARP

source "subsys/net/l2/ethernet/dsa/Kconfig"
source "subsys/net/l2/ethernet/gptp/Kconfig"
source "subsys/net/l2/ethernet/lldp/Kconfig"
source "subsys/net/l2/ethernet/bridge/Kconfig"

config NET_ETHERNET_FORWARD_UNRECOGNISED_ETHERTYPE
	bool "Forward unrecognized EtherType frames further into net stack"
	default y if NET_SOCKETS_PACKET
	help
	  When enabled, the Ethernet L2 will forward even those frames for which
	  it does not recognize the EtherType in the header. By default, such
	  frames are dropped at the L2 processing.

config NET_QBV
	bool "Qbv support"
	depends on PTP_CLOCK
	help
	  Enable Qbv support, Qbv is Enhancements for Scheduled Traffic (EST), one
	  feature of TSN. It provides time "slots" for specific classes of traffic
	  in a manner similar to TDM. Host (beyond standard) can select time/time
	  gate during which a packet will be sent, granular control by software of
	  packet transmission.

endif # NET_L2_ETHERNET
```

## subsys/net/l2/ethernet/gptp/Kconfig
```kconfig
# Copyright (c) 2018 Intel Corporation.
# SPDX-License-Identifier: Apache-2.0

menuconfig NET_GPTP
	bool "IEEE 802.1AS (gPTP) support [EXPERIMENTAL]"
	select PTP_CLOCK
	select NET_L2_PTP_TIMESTAMPING
	select EXPERIMENTAL
	help
	  Enable gPTP driver that send and receives gPTP packets
	  and handles network packet timestamps.

if NET_GPTP

module = NET_GPTP
module-dep = NET_LOG
module-str = Log level for gPTP
module-help = Enable logs for the gPTP stack.
source "subsys/net/Kconfig.template.log_config.net"

config NET_GPTP_GM_CAPABLE
	bool "IEEE 802.1AS GrandMaster Capability"
	help
	  Enable to mark the whole system as Grand Master Capable.

config NET_GPTP_PROBE_CLOCK_SOURCE_ON_DEMAND
	bool "Probe clock source on demand"
	depends on NET_GPTP_GM_CAPABLE
	default y
	help
	  This option is helpful if the driver does not fully support the
	  ClockSourceTime.invoke function. If this is enabled, the clock
	  source is probed when it is actually needed instead of being
	  updated on each tick.
	  See IEEE 802.1AS-2011, chapter 9.2 for more details.

config NET_GPTP_CLOCK_ACCURACY
	hex "gPTP Clock Accuracy"
	range 0 0xff
	default 0xfe

config NET_GPTP_STACK_SIZE
	int "gPTP thread stack size"
	default 2048
	help
	  Set the gPTP thread stack size in bytes. The gPTP thread handles the
	  gPTP state machine. There is one gPTP thread in the system.

config NET_GPTP_NUM_PORTS
	int "Number of gPTP ports"
	range 1 $(UINT16_MAX)
	default 1
	help
	  Configures the gPTP stack to work with the given number of ports.
	  The port concept is the same thing as network interface.

config NET_GPTP_NEIGHBOR_PROP_DELAY_THR
	int "Set neighbor propagation delay threshold (ns)"
	default 100000
	help
	  Defines the neighbor propagation delay threshold in nanoseconds.
	  This is the propagation time threshold, above which a port is not
	  considered capable of participating in the IEEE 802.1AS protocol.
	  See IEEE 802.1AS chapter 11.2.12.6 for details.

config NET_GPTP_INIT_LOG_PDELAY_REQ_ITV
	int "Set initial pdelay request interval in Log2 base"
	default 0
	help
	  Defines the interval at which a Path Delay Request will be sent.
	  The value is the converted in nanoseconds as follow:
	  nanoseconds = (10^9) * 2^(value)

config NET_GPTP_INIT_LOG_SYNC_ITV
	int "Set initial sync interval in Log2 base"
	default -3
	help
	  Defines the interval at which a Sync message will be sent.
	  The value is the converted in nanoseconds as follow:
	  nanoseconds = (10^9) * 2^(value)

config NET_GPTP_INIT_LOG_ANNOUNCE_ITV
	int "Set initial announce interval in Log2 base"
	default 0
	help
	  Defines the interval at which an Announce message will be sent.
	  The value is the converted in nanoseconds as follow:
	  nanoseconds = (10^9) * 2^(value)

config NET_GPTP_SYNC_RECEIPT_TIMEOUT
	int "Number of sync intervals to wait"
	default 3
	help
	  Defines the number of sync intervals to wait without receiving
	  synchronization information before assuming that the master is no
	  longer transmitting synchronization information.

config NET_GPTP_ANNOUNCE_RECEIPT_TIMEOUT
	int "Number of announce intervals to wait"
	default 3
	help
	  Defines the number of announce intervals to wait without receiving
	  an Announce message before assuming that the master is no longer
	  transmitting Announce messages.

config NET_GPTP_USE_DEFAULT_CLOCK_UPDATE
	bool "Use a default clock update function"
	default y
	help
	  Use a default internal function to update port local clock.

config NET_GPTP_PATH_TRACE_ELEMENTS
	int "How many path trace elements to track"
	default 8
	help
	  This tells the number of time-aware systems that transmits the
	  Announce message. Each array element takes 8 bytes. If this value
	  is set to 8, then 8 * 8 = 64 bytes of memory is used.

config NET_GPTP_BMCA_PRIORITY1
	int "BMCA priority1 value"
	default 248 if NET_GPTP_GM_CAPABLE
	default $(UINT8_MAX)
	range 0 $(UINT8_MAX)
	help
	  The priority1 attribute of the local clock. It is used in the
	  Best Master Clock selection Algorithm (BMCA), lower values take
	  precedence. The default value is 255 if the device is non grand
	  master capable, and 248 if it is GM capable.
	  See Chapter 8.6.2.1 of IEEE 802.1AS for a more detailed description
	  of priority1. Note that if the system	is non GM capable, then the
	  value 255 is used always and this setting is ignored.

config NET_GPTP_BMCA_PRIORITY2
	int "BMCA priority2 value"
	default 248
	range 0 $(UINT8_MAX)
	help
	  The priority2 attribute of the local clock. It is used in the BMCA
	  (Best Master Clock selection Algorithm), lower values take
	  precedence. The default value is 248.
	  See Chapter 8.6.2.5 of IEEE 802.1AS for a more detailed description
	  of priority2.

config NET_GPTP_STATISTICS
	bool "Collect gPTP statistics"
	help
	  Enable this if you need to collect gPTP statistics. The statistics
	  can be seen in net-shell if needed.

config NET_GPTP_MONITOR_SYNC_STATUS
	bool "Monitor real-time synchronization status"
	help
	  Monitor real-time synchronization status, like synchronization offset,
	  frequency offset and so on. This will print continuous messages.

endif # NET_GPTP
```

## subsys/net/l2/ethernet/lldp/Kconfig
```kconfig
# Copyright (c) 2017 Intel Corporation.
# SPDX-License-Identifier: Apache-2.0

menuconfig NET_LLDP
	bool "Link Layer Discovery Protocol (LLDP)"
	select NET_MGMT
	select NET_MGMT_EVENT
	help
	  Enable Link Layer Discovery Protocol (LLDP) Transmit support.
	  Please refer to IEEE Std 802.1AB for more information.

if NET_LLDP

module = NET_LLDP
module-dep = NET_LOG
module-str = Log level for LLDP
module-help = Enables core LLDP code to output debug messages.
source "subsys/net/Kconfig.template.log_config.net"

#
# LLDP Tx state machine config
#
config NET_LLDP_TX_INTERVAL
	int "Time between transmissions in seconds (msgTxInterval)"
	default 30
	range 1 3600
	help
	  Interval between transmissions of LLDPDUs during normal
	  (non-fast mode) transmission periods. For further information
	  please refer to section 9.2.5.7 of the LLDP spec.

config NET_LLDP_TX_HOLD
	int "Multiplier of Tx Interval to result on Time to Live value"
	default 4
	range 1 100
	help
	  This value (msgTxHold) is used as a multiplier of
	  CONFIG_NET_LLDP_TX_INTERVAL, to determine the value to be used
	  as Time to Live in LLDP frames. For further information please
	  refer to section 9.2.5.6 of the LLDP spec.

#
# End of LLDPDU TLV CONFIG
#
config NET_LLDP_END_LLDPDU_TLV_ENABLED
	bool "End of LLDPDU TLV"
	default y
	help
	  Tells whether LLDPDU packet will have marker at the end of the packet.

#
# CHASSIS ID TLV CONFIG
#
config NET_LLDP_CHASSIS_ID_SUBTYPE
	int "Chassis ID TLV subtype"
	default 4
	range 1 7
	help
	  Chassis ID subtype options are defined below.
	  Please refer to section 8.5.2.2 of the 802.1AB for more info.
	  Subtype 1 = Chassis component
	  Subtype 2 = Interface alias
	  Subtype 3 = Port component
	  Subtype 4 = MAC address
	  Subtype 5 = Network address
	  Subtype 6 = Interface name
	  Subtype 7 = Locally assigned
	  If subtype 4 is selected, MAC address, then configs
	  NET_LLDP_CHASSIS_ID_MAC0 through NET_LLDP_CHASSIS_ID_MAC5 must
	  be defined, otherwise you must use NET_LLDP_CHASSIS_ID instead.

if NET_LLDP_CHASSIS_ID_SUBTYPE = 4
config NET_LLDP_CHASSIS_ID_MAC0
	hex "Chassis ID MAC Address Byte 0"
	default 0x00
	range 0 0xff
	help
	  Byte 0 of the MAC address.

config NET_LLDP_CHASSIS_ID_MAC1
	hex "Chassis ID MAC Address Byte 1"
	default 0x00
	range 0 0xff
	help
	  Byte 1 of the MAC address.

config NET_LLDP_CHASSIS_ID_MAC2
	hex "Chassis ID MAC Address Byte 2"
	default 0x5e
	range 0 0xff
	help
	  Byte 2 of the MAC address.

config NET_LLDP_CHASSIS_ID_MAC3
	hex "Chassis ID MAC Address Byte 3"
	default 0x00
	range 0 0xff
	help
	  Byte 3 of the MAC address.

config NET_LLDP_CHASSIS_ID_MAC4
	hex "Chassis ID MAC Address Byte 4"
	default 0x53
	range 0 0xff
	help
	  Byte 4 of the MAC address.

config NET_LLDP_CHASSIS_ID_MAC5
	hex "Chassis ID MAC Address Byte 5"
	default 0x8d
	range 0 0xff
	help
	  Byte 5 of the MAC address.
endif

config NET_LLDP_CHASSIS_ID
	string "Chassis ID value"
	default "CHASSIS_ID_PLACEHOLDER"
	depends on NET_LLDP_CHASSIS_ID_SUBTYPE != 4

#
# PORT ID TLV CONFIG
#
config NET_LLDP_PORT_ID_SUBTYPE
	int "Port ID TLV subtype"
	default 5
	range 1 7
	help
	  Port ID subtype options are defined below.
	  Please refer to section 8.5.3.2 of the 802.1AB for more info.
	  Subtype 1 = Interface alias
	  Subtype 2 = Port component
	  Subtype 3 = MAC address
	  Subtype 4 = Network address
	  Subtype 5 = Interface name
	  Subtype 6 = Agent circuit ID
	  Subtype 7 = Locally assigned
	  If subtype 3 is selected (MAC address) then configs
	  NET_LLDP_PORT_ID_MAC0 through NET_LLDP_PORT_ID_MAC5 must
	  be defined, otherwise you must use NET_LLDP_PORT_ID instead.

if NET_LLDP_PORT_ID_SUBTYPE = 3
config NET_LLDP_PORT_ID_MAC0
	hex "Chassis ID MAC Address Byte 0"
	default 0x00
	range 0 0xff
	help
	  Byte 0 of the MAC address.

config NET_LLDP_PORT_ID_MAC1
	hex "Chassis ID MAC Address Byte 1"
	default 0x00
	range 0 0xff
	help
	  Byte 1 of the MAC address.

config NET_LLDP_PORT_ID_MAC2
	hex "Chassis ID MAC Address Byte 2"
	default 0x5e
	range 0 0xff
	help
	  Byte 2 of the MAC address.

config NET_LLDP_PORT_ID_MAC3
	hex "Chassis ID MAC Address Byte 3"
	default 0x00
	range 0 0xff
	help
	  Byte 3 of the MAC address.

config NET_LLDP_PORT_ID_MAC4
	hex "Chassis ID MAC Address Byte 4"
	default 0x53
	range 0 0xff
	help
	  Byte 4 of the MAC address.

config NET_LLDP_PORT_ID_MAC5
	hex "Chassis ID MAC Address Byte 5"
	default 0x8d
	range 0 0xff
	help
	  Byte 5 of the MAC address.
endif

config NET_LLDP_PORT_ID
	string "Port ID value"
	default "PORT_ID_PLACEHOLDER"
	depends on NET_LLDP_PORT_ID_SUBTYPE != 3

endif # NET_LLDP
```
