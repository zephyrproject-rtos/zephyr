## subsys/net/l2/virtual/Kconfig
```kconfig
# Copyright (c) 2021 Intel Corporation.
# SPDX-License-Identifier: Apache-2.0

menuconfig NET_L2_VIRTUAL
	bool "Virtual L2 support"
	help
	  Add a virtual L2 layer driver. This is needed if you have a L2
	  layer that depends on other L2 layer. Like running VPN on top of
	  Ethernet.

if NET_L2_VIRTUAL

config NET_L2_VIRTUAL_MGMT
	bool "Virtual interface network management interface"
	select NET_MGMT
	select NET_MGMT_EVENT
	help
	  Enable support net_mgmt virtual interface which can be used to
	  configure at run-time the L2 settings.

config NET_L2_VIRTUAL_MAX_NAME_LEN
	int "Max length of the virtual L2 layer name"
	default 32
	range 8 128
	help
	  Indicate the max name length, including the terminating NULL byte.
	  Reduce this value to conserve memory.

module = NET_L2_VIRTUAL
module-dep = NET_LOG
module-str = Log level for virtual L2 layer
module-help = Enables virtual L2 to output debug messages.
source "subsys/net/Kconfig.template.log_config.net"

source "subsys/net/l2/virtual/ipip/Kconfig"

endif # NET_L2_VIRTUAL
```

## subsys/net/l2/virtual/ipip/Kconfig
```kconfig
# Copyright (c) 2018 Intel Corporation.
# SPDX-License-Identifier: Apache-2.0

menuconfig NET_L2_IPIP
	bool "IP-to-IP tunneling support"
	depends on NET_L2_VIRTUAL
	help
	  Add a IP-to-IP tunnel driver. If this is enabled, then a network
	  interface will be created that will tunnel traffic on top of
	  existing network interface. Application needs to attach the IPIP
	  driver at runtime to correct network interface.
	  Also application needs to setup IP addresses etc. to the IP-to-IP
	  network interface.

if NET_L2_IPIP

config NET_L2_IPIP_TUNNEL_COUNT
	int "Max number of IPIP tunnels"
	default 1
	help
	  Tells how many IPIP tunnels are supported.

module = NET_L2_IPIP
module-dep = NET_LOG
module-str = Log level for IP-to-IP tunnel
module-help = Enables IP-to-IP driver to output debug messages.
source "subsys/net/Kconfig.template.log_config.net"

config NET_L2_IPIP_TXRX_DEBUG
	bool "Debug received and sent packets"
	depends on NET_L2_IPIP_LOG_LEVEL_DBG
	help
	  Enables printing of received and sent network packets.
	  This can produce lot of output so it is disabled by default.

endif # NET_L2_IPIP
```

## subsys/net/l2/wifi/Kconfig
```kconfig
# Copyright (c) 2023 Nordic Semiconductor ASA
# SPDX-License-Identifier: Apache-2.0

config WIFI_MGMT_RAW_SCAN_RESULTS
	bool "Raw scan results"
	help
	  This option enables raw scan results. When enabled, the raw scan
	  results (beacons or probe responses) are provided to the application.
	  Enabling this config will increase the net_mgmt event size
	  considerably.

if WIFI_MGMT_RAW_SCAN_RESULTS

config WIFI_MGMT_RAW_SCAN_RESULT_LENGTH
	int "Maximum length of raw scan results"
	default 512
	help
	  This option defines the maximum length of raw scan results.

config WIFI_MGMT_RAW_SCAN_RESULTS_ONLY
	bool "Only raw scan results"
	help
	  This option enables only raw scan results. When enabled, the raw scan
	  results (beacons or probe responses) are provided to the application.
	  The scan results are not parsed and the application is responsible
	  for parsing the scan results. Normal scan results are not provided
	  to the application.

endif # WIFI_MGMT_RAW_SCAN_RESULTS

config WIFI_MGMT_TWT_CHECK_IP
	bool "Check IP Assignment for TWT"
	default y
	help
	  This option enables check for valid IP address before TWT setup.
	  If TWT setup is triggered early in the connection, then device might
	  enter deep sleep without having a valid IP, this can result in device
	  being unreachable (IP Level) or unable to receive down link traffic
	  even when it is awake intervals. Rejecting TWT setup till Wi-Fi
	  interface has a valid IP address might be desirable in most scenarios.

config WIFI_MGMT_FORCED_PASSIVE_SCAN
	bool "Force passive Wi-Fi scanning"
	help
	  Always request a passive scan, regardless of the user supplied parameters.
	  This is typically used when the underlying hardware is not certified for
	  RF transmissions. This doesn't guarantee that passive scan will be used,
	  it depends on the underlying chip implementation to support and honour
	  scan type.

config WIFI_MGMT_SCAN_SSID_FILT_MAX
	int "Maximum number of SSIDs that can be specified for SSID filtering"
	default 1
	range 1 4
	help
	  Maximum number of SSIDs that can be specified for SSID filtering.
	  This can be set based on the underlying chipsets limitations.

config WIFI_MGMT_SCAN_CHAN_MAX_MANUAL
	int "Maximum number of channels that can be manually specified"
	range 1 110
	default 3
	help
	  There are approximately 100 channels allocated across the three supported bands.
	  The default of 3 allows the 3 most common channels (2.4GHz: 1, 6, 11) to be specified.

config WIFI_SHELL_MAX_AP_STA
	int "Maximum number of APs and STAs that can be managed in Wi-Fi shell"
	range 1 8
	default 1
	help
	  This option defines the maximum number of APs and STAs that can be managed
	  in Wi-Fi shell.

config WIFI_NM
	bool "Wi-Fi Network manager support"
	help
	  This option enables using the Wi-Fi Network managers (e.g. wpa_supplicant) to
	  manage the Wi-Fi network interfaces.

if WIFI_NM

config WIFI_NM_MAX_MANAGED_INTERFACES
	int "Maximum number of managed interfaces per Wi-Fi network manager"
	default 1
	help
	  This option defines the maximum number of managed interfaces per Wi-Fi
	  network manager instance that can be used simultaneously.

module = WIFI_NM
module-dep = NET_LOG
module-str = Log level for Wi-Fi Network manager module
module-help = Enables using the Wi-Fi Network managers to manage the Wi-Fi network interfaces.
source "subsys/net/Kconfig.template.log_config.net"
endif # WIFI_NM

config WIFI_MGMT_AP_STA_INACTIVITY_TIMEOUT
	int "Station inactivity timeout in seconds"
	default 300
	help
	  Station inactivity timeout is the period for which AP may keep a client
	  in associated state while there is no traffic from that particular
	  client. If a non-zero value is set, AP may choose to disassociate the
	  client after the timeout.

config WIFI_MGMT_AP_STA_SKIP_INACTIVITY_POLL
	bool "Skip inactivity poll for stations after the inactivity timeout"
	help
	  Skip inactivity poll for stations after the inactivity timeout. This
	  will prevent the AP from sending null data frames to the stations after
	  the inactivity timeout. This is useful to disconnect idle stations even
	  if they are within the range of the AP.
	  Note: This is only build time parameter, runtime configuration not supported.

config WIFI_MGMT_AP_MAX_NUM_STA
	int "Maximum number of stations allowed in station table"
	range 1 2007
	default 4
	help
	  Maximum number of stations allowed in station table. New stations will be
	  rejected after the station table is full.

config WIFI_ENT_IDENTITY_MAX_USERS
	int "Maximum number of identity users allowed connection"
	default 8
	help
	  This option defines the maximum number of identity users allowed connection.
```

## subsys/net/l2/wifi/Kconfig.shell
```kconfig
# Copyright (c) 2026 Rithic Chellaram Hariharan
# SPDX-License-Identifier: Apache-2.0

# Wi-Fi shell specific Kconfig options.

config WIFI_SHELL_MAX_AP_STA
	int "Maximum number of APs and STAs that can be managed in Wi-Fi shell"
	range 1 8
	default 1
	help
	  This option defines the maximum number of APs and STAs that can be managed
	  in Wi-Fi shell.

config WIFI_SHELL_ROAMING_AUTO_TRIGGER
	bool "Automatic roaming trigger in Wi-Fi shell"
	depends on NET_L2_WIFI_SHELL
	depends on WIFI_NM_WPA_SUPPLICANT_ROAMING
	default y
	help
	  Enable automatic roaming trigger from roaming-related Wi-Fi events.
	  Disable this if roaming should be started manually from the shell.

if WIFI_NM_WPA_SUPPLICANT_CRYPTO_ENTERPRISE

config WIFI_SHELL_RUNTIME_CERTIFICATES
	bool "Provide Wi-Fi enterprise security certificates at run-time"
	select TLS_CREDENTIALS
	select TLS_CREDENTIALS_SHELL
	select BASE64
	help
	  This option enables providing Wi-Fi enterprise security certificates at run-time.
	  Uses the TLS credentials subsystem to store and manage the certificates.

if WIFI_SHELL_RUNTIME_CERTIFICATES

config HEAP_MEM_POOL_ADD_SIZE_WIFI_CERT
	int "Wi-Fi enterprise security certificates memory pool size"
	# STA - 6 certs and each assume 1500 bytes
	default 12000
	help
	  The size of the memory pool used by the Wi-Fi enterprise security certificates.

endif # WIFI_SHELL_RUNTIME_CERTIFICATES

endif # WIFI_NM_WPA_SUPPLICANT_CRYPTO_ENTERPRISE
```

## subsys/net/lib/Kconfig
```kconfig
# Copyright (c) 2016 Intel Corporation
# SPDX-License-Identifier: Apache-2.0

menu "Network Protocols"

source "subsys/net/lib/coap/Kconfig"

source "subsys/net/lib/dns/Kconfig"

source "subsys/net/lib/mqtt/Kconfig"

source "subsys/net/lib/mqtt_sn/Kconfig"

source "subsys/net/lib/ptp/Kconfig"

source "subsys/net/lib/tftp/Kconfig"

source "subsys/net/lib/http/Kconfig"

source "subsys/net/lib/websocket/Kconfig"

source "subsys/net/lib/lwm2m/Kconfig"

source "subsys/net/lib/socks/Kconfig"

source "subsys/net/lib/sntp/Kconfig"

endmenu

menu "Network Libraries"

source "subsys/net/lib/config/Kconfig"

source "subsys/net/lib/sockets/Kconfig"

source "subsys/net/lib/tls_credentials/Kconfig"

endmenu

menu "Network additional services"

source "subsys/net/lib/capture/Kconfig"

source "subsys/net/lib/dhcpv4/Kconfig"

source "subsys/net/lib/dhcpv6/Kconfig"

source "subsys/net/lib/trickle/Kconfig"

source "subsys/net/lib/zperf/Kconfig"

source "subsys/net/lib/prometheus/Kconfig"

source "subsys/net/lib/wifi_credentials/Kconfig"

# Hidden option for VPN usage. Can be selected by the application
# to setup VPN enablers in the network stack.
config NET_VPN
	bool
	help
	  Setup VPN enablers in the network stack. Meant to
	  be enabled by the VPN implementation.

endmenu
```

## subsys/net/lib/app/Kconfig
```kconfig
# Kconfig.app - Options for networking applications

#
# Copyright (c) 2017 Intel Corporation.
#
# SPDX-License-Identifier: Apache-2.0
#

menuconfig NET_APP
	bool "Network application API support [EXPERIMENTAL]"
	default y
	select NET_MGMT
	select NET_MGMT_EVENT
	help
	  Enable API that helps to create client/server network applications.
	  This API is experimental and subject to change.

if NET_APP

config NET_DEBUG_APP
	bool "Debug net app library"
	default y if NET_LOG_GLOBAL
	help
	  Enables net app library to output debug messages

config NET_APP_SERVER
	bool "Enable server support"
	help
	  Enables net app library server APIs.

config NET_APP_SERVER_NUM_CONN
	int "Number of simultaneous incoming connections"
	default 1
	depends on NET_APP_SERVER
	help
	  Tells how many simultaneous incoming connections the server instance can
	  support. The value of CONFIG_NET_TCP_BACKLOG_SIZE must be greater than
	  or equal to CONFIG_NET_APP_SERVER_NUM_CONN.

config NET_APP_CLIENT
	bool "Enable client support"
	help
	  Enables net app library client APIs.

config NET_APP_TLS
	bool "Enable TLS support for TCP applications"
	depends on NET_TCP
	select MBEDTLS
	help
	  Enables net app library to use TLS for encrypted communication.

config NET_APP_DTLS
	bool "Enable DTLS support for UDP applications"
	depends on NET_UDP
	select MBEDTLS
	help
	  Enables net app library to use DTLS for encrypted UDP communication.

config NET_APP_DTLS_TIMEOUT
	int "DTLS session timeout"
	depends on NET_APP_DTLS
	default 15
	help
	  If a DTLS session does not have any activity, then disconnect
	  the session. The value is in seconds.

config NET_APP_TLS_STACK_SIZE
	int "TLS handler thread stack size"
	default 8192
	depends on NET_APP_TLS || NET_APP_DTLS
	help
	  TLS handler thread stack size. The mbedtls routines will use this stack
	  thus it is by default very large.

endif # NET_APP
```
