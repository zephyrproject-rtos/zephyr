## subsys/net/ip/Kconfig.tls
```kconfig
# Kconfig.stack - TLS/DTLS related options

#
# Copyright (c) 2018 Intel Corporation
# Copyright (c) 2018 Nordic Semiconductor ASA
#
# SPDX-License-Identifier: Apache-2.0
#

menu "TLS options"

config NET_TLS
	bool "TCP TLS support"
	default n
	depends on NET_TCP && MBEDTLS
	help
	  Enable TLS support for TCP connections. TLS is implemented by mbedTLS.

config NET_DTLS
	bool "UDP DTLS placeholder"
	default n
	depends on NET_UDP && MBEDTLS

if NET_TLS || NET_DTLS

menu "Supported TLS version"

config TLS_VERSION_1_0
	bool "Enable support for TLS 1.0"
	depends on NET_TLS
	select TLS_MAC_MD5_ENABLED
	select TLS_MAC_SHA1_ENABLED
	default n

config TLS_VERSION_1_1
	bool "Enable support for TLS 1.1 (DTLS 1.0)"
	select TLS_MAC_MD5_ENABLED
	select TLS_MAC_SHA1_ENABLED
	default n

config TLS_VERSION_1_2
	bool "Enable support for TLS 1.2 (DTLS 1.2)"
	default y

endmenu

menu "Ciphersuite configuration"

comment "Supported key exchange modes"

config TLS_KEY_EXCHANGE_PSK_ENABLED
	bool "Enable the PSK based ciphersuite modes"
	default n

config TLS_KEY_EXCHANGE_DHE_PSK_ENABLED
	bool "Enable the DHE-PSK based ciphersuite modes"
	default n

config TLS_KEY_EXCHANGE_ECDHE_PSK_ENABLED
	bool "Enable the ECDHE-PSK based ciphersuite modes"
	default n

config TLS_KEY_EXCHANGE_RSA_PSK_ENABLED
	bool "Enable the RSA-PSK based ciphersuite modes"
	default n

config TLS_KEY_EXCHANGE_RSA_ENABLED
	bool "Enable the RSA-only based ciphersuite modes"
	default y

config TLS_KEY_EXCHANGE_DHE_RSA_ENABLED
	bool "Enable the DHE-RSA based ciphersuite modes"
	default n

config TLS_KEY_EXCHANGE_ECDHE_RSA_ENABLED
	bool "Enable the ECDHE-RSA based ciphersuite modes"
	default n

config TLS_KEY_EXCHANGE_ECDHE_ECDSA_ENABLED
	bool "Enable the ECDHE-ECDSA based ciphersuite modes"
	default n

config TLS_KEY_EXCHANGE_ECDH_ECDSA_ENABLED
	bool "Enable the ECDH-ECDSA based ciphersuite modes"
	default n

config TLS_KEY_EXCHANGE_ECDH_RSA_ENABLED
	bool "Enable the ECDH-RSA based ciphersuite modes"
	default n

config TLS_KEY_EXCHANGE_ECJPAKE_ENABLED
	bool "Enable the ECJPAKE based ciphersuite modes"
	default n

comment "Supported cipher modes"

config TLS_CIPHER_AES_ENABLED
	bool "Enable the AES block cipher"
	default y

config TLS_CIPHER_CAMELLIA_ENABLED
	bool "Enable the Camellia block cipher"
	default n

config TLS_CIPHER_DES_ENABLED
	bool "Enable the DES block cipher"
	default y

config TLS_CIPHER_CCM_ENABLED
	bool "Enable the Counter with CBC-MAC (CCM) mode for 128-bit block cipher"
	default n
	depends on TLS_CIPHER_AES_ENABLED || TLS_CIPHER_CAMELLIA_ENABLED

config TLS_CIPHER_CBC_ENABLED
	bool "Enable Cipher Block Chaining mode (CBC) for symmetric ciphers"
	default y

comment "Supported message authentication methods"

config TLS_MAC_MD5_ENABLED
	bool "Enable the MD5 hash algorithm"
	default n
	default y if TLS_VERSION_1_0 || TLS_VERSION_1_1

config TLS_MAC_SHA1_ENABLED
	bool "Enable the SHA1 hash algorithm"
	default y

config TLS_MAC_SHA256_ENABLED
	bool "Enable the SHA-224 and SHA-256 hash algorithms"
	default n
	default y if TLS_VERSION_1_2

config TLS_MAC_SHA512_ENABLED
	bool "Enable the SHA-384 and SHA-512 hash algorithms"
	default n

endmenu

config NET_TLS_DEBUG
	bool "Enable TLS debug log"
	default n

comment "TLS/DTLS credentials configuration"

config NET_MAX_CREDENTIALS_NUMBER
	int "Maximum number of TLS/DTLS credentials"
	default 4
	help
	  "Maximum number of TLS/DTLS credentials that can be used simultaneously"

config NET_TLS_PEM_CERTIFICATE_FORMAT
	bool "Enable support for PEM certificate format"
	default n
	help
	  By default only DER (binary) format of certificates is supported. Enable
	  this option to enable support for PEM format.

config NET_PRECONFIGURE_TLS_CREDENTIALS
	bool "Use preconfigured credentials for TLS/DTLS"
	default n
	help
	  Use preconfigured credentials (CA Certificate, PSK) for TLS/DTLS sessions.

config NET_TLS_CREDENTIALS_FILE
	string "TLS/DTLS credentials to preconfigure"
	default "net_tls_default_credentials.h"
	depends on NET_PRECONFIGURE_TLS_CREDENTIALS
	help
	  File containing default TLS/DTLS credentials to preconfigure. TODO Extend description.

endif

endmenu
```

## subsys/net/ip/l2/Kconfig
```kconfig
#
# Copyright (c) 2016 Intel Corporation.
#
# SPDX-License-Identifier: Apache-2.0
#

menu "Link layer options"

config NET_L2_DUMMY
	bool "Enable dummy l2 layer"
	default n
	default y if !NET_L2_ETHERNET && NET_TEST
	help
	  Add a dummy L2 layer driver. This is usually only needed when
	  simulating a network interface when running network stack inside QEMU.

config NET_L2_ETHERNET
	bool "Enable Ethernet support"
	default n
	help
	  Add support for Ethernet, enabling selecting relevant hardware drivers.
	  If NET_SLIP_TAP is selected, NET_L2_ETHERNET will enable to fully
	  simulate Ethernet through SLIP.

config NET_DEBUG_L2_ETHERNET
	bool "Debug Ethernet L2 layer"
	default n
	default y if NET_LOG_GLOBAL
	depends on NET_LOG
	help
	  Enables Ethernet L2 output debug messages

config NET_OFFLOAD
	bool "Offload IP stack [EXPERIMENTAL]"
	default n
	help
	  Enables TCP/IP stack to be offload to a co-processor.

config NET_DEBUG_NET_OFFLOAD
	bool "Debug Net Offload Layer"
	default n
	default y if NET_LOG_GLOBAL
	depends on NET_LOG
	depends on NET_OFFLOAD
	help
	  Enables offload TCP/IP stack output debug messages.

config NET_L2_BT
	bool "Enable Bluetooth support"
	select BT
	select BT_PERIPHERAL
	select BT_CENTRAL
	select BT_SMP
	select BT_L2CAP_DYNAMIC_CHANNEL
	select NET_6LO
	default n
	help
	  Enable Bluetooth driver that send and receives IPv6 packets,
	  does header compression on it and writes it to the
	  Bluetooth stack via L2CAP channel.

config NET_L2_BT_ZEP1656
	bool "***Workaround to work with Linux.***"
	depends on NET_L2_BT
	default n
	help
	  This workaround is necessary to interoperate with Linux up to 4.10 but
	  it might not be compliant with RFC 7668 as it cause the stack to skip
	  Neighbor Discovery cache causing the destination link address to be
	  omitted. For more details why this is needed see:
	  https://jira.zephyrproject.org/browse/ZEP-1656

config NET_L2_BT_SEC_LEVEL
	int "Security level of Bluetooth Link"
	depends on NET_L2_BT
	default 1
	range 1 4
	help
	  Security level of Bluetooth Link:
	  Level 1 (BT_SECURITY_LOW) = No encryption or authentication required
	  Level 2 (BT_SECURITY_MEDIUM) = Only encryption required
	  Level 3 (BT_SECURITY_HIGH) = Encryption and authentication required
	  Level 4 (BT_SECURITY_FIPS) = Secure connection required

config NET_DEBUG_L2_BT
	bool "Debug Bluetooth L2 layer"
	default n
	default y if NET_LOG_GLOBAL
	depends on NET_LOG
	depends on NET_L2_BT
	help
	  Enables Bluetooth L2 output debug messages

config NET_L2_BT_MGMT
	bool "Enable Bluetooth Network Management support"
	depends on NET_L2_BT
	select NET_MGMT
	select NET_MGMT_EVENT
	default n

config NET_L2_BT_SHELL
	bool "Enable Bluetooth shell module"
	default n
	select CONSOLE_SHELL
	select NET_L2_BT_MGMT
	help
	  This can be used for testing Bluetooth management commands through the
	  console via a shell module named "net_bt".

source "subsys/net/ip/l2/ieee802154/Kconfig"

config NET_ARP
	bool "Enable ARP"
	default y
	depends on NET_IPV4 && NET_L2_ETHERNET
	help
	  Enable ARP support. This is necessary on hardware that requires it to
	  get IPv4 working (like Ethernet devices).

config NET_ARP_TABLE_SIZE
	int "Number of entries in ARP table."
	depends on NET_ARP
	default 2
	help
	  Each entry in the ARP table consumes 22 bytes of memory.

config NET_DEBUG_ARP
	bool "Debug IPv4 ARP"
	depends on NET_ARP && NET_LOG
	default n
	default y if NET_LOG_GLOBAL
	help
	  Enables core ARP code part to output debug messages

endmenu
```

## subsys/net/ip/l2/ieee802154/Kconfig
```kconfig
#
# Copyright (c) 2016 Intel Corporation.
#
# SPDX-License-Identifier: Apache-2.0
#

menuconfig NET_L2_IEEE802154
	bool "Enable IEEE 802.15.4 Radio"
	default n
	help
	  Add support for low rate WPAN IEEE 802.15.4 technology.

if NET_L2_IEEE802154

config NET_L2_IEEE802154_MGMT
	bool
	select NET_MGMT
	select NET_MGMT_EVENT
	default n

config NET_DEBUG_L2_IEEE802154
	bool "Enable IEEE 802.15.4 stack debug messages"
	default n
	depends on NET_LOG
	help
	  Enable it if you want to see what's happening. Only useful
	  for developers.

config NET_L2_IEEE802154_ACK_REPLY
	bool "Enable IEEE 802.15.4 ACK reply logic"
	default y
	help
	  Enable inner stack's logic on handling ACK request. Note that
	  if the hw driver has an AUTOACK feature, this is then unnecessary.

choice
	prompt "Device features level support"
	default NET_L2_IEEE802154_ORFD
	help
	  Select which features level you want on the device. Depending on it,
	  the device might expose more or less 802.15.4 protocol features.

config NET_L2_IEEE802154_ORFD
	bool "Support only an OVERLY Reduced Functionality Device"
	help
	  This is a TEST ONLY support. Do not use that in production!
	  This is not spec compliant. This is added for 2 reasons:
	  to support legacy stack behavior and for testing. PAN ID is fixed
	  as well as the channel. The device is not able to scan, associate
	  to a PAN or anything else like that. You have been warned.

config NET_L2_IEEE802154_RFD
	bool "Support Reduced Functionality Device level"
	select NET_L2_IEEE802154_MGMT
	help
	  This is the level for PAN device, not PAN coordinator. This will make
	  possible to do active and/or passive scans, as well as associating
	  and disassociating to/from a PAN. Current support is very fragile,
	  thus it is not set as the default level
endchoice

config NET_L2_IEEE802154_SHELL
	bool "Enable IEEE 802.15.4 shell module"
	default n
	select CONSOLE_SHELL
	depends on NET_L2_IEEE802154_RFD
	help
	This can be used for testing 15.4 through the console via exposing
	a shell module named "ieee15_4".

config NET_L2_IEEE802154_ACK_SET
	bool "Expose ACK request setting"
	default n
	depends on NET_L2_IEEE802154_ORFD
	select NET_L2_IEEE802154_MGMT
	help
	  Enable a network management request to let upper layers to force
	  requesting a ACK on any DATA frames. Such setting can be found
	  useful if one needs to send a buffer "reliably". Note however, this
	  becomes utterly useless if application protocol already handles
	  reliability like TCP.

config NET_L2_IEEE802154_ORFD_PAN_ID
	hex "IEEE 802.15.4 fixed PAN ID"
	depends on NET_L2_IEEE802154_ORFD
	default 0xabcd
	help
	  The fixed PAN ID to use for the ORFD.

config NET_L2_IEEE802154_ORFD_CHANNEL
	int "IEEE 802.15.4 fixed channel"
	depends on NET_L2_IEEE802154_ORFD
	default 26
	help
	  The fixed channel to use for the ORFD.

config NET_L2_IEEE802154_FRAGMENT
	bool "Enable 802.15.4 fragmentation support"
	default y
	depends on NET_6LO
	help
	  If IPv6 packets size more than 802.15.4 MTU, packet is fragmented
	  and reassemble incoming packets according to RFC4944/6282.

config NET_L2_IEEE802154_FRAGMENT_REASS_CACHE_SIZE
	int "IEEE 802.15.4 Reassembly cache size"
	depends on NET_L2_IEEE802154_FRAGMENT
	default 1
	help
	  Simultaneoulsy reassemble 802.15.4 fragments depending on
	  cache size.

config NET_L2_IEEE802154_REASSEMBLY_TIMEOUT
	int "IEEE 802.15.4 Reassembly timeout in seconds"
	depends on NET_L2_IEEE802154_FRAGMENT
	default 5
	range 1 60
	help
	  Reassembly timer will start as soon as first packet received
	  from peer. Reassembly should be finished within a given time.
	  Otherwise all accumulated fragments are dropped.

config  NET_DEBUG_L2_IEEE802154_FRAGMENT
	bool "Enable debug support for IEEE 802.15.4 fragmentation"
	depends on NET_L2_IEEE802154_FRAGMENT && NET_LOG
	default n

source "subsys/net/ip/l2/ieee802154/Kconfig.radio"

endif
```

## subsys/net/l2/Kconfig
```kconfig
# Copyright (c) 2016 Intel Corporation.
# SPDX-License-Identifier: Apache-2.0

menu "Link layer options"

config NET_L2_DUMMY
	bool "Dummy l2 layer"
	default y if !NET_L2_ETHERNET && NET_TEST
	help
	  Add a dummy L2 layer driver. This is usually only needed when
	  simulating a network interface when running network stack inside QEMU.

if NET_L2_DUMMY
source "subsys/net/l2/dummy/Kconfig"
endif

source "subsys/net/l2/virtual/Kconfig"

source "subsys/net/l2/ethernet/Kconfig"

source "subsys/net/l2/ppp/Kconfig"

config NET_L2_PHY_IEEE802154
	bool
	help
	  A common config for all IEEE 802.15.4 based L2 implementations.

source "subsys/net/l2/ieee802154/Kconfig"

source "subsys/net/l2/openthread/Kconfig"

config NET_L2_CUSTOM_IEEE802154
	bool "Custom IEEE802154 L2"
	select NET_L2_PHY_IEEE802154
	help
	  Enable custom IEEE802154 based L2. Zephyr does not provide
	  implementation for this L2 - users can implement their own L2 using
	  this symbol, on top of the IEEE802154 radio driver.

config NET_L2_CUSTOM_IEEE802154_MTU
	int "MTU for the custom IEEE802154 L2"
	depends on NET_L2_CUSTOM_IEEE802154
	default 127

source "subsys/net/l2/canbus/Kconfig"

config NET_L2_WIFI_UTILS
	bool
	help
	  This provides utility functions for Wi-Fi subsystem.

config NET_L2_WIFI_MGMT
	bool "Wi-Fi Management support"
	select NET_MGMT
	select NET_MGMT_EVENT
	select NET_MGMT_EVENT_INFO
	select NET_L2_WIFI_UTILS
	help
	  Enable support for Wi-Fi Management interface.

if NET_L2_WIFI_MGMT
module = NET_L2_WIFI_MGMT
module-dep = NET_LOG
module-str = Log level for Wi-Fi management layer
module-help = Enables Wi-Fi management interface to output debug messages.
source "subsys/net/Kconfig.template.log_config.net"
source "subsys/net/l2/wifi/Kconfig"
endif # NET_L2_WIFI_MGMT

config NET_L2_WIFI_SHELL
	bool "Wi-Fi shell module"
	select NET_L2_WIFI_MGMT
	select NET_L2_WIFI_UTILS
	select SHELL_GETOPT
	select GETOPT_LONG
	help
	  This can be used for controlling Wi-Fi through the console via
	  exposing a shell module named "wifi".

config NET_L2_PTP
	bool "PTP L2 support"
	select NET_PKT_TIMESTAMP
	select PTP_CLOCK
	help
	  Add support for PTP L2 capabilities. Required by gPTP.

endmenu
```

## subsys/net/l2/canbus/Kconfig
```kconfig
# Copyright (c) 2019 Alexander Wachter
# SPDX-License-Identifier: Apache-2.0

config NET_L2_CANBUS_RAW
	bool "CANBUS RAW l2 layer"
	help
	  Add a CANBUS L2 layer driver. This is the layer for SOCKET CAN.
```

## subsys/net/l2/cobs_serial/Kconfig
```kconfig
# COBS Serial L2 configuration
# SPDX-License-Identifier: Apache-2.0

config NET_L2_COBS_SERIAL
	bool "COBS Serial L2 layer"
	select NET_PKT_COBS
	help
	  Enable COBS (Consistent Overhead Byte Stuffing) L2 layer.
	  This L2 performs COBS encoding/decoding on packets sent/received
	  over serial links, providing framing and byte-stuffing.

if NET_L2_COBS_SERIAL

config NET_L2_COBS_SERIAL_RX_MARK_LOOPBACK
	bool "Mark RX packets as loopback (test/self-loop helper)"
	help
	  Mark received packets as loopback before passing them to the IP stack.
	  This is useful for self-loop tests where packets traverse a physical
	  medium (e.g., cross-wired UART) but still originate from a local IP
	  address. Without this, IPv6 input may drop such packets as spoofed
	  ("src addr is mine").

module = NET_L2_COBS_SERIAL
module-dep = NET_LOG
module-str = Log level for COBS Serial L2 layer
module-help = Sets log level for COBS Serial L2 operations.
source "subsys/net/Kconfig.template.log_config.net"

endif # NET_L2_COBS_SERIAL
```

## subsys/net/l2/dummy/Kconfig
```kconfig
# Copyright (c) 2024 Nordic Semiconductor
# SPDX-License-Identifier: Apache-2.0

source "subsys/net/l2/dummy/any/Kconfig"
```
