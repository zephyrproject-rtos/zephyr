## subsys/bluetooth/mesh/shell/Kconfig
```kconfig
# Bluetooth mesh shell configuration options

# Copyright (c) 2022 Nordic Semiconductor
# SPDX-License-Identifier: Apache-2.0

menuconfig BT_MESH_SHELL
	bool "Bluetooth mesh shell"
	select SHELL
	help
	  Activate shell module that provides Bluetooth mesh commands to
	  the console.

if BT_MESH_SHELL

config BT_MESH_SHELL_PROV
	bool "Support for provisioning shell commands"
	depends on BT_MESH_PROV
	default y
	help
	  This options enables support for provisioning shell commands.

config BT_MESH_SHELL_PROV_CTX_INSTANCE
	bool "Support for Shell provisioning context instance"
	depends on BT_MESH_SHELL_PROV
	help
	  This option enables the provisioning context instance in the
	  Bluetooth mesh shell module together with several provisioning
	  commands and target utility features. To use the provisioning
	  context instance, use bt_mesh_shell_prov in the
	  initialization of mesh.

config BT_MESH_SHELL_CDB
	bool "Support for CDB shell commands"
	depends on BT_MESH_CDB
	default y
	help
	  This options enables support for CDB shell commands.

config BT_MESH_SHELL_LOW_POWER
	bool "Support for Low Power node shell commands"
	depends on BT_MESH_LOW_POWER
	default y
	help
	  This option enables support for Low Power node shell commands.

config BT_MESH_SHELL_TEST
	bool "Support for test shell commands"
	default y
	help
	  This option enables support for test mesh shell commands.

config BT_MESH_SHELL_HEALTH_SRV_INSTANCE
	bool "Support for Shell Health Server model instance"
	depends on BT_MESH_SHELL_TEST
	help
	  This option enables Health Server model instance in the
	  Bluetooth mesh shell module together with fault controlling
	  shell commands. To use the model instance, add bt_mesh_shell_health_srv
	  to the device composition data. Use BT_MESH_SHELL_HEALTH_PUB_DEFINE to
	  instantiate publication context.

config BT_MESH_SHELL_GATT_PROXY
	bool "Support for GATT Proxy shell commands"
	depends on BT_MESH_GATT_PROXY || BT_MESH_PROXY_CLIENT
	default y
	help
	  This option enables support for GATT Proxy shell commands.

config BT_MESH_SHELL_HEALTH_CLI
	bool "Support for Health Client Model shell commands"
	depends on BT_MESH_HEALTH_CLI
	default y
	help
	  This option enables support of Health Client shell commands.

config BT_MESH_SHELL_CFG_CLI
	bool "Support for Configuration Client Model shell commands"
	depends on BT_MESH_CFG_CLI
	default y
	help
	  This option enables support of Configuration Client shell commands.

endif # BT_MESH_SHELL
```

## subsys/bluetooth/services/Kconfig
```kconfig
# GATT Services

# Copyright (c) 2018 Nordic Semiconductor ASA
# SPDX-License-Identifier: Apache-2.0

menu "GATT Services"
	depends on BT_CONN

rsource "Kconfig_dis"

rsource "Kconfig_cts"

rsource "Kconfig_hrs"

rsource "Kconfig_tps"

rsource "nus/Kconfig_nus"

rsource "ias/Kconfig_ias"

rsource "ots/Kconfig"

rsource "bas/Kconfig_bas"

endmenu
```

## subsys/bluetooth/services/Kconfig.amota
```kconfig
#
# Copyright (c) 2023 Ambiq Micro Inc.
#
# SPDX-License-Identifier: Apache-2.0

menuconfig BT_AMOTA
	bool "AMOTA service"
	help
	  Enable Ambiq GATT AMOTA BLE service.

if BT_AMOTA

module = BT_AMOTA
module-str = amota
source "subsys/logging/Kconfig.template.log_config"

endif # BT_AMOTA
```

## subsys/bluetooth/services/Kconfig.ans
```kconfig
# Bluetooth GATT Alert Notification Service

# Copyright (c) 2025 Sean Kyer
#
# SPDX-License-Identifier: Apache-2.0

menuconfig BT_ANS
	bool "GATT Alert Notification Service [EXPERIMENTAL]"
	depends on UTF8
	select EXPERIMENTAL

if BT_ANS

module = BT_ANS
module-str = Alert Notification Service (ANS)
source "subsys/logging/Kconfig.template.log_config"

menu "New Alert Categories"

config BT_ANS_NALRT_CAT_SIMPLE_ALERT
	bool "Support Simple Alert"

config BT_ANS_NALRT_CAT_EMAIL
	bool "Support Email"

config BT_ANS_NALRT_CAT_NEWS
	bool "Support News"

config BT_ANS_NALRT_CAT_CALL
	bool "Support Call"

config BT_ANS_NALRT_CAT_MISSED_CALL
	bool "Support Missed Call"

config BT_ANS_NALRT_CAT_SMS_MMS
	bool "Support SMS/MMS"

config BT_ANS_NALRT_CAT_VOICE_MAIL
	bool "Support Voice Mail"

config BT_ANS_NALRT_CAT_SCHEDULE
	bool "Support Schedule"

config BT_ANS_NALRT_CAT_HIGH_PRI_ALERT
	bool "Support High Priority Alert"

config BT_ANS_NALRT_CAT_INSTANT_MESSAGE
	bool "Support Instant Message"

endmenu

menu "Unread Alert Categories"

config BT_ANS_UNALRT_CAT_SIMPLE_ALERT
	bool "Support Simple Alert"

config BT_ANS_UNALRT_CAT_EMAIL
	bool "Support Email"

config BT_ANS_UNALRT_CAT_NEWS
	bool "Support News"

config BT_ANS_UNALRT_CAT_CALL
	bool "Support Call"

config BT_ANS_UNALRT_CAT_MISSED_CALL
	bool "Support Missed Call"

config BT_ANS_UNALRT_CAT_SMS_MMS
	bool "Support SMS/MMS"

config BT_ANS_UNALRT_CAT_VOICE_MAIL
	bool "Support Voice Mail"

config BT_ANS_UNALRT_CAT_SCHEDULE
	bool "Support Schedule"

config BT_ANS_UNALRT_CAT_HIGH_PRI_ALERT
	bool "Support High Priority Alert"

config BT_ANS_UNALRT_CAT_INSTANT_MESSAGE
	bool "Support Instant Message"

endmenu

endif # BT_ANS
```

## subsys/bluetooth/services/Kconfig.dis
```kconfig
# GATT Device Information service

# Copyright (c) 2018 Nordic Semiconductor ASA
# SPDX-License-Identifier: Apache-2.0

menuconfig BT_DIS
	bool "GATT Device Information service"

if BT_DIS

config BT_DIS_SETTINGS
	bool "Settings usage in Device Information Service"
	select SETTINGS
	help
	  Enable Settings usage in Device Information Service.

config BT_DIS_STR_MAX
	int "Maximum size in bytes for DIS strings"
	depends on BT_DIS_SETTINGS
	default 21
	range 2 248
	help
	  Bluetooth DIS string storage size. Storage can be up to 248 bytes
	  long (excluding NULL termination).

config BT_DIS_MODEL_NUMBER
	bool "Model number characteristic"
	depends on !BT_DIS_MODEL_DEPRECATED_USED
	default y
	help
	  Enable model number characteristic in Device Information Service.

config BT_DIS_MODEL_NUMBER_STR
	string "Model number"
	depends on BT_DIS_MODEL_NUMBER
	default SOC
	help
	  Configure model number string that can be read with the model number characteristic
	  in Device Information Service.

config BT_DIS_MODEL
	string "Model name [DEPRECATED]"
	help
	  The device model inside Device Information Service.
	  This option is deprecated. Use BT_DIS_MODEL_NUMBER and BT_DIS_MODEL_NUMBER_STR instead.

config BT_DIS_MODEL_DEPRECATED_USED
	bool
	default y if BT_DIS_MODEL != ""
	select DEPRECATED

config BT_DIS_MANUF_NAME
	bool "Manufacturer name characteristic"
	depends on !BT_DIS_MANUF_DEPRECATED_USED
	default y
	help
	  Enable manufacturer name characteristic in Device Information Service.

config BT_DIS_MANUF_NAME_STR
	string "Manufacturer name"
	depends on BT_DIS_MANUF_NAME
	default "Manufacturer"
	help
	  Configure manufacturer name string that can be read with the manufacturer name
	  characteristic in Device Information Service.

config BT_DIS_MANUF
	string "Manufacturer name [DEPRECATED]"
	help
	  The device manufacturer inside Device Information Service.
	  This option is deprecated. Use BT_DIS_MANUF_NAME and BT_DIS_MANUF_NAME_STR instead.

config BT_DIS_MANUF_DEPRECATED_USED
	bool
	default y if BT_DIS_MANUF != ""
	select DEPRECATED

config BT_DIS_PNP
	bool "PnP_ID characteristic"
	default y
	help
	  Enable PnP_ID characteristic in Device Information Service.

if BT_DIS_PNP

config BT_DIS_PNP_VID_SRC
	int "Vendor ID source"
	range 1 2
	default 1
	help
	  The Vendor ID Source field designates which organization assigned the
	  value used in the Vendor ID field value.
	  The possible values are:
	  - 1 Bluetooth SIG, the Vendor ID was assigned by the Bluetooth SIG
	  - 2 USB IF, the Vendor ID was assigned by the USB IF

config BT_DIS_PNP_VID
	hex "Vendor ID"
	range 0 0xFFFF
	default 0
	help
	  The Vendor ID field is intended to uniquely identify the vendor of the
	  device. This field is used in conjunction with Vendor ID Source field,
	  which determines which organization assigned the Vendor ID field value.
	  Note: The Bluetooth Special Interest Group assigns Device ID Vendor ID,
	  and the USB Implementers Forum assigns Vendor IDs,
	  either of which can be used for the Vendor ID field value.
	  Device providers should procure the Vendor ID from the USB Implementers
	  Forum or the Company Identifier from the Bluetooth SIG.

config BT_DIS_PNP_PID
	hex "Product ID"
	range 0 0xFFFF
	default 0
	help
	  The Product ID field is intended to distinguish between different products
	  made by the vendor identified with the Vendor ID field. The vendors
	  themselves manage Product ID field values.

config BT_DIS_PNP_VER
	hex "Product Version"
	range 0 0xFFFF
	default 1
	help
	  The Product Version field is a numeric expression identifying the device
	  release number in Binary-Coded Decimal. This is a vendor-assigned value,
	  which defines the version of the product identified by the Vendor ID and
	  Product ID fields. This field is intended to differentiate between
	  versions of products with identical Vendor IDs and Product IDs.
	  The value of the field value is 0xJJMN for version JJ.M.N
	  (JJ - major version number, M - minor version number,
	  N - sub-minor version number); e.g., version 2.1.3 is represented with
	  value 0x0213 and version 2.0.0 is represented with a value of 0x0200.
	  When upward-compatible changes are made to the device, it is recommended
	  that the minor version number be incremented. If incompatible changes are
	  made to the device, it is recommended that the major version number be
	  incremented. The sub-minor version is incremented for bug fixes.

endif # BT_DIS_PNP

config BT_DIS_SERIAL_NUMBER
	bool "DIS Serial number characteristic"
	help
	  Enable Serial Number characteristic in Device Information Service.

config BT_DIS_SERIAL_NUMBER_STR
	string "Serial Number"
	depends on BT_DIS_SERIAL_NUMBER
	help
	  Enable Serial Number characteristic in Device Information Service.

config BT_DIS_FW_REV
	bool "DIS Firmware Revision characteristic"
	help
	  Enable Firmware Revision characteristic in Device Information Service.

config BT_DIS_FW_REV_STR
	string "Firmware revision"
	depends on BT_DIS_FW_REV
	default "$(APP_VERSION_TWEAK_STRING)" if "$(VERSION_MAJOR)" != ""
	default "0.0.0+0"
	help
	  Enable firmware revision characteristic in Device Information Service.

config BT_DIS_HW_REV
	bool "DIS Hardware Revision characteristic"
	help
	  Enable Hardware Revision characteristic in Device Information Service.

config BT_DIS_HW_REV_STR
	string "Hardware revision"
	depends on BT_DIS_HW_REV
	help
	  Enable hardware revision characteristic in Device Information Service.

config BT_DIS_SW_REV
	bool "DIS Software Revision characteristic"
	help
	  Enable Software Revision characteristic in Device Information Service.

config BT_DIS_SW_REV_STR
	string "Software revision"
	depends on BT_DIS_SW_REV
	help
	  Enable software revision characteristic in Device Information Service.

config BT_DIS_UDI
	bool "DIS UDI for Medical Devices characteristic"
	help
	  Enable UDI for Medical Devices characteristic in Device Information Service.

if BT_DIS_UDI
config BT_DIS_UDI_LABEL_STR
	string "UDI Label"
	help
	  String value matching the UDI in human readable form
	  as assigned to the product by a recognized UDI Issuer.

config BT_DIS_UDI_DI_STR
	string "UDI Device Identifier"
	help
	  A fixed portion of a UDI that identifies the labeler and the
	  specific version or model of a device.

config BT_DIS_UDI_ISSUER_STR
	string "UDI Issuer"
	help
	  OID representing the UDI Issuing Organization, such as GS1.

config BT_DIS_UDI_AUTHORITY_STR
	string "UDI Authority"
	help
	  OID representing the regional UDI Authority, such as the US FDA.
endif # BT_DIS_UDI

config BT_DIS_SYSTEM_ID
	bool "DIS System ID characteristic [experimental]"
	select EXPERIMENTAL
	help
	  Enable System ID characteristic in Device Information Service.
	  The System ID characteristic is used to represent an extended unique identifier (EUI) of the system
	  implementing the service that contains this characteristic. This 64-bit structure is an EUI-64 which consists
	  of an Organizationally Unique Identifier (OUI) concatenated with a manufacturer-defined identifier.

	  This will be transmitted as the 40 bit identifier followed by the 24-bit OUI.
	  Both in little-endian format.

if BT_DIS_SYSTEM_ID
config BT_DIS_SYSTEM_ID_OUI
	hex "Organizationally Unique Identifier (OUI) of the manufacturer."
	range 0 0xFFFFFF
	default 0
	help
	  The OUI is a 24-bit number issued by the IEEE Registration Authority.
	  System ID characteristic in Device Information Service.
	  Shall contain an Organisationally Unique Identifier (OUI) followed by a manufacturer-defined indentifier unique for the device.

config BT_DIS_SYSTEM_ID_IDENTIFIER
	hex "Manufacturer-defined unique identifier."
	range 0 0xFFFFFFFFFF
	default 0
	help
	  The manufacturer-defined unique identifier is 40 bits long.
endif # BT_DIS_SYSTEM_ID

config BT_DIS_IEEE_RCDL
	bool "DIS IEEE 11073-20601 Regulatory Certification Data List characteristic"
	help
	  Enable IEEE 11073-20601 Regulatory Certification Data List characteristic in Device Information Service.

config BT_DIS_IEEE_RCDL_STR
	string "IEEE 11073-20601 Regulatory Certification Data List"
	depends on BT_DIS_IEEE_RCDL
	help
	  IEEE 11073-20601 Regulatory Certification Data List characteristic in Device Information Service string contents.

endif # BT_DIS
```
