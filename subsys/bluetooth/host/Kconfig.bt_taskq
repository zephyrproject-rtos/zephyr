## subsys/bluetooth/host/audio/Kconfig
```kconfig
# Bluetooth Audio configuration options

#
# Copyright (c) 2020 Intel Corporation
#
# SPDX-License-Identifier: Apache-2.0
#

# This file now contains what is not yet in
# subsys/bluetooth/audio/Kconfig or in
# subsys/bluetooth/Kconfig, and
# depends upon those files

if BT_AUDIO

config BT_ISO
	bool

config BT_CCID
	bool # hidden
	default n
	help
	  This hidden option is enabled when any of the content control
	  features are enabled.

if BT_CONN

if BT_AUDIO_UNICAST

config BT_CODEC_MAX_DATA_COUNT
	int "Codec Capabilities Data Count"
	default 5
	range 1 128
	help
	  This option defines the maximum number of LTV entries a codec can
	  store.

config BT_CODEC_MAX_DATA_LEN
	int "Codec Capabilities Data Length"
	default 4
	range 1 128
	help
	  This option defines the maximum value length of an LTV entry a codec
	  can store.

config BT_CODEC_MAX_METADATA_COUNT
	int "Codec Metadata Count"
	default 2
	range 1 128
	help
	  This option defines the maximum number of LTV entries a metadata can
	  store.

config BT_CODEC_MAX_METADATA_LEN
	int "Codec Metadata Length"
	default 4
	range 1 128
	help
	  This option defines the maximum value length of an LTV entry a
	  metadata can store.

source "subsys/bluetooth/host/audio/Kconfig.baps"

endif # BT_AUDIO_UNICAST
endif # BT_CONN

if BT_AUDIO_DEBUG

config BT_AUDIO_DEBUG_ISO
	bool "ISO channel debug"
	help
	  Use this option to enable ISO channels debug logs for the
	  Bluetooth Audio functionality.


config BT_DEBUG_PACS
	bool "Published Audio Capabilities Service debug"
	depends on BT_PACS
	help
	  Use this option to enable Published Audio Capabilities Service debug
	  logs for the Bluetooth Audio functionality.

config BT_AUDIO_DEBUG_CHAN
	bool "Bluetooth Audio Channel debug"
	depends on BT_AUDIO_CHAN
	help
	  Use this option to enable Bluetooth Audio Channel debug logs for the
	  Bluetooth Audio functionality.

config BT_AUDIO_DEBUG_ENDPOINT
	bool "Bluetooth Audio Endpoint debug"
	depends on BT_AUDIO_ENDPOINT
	help
	  Use this option to enable Bluetooth Audio Endpoint debug logs for the
	  Bluetooth Audio functionality.

config BT_AUDIO_DEBUG_CAPABILITIES
	bool "Bluetooth Audio Capabilities debug"
	depends on BT_AUDIO_CAPABILITIES
	help
	  Use this option to enable Bluetooth Audio Capabilities debug logs for
	  the Bluetooth Audio functionality.

config BT_DEBUG_ASCS
	bool "Audio Stream Control Service debug"
	depends on BT_ASCS
	help
	  Use this option to enable Audio Stream Control Service debug logs for
	  the Bluetooth Audio functionality.

config BT_DEBUG_BAP
	bool "Basic Audio Profile debug"
	depends on BT_BAP
	help
	  Use this option to enable Basic Audio Profile debug logs for the
	  Bluetooth Audio functionality.

endif # BT_AUDIO_DEBUG

# Include Kconfig files for the various parts of the host audio stack
source "subsys/bluetooth/host/audio/Kconfig.csis"
source "subsys/bluetooth/host/audio/Kconfig.bass"
source "subsys/bluetooth/host/audio/Kconfig.tbs"
source "subsys/bluetooth/host/audio/Kconfig.ots"
source "subsys/bluetooth/host/audio/Kconfig.mcs"

endif # BT_AUDIO
```

## subsys/bluetooth/host/audio/Kconfig.ascs
```kconfig
# Bluetooth Audio - Audio Stream Control configuration options
#
# Copyright (c) 2020 Intel Corporation

# SPDX-License-Identifier: Apache-2.0
#

config BT_ASCS
	bool "Audio Stream Control Service Support [d09r08]"
	default y
	help
	  This option enables support for Audio Stream Control Service.

if BT_ASCS
config BT_ASCS_ASE_COUNT
	int "Number of Audio Stream Endpoint Characteristics"
	default 2
	range 1 3
	help
	  An ASE characteristic represents the state of an ASE, which is
	  coupled to a single direction of a unicast Audio Stream.
endif # BT_ASCS
```

## subsys/bluetooth/host/audio/Kconfig.bap
```kconfig
# Bluetooth Audio - Basic Audio Profile configuration options
#
# Copyright (c) 2020 Intel Corporation

# SPDX-License-Identifier: Apache-2.0
#

config BT_BAP
	bool "Basic Audio Profile Support [d09r17]"
	select BT_GATT_AUTO_DISCOVER_CCC
	default n
	help
	  This option enables support for Basic Audio Profile (BAP).

if BT_BAP
config BT_BAP_UNICAST_GROUP_COUNT
	int "Basic Audio Unicast Group count"
	depends on BT_AUDIO_UNICAST
	default BT_ISO_MAX_CIG
	range 0 BT_ISO_MAX_CIG
	help
	  This option sets the number of connected audio groups to support as
	  the unicast client.

config BT_BAP_UNICAST_GROUP_STREAM_COUNT
	int "Basic Audio Unicast Group Stream count"
	depends on BT_BAP_UNICAST_GROUP_COUNT > 0
	default 1
	range 0 BT_ISO_MAX_CHAN if BT_ISO_MAX_CHAN < 31
	range 0 31
	help
	  This option sets the maximum number of streams per unicast group
	  to support.

config BT_BAP_PAC_COUNT
	int "Basic Audio Profile PAC count"
	default 2
	range 1 4 if BT_AUDIO_BROADCAST_SRC_STREAM_COUNT = 0
	range 0 4
	help
	  This option enables caching a number of Published Audio Capabilities
	  (PAC) for Basic Audio Profile on a per connection basis.

config BT_BAP_ASE_SNK_COUNT
	int "Basic Audio Profile ASE Sink count"
	default 2
	range 0 2
	help
	  This option enables caching a number of Audio Stream Endpoint Sink
	  instances for Basic Audio Profile on a per connection basis.

config BT_BAP_ASE_SRC_COUNT
	int "Basic Audio Profile ASE Source count"
	default 1
	range 0 2
	help
	  This option enables caching a number of Audio Stream Endpoint Source
	  instances for Basic Audio Profile on a per connection basis.
endif # BT_BAP
```

## subsys/bluetooth/host/audio/Kconfig.baps
```kconfig
# Bluetooth Audio - Basic Audio configuration options
#
# Copyright (c) 2020 Intel Corporation

# SPDX-License-Identifier: Apache-2.0
#

config BT_AUDIO_STREAM
	# Virtual/hidden option
	bool
	default y if BT_ASCS || BT_BAP || BT_AUDIO_BROADCAST_SINK || BT_AUDIO_BROADCAST_SOURCE

config BT_AUDIO_ENDPOINT
	# Virtual/hidden option
	bool
	default y if BT_ASCS || BT_BAP || BT_AUDIO_BROADCAST_SINK || BT_AUDIO_BROADCAST_SOURCE

config BT_AUDIO_CAPABILITIES
	# Virtual/hidden option
	bool
	default y if BT_ASCS || BT_BAP || BT_AUDIO_BROADCAST_SINK

source "subsys/bluetooth/host/audio/Kconfig.pacs"
source "subsys/bluetooth/host/audio/Kconfig.ascs"
source "subsys/bluetooth/host/audio/Kconfig.bap"
```

## subsys/bluetooth/host/audio/Kconfig.csis
```kconfig
# Bluetooth Audio - Broadcast Assistant configuration options
#
# Copyright (c) 2020 Bose Corporation
#
# SPDX-License-Identifier: Apache-2.0
#

if BT_AUDIO

#################### Coordinated Set Identification Service ####################

config BT_CSIS
	bool "Coordinated Set Identification Service Support"
	imply BT_EXT_ADV if BT_PRIVACY
	help
	  This option enables support for Coordinated Set Identification
	  Service.

if BT_CSIS

config BT_CSIS_TEST_SAMPLE_DATA
	bool "Coordinated Set Identification Service Test Sample Data"
	help
	  Enable the use of the sample data defined by the CSIS spec SIRK.
	  This will use the sample SIRK, prand and LTK.
	  Should not be used for production builds.

config BT_CSIS_SET_SIZE
	int "Coordinated Set Identification Service Size"
	default 2
	range 2 255
	help
	  The size of the set (number of devices).

config BT_CSIS_SET_RANK
	int "Coordinated Set Identification Service Rank"
	default 1
	range 1 BT_CSIS_SET_SIZE
	help
	  The rank of the device in the set.

config BT_CSIS_SET_SIRK_SEED
	int "Coordinated Set Identification Service seed to generate SIRK"
	default 123456
	range 1 4294967295
	help
	  Seed used to generate a unique SIRK for the set.

config BT_CSIS_ENC_SIRK_SUPPORT
	bool "Support for encrypted SIRK"
	default y
	select BT_SMP_SC_PAIR_ONLY
	help
	  Enables support encrypting the SIRK.

############### DEBUG ###############

config BT_DEBUG_CSIS
	bool "Coordinated Set Identification Service debug"
	depends on BT_AUDIO_DEBUG
	help
	  Use this option to enable Coordinated Set Identification Service debug
	  logs for the Bluetooth Audio functionality.

endif # BT_CSIS

#################### Coordinated Set Identification Client ####################

config BT_CSIP
	bool "Coordinated Set Identification Profile Support"
	help
	  This option enables support for Coordinated Set Identification
	  Profile.

if BT_CSIP

config BT_CSIP_MAX_CSIS_INSTANCES
	int "Coordinated Set Identification Service Count"
	default 1
	range 1 3
	help
	  Sets the number of service instances, which corresponds to the number
	  of different sets the peer device may be in.


config BT_CSIP_ENC_SIRK_SUPPORT
	bool "Support for encrypted SIRK"
	default y
	select BT_SMP_SC_PAIR_ONLY
	help
	  Enables support encrypting the SIRK.

############### DEBUG ###############

config BT_DEBUG_CSIP
	bool "Coordinated Set Identification Profile debug"
	depends on BT_AUDIO_DEBUG
	help
	  Use this option to enable Coordinated Set Identification Profile debug
	  logs for the Bluetooth Audio functionality.

endif # BT_CSIP

config BT_DEBUG_CSIS_CRYPTO
	bool "Coordinated Set Identification Service crypto functions debug"
	depends on BT_AUDIO_DEBUG
	depends on BT_CSIP || BT_CSIS
	help
	  Use this option to enable Coordinated Set Identification Service
	  crypto functions debug logs for the Bluetooth Audio functionality.

endif # BT_AUDIO
```

## subsys/bluetooth/host/audio/Kconfig.mcs
```kconfig
# Bluetooth Audio - Media control configuration options

#
# Copyright (c) 2020 Nordic Semiconductor
#
# SPDX-License-Identifier: Apache-2.0
#

if BT_AUDIO

#### Media Control Service ################################

config BT_MCS
	bool "Media Control Service Support"
	default n
	select BT_CCID
	help
	  This option enables support for the Media Control Service.

if BT_MCS

config BT_MCS_MEDIA_PLAYER_NAME
	string "Media Player Name"
	default "Player0"
	help
	  Sets the name of the media player

config BT_MCS_ICON_URI
	string "Media player Icon URI"
	default "http://server.some.where/path/icon.png"
	help
	  This option sets the URI of the Media Player Icon

#### Debug logs ################################################################

config BT_DEBUG_MCS
	bool "Media Control Service debug"
	depends on BT_AUDIO_DEBUG
	help
	  Use this option to enable Media Control Service debug logs for the
	  Bluetooth Audio functionality.

endif # BT_MCS

#### Media Control Client ################################

config BT_MCC
	bool "Media Control Client Support"
	default n
	help
	  This option enables support for the Media Control Client.

if BT_MCC

config BT_MCC_MAX_OTS_INST
	int "Maximum number of OTS instances to setup"
	default 1
	range 0 1
	help
	  Sets the maximum number of Object Transfer Service (OTS)
	  instances to setup and use for the Media Control Service client.

config BT_MCC_OTC_OBJ_BUF_SIZE
	int "The size of the buffer used for OTC object in MCC"
	default 512
	range 1 65536
	help
	  Sets the size (in octets) of the buffer used for receiving the content
	  of objects.
	  Should be set large enough to fit any expected object.

config BT_MCC_TOTAL_OBJ_CONTENT_MEM
	int "Total memory size to use for storing the content of objects"
	default 1
	range 0 65536
	help
	  Sets the total memory size (in octets) to use for storing the content
	  of objects.
	  This is used for the total memory pool buffer size from which memory
	  is allocated when reading object content

config BT_MCC_TRACK_SEGS_MAX_CNT
	int "Maximum number of tracks segments in a track segment object"
	default 25
	range 0 500
	help
	  Sets the maximum number of tracks segments in a track segment object.
	  If the received object is bigger, the remaining data in the object
	  will be ignored

config BT_MCC_GROUP_RECORDS_MAX
	int "Maximum number of records in a group object"
	default 25
	range 0 500
	help
	  Sets the maximum number of records in a group object. If the received
	  group object has more records than this, the remaining records in the
	  object will be ignored.

config BT_MCC_SHELL
	bool "Media Control Client Shell Support"
	default n
	default y if BT_SHELL
	help
	  This option enables shell support for the Media Control Client.

#### MCC Debug logs ####

config BT_DEBUG_MCC
	bool "Media Control Client debug"
	depends on BT_AUDIO_DEBUG
	help
	  Use this option to enable Media Control Client debug logs for the
	  Bluetooth Audio functionality.

endif # BT_MCC


if BT_MCS || BT_MCC

config BT_MCS_MEDIA_PLAYER_NAME_MAX
	int "Max length of media player name"
	default 20
	range 1 255
	help
	  Sets the maximum number of bytes (including the null termination) of
	  the name of the media player

config BT_MCS_ICON_URI_MAX
	int "Max length of media player icon URI"
	default 30
	range 1 255
	help
	  Sets the maximum number of bytes (including the null termination) of
	  the media player icon URI

config BT_MCS_TRACK_TITLE_MAX
	int "Max length of the title of a track"
	default 25
	range 1 255
	help
	  Sets the maximum number of bytes (including the null termination) of
	  the title of any track in the media player

config BT_MCS_GROUP_TITLE_MAX
	int "Max length of the title of a group of tracks"
	default BT_MCS_TRACK_TITLE_MAX
	range 1 255
	help
	  Sets the maximum number of bytes (including the null termination) of
	  the title of any track in the media player

config BT_MCS_SEGMENT_NAME_MAX
	int "Max length of the name of a track segment"
	default 25
	range 1 255
	help
	  Sets the the maximum number of bytes (including the null termination)
	  of the name of any track segment in the media player

config BT_MCS_ICON_BITMAP_SIZE
	int "Media player Icon bitmap object size"
	default 127
	help
	  This option sets the maximum size (in octets) of the icon object.

config BT_MCS_TRACK_SEG_MAX_SIZE
	int "Maximum size for a track segment object"
	default 127
	help
	  This option sets the maximum size (in octets) of a track segment object

config BT_MCS_TRACK_MAX_SIZE
	int "Maximum size for a track object"
	default 127
	help
	  This option sets the maximum size (in octets) of a track object

config BT_MCS_GROUP_MAX_SIZE
	int "Maximum size for a group object"
	default 127
	help
	  This option sets the maximum size (in octets) of a group object

config BT_MCS_MAX_OBJ_SIZE
	int "Total memory size to use for storing the content of objects"
	default 127
	range 0 65536
	help
	  Sets the total memory size (in octets) to use for storing the content of objects.
	  This is used for the total memory pool buffer size from which memory
	  is allocated when sending object content.

endif # BT_MCS || BT_MCC

endif # BT_AUDIO
```

## subsys/bluetooth/host/audio/Kconfig.ots
```kconfig
# Bluetooth Audio - Object transfer configuration options

#
# Copyright (c) 2020 Nordic Semiconductor
#
# SPDX-License-Identifier: Apache-2.0
#

if BT_AUDIO

#### Object Transfer Service ################################

config BT_OTS_TEMP
	bool "Object Transfer Service Support"
	select BT_L2CAP_DYNAMIC_CHANNEL
	select BT_GATT_DYNAMIC_DB
	default n
	help
	  This option enables support for the Object Transfer Service.

if BT_OTS_TEMP

config BT_OTS_TEMP_SERVICE_COUNT
	int "Object Transfer Service count"
	range 1 5
	default 1
	help
	  Sets the number of OTS services to instantiate. The count should be
	  equal to the number of services that include it.

config BT_DEBUG_OTS
	bool "Object Transfer Service debug"
	depends on BT_AUDIO_DEBUG
	help
	  Use this option to enable Object Transfer Service debug logs for the
	  Bluetooth Audio functionality.

endif # BT_OTS_TEMP


#### Object Transfer Service Client ################################

config BT_OTC
	bool "Object Transfer Service Client Support"
	select BT_L2CAP_DYNAMIC_CHANNEL
	select BT_GATT_CLIENT
	select BT_GATT_AUTO_DISCOVER_CCC
	default n
	help
	  This option enables support for the Object Transfer Service Client.

if BT_OTC

config BT_DEBUG_OTC
	bool "Object Transfer Client debug"
	depends on BT_AUDIO_DEBUG
	depends on BT_OTC
	help
	  Use this option to enable Object Transfer Client debug logs for the
	  Bluetooth Audio functionality.

endif # BTC

endif # BT_AUDIO
```
