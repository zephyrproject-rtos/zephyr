## subsys/console/Kconfig
```kconfig
# Copyright (c) 2017 Linaro Limited
# SPDX-License-Identifier: Apache-2.0

menuconfig CONSOLE_SUBSYS
	bool "Console subsystem/support routines [EXPERIMENTAL]"
	help
	  Console subsystem and helper functions

if CONSOLE_SUBSYS

choice CONSOLE_RX_TYPE
	prompt "Console RX type"

config CONSOLE_RX_INTERRUPT_DRIVEN
	bool "Console RX is interrupt driven"
	depends on UART_CONSOLE && SERIAL_SUPPORT_INTERRUPT

config CONSOLE_RX_POLLING
	bool "Console RX is polling"
	depends on UART_CONSOLE
	select RING_BUFFER

endchoice

config CONSOLE_POLLING_RX_POLL_PERIOD
	int "RX polling period (in milliseconds)"
	default 10
	depends on CONSOLE_RX_POLLING
	help
	  Determines how often UART is polled for RX byte.

choice
	prompt "Console 'get' function selection"
	optional
	depends on UART_CONSOLE

config CONSOLE_GETCHAR
	bool "Character by character input and output"
	select UART_CONSOLE_DEBUG_SERVER_HOOKS
	select CONSOLE_HANDLER if CONSOLE_RX_INTERRUPT_DRIVEN

config CONSOLE_GETLINE
	bool "Line by line input"
	select CONSOLE_HANDLER if CONSOLE_RX_INTERRUPT_DRIVEN

endchoice

if CONSOLE_GETCHAR

config CONSOLE_GETCHAR_BUFSIZE
	int "console_getchar() buffer size"
	default 16
	help
	  Buffer size for console_getchar(). The default is optimized
	  to save RAM. You may need to increase it e.g. to support
	  large host-side clipboard pastes. Set to 0 to disable
	  interrupt-driven operation and use busy-polling.

config CONSOLE_PUTCHAR_BUFSIZE
	int "console_putchar() buffer size"
	default 16
	help
	  Buffer size for console_putchar().  The default is optimized
	  to save RAM. You may need to increase it e.g. to support
	  large host-side clipboard pastes. Set to 0 to disable
	  interrupt-driven operation and use busy-polling.

endif # CONSOLE_GETCHAR

endif # CONSOLE_SUBSYS
```

## subsys/cpp/Kconfig
```kconfig
# C++ configuration options

# Copyright (c) 2018 B. Leforestier
# SPDX-License-Identifier: Apache-2.0

menuconfig CPLUSPLUS
	bool "C++ support for the application"
	help
	  This option enables the use of applications built with C++.

if CPLUSPLUS

choice
	prompt "C++ Standard"
	default STD_CPP11
	help
	  C++ Standards.

config STD_CPP98
	bool "C++ 98"
	help
	  1998 C++ standard as modified by the 2003 technical corrigendum
	  and some later defect reports.

config STD_CPP11
	bool "C++ 11"
	help
	  2011 C++ standard, previously known as C++0x.

config STD_CPP14
	bool "C++ 14"
	help
	  2014 C++ standard.

config STD_CPP17
	bool "C++ 17"
	help
	  2017 C++ standard, previously known as C++0x.

config STD_CPP2A
	bool "C++ 2a"
	help
	  Next revision of the C++ standard, which is expected to be published in 2020.

config STD_CPP20
	bool "C++ 20"
	help
	  2020 C++ standard, previously known as C++2A.

config STD_CPP2B
	bool "C++ 2b"
	help
	  Next revision of the C++ standard, which is expected to be published in 2023.

endchoice

config LIB_CPLUSPLUS
	bool "Link with STD C++ library"
	depends on !MINIMAL_LIBC
	help
	  Link with STD C++ Library.

if LIB_CPLUSPLUS

config EXCEPTIONS
	bool "Enable C++ exceptions support"
	depends on !NEWLIB_LIBC_NANO
	help
	  This option enables support of C++ exceptions.

config RTTI
	bool "Enable C++ RTTI support"
	help
	  This option enables support of C++ RTTI.

endif # LIB_CPLUSPLUS

endif # CPLUSPLUS
```

## subsys/cpu_freq/Kconfig
```kconfig
# Copyright (c) 2025 Analog Devices, Inc.
#
# SPDX-License-Identifier: Apache-2.0

config HAS_CPU_FREQ
	bool
	help
	  Enabled by the SoC if it has a DTS property indicating support for
	  CPU frequency scaling.

menuconfig CPU_FREQ
	bool "CPU Frequency Scaling Subsystem"
	select EXPERIMENTAL
	help
	  CPU Frequency scaling subsystem

if CPU_FREQ

module = CPU_FREQ
module-str = CPU Frequency Scaling
source "subsys/logging/Kconfig.template.log_config"

config CPU_FREQ_INTERVAL_MS
	int "CPU Freq evaluation interval"
	default 1000
	help
	  Controls the interval (in milliseconds) at which the CPU Frequency
	  subsystem runs and evaluates the current policy.

config CPU_FREQ_PER_CPU_SCALING
	bool "Per-CPU frequency scaling"
	default n
	depends on SMP
	help
	  Enable per-CPU frequency scaling support. If disabled, setting the
	  P-state will apply to the whole system instead of just the current CPU.
	  This should be done at the SoC level.

choice CPU_FREQ_POLICY
	prompt "CPU Frequency Scaling Policy"
	default CPU_FREQ_POLICY_NONE
	help
	  The policy algorithm to use when using the CPU freq subsystem.

config CPU_FREQ_POLICY_NONE
	bool "No selected policy"
	help
	  Kconfig placeholder if no policy is chosen. This Kconfig will produce a build error

config CPU_FREQ_POLICY_ON_DEMAND
	bool "On-demand Policy"
	select CPU_LOAD_METRIC

config CPU_FREQ_POLICY_PRESSURE
	bool "Pressure based Policy"
	select TRACING
	help
	  Pressure based policy

config CPU_FREQ_POLICY_ENERGY_AWARE
	bool "Energy-aware Policy"
	select CPU_WORKLOAD
	select CPU_WORKLOAD_ESTIMATE
	select POWER_ENERGY_MODEL
	select POWER_QOS
	help
	  Select a P-state by estimating the time needed to finish the next
	  workload window at each available CPU frequency, rejecting P-states
	  that cannot finish before the next policy deadline, and choosing the
	  legal P-state with the lowest estimated active, transition and idle
	  energy score.

endchoice # CPU_FREQ_POLICY

if CPU_FREQ_POLICY_PRESSURE

config CPU_FREQ_POLICY_PRESSURE_LOWEST_PRIO
	int "The lowest priority level (highest numerically) to accumulate"
	default 1
	help
	  The lowest priority level (highest numerically) to accumulate. This should be your lowest priority thread.
	  This priority must not be lower than the idle thread's priority.

config CPU_FREQ_POLICY_PRESSURE_WORKLOAD_DAMPING
	bool "Dampen short pressure bursts using workload history"
	default y
	select CPU_LOAD_METRIC
	help
	  Use CPU load samples to dampen instantaneous runnable-thread pressure
	  when recent runtime history shows little actual non-idle work. This keeps
	  short ready-queue bursts from being treated as sustained CPU demand.

config CPU_FREQ_POLICY_PRESSURE_WORKLOAD_MIN_CONFIDENCE
	int "Minimum workload confidence for pressure damping"
	default 40
	range 0 100
	depends on CPU_FREQ_POLICY_PRESSURE_WORKLOAD_DAMPING
	help
	  Minimum CPU load sample confidence required before it can dampen pressure.
	  Lower values react sooner after boot; higher values wait for more
	  runtime-history samples.

config CPU_FREQ_POLICY_PRESSURE_WORKLOAD_LOW_UTILIZATION
	int "Low utilization threshold for pressure damping"
	default 10
	range 0 100
	depends on CPU_FREQ_POLICY_PRESSURE_WORKLOAD_DAMPING
	help
	  Runtime utilization at or below this percentage is considered low enough
	  to treat high instantaneous pressure as a possible short burst.

config CPU_FREQ_POLICY_PRESSURE_WORKLOAD_DAMPING_PERCENT
	int "Pressure damping percentage"
	default 50
	range 0 100
	depends on CPU_FREQ_POLICY_PRESSURE_WORKLOAD_DAMPING
	help
	  Percentage by which pressure is reduced when a short burst is detected.

endif

if CPU_FREQ_POLICY_ENERGY_AWARE

config CPU_FREQ_POLICY_ENERGY_AWARE_DEADLINE_US
	int "Fallback energy-aware policy deadline in microseconds"
	default 0
	help
	  Fallback deadline used when PM has no earlier registered event. If set
	  to 0, the policy uses CONFIG_CPU_FREQ_INTERVAL_MS as the fallback
	  workload window.

endif

choice CPU_FREQ_PSTATE_SET
	prompt "Select method of setting CPU P-state"
	default CPU_FREQ_PSTATE_SET_SOC if HAS_CPU_FREQ
	default CPU_FREQ_PSTATE_SET_STUB
	help
	  The implementation used to set the CPU P-state.

config CPU_FREQ_PSTATE_SET_STUB
	bool "Stub P-state setter"
	help
	  A stub implementation that does nothing. This is useful for
	  exercising the CPU frequency subsystem without actually
	  changing the CPU frequency.

config CPU_FREQ_PSTATE_SET_SOC
	bool "SoC-specific P-state setter"
	depends on HAS_CPU_FREQ
	help
	  A SoC-specific implementation that sets the CPU P-state using
	  SoC-specific mechanisms. This requires the SoC to provide
	  the necessary implementation of cpu_freq_pstate_set().

config CPU_FREQ_PSTATE_SET_CUSTOM
	bool "Custom P-state setter defined by the project"
	help
	  A custom implementation that sets the CPU P-state using
	  project-specific mechanisms. This requires the project to provide
	  the necessary implementation of cpu_freq_pstate_set().

endchoice # CPU_FREQ_PSTATE_SET

endif # CPU_FREQ
```

## subsys/cpu_load/Kconfig
```kconfig
# Copyright (c) 2025 Analog Devices, Inc.
#
# SPDX-License-Identifier: Apache-2.0

menuconfig CPU_LOAD_METRIC
	bool "CPU Load Subsystem"
	select EXPERIMENTAL
	select THREAD_RUNTIME_STATS
	select SCHED_THREAD_USAGE
	select SCHED_THREAD_USAGE_ALL
	select SCHED_THREAD_USAGE_AUTO_ENABLE
	help
	  CPU Load subsystem

if CPU_LOAD_METRIC

module = CPU_LOAD
module-str = CPU Load Metric
source "subsys/logging/Kconfig.template.log_config"

endif # CPU_LOAD_METRIC
```

## subsys/cpu_workload/Kconfig
```kconfig
# Copyright 2026 NXP
#
# SPDX-License-Identifier: Apache-2.0

menuconfig CPU_WORKLOAD
	bool "CPU Workload"
	select EXPERIMENTAL
	help
	  CPU workload subsystem.

if CPU_WORKLOAD

module = CPU_WORKLOAD
module-str = CPU Workload
source "subsys/logging/Kconfig.template.log_config"

config CPU_WORKLOAD_HISTORY
	bool "CPU runtime-history workload"
	select THREAD_RUNTIME_STATS
	select SCHED_THREAD_USAGE
	select SCHED_THREAD_USAGE_ALL
	select SCHED_THREAD_USAGE_AUTO_ENABLE
	help
	  Track recent CPU runtime history from scheduler runtime statistics.
	  The history workload reports non-idle cycles, elapsed runtime-stat cycles,
	  load percentage, and confidence since the previous cpu_workload query.

config CPU_WORKLOAD_THREAD_PROFILE
	bool "Per-thread workload profile"
	select THREAD_RUNTIME_STATS
	select SCHED_THREAD_USAGE
	select SCHED_THREAD_USAGE_ANALYSIS
	select SCHED_THREAD_USAGE_AUTO_ENABLE
	help
	  Build a per-thread workload profile from scheduler runtime usage windows.

config CPU_WORKLOAD_THREAD_PROFILE_EWMA_SHIFT
	int "Per-thread workload EWMA shift"
	default 3
	range 1 8
	depends on CPU_WORKLOAD_THREAD_PROFILE
	help
	  Shift used by the per-thread workload EWMA.
	  A value of 3 gives alpha = 1/8, using avg = ((7 * avg) + burst) / 8.
	  Smaller values react faster; larger values smooth more aggressively.

config CPU_WORKLOAD_THREAD_PROFILE_CACHE_SIZE
	int "Per-thread workload profile cache size"
	default 16
	range 1 256
	depends on CPU_WORKLOAD_THREAD_PROFILE
	help
	  Maximum number of thread burst profiles cached by the subsystem.
	  Threads that cannot be cached remain unprofiled for thread-profile
	  consumers.

config CPU_WORKLOAD_READY_BACKLOG
	bool "CPU ready backlog workload"
	select THREAD_MONITOR
	select THREAD_RUNTIME_STATS
	select SCHED_THREAD_USAGE
	select SCHED_THREAD_USAGE_AUTO_ENABLE
	select CPU_WORKLOAD_THREAD_PROFILE
	help
	  Estimate runnable backlog work by scanning runnable threads and summing
	  their per-thread CPU burst profiles. This exposes forward-looking runnable
	  work that has not yet completed.

config CPU_WORKLOAD_READY_BACKLOG_MIN_CONFIDENCE
	int "Minimum thread profile confidence for ready backlog"
	default 20
	range 0 100
	depends on CPU_WORKLOAD_READY_BACKLOG
	help
	  Minimum per-thread burst profile confidence required before that profile
	  contributes its average burst cycles to the ready backlog.

config CPU_WORKLOAD_ARRIVAL
	bool "CPU wakeup-arrival workload"
	select THREAD_MONITOR
	select THREAD_RUNTIME_STATS
	select SCHED_THREAD_USAGE
	select SCHED_THREAD_USAGE_ARRIVAL_STATS
	select SCHED_THREAD_USAGE_AUTO_ENABLE
	select CPU_WORKLOAD_THREAD_PROFILE
	help
	  Attribute thread wakeups to arrival sources and estimate the expected
	  cycles from those arrivals using per-thread burst profiles. This provides
	  forward-looking workload for work that arrived since the previous query.

config CPU_WORKLOAD_ESTIMATE
	bool "Unified CPU workload estimate"
	select CPU_WORKLOAD_HISTORY
	select CPU_WORKLOAD_READY_BACKLOG
	select CPU_WORKLOAD_ARRIVAL
	help
	  Combine runtime history, ready backlog, and arrival attribution into a
	  single estimated cycle count. The estimate uses recent runtime history as
	  a conservative floor and adds the forward-looking ready backlog and arrival
	  workloads.

endif # CPU_WORKLOAD
```
