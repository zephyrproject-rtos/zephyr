## subsys/bluetooth/services/ots/Kconfig
```kconfig
# Bluetooth Object Transfer service

# Copyright (c) 2020-2022 Nordic Semiconductor ASA
# SPDX-License-Identifier: Apache-2.0

config BT_OTS
	bool "Object Transfer Service (OTS) [EXPERIMENTAL]"
	select BT_L2CAP_DYNAMIC_CHANNEL
	select BT_GATT_DYNAMIC_DB
	select BT_SMP
	select EXPERIMENTAL
	help
	  Enable Object Transfer Service.

if BT_OTS

config BT_OTS_DIR_LIST_OBJ
	bool "The Directory Listing Object"
	help
	  Enables the Directory Listing Object, which is an object that contains all the metadata
	  from all other objects, for easy exposure to a client. Enabling this will use one of the
	  objects given by BT_OTS_MAX_OBJ_CNT.

config BT_OTS_DIR_LIST_OBJ_NAME
	string "The object name of the Directory Listing Object"
	default "Directory"
	depends on BT_OTS_DIR_LIST_OBJ
	help
	  The name of the Directory Listing Object when it is read by a client.

config BT_OTS_MAX_INST_CNT
	int "Maximum number of available OTS instances"
	default 1
	range 1 1 if !BT_OTS_SECONDARY_SVC

config BT_OTS_SECONDARY_SVC
	bool "Register OTS as Secondary Service"

config BT_OTS_OACP_CREATE_SUPPORT
	bool "Support OACP Create Operation"
	depends on BT_OTS_OACP_WRITE_SUPPORT
	depends on BT_OTS_OBJ_NAME_WRITE_SUPPORT

config BT_OTS_OACP_DELETE_SUPPORT
	bool "Support OACP Delete Operation"

config BT_OTS_OACP_READ_SUPPORT
	bool "Support OACP Read Operation"
	default y

config BT_OTS_OACP_WRITE_SUPPORT
	bool "Support OACP Write Operation"

config BT_OTS_OACP_PATCH_SUPPORT
	bool "Support patching of objects"
	depends on BT_OTS_OACP_WRITE_SUPPORT

config BT_OTS_OLCP_GO_TO_SUPPORT
	bool "Support OLCP Go To Operation"
	default y

config BT_OTS_OBJ_NAME_WRITE_SUPPORT
	bool "Support object name write"

endif # BT_OTS

#### Object Transfer Service Client ################################

config BT_OTS_CLIENT
	bool "Object Transfer Service Client [Experimental]"
	select BT_L2CAP_DYNAMIC_CHANNEL
	select BT_GATT_CLIENT
	select BT_GATT_AUTO_DISCOVER_CCC
	select EXPERIMENTAL
	help
	  This option enables support for the Object Transfer Service Client.

if BT_OTS_CLIENT

# TODO: Unify logging for OTS server and client - the client uses
# "BT" debugging, the server does not.
config BT_DEBUG_OTS_CLIENT
	bool "Object Transfer Service Client debug"
	help
	  Use this option to enable Object Transfer Client debug logs

endif # BT_OTS_CLIENT

if BT_OTS || BT_OTS_CLIENT

config BT_OTS_MAX_OBJ_CNT
	hex "Maximum number of objects that each service instance can store"
	default 0x05
	# Given the maximum size of a directory listing record (172) and the maximum size of an
	# object using the net_buf implementation is 2^16-1, the maximum number of objects is given
	# by 2^16-1 / 172 = 381 == 0x17D)
	range 0x02 0x17D if BT_OTS_DIR_LIST_OBJ
	# Max obj count is otherwise the non-RFU IDs available
	range 0x01 0xFFFFFFFFFFFFFEFF

config BT_OTS_L2CAP_CHAN_TX_MTU
	int "Size of TX MTU for Object Transfer Channel"
	default 256
	range 21 65533

config BT_OTS_L2CAP_CHAN_RX_MTU
	int "Size of RX MTU for Object Transfer Channel"
	# RX MTU will be truncated to account for the L2CAP PDU and SDU header.
	default BT_BUF_ACL_RX_SIZE
	range 21 BT_BUF_ACL_RX_SIZE

config BT_OTS_OBJ_MAX_NAME_LEN
	int "Maximum object name length"
	# Max name length allowed by OTS spec is 120 octets
	# TODO: Set separate max name length for client, as other
	# servers may use the full 120 octets.
	default 120
	range 1 120

module = BT_OTS
module-str = BT_OTS
source "${ZEPHYR_BASE}/subsys/logging/Kconfig.template.log_config"

endif # BT_OTS || BT_OTS_CLIENT
```

## subsys/bluetooth/shell/Kconfig
```kconfig
# Shell configuration options

# Copyright (c) 2017 Intel Corporation
# SPDX-License-Identifier: Apache-2.0

config BT_SHELL
	bool "Bluetooth shell"
	select SHELL
	select BT_TICKER_NEXT_SLOT_GET if BT_LL_SW_SPLIT
	help
	  Activate shell module that provides Bluetooth commands to the
	  console.
```

## subsys/boot_info/Kconfig
```kconfig
# Copyright (c) 2023 Laczen
# SPDX-License-Identifier: Apache-2.0

menuconfig BOOT_INFO
	bool "Boot Information Area"
	help
	  Enable boot information area access with different backend solutions.
	  The boot information area can be stored on bbram, ram, ...

if BOOT_INFO

module = BOOT_INFO
module-str = boot_info
source "subsys/logging/Kconfig.template.log_config"

endif # BOOT_INFO
```

## subsys/can/Kconfig
```kconfig
# Kconfig - CAN configuration options
#
# Copyright (c) 2019 Erwin Rol <erwin@erwinrol.com>
#
# SPDX-License-Identifier: Apache-2.0
#

menuconfig CAN_STACKS
	bool "CAN support"
	help
	  This option enables CAN support.

if CAN_STACKS

module = CAN_STACKS
module-str = can_stacks
source "subsys/logging/Kconfig.template.log_config"

endif # CAN_STACKS

source "subsys/can/canopen/Kconfig"
source "subsys/can/devicenet/Kconfig"
source "subsys/can/j1939/Kconfig"
```

## subsys/can/cancrypt/Kconfig
```kconfig
# Kconfig - CAN stack configuration options

#
# Copyright (c) 2017 Erwin Rol <erwin@erwinrol.com>
#
# SPDX-License-Identifier: Apache-2.0
#

menuconfig CANCRYPT
	bool "CANCrypt"
	depends on CAN
	default n

if CANCRYPT

endif
```

## subsys/can/canopen/Kconfig
```kconfig
# Kconfig - CAN J1939
#
# Copyright (c) 2019 Erwin Rol <erwin@erwinrol.com>
#
# SPDX-License-Identifier: Apache-2.0
#

menuconfig CANOPEN
	bool "CANOpen stack"
	depends on CAN_STACKS
	help
	  Enable support of CANOpen stack.

if CANOPEN

module = CANOPEN
module-str = canopen
source "subsys/logging/Kconfig.template.log_config"

config CANOPEN_DUMMY
	bool "Dummy"
	help
	  Dummy help.

endif # CANOPEN
```

## subsys/can/devicenet/Kconfig
```kconfig
# Kconfig - CAN J1939
#
# Copyright (c) 2019 Erwin Rol <erwin@erwinrol.com>
#
# SPDX-License-Identifier: Apache-2.0
#

menuconfig DEVICENET
	bool "DeviceNet stack"
	depends on CAN_STACKS
	help
	  Enable support of DeviceNet stack.

if DEVICENET

module = DEVICENET
module-str = devicenet
source "subsys/logging/Kconfig.template.log_config"

config DEVICENET_DUMMY
	bool "Dummy"
	help
	  Dummy help.

endif # DEVICENET
```

## subsys/can/j1939/Kconfig
```kconfig
# Kconfig - CAN J1939
#
# Copyright (c) 2019 Erwin Rol <erwin@erwinrol.com>
#
# SPDX-License-Identifier: Apache-2.0
#

menuconfig J1939
	bool "J1939 stack"
	depends on CAN_STACKS
	help
	  Enable support of J1939 stack.

if J1939

module = J1939
module-str = j1939
source "subsys/logging/Kconfig.template.log_config"

config J1939_DUMMY
	bool "Dummy"
	help
	  Dummy help.

endif # J1939
```

## subsys/canbus/Kconfig
```kconfig
# CAN bus subsystem configuration options

# Copyright (c) 2019 Vestas Wind Systems A/S
# Copyright (c) 2026 Deere & Company
# SPDX-License-Identifier: Apache-2.0

menu "Controller Area Network (CAN) bus subsystem"

source "subsys/canbus/isotp/Kconfig"
source "subsys/canbus/j1939/Kconfig"

endmenu
```

## subsys/canbus/Kconfig.canopen
```kconfig
# Copyright (c) 2019 - 2021 Vestas Wind Systems A/S
# SPDX-License-Identifier: Apache-2.0

menuconfig CANOPEN
	bool "CANopen protocol support"
	depends on CAN
	select CANOPENNODE
	help
	  Enable CANopen (EN 50325-4) (CiA 301) protocol
	  support. Support is provided by the 3rd party CANopenNode
	  protocol stack.

if CANOPEN

module = CANOPEN
module-str = CANopen
source "subsys/logging/Kconfig.template.log_config"

endif # CANOPEN
```

## subsys/canbus/isotp/Kconfig
```kconfig
# ISO-TP configuration options

# Copyright (c) 2019 Alexander Wachter
# SPDX-License-Identifier: Apache-2.0

menuconfig ISOTP
	bool "ISO-TP Transport [EXPERIMENTAL]"
	depends on CAN
	select NET_BUF
	select POLL
	select EXPERIMENTAL
	help
	  Enable ISO TP support for CAN

if ISOTP

module = ISOTP
module-str = ISOTP
source "subsys/logging/Kconfig.template.log_config"

config ISOTP_WFTMAX
	int "WFTmax (Max WAIT frames before aborting)."
	default 10
	range 0 254
	help
	  This value defines the maximum number of WAIT frames before the transmission
	  is aborted.

config ISOTP_BS_TIMEOUT
	int "Bs timeout [ms] (timeout for receiving the frame control)"
	default 1000
	range 200 10000
	help
	  Timeout for the reception of the next FC frame. ISO 15765-2: 1000ms

config ISOTP_A_TIMEOUT
	int "Ar and As timeout [ms] (sending and receiving timeout)"
	default 1000
	range 200 10000
	help
	  As (sender transmit timeout) and Ar (receiver transmit timeout).
	  ISO 15765-2: 1000ms

config ISOTP_CR_TIMEOUT
	int "Cr timeout [ms] (timeout for consecutive frames)"
	default 1000
	range 200 10000
	help
	  Cr (receiver consecutive frame) timeout.
	  ISO 15765-2: 1000ms

config ISOTP_REQUIRE_RX_PADDING
	bool "Require padding for received messages"
	help
	  If enabled, SFs, FCs and the last CF must always have a DLC of 8 bytes
	  (for classic CAN) and unused bytes must be padded by the sending
	  device. This setting allows to be compliant to AUTOSAR Specification
	  of CAN Transport Layer.

	  By default, received CAN frames with or without padding are accepted.

config ISOTP_ENABLE_TX_PADDING
	bool "Padding for transmitted messages"
	default y if ISOTP_REQUIRE_RX_PADDING
	help
	  Add padding bytes 0xCC (as recommended by Bosch) if the PDU payload
	  does not fit exactly into the CAN frame.

config ISOTP_RX_BUF_COUNT
	int "Number of data buffers for receiving data"
	default 4
	help
	  Each data buffer will occupy ISOTP_RX_BUF_SIZE + smallish
	  header (sizeof(struct net_buf)) amount of data.

config ISOTP_RX_BUF_SIZE
	int "Size of one buffer data block"
	default 63 if CAN_FD_MODE
	default 56
	help
	  This value defines the size of a single block in the pool. The number of
	  blocks is given by ISOTP_RX_BUF_COUNT. To be efficient use a multiple of
	  CAN_MAX_DLEN - 1 (for classic CAN : 8 - 1 = 7, for CAN-FD : 64 - 1 = 63).

config ISOTP_RX_SF_FF_BUF_COUNT
	int "Number of SF and FF data buffers for receiving data"
	default 4
	help
	  This buffer is used for first and single frames. It is extra because the
	  buffer has to be ready for the first reception in isr context and therefor
	  is allocated when binding.
	  Each buffer will occupy CAN_MAX_DLEN - 1 byte + header (sizeof(struct net_buf))
	  amount of data.

config ISOTP_USE_TX_BUF
	bool "Buffer tx writes"
	help
	  Copy the outgoing data to a net buffer so that the calling function
	  can discard the data.

if ISOTP_USE_TX_BUF

config ISOTP_TX_BUF_COUNT
	int "Number of data buffers for sending data"
	default 4
	help
	  Each data buffer will occupy CONFIG_NET_BUF_DATA_SIZE + smallish
	  header (sizeof(struct net_buf)) amount of data. If context buffers
	  are used, use the same size here.

config ISOTP_BUF_TX_DATA_POOL_SIZE
	int "Size of the memory pool where buffers are allocated from"
	default 256
	help
	  This value defines the size of the memory pool where the buffers
	  for sending are allocated from.

endif # ISOTP_USE_TX_BUF

config ISOTP_ENABLE_CONTEXT_BUFFERS
	bool "Buffered tx contexts"
	default y
	help
	  This option enables buffered sending contexts. This makes send and
	  forget possible. A memory slab is used to buffer the context.

config ISOTP_TX_CONTEXT_BUF_COUNT
	int "Amount of context buffers for sending data"
	default 4
	depends on ISOTP_ENABLE_CONTEXT_BUFFERS
	help
	  This defines the size of the memory slab where the buffers are
	  allocated from.

config ISOTP_CUSTOM_FIXED_ADDR
	bool "Use fixed address not compatible with SAE J1939"
	default n
	help
	  This option allow to use an alternative CAN frame id format.
	  If not set ISO-TP fixed addressing use SAE J1939 standard.

menu "Fixed address definition"
	visible if ISOTP_CUSTOM_FIXED_ADDR

config ISOTP_FIXED_ADDR_SA_POS
	int "Position of fixed source address (SA)"
	default 0
	help
	  Source address position in bits.

config ISOTP_FIXED_ADDR_SA_MASK
	hex "Mask to obtain fixed source address (SA)"
	default 0xFF
	help
	  Source address mask.

config ISOTP_FIXED_ADDR_TA_POS
	int "Position of fixed target address (TA)"
	default 8
	help
	  Target address position in bits.

config ISOTP_FIXED_ADDR_TA_MASK
	hex "Mask to obtain fixed target address (TA)"
	default 0xFF00
	help
	  Target address mask.

config ISOTP_FIXED_ADDR_PRIO_POS
	int "Position of priority in fixed addressing mode"
	default 26
	help
	  Priority address position in bits.

config ISOTP_FIXED_ADDR_PRIO_MASK
	hex "Mask for priority in fixed addressing mode"
	default 0x1C000000
	help
	  Priority address mask.

config ISOTP_FIXED_ADDR_RX_MASK
	hex "CAN filter RX mask to match any priority and source address (SA)"
	default 0x03FFFF00
	help
	  CAN filter RX mask

endmenu

endif # ISOTP
```
