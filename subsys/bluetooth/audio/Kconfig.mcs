## subsys/bluetooth/controller/Kconfig.direction_finding
```kconfig
# Zephyr Bluetooth Controller configuration options

# Copyright (c) 2020 Nordic Semiconductor ASA
# SPDX-License-Identifier: Apache-2.0


menuconfig BT_CTRL_DIRECTION_FINDING
	bool "LE Direction Finding Support [Experimental]"
	help
	  Enable support for Bluetooth 5.1 Direction Finding

if BT_CTRL_DIRECTION_FINDING

config BT_CTLR_DF_CTE_TX_SUPPORT
	bool

config BT_CTLR_DF_CTE_RX_2US_SUPPORT
	bool

config BT_CTLR_DF_CTE_RX_1US_SUPPORT
	bool

config BT_CTLR_DF_ANT_SWITCHING_2US_SUPPORT
	bool

config BT_CTLR_DF_ANT_SWITCHING_1US_SUPPORT
	bool

# Basic controller functionalities required for implementation of
# Bluetooth v5.1 Direction Finding

config BT_CTLR_DF_CTE_TX
	bool "Enable transmission of Constant Tone Extension"
	depends on BT_CTLR_DF_CTE_TX_SUPPORT
	default y
	help
	  Enable support for transmission of Constant Tone Extension in
	  controller.

menu "BT Direction Finding CTE sampling slots"

config BT_CTLR_DF_CTE_RX_2US
	bool "Enable reception of CTE with 2us sampling slots"
	depends on BT_CTLR_DF_CTE_RX_2US_SUPPORT
	default y
	help
	  Enable reception of Constant Tone Extension. Process IQ sampling
	  during CTE reception with 2us sampling slots.
	  This sampling type is mandatory for Direction Finding according to
	  Bluetooth v5.1.

config BT_CTLR_DF_CTE_RX_1US
	bool "Enable reception of CTE with 1us sampling slots"
	depends on BT_CTLR_DF_CTE_RX_1US_SUPPORT
	default y
	help
	  Enable reception of Constant Tone Extension. Process IQ sampling
	  during CTE reception with 1us sampling slots.
	  This sampling type is optional for Direction Finding according to
	  Bluetooth v5.1.

endmenu

menu "BT Direction Finding CTE antenna switching slots"

config BT_CTLR_DF_ANT_SWITCHING_2US
	bool "Enable support for 2us antenna switching slots"
	depends on BT_CTLR_DF_ANT_SWITCHING_2US_SUPPORT
	default y
	help
	  Enable support for 2us antenna switching slots. This antenna switching
	  mode is mandatory for Direction Finding according to Bluetooth v5.1.

config BT_CTLR_DF_ANT_SWITCHING_1US
	bool "Enable support for 1us antenna switching slots"
	depends on BT_CTLR_DF_ANT_SWITCHING_1US_SUPPORT
	default y
	help
	  Enable support for 1us antenna switching slots. This antenna switching
	  mode is optional for Direction Finding according to Bluetooth v5.1.

endmenu
# Features related with Direction Finding
# BT Core spec 5.1, Vol 6, Part B, sec. 4.6 Feature Support

config BT_CTLR_DF_ANT_SWITCHING_TX
	bool "Enable antenna switching during CTE transmission (AoD) feature"
	depends on BT_CTLR_DF_CTE_TX && BT_CTLR_DF_ANT_SWITCHING_2US
	default y
	help
	  Enable support for antenna switching during CTE transmission.
	  It is Angle of Departure mode.

config BT_CTLR_DF_ANT_SWITCHING_RX
	bool "Enable antenna switching during CTE reception (AoA) feature"
	depends on BT_CTLR_DF_ANT_SWITCHING_RX_SUPPORT
	depends on BT_CTLR_DF_ANT_SWITCHING_2US
	default y
	help
	  Enable support for antenna switching during CTE reception.
	  It is Angle of Arrival mode.

config BT_CTLR_DF_CTE_RX
	bool "Enable receive of Constant Tone Extension feature"
	depends on BT_CTLR_DF_CTE_RX_2US
	default y
	help
	  Enable support for reception of Constant Tone Extension in controller.

config BT_CTLR_DF_CONN_CTE_REQ
	bool "Enable Connection CTE Request feature"
	depends on BT_CTLR_DF_CTE_RX || BT_CONN
	help
	  Enable support for Bluetooth v5.1 Connection CTE Request feature
	  in controller.

config BT_CTLR_DF_CONN_CTE_RSP
	bool "Enable Connection CTE Response feature"
	depends on BT_CTLR_DF_CTE_TX || BT_CONN
	default y
	help
	  Enable support for Bluetooth v5.1 Connection CTE Response feature
	  in controller.

config BT_CTLR_DF_BROADCAST_CTE_TX
	bool "Enable Connectionless CTE Transmitter feature"
	depends on BT_CTLR_DF_CTE_TX && BT_CTLR_ADV_PERIODIC
	default y
	help
	  Enable support for Bluetooth v5.1 Connectionless CTE Response feature
	  in controller.

config BT_CTLR_DF_BROADCAST_CTE_RX
	bool "Enable Connectionless CTE Receiver feature"
	depends on BT_CTLR_DF_CTE_RX && BT_CTLR_ADV_PERIODIC
	default y
	# depends on periodic advertising
	help
	  Enable support for Bluetooth v5.1 Connectionless CTE Request feature
	  in controller.

endif # BT_CTRL_DIRECTION_FINDING
```

## subsys/bluetooth/controller/Kconfig.dtm
```kconfig
# Zephyr Bluetooth Controller configuration options

# Copyright (c) 2022 Nordic Semiconductor ASA
# SPDX-License-Identifier: Apache-2.0

config BT_CTLR_DTM_HCI_SUPPORT
	bool

config BT_CTLR_DTM
	bool
	help
	  Enable support for Direct Test Mode in the Controller.

menuconfig BT_CTLR_DTM_HCI
	bool "Direct Test Mode over HCI"
	depends on BT_CTLR_DTM_HCI_SUPPORT
	select BT_CTLR_DTM
	help
	  Enable support for Direct Test Mode over the HCI transport.

if BT_CTLR_DTM_HCI

config BT_CTLR_DTM_HCI_RX_V3
	bool "HCI LE Receiver Test v3"
	default y
	help
	  Enable support for the DTM Receiver test command v3.

config BT_CTLR_DTM_HCI_TX_V3
	bool "HCI LE Transmitter Test v3"
	default y
	help
	  Enable support for the DTM Transmitter test command v3.

config BT_CTLR_DTM_HCI_TX_V4
	bool "HCI LE Transmitter Test v4"
	default y
	help
	  Enable support for the DTM Transmitter test command v4.

menuconfig BT_CTLR_DTM_HCI_DF_IQ_REPORT
	bool "Connectionless IQ report HCI event [EXPERIMENTAL]"
	depends on BT_CTLR_DF_CTE_RX && BT_CTLR_DTM_HCI_RX_V3
	select EXPERIMENTAL
	help
	  Enable generation of the HCI LE Connectionless IQ Report event
	  after the Constant Tone Extension reception.

if BT_CTLR_DTM_HCI_DF_IQ_REPORT

	config BT_CTLR_DTM_HCI_DF_IQ_REPORT_NUM_MAX
	int "IQ Report pool size"
	default 32
	help
	  Maximum number of the DTM IQ Reports in pool. It depends on the upper tester
	  test packets transmission interval.


endif # BT_CTLR_DTM_HCI_DF_IQ_REPORT

endif # BT_CTLR_DTM_HCI
```

## subsys/bluetooth/controller/coex/Kconfig
```kconfig
# Bluetooth co-existence configuration options

# Copyright (c) 2022 Dronetag
# SPDX-License-Identifier: Apache-2.0

menuconfig BT_CTLR_COEX_DRIVERS
	bool "Bluetooth Co-existence Drivers"
	default n
	depends on BT_CTLR

if BT_CTLR_COEX_DRIVERS

config BT_CTLR_COEX_TICKER
	bool "Coexistence Ticker"
	help
	  When enabled Coexistence device implementation is included in
	  the controller. Which abort any radio states, when coex pin is asserted.

endif # BT_CTLR_COEX_DRIVERS
```

## subsys/bluetooth/controller/hci/kw41z/Kconfig
```kconfig
# Kconfig - Bluetooth Controller configuration options
#
# Copyright (c) 2018 Linaro Limited
# Copyright (c) 2018 NXP Corporation
#
# SPDX-License-Identifier: Apache-2.0
#

comment "KW41Z BLE Controller support"


if BT_LL_KW41Z

# KW41Z Link Layer Controller settings

config KW41_NUM_TIMERS
	int "Number of framework timers"
	default 1
	help
	  Select the number of timer service timers.

config KW41_CTRL_PRIO
	int "Link layer controller priority"
	default 1
	help
	  Select the priority level the controller task shall run at.
	  Should be set higher than host layer protocol stacks.

config KW41_CTRL_STACK_SIZE
	# Hidden option for Controller's Co-Operative high priority thread
	# stack size.
	int "KW41 Controller stack size"
	default 1400

config KW41_COEX_RF_DENY_ACTIVE_STATE
	# Need to consider using a config for gMWS_UseCoexistence_d
	# but for now this is is the pin polarity.
	int
	default 1
	help
	  Coexistence RF Deny pin polarity:
	    1 - for active on logic one;
	    0 - active on logic zero

config KW41_ADVERTISING_DEFAULT_TX_POWER
	int "Advertising default TX power"
	default 20
	help
	  Default Tx Power on the advertising channel.
	  For MKW41Z BLE controller there are 32 possible power
	  levels 0 <= N <= 31 for which the output power is distributed
	  evenly between minimum and maximum power levels.
	  For further details see the silicon datasheet.

config KW41_CONNECTION_DEFAULT_TX_POWER
	int "Connection default TX power"
	default 20
	help
	  Default Tx Power on the connection channel.
	  For MKW41Z BLE controller there are 32 possible power
	  levels 0 <= N <= 31 for which the output power is distributed
	  evenly between minimum and maximum power levels.
	  For further details see the silicon datasheet.

config KW41_MCU_SLEEP_DURING_BLE_EVENTS
	bool "Enable/disable MCU Sleep"
	default y
	help
	   Enable/Disable MCU Sleep During BLE Events

config KW41_ADVERTISING_PACKET_INTERVAL
	int "Advertising packet interval"
	default 8
	help
	  Time between the beginning of two consecutive advertising PDU's
	  Time = ADVERTISING_PACKET_INTERVAL * 0.625msec
	  Time range <= 10msec

config KW41_SCAN_CHANNEL_MAP
	hex "Channel SCAN MAP"
	default 0x07
	help
	  Advertising channels that are enabled for scanning operation.
	  Range 0x01 - 0x07
	  0x01 - Enables channel 37 for use.
	  0x02 - Enables channel 38 for use.
	  0x04 - Enables channel 39 for use.

config KW41_INITIATOR_CHANNEL_MAP
	hex "Initiator channel map"
	default 0x07
	help
	  Advertising channels that are enabled for initiator scanning operation.
	  Range 0x01 - 0x07
	  0x01 - Enables channel 37 for use.
	  0x02 - Enables channel 38 for use.
	  0x04 - Enables channel 39 for use.

config KW41_OFFSET_TO_FIRST_INSTANT
	hex "Offset to first instant register"
	default 0xFFFF
	help
	  Offset to the first instant register. Units in 625uS time slots.

	  Ex. If current clock value is 0x0004 and offset is 0x0008, then
	  the first event will begin when clock value becomes 0x000C.

	  A value of 0xFFFF will be ignored and default value (0x0006)
	  will be set.

config KW41_XTAL_TRIM
	hex "XTAL trim value"
	default 0xFF
	help
	  Measured trim value for tuning XTAL.

config KW41_MEM_USAGE_STATS
	bool "Enable KW41 Framework memory usage statistics"
	help
	  Turn on KW41 Framework memory usage statistics.

config KW41_POOL_32_CNT
	int "Framework 32 byte buffer count"
	default 6
	help
	  Count of 32 byte buffer blocks available to the KW41 BLE Link Layer
	  controller.

	  If an allocation error is indicated then increase this number.

config KW41_POOL_64_CNT
	int "Framework 64 byte buffer count"
	default 64
	help
	  Count of 64 byte buffer blocks available to the KW41 BLE Link Layer
	  controller.

	  If an allocation error is indicated then increase this number.

config KW41_POOL_128_CNT
	int "Framework 128 byte buffer count"
	default 4
	help
	  Count of 128 byte buffer blocks available to the KW41 BLE Link Layer
	  controller.

	  If an allocation error is indicated then increase this number.

config KW41_POOL_256_CNT
	int "Framework 256 byte buffer count"
	default 2
	help
	  Count of 256 byte buffer blocks available to the KW41 BLE Link Layer
	  controller.

	  If an allocation error is indicated then increase this number.

config KW41_POOL_512_CNT
	int "Framework 512 byte buffer count"
	default 0
	help
	  Count of 512 byte buffer blocks available to the KW41 BLE Link Layer
	  controller.

	  If an allocation error is indicated then increase this number.

config KW41_POOL_1024_CNT
	int "Framework 1024 byte buffer count"
	default 0
	help
	  Count of 1024 byte buffer blocks available to the KW41 BLE Link Layer
	  controller.

	  If an allocation error is indicated then increase this number.

endif # BT_LL_KW41Z
```

## subsys/bluetooth/crypto/Kconfig
```kconfig
# Copyright (c) 2022 Nordic Semiconductor ASA
# SPDX-License-Identifier: Apache-2.0

config BT_CRYPTO
	bool
	select PSA_CRYPTO
	select PSA_WANT_KEY_TYPE_AES
	select PSA_WANT_ALG_CMAC
	select PSA_WANT_ALG_ECB_NO_PADDING
	imply MBEDTLS_AES_ROM_TABLES if MBEDTLS_PSA_CRYPTO_C
	help
	  This option enables the Bluetooth Cryptographic Toolbox.
```

## subsys/bluetooth/crypto_toolbox/Kconfig
```kconfig
config BT_CRYPTO_TOOLBOX
    bool "Cryptographic Toolbox"
    select TINYCRYPT
    select TINYCRYPT_AES
    select TINYCRYPT_AES_CMAC
    help
      This option enable the Bluetooth Cryptographic Toolbox.
      
config BT_DEBUG_CRYPTO_TOOLBOX
	bool "Bluetooth Cryptographic Toolbox debug"
	depends on BT_CRYPTO_TOOLBOX
	help
	  This option enables debug support for the Bluetooth
	  Cryptographic Toolbox.

	  WARNING: This option prints out private security keys such as
	  the Long Term Key.
	  Use of this feature in production is strongly discouraged.
```
