## subsys/bluetooth/audio/Kconfig.mcs
```kconfig
# Bluetooth Audio - Media control configuration options

#
# Copyright (c) 2020-2022 Nordic Semiconductor
#
# SPDX-License-Identifier: Apache-2.0
#

#### Media Control Service ################################

config BT_MCS
	bool "Media Control Service Support"
	depends on MCTL_LOCAL_PLAYER_REMOTE_CONTROL
	depends on UTF8
	select BT_CCID
	select EXPERIMENTAL
	help
	  This option enables support for the Media Control Service.

if BT_MCS

config BT_DEBUG_MCS
	bool "Media Control Service debug"
	select DEPRECATED
	help
	  Use this option to enable Media Control Service debug logs for the
	  Bluetooth Audio functionality.

module = BT_MCS
legacy-debug-sym = BT_DEBUG_MCS
module-str = "Media Control Service"
source "subsys/bluetooth/common/Kconfig.template.log_config_bt"

endif # BT_MCS

#### Media Control Client ################################

config BT_MCC
	bool "Media Control Client Support"
	select BT_GATT_CLIENT
	select BT_GATT_AUTO_DISCOVER_CCC
	select EXPERIMENTAL
	help
	  This option enables support for the Media Control Client.

if BT_MCC

config BT_MCC_MEDIA_PLAYER_NAME_MAX
	int "Max length of media player name"
	default 20
	range 1 255
	help
	  Sets the maximum number of bytes (including the null termination) of
	  the name of the media player. If the name is longer, the media
	  control client will truncate the name when reading it.

config BT_MCC_ICON_URL_MAX
	int "Max length of media player icon URL"
	default 40
	range 1 255
	help
	  Sets the maximum number of bytes (including the null termination) of
	  the media player icon URL. If the URL is longer, the media control
	  client will truncate the name when reading it.

config BT_MCC_TRACK_TITLE_MAX
	int "Max length of the title of a track"
	default 40
	range 1 255
	help
	  Sets the maximum number of bytes (including the null termination) of
	  the title of any track in the media player. If the title is longer,
	  the media control client will truncate the title when reading it.

config BT_MCC_SEGMENT_NAME_MAX
	int "Max length of the name of a track segment"
	default 25
	range 1 255
	help
	  Sets the the maximum number of bytes (including the null termination)
	  of the name of any track segment in the media player. If the name is
	  longer, the media control client will truncate the name when reading
	  it.

config BT_MCC_OTS
	bool "Media Control Client support for Object Transfer Service"
	depends on BT_OTS_CLIENT
	help
	  Use this option to configure support in the Media Control Client for
	  an included Object Transfer Service in the Media Control Service.

if BT_MCC_OTS

config BT_MCC_OTC_OBJ_BUF_SIZE
	int "The size of the buffer used for OTC object in MCC"
	default 512
	range 1 65536
	help
	  Sets the size (in octets) of the buffer used for receiving the content
	  of objects.
	  Should be set large enough to fit any expected object.

config BT_MCC_TOTAL_OBJ_CONTENT_MEM
	int "Total memory size to use for storing the content of objects"
	default 1
	range 0 65536
	help
	  Sets the total memory size (in octets) to use for storing the content
	  of objects.
	  This is used for the total memory pool buffer size from which memory
	  is allocated when reading object content.

config BT_MCC_TRACK_SEGS_MAX_CNT
	int "Maximum number of tracks segments in a track segment object"
	default 25
	range 0 500
	help
	  Sets the maximum number of tracks segments in a track segment object.
	  If the received object is bigger, the remaining data in the object
	  will be ignored.

config BT_MCC_GROUP_RECORDS_MAX
	int "Maximum number of records in a group object"
	default 25
	range 0 500
	help
	  Sets the maximum number of records in a group object. If the received
	  group object has more records than this, the remaining records in the
	  object will be ignored.

endif # BT_MCC_OTS

config BT_MCC_SHELL
	bool "Media Control Client Shell Support"
	default y if BT_SHELL
	help
	  This option enables shell support for the Media Control Client.

#### MCC Debug logs ####

config BT_DEBUG_MCC
	bool "Media Control Client debug"
	select DEPRECATED
	help
	  Use this option to enable Media Control Client debug logs for the
	  Bluetooth Audio functionality.

module = BT_MCC
legacy-debug-sym = BT_DEBUG_MCC
module-str = "Media Control Client"
source "subsys/bluetooth/common/Kconfig.template.log_config_bt"

endif # BT_MCC
```

## subsys/bluetooth/audio/Kconfig.mctl
```kconfig
# Bluetooth Audio - Media control configuration options

#
# Copyright (c) 2022 Nordic Semiconductor
#
# SPDX-License-Identifier: Apache-2.0
#

# TODO: Decide, and add, top-level namespace prefix (currently none) to symbols.
# Dependent upon where the module will be placed.

config MCTL
	bool "Support for media player control"
	select EXPERIMENTAL
	help
	  Enables support for control of local and remote media players
	  To enable support for control of a local media player, support for
	  local media player must be enabled

if MCTL

config MCTL_LOCAL_PLAYER_CONTROL
	bool "Support for control of local media player"
	help
	  This option enables support for control of a local media player

config MCTL_LOCAL_PLAYER_LOCAL_CONTROL
	bool "Support for local control of local media player"
	default y
	depends on MCTL_LOCAL_PLAYER_CONTROL
	help
	  This option enables support for local application control of local
	   media players

config MCTL_LOCAL_PLAYER_REMOTE_CONTROL
	bool "Support for remote control of local media players"
	depends on MCTL_LOCAL_PLAYER_CONTROL
	help
	  This option enables support for remote control of local media
	   players.

config MCTL_REMOTE_PLAYER_CONTROL
	bool "Support for control of remote media player"
	default y
	# TODO: Remove dependency on BT_MCC once MCC has been reworked
	depends on BT_MCC
	help
	  This options enables support for control of a remote media player.

config MCTL_REMOTE_PLAYER_CONTROL_OBJECTS
	bool "Support for accessing objects on remote player"
	depends on MCTL_REMOTE_PLAYER_CONTROL
	default y
	# TODO: Remove dependency on BT_MCC_OTS once MCC has been reworked
	depends on BT_MCC_OTS
	help
	  This options enables support for accessing objects (tracks, groups,
	  search results, ...) on a remote media player

config MCTL_DEBUG
	bool "Media control debug"
	help
	  Use this option to enable Media control debug logs

endif # MCTL
```

## subsys/bluetooth/audio/Kconfig.mediacontrol
```kconfig
# Bluetooth Audio - Media control configuration options

#
# Copyright (c) 2022 Nordic Semiconductor
#
# SPDX-License-Identifier: Apache-2.0
#

if BT_AUDIO

config BT_MEDIACONTROL
	bool "Support for media player control"
	help
	  Enables support for control of local and remote media players
	  To enable support for control of a local media player, support for
	  local media player must be enabled
	  # TODO: Reference config for local media player

if BT_MEDIACONTROL

config BT_MEDIACONTROL_LOCAL_PLAYER_CONTROL
	bool "Support for control of local media player"
	# TODO: Move MPL out of BT susbystem
	depends on BT_MPL
	help
	  This option enables support for control of a local media player

config BT_MEDIACONTROL_LOCAL_PLAYER_LOCAL_CONTROL
	bool "Support for local control of local media player"
	depends on BT_MEDIACONTROL_LOCAL_PLAYER_CONTROL
	help
	  This option enables support for local application control of local
	   media players

config BT_MEDIACONTROL_LOCAL_PLAYER_REMOTE_CONTROL
	bool "Support for remote control of local media player"
	depends on BT_MEDIACONTROL_LOCAL_PLAYER_CONTROL
	select BT_MCS
	help
	  This option enables support for remote control of local media
	   players, using GATT and the Media Control Service

config BT_MEDIACONTROL_REMOTE_PLAYER_CONTROL
	bool "Support for control of remote media player"
	default y
	select BT_MCC
	help
	  This options enables support for control of a remote media player,
	  using GATT and the Media Control Client

endif # BT_MEDIACONTROL

endif # BT_AUDIO
```

## subsys/bluetooth/audio/Kconfig.micp
```kconfig
# Bluetooth Audio - Microphone Input Control Service options
#
# Copyright (c) 2020 Bose Corporation
# Copyright (c) 2020-2022 Nordic Semiconductor ASA
#
# SPDX-License-Identifier: Apache-2.0
#

########### Microphone Input Control Profile Microphone Device ###########

config BT_MICP_MIC_DEV
	bool "Microphone Input Control Profile Microphone Device Support [EXPERIMENTAL]"
	select EXPERIMENTAL
	help
	  This option enables support for Microphone Input Control Profile
	  Microphone Device.

if BT_MICP_MIC_DEV

config BT_MICP_MIC_DEV_AICS_INSTANCE_COUNT
	int "Audio Input Control Service instance count for \
	     Microphone Input Control Service Microphone Device"
	default 0
	range 0 BT_AICS_MAX_INSTANCE_COUNT
	help
	  This option sets the number of instances of Audio Input Control
	  Services for Microphone Input Control Profile Microphone Device.

config BT_MICP_MIC_DEV_AICS
	bool # Hidden
	default y if BT_MICP_MIC_DEV_AICS_INSTANCE_COUNT > 0
	help
	  This hidden option makes it possible to easily check if AICS is
	  enabled for Microphone Input Control Profile Microphone Device.

############# DEBUG #############

config BT_DEBUG_MICP_MIC_DEV
	bool "Microphone Input Control Profile Microphone Device debug"
	select DEPRECATED
	help
	  Use this option to enable Microphone Input Control Profile
	  Microphone Device debug logs for the Bluetooth Audio functionality.

module = BT_MICP_MIC_DEV
legacy-debug-sym = BT_DEBUG_MICP_MIC_DEV
module-str = "Microphone Input Control Profile Microphone Device"
source "subsys/bluetooth/common/Kconfig.template.log_config_bt"

endif # BT_MICP_MIC_DEV

########### Microphone Input Control Profile Microphone Controller ###########

config BT_MICP_MIC_CTLR
	bool "Microphone Input Control Profile Microphone Controller Support [EXPERIMENTAL]"
	select BT_GATT_CLIENT
	select BT_GATT_AUTO_DISCOVER_CCC
	select EXPERIMENTAL
	help
	  This option enables support for the Microphone Input Control Profile
	  Microphone Controller role

if BT_MICP_MIC_CTLR

config BT_MICP_MIC_CTLR_MAX_AICS_INST
	int "Maximum number of Audio Input Control Service instances to setup"
	default 0
	range 0 BT_AICS_CLIENT_MAX_INSTANCE_COUNT
	help
	  Sets the maximum number of Audio Input Control Service (AICS)
	  instances to setup and use.

config BT_MICP_MIC_CTLR_AICS
	bool # Hidden
	default y if BT_MICP_MIC_CTLR_MAX_AICS_INST > 0
	help
	  This hidden option makes it possible to easily check if AICS is
	  enabled for MICP client.

############# DEBUG #############

config BT_DEBUG_MICP_MIC_CTLR
	bool "Microphone Input Control Profile Microphone Controller debug"
	select DEPRECATED
	help
	  Use this option to enable Microphone Input Control Profile Microphone
	  Controller debug logs for the Bluetooth Audio functionality.

module = BT_MICP_MIC_CTLR
legacy-debug-sym = BT_DEBUG_MICP_MIC_CTLR
module-str = "Microphone Input Control Profile Microphone Controller"
source "subsys/bluetooth/common/Kconfig.template.log_config_bt"

endif # BT_MICP_MIC_CTLR
```

## subsys/bluetooth/audio/Kconfig.mics
```kconfig
# Bluetooth Audio - Microphone Input Control Service options
#
# Copyright (c) 2020 Bose Corporation
# Copyright (c) 2020-2021 Nordic Semiconductor ASA
#
# SPDX-License-Identifier: Apache-2.0
#

##################### Microphone Input Control Service #####################

config BT_MICS
	bool "Microphone Input Control Service Support [EXPERIMENTAL]"
	select EXPERIMENTAL
	help
	  This option enables support for Microphone Input Control Service.

if BT_MICS

config BT_MICS_AICS_INSTANCE_COUNT
	int "Audio Input Control Service instance count for Microphone Input Control Service"
	default 0
	range 0 BT_AICS_MAX_INSTANCE_COUNT
	help
	  This option sets the number of instances of Audio Input Control
	  Services for MICS.

config BT_MICS_AICS
	bool # Hidden
	default y if BT_MICS_AICS_INSTANCE_COUNT > 0
	help
	  This hidden option makes it possible to easily check if AICS is
	  enabled for MICS.

############# DEBUG #############

config BT_DEBUG_MICS
	bool "Microphone Input Control Service debug"
	help
	  Use this option to enable Microphone Input Control Service debug logs
	  for the Bluetooth Audio functionality.

endif # BT_MICS

##################### Microphone Control Profile Client #####################

config BT_MICS_CLIENT
	bool "Microphone Control Profile Support [EXPERIMENTAL]"
	select BT_GATT_CLIENT
	select BT_GATT_AUTO_DISCOVER_CCC
	select EXPERIMENTAL
	help
	  This option enables support for Microphone Control Profile.

if BT_MICS_CLIENT

config BT_MICS_CLIENT_MAX_AICS_INST
	int "Maximum number of Audio Input Control Service instances to setup"
	default 0
	range 0 3
	help
	  Sets the maximum number of Audio Input Control Service (AICS)
	  instances to setup and use.

config BT_MICS_CLIENT_AICS
	bool # Hidden
	default y if BT_MICS_CLIENT_MAX_AICS_INST > 0
	help
	  This hidden option makes it possible to easily check if AICS is
	  enabled for MICS client.

############# DEBUG #############

config BT_DEBUG_MICS_CLIENT
	bool "Microphone Control Profile debug"
	help
	  Use this option to enable Microphone Control Profile debug logs for
	  the Bluetooth Audio functionality.

endif # BT_MICS_CLIENT
```

## subsys/bluetooth/audio/Kconfig.otc
```kconfig
# Bluetooth Audio - Object transfer configuration options

#
# Copyright (c) 2020 Nordic Semiconductor
#
# SPDX-License-Identifier: Apache-2.0
#

if BT_AUDIO

#### Object Transfer Service Client ################################

config BT_OTC
	bool "Object Transfer Service Client Support"
	select BT_L2CAP_DYNAMIC_CHANNEL
	select BT_GATT_CLIENT
	select BT_GATT_AUTO_DISCOVER_CCC
	default n
	help
	  This option enables support for the Object Transfer Service Client.

if BT_OTC

config BT_DEBUG_OTC
	bool "Object Transfer Client debug"
# TODO: Remove dependency on BT_AUDIO_DEBUG when moved out of the audio directory
	depends on BT_AUDIO_DEBUG
	depends on BT_OTC
	help
	  Use this option to enable Object Transfer Client debug logs for the
	  Bluetooth Audio functionality.

endif # BTC

endif # BT_AUDIO
```
