## subsys/net/lib/tls_credentials/Kconfig.shell
```kconfig
# Copyright (c) 2023 Nordic Semiconductor ASA
# SPDX-License-Identifier: Apache-2.0

menuconfig TLS_CREDENTIALS_SHELL
	bool "TLS credentials management shell"
	depends on TLS_CREDENTIALS
	depends on SHELL
	depends on BASE64
	help
	  Enable shell commands to manage TLS credentials.

if TLS_CREDENTIALS_SHELL

config TLS_CREDENTIALS_SHELL_CRED_BUF_SIZE
	int "Size of buffer used for storing and retrieving credentials, measured in bytes."
	default 1024
	help
	  The amount of preallocated buffer (in bytes) used for storing and retrieving credentials.

config TLS_CREDENTIALS_SHELL_CRED_OUTPUT_WIDTH
	int "Credential output line width (characters)"
	default 32
	help
	   This setting specifies how long (in characters) contiguous lines of base64 credential
	   output should be. Must be a multiple of 4. Applies only to ??? mode.

config TLS_CREDENTIALS_SHELL_DIGEST_BUF_SIZE
	int "Buffer for generating credentials digests"
	default 48
	help
	   The amount of preallocated buffer (in bytes) for temporarily storing credential digests.

	   Also used to print error messages if digest generation fails.

config TLS_CREDENTIALS_SHELL_KEYGEN
	bool "Shell commands for on-device key and CSR generation"
	depends on TLS_CREDENTIALS_KEYGEN
	default y
	help
	  Add the keygen, keydel, csr and pubkey commands to the 'cred' shell command. The private
	  key never leaves the device. The CSR and the public key are printed Base64 encoded.

config TLS_CREDENTIALS_SHELL_KEYGEN_CSR_BUF_SIZE
	int "Buffer for the CSR, in bytes"
	depends on TLS_CREDENTIALS_SHELL_KEYGEN
	default 512
	help
	  Size of the buffer for the DER CSR. The default fits a subject of about 40 characters
	  in the worst case, and much longer subjects with few attributes. See
	  TLS_CREDENTIAL_KEYGEN_CSR_SIZE() for a size that always fits.

if TLS_CREDENTIALS_BACKEND_VOLATILE

config HEAP_MEM_POOL_ADD_SIZE_TLS_CRED_SHELL
	int "TLS credentials shell memory pool size"
	# default 4 certs and each assume 1500 bytes
	default 6000
	help
	  The size of the memory pool used by the TLS credentials shell.
endif # TLS_CREDENTIALS_BACKEND_VOLATILE

endif # TLS_CREDENTIALS_SHELL
```

## subsys/nfc/Kconfig
```kconfig
# Copyright (c) 2026 RAKwireless Technology Limited
# SPDX-License-Identifier: Apache-2.0

menuconfig NFC
	bool "Near Field Communication (NFC) subsystem [EXPERIMENTAL]"
	select EXPERIMENTAL
	help
	  Vendor- and technology-neutral NFC protocol subsystem above the NFC
	  driver API. Poller (reader) side first.

if NFC

module = NFC
module-str = NFC
source "subsys/logging/Kconfig.template.log_config"

# Shared ISO/IEC 14443 Type A framing (CRC/BCC/PCB). Not user-selectable; it is
# pulled in by whichever layer above needs it (NFC-A activation, ISO-DEP).
config NFC_ISO14443A
	bool
	select CRC
	help
	  ISO/IEC 14443 Type A framing primitives shared by NFC-A activation and
	  ISO-DEP block transmission.

config NFC_NFCA
	bool "NFC-A discovery and activation"
	default y
	select NFC_ISO14443A
	help
	  NFC-A discovery and anticollision on top of the driver API.

config NFC_NFCA_FIELD_OFF_MS
	int "Time the RF field is removed at the start of an NFC-A poll cycle"
	depends on NFC_NFCA
	default 5
	range 1 100
	help
	  How long discovery removes the field so that a target still on the
	  antenna powers down and answers the next cycle. Too short and a halted
	  target keeps ignoring discovery.

config NFC_NFCA_POLL_INTERVAL_MS
	int "Time the RF field is left on between NFC-A poll cycles"
	depends on NFC_NFCA
	default 50
	range 1 1000
	help
	  How long discovery powers a target before the next poll on a
	  host-driven frontend. A secure element takes far longer than the
	  ISO/IEC 14443 guard time to start up, so raising this helps if such a
	  card is never found. Ignored on a controller that polls in firmware.

config NFC_ISO_DEP
	bool "ISO-DEP (ISO/IEC 14443-4)"
	default y if NFC_NFCA
	select NFC_ISO14443A
	help
	  ISO-DEP block-transmission protocol above NFC-A/B activation.

if NFC_ISO_DEP

config NFC_ISO_DEP_DEFAULT_CID
	hex "Default CID used during RATS"
	default 0x00
	help
	  Card identifier requested when activating a target, 0x00 to 0x0E.
	  Leave at 0x00 unless several targets must stay activated at once.

choice NFC_ISO14443_FSD
	prompt "Maximum frame size in poll mode (FSD)"
	default NFC_ISO14443_FSD_24

config NFC_ISO14443_FSD_16
	bool "16"

config NFC_ISO14443_FSD_24
	bool "24"

config NFC_ISO14443_FSD_32
	bool "32"

config NFC_ISO14443_FSD_64
	bool "64"

config NFC_ISO14443_FSD_128
	bool "128"

config NFC_ISO14443_FSD_256
	bool "256"

endchoice

config NFC_ISO14443_FSD_MAX
	int
	default 16 if NFC_ISO14443_FSD_16
	default 24 if NFC_ISO14443_FSD_24
	default 32 if NFC_ISO14443_FSD_32
	default 64 if NFC_ISO14443_FSD_64
	default 128 if NFC_ISO14443_FSD_128
	default 256 if NFC_ISO14443_FSD_256

config NFC_ISO14443_FSDI
	hex
	default 0x00 if NFC_ISO14443_FSD_16
	default 0x10 if NFC_ISO14443_FSD_24
	default 0x20 if NFC_ISO14443_FSD_32
	default 0x50 if NFC_ISO14443_FSD_64
	default 0x70 if NFC_ISO14443_FSD_128
	default 0x80 if NFC_ISO14443_FSD_256

endif # NFC_ISO_DEP

config NFC_NDEF
	bool "NDEF message codec"
	default y
	help
	  NDEF (NFC Data Exchange Format) message parser and encoder. A pure
	  codec with no dependency on the driver API.

config NFC_T2T
	bool "Type 2 Tag operations"
	depends on NFC_NFCA
	default y if NFC_NFCA
	help
	  NFC Forum Type 2 Tag read/write over raw NFC-A.

config NFC_T4T
	bool "Type 4 Tag operations"
	depends on NFC_ISO_DEP
	default y if NFC_ISO_DEP
	help
	  NFC Forum Type 4 Tag read/write over ISO-DEP. Needs a frontend; a
	  controller that runs ISO-DEP in firmware reports -ENOTSUP.

config NFC_TAG
	bool "Tag-type-neutral NDEF access"
	depends on NFC_T2T || NFC_T4T
	default y if NFC_T2T || NFC_T4T
	help
	  Detect the NDEF tag type and dispatch to the Type 2 or Type 4 backend
	  (nfc_tag_connect, nfc_tag_read_ndef, nfc_tag_write_ndef). A product that
	  meets only one of the two can leave the other backend out; a tag of the
	  excluded type then reports -ENOTSUP at nfc_tag_connect().

endif # NFC
```

## subsys/nvmem/Kconfig
```kconfig
# Copyright (c) 2025 Basalte bv
# SPDX-License-Identifier: Apache-2.0

menuconfig NVMEM
	bool "Non Volatile Memory (NVMEM)"

if NVMEM

config NVMEM_PROVIDER
	bool
	help
	  Enabled when a native NVMEM provider driver is selected. Native
	  providers implement the NVMEM provider device API instead of one
	  of the memory device APIs.

config NVMEM_BBRAM
	bool "NVMEM support for Battery Backed RAM"
	default y
	depends on BBRAM

config NVMEM_EEPROM
	bool "NVMEM support for EEPROM devices"
	default y
	depends on EEPROM

config NVMEM_FLASH
	bool "NVMEM (read) support for flash devices"
	default y
	depends on FLASH

config NVMEM_FLASH_WRITE
	bool "NVMEM write support for flash devices"
	depends on NVMEM_FLASH
	help
	  Allow writing to NVMEM cells in flash devices.

	  An explicit option is added for this as it's non-trivial
	  to write to flash devices requiring out-of-bands erase or
	  taking write-block sizes into account.

config NVMEM_OTP
	bool "NVMEM (read) support for OTP memory handling devices"
	default y
	depends on OTP

config NVMEM_OTP_WRITE
	bool "NVMEM (write) support for OTP memory handling devices"
	depends on NVMEM_OTP && OTP_PROGRAM

config NVMEM_PSA
	bool
	help
	  Enabled when a PSA Secure Storage NVMEM provider is selected.

config NVMEM_PSA_ITS
	bool "NVMEM cells backed by PSA Internal Trusted Storage"
	default y
	depends on DT_HAS_ZEPHYR_NVMEM_PSA_ITS_ENABLED
	depends on TFM_PARTITION_INTERNAL_TRUSTED_STORAGE || SECURE_STORAGE
	select NVMEM_PSA
	select NVMEM_PROVIDER

config NVMEM_PSA_PS
	bool "NVMEM cells backed by PSA Protected Storage"
	default y
	depends on DT_HAS_ZEPHYR_NVMEM_PSA_PS_ENABLED
	depends on TFM_PARTITION_PROTECTED_STORAGE || SECURE_STORAGE
	select NVMEM_PSA
	select NVMEM_PROVIDER

config NVMEM_PSA_WRITE
	bool "Write support for PSA Secure Storage backed NVMEM cells"
	default y
	depends on NVMEM_PSA
	help
	  Allow writing to NVMEM cells backed by PSA Secure Storage entries.

	  Writing part of a cell reads, modifies and rewrites the whole
	  backing entry, as the PSA Secure Storage APIs only support
	  whole-entry writes.

config NVMEM_PSA_WRITE_BUF_SIZE
	int "PSA Secure Storage entry read-modify-write buffer size"
	depends on NVMEM_PSA_WRITE
	default SECURE_STORAGE_ITS_MAX_DATA_SIZE if SECURE_STORAGE
	default 128
	help
	  Size of the buffer used to read-modify-write a whole PSA Secure
	  Storage entry when writing part of an NVMEM cell. Partial writes
	  to entries larger than this buffer fail with -ENOBUFS.

module = NVMEM
module-str = nvmem
source "subsys/logging/Kconfig.template.log_config"

endif # NVMEM
```

## subsys/pmbus/Kconfig
```kconfig
# SPDX-FileCopyrightText: Copyright (c) 2026 Linumiz
#
# SPDX-License-Identifier: Apache-2.0

menuconfig PMBUS
	bool "PMBus core [EXPERIMENTAL]"
	depends on SMBUS
	select EXPERIMENTAL
	help
	  Enable the PMBus (Power Management Bus) core. It provides command
	  access with page handling and the PMBus data format conversions to
	  drivers of PMBus devices.

if PMBUS

config PMBUS_MAX_PAGES
	int "Maximum number of pages per device"
	range 1 32
	default 1
	help
	  Largest number of pages a PMBus device can have. It sets the size of
	  the per page state kept for each device.

module = PMBUS
module-str = pmbus
source "subsys/logging/Kconfig.template.log_config"

endif # PMBUS
```

## subsys/precision_timing/Kconfig
```kconfig
# SPDX-FileCopyrightText: Copyright The Zephyr Project Contributors
# SPDX-FileCopyrightText: Copyright (c) 2026 Philipp Steiner
#
# SPDX-License-Identifier: Apache-2.0

config PRECISION_TIMING
	bool "Precision timing infrastructure"
	help
	  Enable protocol-neutral precision time arithmetic, clock operations,
	  and a reusable proportional-integral controller.

	  The API is at experimental maturity as described by the Zephyr API
	  lifecycle, so it may still change. The subsystem is a building block
	  for protocols such as PTP and gPTP and does not change their maturity.

if PRECISION_TIMING

config PRECISION_TIMING_PI_KP
	int "PI controller proportional gain in thousandths"
	default 700
	range 0 10000
	help
	  Proportional gain used by the PTP and gPTP clock PI controllers,
	  expressed in thousandths. For example, 700 configures a gain of 0.7.

	  The default is suitable for a Sync interval around one second.
	  Shorter Sync intervals may require a smaller gain to avoid
	  oscillation.

config PRECISION_TIMING_PI_KI
	int "PI controller integral gain in thousandths"
	default 300
	range 0 10000
	help
	  Integral gain used by the PTP and gPTP clock PI controllers,
	  expressed in thousandths. For example, 300 configures a gain of 0.3.

	  The default is suitable for a Sync interval around one second.
	  Shorter Sync intervals may require a smaller gain to avoid
	  oscillation.

config PRECISION_TIMING_PI_INTEGRAL_LIMIT_PPM
	int "PI controller integral term limit in ppm"
	default 0
	range 0 1000000
	help
	  Largest magnitude of the integral term of the PTP and gPTP clock PI
	  controllers, in ppm. The integral term holds the estimate of the
	  frequency error of the local clock, so the limit only needs to cover
	  the tolerance of the oscillator with some margin. It stops the
	  integral term from winding up while a large offset lasts.

	  0 disables the limit.

config PRECISION_TIMING_PI_OUTPUT_LIMIT_PPM
	int "PI controller output limit in ppm"
	default 0
	range 0 1000000
	help
	  Largest magnitude of the rate correction requested by the PTP and
	  gPTP clock PI controllers, in ppm. Set it below the largest rate
	  correction the clock driver accepts, so that a large offset gives a
	  correction at the limit instead of a request the driver rejects.
	  While the output is at the limit, the integral term does not grow
	  further.

	  0 disables the limit.

endif # PRECISION_TIMING
```
