## subsys/mpipe/fs/Kconfig
```kconfig
# Copyright 2026 NXP
# SPDX-License-Identifier: Apache-2.0

config MPIPE_FS
	bool "Filesystem plugin support"
	depends on FILE_SYSTEM
	help
	  A source that reads a file in fixed-size blocks and a sink that writes
	  whatever reaches it, on any mounted Zephyr file system.

	  Neither knows what it is carrying: a file is a stream of bytes with no
	  format attached, so the source announces no capability of its own and
	  whatever follows it - typically a parser - works the format out. That
	  makes these the usual way to drive a graph without hardware.

if MPIPE_FS

config MPIPE_FS_BLOCK_SIZE
	int "Size of a buffer to read/write from/to a file"
	default 4096
	help
	  Default blocksize (read/write chunk size) used when the element blocksize
	  property is not set.
	  Also used as the size of each internal buffer when file_src falls back to
	  its own static buffer pool.

config MPIPE_FS_NUM_BUFS
	int "Number of buffers in the internal output pool"
	range 1 255
	default 1
	help
	  Number of static buffers in file_src's internal net_buf pool.
	  1 may be enough for fully synchronous pipelines; use >1 if downstream can
	  retain buffers asynchronously.
	  If downstream proposes a pool, file_src uses it instead.

endif # MPIPE_FS
```

## subsys/mpipe/img/Kconfig
```kconfig
# Copyright 2026 NXP
# SPDX-License-Identifier: Apache-2.0

config MPIPE_IMG
	bool "Image codec plugin support"
	help
	  Elements that turn a coded image stream into frames and decode them: a
	  JPEG parser that finds frame boundaries in undifferentiated bytes, and
	  a software JPEG decoder that produces raw pixels.

	  The two are separate because the split is real. The parser is what
	  first knows the format, and it can be followed either by the software
	  decoder here or by a hardware decoder from the video plugin, without
	  either side knowing which.

if MPIPE_IMG

config MPIPE_IMG_JPEG_PARSER_MAX_FRAME_SIZE
	int "Maximum JPEG frame size in bytes"
	default 0
	help
	  Maximum size of a single JPEG frame that the parser can accumulate when
	  downstream does not provide a usable pool.
	  Default value is set to 0 to disable the internal staging pool entirely
	  (no memory reserved).

config MPIPE_IMG_JPEG_PARSER_POOL_NUM
	int "Staging pool buffer count"
	range 1 255
	default 2
	help
	  Number of buffers in the parser's internal staging pool.
	  2 is usually enough (one partial, one output).

config MPIPE_IMG_JPEG_DECODER_POOL_NUM
	int "Number of buffers in the jpeg decoder's output pool"
	range 1 255
	default 1
	help
	  Number of buffers in the decoder's internal output pool, used when
	  downstream proposes no pool of its own.

	  One is enough where the element downstream consumes each frame before
	  the next arrives, which is the case for a display sink. Raise it when
	  downstream holds frames past the chain call.

config MPIPE_IMG_JPEG_DECODER_MAX_OUT_FRAME_SIZE
	int "Maximum decoded output frame size in bytes"
	default 153600
	help
	  Maximum decoded output frame size in bytes for the SW JPEG decoder internal pool.
	  Default value is set for 320x240 RGB565 format.

endif # MPIPE_IMG
```

## subsys/mpipe/net/Kconfig
```kconfig
# Copyright 2026 NXP
# SPDX-License-Identifier: Apache-2.0

config MPIPE_NET
	bool "Network plugin support"
	depends on NETWORKING && NET_TCP && NET_SOCKETS
	select NET_IPV4_MAPPING_TO_IPV6 if NET_NATIVE_IPV6
	help
	  TCP server sink and source elements. Each listens on its own port,
	  takes one client and moves pipeline buffers as a raw byte stream.
	  With IPv6 enabled a single socket serves IPv4 clients too, through
	  IPv4-mapped addresses.

if MPIPE_NET

config MPIPE_NET_SINK_PORT
	int "Default port the TCP sink listens on"
	range 1 65535
	default 5000
	help
	  Used unless the application sets MPIPE_PROP_TCP_SERVER_SINK_PORT.

config MPIPE_NET_SRC_PORT
	int "Default port the TCP source listens on"
	range 1 65535
	default 5001
	help
	  Used unless the application sets MPIPE_PROP_TCP_SERVER_SRC_PORT.

config MPIPE_NET_SRC_BUF_SIZE
	int "Size of a TCP source receive buffer in bytes"
	range 64 65535
	default 4096
	help
	  One recv() fills at most this many bytes.

config MPIPE_NET_SRC_NUM_BUFS
	int "Number of buffers in the TCP source pool"
	range 1 255
	default 4
	help
	  Use more than one when downstream holds buffers across calls.

endif # MPIPE_NET
```

## subsys/mpipe/nn/Kconfig
```kconfig
#
# Copyright 2026 NXP
#
# SPDX-License-Identifier: Apache-2.0
#

config MPIPE_NN
	bool "Neural network plugin"
	help
	  Enable the neural network plugin: elements that convert media buffers to
	  tensors, run neural network inference through a pluggable backend
	  and decode the resulting tensors into application-level results.

if MPIPE_NN

config MPIPE_NN_MAX_IO_TENSORS
	int "Maximum input/output tensors of a model"
	range 1 16
	default 4
	help
	  Size of the per-direction tensor descriptor set. Four covers the
	  common detection post-processing convention (boxes, classes,
	  scores, count).

config MPIPE_NN_CONVERTER
	bool "Video frame to tensor converter element"
	help
	  Element converting a video frame into a model input tensor in one
	  pass: nearest-neighbor scaling, color conversion and quantization.

if MPIPE_NN_CONVERTER

config MPIPE_NN_CONVERTER_POOL_NUM
	int "Number of tensor buffers of the converter"
	range 1 8
	default 2
	help
	  Tensors in flight between the converter and the inference element.
	  A frame arriving while all are held downstream is dropped.

config MPIPE_NN_CONVERTER_MAX_TENSOR_SIZE
	int "Maximum output tensor size of the converter (in bytes)"
	range 1 16777216
	default 16384
	help
	  Upper bound of one converted tensor; sizes the static buffer pool.
	  The default covers a 128x128 single-channel model input.

config MPIPE_NN_CONVERTER_DUMP
	bool "Dump converted tensors to the console"
	help
	  Print every MPIPE_NN_CONVERTER_DUMP_PERIOD-th tensor the converter
	  produces as hex rows on the console, to check what a model is fed:
	  geometry, orientation, brightness and byte order. Debugging aid;
	  a 96x96 tensor is about 19 kB of output, so use an immediate log
	  mode and a short period only on a fast console.

config MPIPE_NN_CONVERTER_DUMP_PERIOD
	int "Frames between two tensor dumps"
	depends on MPIPE_NN_CONVERTER_DUMP
	range 1 100000
	default 100
	help
	  Every Nth converted tensor is dumped.

endif # MPIPE_NN_CONVERTER

config MPIPE_NN_RUNNER
	bool "Neural network inference element"
	help
	  Element running a model on every input tensor buffer through the
	  selected backend.

if MPIPE_NN_RUNNER

choice MPIPE_NN_BACKEND
	prompt "Inference backend"
	default MPIPE_NN_BACKEND_FAKE

config MPIPE_NN_BACKEND_FAKE
	bool "Fake backend"
	help
	  Deterministic pseudo-inference with no runtime dependency, for
	  framework bring-up and continuous integration.

config MPIPE_NN_BACKEND_TFLM
	bool "TensorFlow Lite Micro backend"
	depends on TENSORFLOW_LITE_MICRO
	depends on STD_CPP17 || STD_CPP2A || STD_CPP20 || STD_CPP2B
	help
	  Run inference through the optional tflite-micro module, which needs
	  C++17 or later. With CONFIG_ETHOS_U or CONFIG_TFLM_NXP_NEUTRON the
	  backend also registers the NPU custom operator, so a model compiled
	  for that NPU runs on it; a model that was not runs on the CPU
	  kernels without notice.

endchoice

config MPIPE_NN_TFLM_MAX_OPS
	int "Operator capacity of the TFLM op resolver"
	range 25 64
	default 32
	depends on MPIPE_NN_BACKEND_TFLM
	help
	  Operator registrations the op resolver can hold. The backend
	  registers a fixed set for quantized vision models plus the NPU
	  custom operator when one is configured; raise it when extending
	  the registration list.

config MPIPE_NN_TFLM_MAX_INSTANCES
	int "Concurrent TFLM interpreter instances"
	range 1 4
	default 1
	depends on MPIPE_NN_BACKEND_TFLM
	help
	  Number of inference elements that can hold a loaded model at the
	  same time. Each instance reserves static storage for an interpreter
	  and an op resolver.

config MPIPE_NN_RUNNER_POOL_NUM
	int "Number of output buffers of the inference element"
	range 1 8
	default 2
	help
	  Output buffers in flight between the inference element and the
	  decoder. An inference finding none free is dropped.

config MPIPE_NN_RUNNER_MAX_OUT_SIZE
	int "Maximum total output size of a model (in bytes)"
	range 1 1048576
	default 512
	help
	  Upper bound of the flat buffer holding every output tensor of one
	  inference; sizes the static buffer pool. Classification outputs
	  are tiny; detection outputs need a few kilobytes.

endif # MPIPE_NN_RUNNER

config MPIPE_NN_DECODER
	bool "Tensor decoder element"
	help
	  Transform element turning output tensors into a results stream:
	  ranked class scores, or bounding boxes filtered by score and
	  non-maximum suppression, one results structure per buffer,
	  typically consumed by an app_sink.

config MPIPE_NN_DECODER_POOL_NUM
	int "Number of results buffers of the decoder element"
	range 1 8
	default 2
	depends on MPIPE_NN_DECODER
	help
	  Results buffers in flight between the decoder and its consumer. An
	  inference finding none free is dropped.

config MPIPE_NN_DECODER_CANDIDATES_MAX
	int "Boxes kept for non-maximum suppression"
	range 1 64
	default 16
	depends on MPIPE_NN_DECODER
	help
	  Boxes above the score threshold that the scored box list layout
	  ranks before non-maximum suppression, best first; lower-scored
	  ones are dropped. Keep it above MPIPE_NN_RESULTS_MAX so the
	  suppression has something to drop.

config MPIPE_NN_RESULTS_MAX
	int "Maximum entries in a result set"
	range 1 32
	default 8
	help
	  Ranked classes or boxes one struct mpipe_nn_results holds.

endif # MPIPE_NN
```

## subsys/mpipe/utils/Kconfig
```kconfig
#
# Copyright 2026 NXP
#
# SPDX-License-Identifier: Apache-2.0
#

config MPIPE_PLAYER
	bool "Multimedia Pipeline player helper"
	depends on MPIPE
	imply SHELL
	imply SERIAL
	imply UART_CONSOLE
	help
	  Enable the mpipe_player control layer: a reusable, media-player-like
	  helper that owns the run-time lifecycle of a pipeline (play, pause,
	  stop, replay, quit). When SHELL is enabled it also registers
	  interactive shell commands ("player play|pause|stop|replay|quit|status"
	  and the single-letter shortcuts p/s/r/q).

if MPIPE_PLAYER

config MPIPE_PLAYER_WORKER_STACK_SIZE
	int "Player worker thread stack size"
	default 6144
	help
	  Stack size (in bytes) for the player worker thread that serializes
	  pipeline state changes.

	  Capability negotiation runs on this thread and recurses from the source
	  down to the sinks. Each element keeps a few capabilities live while it
	  negotiates, roughly 800 bytes, so budget that much per element. The
	  default suits chains of up to about seven elements; raise it for longer
	  pipelines.

config MPIPE_PLAYER_WORKER_PRIORITY
	int "Player worker thread priority"
	default 5
	help
	  Scheduling priority for the player worker thread.

config MPIPE_PLAYER_CMD_QUEUE_DEPTH
	int "Player command queue depth"
	default 8
	help
	  Number of pending commands the player can buffer. Posting never
	  blocks, so a command asked for once the queue is full is dropped
	  and reported.

config MPIPE_PLAYER_DUMP_ON_STATE_CHANGE
	bool "Dump the pipeline on every state change and every error"
	depends on MPIPE_DUMP
	help
	  Print the pipeline after each state the player drives it to, and
	  whenever an element reports an error.

	  The dump is taken once the transition has finished, never between
	  two of them, so it delays nothing: a failure stops the pipeline
	  where it broke and the graph is still that failure's graph.

	  It goes to the console rather than the shell, since no shell
	  instance exists at that point. Extract a graph from a capture with:

	    sed -n '/^digraph/,/^}/p' log > pipe.dot

endif # MPIPE_PLAYER

config MPIPE_DUMP_MAX_ELEMENTS
	int "Maximum number of elements a dump can index"
	depends on MPIPE_DUMP
	range 2 256
	default 32
	help
	  A dump flattens nested bins, so it can hold more elements than one
	  bin's MPIPE_BIN_MAX_CHILDREN. An element past this limit is left out
	  of the graph and the dump is marked truncated.
```

## subsys/mpipe/vid/Kconfig
```kconfig
#
# Copyright 2025 NXP
#
# SPDX-License-Identifier: Apache-2.0
#

config MPIPE_VID
	bool "Video plugin support"
	select VIDEO
	help
	  Elements backed by Zephyr video devices: capture from a camera, and
	  memory-to-memory transforms performed by hardware such as a scaler,
	  rotator or decoder.

	  This is where zero-copy matters most, so the pools here hand out the
	  driver's own buffers rather than copies, and a frame captured by a
	  camera reaches the display without being moved.

if MPIPE_VID

config MPIPE_VID_CONVERT
	bool "Software-based pixel format converter"
	help
	  A transform that converts a frame from one pixel format to another on
	  the CPU.

	  It exists as the fallback for a conversion no hardware on the board can
	  do, which is common between a decoder's output format and what a panel
	  accepts. It converts pixel formats only: it does not scale, crop or
	  rotate. Expect it to cost real CPU time per frame.

endif # MPIPE_VID
```

## subsys/net/Kconfig
```kconfig
# Net stack configuration options

# Copyright (c) 2015 Intel Corporation
# SPDX-License-Identifier: Apache-2.0

menu "Networking"

config NETWORKING
	bool "Link layer and networking (including IP)"
	select NET_BUF
	select POLL
	select ENTROPY_GENERATOR
	help
	  This option enables generic link layer and networking support
	  and is the basis for higher level protocols (e.g. IP protocols).

if NETWORKING

# Such option should not be configured manually but by device drivers
# which supports PM properly.
config NET_POWER_MANAGEMENT
	bool
	depends on PM_DEVICE

config NET_LTO
	bool "Link Time Optimization of the network stack and drivers"
	depends on LTO_SUPPORTED
	depends on !USERSPACE
	select LTO_SELECTED_LIBRARIES if !LTO
	help
	  Compile the network stack, net_buf and the network drivers with
	  Link Time Optimization, and the rest of the image without it. This
	  lets the compiler inline across the files and libraries on the
	  network data path. The option has no effect when CONFIG_LTO
	  already applies Link Time Optimization to the whole image.

source "subsys/net/Kconfig.hostname"

source "subsys/net/l2/Kconfig"

source "subsys/net/ip/Kconfig"

source "subsys/net/pkt_filter/Kconfig"

source "subsys/net/lib/Kconfig"

source "subsys/net/conn_mgr/Kconfig"

endif

endmenu
```

## subsys/net/ip/Kconfig.stack
```kconfig
# Stack usage related options

# Copyright (c) 2016 Intel Corporation.
# SPDX-License-Identifier: Apache-2.0

menu "Stack usage"

config NET_TX_STACK_SIZE
	int "TX thread stack size"
	default 1200
	help
	  Set the TX thread stack size in bytes. The TX thread is waiting
	  data from application. Each network interface will start one
	  TX thread for sending network packets destined to it.
	  This value is a baseline and the actual TX stack size might
	  be bigger depending on what features are enabled.

config NET_RX_STACK_SIZE
	int "RX thread stack size"
	default 3072 if ARM64
	default 1792 if DNS_RESOLVER
	default 1500
	help
	  Set the RX thread stack size in bytes. The RX thread is waiting
	  data from network. There is one RX thread in the system.
	  This value is a baseline and the actual RX stack size might
	  be bigger depending on what features are enabled.

config NET_DEDICATED_WORKQUEUE
	bool
	default y if NET_NATIVE
	depends on MULTITHREADING

config NET_DEDICATED_WORKQUEUE_STACK_SIZE
	int
	default 2048 if COVERAGE_GCOV
	default 1536 if 64BIT
	default 1280
	depends on NET_DEDICATED_WORKQUEUE

module = NET
module-str = networking
source "kernel/Kconfig.template.workqueue"

endmenu
```
