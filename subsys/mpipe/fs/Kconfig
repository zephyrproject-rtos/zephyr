## subsys/net/l2/ethernet/bridge/Kconfig
```kconfig
# Ethernet bridge configuration options

# Copyright 2025 NXP
# SPDX-License-Identifier: Apache-2.0

menuconfig NET_ETHERNET_BRIDGE
	bool "Ethernet Bridging support"
	select NET_PROMISCUOUS_MODE
	select NET_L2_VIRTUAL
	help
	  Enables Ethernet bridging where packets can be transparently
	  forwarded across interfaces registered to a bridge.

if NET_ETHERNET_BRIDGE

config NET_ETHERNET_BRIDGE_COUNT
	int "Max number of bridge interfaces"
	default 1
	range 1 16
	help
	  How many bridge interfaces are created. Each interface can bridge
	  two or more Ethernet interfaces.

config NET_ETHERNET_BRIDGE_ETH_INTERFACE_COUNT
	int "Max number of Ethernet interfaces bridged together"
	default 2
	range 2 32
	help
	  How many Ethernet interfaces can be bridged together per each
	  bridge interface.

choice NET_ETHERNET_BRIDGE_MAC
	prompt "Bridge interface MAC address source"
	default NET_ETHERNET_BRIDGE_RANDOM_MAC
	help
	  Select how the MAC (link) address of a bridge interface is assigned.
	  A bridge interface can own an IP address and terminate/originate
	  traffic of its own, so it needs a MAC address. For a fully custom
	  address the application can instead call net_if_set_link_addr() on the
	  bridge interface while it is down (bridge interfaces do not auto-start).

config NET_ETHERNET_BRIDGE_RANDOM_MAC
	bool "Random MAC address"
	help
	  Assign a random locally administered MAC address to each bridge
	  interface. A new address is generated on every boot, so peers'
	  ARP/neighbor caches for the bridge become stale across reboots.

config NET_ETHERNET_BRIDGE_UNIQUE_MAC
	bool "Stable MAC address derived from the device ID"
	depends on HWINFO
	help
	  Derive a stable locally administered MAC address from the hardware
	  device ID. The same address is used across reboots so peers' caches
	  stay valid. The bridge index is mixed in so multiple bridge interfaces
	  get distinct addresses. Falls back to a random address when no device
	  ID is available.

config NET_ETHERNET_BRIDGE_PREFIX_MAC
	bool "Stable MAC address from configured prefix"
	help
	  Assign a stable MAC address by appending the bridge index to a
	  configured five-octet MAC address prefix. The resulting address is the
	  same across reboots so peers' caches stay valid.

endchoice

config NET_ETHERNET_BRIDGE_MAC_PREFIX
	string "Bridge MAC address prefix"
	depends on NET_ETHERNET_BRIDGE_PREFIX_MAC
	default "02:00:00:00:00"
	help
	  Five-octet colon-separated MAC address prefix used for bridge
	  interfaces. The bridge index is used as the final octet, so bridge0
	  with prefix "02:00:00:00:00" gets "02:00:00:00:00:00" and bridge1
	  gets "02:00:00:00:00:01".

config NET_ETHERNET_BRIDGE_TXRX_DEBUG
	bool "Debug received and sent packets in bridge"
	depends on NET_L2_ETHERNET_LOG_LEVEL_DBG
	help
	  Enables printing of received and sent network packets.
	  This can produce lot of output so it is disabled by default.

config NET_ETHERNET_BRIDGE_SHELL
	bool "Ethernet Bridging management shell"
	select NET_SHELL
	select SHELL_GETOPT if NET_ETHERNET_BRIDGE_STP
	select GETOPT_LONG if NET_ETHERNET_BRIDGE_STP
	help
	  Enables shell utility to manage bridge configuration interactively.

config NET_ETHERNET_BRIDGE_FDB
	bool "FDB (Forwarding database) table support"
	help
	  Enables FDB (Forwarding database) table support.

config NET_ETHERNET_BRIDGE_FDB_MAX_ENTRIES
	int "Max number of FDB (Forwarding database) entries"
	depends on NET_ETHERNET_BRIDGE_FDB
	default 32
	range 1 $(UINT16_MAX)
	help
	  How many FDB (Forwarding database) entries supported.

config NET_ETHERNET_BRIDGE_FDB_LEARNING
	bool "Learn source MAC addresses into the FDB"
	depends on NET_ETHERNET_BRIDGE_FDB
	default y
	help
	  Learn the port of each source MAC address from received frames,
	  so that a frame to a known destination is sent out of one port
	  instead of being flooded. Learned entries are dynamic and never
	  replace static ones. When the table is full nothing more is
	  learned, and frames to unknown destinations are flooded.

config NET_ETHERNET_BRIDGE_FDB_AGEING_TIME
	int "Ageing time of learned FDB entries in seconds"
	depends on NET_ETHERNET_BRIDGE_FDB_LEARNING
	default 300
	range 1 1000000
	help
	  A learned entry is removed when no frame from its address has been
	  received for this long. Static entries do not age.

config NET_ETHERNET_BRIDGE_STP
	bool "Rapid Spanning Tree Protocol (RSTP) [EXPERIMENTAL]"
	select EXPERIMENTAL
	select NET_ETHERNET_BRIDGE_FDB
	select NET_MGMT
	select NET_MGMT_EVENT
	select NET_MGMT_EVENT_INFO
	help
	  Support the Rapid Spanning Tree Protocol, as specified in IEEE Std
	  802.1Q-2014 Clause 13 and earlier in IEEE Std 802.1D-2004, on the
	  bridge interfaces. It blocks the ports that would make a loop, and
	  falls back to STP BPDUs on a port where an STP bridge is attached.
	  The protocol runs on a bridge once eth_bridge_stp_enable() is
	  called for it, and raises net_mgmt events when a port changes its
	  role or state, the root bridge changes, or a topology change starts.
	  Each bridge port takes about 230 bytes of RAM.

module = NET_ETHERNET_BRIDGE
module-dep = NET_LOG
module-str = Log level for Ethernet Bridging
module-help = Enables Ethernet Bridge code to output debug messages.
source "subsys/net/Kconfig.template.log_config.net"

endif # NET_ETHERNET_BRIDGE
```

## subsys/net/l2/ethernet/dsa/Kconfig
```kconfig
# Distributed Switch Architecture [DSA] configuration options

# Copyright (c) 2020 DENX Software Engineering GmbH
#               Lukasz Majewski <lukma@denx.de>
# Copyright 2025 NXP
# SPDX-License-Identifier: Apache-2.0

menuconfig NET_DSA
	bool "Distributed Switch Architecture support"
	help
	  Enable Distributed Switch Architecture support.

if NET_DSA

config DSA_PORT_MAX_COUNT
	int "DSA port max count"
	default 8
	help
	  Set DSA port max count.

config DSA_TAG_SIZE
	int "DSA tag size in bytes"
	default 0
	help
	  Set the DSA tag length in bytes.

config DSA_CONDUIT_PROMISC_ON
	bool "Run DSA conduit in promiscuous mode"
	default y
	select NET_PROMISCUOUS_MODE
	help
	  Some conduits leverage ingress filters to discard packets whose DMAC field does not match
	  that programmed into the conduit's MAC before said packets are ever made available to the
	  software. Such conduits typically need to run in promiscuous mode to ensure packets
	  received on DSA ports being processed.


module = NET_DSA
module-dep = NET_LOG
module-str = Log level for DSA
module-help = Enables core DSA code to output debug messages.
source "subsys/net/Kconfig.template.log_config.net"

endif # NET_DSA
```

## subsys/net/l2/ppp/Kconfig
```kconfig
# Copyright (c) 2019 Intel Corporation.
# SPDX-License-Identifier: Apache-2.0

menuconfig NET_L2_PPP
	bool "Point-to-point (PPP) support"
	select NET_MGMT
	select NET_MGMT_EVENT
	help
	  Add support for PPP.

if NET_L2_PPP

config NET_L2_PPP_TIMEOUT
	int "Maximum timeout in ms for Configure-Req"
	default 3000
	range 1 $(UINT32_MAX)
	help
	  How long to wait Configure-Req.

config NET_L2_PPP_MAX_CONFIGURE_REQ_RETRANSMITS
	int "Maximum number of Configure-Req retransmits"
	default 10
	range 0 $(UINT32_MAX)
	help
	  How many times to resend Configure-Req messages before deciding the
	  link is not working properly.

config NET_L2_PPP_MAX_TERMINATE_REQ_RETRANSMITS
	int "Maximum number of Terminate-Req retransmits"
	default 2
	range 0 $(UINT32_MAX)
	help
	  How many times to resend Terminate-Req messages before terminating
	  the link.

config NET_L2_PPP_MAX_NACK_LOOPS
	int "Maximum number of NACK loops accepted"
	default 5
	range 0 $(UINT32_MAX)
	help
	  How many times to accept NACK loops.

config NET_L2_PPP_OPTION_DNS_USE
	bool "Use negotiated DNS servers"
	depends on DNS_RESOLVER
	help
	  Use the DNS servers negotiated in the IPCP configuration.

config NET_L2_PPP_AUTH_SUPPORT
	bool

config NET_L2_PPP_PAP
	bool "PAP authentication protocol"
	select NET_L2_PPP_AUTH_SUPPORT
	help
	  Enable support for PAP authentication protocol.

config NET_L2_PPP_OPTION_MRU
	bool "LCP MRU option support"
	help
	  Enable support for LCP MRU option.

config NET_L2_PPP_OPTION_PFC
	bool "LCP Protocol-Field-Compression (PFC) option support"
	help
	  Enable LCP negotiation of Protocol-Field-Compression (RFC 1661,
	  option 7). This advertises to the peer that a Protocol field
	  compressed to a single octet, which is possible for protocol numbers
	  below 0x0100, is acceptable, and records a matching request from the
	  peer in the PPP context.

	  This option only controls the LCP exchange. Reception does not depend
	  on it, the receiver always accepts both the compressed and the
	  uncompressed form. Compressing the Protocol field on transmit is not
	  implemented.

config NET_L2_PPP_OPTION_ACFC
	bool "LCP Address-and-Control-Field-Compression (ACFC) option support"
	help
	  Enable LCP negotiation of Address-and-Control-Field-Compression
	  (RFC 1661, option 8). This advertises to the peer that frames without
	  the Address (0xFF) and Control (0x03) fields are acceptable, and
	  records a matching request from the peer in the PPP context.

	  This option only controls the LCP exchange. Reception does not depend
	  on it, the receiver decompresses the fields as described in RFC 1662
	  ch. 3.2 and accepts both forms. Omitting the fields on transmit is
	  not implemented.

config NET_L2_PPP_OPTION_SERVE_IP
	bool "Serve IP address to peer"
	help
	  Enable support for serving IP address to PPP peer.

config NET_L2_PPP_OPTION_SERVE_DNS
	bool "Serve DNS addresses to peer"
	help
	  Enable support for serving DNS addresses to PPP peer.

module = NET_L2_PPP
module-dep = NET_LOG
module-str = Log level for ppp L2 layer
module-help = Enables ppp L2 to output debug messages.
source "subsys/net/Kconfig.template.log_config.net"

config NET_L2_PPP_MGMT
	bool "Ppp network management interface"
	select NET_MGMT
	select NET_MGMT_EVENT
	help
	  Enable support net_mgmt ppp interface which can be used to
	  configure at run-time ppp drivers and L2 settings.

config NET_L2_PPP_TX_STACK_SIZE
	int "Stack size for TX handler"
	default 2048 if COVERAGE_GCOV
	default 1024
	help
	  Set the TX handler stack size.

config NET_L2_PPP_THREAD_PRIO
	int "Priority of the PPP TX thread"
	default 1
	help
	  Set the priority of the PPP TX thread, that handles all
	  transmission of PPP packets.
	  Value 0 = highest priortity.
	  When CONFIG_NET_TC_THREAD_COOPERATIVE = y, lowest priority is
	  CONFIG_NUM_COOP_PRIORITIES-1 else lowest priority is
	  CONFIG_NUM_PREEMPT_PRIORITIES-1.
	  When using PPP in combination with TCP, make sure the priority
	  is higher (or equal) than the TCP work queue, otherwise the
	  TCP stack will consume all net_bufs before transferring
	  execution to the lower layer network stack, with a high risk of
	  running out of net_bufs.

endif # NET_L2_PPP
```

## subsys/net/lib/coap/Kconfig.oscore
```kconfig
# CoAP OSCORE (RFC 8613) implementation for Zephyr

# Copyright (c) 2026 Siemens AG
# SPDX-License-Identifier: Apache-2.0

config COAP_OSCORE
	bool "OSCORE support for CoAP (RFC 8613) [EXPERIMENTAL]"
	depends on UOSCORE
	depends on PSA_CRYPTO
	select EXPERIMENTAL
	help
	  Enable Object Security for Constrained RESTful Environments (OSCORE)
	  support for CoAP server. OSCORE provides end-to-end protection of
	  CoAP messages using COSE (CBOR Object Signing and Encryption).

	  This option requires the uoscore-uedhoc module and PSA Crypto support.
	  When enabled, CoAP messages can be protected with OSCORE by using a
	  OSCORE enabled service.

	  See RFC 8613 for details.

if COAP_OSCORE

config COAP_OSCORE_MAX_CONTEXTS
	int "Maximum number of OSCORE security contexts"
	default 1
	range 1 32
	help
	  Number of OSCORE security contexts that can be allocated at runtime
	  through coap_oscore_context_init(). Each context is used to protect
	  and verify messages for one CoAP client or service. Increase this if
	  your application uses more than one OSCORE-enabled endpoint at a time.

config COAP_OSCORE_MASTER_SECRET_MAX_LEN
	int "Maximum OSCORE Master Secret length in bytes"
	default 16
	range 16 64
	help
	  Size of the per-context buffer that stores the OSCORE Master Secret.
	  The Master Secret is application-chosen HKDF input keying material of
	  variable length (RFC 8613 Section 3.1); the common case for the
	  AES-CCM-16-64-128 profile is 16 bytes. Increase this if your deployment
	  provisions longer secrets. Each of the CONFIG_COAP_OSCORE_MAX_CONTEXTS
	  contexts reserves this many bytes.

config COAP_OSCORE_MASTER_SALT_MAX_LEN
	int "Maximum OSCORE Master Salt length in bytes"
	default 8
	range 0 64
	help
	  Size of the per-context buffer that stores the OSCORE Master Salt.
	  The Master Salt is optional (RFC 8613 Section 3.1) and may be empty;
	  when present it is commonly 8 bytes. Set to 0 to disable Master Salt
	  storage entirely (contexts may then only be provisioned with an empty
	  salt). Increase this if your deployment provisions a longer salt. Each
	  of the CONFIG_COAP_OSCORE_MAX_CONTEXTS contexts reserves this many bytes.

config COAP_OSCORE_EXCHANGE_CACHE_SIZE
	int "OSCORE exchange cache size per service"
	default 3
	range 1 255
	help
	  Number of OSCORE exchange entries to cache per service endpoint.
	  This tracks which ongoing exchanges require OSCORE-protected responses.
	  Each entry stores client address and token information to match
	  responses to OSCORE requests per RFC 8613 Section 8.3.

	  Synchronous responses also go through the cache (the entry is added
	  before the handler runs and removed after the response is sent).
	  Observe notifications bypass the cache entirely and use the per-observer
	  OSCORE context instead. Size the cache to the maximum number of
	  concurrent in-flight requests you expect.

config COAP_OSCORE_EXCHANGE_LIFETIME_MS
	int "OSCORE exchange lifetime in milliseconds"
	default 247000
	help
	  Lifetime of a tracked OSCORE exchange entry. In practice, expiry only
	  affects deferred (separate) responses, i.e. responses produced after
	  the request handler has already returned. Synchronous responses always
	  find a live entry (it was just created), and Observe notifications
	  bypass the cache entirely.

	  After this time a deferred exchange entry is considered expired and
	  removed. A separate response produced later is treated as invalid: on an
	  OSCORE-required service it is dropped (fail-closed). On a mixed service
	  that also accepts unprotected clients it can no longer be matched to the
	  exchange and would be sent unprotected. Keep this value at or above the
	  CoAP EXCHANGE_LIFETIME if a resource can defer responses that long.

	  The default of 247 seconds matches the CoAP EXCHANGE_LIFETIME
	  (RFC 7252 Section 4.8.2).

config COAP_OSCORE_CONTEXT_REUSE
	bool "OSCORE support for context reuse across reboots"
	select UOSCORE_NVM_SUPPORT
	help
	  Enable support for reusing OSCORE security contexts across device
	  reboots. When a context is reused, the sender sequence number (SSN)
	  must be persisted to non-volatile memory to prevent AEAD nonce reuse,
	  which is cryptographically catastrophic.

	  The SSN is persisted automatically through the Zephyr settings
	  subsystem (selected via UOSCORE_NVM_SUPPORT), so the application
	  needs a working settings backend, e.g. a storage partition and its
	  matching backend such as CONFIG_SETTINGS_NVS.

	  Applications that cannot guarantee a fresh context at every boot
	  (e.g., via EDHOC key derivation) require this option. All other
	  deployments should leave this disabled.

endif # COAP_OSCORE
```
