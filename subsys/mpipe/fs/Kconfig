## subsys/net/lib/ocpp/Kconfig
```kconfig
# Copyright (c) 2025 Linumiz GmbH
# SPDX-License-Identifier: Apache-2.0

config OCPP
	bool "Open Charge Point Protocol [EXPERIMENTAL]"
	depends on JSON_LIBRARY
	depends on WEBSOCKET_CLIENT
	select EXPERIMENTAL
	select POSIX_C_LANG_SUPPORT_R
	help
	  This option enables the open charge point protocol library

if OCPP

module=OCPP
module-dep=NET_LOG
module-str=Log level for OCPP
module-help=Enables ocpp debug messages.
source "subsys/net/Kconfig.template.log_config.net"

config OCPP_INT_THREAD_STACKSIZE
	int "OCPP internal thread stacksize"
	default 4096
	help
	   OCPP internal thread stacksize

config OCPP_WSREADER_THREAD_STACKSIZE
	int "OCPP websocket reader thread stacksize"
	default 4096
	help
	   OCPP websocket reader thread stacksize

config OCPP_RECV_BUFFER_SIZE
	int "OCPP websocket receive buffer size"
	default 2048
	help
	   OCPP websocket receive buffer size

config OCPP_INTERNAL_MSGQ_CNT
	int "OCPP internal message queue count"
	default 10
	help
	   Messages communication between websocket reader and internal
	   process thread

config OCPP_MSG_JSON
	bool "PDU message format as JSON"
	default y
	help
	   If enabled y, then the Charge Point and Central System PDU message
	   format as JSON

config OCPP_BASIC_AUTH
	bool "HTTP Basic authentication"
	select BASE64
	help
	  Send the charge point credentials passed to ocpp_init() to the
	  central system in the Authorization header of the websocket
	  handshake (RFC 7617). This is the charge point authentication of
	  the security profiles 1 and 2 of the OCPP 1.6 security whitepaper.

	  Without TLS (security profile 1) the credentials are readable on
	  the network: use it in trusted networks only (A00.FR.201).

	  The AuthorizationKey configuration key is not implemented.

if OCPP_BASIC_AUTH

config OCPP_BASIC_AUTH_USERNAME_MAX_LEN
	int "Maximum length of the basic authentication username"
	default 48
	range 1 255
	help
	  Longest charge point identity, in characters, that ocpp_init()
	  accepts as username.

config OCPP_BASIC_AUTH_PASSWORD_MAX_LEN
	int "Maximum length of the basic authentication password"
	default 40
	range 16 255
	help
	  Longest password, in bytes, that ocpp_init() accepts. The shortest
	  is fixed to the 16 bytes of the OCPP 1.6 security whitepaper
	  (A00.FR.205). Its keys have 20 bytes at most; the default also fits
	  their 40 hexadecimal digits for a central system that expects text.

endif # OCPP_BASIC_AUTH

config OCPP_PROFILE_SMART_CHARGE
	bool "OCPP profile smart charging"
	help
	  Enables the OCPP library to support the Smart Charging profile
	  functionality. Charge Point may support this profile as optional.

config OCPP_PROFILE_REMOTE_TRIG
	bool "OCPP profile remote trigger"
	help
	  Enables the OCPP library to support the Remote Trigger
	  functionality. Charge Point may support this profile as optional.

config OCPP_PROFILE_RESERVATION
	bool "OCPP profile reservation"
	help
	  Enables the OCPP library to support the Profile Reservation
	  functionality. Charge Point may support this profile as optional.

config OCPP_PROFILE_LOCAL_AUTH_LIST
	bool "OCPP profile local authorization list"
	help
	  Enables the OCPP library to support the Local Authorization List
	  functionality. Stores IdTag and its validity information in the
	  persistent storage. Charge Point may support this as optional.

config OCPP_PROFILE_FIRMWARE_MGNT
	bool "OCPP profile firmware management"
	help
	  Enables the OCPP library to support the Firmware Management of
	  Charge Point as optional profile.

endif # OCPP
```

## subsys/net/lib/rfc2217/Kconfig
```kconfig
# SPDX-FileCopyrightText: Copyright The Zephyr Project Contributors
# SPDX-License-Identifier: Apache-2.0

menuconfig NET_RFC2217
	bool "Telnet COM port control (RFC 2217)"
	help
	  The server side of the Telnet COM port control option: a client
	  such as pyserial's rfc2217:// sets the line of a serial port and
	  exchanges data with it over a Telnet connection.

if NET_RFC2217

config NET_RFC2217_SIGNATURE
	string "Signature"
	default "Zephyr"
	help
	  The text the server sends when a client asks for its signature.

config NET_RFC2217_SERVER
	bool "RFC 2217 server"
	default y if DT_HAS_ZEPHYR_RFC2217_SERVER_ENABLED
	depends on NET_TCP && NET_SOCKETS
	depends on SERIAL_SUPPORT_INTERRUPT
	select UART_INTERRUPT_DRIVEN
	select NET_SOCKETS_SERVICE
	help
	  A UART over TCP, one client at a time, defined in the devicetree
	  (zephyr,rfc2217-server) or by the application.  Each server
	  takes three of the socket service's poll entries
	  (CONFIG_ZVFS_POLL_MAX).

if NET_RFC2217_SERVER

config NET_RFC2217_SERVER_RX_SIZE
	int "UART receive buffer size"
	default 512
	help
	  Bytes received from the UART and not yet sent to the client.

config NET_RFC2217_SERVER_TX_SIZE
	int "UART transmit buffer size"
	default 512
	help
	  Bytes received from the client and not yet transmitted on the
	  UART.  The server stops reading from the client while it is full.

config NET_RFC2217_SERVER_OUT_SIZE
	int "Output buffer size"
	default 256
	help
	  Escaped serial data and replies on their way to the client.

config NET_RFC2217_SERVER_INIT_PRIORITY
	int "Devicetree servers init priority"
	default 90
	help
	  Initialization priority, at the APPLICATION level, of the servers
	  defined in the devicetree.

module = NET_RFC2217_SERVER
module-dep = NET_LOG
module-str = Log level for the RFC 2217 server
module-help = Enables the RFC 2217 server to output debug messages.
source "subsys/net/Kconfig.template.log_config.net"

endif # NET_RFC2217_SERVER

endif # NET_RFC2217
```

## subsys/net/lib/rtp/Kconfig
```kconfig
# SPDX-FileCopyrightText: 2026 Basalte bv
# SPDX-License-Identifier: Apache-2.0

menuconfig RTP
	bool "Real-Time transport Protocol (RTP) [EXPERIMENTAL]"
	select EXPERIMENTAL
	depends on NET_UDP
	help
	  Real-time Transport Protocol implementation based on RFC 3550

if RTP

module = RTP
module-dep = NET_LOG
module-str = Log level for RTP
module-help = Enable logs for the RTP stack.
source "subsys/net/Kconfig.template.log_config.net"

config RTP_MAX_CSRC_COUNT
	int "RTP Max CSRC Count"
	default 0
	range 0 15
	help
	  Set the maximum number of CSRC identifiers in an RTP header

config RTP_MCAST_TTL
	int "RTP Mcast TTL"
	default 127
	range 0 255
	help
	  Set the time-to-live for multicast RTP packets. For IPv6 sessions, this value
	  is used as the multicast hop limit.

config RTP_TRANSPORT_SOCKET
	bool "RTP Transport Socket"
	default y
	select NET_SOCKETS
	select NET_SOCKETS_SERVICE
	help
	  Select the socket transport implementation for RTP. This is the default option.

if RTP_TRANSPORT_SOCKET

config RTP_TRANSPORT_SOCKET_MAX_SESSIONS
	int "RTP Transport Socket Max Sessions"
	default 4
	help
	  Number of concurrent sessions the socket transport supports.
	  One RX socket fd is consumed per active session

config RTP_TRANSPORT_SOCKET_BUF_SIZE
	int "RTP Transport Socket Buf Size"
	default 1500
	range 64 $(UINT16_MAX)
	help
	  Size of the send and receive socket buffer

config RTP_TRANSPORT_SOCKET_INIT_PRIO
	int "RTP Transport Socket Init Prio"
	default 70
	help
	  Initialisation priority of the rtp socket stack. During initialisation, all socket file
	  descriptors are set to -1.

endif # RTP_TRANSPORT_SOCKET

config RTP_TRANSPORT_NET_PKT
	bool "RTP Transport Net Pkt"
	help
	  Select the net pkt transport implementation for RTP. This is the fastest implementation
	  with the least amount of overhead

if RTP_TRANSPORT_NET_PKT

config RTP_LOCAL_PORT_BASE
	int "RTP Local Port Base"
	default 51000
	range 1024 65535
	help
	  Base port from which the local rtp ports start, if no local port is defined by the user

endif # RTP_TRANSPORT_NET_PKT

config SRTP
	bool "Secure RTP (SRTP) [EXPERIMENTAL]"
	select EXPERIMENTAL
	select PSA_CRYPTO
	select PSA_WANT_KEY_TYPE_AES
	select PSA_WANT_ALG_CTR
	select PSA_WANT_ALG_ECB_NO_PADDING
	select PSA_WANT_ALG_HMAC
	select PSA_WANT_KEY_TYPE_HMAC
	select PSA_WANT_ALG_SHA_1
	imply PSA_WANT_ALG_GCM
	help
	  Secure Real-time Transport Protocol implementation based on RFC 3711,
	  with AES-128 and AES-256 GCM crypto suites based on RFC 7714.
	  Protects RTP packets only; SRTCP is not supported. Key exchange is
	  out of scope: master keys are provisioned by the application.

if SRTP

config SRTP_MAX_RX_STREAMS
	int "SRTP Max RX streams per session"
	default 4
	range 1 $(UINT8_MAX)
	help
	  Number of inbound SSRCs per RTP session for which SRTP crypto
	  contexts can be instantiated. Streams are late-bound: a context is
	  created when the first packet of an unknown SSRC arrives.

config SRTP_REPLAY_WINDOW_SIZE
	int "SRTP replay protection window size"
	default 128
	range 64 1024
	help
	  Size of the replay protection sliding window in packets, as per
	  RFC 3711 section 3.3.2. Must be a multiple of 64.

config SRTP_NET_PKT_BUF_SIZE
	int "SRTP staging buffer size for the net pkt transport"
	depends on RTP_TRANSPORT_NET_PKT
	default NET_BUF_DATA_SIZE
	range 64 $(UINT16_MAX)
	help
	  Size of the staging buffer used to get a contiguous view of RTP
	  packets on the net pkt transport when SRTP is enabled on a session.
	  The buffer is part of the session's SRTP context and shared between
	  transmit and receive. The default matches the net pkt transport's
	  transmit allocation size. Received packets larger than this are
	  dropped.

endif # SRTP

endif # RTP
```

## subsys/net/lib/snmp/Kconfig
```kconfig
# SPDX-FileCopyrightText: Copyright The Zephyr Project Contributors
# SPDX-License-Identifier: Apache-2.0

menuconfig SNMP
	bool "SNMP agent [EXPERIMENTAL]"
	select EXPERIMENTAL
	help
	  SNMPv1 and SNMPv2c agent.

if SNMP

module = SNMP
module-dep = NET_LOG
module-str = Log level for SNMP
module-help = Enable debug message of SNMP agent.
source "subsys/net/Kconfig.template.log_config.net"

endif # SNMP
```

## subsys/net/lib/sntp/Kconfig
```kconfig
# SPDX-FileCopyrightText: Copyright The Zephyr Project Contributors
# SPDX-FileCopyrightText: Copyright (c) 2017 Linaro Limited
# SPDX-License-Identifier: Apache-2.0

menu "SNTP (Simple Network Time Protocol) support"
	depends on NET_SOCKETS

config SNTP
	bool "SNTP client"
	select SNTP_LIB
	help
	  Enable SNTP client support

if SNTP

config SNTP_UNCERTAINTY
	bool "Calculate SNTP uncertainty and set uptime timestamp"
	help
	  Get a more reliable timestamp by supplying the sntp_time struct with an
	  uptime timestamp of when the time was valid and an uncertainty of the
	  time in microseconds. Time is then given as:
	  seconds,fraction +/- uncertainty at uptime timestamp.
	  Enabling this option uses more resources (memory) and is not normally
	  needed.

endif # SNTP

config SNTP_SERVER
	bool "SNTP server"
	depends on NET_UDP
	depends on NET_IPV4 || NET_IPV6
	select SNTP_LIB
	select NET_SOCKETS_SERVICE
	help
	  Enable SNTP server support. The server answers queries on UDP port
	  123 for every enabled address family. The application is responsible
	  for setting the system clock and for telling the server about the
	  clock source with sntp_server_clock_source().

config SNTP_LIB
	bool
	help
	  SNTP support library

if SNTP_LIB

module = SNTP
module-dep = NET_LOG
module-str = Log level for SNTP
module-help = Enable debug message of SNTP library.
source "subsys/net/Kconfig.template.log_config.net"

endif # SNTP_LIB

endmenu
```

## subsys/net/lib/srtp/Kconfig
```kconfig
# SPDX-FileCopyrightText: 2026 Sayed Naser Moravej
# SPDX-License-Identifier: Apache-2.0

menuconfig SRTP
	bool "Secure Real-time Transport Protocol (SRTP) [EXPERIMENTAL]"
	select EXPERIMENTAL
	select LIBSRTP
	select RTP
	select RTP_TRANSPORT_SOCKET
	help
	  RFC 3711 Secure Real-time Transport Protocol implementation.

if SRTP

module = SRTP
module-dep = NET_LOG
module-str = Log level for SRTP
module-help = Enable logs for the SRTP stack.
source "subsys/net/Kconfig.template.log_config.net"

config NET_SRTP_KEY
	string "SRTP master key."
	default "c1eec3717da76195bb878578790af71c4ee9f859e197a414a78d5abc7451"
	help
	  This key in hexadecimal which is used by the application. You can override it in prj.conf
	  or via menuconfig / guiconfig.

config SRTP_REPLAY_PROTECTION
	bool "Enable replay protection"
	default y
	help
	  Enable SRTP packet replay protection.

config SRTP_REPLAY_WINDOW_SIZE
	int "Replay protection window size"
	default 64
	range 32 1024
	depends on SRTP_REPLAY_PROTECTION
	help
	  Size of the replay protection window.

config SRTP_MAX_MASTER_KEYS
	int "Maximum number of master keys"
	default 4
	range 1 16
	help
	  Maximum number of master keys stored by the SRTP library.

endif # SRTP
```

## subsys/net/lib/stun/Kconfig
```kconfig
# SPDX-FileCopyrightText: Copyright The Zephyr Project Contributors
# SPDX-FileCopyrightText: Copyright (c) 2026 Kirill Shypachov
# SPDX-License-Identifier: Apache-2.0

menuconfig STUN
	bool "STUN (Session Traversal Utilities for NAT) library [EXPERIMENTAL]"
	select EXPERIMENTAL
	select PSA_CRYPTO
	select CRC
	select UTF8
	imply PSA_WANT_ALG_HMAC
	imply PSA_WANT_KEY_TYPE_HMAC
	imply PSA_WANT_ALG_SHA_1
	imply PSA_WANT_ALG_SHA_256
	help
	  STUN message codec as defined in RFC 8489: parsing and building of
	  messages, the MESSAGE-INTEGRITY and MESSAGE-INTEGRITY-SHA256
	  attributes (computed through the PSA Crypto API), FINGERPRINT and
	  the attributes ICE (RFC 8445) adds. The library does no I/O.

	  Both integrity attributes need HMAC of the PSA Crypto API,
	  MESSAGE-INTEGRITY with SHA-1 and MESSAGE-INTEGRITY-SHA256 with
	  SHA-256. All of it is enabled by default. The functions that
	  compute or verify an attribute return -EIO if the backend lacks
	  what the attribute needs.

if STUN

module = STUN
module-dep = NET_LOG
module-str = Log level for STUN
module-help = Enable the log of the STUN library.
source "subsys/net/Kconfig.template.log_config.net"

endif # STUN
```
