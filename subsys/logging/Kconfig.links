## subsys/logging/frontends/Kconfig
```kconfig
# Copyright (c) 2022 Nordic Semiconductor ASA
# SPDX-License-Identifier: Apache-2.0

menu "Frontends"

config LOG_FRONTEND_DICT_UART
	bool "UART dictionary frontend"
	select LOG_DICTIONARY_SUPPORT
	select MPSC_PBUF
	depends on UART_ASYNC_API || UART_INTERRUPT_DRIVEN
	imply LOG_FMT_SECTION
	imply LOG_FMT_SECTION_STRIP if !LOG_ALWAYS_RUNTIME
	help
	  Frontend sends data in binary dictionary mode.

if LOG_FRONTEND_DICT_UART

config LOG_FRONTEND_DICT_UART_BUFFER_SIZE
	int "Buffer size"
	default 1024
	help
	  Number of bytes dedicated for buffering data

config LOG_FRONTEND_DICT_UART_DROPPED_NOTIFY_PERIOD
	int "Dropped notification period"
	default 500
	help
	  Determines how often a report about dropped messages is printed. Given
	  in milliseconds.

endif

config LOG_FRONTEND_IPC
	bool "IPC service frontend"
	depends on IPC_SERVICE
	select LOG_FRONTEND_OPT_API
	help
	  Frontend sends log messages over IPC service to a remote domain.
	  Requires an IPC instance labeled ipc0 in devicetree.

if LOG_FRONTEND_IPC

config LOG_FRONTEND_IPC_EARLY_BUFFER_SIZE
	int "Early buffer size"
	default 1024
	help
	  Number of bytes dedicated for buffering log messages emitted before the IPC service
	  is ready.

config LOG_FRONTEND_IPC_PACKET_SIZE
	int "Packet size"
	default 256
	help
	  Target size of the IPC service packets.

config LOG_FRONTEND_IPC_MSG_TIMEOUT
	int "Message timeout"
	default 5
	help
	  Timeout in milliseconds after which current buffer with logging messages is sent.
	  Buffer with messages is sent when it is full or when this timeout is reached.

config LOG_FRONTEND_IPC_DROPPED_MSG_TIMEOUT
	int "Dropped message timeout"
	default 1000
	help
	  Timeout in milliseconds after which a report about dropped messages is printed.

config LOG_FRONTEND_IPC_STRING_ACCESS
	bool "Main core has access to local RO strings"
	help
	  Enable if core that processes messages has access to local read-only strings.
	  It allows to reduce processing and message size as read-only strings are not copied
	  into the IPC message.

endif

config LOG_FRONTEND_STMESP
	bool "Coresight STM frontend"
	depends on DT_HAS_ARM_STMESP_ENABLED
	imply ARM_ON_ENTER_CPU_IDLE_HOOK if LOG_FRONTEND_STMESP_FLUSH_COUNT > 0
	imply CBPRINTF_RV32E_USE_DEFAULT_ALIGNMENT if RISCV

if LOG_FRONTEND_STMESP

config LOG_FRONTEND_STMESP_DICT
	bool
	default y if !LOG_FRONTEND_STMESP_FSC
	select LOG_FRONTEND_OPT_API
	select LOG_DICTIONARY_DB
	imply LOG_FMT_SECTION
	imply LOG_FMT_SECTION_STRIP

config LOG_FRONTEND_STMESP_FSC
	bool "Send fully self-contained messages"
	select LOG_MSG_APPEND_RO_STRING_LOC if !(DEBUG_NRF_ETR || \
			SOC_NRF54H20_CPUPPR || SOC_NRF54H20_CPUFLPR)

config LOG_FRONTEND_STMESP_FLUSH_COUNT
	int "Number of flushing words"
	default 4
	help
	  Before going to sleep CPU shall write to STM some dummy data to ensure
	  that any buffered data goes to TPIU/ETR.

config LOG_FRONTEND_STMESP_EARLY_BUF_SIZE
	int "Buffer size to store early messages"
	default 1024 if DEBUG_NRF_ETR
	default 0
	help
	  Frontend cannot write to STM if it is used with ETR buffer unless ETR is
	  initialized and memory is properly configured (privileges). Data is stored
	  in the buffer and flushed to the STMESP once the pipeline is ready.

config LOG_FRONTEND_STMESP_DICT_VER
	def_int 0

config LOG_FRONTEND_STMESP_TURBO_LOG
	bool "Optimize short_logs"
	select LOG_CUSTOM_HEADER
	default y if (DEBUG_NRF_ETR || SOC_NRF54H20_CPUPPR || SOC_NRF54H20_CPUFLPR) \
		     && LOG_FRONTEND_STMESP_FSC
	help
	  When enabled, then logging messages with 0 and 1 numeric argument are
	  optimized and handled much faster than others.

config LOG_FRONTEND_STMESP_TURBO_DROP_OTHERS
	bool "Drop all logs except turbo logs"
	help
	  Option can be enabled for memory constraint cases to remove all logging
	  related code except turbo logs.

config LOG_FRONTEND_STMESP_TURBO_LOG_BASE
	def_int 32768

config LOG_FRONTEND_STPESP_TURBO_SOURCE_PORT_ID
	def_int 65535
	depends on LOG_FRONTEND_STMESP_TURBO_LOG

config LOG_FRONTEND_STMESP_GUARANTEED_ACCESS
	bool "Use STMESP guaranteed access"
	help
	  When enabled, accessing STMESP registers will stall if write cannot be
	  performed (e.g. ETR buffer is full).

config LOG_FRONTEND_STMESP_MSG_END_TIMESTAMP
	bool "Generate timestamp and marker at message end"
	help
	  Generate a zero data byte with timestamp and marker at message end,
	  instead of generating a timestamp and marker at message start and
	  a flag at end. This can be used to maintain compatibility with
	  certain decoders.

endif # LOG_FRONTEND_STMESP

config LOG_FRONTEND_STMESP_DEMUX
	bool "Demultiplexer of logging packets from STM stream"
	select MPSC_PBUF
	help
	  Module demultiplexes messages encoded in STPv2 stream. Messages may
	  be interleaved because they may come from multiple cores (majors).
	  There are 3 types of messages: logging, tracepoints and HW events.

if LOG_FRONTEND_STMESP_DEMUX

config LOG_FRONTEND_STMESP_DEMUX_ACTIVE_PACKETS
	int "Active packets"
	default 12

config LOG_FRONTEND_STMESP_DEMUX_BUFFER_SIZE
	int "Buffer size"
	default 1024

config LOG_FRONTEND_STMESP_DEMUX_MAX_UTILIZATION
	bool "Track maximum utilization"

config LOG_FRONTEND_STMESP_DEMUX_GC_TIMEOUT
	int "Message timeout (in milliseconds)"
	default 100
	help
	  If log message is not completed within that time frame it is discarded.

endif # LOG_FRONTEND_STMESP_DEMUX

config LOG_FRONTEND_STMESP_FLUSH_PORT_ID
	def_int 0
	depends on LOG_FRONTEND_STMESP_DEMUX || LOG_FRONTEND_STMESP

config LOG_FRONTEND_STMESP_TP_CHAN_BASE
	def_int 255
	depends on LOG_FRONTEND_STMESP_DEMUX || LOG_FRONTEND_STMESP
	help
	  Do not change this value as it is aligned with host decoder (nrfutil trace).


endmenu
```

## subsys/lorawan/lora-basics-modem/Kconfig
```kconfig
# Copyright (c) 2026 RAKwireless Technology Limited
# SPDX-License-Identifier: Apache-2.0

if LORA_MODULE_BACKEND_LORA_BASICS_MODEM

config LORAWAN_LBM
	bool
	default y
	depends on LORA_BASICS_MODEM_CORE
	help
	  Hidden symbol enabling the LoRa Basics Modem LoRaWAN backend. The
	  modem core carries the stack this backend calls into, and turns
	  itself on alongside LoRaWAN.

config LORAWAN_LBM_ENGINE_STACK_SIZE
	int "Engine thread stack size"
	default 4096

config LORAWAN_LBM_ENGINE_PRIORITY
	int "Engine thread priority"
	default 5

config LORAWAN_LBM_ENGINE_START_DELAY_MS
	int "Engine thread start delay in milliseconds"
	default 0
	help
	  Delay before the engine thread runs. Raise it to keep the modem off
	  the bus until a console that only comes up after boot, such as CDC
	  ACM, is ready to carry the log.

config LORAWAN_LBM_ENGINE_MAX_SLEEP_MS
	int "Longest the engine thread sleeps between runs"
	default 1000
	help
	  Upper bound on the wait the modem engine asks for. The engine names
	  a time and expects an interrupt to wake it sooner, so a wake-up that
	  never arrives would otherwise park it for as long as it asked, which
	  can be days. Running it again this often costs power but keeps a
	  missed wake-up from stalling the stack.

config LORAWAN_LBM_START_TIMEOUT_S
	int "Seconds to wait for the modem to come up in lorawan_start()"
	default 10

config LORAWAN_LBM_JOIN_TIMEOUT_S
	int "Seconds to wait for a join to settle"
	default 120

config LORAWAN_LBM_TX_TIMEOUT_S
	int "Seconds to wait for an uplink to settle"
	default 120

endif # LORA_MODULE_BACKEND_LORA_BASICS_MODEM
```

## subsys/lorawan/native/Kconfig
```kconfig
# Native LoRaWAN backend configuration
#
# Copyright (c) 2026 Carlo Caione <ccaione@baylibre.com>
# SPDX-License-Identifier: Apache-2.0

if LORA_MODULE_BACKEND_NATIVE

config LORAWAN_NATIVE
	bool
	default y
	select PSA_CRYPTO
	select PSA_WANT_ALG_CMAC
	select PSA_WANT_ALG_ECB_NO_PADDING
	select PSA_WANT_KEY_TYPE_AES
	help
	  Hidden config to enable native LoRaWAN backend specific options.

config LORAWAN_NATIVE_ENGINE_STACK_SIZE
	int "Engine thread stack size"
	default 4096
	help
	  Stack size for the native LoRaWAN engine thread.

config LORAWAN_NATIVE_ENGINE_PRIORITY
	int "Engine thread priority"
	default 2
	help
	  Priority for the native LoRaWAN engine thread.

config LORAWAN_NATIVE_RX_SETUP_MARGIN_MS
	int "Receive window setup margin in milliseconds"
	default 400 if LORA_RUI3
	default 50
	range 1 1000
	help
	  How long before a receive window the stack wakes to put the radio
	  into reception, which has to cover the time the driver needs to
	  apply the window's parameters. A radio on SPI is ready in well
	  under a millisecond; one reached over an AT command interface
	  spends a command exchange on each setting it has to change, and
	  the RUI3 modem was measured at 118 ms for a window. The upper
	  bound is the shortest receive delay a device negotiates, 1 s.

config LORAWAN_NATIVE_PUBLIC_NETWORK
	bool "LoRaWAN Public Network"
	default y
	help
	  Enable this option to use a public LoRaWAN network.
	  Disable for private LoRaWAN networks.

endif # LORA_MODULE_BACKEND_NATIVE

rsource "region/Kconfig"
```

## subsys/lorawan/nvm/Kconfig
```kconfig
# LoRaWAN Non Volatile Memory configuration options

# Copyright (c) 2022 Intellinium <giuliano.franchetto@intellinium.com>
# SPDX-License-Identifier: Apache-2.0

config LORAWAN_NVM_SETTINGS_SUPPORTED
	bool
	help
	  Selected by LoRaWAN backends that can persist their state through
	  the Settings-based NVM interface.

choice LORAWAN_NVM
	bool "LoRaWAN NVM backend"
	default LORAWAN_NVM_SETTINGS if SETTINGS
	default LORAWAN_NVM_NONE

config LORAWAN_NVM_NONE
	bool "No NVM backend for LoRaWAN"
	help
	  If this configuration is used, it is the responsibility of the
	  application to store and restore the DevNonce value each time
	  a OTAA join request is sent. This value should be used in the
	  join configuration directly.

config LORAWAN_NVM_SETTINGS
	bool "Settings based NVM"
	depends on SETTINGS
	depends on LORAWAN_NVM_SETTINGS_SUPPORTED
	help
	  Persist the LoRaWAN backend's records using Settings. The backend
	  defines which state is stored and when it is restored or updated.

endchoice
```
