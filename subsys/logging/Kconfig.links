## subsys/mgmt/mcumgr/grp/transport_mgmt/Kconfig
```kconfig
# Copyright Nordic Semiconductor ASA 2025-2026. All rights reserved.
# SPDX-License-Identifier: Apache-2.0

menuconfig MCUMGR_GRP_TRANSPORT
	bool "MCUmgr handlers for transport management [EXPERIMENTAL]"
	select MCUMGR_SMP_CBOR_MIN_DECODING_LEVEL_2
	select MCUMGR_SMP_CBOR_MIN_ENCODING_LEVEL_3 if ZCBOR_CANONICAL
	select MCUMGR_SMP_CBOR_MIN_ENCODING_LEVEL_2
	select EXPERIMENTAL
	help
	  Enables MCUmgr handlers for transport management.

if MCUMGR_GRP_TRANSPORT

config MCUMGR_GRP_TRANSPORT_LOCKING
	bool "Semaphore locking"
	default y
	help
	  If enabled, will prevent concurrent access of bridge variables with a semaphore. Can be
	  disabled to reduce resource usage on systems where there will not be any concurrent
	  resource usage.

config MCUMGR_GRP_TRANSPORT_MAX_BRIDGES
	int "Maximum bridges"
	default 1
	range 1 128
	help
	  The maximum number of concurrent bridges to support.

	  Note that this is for the bridge infrastructe itself, individual transports may have
	  lower limits on maximum numbers of concurrent bridges.

choice MCUMGR_GRP_TRANSPORT_GROUP_ID_TYPE
	prompt "Group ID type"
	default MCUMGR_GRP_TRANSPORT_GROUP_ID_DEFAULT
	help
	  Specifies how the MCUmgr command group ID is defined.

config MCUMGR_GRP_TRANSPORT_GROUP_ID_DEFAULT
	bool "Default"
	help
	  Uses the global default transport group ID, which is universally compatible.

config MCUMGR_GRP_TRANSPORT_GROUP_ID_CUSTOM_VALUE
	bool "Specify custom value"
	help
	  A Kconfig value will be used to set the transport group ID, which is custom to an
	  application or device.

if MCUMGR_GRP_TRANSPORT_GROUP_ID_CUSTOM_VALUE

config MCUMGR_GRP_TRANSPORT_GROUP_ID_CUSTOM_VALUE_GROUP_ID
	int "Group ID"
	range 64 65535
	help
	  The group index to use for the transport management group.

endif # MCUMGR_GRP_TRANSPORT_GROUP_ID_CUSTOM_VALUE

config MCUMGR_GRP_TRANSPORT_GROUP_ID_CUSTOM_FUNCTION
	bool "Get from custom function"
	help
	  A function's return value will be used to set the transport group ID, which is custom
	  to an application or device.

endchoice

config MCUMGR_GRP_TRANSPORT_INFO_FUNCTIONS
	bool
	prompt "Info functions" if !MCUMGR_GRP_TRANSPORT_GROUP_ID_DEFAULT
	default y
	help
	  Disabling this will remove the information functions which frees up resources on
	  devices where the transport layout is static or already known, meaning that this will no
	  longer comply with the transport management group specification, hence why it can only
	  be disabled when using a custom group ID.

endif # MCUMGR_GRP_TRANSPORT
```

## subsys/mgmt/mcumgr/transport/Kconfig.ethernet
```kconfig
# Copyright (c) 2026 Aleksandr Senin
# SPDX-License-Identifier: Apache-2.0

# The Kconfig file is dedicated to the raw Ethernet transport of the MCUmgr
# subsystem and provides Kconfig options to control aspects of the transport.
#
# Options defined in this file should be prefixed:
#  MCUMGR_TRANSPORT_ETHERNET_

menuconfig MCUMGR_TRANSPORT_ETHERNET
	bool "Raw Ethernet MCUmgr SMP transport [EXPERIMENTAL]"
	depends on NET_L2_ETHERNET
	select EXPERIMENTAL
	help
	  Enable the experimental raw Ethernet SMP transport. Each SMP packet
	  is carried in one Ethernet frame with the configured EtherType,
	  without IP encapsulation. Unicast requests are accepted on any
	  Ethernet interface. Replies use the receiving interface's MAC address
	  and are sent to the sender.
	  Broadcast and multicast requests are dropped regardless of the
	  interface's hardware MAC filter configuration.
	  Any host on the same Ethernet segment can send requests to this
	  transport. The transport does not provide authentication.

if MCUMGR_TRANSPORT_ETHERNET

config MCUMGR_TRANSPORT_ETHERNET_ETHERTYPE
	hex "EtherType used for SMP frames"
	range 0x0000 0xFFFF
	default 0x0000
	help
	  Set the EtherType explicitly to a value in 0x0600 through 0xFFFF.
	  Zero is an unset value and causes a build error. This numeric range
	  is not a pool of freely available identifiers; use an EtherType
	  assigned for the protocol in production deployments.
	  For development on a controlled experimental network, 0x88B5 and
	  0x88B6 are IEEE Local Experimental EtherTypes. These values must not
	  be used in shipped products. The sample uses 0x88B5. Configure the
	  host client to use the same EtherType as the device.

config MCUMGR_TRANSPORT_ETHERNET_AUTOMATIC_INIT
	bool "Ethernet SMP autostart"
	default y
	help
	  Enable starting the Ethernet SMP transport at boot time without
	  needing any code in the application to do this, otherwise will need
	  the user application to manually start and stop the transport using
	  `smp_ethernet_open` and `smp_ethernet_close`.

endif # MCUMGR_TRANSPORT_ETHERNET
```

## subsys/mgmt/mcumgr/transport/Kconfig.i2c
```kconfig
#
# Copyright (c) 2026 Aerlync Labs Inc.
#
# SPDX-License-Identifier: Apache-2.0
#

menuconfig MCUMGR_TRANSPORT_I2C
	bool "I2C MCUmgr SMP transport"
	depends on MULTITHREADING && I2C && I2C_TARGET && DT_HAS_ZEPHYR_SMP_I2C_ENABLED
	select MCUMGR_TRANSPORT_REASSEMBLY
	help
	  Enable MCUmgr SMP transport over I2C. The device operates as an I2C
	  target and exchanges raw SMP packets. The packet length is taken from
	  the SMP header. A request can be split over several I2C writes, which
	  are chained together up to MCUMGR_TRANSPORT_NETBUF_SIZE. An optional
	  data-ready GPIO (data-ready-gpios in DTS) signals the controller when
	  a response is available.

	  The GPIO is optional. If data-ready-gpios is omitted the controller
	  polls by reading the SMP header until it is non-empty.

	  A response is read back in a single I2C transaction, so in buffer mode
	  the I2C target driver's own buffer must be large enough for the
	  largest response. The sizing note is in
	  doc/services/device_mgmt/smp_transport.rst.

if MCUMGR_TRANSPORT_I2C

config MCUMGR_TRANSPORT_I2C_REASSEMBLY_TIMEOUT_MS
	int "I2C incomplete request timeout (ms)"
	range 100 60000
	default 1000
	help
	  A request that is split over several I2C writes is dropped if the rest
	  of it does not arrive within this time, for example because the
	  controller rebooted or the data was corrupt. Without this, the stale
	  data would stay in the buffer and the next request would be appended
	  to it.

endif # MCUMGR_TRANSPORT_I2C

menuconfig MCUMGR_TRANSPORT_I2C_CLIENT
	bool "I2C controller MCUmgr SMP transport"
	depends on MULTITHREADING && I2C && SMP_CLIENT && DT_HAS_ZEPHYR_SMP_I2C_CLIENT_ENABLED
	help
	  Enable MCUmgr SMP transport over I2C in controller mode. The device
	  operates as an I2C controller and communicates with a remote target
	  running zephyr,smp-i2c.

if MCUMGR_TRANSPORT_I2C_CLIENT

config MCUMGR_TRANSPORT_I2C_CLIENT_POLL_MS
	int "I2C client poll interval (ms)"
	depends on $(dt_compat_any_not_has_prop,$(DT_COMPAT_ZEPHYR_SMP_I2C_CLIENT),data-ready-gpios)
	default 5
	help
	  Interval between SMP header polling reads. Only used when the node has
	  no data-ready GPIO.

config MCUMGR_TRANSPORT_I2C_CLIENT_POLL_RETRIES
	int "I2C client poll retries"
	depends on $(dt_compat_any_not_has_prop,$(DT_COMPAT_ZEPHYR_SMP_I2C_CLIENT),data-ready-gpios)
	default 1000
	help
	  Maximum polling attempts before timing out (e.g. during target flash erase).
	  Only used when the node has no data-ready GPIO.

config MCUMGR_TRANSPORT_I2C_CLIENT_DRDY_TIMEOUT_MS
	int "I2C client DRDY timeout (ms)"
	depends on $(dt_compat_any_has_prop,$(DT_COMPAT_ZEPHYR_SMP_I2C_CLIENT),data-ready-gpios)
	default 5000
	help
	  Maximum wait time in milliseconds for the DRDY GPIO interrupt. Only used
	  when the node has a data-ready GPIO.

endif # MCUMGR_TRANSPORT_I2C_CLIENT
```

## subsys/mgmt/mcumgr/transport/Kconfig.raw_uart
```kconfig
# Copyright Runtime.io 2018. All rights reserved.
# Copyright Nordic Semiconductor ASA 2020-2026. All rights reserved.
# SPDX-License-Identifier: Apache-2.0

# The Kconfig file is dedicated to the raw UART transport of the MCUmgr subsystem and provides
# Kconfig options to control aspects of the transport.
#
# Options defined in this file should be prefixed with:
#  MCUMGR_TRANSPORT_RAW_UART_

menuconfig MCUMGR_TRANSPORT_RAW_UART
	bool "Raw UART (non-SMP over console) MCUmgr transport"
	depends on CONSOLE
	depends on UART_MCUMGR
	select MCUMGR_TRANSPORT_SERIAL_HAS_RAW_BINARY_NON_SMP_OVER_CONSOLE
	help
	  Enables handling of MCUmgr commands received over UART, which are not encoded in the SMP
	  over console format (without additional fields or base64 encoding). This is an even
	  lighter-weight alternative to CONFIG_MCUMGR_TRANSPORT_UART. It allows MCUmgr commands
	  to be received over a binary (non-textual) UART without requiring an additional thread.

	  The transport runs on the UART of each enabled zephyr,smp-uart-raw devicetree node.
	  When no zephyr,smp-uart or zephyr,smp-uart-raw node of an enabled transport exists, it
	  runs on the zephyr,uart-mcumgr chosen UART if UART_MCUMGR_RAW_PROTOCOL is enabled. It
	  can be enabled together with MCUMGR_TRANSPORT_UART.

if MCUMGR_TRANSPORT_RAW_UART

config MCUMGR_TRANSPORT_RAW_UART_INPUT_TIMEOUT
	bool "Input expiration"
	help
	  If enabled, will time out a partial or erroneous MCUmgr command received via the raw
	  UART transport after a given time. This prevents the UART from becoming locked if it
	  never receives the full packet that it was expecting to receive.

config MCUMGR_TRANSPORT_RAW_UART_INPUT_TIMEOUT_TIME_MS
	int "Input expiration timeout"
	depends on MCUMGR_TRANSPORT_RAW_UART_INPUT_TIMEOUT
	default 3000
	help
	  Time (in msec) after first receiving data on the UART transport before considering it
	  as timed out and clearing the receive buffer to await a new command.

endif # MCUMGR_TRANSPORT_RAW_UART
```

## subsys/mgmt/mcumgr/transport/Kconfig.shell
```kconfig
# Copyright Runtime.io 2018. All rights reserved.
# Copyright Nordic Semiconductor ASA 2020-2022. All rights reserved.
# SPDX-License-Identifier: Apache-2.0

# The Kconfig file is dedicated to shell transport of MCUmgr
# subsystem and provides Kconfig options to control aspects of
# the transport.
#
# Options defined in this file should be prefixed:
#  MCUMGR_TRANSPORT_SHELL_

menuconfig MCUMGR_TRANSPORT_SHELL
	bool "Shell MCUmgr SMP transport"
	depends on SHELL
	depends on BASE64
	depends on CRC
	select MCUMGR_TRANSPORT_SERIAL_HAS_SMP_OVER_CONSOLE
	help
	  Enables handling of SMP commands received over shell. This allows the shell to be use
	  for both MCUmgr commands and shell commands.

if MCUMGR_TRANSPORT_SHELL

config MCUMGR_TRANSPORT_SHELL_MTU_DEPRECATED
	bool
	default y if MCUMGR_TRANSPORT_SHELL_MTU != 256
	select DEPRECATED
	help
	  Indicates that MCUMGR_TRANSPORT_SHELL_MTU has been changed from its default. The option
	  is deprecated.

config MCUMGR_TRANSPORT_SHELL_MTU
	int "Shell SMP MTU [DEPRECATED]"
	default 256
	help
	  Value returned by the shell transport's get_mtu callback. This option is deprecated along
	  with that callback, which the SMP layer does not use. SMP over console frames are limited
	  to 127 bytes and the maximum SMP packet size is set by MCUMGR_TRANSPORT_NETBUF_SIZE.

config MCUMGR_TRANSPORT_SHELL_RX_BUF_COUNT
	int "Shell SMP RX buffer count"
	default 2
	help
	  Number of buffers used for receiving SMP fragments over shell.

config MCUMGR_TRANSPORT_SHELL_INPUT_TIMEOUT
	bool "Shell input expiration"
	help
	  If enabled, will time out a partial or erroneous MCUmgr command received via the shell
	  transport after a given time. This prevents the shell from becoming locked if it never
	  receives the full packet that a header indicated it would receive.

config MCUMGR_TRANSPORT_SHELL_INPUT_TIMEOUT_TIME
	int "Shell input expiration timeout"
	depends on MCUMGR_TRANSPORT_SHELL_INPUT_TIMEOUT
	default 3000
	help
	  Time (in msec) after receiving a valid MCUmgr header on the serial transport before
	  considering it as timed out and returning the shell to normal operation.

endif # MCUMGR_TRANSPORT_SHELL
```

## subsys/mgmt/mcumgr/transport/Kconfig.uart
```kconfig
# Copyright Runtime.io 2018. All rights reserved.
# Copyright Nordic Semiconductor ASA 2020-2022. All rights reserved.
# SPDX-License-Identifier: Apache-2.0

# The Kconfig file is dedicated to UART transport of MCUmgr
# subsystem and provides Kconfig options to control aspects of
# the transport.
#
# Options defined in this file should be prefixed:
#  MCUMGR_TRANSPORT_UART_

menuconfig MCUMGR_TRANSPORT_UART
	bool "UART MCUmgr SMP transport"
	depends on CONSOLE
	depends on BASE64
	depends on CRC
	depends on UART_MCUMGR
	depends on !UART_MCUMGR_RAW_PROTOCOL
	select MCUMGR_TRANSPORT_SERIAL_HAS_SMP_OVER_CONSOLE
	help
	  Enables handling of SMP commands received over UART. This is a lightweight alternative
	  to MCUMGR_TRANSPORT_SHELL. It allows MCUmgr commands to be received over UART without
	  requiring an additional thread.

if MCUMGR_TRANSPORT_UART

config MCUMGR_TRANSPORT_UART_MTU_DEPRECATED
	bool
	default y if MCUMGR_TRANSPORT_UART_MTU != 256
	select DEPRECATED
	help
	  Indicates that MCUMGR_TRANSPORT_UART_MTU has been changed from its default. The option
	  is deprecated.

config MCUMGR_TRANSPORT_UART_MTU
	int "UART SMP MTU [DEPRECATED]"
	default 256
	help
	  Value returned by the UART transport's get_mtu callback. This option is deprecated along
	  with that callback, which the SMP layer does not use. SMP over console frames are limited
	  to 127 bytes and the maximum SMP packet size is set by MCUMGR_TRANSPORT_NETBUF_SIZE.

endif # MCUMGR_TRANSPORT_UART
```

## subsys/micro_core/Kconfig
```kconfig
# Copyright (c) 2026 Mahdi Sahebi
# SPDX-License-Identifier: Apache-2.0

menuconfig MC
	bool "Micro Core communication services"
	default n
	help
	  Enable the experimental, heap-free Micro Core communication services.

if MC

config MC_COMM
	bool "Reliable byte communication"
	select CRC
	default y
	help
	  Enable framed, acknowledged byte communication using application-owned
	  storage and application-provided transport callbacks.

config MC_MSG
	bool "ID-based message communication"
	depends on MC_COMM
	default y
	help
	  Enable message IDs, subscriptions, and zero-length signals on top of
	  MC_COMM.

endif
```

## subsys/mp/net/Kconfig
```kconfig
# Copyright 2026 NXP
# SPDX-License-Identifier: Apache-2.0

config MP_NET
	bool "Network plugin support"
	depends on NETWORKING && NET_TCP && NET_SOCKETS
	select NET_IPV4_MAPPING_TO_IPV6 if NET_IPV6
	help
	  Enable the network plugin, which provides TCP server sink and source
	  elements. Each element listens on its own port, accepts one client, and
	  moves pipeline buffers as a raw byte stream.
	  When IPv6 is enabled a single socket serves both IPv4 and IPv6 clients
	  through IPv4-mapped addresses.

if MP_NET

config MP_NET_SINK_PORT
	int "Default TCP port the sink listens on"
	range 1 65535
	default 5000
	help
	  Port tcpsink binds to when the application does not set
	  MP_PROP_NET_SINK_PORT.

config MP_NET_SRC_PORT
	int "Default TCP port the source listens on"
	range 1 65535
	default 5001
	help
	  Port tcpsrc binds to when the application does not set
	  MP_PROP_NET_SRC_PORT.

config MP_NET_SRC_BUF_SIZE
	int "Size of a receive buffer in bytes"
	range 64 65536
	default 4096
	help
	  Size of each buffer in the tcpsrc internal net_buf pool. One recv() call
	  fills at most this many bytes.

config MP_NET_SRC_NUM_BUFS
	int "Number of buffers in the receive pool"
	range 1 255
	default 4
	help
	  Number of buffers in the tcpsrc internal net_buf pool. Use more than one
	  if downstream can retain buffers asynchronously.

endif # MP_NET
```
