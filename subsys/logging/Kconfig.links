## subsys/mpipe/Kconfig
```kconfig
#
# Copyright 2025 NXP
#
# SPDX-License-Identifier: Apache-2.0
#

menuconfig MPIPE
	bool "Multimedia Pipeline framework [EXPERIMENTAL]"
	imply THREAD_NAME
	select NET_BUF
	select ZBUS
	select ZBUS_RUNTIME_OBSERVERS
	# For zbus_runtime_channel_init(), which zbus keeps behind this symbol.
	# mpipe never registers a channel, so the registry code links out.
	select ZBUS_RUNTIME_CHANNEL_REGISTRATION
	select EXPERIMENTAL
	help
	  Build a media stream out of self-contained processing elements linked
	  into a graph, instead of wiring the drivers together by hand.

	  The framework negotiates the data format between neighboring elements,
	  settles the buffer pools, and moves those buffers along the graph under
	  a state machine.

	  This enables the framework only. The elements live in plugins, each
	  behind its own option.

if MPIPE

module = MPIPE
module-str = mpipe
source "subsys/logging/Kconfig.template.log_config"

# ---- Framework options ----

config MPIPE_STRUCTURE_MAX_FIELDS
	int "Maximum fields one caps structure can hold"
	range 1 255
	default 5
	help
	  Number of capability fields a single caps structure can hold at once.
	  Size it for the largest union of fields that can meet in one
	  intersection, not for the number of fields an element sets. An
	  intersection that runs out of slots fails with -ENOSPC.

config MPIPE_THREADS_NUM
	int "Number of streaming threads"
	range 1 255
	default 1
	help
	  Size of the pool of thread stacks the framework draws from. A stack
	  is returned to the pool when its thread terminates and reused by the
	  next one. Count one for each pipeline that can run at the same time,
	  plus one for every queue element.

config MPIPE_THREAD_STACK_SIZE
	int "Stack size of a streaming thread"
	default 1024
	help
	  Stack size in bytes of each streaming thread, of a pipeline or of a
	  queue element. A streaming thread only acquires a buffer and pushes it
	  downstream; capability negotiation runs on the thread that drives the
	  state change, not here.

config MPIPE_THREAD_DEFAULT_PRIORITY
	int "Priority of a streaming thread"
	default 5
	help
	  Zephyr scheduling priority the streaming threads are created with.
	  It should sit above the work the pipeline feeds, so that a source keeps
	  producing while downstream elements consume.

config MPIPE_WORKQUEUE
	bool "Element-level work offload (P4WQ)"
	select SCHED_DEADLINE
	help
	  Let elements offload finite work items, such as a decode or an
	  inference, to a shared P4WQ (Pooled Parallel Preemptible
	  Priority-based Work Queue) thread pool, each item with its own
	  priority.

config MPIPE_WORKQUEUE_THREADS_NUM
	int "Number of threads in mpipe workqueue pool"
	range 1 32
	default 1
	depends on MPIPE_WORKQUEUE
	help
	  Number of threads in the shared P4WQ pool.

config MPIPE_WORKQUEUE_STACK_SIZE
	int "Stack size for mpipe workqueue pool threads"
	default 4096
	depends on MPIPE_WORKQUEUE
	help
	  Stack size in bytes for each thread in the mpipe workqueue pool.

config MPIPE_NET_BUF_POOL_COUNT
	int "Number of buffers in the mpipe shared net_buf pool"
	range 1 1024
	default 1
	help
	  Number of net_buf buffers in the pool shared by every pipeline: the
	  sum of the buffers each pipeline can have in flight at once.

config MPIPE_BIN_MAX_CHILDREN
	int "Maximum number of elements in a bin/pipeline"
	range 2 64
	default 10
	help
	  Maximum number of elements in one bin or pipeline. It sizes the
	  arrays the topological sort uses during a state change.

config MPIPE_FAKE_SRC
	bool "Fake source element"
	help
	  A source that produces buffers of synthetic data bound to no device.

	  It exists so a graph can be built and run where a real source would
	  need hardware, which is what the framework's own tests use it for. It
	  is not meant to be part of an application.

config MPIPE_FAKE_SRC_BUF_SZ
	int "Buffer size of the fake source element (in bytes)"
	range 1 1024
	default 1
	depends on MPIPE_FAKE_SRC
	help
	  Size in bytes of each buffer the fake source produces. The default of
	  one byte is enough to exercise the flow through a graph; raise it when
	  a test needs buffers of a realistic size.

config MPIPE_RPC
	bool "Transform client elements (remote processing)"
	help
	  Build the client-side elements that run their processing on another
	  core instead of locally.

	  A transform client looks like an ordinary element in the graph, but
	  forwards each buffer over a transport to a server on the remote core
	  and waits for the result. The transport itself is not provided here:
	  the application supplies it through the element's RPC hooks.

# ---- ZBus defaults for MPIPE ----
# The framework allocates nothing, so the bus underneath it must not either.
# mpipe_bin.c refuses to build if a dynamic choice wins anyway.

config ZBUS_PREFER_DYNAMIC_ALLOCATION
	default n

config ZBUS_MSG_SUBSCRIBER_NET_BUF_STATIC_DATA_SIZE
	depends on ZBUS_MSG_SUBSCRIBER_BUF_ALLOC_STATIC
	default 24

config ZBUS_MSG_SUBSCRIBER_NET_BUF_POOL_SIZE
	depends on ZBUS_MSG_SUBSCRIBER
	default 4

# ---- Plugins and utilities ----
# Each plugin/utility directory ships its own Kconfig, guarded by its own
# CONFIG_MPIPE_* option. Adding a new plugin needs no change to this file.
osource "subsys/mpipe/*/Kconfig"

endif # MPIPE
```

## subsys/mpipe/aud/Kconfig
```kconfig
#
# Copyright 2025 NXP
#
# SPDX-License-Identifier: Apache-2.0
#

config MPIPE_AUD
	bool "Audio plugin support"
	select AUDIO
	help
	  Elements that capture, process and play back PCM audio: a digital
	  microphone source, a gain transform, and a sink driving an audio codec
	  over I2S.

	  They sit on Zephyr's audio APIs and describe what they carry as a
	  sample rate, a sample width, a channel count and the layout of those
	  channels within a buffer.

if MPIPE_AUD

config MPIPE_AUD_BUFFER_POOL_SZ_MAX
	int "Size of the largest buffer in the buffer pool"
	default 98304
	help
	  Size in bytes of the largest buffer the audio pool can hand out. It
	  bounds one block of PCM, so it follows from the sample rate, the sample
	  width, the channel count and how much time one buffer covers.

	  The default holds roughly half a second of 48 kHz 16-bit stereo, or a
	  full second of the same in mono. Reserved
	  memory, so lower it when the pipeline's format is known and smaller.

config MPIPE_AUD_BUFFER_POOL_NUM_MAX
	int "Number of maximum sized buffers in the buffer pool"
	default 10
	help
	  Upper bound on how many buffers the audio pool provides. Negotiation
	  settles the number actually used, and this caps what it may ask for.

	  Audio needs more slack than video: a codec starved of data produces an
	  audible artifact rather than a dropped frame, so leave enough for the
	  sink to keep its buffers primed.

config MPIPE_AUD_I2S_CODEC_SINK_SET_OUTPUT_VOLUME
	bool "Set codec output volume in the I2S codec sink"
	help
	  When enabled, the I2S codec sink programs the codec output volume
	  after configuring it. Without this, the codec keeps its driver
	  default (typically 0 dB / unity), which can overdrive the analog
	  output stage and sound distorted on boards with a fixed line/speaker
	  amplifier.

config MPIPE_AUD_I2S_CODEC_SINK_OUTPUT_VOLUME
	int "Codec output volume (codec-specific units)"
	default 106
	depends on MPIPE_AUD_I2S_CODEC_SINK_SET_OUTPUT_VOLUME
	help
	  Output volume value passed to audio_codec_set_property() as the
	  AUDIO_PROPERTY_OUTPUT_VOLUME for AUDIO_CHANNEL_ALL. The units are
	  codec specific. For the WM8962 the field is 7 bits where 121 (0x79)
	  is 0 dB, each step is 1 dB and values up to and including 47 (0x2F)
	  mute the output. The default of 106 is approximately -15 dB.

endif # MPIPE_AUD
```

## subsys/mpipe/base/Kconfig
```kconfig
#
# Copyright 2026 NXP
#
# SPDX-License-Identifier: Apache-2.0
#

config MPIPE_BASE
	bool "Base elements"
	help
	  Media-agnostic elements that shape a graph rather than its data: a caps
	  filter that constrains what a link may carry, a tee that splits a graph
	  into branches, a queue that splits it across threads, and the
	  application source and sink that let the application inject data
	  into a graph and receive what comes out of it.

if MPIPE_BASE

config MPIPE_BASE_APP_SINK
	bool "Application sink element"
	help
	  Enable the app_sink element which hands the buffers reaching the
	  end of a pipeline to the application, through a callback or a
	  pull API.

config MPIPE_BASE_APP_SINK_QUEUE_DEPTH
	int "Buffers the app_sink can hold for pulling"
	range 1 32
	default 2
	depends on MPIPE_BASE_APP_SINK
	help
	  Number of buffers queued for mpipe_app_sink_pull() when no callback
	  is set. A buffer arriving on a full queue is dropped.

config MPIPE_BASE_APP_SRC
	bool "Application source element"
	help
	  Enable the app_src element which lets the application inject data
	  into a pipeline: payloads are pushed at the application's pace
	  and end of stream is declared explicitly.

config MPIPE_BASE_APP_SRC_POOL_NUM
	int "Number of buffers of the app_src pool"
	range 1 32
	default 2
	depends on MPIPE_BASE_APP_SRC
	help
	  Number of buffers in the pool shared by every app_src element: the
	  pushed payloads that can be in flight at once.

config MPIPE_BASE_APP_SRC_BUF_SZ
	int "Buffer size of the app_src element (in bytes)"
	range 1 262144
	default 1024
	depends on MPIPE_BASE_APP_SRC
	help
	  Upper bound of one pushed payload; sizes the static buffer pool.

config MPIPE_BASE_APP_SRC_QUEUE_DEPTH
	int "Payloads the app_src can queue ahead"
	range 1 32
	default 2
	depends on MPIPE_BASE_APP_SRC
	help
	  Number of pushed payloads waiting for the pipeline thread before a
	  push blocks.

config MPIPE_BASE_CAPS_FILTER
	bool "Caps filter element"
	help
	  Enable the caps_filter element, which constrains the format
	  negotiated on the link it sits on.

config MPIPE_BASE_QUEUE
	bool "Queue element (for pipeline-level threading)"
	help
	  Enable the queue element, which runs the elements downstream of it
	  on a thread of its own, counted in MPIPE_THREADS_NUM. A full queue
	  holds the producer by default; a leak policy drops the oldest or the
	  arriving buffer instead.

config MPIPE_BASE_QUEUE_MAX_SIZE
	int "Max size of a queue element"
	range 1 255
	default 2
	depends on MPIPE_BASE_QUEUE
	help
	  Upper bound of the number of buffers a queue element holds, set per
	  element with its size property; also the default.

config MPIPE_BASE_TEE
	bool "Tee element"
	help
	  Enable the tee element which splits a single input branch
	  into multiple output branches.

config MPIPE_BASE_TEE_MAX_SRC_PADS_NUM
	int "Maximum number of source pads of a tee element"
	range 2 8
	default 2
	depends on MPIPE_BASE_TEE
	help
	  Upper bound of the number of source pads of a tee element, set per
	  element with its property. Storage is reserved for all of them.

endif # MPIPE_BASE
```

## subsys/mpipe/disp/Kconfig
```kconfig
#
# Copyright 2025 NXP
#
# SPDX-License-Identifier: Apache-2.0
#

config MPIPE_DISP
	bool "Display plugin support"
	select DISPLAY
	help
	  The sink element that puts frames on a screen, terminating a video
	  graph.

	  What it accepts comes from the panel rather than from the element: its
	  capabilities are enumerated from the display's own pixel formats and
	  resolution. A graph ending here therefore usually needs a converter in
	  front of it, unless the source already produces what the panel takes.
```
