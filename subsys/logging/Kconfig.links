## subsys/mgmt/bmc/Kconfig
```kconfig
# SPDX-FileCopyrightText: Copyright (c) 2025-2026 Tenstorrent USA, Inc.
# SPDX-FileCopyrightText: Copyright The Zephyr Project Contributors
# SPDX-License-Identifier: Apache-2.0

menuconfig BMC
	bool "Baseboard Management Controller (BMC)"
	depends on NETWORKING
	select NET_CONFIG_SETTINGS
	select NET_HOSTNAME_ENABLE
	select NET_HOSTNAME_DYNAMIC
	select REBOOT
	help
	  Enable the BMC subsystem, a set of building blocks for managing a
	  host system: network configuration, host power control, a sensor
	  registry, a captured host console and a Redfish service.

	  The subsystem provides mechanism only. Product policy such as
	  branding, the web dashboard, the board GPIO map and the reported
	  identity is supplied by the application through the registration
	  APIs in include/zephyr/mgmt/bmc/.

if BMC

module = BMC
module-str = BMC
source "subsys/logging/Kconfig.template.log_config"

config BMC_ADMIN_USER
	string "Administrator user name"
	default "admin"
	help
	  User name accepted by the built-in authentication backend.

config BMC_DEFAULT_ADMIN_PASSWORD
	string "Default administrator password"
	default "changeme"
	help
	  Password accepted by the built-in authentication backend until it is
	  changed at runtime. Products are expected to override this, or to
	  register their own backend with bmc_auth_ops_register().

config BMC_DEFAULT_ADMIN_PASSWORD_UNCHANGED
	bool
	default y if BMC_DEFAULT_ADMIN_PASSWORD = "changeme"
	help
	  Hidden helper that lets the build warn about the placeholder
	  administrator password.

config BMC_DEFAULT_HOSTNAME
	string "Default host name"
	default "bmc"

config BMC_DEFAULT_USE_DHCP4
	bool "Use DHCPv4 by default"
	depends on NET_IPV4
	default y

config BMC_DEFAULT_IPV4_ADDRESS
	string "Default static IPv4 address"
	depends on NET_IPV4
	default "0.0.0.0"

config BMC_DEFAULT_IPV4_SUBNET_MASK
	string "Default static IPv4 subnet mask"
	depends on NET_IPV4
	default "0.0.0.0"

config BMC_DEFAULT_IPV4_GATEWAY
	string "Default static IPv4 gateway"
	depends on NET_IPV4
	default "0.0.0.0"

config BMC_DEFAULT_NTP_SERVER
	string "Default NTP server"
	default "pool.ntp.org"

config BMC_DEFAULT_HOST_AUTO_POWERON
	bool "Power the host on by default when the BMC boots"

config BMC_UUID
	bool "Derive the BMC UUID from the hardware device ID"
	default y
	depends on HWINFO
	select MBEDTLS
	select PSA_CRYPTO
	select MBEDTLS_PSA_CRYPTO_C
	select PSA_WANT_ALG_SHA_1
	select UUID
	select UUID_V5
	help
	  Without this the BMC reports the nil UUID.

config BMC_UUID_NS
	string
	default "6ae4c3c7-fff0-472a-a77c-6f3f5a09ee7c"
	help
	  Namespace the per-device UUID is generated from. Changing this
	  changes the UUID of every device.

config BMC_SETTINGS
	bool "Persist the BMC configuration"
	default y
	depends on SETTINGS
	help
	  Store the runtime configuration in the settings subsystem, under the
	  "bmc/" tree. Without this the configuration is reset to the Kconfig
	  defaults on every boot.

	  The application selects the settings backend, so any of NVS, ZMS,
	  FCB or FILE can be used.

config BMC_DNS_RESOLVE
	bool "Resolve host names"
	select DNS_RESOLVER
	select NET_SOCKETS_SERVICE
	select NET_DHCPV4_OPTION_DNS_ADDRESS if NET_DHCPV4
	select DNS_SERVER_IP_ADDRESSES
	select DNS_RECONFIGURE_CLEANUP
	help
	  Needed to reach an NTP server given by name.

config BMC_NTP
	bool "Synchronise the clock over NTP"
	default y
	select SNTP
	select BMC_DNS_RESOLVE

if BMC_NTP

config BMC_DEFAULT_USE_NTP
	bool "Use NTP by default"
	default y

config BMC_NTP_THREAD_STACK_SIZE
	int "NTP thread stack size"
	default 2048

config BMC_NTP_THREAD_PRIORITY
	int "NTP thread priority"
	default 10

endif # BMC_NTP

config BMC_RTC
	bool "Keep a real time clock in sync with the system clock"
	default y
	depends on RTC
	depends on $(dt_alias_enabled,bmc-rtc) || $(dt_nodelabel_enabled,rtc)

config BMC_RTC_DEFAULT_YEAR
	int "Year the clock starts at when the RTC is not set"
	default 2026
	depends on BMC_RTC
	help
	  A plausible time keeps TLS certificate validity checks from failing
	  before NTP has had a chance to run.

config BMC_HOST_GPIO
	bool "Control the host over GPIOs"
	default y
	depends on GPIO
	depends on $(dt_alias_enabled,bmc-host-power)
	help
	  Register the built-in GPIO backend for the host control operations,
	  driven by the bmc-host-power, bmc-host-power-2, bmc-host-reset and
	  bmc-status-led devicetree aliases.

	  An application that talks to its host differently leaves this off and
	  calls bmc_host_ops_register() instead.

if BMC_HOST_GPIO

config BMC_HOST_GPIO_RESET_PULSE_MS
	int "Length of the host reset pulse in milliseconds"
	default 100

config BMC_HOST_GPIO_HEARTBEAT
	bool "Blink the status LED while the BMC is running"
	default y
	depends on $(dt_alias_enabled,bmc-status-led)

config BMC_HOST_GPIO_HEARTBEAT_PERIOD_MS
	int "Status LED blink period in milliseconds"
	default 1000
	depends on BMC_HOST_GPIO_HEARTBEAT

endif # BMC_HOST_GPIO

config BMC_RESET_BUTTON
	bool "Reset the configuration from a button"
	default y
	depends on GPIO
	depends on $(dt_alias_enabled,bmc-reset-button)
	help
	  Hold the button to erase the stored configuration and reboot.

config BMC_RESET_BUTTON_HOLD_MS
	int "How long the reset button has to be held, in milliseconds"
	default 3000
	depends on BMC_RESET_BUTTON

config BMC_SENSORS
	bool "Sensor registry"
	default y
	select SENSOR
	help
	  Let the application publish sensors with BMC_SENSOR_DEFINE() and
	  report them over Redfish and the shell.

config BMC_HTTP
	bool "HTTP service"
	default y
	select HTTP_SERVER
	help
	  Run an HTTP server the BMC and the application attach resources to.

if BMC_HTTP

config BMC_HTTP_PORT
	int "HTTP port"
	default 80

config BMC_HTTP_CONCURRENT
	int "Concurrent connections per service"
	default HTTP_SERVER_MAX_CLIENTS
	range 1 HTTP_SERVER_MAX_CLIENTS

config BMC_HTTP_BACKLOG
	int "Listen backlog per service"
	default 4

config BMC_HTTPS
	bool "HTTPS service"
	depends on NET_SOCKETS_SOCKOPT_TLS
	help
	  Serve the same resources over TLS on a second port. The application
	  provisions the server certificate and key under
	  CONFIG_BMC_HTTPS_SEC_TAG before bmc_init() runs.

config BMC_HTTPS_PORT
	int "HTTPS port"
	default 443
	depends on BMC_HTTPS

config BMC_HTTPS_SEC_TAG
	int "Security tag holding the HTTPS server credentials"
	default 1
	depends on BMC_HTTPS

config BMC_WEBSOCKET
	bool "Websocket support"
	default y
	select HTTP_SERVER_WEBSOCKET
	select NET_SOCKETS_SERVICE
	select BASE64
	help
	  Let clients upgrade to a websocket, which the console bridge and the
	  websocket shell backend need.

endif # BMC_HTTP

config BMC_REDFISH
	bool "Redfish service"
	default y
	depends on BMC_HTTP
	select HTTP_SERVER_CAPTURE_HEADERS
	# The Redfish tree is served by one HTTP resource that matches /redfish
	# as a leading directory.
	select HTTP_SERVER_RESOURCE_WILDCARD
	select JSON_LIBRARY
	select BASE64
	help
	  Serve the Redfish resources describing the BMC, the managed system
	  and its chassis.

if BMC_REDFISH

config BMC_REDFISH_PRODUCT_NAME
	string "Default product name"
	default "BMC Board"
	help
	  Used unless the application registers a bmc_redfish_identity.

config BMC_REDFISH_MANUFACTURER
	string "Default manufacturer"
	default "Zephyr"

config BMC_REDFISH_MODEL
	string "Default model"
	default "Generic"

config BMC_REDFISH_SERIAL_NUMBER
	string "Default serial number"
	default "0000000000"

config BMC_REDFISH_PROCESSOR_MODEL
	string "Default host processor model"
	default "N/A"

config BMC_REDFISH_PROCESSOR_COUNT
	int "Default host processor count"
	default 1

config BMC_REDFISH_MEMORY_GIB
	int "Default host memory size in GiB"
	default 0
	help
	  0 is reported as unknown.

config BMC_REDFISH_CHASSIS_TYPE
	string "Redfish ChassisType"
	default "RackMount"

config BMC_REDFISH_RESPONSE_BUFFER_SIZE
	int "Largest Redfish response body"
	default 2048

config BMC_REDFISH_REQUEST_BUFFER_SIZE
	int "Largest Redfish request body"
	default 512

config BMC_REDFISH_BUFFER_HEAP_SIZE
	int "Heap the Redfish request and response buffers are taken from"
	default 8192
	help
	  Sized for CONFIG_BMC_HTTP_CONCURRENT in-flight transactions.

endif # BMC_REDFISH

config BMC_CONSOLE_LOGGER
	bool "Capture the host console"
	default y
	depends on $(dt_alias_enabled,host-console-uart)
	depends on SERIAL_SUPPORT_ASYNC
	select UART_ASYNC_API
	select RING_BUFFER
	help
	  Record what the host prints on its console UART into a circular
	  buffer that transports and the application can read back.

if BMC_CONSOLE_LOGGER

config BMC_CONSOLE_LOG_SIZE
	int "Captured host console size in bytes"
	range 64 65536
	default 2048

config BMC_CONSOLE_BAUDRATE
	int "Host console baud rate"
	default 115200

config BMC_CONSOLE_BRIDGE
	bool "Bridge the host console to a TCP port"
	default y

if BMC_CONSOLE_BRIDGE

config BMC_CONSOLE_BRIDGE_PORT
	int "Host console TCP port"
	default 2200

config BMC_CONSOLE_BRIDGE_STACK_SIZE
	int "Host console bridge thread stack size"
	default 1024

config BMC_CONSOLE_BRIDGE_PRIORITY
	int "Host console bridge thread priority"
	default 5

endif # BMC_CONSOLE_BRIDGE

config BMC_CONSOLE_BRIDGE_WS
	bool "Bridge the host console to a websocket"
	default y
	depends on BMC_WEBSOCKET
	help
	  Publish the captured host console at /console/host so that a web
	  terminal can attach to it.

if BMC_CONSOLE_BRIDGE_WS

config BMC_CONSOLE_BRIDGE_WS_STACK_SIZE
	int "Host console websocket thread stack size"
	default 4096 if BMC_HTTPS
	default 2048

config BMC_CONSOLE_BRIDGE_WS_PRIORITY
	int "Host console websocket thread priority"
	default 5

endif # BMC_CONSOLE_BRIDGE_WS

endif # BMC_CONSOLE_LOGGER

config BMC_JTAG
	bool "JTAG bit-banging daemon"
	default y
	depends on GPIO
	depends on $(dt_path_enabled,/jtag)
	help
	  Speak the OpenOCD remote_bitbang protocol over TCP, driving the JTAG
	  pins described by the /jtag devicetree node.

if BMC_JTAG

config BMC_JTAG_PORT
	int "JTAG daemon TCP port"
	default 3335

config BMC_JTAG_STACK_SIZE
	int "JTAG daemon stack size"
	default 1024

config BMC_JTAG_PRIORITY
	int "JTAG daemon priority"
	default 5

endif # BMC_JTAG

endif # BMC

config SHELL_WEBSOCKET_ENDPOINT_URL
	string
	depends on BMC && SHELL_BACKEND_WEBSOCKET
	default "console/bmc"
```

## subsys/mgmt/fota_http/Kconfig
```kconfig
# Copyright (c) 2026 Espressif Systems (Shanghai) Co., Ltd.
# SPDX-License-Identifier: Apache-2.0

menuconfig FOTA_HTTP
	bool "Firmware Over-the-Air over HTTP"
	depends on NETWORKING
	depends on NET_TCP
	depends on NET_SOCKETS
	depends on HTTP_CLIENT
	depends on FLASH
	depends on FLASH_MAP
	depends on IMG_MANAGER
	depends on MCUBOOT_IMG_MANAGER
	select MPU_ALLOW_FLASH_WRITE if ARM_MPU
	select IMG_ERASE_PROGRESSIVELY
	help
	  Download a firmware image from an HTTP server and write it straight
	  into the MCUboot slot that is not currently running, then request
	  the bootloader to boot it on the next reset. No server side
	  protocol is involved: any HTTP server able to serve a file works.

	  The image is streamed to flash as it arrives, so its size is not
	  limited by RAM. Only the MCUboot header is checked after the
	  download. MCUboot validates the image signature before it is ever
	  booted.

if FOTA_HTTP

config FOTA_HTTP_SHELL
	bool "FOTA HTTP shell commands"
	depends on SHELL
	default y
	help
	  Register a "fota" shell command with download, cancel, apply,
	  confirm, status and erase subcommands. Downloads run on the
	  library thread so the shell stack size does not matter.

config FOTA_HTTP_THREAD_STACK_SIZE
	int "Stack size of the download thread"
	default 8192 if FOTA_HTTP_TLS
	default 4096
	help
	  Stack of the thread running fota_http_download_async(). A TLS
	  handshake needs the larger value.

config FOTA_HTTP_THREAD_PRIORITY
	int "Priority of the download thread"
	default 5

config FOTA_HTTP_RECV_BUF_SIZE
	int "HTTP receive buffer size"
	default 2048
	range 512 16384
	help
	  Buffer holding the response headers and the body data of one
	  receive. A larger buffer means fewer receive calls per image.

config FOTA_HTTP_URL_MAX_LEN
	int "Maximum URL length"
	default 256
	range 64 1024
	help
	  Longest URL accepted, including any redirect target.

config FOTA_HTTP_TIMEOUT_MS
	int "HTTP request timeout in milliseconds"
	default 60000
	help
	  Timeout for the whole transfer, not for a single fragment. Size it
	  for the largest image expected over the slowest link in use.

config FOTA_HTTP_MAX_REDIRECTS
	int "Maximum number of HTTP redirects to follow"
	default 3
	range 0 10
	help
	  Follow 301, 302, 303, 307 and 308 responses up to this many times.
	  Set 0 to treat any redirect as an error.

config FOTA_HTTP_RESUME
	bool "Resume interrupted downloads"
	depends on STREAM_FLASH_PROGRESS
	help
	  Persist the download offset in settings so that a download
	  interrupted by a power loss or a network error can continue where
	  it stopped, using an HTTP Range request. Servers that ignore the
	  Range header restart the transfer from zero.

config FOTA_HTTP_RESUME_SAVE_INTERVAL
	int "Bytes written between two progress saves"
	depends on FOTA_HTTP_RESUME
	default 65536
	help
	  Progress is also saved when a download fails, so this only bounds
	  the data lost on a power cut. Smaller values wear the settings
	  storage faster.

config FOTA_HTTP_SHA256_CHECK
	bool "Verify a caller supplied SHA-256 after the download"
	select IMG_ENABLE_IMAGE_CHECK
	help
	  Compare the flash contents against the digest passed in
	  fota_http_download_params. This catches a corrupted transfer
	  before the reboot, it is not a substitute for the MCUboot
	  signature check.

config FOTA_HTTP_REJECT_DOWNGRADE
	bool "Refuse images older than the running one"
	help
	  Compare the version in the downloaded image header with the
	  running image and fail the download when it is older. This is a
	  convenience check only, use the MCUboot downgrade prevention
	  options for an enforced policy.

config FOTA_HTTP_TLS
	bool "Allow https URLs"
	depends on NET_SOCKETS_SOCKOPT_TLS
	help
	  Accept https URLs. Register the CA certificate with
	  fota_http_tls_add_ca() before the first download, or add it
	  under FOTA_HTTP_TLS_SEC_TAG with tls_credential_add().

if FOTA_HTTP_TLS

choice FOTA_HTTP_TLS_VERSION
	prompt "TLS protocol version"
	default FOTA_HTTP_TLS_VERSION_1_2

config FOTA_HTTP_TLS_VERSION_1_2
	bool "TLS 1.2"

config FOTA_HTTP_TLS_VERSION_1_3
	bool "TLS 1.3"
	depends on MBEDTLS_SSL_PROTO_TLS1_3

endchoice

config FOTA_HTTP_TLS_SEC_TAG
	int "TLS security tag"
	default 1
	help
	  Security tag under which the CA certificate, and optionally the
	  client certificate and key, are registered. A download can pass
	  its own tag list instead.

config FOTA_HTTP_TLS_PEER_VERIFY
	int "TLS peer verification level"
	default 2
	range 0 2
	help
	  0 disables verification, 1 makes it optional and 2 requires it.
	  Lower values accept a server that cannot be authenticated, which
	  lets anyone able to redirect the connection install their own
	  firmware. Leave it at 2 for production.

endif # FOTA_HTTP_TLS

module = FOTA_HTTP
module-str = fota_http
source "subsys/logging/Kconfig.template.log_config"

endif # FOTA_HTTP
```
