## subsys/logging/backends/Kconfig.rpmsg
```kconfig
# Copyright (c) 2026 Simon Maurer <mail@maurer.systems>
# SPDX-License-Identifier: Apache-2.0

config LOG_BACKEND_RPMSG
	bool "OpenAMP RPMsg log backend"
	depends on REMOTEPROC
	help
	  Enable a logging backend that transmits log output over an
	  RPMsg channel using OpenAMP.

	  If the RPMsg channel is not yet available, logs are written
	  to the RAM console as a fallback.

	  Note:
	  The host (e.g. Linux) must send an initial message on the
	  RPMsg channel to establish the connection before log output
	  is transmitted.

if LOG_BACKEND_RPMSG

backend = RPMSG
backend-str = rpmsg
source "subsys/logging/Kconfig.template.log_format_config"

endif # LOG_BACKEND_RPMSG
```

## subsys/logging/backends/Kconfig.rtt
```kconfig
# Copyright (c) 2021 Nordic Semiconductor ASA
# SPDX-License-Identifier: Apache-2.0

config LOG_BACKEND_RTT
	bool "Segger J-Link RTT backend"
	depends on USE_SEGGER_RTT
	default y if !SHELL_BACKEND_RTT
	select SEGGER_RTT_CUSTOM_LOCKING
	select LOG_OUTPUT
	help
	  When enabled, backend will use RTT for logging. This backend works on a per
	  message basis. Only a whole message (terminated with a carriage return: '\r')
	  is transferred to up-buffer at once depending on available space and
	  selected mode.
	  In panic mode backend always blocks and waits until there is space
	  in up-buffer for a message and message is transferred to host.

if LOG_BACKEND_RTT

choice LOG_BACKEND_RTT_MODE
	prompt "Logger behavior"
	default LOG_BACKEND_RTT_MODE_BLOCK

config LOG_BACKEND_RTT_MODE_DROP
	bool "Drop messages that do not fit in up-buffer."
	help
	  If there is not enough space in up-buffer for a message, drop it.
	  Number of dropped messages will be logged.
	  Increase up-buffer size helps to reduce dropping of messages.

config LOG_BACKEND_RTT_MODE_BLOCK
	bool "Block until message is transferred to host."
	help
	  Waits until there is enough space in the up-buffer for a message.

config LOG_BACKEND_RTT_MODE_OVERWRITE
	bool "Overwrite messages if up-buffer full"
	help
	  If there is not enough space in up-buffer for a message overwrite
	  oldest one.

endchoice

backend = RTT
backend-str = rtt
source "subsys/logging/Kconfig.template.log_format_config"

config LOG_BACKEND_RTT_MESSAGE_SIZE
	int "Size of internal buffer for storing messages."
	range 32 256
	default 128
	depends on LOG_BACKEND_RTT_MODE_DROP
	help
	  This option defines maximum message size transferable to up-buffer.

if LOG_BACKEND_RTT_MODE_BLOCK

config LOG_BACKEND_RTT_OUTPUT_BUFFER_SIZE
	int "Size of the output buffer"
	default 16
	help
	  Buffer is used by log_output module for preparing output data (e.g.
	  string formatting).

config LOG_BACKEND_RTT_RETRY_CNT
	int "Number of retries"
	default 4
	help
	  Number of TX retries before dropping the data and assuming that
	  RTT session is inactive.

config LOG_BACKEND_RTT_RETRY_DELAY_MS
	int "Delay between TX retries in milliseconds"
	default 5
	help
	  Sleep period between TX retry attempts. During RTT session, host pulls
	  data periodically. Period starts from 1-2 milliseconds and can be
	  increased if traffic on RTT increases (also from host to device). In
	  case of heavy traffic data can be lost and it may be necessary to
	  increase delay or number of retries.

endif # LOG_BACKEND_RTT_MODE_BLOCK

config LOG_BACKEND_RTT_BUFFER
	int "Buffer number used for logger output."
	range 0 SEGGER_RTT_MAX_NUM_UP_BUFFERS
	default 0
	help
	  Select index of up-buffer used for logger output, by default it uses
	  terminal up-buffer and its settings.

config LOG_BACKEND_RTT_BUFFER_SIZE
	int "Size of reserved up-buffer for logger output."
	default 1024
	depends on LOG_BACKEND_RTT_BUFFER > 0
	help
	  Specify reserved size of up-buffer used for logger output.

# Enable processing of printk calls using log if terminal buffer is used.
# Same buffer is used by RTT console. If printk would go through RTT console
# that will lead to corruption of RTT data which is not protected against being
# interrupted by an interrupt.
config LOG_BACKEND_RTT_FORCE_PRINTK
	bool
	default y if LOG_BACKEND_RTT_BUFFER = 0 && RTT_CONSOLE
	select LOG_PRINTK

endif # LOG_BACKEND_RTT
```

## subsys/logging/backends/Kconfig.semihost
```kconfig
# Copyright (c) 2024 Contributors to the logging subsystem.
# SPDX-License-Identifier: Apache-2.0

config LOG_BACKEND_SEMIHOST
	bool "Semihost as backend"
	depends on SEMIHOST
	select LOG_BACKEND_SUPPORTS_FORMAT_TIMESTAMP
	help
	  Enable backend in semihost (using host stdout)

if LOG_BACKEND_SEMIHOST

config LOG_BACKEND_SEMIHOST_BUFFER_SIZE
	int "Size of reserved up-buffer for logger output."
	default 256
	help
	  Specify reserved size of up-buffer used for logger output.

config LOG_BACKEND_SEMIHOST_AUTOSTART
	bool "Autostart semihost backend"
	default y
	help
	  Enable semihost backend to start automatically.

backend = SEMIHOST
backend-str = semihost
source "subsys/logging/Kconfig.template.log_format_config"

endif # LOG_BACKEND_SEMIHOST
```

## subsys/logging/backends/Kconfig.spinel
```kconfig
# Copyright (c) 2021 Nordic Semiconductor ASA
# SPDX-License-Identifier: Apache-2.0

config LOG_BACKEND_SPINEL
	bool "OpenThread dedicated Spinel protocol backend"
	depends on !LOG_BACKEND_UART
	depends on OPENTHREAD
	help
	  When enabled, backend will use OpenThread dedicated SPINEL protocol for logging.
	  This protocol is byte oriented and wraps given messages into serial frames.
	  Backend should be enabled only to OpenThread purposes and when UART backend is disabled
	  or works on another UART device to avoid interference.

if LOG_BACKEND_SPINEL

config LOG_BACKEND_SPINEL_BUFFER_SIZE
	int "Size of reserved up-buffer for logger output."
	default 64
	help
	  Specify reserved size of up-buffer used for logger output.

backend = SPINEL
backend-str = spinel
source "subsys/logging/Kconfig.template.log_format_config"

endif # LOG_BACKEND_SPINEL
```

## subsys/logging/backends/Kconfig.swo
```kconfig
# Copyright (c) 2021 Nordic Semiconductor ASA
# SPDX-License-Identifier: Apache-2.0

config LOG_BACKEND_SWO
	bool "Serial Wire Output (SWO) backend"
	depends on HAS_SWO
	select LOG_OUTPUT
	select LOG_BACKEND_SUPPORTS_FORMAT_TIMESTAMP
	help
	  When enabled, backend will use SWO for logging.

if LOG_BACKEND_SWO

config LOG_BACKEND_SWO_REF_FREQ_HZ
	int "SWO reference clock frequency"
	default $(dt_node_int_prop_int,$(dt_nodelabel_path,itm),swo-ref-frequency) if $(dt_nodelabel_enabled,itm)
	default $(dt_node_int_prop_int,/cpus/cpu@0,clock-frequency) if $(dt_node_has_prop,/cpus/cpu@0,clock-frequency)
	default 0
	help
	  Set SWO reference frequency. In most cases it is equal to CPU
	  frequency.

config LOG_BACKEND_SWO_FREQ_HZ
	int "Set SWO output frequency"
	default 0
	help
	  Set SWO output frequency. Value 0 will select maximum frequency
	  supported by the given MCU. Not all debug probes support high
	  frequency SWO operation. In this case the frequency has to be set
	  manually.

	  SWO value defined by this option will be configured at boot. Most SWO
	  viewer programs will configure SWO frequency when attached to the
	  debug probe. Such configuration will persist only until the device
	  reset. To ensure flawless operation the frequency configured here and
	  by the SWO viewer program has to match.

backend = SWO
backend-str = swo
source "subsys/logging/Kconfig.template.log_format_config"

endif # LOG_BACKEND_SWO
```

## subsys/logging/backends/Kconfig.telink_w91
```kconfig
# Copyright (c) 2024 Telink Semiconductor
# SPDX-License-Identifier: Apache-2.0

config LOG_BACKEND_TELINK_W91
	bool "Telink W91 backend"
	depends on TELINK_W91_DEBUG_ENABLE
	default y
	select LOG_OUTPUT
	help
	  When enabled backend is using Telink W91 to output logs.

if LOG_BACKEND_TELINK_W91

backend = TELINK_W91
backend-str = telink-w91
source "subsys/logging/Kconfig.template.log_format_config"

endif # LOG_BACKEND_TELINK_W91
```

## subsys/logging/backends/Kconfig.uart
```kconfig
# Copyright (c) 2021 Nordic Semiconductor ASA
# SPDX-License-Identifier: Apache-2.0

config LOG_BACKEND_UART
	bool "UART backend"
	depends on UART_CONSOLE
	default y if !SHELL_BACKEND_SERIAL && !SHELL_BACKEND_RTT
	select LOG_BACKEND_SUPPORTS_FORMAT_TIMESTAMP
	help
	  When enabled backend is using UART to output logs.

if LOG_BACKEND_UART

config LOG_BACKEND_UART_ASYNC
	bool "Use UART Asynchronous API"
	depends on UART_ASYNC_API
	depends on !LOG_BACKEND_UART_OUTPUT_DICTIONARY_HEX

config LOG_BACKEND_UART_BUFFER_SIZE
	int "Maximum number of bytes to buffer in RAM before flushing"
	default 32 if LOG_BACKEND_UART_ASYNC
	default 1
	help
	  In deferred logging mode, sets the maximum number of bytes which can be buffered in
	  RAM before log_output_flush is automatically called on the UART backend.  The buffer
	  will also be flushed after each log message.

	  In immediate logging mode, processed log messages are not buffered and are always
	  output one byte at a time.

config LOG_BACKEND_UART_AUTOSTART
	bool "Automatically start UART backend"
	default y
	help
	  When enabled automatically start the UART logging backend on
	  application start. When disabled, the application needs to start
	  the backend manually using log_backend_enable().

backend = UART
backend-str = uart
source "subsys/logging/Kconfig.template.log_format_config"

if LOG_BACKEND_UART_OUTPUT_DICTIONARY

choice
	prompt "Dictionary mode output format"
	default LOG_BACKEND_UART_OUTPUT_DICTIONARY_BIN

config LOG_BACKEND_UART_OUTPUT_DICTIONARY_BIN
	bool "Dictionary (binary)"
	help
	  Dictionary-based logging output in binary.

config LOG_BACKEND_UART_OUTPUT_DICTIONARY_HEX
	bool "Dictionary (hexadecimal)"
	help
	  Dictionary-based logging output in hexadecimal. Supported only for UART backend.

endchoice

endif # LOG_BACKEND_UART_OUTPUT_DICTIONARY

endif # LOG_BACKEND_UART
```

## subsys/logging/backends/Kconfig.xtensa_sim
```kconfig
# Copyright (c) 2021 Nordic Semiconductor ASA
# SPDX-License-Identifier: Apache-2.0

config LOG_BACKEND_XTENSA_SIM
	bool "Xtensa simulator backend"
	depends on SOC_XTENSA_SAMPLE_CONTROLLER || SOC_XTENSA_DC233C || SOC_FAMILY_INTEL_ADSP
	default y if SOC_XTENSA_SAMPLE_CONTROLLER || SOC_XTENSA_DC233C
	select LOG_BACKEND_SUPPORTS_FORMAT_TIMESTAMP
	help
	  Enable backend in xtensa simulator

config LOG_BACKEND_XTENSA_OUTPUT_BUFFER_SIZE
	int "Size of the output buffer"
	default 16
	depends on LOG_BACKEND_XTENSA_SIM
	help
	  Buffer is used by log_output module for preparing output data (e.g.
	  string formatting).

if LOG_BACKEND_XTENSA_SIM

backend = XTENSA_SIM
backend-str = xtensa_sim
source "subsys/logging/Kconfig.template.log_format_config"

endif # LOG_BACKEND_XTENSA_SIM
```

## subsys/lorawan/Kconfig
```kconfig
# LoRaWAN configuration options
#
# Copyright (c) 2020 Manivannan Sadhasivam <mani@kernel.org>
# SPDX-License-Identifier: Apache-2.0

menuconfig LORAWAN
	bool "LoRaWAN support [EXPERIMENTAL]"
	depends on LORA
	select REQUIRES_FULL_LIBC
	select EXPERIMENTAL
	help
	  This option enables LoRaWAN support.

if LORAWAN

module = LORAWAN
module-str = lorawan
source "subsys/logging/Kconfig.template.log_config"

menu "LoRaWAN Regions"

config LORAWAN_REGION_AS923
	bool "Asia 923MHz Frequency band"

config LORAWAN_REGION_AU915
	bool "Australia 915MHz Frequency band"

config LORAWAN_REGION_CN470
	bool "China 470MHz Frequency band"

config LORAWAN_REGION_CN779
	bool "China 779MHz Frequency band"

config LORAWAN_REGION_EU433
	bool "Europe 433MHz Frequency band"

config LORAWAN_REGION_EU868
	bool "Europe 868MHz Frequency band"

config LORAWAN_REGION_KR920
	bool "South Korea 920MHz Frequency band"

config LORAWAN_REGION_IN865
	bool "India 865MHz Frequency band"

config LORAWAN_REGION_US915
	bool "North America 915MHz Frequency band"

config LORAWAN_REGION_RU864
	bool "Russia 864MHz Frequency band"

endmenu

rsource "loramac-node/Kconfig"

rsource "emul/Kconfig"

rsource "nvm/Kconfig"

rsource "services/Kconfig"

endif # LORAWAN
```

## subsys/lorawan/class/Kconfig
```kconfig
# Kconfig - LoRaWAN radio frequency configuration options
#
# Copyright (c) 2018 Ding Tao
#
# SPDX-License-Identifuer: Apache-2.0
#

choice
	prompt "LoRaWAN radio frequency selection"
	default REGION_CN470

config REGION_AS923
	bool "AS923"

config REGION_AU915
	bool "AS915"

config REGION_CN470
	bool "CN470"

config REGION_CN779
	bool "CN779"

config REGION_EU433
	bool "EU433"

config REGION_EU868
	bool "EU868"

config REGION_IN865
	bool "IN865"

config REGION_KR920
	bool "KR920"

config REGION_US915
	bool "US915"

config REGION_US915_HYBRID
	bool "US915-Hybird"

endchoice
```

## subsys/lorawan/emul/Kconfig
```kconfig
# LoRaWAN emulator configuration
#
# Copyright (c) 2024 A Labs GmbH
# Copyright (c) 2024 tado GmbH
# SPDX-License-Identifier: Apache-2.0

config LORAWAN_EMUL
	bool "LoRaWAN Emulator"
	# The emulator currently depends on loramac-node for some types and
	# functions. Once these dependencies are removed, this can be changed.
	depends on LORA_MODULE_BACKEND_LORAMAC_NODE
	help
	  The emulator can be used for unit testing of LoRaWAN services.
	  It provides interfaces to send arbitrary messages to the LoRaWAN
	  stack and receive the response through callbacks without using
	  actual LoRa hardware.

	  See include/zephyr/lorawan/emul.h for the emulator API.
```

## subsys/lorawan/loramac-node/Kconfig
```kconfig
# LoRaWAN loramac-node backend configuration
#
# Copyright (c) 2020 Manivannan Sadhasivam <mani@kernel.org>
# SPDX-License-Identifier: Apache-2.0

if LORA_MODULE_BACKEND_LORAMAC_NODE

config LORAWAN_LORAMAC_NODE
	bool
	default y
	select HAS_SEMTECH_LORAMAC
	imply HAS_SEMTECH_SOFT_SE
	help
	  Hidden config to enable loramac-node backend specific options.

config LORAWAN_SYSTEM_MAX_RX_ERROR
	int "LoRaWAN System Max Rx Error"
	default 20
	help
	  System Max Rx timing error value in ms to be used by LoRaWAN stack
	  for calculating the RX1/RX2 window timing.

config LORAWAN_PUBLIC_NETWORK
	bool "LoRaWAN Public Network"
	default y
	help
	  Enable this option to use a public LoRaWAN network.
	  Disable for private LoRaWAN networks.

endif # LORA_MODULE_BACKEND_LORAMAC_NODE
```

## subsys/lorawan/native/region/Kconfig
```kconfig
# Native LoRaWAN region configuration
#
# Copyright (c) 2026 Carlo Caione <ccaione@baylibre.com>
# SPDX-License-Identifier: Apache-2.0

if LORA_MODULE_BACKEND_NATIVE

config LORAWAN_NATIVE_DUTY_CYCLE
	bool "Enforce regional duty cycle limits"
	help
	  Enable per-sub-band duty cycle enforcement as required by
	  ETSI regulations (e.g. EU868). When enabled, the stack
	  tracks on-air time per sub-band and blocks channels whose
	  off-time has not yet elapsed.

	  Disable this option for testing or when duty cycle
	  enforcement is handled externally.

config LORAWAN_NATIVE_MAX_CHANNELS
	int
	default 16
	help
	  Sizes the per-session channel table.  Not user-tunable: the value
	  is dictated by the selected region(s).  Currently only EU868 is
	  implemented (16-channel plan).  Regions with larger channel plans
	  will extend this config with 'default N if LORAWAN_REGION_X' lines
	  when they land.

endif # LORA_MODULE_BACKEND_NATIVE
```

## subsys/lorawan/radio/Kconfig
```kconfig
# Kconfig - Semtech radio chip selection
#
# Copyright (c) 2018 Ding Tao
#
# SPDX-License-Identifier: Apache-2.0
#

choice
	prompt "Radio chip selection"
	default SX1276
	help
	  Select the LoRaWAN chip to compile

config SX1272
	bool "Semtech SX1272"
	select SPI
	help
	  Use Semtech SX1272 as base radio

config SX1276
	bool "Semtech SX1276"
	select SPI
	help
	  Use Semetech SX1276 as base radio
endchoice

source "subsys/lorawan/radio/Kconfig.sx1272"
source "subsys/lorawan/radio/Kconfig.sx1276"
```
