## subsys/logging/Kconfig.processing
```kconfig
# Copyright (c) 2021 Nordic Semiconductor ASA
# SPDX-License-Identifier: Apache-2.0

menu "Processing"

if !LOG_MODE_MINIMAL

config LOG_PRINTK
	bool "Process printk messages"
	depends on !USERSPACE
	default y if PRINTK
	help
	  If enabled, printk messages are redirected to the logging subsystem.
	  The messages are formatted in place and logged unconditionally.

if LOG_MODE_DEFERRED && !LOG_FRONTEND_ONLY

config LOG_MODE_OVERFLOW
	bool "Drop oldest message when full"
	default y
	help
	  If enabled, then if there is no space to log a new message, the
	  oldest one is dropped. If disabled, current message is dropped.

config LOG_BLOCK_IN_THREAD
	bool "Block in thread context on full"
	depends on MULTITHREADING
	help
	  When enabled logger will block (if in the thread context) when
	  internal logger buffer is full and new message cannot be allocated.

config LOG_BLOCK_IN_THREAD_TIMEOUT_MS
	int "Maximum time (in milliseconds) thread can be blocked"
	default 1000
	range -1 10000
	depends on LOG_BLOCK_IN_THREAD
	help
	  If new buffer for a log message cannot be allocated in that time, log
	  message is dropped. Forever blocking (-1) is possible however may lead
	  to the logger deadlock if logging is enabled in threads used for
	  logging (e.g. logger or shell thread).

config LOG_PROCESS_TRIGGER_THRESHOLD
	int "Number of buffered log messages before flushing"
	default 10
	depends on MULTITHREADING
	help
	  When number of buffered messages reaches the threshold thread is waken
	  up. Log processing thread ID is provided during log initialization.
	  Set 0 to disable the feature. If LOG_PROCESS_THREAD is enabled then
	  this threshold is used by the internal thread.

config LOG_PROCESS_THREAD
	bool "Use internal thread for log processing"
	depends on MULTITHREADING
	default y
	help
	  When enabled thread is created by the logger subsystem. Thread is
	  waken up periodically (see LOG_PROCESS_THREAD_SLEEP_MS) and whenever
	  number of buffered messages exceeds the threshold (see
	  LOG_PROCESS_TRIGGER_THR).

if LOG_PROCESS_THREAD

config LOG_PROCESS_THREAD_STARTUP_DELAY_MS
	int "Set log processing thread startup delay"
	default 0
	help
	  Log processing thread starts after requested delay given in
	  milliseconds. When started, thread process any buffered messages.

config LOG_PROCESS_THREAD_SLEEP_MS
	int "Set internal log processing thread sleep period"
	default 1000
	help
	  Log processing thread sleeps for requested period given in
	  milliseconds. When waken up, thread process any buffered messages.

config LOG_PROCESS_THREAD_STACK_SIZE
	int "Stack size for the internal log processing thread"
	default 4096 if (X86 && X86_64)
	default 4096 if ARM64
	default 4096 if (ARC && 64BIT)
	default 4096 if SPARC
	default 2048 if COVERAGE_GCOV
	default 2048 if (RISCV && 64BIT)
	default 2048 if LOG_BACKEND_FS
	default 1152 if LOG_BACKEND_NET
	default 4096 if NO_OPTIMIZATIONS
	default 1024 if XTENSA
	default 2048 if ASSERT || SPIN_VALIDATE
	default 768
	help
	  Set the internal stack size for log processing thread.

config LOG_PROCESSING_LATENCY_US
	int "Maximum remote message latency (in microseconds)"
	default 100000
	depends on LOG_MULTIDOMAIN
	help
	  Arbitrary time between log message creation in the remote domain and
	  processing in the local domain. Higher value increases message processing
	  latency but increases chances of maintaining correct ordering of the
	  messages. Option is used only if links are using dedicated buffers
	  for remote messages.

config LOG_PROCESS_THREAD_CUSTOM_PRIORITY
	bool "Custom log thread priority"
	help
	  Set a custom value for the log processing thread.

config LOG_PROCESS_THREAD_PRIORITY
	int "Priority of the log processing thread"
	default 0
	depends on LOG_PROCESS_THREAD_CUSTOM_PRIORITY
	help
	  The priority of the log processing thread.
	  When not set the prority is set to K_LOWEST_APPLICATION_THREAD_PRIO.

endif # LOG_PROCESS_THREAD

config LOG_BUFFER_SIZE
	int "Number of bytes dedicated for the logger internal buffer"
	default 1024
	range 128 65536
	help
	  Number of bytes dedicated for the logger internal buffer.

endif # LOG_MODE_DEFERRED && !LOG_FRONTEND_ONLY

if LOG_MULTIDOMAIN

config LOG_DOMAIN_NAME_CACHE_ENTRY_SIZE
	int "Cache slot size of domain name"
	default 8

config LOG_DOMAIN_NAME_CACHE_ENTRY_COUNT
	int "Number of entries in domain name cache"
	default 2

config LOG_SOURCE_NAME_CACHE_ENTRY_SIZE
	int "Cache slot size of source name"
	default 16

config LOG_SOURCE_NAME_CACHE_ENTRY_COUNT
	int "Number of entries in source name cache"
	default 8

endif # LOG_MULTIDOMAIN

config LOG_TRACE_SHORT_TIMESTAMP
	bool "Use 24 bit timestamp for tracing"
	default y
	help
	  When enabled, shorter timestamp is used and trace message is
	  compressed.

config LOG_TIMESTAMP_64BIT
	bool "Use 64 bit timestamp"

config LOG_TIMESTAMP_USE_REALTIME
	bool "Use real time clock for timestamp"
	select LOG_TIMESTAMP_64BIT
	depends on POSIX_CLOCK
	help
	  When enabled, real time clock is used for timestamping.

config LOG_SPEED
	bool "Prefer performance over size"
	depends on LOG_MODE_DEFERRED
	depends on !LOG_FRONTEND
	help
	  If enabled, logging may take more code size to get faster logging.

endif # !LOG_MODE_MINIMAL

endmenu
```

## subsys/logging/Kconfig.template.log_config
```kconfig
# SPDX-License-Identifier: Apache-2.0

choice "$(module)_LOG_LEVEL_CHOICE"
	prompt "Max compiled-in log level for $(module-str)"
	default $(module)_LOG_LEVEL_INF
	depends on LOG

config $(module)_LOG_LEVEL_OFF
	bool "Off"

config $(module)_LOG_LEVEL_ERR
	bool "Error"

config $(module)_LOG_LEVEL_WRN
	bool "Warning"

config $(module)_LOG_LEVEL_INF
	bool "Info"

config $(module)_LOG_LEVEL_DBG
	bool "Debug"

endchoice

config $(module)_LOG_LEVEL
	int
	depends on LOG
	default 0 if $(module)_LOG_LEVEL_OFF
	default 1 if $(module)_LOG_LEVEL_ERR
	default 2 if $(module)_LOG_LEVEL_WRN
	default 3 if $(module)_LOG_LEVEL_INF
	default 4 if $(module)_LOG_LEVEL_DBG
```

## subsys/logging/Kconfig.template.log_config_inherit
```kconfig
# Copyright (c) 2022 Nordic Semicoductor ASA
# SPDX-License-Identifier: Apache-2.0

# Usage:
# This template allow module to use the parent module log level by default.
#
# The following arguments are mandatory:
# 	- module:
#		Name of the new log module.
#		Example: "BT_HCI_CORE"
#	- parent-module:
#		Name of the module that will be inherited by the new module.
#		Example: "BT"

choice "$(module)_LOG_LEVEL_CHOICE"
	default $(module)_LOG_LEVEL_INHERIT if y

config $(module)_LOG_LEVEL_INHERIT
	bool "Inherit $(parent-module)_LOG_LEVEL"

endchoice

config $(module)_LOG_LEVEL
	default $(parent-module)_LOG_LEVEL if $(module)_LOG_LEVEL_INHERIT

module := $(module)
source "subsys/logging/Kconfig.template.log_config"
```

## subsys/logging/Kconfig.template.log_format_config
```kconfig
# Copyright (c) 2022 Intel Corporation.
# SPDX-License-Identifier: Apache-2.0

choice "LOG_BACKEND_$(backend)_OUTPUT"
	prompt "Backend Output Mode"
	default LOG_BACKEND_$(backend)_OUTPUT_TEXT

config LOG_BACKEND_$(backend)_OUTPUT_TEXT
	bool "Text"
	help
	  Output in text.

config LOG_BACKEND_$(backend)_OUTPUT_SYST
	bool "MIPI SyS-T"
	depends on LOG_MIPI_SYST_ENABLE
	help
	  When enabled backend is used to output syst format logs.

config LOG_BACKEND_$(backend)_OUTPUT_DICTIONARY
	bool "Dictionary"
	select LOG_DICTIONARY_SUPPORT
	help
	  Backend is in dictionary-based logging output mode.

endchoice

# The numbering of the format types should be consistent across
# all the backends in the Kconfig and their values must match
# LOG_OUTPUT_XXX type in C files.
# Example : LOG_BACKEND_XXX_OUTPUT_TEXT should be numbered 0 across all backends
# and should match the value of LOG_OUTPUT_TEXT defined in log_output.h
config LOG_BACKEND_$(backend)_OUTPUT_DEFAULT
	int
	default 0 if LOG_BACKEND_$(backend)_OUTPUT_TEXT
	default 1 if LOG_BACKEND_$(backend)_OUTPUT_SYST
	default 2 if LOG_BACKEND_$(backend)_OUTPUT_DICTIONARY
```

## subsys/logging/backends/Kconfig
```kconfig
# Copyright (c) 2021 Nordic Semiconductor ASA
# SPDX-License-Identifier: Apache-2.0

menu "Backends"

rsource "Kconfig.adsp"
rsource "Kconfig.adsp_mtrace"
rsource "Kconfig.ble"
rsource "Kconfig.efi_console"
rsource "Kconfig.fs"
rsource "Kconfig.native_posix"
rsource "Kconfig.net"
rsource "Kconfig.rtt"
rsource "Kconfig.spinel"
rsource "Kconfig.swo"
rsource "Kconfig.uart"
rsource "Kconfig.xtensa_sim"
rsource "Kconfig.multidomain"
rsource "Kconfig.semihost"

endmenu
```

## subsys/logging/backends/Kconfig.adsp
```kconfig
# Copyright (c) 2021 Nordic Semiconductor ASA
# SPDX-License-Identifier: Apache-2.0

config LOG_BACKEND_ADSP
	bool "Intel ADSP buffer backend"
	depends on SOC_FAMILY_INTEL_ADSP
	select LOG_BACKEND_SUPPORTS_FORMAT_TIMESTAMP
	help
	  Enable backend for the host trace protocol of the Intel ADSP
	  family of audio processors

if LOG_BACKEND_ADSP

backend = ADSP
backend-str = adsp
source "subsys/logging/Kconfig.template.log_format_config"

endif # LOG_BACKEND_ADSP
```

## subsys/logging/backends/Kconfig.adsp_hda
```kconfig
# Copyright (c) 2021 Nordic Semiconductor ASA
# SPDX-License-Identifier: Apache-2.0

config LOG_BACKEND_ADSP_HDA
	bool "Intel ADSP HDA backend"
	depends on SOC_FAMILY_INTEL_ADSP && DMA && DMA_INTEL_ADSP_HDA_HOST_OUT
	select LOG_OUTPUT
	help
	  Provide a logging backend which writes to a buffer and
	  periodically flushes to hardware using ringbuffer like
	  semantics provided by DMA_INTEL_ADSP_HDA.

if LOG_BACKEND_ADSP_HDA

backend = ADSP_HDA
backend-str = adsp_hda
source "subsys/logging/Kconfig.template.log_format_config"

config LOG_BACKEND_ADSP_HDA_SIZE
	int "Size of ring buffer"
	range 128 8192
	default 4096
	help
	  Sets the ring buffer size cAVS HDA uses for logging. Effectively
	  determines how many log messages may be written to in a period of time.
	  The period of time is decided by how often to inform the hardware of
	  writes to the buffer.

config LOG_BACKEND_ADSP_HDA_FLUSH_TIME
	int "Time in milliseconds to periodically flush writes to hardware"
	range 1 10000
	default 500
	help
	    The Intel ADSP HDA backend periodically writes out its buffer contents
	    to hardware by informing the DMA hardware the contents of the ring
	    buffer.

config LOG_BACKEND_ADSP_HDA_CAVSTOOL
	bool "Log backend is to be used with cavstool"
	help
		Use cavstool understood IPC messages to inform setup and logging of
		HDA messages.

config LOG_BACKEND_ADSP_HDA_PADDING
	bool "Log backend should pad the buffer with \0 characters when flushing"
	help
		HDA requires transfers be 128 byte aligned such that a partial message may
		never make it across unless padded with \0 characters to the next 128 byte
		aligned address. This may or may not work depending on the log format
		being used but should certainly work with text based logging.

endif # LOG_BACKEND_ADSP_HDA
```

## subsys/logging/backends/Kconfig.adsp_mtrace
```kconfig
# Copyright (c) 2021 Nordic Semiconductor ASA
# SPDX-License-Identifier: Apache-2.0

config LOG_BACKEND_ADSP_MTRACE
	bool "Intel ADSP mtrace backend"
	depends on SOC_FAMILY_INTEL_ADSP
	select LOG_BACKEND_SUPPORTS_FORMAT_TIMESTAMP
	help
	  Provide a logging backend which writes to SRAM window
	  using the SOF Linux driver mtrace buffer layout.

if LOG_BACKEND_ADSP_MTRACE

backend = ADSP_MTRACE
backend-str = adsp_mtrace
source "subsys/logging/Kconfig.template.log_format_config"

config LOG_MULTI_SLOT
	bool "Use separate debug window slot per core for mtrace logging"
	depends on SMP
	depends on INTEL_ADSP_DEBUG_SLOT_MANAGER
	depends on LOG_CORE_ID_PREFIX
	help
	  When enabled, each CPU core gets its own debug window slot for
	  mtrace logging. This allows the host to read per-core log data
	  from separate memory window slots.

endif # LOG_BACKEND_ADSP_MTRACE

config MTRACE_LOG_CACHE_BUF_SIZE
	int "Number of bytes dedicated for the mtrace log cache buffer"
	depends on LOG_BACKEND_ADSP_MTRACE
	default 0
	range 0 32768
	help
	  Number of bytes dedicated for the mtrace log cache buffer.
```

## subsys/logging/backends/Kconfig.ble
```kconfig
# Copyright (c) 2023 Victor Chavez
# SPDX-License-Identifier: Apache-2.0

config LOG_BACKEND_BLE
	bool "Bluetooth Low Energy (BLE) backend"
	depends on BT
	depends on LOG_PROCESS_THREAD_STACK_SIZE>=2048
	select EXPERIMENTAL
	help
	  Backend that sends log messages over Bluetooth LE Notifications. This
	  characteristic and its service are compatible with the Nordic UART
	  Service (NUS), from the nRF Connect SDK.
	  This allows to use this BLE Logger directly with a compatible app such
	  as the nRF UART 2.0 or nRF Toolbox app.

if LOG_BACKEND_BLE

backend = BLE
backend-str = ble
source "subsys/logging/Kconfig.template.log_format_config"

endif # LOG_BACKEND_BLE
```

## subsys/logging/backends/Kconfig.can
```kconfig
# Copyright (c) 2025 Paul Wedeck <paulwedeck@gmail.com>
# SPDX-License-Identifier: Apache-2.0

config LOG_BACKEND_CAN
	bool "CAN backend"
	depends on CAN
	depends on CAN_LOG_LEVEL_OFF
	help
	  Backend to send out logs using raw CAN frames.

if LOG_BACKEND_CAN

config LOG_BACKEND_CAN_ID
	hex "CAN ID"
	default 0x7ff
	range 0x000 0x7ff if !LOG_BACKEND_USE_EXTID
	range 0x00000000 0x1fffffff if LOG_BACKEND_USE_EXTID
	help
	  CAN ID where log frames should be sent.

config LOG_BACKEND_USE_EXTID
	bool "Use Extended (29-bit) CAN ID"
	default n
	help
	  Enables use of Extended (29-bit) id.

config LOG_BACKEND_CAN_USE_FD
	bool "Use FD"
	depends on CAN_FD_MODE
	default n
	help
	  Enables use of CAN FD (64 byte) frames.

config LOG_BACKEND_CAN_USE_FD_BRS
	bool "Use baud rate switching (BRS)"
	depends on LOG_BACKEND_CAN_USE_FD
	default n
	help
	  Enables use of CAN FD baud rate switching.

config LOG_BACKEND_CAN_AUTOSTART
	bool "Autostart CAN backend"
	default y
	help
	  Select this if logging should be enabled from the start.

backend = CAN
backend-str = can
source "subsys/logging/Kconfig.template.log_format_config"

endif # LOG_BACKEND_CAN
```

## subsys/logging/backends/Kconfig.efi_console
```kconfig
# Copyright (c) 2021 Nordic Semiconductor ASA
# SPDX-License-Identifier: Apache-2.0

config LOG_BACKEND_EFI_CONSOLE
	bool "EFI_CONSOLE backend"
	depends on X86_EFI_CONSOLE
	select LOG_OUTPUT
	default y if !UART_CONSOLE
	help
	  When enabled backend is using EFI CONSOLE to output logs.

if LOG_BACKEND_EFI_CONSOLE

backend = EFI_CON
backend-str = efi_console
source "subsys/logging/Kconfig.template.log_format_config"

endif # LOG_BACKEND_EFI_CONSOLE
```
