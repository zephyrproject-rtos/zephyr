## subsys/logging/Kconfig.formatting
```kconfig
# Copyright (c) 2021 Nordic Semiconductor ASA
# SPDX-License-Identifier: Apache-2.0

menu "Output Formatting"

menu "Prepend non-hexdump log message with function name"
	depends on !LOG_FRONTEND_ONLY

config LOG_FUNC_NAME_PREFIX_ERR
	bool "Error messages prepended"

config LOG_FUNC_NAME_PREFIX_WRN
	bool "Warning messages prepended"

config LOG_FUNC_NAME_PREFIX_INF
	bool "Info messages prepended"

config LOG_FUNC_NAME_PREFIX_DBG
	bool "Debug messages prepended"
	default y

endmenu

menuconfig LOG_MIPI_SYST_ENABLE
	bool "MIPI SyS-T format output"
	select MIPI_SYST_LIB
	select LOG_OUTPUT
	help
	  Enable MIPI SyS-T format output for the logger system.

if LOG_MIPI_SYST_ENABLE

config LOG_MIPI_SYST_USE_CATALOG
	bool "Use MIPI Sys-T Catalog for logging"
	depends on !PICOLIBC
	select LOG_FMT_SECTION
	select LOG_USE_TAGGED_ARGUMENTS
	help
	  Use MIPI Sys-T Catalog for logging instead of plain text.

config LOG_MIPI_SYST_DISABLE_TIMESTAMP
	bool "Disable MIPI Sys-T protocol timestamp"
	help
	  Remove the timestamp from the MIPI Sys-T protocol.

config LOG_MIPI_SYST_CATALOG_ARGS_BUFFER_SIZE
	int "Size of temporary arguments buffer when using Sys-T Catalog"
	depends on LOG_MIPI_SYST_USE_CATALOG
	default 1024
	help
	  The size (in bytes) of the temporary buffer to store the expanded
	  argument list needed for the MIPI Sys-T library for processing
	  catalog messages.

config LOG_MIPI_SYST_ARGS_BUFFER_SIZE
	int "Buffer size in bytes"
	default 1024
	help
	  This user-configurable option specifies the maximum size (in bytes) to reserve in
	  the call stack for processing the logging format strings MIPI Sys-T library.
	  Increasing it will allow for longer strings to be logged at the expense of used
	  stack space. Conversely decreasing it will lessen the stack burden at the expense
	  of shorter maximum log strings.

config LOG_MIPI_SYST_OUTPUT_LOG_MSG_SRC_ID
	bool "Output Log Message Source ID as Module ID"
	default y if LOG_MIPI_SYST_USE_CATALOG
	help
	  Enable this option to output the log message source ID
	  as the Sys-T message module ID (as in origin unit in Sys-T
	  message header).

config LOG_MIPI_SYST_MSG_DEFAULT_MODULE_ID
	int "Default module ID in Sys-T message"
	range 0 127
	default 127 if LOG_MIPI_SYST_OUTPUT_LOG_MSG_SRC_ID
	default 0
	help
	  The default module ID embedded in the origin unit in
	  Sys-T message header.

	  If CONFIG_LOG_MIPI_SYST_OUTPUT_LOG_MSG_SRC_ID is disabled,
	  this will be used for all Sys-T messages.

	  If CONFIG_LOG_MIPI_SYST_OUTPUT_LOG_MSG_SRC_ID is enabled,
	  this will be used for log messages without source IDs,
	  for example, printk() if CONFIG_LOG_PRINTK is enabled.

config LOG_MIPI_SYST_MSG_DEFAULT_UNIT_ID
	int "Default unit ID in Sys-T message"
	range 0 15
	default 0
	help
	  The default unit ID embedded in the origin unit in
	  Sys-T message header.

endif # LOG_MIPI_SYST_ENABLE

config LOG_DICTIONARY_SUPPORT
	bool
	select LOG_DICTIONARY_DB
	help
	  Enable support for dictionary based logging.

	  Dictionary based logging is binary based where predefined strings
	  are replaced with their equivalent addresses from the built binary
	  image file in log output. This reduces the size required to store
	  the log output when there are long format strings to be logged.

	  This should be selected by the backend automatically.

config LOG_THREAD_ID_PREFIX
	bool "Thread ID prefix"
	help
	  Enable support for prefixing log message with thread name or ID.
	  Thread name is used if THREAD_NAME is enabled.

config LOG_CUSTOM_FORMAT_SUPPORT
	bool "Custom format support"
	default n
	help
	  Enable support for custom formatter.
	  Allows custom format callbacks registering for logging backend.

config LOG_IMMEDIATE_CLEAN_OUTPUT
	bool "Clean log output"
	depends on LOG_MODE_IMMEDIATE
	help
	  If enabled, interrupts are locked during whole log message processing.
	  As a result, processing on one log message cannot be interrupted by
	  another one and output is clean, not interleaved. However, enabling
	  this option is causing interrupts locking for significant amount of
	  time (up to multiple milliseconds).

config LOG_BACKEND_SHOW_COLOR
	bool "Colors in the backend"
	depends on LOG_BACKEND_UART || LOG_BACKEND_NATIVE_POSIX || LOG_BACKEND_RTT \
	           || LOG_BACKEND_SWO || LOG_BACKEND_XTENSA_SIM || SHELL_LOG_BACKEND
	default y
	help
	  When enabled selected backend prints errors in red and warning in yellow.

if LOG_BACKEND_SHOW_COLOR

config LOG_INFO_COLOR_GREEN
	bool "Use green color for info level logs"

config LOG_DBG_COLOR_BLUE
	bool "Use blue color for debug level logs"

endif # LOG_BACKEND_SHOW_COLOR

config LOG_TAG_MAX_LEN
	int "Tag max length"
	default 0
	range 0 64
	help
	  Setting non-zero value enables option to specify a tag which is
	  prepended to each log message. Tag can be changed at runtime.

config LOG_TAG_DEFAULT
	string "Default tag"
	depends on LOG_TAG_MAX_LEN > 0
	default ""
	help
	  Initial tag.

config LOG_BACKEND_SUPPORTS_FORMAT_TIMESTAMP
	bool
	help
	  Selected by log backends that supports timestamp formatting.

config LOG_BACKEND_FORMAT_TIMESTAMP
	bool "Timestamp formatting in the backend"
	depends on LOG_BACKEND_SUPPORTS_FORMAT_TIMESTAMP
	default y
	help
	  When enabled timestamp is formatted to hh:mm:ss:ms,us.

config LOG_OUTPUT_FORMAT_LINUX_TIMESTAMP
	bool "Format timestamp in Linux format"
	help
	  This formatting is something in the middle between the pure raw format
	  and the hh:mm:ss:ms,us one. It resembles the Linux's kernel format in
	  which timestamps are printed as fixed point values with seconds on the
	  left side of the point and microseconds on the right side.

config LOG_OUTPUT_FORMAT_CUSTOM_TIMESTAMP
	bool "Custom timestamp format support"
	help
	  Enable support for custom formatter for the timestamp.
	  It will be applied to all backends.

endmenu
```

## subsys/logging/Kconfig.frontends
```kconfig
# Copyright (c) 2022 Nordic Semiconductor ASA
# SPDX-License-Identifier: Apache-2.0

menu "Frontends"

config LOG_FRONTEND_DICT_UART
	bool "UART dictionary frontend"
	select LOG_DICTIONARY_DB
	select MPSC_PBUF
	depends on UART_ASYNC_API || UART_INTERRUPT_DRIVEN
	help
	  Frontend sends data in binary dictionary mode.

if LOG_FRONTEND_DICT_UART

config LOG_FRONTEND_DICT_UART_BUFFER_SIZE
	int "Buffer size"
	default 1024
	help
	  Number of bytes dedicated for buffering data

config LOG_FRONTEND_DICT_UART_DROPPED_NOTIFY_PERIOD
	int "Dropped notification period"
	default 500
	help
	  Determines how often a report about dropped messages is printed. Given
	  in milliseconds.

endif
endmenu
```

## subsys/logging/Kconfig.misc
```kconfig
# Copyright (c) 2021 Nordic Semiconductor ASA
# SPDX-License-Identifier: Apache-2.0

menu "Misc"

config LOG_CMDS
	bool "Shell commands"
	depends on SHELL
	depends on !LOG_FRONTEND_ONLY && !LOG_MODE_MINIMAL

config LOG_TEST_CLEAR_MESSAGE_SPACE
	bool "Clear message after allocation"
	default y
	depends on ZTEST
	help
	  Used in testing to simplify message comparision if message contains
	  paddings.

config LOG_USE_VLA
	bool "Using variable length arrays"
	default y if !MISRA_SANE
	help
	  Using VLA slightly decreases stack usage in some cases it may not be
	  supported. Note that VLA are used for arrays which size is resolved at
	  compile time so at runtime arrays have fixed size.

config LOG_SIMPLE_MSG_OPTIMIZE
	bool "Optimize simple messages for size"
	depends on !64BIT && !CBPRINTF_PACKAGE_HEADER_STORE_CREATION_FLAGS
	default y
	help
	  Dedicated code for handling simple log messages (0-2 32 bit word arguments).
	  Approximately, 70%-80% log messages in the application fit into that category.
	  Depending on the architecture code size reduction is from 0-40% (highest seen on
	  RISCV32) and execution time also up to 40%.

config LOG_ALWAYS_RUNTIME
	bool "Always use runtime message creation (v2)"
	default y if NO_OPTIMIZATIONS
	default y if LOG_MODE_IMMEDIATE
	default y if "$(ZEPHYR_TOOLCHAIN_VARIANT)" = "xcc"
	help
	  If enabled, runtime method is always used for message creation. Static
	  creation relies on compiler being able to optimize and remove code
	  based on information known at compile time. Runtime only approach must
	  be used when optimization is disabled because some compilers
	  (seen on arm_cortex_m and x86) were using unrealistic amount of stack
	  for dead code. It is also required in immediate mode since it requires
	  less stack than static message creation and speed has lower priority
	  in that mode.

config LOG_FMT_SECTION
	bool "Keep log strings in dedicated section"
	help
	  When enabled, logs are kept in dedicated memory section. It allows
	  removing strings from final binary and should be used for dictionary
	  logging.

config LOG_FMT_SECTION_STRIP
	bool "Strip log strings from binary"
	depends on LOG_DICTIONARY_SUPPORT
	depends on LOG_FMT_SECTION
	depends on LINKER_DEVNULL_SUPPORT
	depends on !LOG_ALWAYS_RUNTIME
	depends on !LOG_OUTPUT
	imply LINKER_DEVNULL_MEMORY
	imply LOG_FMT_STRING_VALIDATE

config LOG_FMT_STRING_VALIDATE
	bool "Validate logging strings"
	help
	  Logging strings cannot use %p with character pointers. They should be
	  casted to the pointer of another type (e.g. void *). With this feature
	  enabled, at compile time, the preprocessor detects strings with %p
	  without casting and reports an error at runtime.

config LOG_USE_TAGGED_ARGUMENTS
	bool "Using tagged arguments for packaging"
	depends on !PICOLIBC
	select CBPRINTF_PACKAGE_SUPPORT_TAGGED_ARGUMENTS
	select LOG_ALWAYS_RUNTIME
	help
	  If enabled, packaging uses tagged arguments.

config LOG_MEM_UTILIZATION
	bool "Tracking maximum memory utilization"
	depends on LOG_MODE_DEFERRED
	default y if LOG_CMDS
	help
	  When enabled, maximum usage of memory used for log messages in deferred
	  mode is tracked. It can be used to trim LOG_BUFFER_SIZE.

config LOG_DICTIONARY_DB
	bool

config LOG_DICTIONARY_DB_TARGET
	bool "Only generated log dictionary database from target"
	depends on LOG_DICTIONARY_DB
	help
	  Enable this option to make generating the log dictionary database
	  only done by its own build target.
	  This removes the target from the ALL make target and the target
	  'log_dict_db_gen' has to be called in addition.

config LOG_MSG_APPEND_RO_STRING_LOC
	bool
	help
	  Enable this option to force log messages to always append location of
	  read-only string arguments in the package. This should be selected by
	  backends if required.

config LOG_FAILURE_REPORT_PERIOD
	int "Failure report period (in milliseconds)"
	default 1000
	depends on LOG_MODE_DEFERRED
	help
	  Determines how often failures are reported. Report contains number
	  of dropped messages. It may contain additional information depending
	  on the mode.

config LOG_DOMAIN_NAME
	string "Domain name"
	default ""

if LOG_MULTIDOMAIN

config LOG_REMOTE_DOMAIN_MAX_COUNT
	int "Maximum number of link domains"
	default 4
	help
	  Number of domains that can be handled by a link

endif
endmenu
```

## subsys/logging/Kconfig.mode
```kconfig
# Copyright (c) 2021 Nordic Semiconductor ASA
# SPDX-License-Identifier: Apache-2.0

choice LOG_MODE
	prompt "Mode"
	depends on !LOG_FRONTEND_ONLY
	default LOG_MODE_IMMEDIATE if ARCH_POSIX
	default LOG_MODE_MINIMAL if LOG_DEFAULT_MINIMAL
	default LOG_MODE_DEFERRED

config LOG_MODE_DEFERRED
	bool "Deferred logging"
	select MPSC_PBUF
	help
	  Log messages are buffered and processed later. This mode has the
	  least impact on the application. Time consuming processing is
	  deferred to the known context.

config LOG_MODE_IMMEDIATE
	bool "Synchronous"
	help
	  When enabled log is processed in the context of the call. It impacts
	  performance of the system since time consuming operations are
	  performed in the context of the log entry (e.g. high priority
	  interrupt).Logger backends must support exclusive access to work
	  flawlessly in that mode because one log operation can be interrupted
	  by another one in the higher priority context.

config LOG_MODE_MINIMAL
	bool "Minimal-footprint"
	select PRINTK
	help
	  Enable minimal logging implementation. This has very little footprint
	  overhead on top of the printk() implementation for standard
	  logging macros. Hexdump macros are also supported, with a small
	  amount of code pulled in if used. Build time filtering is supported,
	  but not runtime filtering. There are no timestamps, prefixes,
	  colors, or asynchronous logging, and all messages are simply
	  sent to printk().

endchoice

config LOG_FRONTEND
	bool "Frontend"
	help
	  When enabled, logs are redirected to a custom frontend which is the
	  fastest way of getting logs out. The logs are redirected at the function
	  level. To redirect logs at the macro level, see LOG_CUSTOM_HEADER.

config LOG_FRONTEND_ONLY
	bool "No backends"
	depends on LOG_FRONTEND
	help
	  Option indicates that there are no backends intended to be used.
	  Code asserts if any backend is enabled.

config LOG_FRONTEND_OPT_API
	bool "Frontend optimized API"
	help
	  When enabled, frontend implements functions which are optimized versions
	  used for the most common log messages.

config LOG_CUSTOM_HEADER
	bool "Include Custom Log Header"
	help
	  When enabled, a custom application provided header, named
	  "zephyr_custom_log.h", is included at the end of log.h. This enables
	  extension of the LOG_* APIs at the macro level. Please use cautiously!
	  The internal LOG API may change in future releases.

config LOG_DEFAULT_MINIMAL
	bool

config LOG_MULTIDOMAIN
	bool "Multi-domain logger"
	select LOG_TIMESTAMP_64BIT
```
