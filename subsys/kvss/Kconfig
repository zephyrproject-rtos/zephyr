## subsys/logging/backends/Kconfig.mqtt
```kconfig
# Copyright (c) 2024 Arif Balik <arifbalik@outlook.com>
# SPDX-License-Identifier: Apache-2.0

config LOG_BACKEND_MQTT
	bool "MQTT backend"
	depends on MQTT_LIB && !LOG_MODE_IMMEDIATE
	help
	  Send log messages to an MQTT broker using an external MQTT client.
	  This backend publishes log messages to a configurable MQTT topic
	  using an MQTT client provided by the application via the
	  log_backend_mqtt_client_set() API. The application is responsible
	  for initializing, connecting, and managing the MQTT client lifecycle.

if LOG_BACKEND_MQTT

config LOG_BACKEND_MQTT_TOPIC_DEFAULT
	string "Default MQTT topic for log messages"
	default "zephyr/logs"
	help
	  Default MQTT topic for log messages. Use log backend MQTT API to change it at runtime.

config LOG_BACKEND_MQTT_QOS
	int "MQTT Quality of Service level"
	default 0
	range 0 2
	help
	  QoS level for published log messages:
	  0 - At most once delivery (fire and forget)
	  1 - At least once delivery (acknowledged delivery)
	  2 - Exactly once delivery (assured delivery)

config LOG_BACKEND_MQTT_RETAIN
	bool "Retain MQTT messages"
	help
	  When enabled, published log messages will be retained by the broker
	  and delivered to new subscribers immediately upon subscription.

config LOG_BACKEND_MQTT_MAX_MSG_SIZE
	int "Maximum log message size"
	default 256
	range 64 1024
	help
	  Maximum size of a single log message in bytes.

backend = MQTT
backend-str = mqtt
source "subsys/logging/Kconfig.template.log_format_config"

endif # LOG_BACKEND_MQTT
```

## subsys/logging/backends/Kconfig.multidomain
```kconfig
# Copyright (c) 2022 Nordic Semiconductor ASA
# SPDX-License-Identifier: Apache-2.0

config LOG_MULTIDOMAIN_BACKEND
	bool
	select LOG_TIMESTAMP_64BIT
	select LOG_MSG_APPEND_RO_STRING_LOC

config LOG_BACKEND_IPC_SERVICE
	bool "IPC service backend"
	select LOG_MULTIDOMAIN_BACKEND
```

## subsys/logging/backends/Kconfig.native_posix
```kconfig
# Copyright (c) 2021 Nordic Semiconductor ASA
# SPDX-License-Identifier: Apache-2.0

config LOG_BACKEND_NATIVE_POSIX
	bool "Native backend"
	depends on ARCH_POSIX
	default y
	select LOG_BACKEND_SUPPORTS_FORMAT_TIMESTAMP
	help
	  Enable backend in native_posix

if LOG_BACKEND_NATIVE_POSIX

config LOG_BACKEND_NATIVE_POSIX_STDOUT_BUF_SIZE
	int "Standard output buffer size"
	default 256
	help
	  Size of the buffer used to buffer log messages before flushing
	  to the host terminal. Messages are flushed on newline or when the
	  buffer is full.

backend = NATIVE_POSIX
backend-str = native_posix
source "subsys/logging/Kconfig.template.log_format_config"

endif # LOG_BACKEND_NATIVE_POSIX
```

## subsys/logging/backends/Kconfig.net
```kconfig
# Copyright (c) 2021 Nordic Semiconductor ASA
# SPDX-License-Identifier: Apache-2.0

# Immediate mode cannot be used with network backend as it would cause the sent
# rsyslog message to be malformed.
config LOG_BACKEND_NET
	bool "Networking backend"
	depends on NETWORKING && (NET_UDP || NET_TCP) && !LOG_MODE_IMMEDIATE
	help
	  Send syslog messages to network server.
	  See RFC 5424 (syslog protocol) and RFC 5426 (syslog over UDP) and
	  RFC 6587 (syslog over TCP) specifications for details.

if LOG_BACKEND_NET

config LOG_BACKEND_NET_RFC5424_STRUCTURED_DATA
	bool "Print structured data according to RFC 5424"
	help
	  Print additional structured data as described in
	  RFC 5424 chapter 6.3. Note that this might increase the
	  length of the syslog message a lot.

config LOG_BACKEND_NET_RFC5424_SDATA_TZKNOWN
	bool "RFC 5424 chapter 7.1.1 tzKnown field"
	depends on LOG_BACKEND_NET_RFC5424_STRUCTURED_DATA
	help
	  The tzKnown parameter indicates whether the originator knows its time zone.
	  See RFC 5424 chapter 7.1 for details.

config LOG_BACKEND_NET_RFC5424_SDATA_ISSYNCED
	bool "RFC 5424 chapter 7.1.2 isSynced field"
	depends on LOG_BACKEND_NET_RFC5424_STRUCTURED_DATA
	help
	  The isSynced parameter indicates whether the originator is
	  synchronized to a reliable external time source, e.g., via NTP.
	  See RFC 5424 chapter 7.1 for details.

config LOG_BACKEND_NET_RFC5424_SDATA_SOFTWARE
	bool "RFC 5424 chapter 7.2.3 software description field"
	depends on LOG_BACKEND_NET_RFC5424_STRUCTURED_DATA
	help
	  Software description parameter uniquely identifies the software that
	  generated the message.
	  See RFC 5424 chapter 7.2 for details.

config LOG_BACKEND_NET_RFC5424_SDATA_SOFTWARE_VALUE
	string "RFC 5424 chapter 7.2.3 software field value"
	default "zephyr"
	depends on LOG_BACKEND_NET_RFC5424_SDATA_SOFTWARE
	help
	  User defined value for the software field.
	  See RFC 5424 chapter 7.2.3 for details.

config LOG_BACKEND_NET_RFC5424_SDATA_SOFTWARE_VERSION
	bool "RFC 5424 chapter 7.2.4 software version field"
	depends on LOG_BACKEND_NET_RFC5424_STRUCTURED_DATA
	help
	  Software version parameter uniquely identifies the software that
	  generated the message.
	  See RFC 5424 chapter 7.2.4 for details.

config LOG_BACKEND_NET_RFC5424_SDATA_SEQID
	bool "RFC 5424 chapter 7.3.1 sequence id field"
	depends on LOG_BACKEND_NET_RFC5424_STRUCTURED_DATA
	help
	  Sequence id parameter tracks the sequence in which the
	  originator submits messages to the syslog transport for sending.
	  See RFC 5424 chapter 7.3.1 for details.

config LOG_BACKEND_NET_RFC5424_SDATA_UPTIME
	bool "RFC 5424 chapter 7.3.2 system uptime field"
	depends on LOG_BACKEND_NET_RFC5424_STRUCTURED_DATA
	help
	  The system uptime parameter tracks the "time (in hundredths of a
	  second) since the network management portion of the system was last
	  re-initialized." For Zephyr this is currently interpreted as the
	  system uptime.
	  See RFC 5424 chapter 7.3.2 for details.

config LOG_BACKEND_NET_SERVER
	string "Syslog server IP address"
	help
	  This can be either IPv4 or IPv6 address.
	  Server listen UDP port number can be configured here too.
	  Following syntax is supported:
	  192.0.2.1:514
	  192.0.2.42
	  [2001:db8::1]:514
	  [2001:db8::2]
	  2001:db::42
	  If you want to use TCP, add "tcp://" in front of the address
	  like this
	  tcp://192.0.2.1:514
	  tcp://192.0.2.42
	  tcp://[2001:db8::1]:514
	  UDP is used by default if the URI is missing.

config LOG_BACKEND_NET_MAX_BUF_SIZE
	int "Max syslog message size"
	range 64 1180
	default 1180 if NET_IPV6
	default 480 if NET_IPV4
	default 256
	help
	  As each syslog message needs to fit to UDP packet, set this value
	  so that messages are not truncated.
	  The RFC 5426 recommends that for IPv4 the size is 480 octets and for
	  IPv6 the size is 1180 octets. As each buffer will use RAM, the value
	  should be selected so that typical messages will fit the buffer.

config LOG_BACKEND_NET_AUTOSTART
	bool "Automatically start networking backend"
	default y if NET_CONFIG_NEED_IPV4 || NET_CONFIG_NEED_IPV6
	help
	  When enabled automatically start the networking backend on
	  application start. If no routes to the logging server are available
	  on application startup, this must be set to n and the backend must be
	  started by the application later on. Otherwise the logging
	  thread might block.

config LOG_BACKEND_NET_USE_DHCPV4_OPTION
	bool "Use DHCPv4 Log Server Option to configure syslog server"
	depends on NET_DHCPV4
	help
	  When enabled the syslog server IP address is read from the DHCPv4
	  Log Server Option (7).

backend = NET
backend-str = net
source "subsys/logging/Kconfig.template.log_format_config"

endif # LOG_BACKEND_NET
```
