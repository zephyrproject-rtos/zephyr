## soc/qemu/virt_m68k/Kconfig
```kconfig
# Copyright (c) 2026 Dimitri Varpusvuori
# SPDX-License-Identifier: Apache-2.0

config SOC_FAMILY_QEMU_VIRT_M68K
	select M68K

config SOC_QEMU_VIRT_M68K_M68000
	select CPU_M68000

config SOC_QEMU_VIRT_M68K_M68010
	select CPU_M68010
```

## soc/qemu/virt_m68k/Kconfig.soc
```kconfig
# Copyright (c) 2026 Dimitri Varpusvuori
# SPDX-License-Identifier: Apache-2.0

config SOC_FAMILY_QEMU_VIRT_M68K
	bool

config SOC_QEMU_VIRT_M68K_M68000
	bool
	select SOC_FAMILY_QEMU_VIRT_M68K

config SOC_QEMU_VIRT_M68K_M68010
	bool
	select SOC_FAMILY_QEMU_VIRT_M68K

config SOC_FAMILY
	default "qemu_virt_m68k" if SOC_FAMILY_QEMU_VIRT_M68K

config SOC
	default "qemu_virt_m68k_m68000" if SOC_QEMU_VIRT_M68K_M68000
	default "qemu_virt_m68k_m68010" if SOC_QEMU_VIRT_M68K_M68010
```

## soc/qemu/virt_riscv/qemu_virt_riscv64/Kconfig
```kconfig
# Copyright (c) 2024 Antmicro <www.antmicro.com>
# SPDX-License-Identifier: Apache-2.0

config SOC_QEMU_VIRT_RISCV64
	select RISCV_HAS_AIA if BOARD_QEMU_RISCV64_QEMU_VIRT_RISCV64_AIA_IMSIC || \
				BOARD_QEMU_RISCV64_QEMU_VIRT_RISCV64_AIA_IMSIC_SMP || \
				BOARD_QEMU_RISCV64_QEMU_VIRT_RISCV64_AIA_DIRECT || \
				BOARD_QEMU_RISCV64_QEMU_VIRT_RISCV64_AIA_DIRECT_SMP
```

## soc/raspberrypi/rpi_pico/common/Kconfig.cpu1
```kconfig
# Copyright (c) Qualcomm Technologies, Inc. and/or its subsidiaries.
# SPDX-License-Identifier: Apache-2.0

config SOC_FAMILY_RPI_PICO_CPU1
	bool
	help
	  Hidden marker selected by every CPU1-side SoC variant. Used to
	  gate Kconfig options that are only meaningful in CPU0 images,
	  such as SOC_RPI_PICO_CPU1_ENABLE.
```

## soc/realtek/ameba/amebasmart/Kconfig.soc
```kconfig
# Copyright (c) 2026 Realtek Semiconductor Corp.
# SPDX-License-Identifier: Apache-2.0

config SOC_SERIES_AMEBASMART
	bool
	select SOC_FAMILY_REALTEK_AMEBA

config SOC_SERIES
	default "amebasmart" if SOC_SERIES_AMEBASMART

config SOC_RTL8730E_CA32
	bool
	select SOC_SERIES_AMEBASMART

config SOC_RTL8730E_KM4
	bool
	select SOC_SERIES_AMEBASMART

config SOC_RTL8730E_KM0
	bool
	select SOC_SERIES_AMEBASMART

config SOC
	default "rtl8730e" if SOC_RTL8730E_CA32 || SOC_RTL8730E_KM4 || SOC_RTL8730E_KM0
```

## soc/realtek/fingerprint/rts5817/Kconfig
```kconfig
# Copyright (c) 2025 Realtek Semiconductor, Inc.
# SPDX-License-Identifier: Apache-2.0

config SOC_RTS5817
	select ARM
	select CPU_CORTEX_M33
	select CPU_HAS_FPU
	select CPU_HAS_ARM_MPU
	select CPU_HAS_DCACHE
	select CPU_HAS_ICACHE
	select CACHE_MANAGEMENT
	select ARMV8_M_DSP
	select INIT_ARCH_HW_AT_BOOT
	select XIP
	select ARCH_HAS_EXTRA_EXCEPTION_INFO
	select SOC_EARLY_INIT_HOOK
	select HAS_PM
	select HAS_PM_S2RAM_CUSTOM_MARKING

config SOC_RTS5817_PM_SUSPEND_IDLE_LOWER_FREQ
	bool "Lower CPU/bus clock frequency during suspend-to-idle"
	depends on SOC_RTS5817 && PM
	default y
	help
	  When entering the suspend-to-idle power state, drop the CPU/bus
	  (RTS_FP_CLK_BUS) clock to SOC_RTS5817_PM_SUSPEND_IDLE_BUS_FREQ in
	  order to reduce power, and restore the previous frequency on wakeup.

config SOC_RTS5817_PM_SUSPEND_IDLE_BUS_FREQ
	int "CPU/bus clock frequency (Hz) during suspend-to-idle"
	depends on SOC_RTS5817_PM_SUSPEND_IDLE_LOWER_FREQ
	default 30000000
	help
	  Target CPU/bus clock frequency while in suspend-to-idle. Must be one
	  of the discrete rates supported by the bus clock driver:
	  16, 20, 24, 30, 40, 48, 60, 80, 96, 120, 160 or 240 MHz.
```

## soc/renesas/ra/ra6b1/Kconfig
```kconfig
# SPDX-FileCopyrightText: 2026 Renesas Electronics Corporation
# SPDX-License-Identifier: Apache-2.0

config SOC_SERIES_RA6B1
	select ARM
	select CPU_CORTEX_M33
	select CPU_HAS_FPU
	select CPU_CORTEX_M_HAS_DWT
	select CPU_HAS_ARM_MPU
	select CPU_CORTEX_M_HAS_SYSTICK
	select CPU_HAS_ARM_SAU
	select ARMV8_M_DSP
	select HAS_RENESAS_RAFW_FSP
	select SRAM_VECTOR_TABLE # Let Zephyr copy IVT to the beginning of SRAM
	select STATIC_INIT_GNU # needed for functions in .init_array section
	select SOC_EARLY_RESET_HOOK
	select FPU
	select ARM_MPU
```

## soc/renesas/ra/ra6b1/Kconfig.defconfig
```kconfig
# SPDX-FileCopyrightText: 2026 Renesas Electronics Corporation
# SPDX-License-Identifier: Apache-2.0

if SOC_SERIES_RA6B1

config NUM_IRQS
	default 60

DT_LPCLK_PATH := $(dt_nodelabel_path,lp_clk)
DT_SYSCLK_PATH := $(dt_nodelabel_path,sys_clk)
DT_LPCLK_SRC_PATH := $(dt_node_ph_prop_path,$(DT_LPCLK_PATH),clock-src)
DT_SYSCLK_SRC_PATH := $(dt_node_ph_prop_path,$(DT_SYSCLK_PATH),clock-src)

config SYS_CLOCK_HW_CYCLES_PER_SEC
	default $(dt_node_int_prop_int,$(DT_SYSCLK_SRC_PATH),clock-frequency) if CORTEX_M_SYSTICK

config FLASH_BASE_ADDRESS
	default $(dt_chosen_reg_addr_hex,$(DT_CHOSEN_Z_FLASH))

config FLASH_SIZE
	default $(dt_chosen_reg_size_int,$(DT_CHOSEN_Z_FLASH),0,K)

config FLASH_LOAD_OFFSET
	default 0x2000 if !USE_DT_CODE_PARTITION

config ROM_START_OFFSET
	default 0x200

config MINIMAL_LIBC_RAND
	default y if MINIMAL_LIBC

endif # SOC_SERIES_RA6B1
```

## soc/renesas/ra/ra6b1/Kconfig.soc
```kconfig
# SPDX-FileCopyrightText: 2026 Renesas Electronics Corporation
# SPDX-License-Identifier: Apache-2.0

config SOC_SERIES_RA6B1
	bool
	select SOC_FAMILY_RENESAS_RA
	help
	  Renesas RA6B1 series

config SOC_R7KA6B1AF4ZNQ
	bool
	select SOC_SERIES_RA6B1
	help
	  R7KA6B1AF4ZNQ

config SOC_R7KA6B1AG4ZNQ
	bool
	select SOC_SERIES_RA6B1
	help
	  R7KA6B1AG4ZNQ

config SOC_R7KA6B1BF4ZNQ
	bool
	select SOC_SERIES_RA6B1
	help
	  R7KA6B1BF4ZNQ

config SOC_R7KA6B1BG4ZNQ
	bool
	select SOC_SERIES_RA6B1
	help
	  R7KA6B1BG4ZNQ

config SOC_R7KA6B1AF4ZDC
	bool
	select SOC_SERIES_RA6B1
	help
	  R7KA6B1AF4ZDC

config SOC_R7KA6B1AG4ZDC
	bool
	select SOC_SERIES_RA6B1
	help
	  R7KA6B1AG4ZDC

config SOC_R7KA6B1BF4ZDC
	bool
	select SOC_SERIES_RA6B1
	help
	  R7KA6B1BF4ZDC

config SOC_R7KA6B1BG4ZDC
	bool
	select SOC_SERIES_RA6B1
	help
	  R7KA6B1BG4ZDC

config SOC_R7KA6B1AG4ZAK
	bool
	select SOC_SERIES_RA6B1
	help
	  R7KA6B1AG4ZAK

config SOC_R7KA6B1BG4ZAK
	bool
	select SOC_SERIES_RA6B1
	help
	  R7KA6B1BG4ZAK

config SOC_SERIES
	default "ra6b1" if SOC_SERIES_RA6B1

config SOC
	default "r7ka6b1af4znq" if SOC_R7KA6B1AF4ZNQ
	default "r7ka6b1ag4znq" if SOC_R7KA6B1AG4ZNQ
	default "r7ka6b1bf4znq" if SOC_R7KA6B1BF4ZNQ
	default "r7ka6b1bg4znq" if SOC_R7KA6B1BG4ZNQ
	default "r7ka6b1af4zdc" if SOC_R7KA6B1AF4ZDC
	default "r7ka6b1ag4zdc" if SOC_R7KA6B1AG4ZDC
	default "r7ka6b1bf4zdc" if SOC_R7KA6B1BF4ZDC
	default "r7ka6b1bg4zdc" if SOC_R7KA6B1BG4ZDC
	default "r7ka6b1ag4zak" if SOC_R7KA6B1AG4ZAK
	default "r7ka6b1bg4zak" if SOC_R7KA6B1BG4ZAK
```

## soc/renesas/rh850/Kconfig.soc
```kconfig
# SPDX-FileCopyrightText: Copyright (c) 2026 Linumiz
#
# SPDX-License-Identifier: Apache-2.0

config SOC_FAMILY_RENESAS_RH850
	bool

config SOC_FAMILY
	default "renesas_rh850" if SOC_FAMILY_RENESAS_RH850

rsource "*/Kconfig.soc"
```

## soc/renesas/rh850/rh850u2a/Kconfig
```kconfig
# SPDX-FileCopyrightText: Copyright (c) 2026 Linumiz
#
# SPDX-License-Identifier: Apache-2.0

config SOC_SERIES_RH850U2A
	select RH850
	select CPU_G4MH
	select XIP
	select RENESAS_RH850_INTC
	select SOC_EARLY_INIT_HOOK
```

## soc/renesas/rh850/rh850u2a/Kconfig.soc
```kconfig
# SPDX-FileCopyrightText: Copyright (c) 2026 Linumiz
#
# SPDX-License-Identifier: Apache-2.0

config SOC_SERIES_RH850U2A
	bool
	select SOC_FAMILY_RENESAS_RH850
	help
	  Renesas RH850/U2A series

config SOC_R7F702300
	bool
	select SOC_SERIES_RH850U2A
	help
	  RH850/U2A16 (R7F702300)

config SOC_SERIES
	default "rh850u2a" if SOC_SERIES_RH850U2A

config SOC
	default "r7f702300" if SOC_R7F702300
```

## soc/renesas/rh850/rh850u2b/Kconfig.soc
```kconfig
# SPDX-FileCopyrightText: Copyright (c) 2026 Linumiz
#
# SPDX-License-Identifier: Apache-2.0

config SOC_SERIES_RH850U2B
	bool
	select SOC_FAMILY_RENESAS_RH850
	help
	  Renesas RH850/U2B series

config SOC_RH850U2B
	bool
	select SOC_SERIES_RH850U2B
	help
	  RH850/U2B, no specific part

config SOC_SERIES
	default "rh850u2b" if SOC_SERIES_RH850U2B

config SOC
	default "rh850u2b" if SOC_RH850U2B
```

## soc/renesas/rh850/rh850u2c/Kconfig.soc
```kconfig
# SPDX-FileCopyrightText: Copyright (c) 2026 Linumiz
#
# SPDX-License-Identifier: Apache-2.0

config SOC_SERIES_RH850U2C
	bool
	select SOC_FAMILY_RENESAS_RH850
	help
	  Renesas RH850/U2C series

config SOC_R7F702600
	bool
	select SOC_SERIES_RH850U2C
	help
	  RH850/U2C8 (R7F702600)

config SOC_SERIES
	default "rh850u2c" if SOC_SERIES_RH850U2C

config SOC
	default "r7f702600" if SOC_R7F702600
```

## soc/renesas/rh850/u2c/Kconfig.defconfig
```kconfig
# SPDX-FileCopyrightText: Copyright (c) 2026 Linumiz
#
# SPDX-License-Identifier: Apache-2.0

if SOC_SERIES_U2C

config NUM_IRQS
	default 630

config SYS_CLOCK_HW_CYCLES_PER_SEC
	default $(dt_nodelabel_int_prop,ostm0,clock-frequency)

endif # SOC_SERIES_U2C
```

## soc/renesas/rx/rx74m/Kconfig
```kconfig
# Copyright (c) 2026 Renesas Electronics Corporation
# SPDX-License-Identifier: Apache-2.0

config SOC_SERIES_RX74M
	select RX
	select CPU_RXV3E
	select XIP
	select CLOCK_CONTROL_RENESAS_RX_CGC if CLOCK_CONTROL
	select HAS_RENESAS_RX_FSP
	select CLOCK_CONTROL
	select SOC_EARLY_INIT_HOOK
```

## soc/renesas/rx/rx74m/Kconfig.soc
```kconfig
# Copyright (c) 2026 Renesas Electronics Corporation
# SPDX-License-Identifier: Apache-2.0

config SOC_SERIES_RX74M
	bool
	select SOC_FAMILY_RENESAS_RX
	help
	  Renesas RX74M series

config SOC_R5K574MCB4AE
	bool
	select SOC_SERIES_RX74M
	help
	  R5K574MCB4AE

config SOC_SERIES
	default "rx74m" if SOC_SERIES_RX74M

config SOC
	default "r5k574mcb4ae" if SOC_R5K574MCB4AE
```

## soc/renesas/rx/rx74n/Kconfig.defconfig
```kconfig
# Copyright (c) 2026 Renesas Electronics Corporation
# SPDX-License-Identifier: Apache-2.0

if SOC_SERIES_RX74N

DT_CMT_PATH := $(dt_nodelabel_path,cmt)

config SYS_CLOCK_HW_CYCLES_PER_SEC
	default $(dt_node_int_prop_int,$(DT_CMT_PATH),clock-frequency)

config SYS_CLOCK_TICKS_PER_SEC
	default 1000

config INITIALIZATION_STACK_SIZE
	default 512

# Enable hex file generation
config BUILD_OUTPUT_HEX
	default y

endif # SOC_SERIES_RX74N
```

## soc/renesas/rx/rx74n/Kconfig.soc
```kconfig
# Copyright (c) 2026 Renesas Electronics Corporation
# SPDX-License-Identifier: Apache-2.0

config SOC_SERIES_RX74N
	bool
	select SOC_FAMILY_RENESAS_RX
	help
	  Renesas RX74N series

config SOC_R5K574NCB4AE
	bool
	select SOC_SERIES_RX74N
	help
	  R5K574NCB4AE

config SOC_SERIES
	default "rx74n" if SOC_SERIES_RX74N

config SOC
	default "r5k574ncb4ae" if SOC_R5K574NCB4AE
```
