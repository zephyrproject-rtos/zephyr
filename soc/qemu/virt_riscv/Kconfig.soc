## soc/qemu/virt_riscv/Kconfig.soc
```kconfig
# Copyright (c) 2024 Antmicro <www.antmicro.com>
# SPDX-License-Identifier: Apache-2.0

config SOC_QEMU_VIRT_RISCV
	bool

config SOC
	default "qemu_virt_riscv" if SOC_QEMU_VIRT_RISCV
```

## soc/qemu/virt_riscv/qemu_riscv32/Kconfig.soc
```kconfig
# Copyright (c) 2024 Antmicro <www.antmicro.com>
# SPDX-License-Identifier: Apache-2.0

config SOC_QEMU_RISCV32
	bool
	default y
	depends on SOC_FAMILY_QEMU_VIRT_RISCV
	depends on !BOARD_QEMU_RISCV32_QEMU_RISCV32_AIA && !BOARD_QEMU_RISCV32_QEMU_RISCV32_AIA_SMP

config SOC
	default "qemu_riscv32" if SOC_QEMU_RISCV32
```

## soc/qemu/virt_riscv/qemu_riscv32_aia/Kconfig.soc
```kconfig
# Copyright (c) 2024 Antmicro <www.antmicro.com>
# Copyright (c) 2025 Synopsys, Inc.
# SPDX-License-Identifier: Apache-2.0

config SOC_QEMU_RISCV32_AIA
	bool
	default y
	depends on SOC_FAMILY_QEMU_VIRT_RISCV
	depends on (BOARD_QEMU_RISCV32_QEMU_RISCV32_AIA || BOARD_QEMU_RISCV32_QEMU_RISCV32_AIA_SMP)

config SOC
	default "qemu_riscv32_aia" if SOC_QEMU_RISCV32_AIA
```

## soc/qemu/virt_riscv/qemu_virt_riscv32/Kconfig
```kconfig
# Copyright (c) 2024 Antmicro <www.antmicro.com>
# SPDX-License-Identifier: Apache-2.0

config SOC_QEMU_VIRT_RISCV32
	select RISCV_HAS_AIA if BOARD_QEMU_RISCV32_QEMU_VIRT_RISCV32_AIA_IMSIC || \
				BOARD_QEMU_RISCV32_QEMU_VIRT_RISCV32_AIA_IMSIC_SMP || \
				BOARD_QEMU_RISCV32_QEMU_VIRT_RISCV32_AIA_DIRECT || \
				BOARD_QEMU_RISCV32_QEMU_VIRT_RISCV32_AIA_DIRECT_SMP
```

## soc/qemu/virt_riscv/qemu_virt_riscv32/Kconfig.soc
```kconfig
# Copyright (c) 2024 Antmicro <www.antmicro.com>
# SPDX-License-Identifier: Apache-2.0

config SOC_QEMU_VIRT_RISCV32
	bool
	default y
	depends on SOC_FAMILY_QEMU_VIRT_RISCV
	depends on !BOARD_QEMU_RISCV32_QEMU_VIRT_RISCV32_AIA && !BOARD_QEMU_RISCV32_QEMU_VIRT_RISCV32_AIA_SMP

config SOC
	default "qemu_virt_riscv32" if SOC_QEMU_VIRT_RISCV32
```

## soc/qemu/virt_riscv/qemu_virt_riscv32_aia/Kconfig
```kconfig
# Copyright (c) 2024 Antmicro <www.antmicro.com>
# Copyright (c) 2025 Synopsys, Inc.
# SPDX-License-Identifier: Apache-2.0

config SOC_QEMU_VIRT_RISCV32_AIA
	depends on SOC_FAMILY_QEMU_VIRT_RISCV
	select RISCV
	select RISCV_PRIVILEGED
	select RISCV_HAS_AIA
	select INCLUDE_RESET_VECTOR
	select RISCV_ISA_RV32I
	select RISCV_ISA_EXT_M
	select RISCV_ISA_EXT_A
	select RISCV_ISA_EXT_C
	select RISCV_ISA_EXT_SMCSRIND
	select RISCV_ISA_EXT_ZICSR
	select RISCV_ISA_EXT_ZIFENCEI
	select RISCV_SOC_HAS_GP_RELATIVE_ADDRESSING
	select CPU_HAS_FPU
	imply XIP
```

## soc/qemu/virt_riscv/qemu_virt_riscv32_aia/Kconfig.defconfig
```kconfig
# Copyright (c) 2024 Antmicro <www.antmicro.com>
# Copyright (c) 2025 Synopsys, Inc.
# SPDX-License-Identifier: Apache-2.0

if SOC_QEMU_VIRT_RISCV32_AIA

config SYS_CLOCK_HW_CYCLES_PER_SEC
	default 10000000

config RISCV_SOC_INTERRUPT_INIT
	default y

# AIA uses direct EIID addressing (no multi-level encoding)
# EIIDs 0-15 are reserved for local interrupts
# EIIDs 16+ are external interrupts handled by APLIC/IMSIC
config NUM_IRQS
	default 256

config GEN_IRQ_START_VECTOR
	default 0

config PMP_SLOTS
	default 16

endif # SOC_QEMU_VIRT_RISCV32_AIA
```

## soc/qemu/virt_riscv/qemu_virt_riscv32_aia/Kconfig.soc
```kconfig
# Copyright (c) 2024 Antmicro <www.antmicro.com>
# Copyright (c) 2025 Synopsys, Inc.
# SPDX-License-Identifier: Apache-2.0

config SOC_QEMU_VIRT_RISCV32_AIA
	bool
	default y
	depends on SOC_FAMILY_QEMU_VIRT_RISCV
	depends on (BOARD_QEMU_RISCV32_QEMU_VIRT_RISCV32_AIA || BOARD_QEMU_RISCV32_QEMU_VIRT_RISCV32_AIA_SMP)

config SOC
	default "qemu_virt_riscv32_aia" if SOC_QEMU_VIRT_RISCV32_AIA
```

## soc/qemu/virt_riscv/qemu_virt_riscv32e/Kconfig
```kconfig
# Copyright (c) 2020 Cobham Gaisler AB
# Copyright (c) 2024 Antmicro <www.antmicro.com>
# SPDX-License-Identifier: Apache-2.0

config SOC_QEMU_VIRT_RISCV32E
	select RISCV_ISA_RV32E
	select RISCV_ISA_EXT_ZICSR
	select RISCV_ISA_EXT_ZIFENCEI
```

## soc/qemu/virt_riscv/qemu_virt_riscv32e/Kconfig.soc
```kconfig
# Copyright (c) 2024 Antmicro <www.antmicro.com>
# SPDX-License-Identifier: Apache-2.0

config SOC_QEMU_VIRT_RISCV32E
	bool
	select SOC_FAMILY_QEMU_VIRT_RISCV

config SOC
	default "qemu_virt_riscv32e" if SOC_QEMU_VIRT_RISCV32E
```

## soc/qemu/virt_riscv/qemu_virt_riscv64/Kconfig.soc
```kconfig
# Copyright (c) 2024 Antmicro <www.antmicro.com>
# SPDX-License-Identifier: Apache-2.0

config SOC_QEMU_VIRT_RISCV64
	bool
	select SOC_FAMILY_QEMU_VIRT_RISCV

config SOC
	default "qemu_virt_riscv64" if SOC_QEMU_VIRT_RISCV64
```

## soc/quicklogic/eos_s3/Kconfig
```kconfig
# Copyright (c) 2020 Antmicro <www.antmicro.com>
# SPDX-License-Identifier: Apache-2.0

config SOC_EOS_S3
	select ARM
	select CPU_CORTEX_M4
	select CPU_CORTEX_M_HAS_SYSTICK
	select CPU_HAS_ARM_MPU
	select CPU_HAS_FPU
	select EOS_S3_HAL
	select SOC_EARLY_INIT_HOOK
```

## soc/quicklogic/eos_s3/Kconfig.defconfig
```kconfig
# Copyright (c) 2020 Antmicro <www.antmicro.com>
# SPDX-License-Identifier: Apache-2.0

if SOC_EOS_S3

config NUM_IRQS
	default 52

config SYS_CLOCK_HW_CYCLES_PER_SEC
	default 61440000

if SERIAL

config UART_INTERRUPT_DRIVEN
	default y

endif # SERIAL

endif # SOC_EOS_S3
```

## soc/quicklogic/eos_s3/Kconfig.soc
```kconfig
# Copyright (c) 2020 Antmicro <www.antmicro.com>
# SPDX-License-Identifier: Apache-2.0

config SOC_EOS_S3
	bool
	help
	  QuickLogic EOS S3 SoC

config SOC
	default "quicklogic_eos_s3" if SOC_EOS_S3
```

## soc/rapidsi/Kconfig.soc
```kconfig
# Copyright (c) 2024 Rapid Silicon
# SPDX-License-Identifier: Apache-2.0

config SOC_FAMILY_RAPIDSI
	bool

config SOC_FAMILY
	default "rapidsi" if SOC_FAMILY_RAPIDSI

rsource "*/Kconfig.soc"
```

## soc/rapidsi/virgo/Kconfig.soc
```kconfig
# Copyright (c) 2024 Rapid Silicon
# SPDX-License-Identifier: Apache-2.0

config SOC_SERIES_VIRGO
	bool
	select SOC_FAMILY_RAPIDSI
	help
	  Rapid Silicon SoC Series Implementation"

config SOC_VIRGO
	bool
	select SOC_SERIES_VIRGO
	help
	  Rapid Silicon Virgo SoC implementation"

config SOC_SERIES
	default "virgo" if SOC_SERIES_VIRGO

config SOC
	default "virgo" if SOC_VIRGO
```

## soc/rapidsilicon/Kconfig
```kconfig
# Copyright (c) 2024 Rapid Silicon
# SPDX-License-Identifier: Apache-2.0

if SOC_FAMILY_VIRGO

rsource "*/Kconfig"

endif # SOC_FAMILY_VIRGO
```

## soc/rapidsilicon/Kconfig.soc
```kconfig
# Copyright (c) 2024 Rapid Silicon
# SPDX-License-Identifier: Apache-2.0

config SOC_FAMILY_VIRGO
	bool

config SOC_FAMILY
	default "virgo" if SOC_FAMILY_VIRGO

rsource "*/Kconfig.soc"
```

## soc/rapidsilicon/virgo/Kconfig
```kconfig
# Copyright (c) 2024 Rapid Silicon
# SPDX-License-Identifier: Apache-2.0

config SOC_SERIES_VIRGO
	select RISCV
	select RISCV_PRIVILEGED
	select RISCV_HAS_CLIC
	select RISCV_VECTORED_MODE
	select GEN_IRQ_VECTOR_TABLE

config SOC_VIRGO
	select ATOMIC_OPERATIONS_BUILTIN
	select INCLUDE_RESET_VECTOR
	select RISCV_ISA_EXT_M
	select RISCV_ISA_EXT_C
	select RISCV_ISA_RV32I
	select RISCV_ISA_EXT_ZICSR
	select RISCV_ISA_EXT_ZIFENCEI
	select ATOMIC_OPERATIONS_C
	select THREAD_NAME

if SOC_SERIES_VIRGO

choice IRQ_VECTOR_TABLE_TYPE
	default IRQ_VECTOR_TABLE_JUMP_BY_ADDRESS
endchoice

config RISCV_MCAUSE_EXCEPTION_MASK
	default 0x1F

config ARCH_SW_ISR_TABLE_ALIGN
	default 64

config RISCV_ALWAYS_SWITCH_THROUGH_ECALL
	default y if MULTITHREADING

config SOC_ANDES_V5_EXECIT
	bool "Andes V5 EXEC.IT extension"
	depends on RISCV_ISA_EXT_C
	depends on !RISCV_GENERIC_TOOLCHAIN
	depends on !LINKER_USE_NO_RELAX
	help
		The EXEC.IT extension (Execution on Instruction Table) generate
		a look-up table and replaces suitable 32-bit instructions with
		the 16-bit "exec.it <INDEX>".

endif # SOC_SERIES_VIRGO
```

## soc/rapidsilicon/virgo/Kconfig.defconfig
```kconfig
# Copyright (c) 2024 Rapid Silicon
# SPDX-License-Identifier: Apache-2.0

if SOC_SERIES_VIRGO

# Kconfig picks the first default with a satisfied condition.
# SoC defaults should be parsed before SoC Series defaults, because SoCs usually
# overrides SoC Series values.
rsource "Kconfig.defconfig.virgo*"

# Below CONFIG_SYS_CLOCK_HW_CYCLES_PER_SEC is used by machine timer
config SYS_CLOCK_HW_CYCLES_PER_SEC
	default 133333333

config KERNEL_ENTRY
	default "entry"

config RISCV_GENERIC_TOOLCHAIN
	default y if "$(ZEPHYR_TOOLCHAIN_VARIANT)" = "zephyr"
	default n

config RISCV_SOC_INTERRUPT_INIT
	default y

config RISCV_GP
	default y

config RISCV_MCAUSE_EXCEPTION_MASK
	default 0xFFF

config NUM_2ND_LEVEL_AGGREGATORS
	default 1

config 2ND_LVL_ISR_TBL_OFFSET
	default 0

config 2ND_LVL_INTR_00_OFFSET
	default 0

config MAX_IRQ_PER_AGGREGATOR
	default 52

config NUM_IRQS
	default 52

endif # SOC_SERIES_VIRGO
```

## soc/rapidsilicon/virgo/Kconfig.soc
```kconfig
# Copyright (c) 2024 Rapid Silicon
# SPDX-License-Identifier: Apache-2.0

config SOC_SERIES_VIRGO
	bool
	select SOC_FAMILY_VIRGO
	help
	  Rapid Silicon SoC Series Virgo Implementation"

config SOC_VIRGO
	bool
	select SOC_SERIES_VIRGO
	help
	  Virgo SoC implementation"

config SOC_SERIES
	default "virgo" if SOC_SERIES_VIRGO

config SOC
	default "virgo" if SOC_VIRGO
```

## soc/raspberry_pi/Kconfig.soc
```kconfig
# Raspberry Pi (RP) MCU line

# Copyright (c) 2021 Nordic Semiconductor ASA
# SPDX-License-Identifier: Apache-2.0

config SOC_FAMILY_RPI_PICO
	bool

config SOC_FAMILY
	default "rpi_pico" if SOC_FAMILY_RPI_PICO

rsource "*/Kconfig.soc"
```

## soc/raspberrypi/Kconfig
```kconfig
# Raspberry Pi (RP) MCU line

# Copyright (c) 2021 Nordic Semiconductor ASA
# Copyright (c) 2021 Yonatan Schachter
# SPDX-License-Identifier: Apache-2.0

if SOC_FAMILY_RPI_PICO

rsource "*/Kconfig"

endif # SOC_FAMILY_RPI_PICO
```

## soc/raspberrypi/Kconfig.defconfig
```kconfig
# Raspberry Pi (RP) MCU line

# Copyright (c) 2021 Nordic Semiconductor ASA
# SPDX-License-Identifier: Apache-2.0

if SOC_FAMILY_RPI_PICO

rsource "*/Kconfig.defconfig"

config PINCTRL
	default y

endif # SOC_FAMILY_RPI_PICO
```

## soc/raspberrypi/rp2xxx/Kconfig.defconfig
```kconfig
# Raspberry Pi RP2XXX MCU line

# Copyright (c) 2021 Nordic Semiconductor ASA
# Copyright (c) 2021 Yonatan Schachter
# SPDX-License-Identifier: Apache-2.0

if SOC_SERIES_RP2XXX

rsource "Kconfig.defconfig.rp2*"

config NUM_IRQS
	default 26

endif # SOC_SERIES_RP2XXX
```
