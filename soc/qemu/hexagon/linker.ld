/*
 * Copyright (c) Qualcomm Technologies, Inc. and/or its subsidiaries.
 *
 * SPDX-License-Identifier: Apache-2.0
 */

#include <zephyr/devicetree.h>
#include <zephyr/linker/sections.h>
#include <zephyr/linker/linker-defs.h>
#include <zephyr/linker/linker-tool.h>

#define ROMABLE_REGION              RAM
#define RAMABLE_REGION              RAM


/* MMU page alignment for userspace */
#ifdef CONFIG_MMU
#define MMU_PAGE_ALIGN . = ALIGN(CONFIG_MMU_PAGE_SIZE);
#define HDR_MMU_PAGE_ALIGN ALIGN(CONFIG_MMU_PAGE_SIZE)
#else
#define MMU_PAGE_ALIGN
#define HDR_MMU_PAGE_ALIGN
#endif

/*
 * The hexagon toolchain unconditionally injects picolibc.ld into the
 * link command. To prevent picolibc's sections from overlapping with
 * ours, we leave __flash/__ram at picolibc's defaults (0x100000/0x500000)
 * so its sections are placed at non-conflicting addresses. Our sections
 * use the RAM region from the zephyr,sram chosen node.
 */

MEMORY
{
    RAM (rwx)     : ORIGIN = DT_REG_ADDR(DT_CHOSEN(zephyr_sram)), LENGTH = DT_REG_SIZE(DT_CHOSEN(zephyr_sram))
    IDT_LIST (wx) : ORIGIN = 0xFFFFF7FF, LENGTH = 2K
}

ENTRY(__start)

SECTIONS
{
    #include <zephyr/linker/rel-sections.ld>

    SECTION_PROLOGUE(.plt,,)
    {
        *(.plt)
    }

    SECTION_PROLOGUE(.iplt,,)
    {
        *(.iplt)
    }

    GROUP_START(ROMABLE_REGION)
    __rom_region_start = .;

    /* Reset vector must be at the beginning */
    SECTION_PROLOGUE(.reset.__start,,)
    {
        . = ALIGN(4);
        KEEP(*(.reset.__start))
    } GROUP_LINK_IN(ROMABLE_REGION)

    /* Event vector table */
    SECTION_PROLOGUE(.event_vectors._event_vector_table,,)
    {
        . = ALIGN(4);
        KEEP(*(.event_vectors._event_vector_table))
    } GROUP_LINK_IN(ROMABLE_REGION)

    /* IRQ vector table (generated by gen_isr_tables) */
    SECTION_PROLOGUE(.gnu.linkonce.irq_vector_table,,)
    {
        . = ALIGN(4);
        *(.gnu.linkonce.irq_vector_table)
        *(.gnu.linkonce.irq_vector_table*)
    } GROUP_LINK_IN(ROMABLE_REGION)

    SECTION_PROLOGUE(_TEXT_SECTION_NAME,,)
    {
        . = ALIGN(4);
        __text_region_start = .;
        *(.text .text.*)
        *(.gnu.linkonce.t.*)
        #include <zephyr/linker/kobject-text.ld>
    } GROUP_LINK_IN(ROMABLE_REGION)

    __text_region_end = .;
    __rodata_region_start = .;

    #include <zephyr/linker/common-rom.ld>
    /* Generated by zephyr_linker_sources(ROM_SECTIONS ...) */
    #include <snippets-rom-sections.ld>

    SECTION_PROLOGUE(_RODATA_SECTION_NAME,,)
    {
        . = ALIGN(4);
        *(.rodata)
        *(.rodata.*)
        *(.gnu.linkonce.r.*)
        #include <snippets-rodata.ld>
        #include <zephyr/linker/kobject-rom.ld>
    } GROUP_LINK_IN(ROMABLE_REGION)

    #include <zephyr/linker/cplusplus-rom.ld>

    __rodata_region_end = .;
    __rom_region_end = .;

    GROUP_END(ROMABLE_REGION)

    GROUP_START(RAMABLE_REGION)

#ifdef CONFIG_USERSPACE
    /* Application shared memory must come first for userspace */
#define SMEM_PARTITION_ALIGN(size) MMU_PAGE_ALIGN
#define APP_SHARED_ALIGN MMU_PAGE_ALIGN

#include <app_smem.ld>

    _app_smem_size = _app_smem_end - _app_smem_start;
    _app_smem_num_words = _app_smem_size >> 2;
    _app_smem_rom_start = LOADADDR(_APP_SMEM_SECTION_NAME);

    _image_ram_start = _app_smem_start;
    z_mapped_start = _app_smem_start;
#endif /* CONFIG_USERSPACE */

    /*
     * .tdata gets an output section of its own, immediately after .data and
     * loaded from the same region, rather than being folded into .data.
     *
     * It cannot share .data's output section: .tdata input sections carry
     * SHF_TLS and .data's do not, and lld refuses to mix the two
     * ("incompatible section flags for datas"), so any application with an
     * initialized thread-local failed to link. It has to stay adjacent to
     * .data, though, because the hexagon toolchain unconditionally injects
     * picolibc.ld, whose ASSERT compares __data_size against
     * __data_source_size -- __data_end is therefore taken at the end of
     * .tdata below so that the initialized-data span covers both sections.
     */
    SECTION_DATA_PROLOGUE(_DATA_SECTION_NAME,,)
    {
        MMU_PAGE_ALIGN
#ifndef CONFIG_USERSPACE
        _image_ram_start = .;
        z_mapped_start = .;
#endif
        __data_region_start = .;
        __data_start = .;

        *(.data)
        *(.data.*)
        *(.gnu.linkonce.s.*)
        #include <snippets-rwdata.ld>

        . = ALIGN(8);
    } GROUP_DATA_LINK_IN(RAMABLE_REGION, ROMABLE_REGION)

    SECTION_DATA_PROLOGUE(.tdata,,)
    {
        __tdata_start = .;
        *(.tdata .tdata.* .gnu.linkonce.td.*);
        /*
         * Pad to the TLS alignment so that .tbss below starts exactly at
         * __tdata_end. z_tls_data_size() is __tdata_size + __tbss_size, and
         * the compiler biases every local-exec access by the PT_TLS p_memsz;
         * a gap between the two sections would make those two disagree and
         * shift every thread-local by the size of the gap.
         */
        . = ALIGN(8);
        __tdata_end = .;
    } GROUP_DATA_LINK_IN(RAMABLE_REGION, ROMABLE_REGION)

    __tdata_size = __tdata_end - __tdata_start;
    /* Matches TLS_BLOCK_ALIGN in arch/hexagon/core/tls.c, which aligns the
     * per-thread copy of this block.
     */
    __tdata_align = 8;

    __data_end = __tdata_end;
    __data_size = __data_end - __data_start;
    __data_load_start = LOADADDR(_DATA_SECTION_NAME);

    /*
     * Override picolibc.ld PROVIDE symbols so the ASSERT
     * (__data_size == __data_source_size) passes. Our non-XIP
     * layout has VMA == LMA so these are identical.
     */
    __data_source = LOADADDR(_DATA_SECTION_NAME);
    __data_source_end = __data_source + __data_size;
    __data_source_size = __data_size;

    SECTION_DATA_PROLOGUE(.tbss,(NOLOAD),)
    {
        __tbss_start = .;
        *(.tbss .tbss.* .gnu.linkonce.tb.* .tcommon);
        /*
         * Pad so that the whole TLS block (.tdata + .tbss) is a multiple of
         * the 8-byte block alignment. The compiler biases a local-exec
         * access by ROUND_UP(p_memsz, p_align), and p_align is only 8 when
         * some thread-local actually needs it -- an image with no 8-byte
         * thread-local gets p_align 4. Keeping p_memsz a multiple of 8 makes
         * that rounding a no-op either way, so the bias is always exactly
         * z_tls_data_size() and arch_tls_stack_setup() does not have to know
         * which alignment the linker picked.
         */
        . = ALIGN(8);
        __tbss_end = .;
    } GROUP_DATA_LINK_IN(RAMABLE_REGION, RAMABLE_REGION)

    __tbss_align = 8;
    __tbss_size = __tbss_end - __tbss_start;
    __tls_start = __tdata_start;
    __tls_end = __tbss_end;
    __tls_size = __tbss_end - __tdata_start;
    #include <snippets-ram-sections.ld>
    #include <zephyr/linker/common-ram.ld>
    #include <snippets-data-sections.ld>
    #include <zephyr/linker/kobject-data.ld>
    #include <zephyr/linker/cplusplus-ram.ld>

    __data_region_end = .;

    SECTION_DATA_PROLOGUE(_BSS_SECTION_NAME,(NOLOAD),)
    {
        MMU_PAGE_ALIGN
        __bss_start = .;
        *(.bss .bss.*)
        *(COMMON)
        . = ALIGN(4);
        __bss_end = .;
    } GROUP_DATA_LINK_IN(RAMABLE_REGION, RAMABLE_REGION)

    SECTION_PROLOGUE(_NOINIT_SECTION_NAME,(NOLOAD),)
    {
        *(.noinit .noinit.*)
#if defined(CONFIG_LLEXT) && !defined(CONFIG_LLEXT_CUSTOM_HEAP_PLACEMENT)
        /* Kept in sync with zephyr/linker/common-noinit.ld, which this
         * script open-codes rather than includes.  Without these the llext
         * heaps are orphaned and the linker drops them into IDT_LIST.
         */
        *(.llext_heap)
        *(.llext_ext_heap)
        *(.llext_metadata_heap)
#endif
        #include <snippets-noinit.ld>
    } GROUP_LINK_IN(RAMABLE_REGION)

#ifdef CONFIG_USERSPACE
    /* User mode stacks section */
    SECTION_PROLOGUE(.user_stacks,(NOLOAD),)
    {
        . = ALIGN(8);
        z_user_stacks_start = .;
        *(.user_stacks)
        z_user_stacks_end = .;
    } GROUP_LINK_IN(RAMABLE_REGION)
#endif

    /* Interrupt stack section */
    SECTION_PROLOGUE(.interrupt_stack,(NOLOAD),)
    {
        . = ALIGN(8);
        _interrupt_stack = .;
        . = . + CONFIG_ISR_STACK_SIZE;
        _interrupt_stack_end = .;
    } GROUP_LINK_IN(RAMABLE_REGION)

    #include <zephyr/linker/ram-end.ld>

    GROUP_END(RAMABLE_REGION)

    #ifdef CONFIG_GEN_ISR_TABLES
    #include <zephyr/linker/intlist.ld>
    #endif

    #include <snippets-sections.ld>

    #include <zephyr/linker/debug-sections.ld>
    /DISCARD/ : { *(.note.GNU-stack) *(.hexagon.attributes) }

    /* Final section for deterministic sizing */
    SECTION_PROLOGUE(.last_section,,)
    {
        _end = .;
        _image_end = .;
    } GROUP_LINK_IN(RAMABLE_REGION)
}
