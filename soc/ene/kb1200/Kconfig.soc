## soc/ene/kb1200/Kconfig.soc
```kconfig
# Copyright (c) 2024 ENE Technology Inc.
# SPDX-License-Identifier: Apache-2.0

config SOC_KB1200
	bool
	help
	  ENE KB1200

config SOC
	default "kb1200" if SOC_KB1200
```

## soc/espressif/Kconfig
```kconfig
# Copyright (c) 2023 Espressif Systems (Shanghai) Co., Ltd.
# SPDX-License-Identifier: Apache-2.0

config SOC_FAMILY_ESPRESSIF_ESP32
	select PM_STATE_SET_IRQ_UNLOCKED

if SOC_FAMILY_ESPRESSIF_ESP32

rsource "*/Kconfig"

menu "MAC Config"

config ESP_MAC_ADDR_UNIVERSE_WIFI_STA
	bool

config ESP_MAC_ADDR_UNIVERSE_WIFI_AP
	bool

config ESP_MAC_ADDR_UNIVERSE_ETH
	bool

config ESP_MAC_ADDR_UNIVERSE_BT
	bool

config ESP_MAC_ADDR_UNIVERSE_IEEE802154
	bool

config ESP_MAC_UNIVERSAL_MAC_ADDRESSES_ONE
	bool

config ESP_MAC_UNIVERSAL_MAC_ADDRESSES_TWO
	bool

config ESP_MAC_UNIVERSAL_MAC_ADDRESSES_FOUR
	bool

# Insert chip-specific MAC config
rsource "*/Kconfig.mac"

endmenu

config RESERVE_RTC_MEM
	int
	default 0
	help
	  This option reserves an area in RTC FAST memory.

config SOC_ESP32_ENABLE_PVT
	bool "Auto adjust hp & lp voltage using pvt function"
	depends on SOC_SERIES_ESP32C5 || SOC_SERIES_ESP32C6 || SOC_SERIES_ESP32P4
	default n if SOC_SERIES_ESP32C6
	default y
	help
	  If enabled, hp & lp voltage can be auto adjusted by the PVT
	  characteristic. Otherwise, internal voltage is set to a fixed
	  dbias. This is required for stable mass production; disable for
	  debugging only.

rsource "Kconfig.ulp"

endif # SOC_FAMILY_ESPRESSIF_ESP32
```

## soc/espressif/Kconfig.ulp
```kconfig
# Copyright (c) 2025 Espressif Systems (Shanghai) Co., Ltd.
# SPDX-License-Identifier: Apache-2.0

menu "Ultra Low Power (ULP) Coprocessor"

config ULP_COPROC_ENABLED
	bool "Ultra Low Power (ULP) Coprocessor"
	default y if SOC_ESP32C6_LPCORE
	select SOC_LATE_INIT_HOOK if SOC_ESP32C6_HPCORE
	help
	  Enable this feature if you plan to use the ULP Coprocessor.
	  Once this option is enabled, further ULP co-processor configuration will appear in the menu.

choice ULP_COPROC_TYPE
	prompt "ULP Coprocessor type"
	depends on ULP_COPROC_ENABLED
	default ULP_COPROC_TYPE_LP_CORE if SOC_SERIES_ESP32C6
	help
	  Choose the ULP Coprocessor type: ULP FSM (Finite State Machine) or ULP RISC-V.

config ULP_COPROC_TYPE_FSM
	bool "ULP FSM (Finite State Machine)"
	depends on SOC_SERIES_ESP32 || SOC_SERIES_ESP32S2 || SOC_SERIES_ESP32S3

config ULP_COPROC_TYPE_RISCV
	bool "ULP RISC-V"
	depends on SOC_SERIES_ESP32S2 || SOC_SERIES_ESP32S3

config ULP_COPROC_TYPE_LP_CORE
	bool "LP core RISC-V"
	depends on SOC_SERIES_ESP32C6
endchoice

menu "ULP RISC-V Settings"
	depends on ULP_COPROC_TYPE_RISCV

config ULP_RISCV_INTERRUPT_ENABLE
	bool "ULP RISC-V interrupts"
	help
	  Turn on this setting to enabled interrupts on the ULP RISC-V core.

endmenu

menu "ULP Debugging Options"

config ULP_PANIC_OUTPUT_ENABLE
	bool "Panic handler outputs to LP UART"
	depends on ULP_COPROC_TYPE_LP_CORE
	help
	  Set this option to enable panic handler functionality. If this option is
	  enabled then the LP Core will output a panic dump over LP UART,
	  similar to what the main core does. Output depends on LP UART already being
	  initialized and configured.
	  Disabling this option will reduce the LP core binary size by not
	  linking in panic handler functionality.

config ULP_HP_UART_CONSOLE_PRINT
	bool "Route lp_core_printf to the console HP-UART"
	depends on ULP_COPROC_TYPE_LP_CORE
	help
	  Set this option to route lp_core_printf to the console HP-UART.
	  This allows you to easily view print outputs from the LP core, without
	  having to connect to the LP-UART. This option comes with the following
	  limitations:

	  1. There is no mutual exclusion between the HP-Core and the LP-Core accessing
	  the HP-UART, which means that if both cores are logging heavily the output
	  strings might get mangled together.
	  2. The HP-UART can only work while the HP-Core is running, which means that
	  if the HP-Core is in deep sleep, the LP-Core will not be able to print to the
	  console HP-UART.

	  Due to these limitations it is only recommended to use this option for easy debugging.
	  For more serious use-cases you should use the LP-UART.

config ULP_NORESET_UNDER_DEBUG
	bool "Avoid resetting LP core when debugger is attached"
	depends on ULP_COPROC_TYPE_LP_CORE
	default y
	help
	  Enable this feature to avoid resetting LP core in sleep mode when debugger is attached,
	  otherwise configured HW breakpoints and dcsr.ebreak* bits will be missed.
	  This is a workaround until it will be fixed in HW.

endmenu

endmenu  # Ultra Low Power (ULP) Coprocessor
```

## soc/espressif/common/Kconfig.amp
```kconfig
# Copyright (c) 2023 Espressif Systems (Shanghai) Co., Ltd.
# SPDX-License-Identifier: Apache-2.0

config SOC_ENABLE_APPCPU
	bool
	default y
	depends on (IPM || MBOX)
	depends on SOC_SERIES_ESP32 || SOC_SERIES_ESP32S3
	help
	  This hidden configuration lets PROCPU core to map and start APPCPU whenever IPM is enabled.

menu "Espressif AMP Config"

config ESP_APPCPU_IRAM_SIZE
	hex "ESP32* APPCPU IRAM size"
	default 0x10000
	help
	  Defines APPCPU IRAM area size in bytes.

config ESP_APPCPU_DRAM_SIZE
	hex "ESP32* APPCPU DRAM size"
	default 0x10000
	help
	  Defines APPCPU DRAM area size in bytes.

endmenu # AMP config
```

## soc/espressif/common/Kconfig.console
```kconfig
# Copyright (c) 2025 Espressif Systems (Shanghai) Co., Ltd.
# SPDX-License-Identifier: Apache-2.0

if SOC_FAMILY_ESPRESSIF_ESP32

DT_CHOSEN_Z_CONSOLE := zephyr,console

if !$(dt_chosen_enabled,$(DT_CHOSEN_Z_CONSOLE))

config ESP_CONSOLE_UART_NUM
	int
	default -1

config ESP_CONSOLE_UART_BAUDRATE
	int
	default 0

endif # !$(dt_chosen_enabled,$(DT_CHOSEN_Z_CONSOLE))

if $(dt_chosen_enabled,$(DT_CHOSEN_Z_CONSOLE))

if $(dt_nodelabel_enabled,uart0)
	ESP32_UART0_NODE_PATH := $(dt_nodelabel_path,uart0)
	ESP32_UART0_CURR_SPEED := $(dt_node_int_prop_int,$(ESP32_UART0_NODE_PATH),current-speed)
endif # $(dt_nodelabel_enabled,uart0)

if $(dt_nodelabel_enabled,uart1)
	ESP32_UART1_NODE_PATH := $(dt_nodelabel_path,uart1)
	ESP32_UART1_CURR_SPEED := $(dt_node_int_prop_int,$(ESP32_UART1_NODE_PATH),current-speed)
endif # $(dt_nodelabel_enabled,uart1)

if $(dt_nodelabel_enabled,uart2)
	ESP32_UART2_NODE_PATH := $(dt_nodelabel_path,uart2)
	ESP32_UART2_CURR_SPEED := $(dt_node_int_prop_int,$(ESP32_UART2_NODE_PATH),current-speed)
endif # $(dt_nodelabel_enabled,uart2)

if $(dt_nodelabel_enabled,usb_serial)
	ESP32_USB_SERIAL_CURR_SPEED := 1

config ESP_ROM_USB_SERIAL_DEVICE_NUM
	int
	default 4 if SOC_SERIES_ESP32S3
	default 3

endif # $(dt_nodelabel_enabled,usb_serial)

config ESP_CONSOLE_UART
	bool
	default y if $(dt_nodelabel_enabled,uart0) && $(dt_chosen_reg_addr_hex,$(DT_CHOSEN_Z_CONSOLE)) = $(dt_nodelabel_reg_addr_hex,uart0) || \
		     $(dt_nodelabel_enabled,uart1) && $(dt_chosen_reg_addr_hex,$(DT_CHOSEN_Z_CONSOLE)) = $(dt_nodelabel_reg_addr_hex,uart1) || \
		     $(dt_nodelabel_enabled,uart2) && $(dt_chosen_reg_addr_hex,$(DT_CHOSEN_Z_CONSOLE)) = $(dt_nodelabel_reg_addr_hex,uart2)

config ESP_CONSOLE_USB_SERIAL_JTAG
	bool
	default y if $(dt_nodelabel_enabled,usb_serial) && $(dt_chosen_reg_addr_hex,$(DT_CHOSEN_Z_CONSOLE)) = $(dt_nodelabel_reg_addr_hex,usb_serial)

config ESP_CONSOLE_UART_NUM
	int
	default 0 if $(dt_nodelabel_enabled,uart0) && $(dt_chosen_reg_addr_hex,$(DT_CHOSEN_Z_CONSOLE)) = $(dt_nodelabel_reg_addr_hex,uart0)
	default 1 if $(dt_nodelabel_enabled,uart1) && $(dt_chosen_reg_addr_hex,$(DT_CHOSEN_Z_CONSOLE)) = $(dt_nodelabel_reg_addr_hex,uart1)
	default 2 if $(dt_nodelabel_enabled,uart2) && $(dt_chosen_reg_addr_hex,$(DT_CHOSEN_Z_CONSOLE)) = $(dt_nodelabel_reg_addr_hex,uart2)
	default ESP_ROM_USB_SERIAL_DEVICE_NUM if $(dt_nodelabel_enabled,usb_serial) && $(dt_chosen_reg_addr_hex,$(DT_CHOSEN_Z_CONSOLE)) = $(dt_nodelabel_reg_addr_hex,usb_serial)
	default -1

config ESP_CONSOLE_UART_BAUDRATE
	int
	default $(ESP32_UART0_CURR_SPEED) if $(dt_nodelabel_enabled,uart0) && $(dt_chosen_reg_addr_hex,$(DT_CHOSEN_Z_CONSOLE)) = $(dt_nodelabel_reg_addr_hex,uart0)
	default $(ESP32_UART1_CURR_SPEED) if $(dt_nodelabel_enabled,uart1) && $(dt_chosen_reg_addr_hex,$(DT_CHOSEN_Z_CONSOLE)) = $(dt_nodelabel_reg_addr_hex,uart1)
	default $(ESP32_UART2_CURR_SPEED) if $(dt_nodelabel_enabled,uart2) && $(dt_chosen_reg_addr_hex,$(DT_CHOSEN_Z_CONSOLE)) = $(dt_nodelabel_reg_addr_hex,uart2)
	default $(ESP32_USB_SERIAL_CURR_SPEED) if $(dt_nodelabel_enabled,usb_serial) && $(dt_chosen_reg_addr_hex,$(DT_CHOSEN_Z_CONSOLE)) = $(dt_nodelabel_reg_addr_hex,usb_serial)
	default 0

config ESP_CONSOLE
	bool
	default y if ESP_CONSOLE_UART || ESP_CONSOLE_USB_SERIAL_JTAG

endif # $(dt_chosen_enabled,$(DT_CHOSEN_Z_CONSOLE))

endif # SOC_FAMILY_ESPRESSIF_ESP32
```

## soc/espressif/common/Kconfig.defconfig
```kconfig
# Copyright (c) 2023 Espressif Systems (Shanghai) Co., Ltd.
# SPDX-License-Identifier: Apache-2.0

if SOC_SERIES_ESP32C3

config GEN_ISR_TABLES
	default y

config GEN_SW_ISR_TABLE
	default y

config GEN_IRQ_VECTOR_TABLE
	default n

config DYNAMIC_INTERRUPTS
	default y

config ISR_STACK_SIZE
	default 2048

config ATOMIC_OPERATIONS_C
	default y

config MINIMAL_LIBC_OPTIMIZE_STRING_FOR_SIZE
	default n

config SYS_CLOCK_HW_CYCLES_PER_SEC
	default 16000000

config SYS_CLOCK_TICKS_PER_SEC
	default 1000

config MINIMAL_LIBC_OPTIMIZE_STRING_FOR_SIZE
	default n

config CLOCK_CONTROL
	default y

if BOOTLOADER_MCUBOOT

config HAS_FLASH_LOAD_OFFSET
	default y

config MCUBOOT_GENERATE_UNSIGNED_IMAGE
	default y

config MCUBOOT_GENERATE_CONFIRMED_IMAGE
	default y

config ROM_START_OFFSET
	default 0x20

endif # BOOTLOADER_MCUBOOT

endif # SOC_SERIES_ESP32C3

# Copyright (c) 2023 Espressif Systems (Shanghai) Co., Ltd.
# SPDX-License-Identifier: Apache-2.0

if SOC_SERIES_ESP32 || SOC_SERIES_ESP32S2 || SOC_SERIES_ESP32S3

# Xtensa default options for ESP32 family
config XTENSA_RESET_VECTOR
	default n

config XTENSA_USE_CORE_CRT1
	default n

config GEN_ISR_TABLES
	default y

config GEN_IRQ_VECTOR_TABLE
	default n

config CLOCK_CONTROL
	default y

config SYS_CLOCK_HW_CYCLES_PER_SEC
	default $(dt_node_int_prop_int,/cpus/cpu@0,clock-frequency)

config XTENSA_CCOUNT_HZ
	default SYS_CLOCK_HW_CYCLES_PER_SEC

config MINIMAL_LIBC_OPTIMIZE_STRING_FOR_SIZE
	default n

if BOOTLOADER_MCUBOOT

config HAS_FLASH_LOAD_OFFSET
	default y

config MCUBOOT_GENERATE_UNSIGNED_IMAGE
	default y

config MCUBOOT_GENERATE_CONFIRMED_IMAGE
	default y

config ROM_START_OFFSET
	default 0x20

endif # BOOTLOADER_MCUBOOT

endif # SOC_SERIES_ESP32 || SOC_SERIES_ESP32S2 || SOC_SERIES_ESP32S3
```

## soc/espressif/common/Kconfig.efuse
```kconfig
# Copyright (c) 2025 Espressif Systems (Shanghai) Co., Ltd.
# SPDX-License-Identifier: Apache-2.0

if SOC_FAMILY_ESPRESSIF_ESP32

config ESP32_EFUSE_VIRTUAL
	bool "Simulate eFuse operations in RAM"
	help
	  If "y" - The virtual mode is enabled and all eFuse operations (read and write) are redirected
	  to RAM instead of eFuse registers, all permanent changes (via eFuse) are disabled.

	  If it is "y", then SECURE_FLASH_ENCRYPTION_MODE_RELEASE cannot be used.
	  Because the EFUSE VIRT mode is for testing only.

	  During startup, the eFuses are copied into RAM. This mode is useful for fast tests.

config ESP32_EFUSE_VIRTUAL_KEEP_IN_FLASH
	bool "Keep eFuses in flash"
	depends on ESP32_EFUSE_VIRTUAL
	help
	  In addition to the "Simulate eFuse operations in RAM" option, this option just adds
	  a feature to keep eFuses after reboots in flash memory. To use this mode the partition_table
	  should have the `sys_partition` partition.

	  During startup, the eFuses are copied from flash or,
	  in case if flash is empty, from real eFuse to RAM and then update flash.
	  This mode is useful when need to keep changes after reboot
	  (testing secure_boot and flash_encryption).

config ESP32_EFUSE_VIRTUAL_OFFSET
	hex
	depends on ESP32_EFUSE_VIRTUAL_KEEP_IN_FLASH
	default $(dt_nodelabel_reg_addr_hex,sys_partition) if $(dt_nodelabel_exists,sys_partition)
	default 0x0

config ESP32_EFUSE_VIRTUAL_SIZE
	hex
	depends on ESP32_EFUSE_VIRTUAL_KEEP_IN_FLASH
	default 0x2000 if $(dt_nodelabel_exists,sys_partition)
	default 0x0

config ESP32_EFUSE_MAX_BLK_LEN
	int
	default 192 if SOC_SERIES_ESP32
	default 256

endif # SOC_FAMILY_ESPRESSIF_ESP32
```
