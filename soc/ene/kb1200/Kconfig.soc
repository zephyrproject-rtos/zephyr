## soc/espressif/esp32c3/Kconfig.rtc
```kconfig
# Copyright (c) 2024 Espressif Systems (Shanghai) Co., Ltd.
# SPDX-License-Identifier: Apache-2.0

if SOC_SERIES_ESP32C3

choice RTC_CLK_SRC
	prompt "RTC clock source"
	default RTC_CLK_SRC_INT_RC
	help
	  Choose which clock is used as RTC clock source.

config RTC_CLK_SRC_INT_RC
	bool "Internal 136kHz RC oscillator"

config RTC_CLK_SRC_EXT_CRYS
	bool "External 32kHz crystal"
	select ESP_SYSTEM_RTC_EXT_XTAL

config RTC_CLK_SRC_EXT_OSC
	bool "External 32kHz oscillator at 32K_XP pin"
	select ESP_SYSTEM_RTC_EXT_OSC

config RTC_CLK_SRC_INT_8MD256
	bool "Internal 17.5MHz oscillator, divided by 256"

endchoice # ESP32C3_RTC_CLK_SRC

config RTC_CLK_CAL_CYCLES
	int "Number of cycles for RTC_SLOW_CLK calibration"
	default 3000 if RTC_CLK_SRC_EXT_CRYS || RTC_CLK_SRC_EXT_OSC || RTC_CLK_SRC_INT_8MD256
	default 1024 if RTC_CLK_SRC_INT_RC
	range 0 27000 if RTC_CLK_SRC_EXT_CRYS || RTC_CLK_SRC_EXT_OSC || RTC_CLK_SRC_INT_8MD256
	range 0 32766 if RTC_CLK_SRC_INT_RC
	help
	  When the startup code initializes RTC_SLOW_CLK, it can perform
	  calibration by comparing the RTC_SLOW_CLK frequency with main XTAL
	  frequency. This option sets the number of RTC_SLOW_CLK cycles measured
	  by the calibration routine. Higher numbers increase calibration
	  precision, which may be important for applications which spend a lot of
	  time in deep sleep. Lower numbers reduce startup time.

	  When this option is set to 0, clock calibration will not be performed at
	  startup, and approximate clock frequencies will be assumed:

	  - 150000 Hz if internal RC oscillator is used as clock source. For this use value 1024.
	  - 32768 Hz if the 32k crystal oscillator is used. For this use value 3000 or more.
	    In case more value will help improve the definition of the launch of the crystal.
	    If the crystal could not start, it will be switched to internal RC.

config ESP_SYSTEM_RTC_EXT_XTAL_BOOTSTRAP_CYCLES
	int "Bootstrap cycles for external 32kHz crystal"
	depends on ESP_SYSTEM_RTC_EXT_XTAL
	default 0
	range 0 32768
	help
	  To reduce the startup time of an external RTC crystal,
	  we bootstrap it with a 32kHz square wave for a fixed number of cycles.
	  Setting 0 will disable bootstrapping (if disabled, the crystal may take
	  longer to start up or fail to oscillate under some conditions).

	  If this value is too high, a faulty crystal may initially start and then fail.
	  If this value is too low, an otherwise good crystal may not start.

	  To accurately determine if the crystal has started,
	  set a larger "Number of cycles for RTC_SLOW_CLK calibration" (about 3000).

endif # SOC_SERIES_ESP32C3
```

## soc/espressif/esp32c3/Kconfig.soc
```kconfig
# Copyright (c) 2023 Espressif Systems (Shanghai) Co., Ltd.
# SPDX-License-Identifier: Apache-2.0

config SOC_SERIES_ESP32C3
	bool
	select SOC_FAMILY_ESPRESSIF_ESP32
	help
	  ESP32C3

config SOC_ESP32C3
	bool
	select SOC_SERIES_ESP32C3
	help
	  ESP32C3

config SOC_SERIES
	default "esp32c3" if SOC_SERIES_ESP32C3

config SOC
	default "esp32c3" if SOC_SERIES_ESP32C3
```

## soc/espressif/esp32c5/Kconfig.soc
```kconfig
# Copyright (c) 2026 Espressif Systems (Shanghai) Co., Ltd.
# SPDX-License-Identifier: Apache-2.0

config SOC_SERIES_ESP32C5
	bool
	select SOC_FAMILY_ESPRESSIF_ESP32

config SOC_ESP32_C5_WROOM_1_N8R4
	bool
	select SOC_ESP32C5

config SOC_ESP32C5
	bool
	select SOC_SERIES_ESP32C5

config SOC_ESP32C5_HPCORE
	bool
	help
	  This hidden configuration defines that build is targeted for HP CORE.

config SOC_ESP32C5_LPCORE
	bool
	help
	  This hidden configuration defines that build is targeted for LP CORE.

config SOC_SERIES
	default "esp32c5" if SOC_SERIES_ESP32C5

config SOC
	default "esp32c5" if SOC_ESP32C5

config SOC_PART_NUMBER
	default "ESP32_C5_WROOM_1_N8R4" if SOC_ESP32_C5_WROOM_1_N8R4
```

## soc/espressif/esp32c6/Kconfig.soc
```kconfig
# Copyright (c) 2024 Espressif Systems (Shanghai) Co., Ltd.
# SPDX-License-Identifier: Apache-2.0

config SOC_SERIES_ESP32C6
	bool
	select SOC_FAMILY_ESPRESSIF_ESP32

config SOC_ESP32C6
	bool
	select SOC_SERIES_ESP32C6

config SOC_ESP32C6_HPCORE
	bool
	help
	  This hidden configuration defines that build is targeted for HP CORE.

config SOC_ESP32C6_LPCORE
	bool
	help
	  This hidden configuration defines that build is targeted for LP CORE.

config SOC_SERIES
	default "esp32c6" if SOC_SERIES_ESP32C6

config SOC
	default "esp32c6" if SOC_ESP32C6
```

## soc/espressif/esp32h2/Kconfig
```kconfig
# Copyright (c) 2025 Espressif Systems (Shanghai) Co., Ltd.
# SPDX-License-Identifier: Apache-2.0

config SOC_SERIES_ESP32H2
	select RISCV
	select RISCV_SOC_HAS_GP_RELATIVE_ADDRESSING
	select DYNAMIC_INTERRUPTS
	select CLOCK_CONTROL
	select PINCTRL
	select HAS_ESPRESSIF_HAL
	select HAS_PM
	select HAS_POWEROFF
```

## soc/espressif/esp32h2/Kconfig.soc
```kconfig
# Copyright (c) 2025 Espressif Systems (Shanghai) Co., Ltd.
# SPDX-License-Identifier: Apache-2.0

config SOC_SERIES_ESP32H2
	bool
	select SOC_FAMILY_ESPRESSIF_ESP32

config SOC_ESP32_H2_MINI_H2
	bool
	select SOC_ESP32H2

config SOC_ESP32_H2_MINI_H4
	bool
	select SOC_ESP32H2

config SOC_ESP32_H2_WROOM_02C_H2
	bool
	select SOC_ESP32H2

config SOC_ESP32_H2_WROOM_02C_H4
	bool
	select SOC_ESP32H2

config SOC_ESP32H2
	bool
	select SOC_SERIES_ESP32H2

config SOC_SERIES
	default "esp32h2" if SOC_SERIES_ESP32H2

config SOC
	default "esp32h2" if SOC_ESP32H2

config SOC_PART_NUMBER
	default "ESP32_H2_MINI_1_H2S" if SOC_ESP32_H2_MINI_H2
	default "ESP32_H2_MINI_1_H4S" if SOC_ESP32_H2_MINI_H4
	default "ESP32_H2_WROOM_02C_H2S" if SOC_ESP32_H2_WROOM_02C_H2
	default "ESP32_H2_WROOM_02C_H4S" if SOC_ESP32_H2_WROOM_02C_H4
```

## soc/espressif/esp32p4/Kconfig
```kconfig
# Copyright (c) 2026 Espressif Systems (Shanghai) Co., Ltd.
# SPDX-License-Identifier: Apache-2.0

config SOC_SERIES_ESP32P4
	select RISCV
	select RISCV_SOC_HAS_GP_RELATIVE_ADDRESSING
	select DYNAMIC_INTERRUPTS if SOC_ESP32P4_HPCORE
	select CLOCK_CONTROL if SOC_ESP32P4_HPCORE
	select PINCTRL if SOC_ESP32P4_HPCORE
	select HAS_ESPRESSIF_HAL
	select CPU_HAS_DCACHE if SOC_ESP32P4_HPCORE
	select HAS_PM
	select HAS_POWEROFF
	select ARCH_HAS_NOCACHE_MEMORY_SUPPORT if SOC_ESP32P4_HPCORE
	select SOC_PER_CORE_INIT_HOOK if SOC_ESP32P4_HPCORE && SMP

if SOC_SERIES_ESP32P4

menu "Cache config"

choice ESP32_CACHE_L2_SIZE_CHOICE
	prompt "L2 cache size"
	default ESP32_CACHE_L2_128KB
	help
	  L2 cache size to be set on application startup. The L2 cache is
	  carved out of HP SRAM, so a larger cache reduces usable SRAM.

config ESP32_CACHE_L2_128KB
	bool "128KB"

config ESP32_CACHE_L2_256KB
	bool "256KB"

config ESP32_CACHE_L2_512KB
	bool "512KB"

endchoice

config ESP32_CACHE_L2_SIZE
	hex
	default 0x20000 if ESP32_CACHE_L2_128KB
	default 0x40000 if ESP32_CACHE_L2_256KB
	default 0x80000 if ESP32_CACHE_L2_512KB

choice ESP32_CACHE_L2_LINE_SIZE_CHOICE
	prompt "L2 cache line size"
	default ESP32_CACHE_L2_LINE_64B if ESP32_CACHE_L2_128KB
	default ESP32_CACHE_L2_LINE_64B if ESP32_CACHE_L2_256KB
	default ESP32_CACHE_L2_LINE_128B if ESP32_CACHE_L2_512KB
	help
	  L2 cache line size to be set on application startup. 64B lines
	  are only valid for 128KB and 256KB cache sizes; the 512KB cache
	  is fixed to 128B lines.

config ESP32_CACHE_L2_LINE_64B
	bool "64 Bytes"
	depends on ESP32_CACHE_L2_128KB || ESP32_CACHE_L2_256KB

config ESP32_CACHE_L2_LINE_128B
	bool "128 Bytes"

endchoice

config ESP32_CACHE_L2_LINE_SIZE
	int
	default 64 if ESP32_CACHE_L2_LINE_64B
	default 128 if ESP32_CACHE_L2_LINE_128B

endmenu # Cache config

rsource "Kconfig.caps"

config ESP32P4_EMAC
	bool
	default y if ETH_ESP32
	default y if MDIO_ESP32
	help
	  Hidden option to enable the ESP32-P4 Ethernet
	  MAC driver. Both Ethernet and MDIO depend on
	  this driver. This option allows enabling MDIO
	  independently of Ethernet.

config SOC_ESP32P4_REV_MIN_FULL
	int
	default 103 if SOC_ESP32P4_REV_1_3
	default 300 if SOC_ESP32P4_REV_3_0
	default 301 if SOC_ESP32P4_REV_3_1
	default 301
	help
	  Minimum supported ESP32-P4 chip revision in major * 100 + minor
	  format, matching what efuse_hal_chip_revision() returns at runtime.
	  Derived from the SOC_ESP32P4_REV_* symbol the board selects; defaults
	  to v3.1 (301), the floor of the v3.x family, when none is selected.

endif # SOC_SERIES_ESP32P4
```

## soc/espressif/esp32p4/Kconfig.soc
```kconfig
# Copyright (c) 2026 Espressif Systems (Shanghai) Co., Ltd.
# SPDX-License-Identifier: Apache-2.0

config SOC_SERIES_ESP32P4
	bool
	select SOC_FAMILY_ESPRESSIF_ESP32

config SOC_ESP32P4
	bool
	select SOC_SERIES_ESP32P4

#
# ESP32-P4 silicon revision selection.
#
# These are hidden symbols selected by a board's Kconfig.defconfig to
# declare the minimum supported chip revision. The numeric revision value
# (major * 100 + minor) is derived from these in the hal_espressif Kconfig,
# which owns the revision-to-build plumbing.
#
# v1.3 is the only pre-v3 revision: the mintthresh CSR, the SRAM layout and
# the default L2 cache size differ on it from the v3.x parts, so the code
# paths for those gate on SOC_ESP32P4_REV_1_3 directly.
#
# REV_3_1 is the floor for the whole v3.x family (v3.1 and above): v3.1+
# silicon is code-identical and excludes the v3.0-only hardware workarounds.
# There is intentionally no separate v3.2 symbol.
#
config SOC_ESP32P4_REV_1_3
	bool
	depends on SOC_ESP32P4

config SOC_ESP32P4_REV_3_0
	bool
	depends on SOC_ESP32P4

config SOC_ESP32P4_REV_3_1
	bool
	depends on SOC_ESP32P4

config SOC_ESP32P4_HPCORE
	bool
	select SOC_ESP32P4
	help
	  This hidden configuration defines that build is targeted for HP CORE.

config SOC_ESP32P4_LPCORE
	bool
	select SOC_ESP32P4
	help
	  This hidden configuration defines that build is targeted for LP CORE.

config SOC_SERIES
	default "esp32p4" if SOC_SERIES_ESP32P4

config SOC
	default "esp32p4" if SOC_ESP32P4
```

## soc/espressif/esp32s2/Kconfig
```kconfig
# Copyright (c) 2023 Espressif Systems (Shanghai) Co., Ltd.
# SPDX-License-Identifier: Apache-2.0

config SOC_SERIES_ESP32S2
	select XTENSA
	select ATOMIC_OPERATIONS_C
	select DYNAMIC_INTERRUPTS
	select CLOCK_CONTROL
	select PINCTRL
	select HAS_ESPRESSIF_HAL
	select ARCH_SUPPORTS_COREDUMP
	select HAS_PM
	select HAS_POWEROFF

if SOC_SERIES_ESP32S2

menu "Cache config"

choice
	prompt "Instruction cache line size"
	default ESP32S2_INSTRUCTION_CACHE_LINE_32B

	config ESP32S2_INSTRUCTION_CACHE_LINE_16B
		bool "16 Bytes"

	config ESP32S2_INSTRUCTION_CACHE_LINE_32B
		bool "32 Bytes"

endchoice

choice
	prompt "Instruction cache size"
	default ESP32S2_INSTRUCTION_CACHE_8KB

	config ESP32S2_INSTRUCTION_CACHE_8KB
		bool "8KB instruction cache size"

	config ESP32S2_INSTRUCTION_CACHE_16KB
		bool "16KB instruction cache size"

endchoice

choice ESP32S2_DATA_CACHE_SIZE
	prompt "Data cache size"
	default ESP32S2_DATA_CACHE_8KB
	help
		Data cache size to be set on application startup.
	config ESP32S2_DATA_CACHE_0KB
		depends on !ESP_SPIRAM
		bool "0KB"
	config ESP32S2_DATA_CACHE_8KB
		bool "8KB"
	config ESP32S2_DATA_CACHE_16KB
		bool "16KB"

endchoice

choice
	prompt "Data cache line size"
	default ESP32S2_DATA_CACHE_LINE_32B

	config ESP32S2_DATA_CACHE_LINE_16B
		bool "16 Bytes"

	config ESP32S2_DATA_CACHE_LINE_32B
		bool "32 Bytes"

endchoice

config ESP32S2_INSTRUCTION_CACHE_SIZE
	hex
	default 0x4000 if ESP32S2_INSTRUCTION_CACHE_16KB
	default 0x2000

config ESP32S2_DATA_CACHE_SIZE
	hex
	default 0x2000 if ESP32S2_DATA_CACHE_8KB
	default 0x4000 if ESP32S2_DATA_CACHE_16KB
	default 0x0000

endmenu  # Cache config

endif # SOC_SERIES_ESP32S2
```

## soc/espressif/esp32s2/Kconfig.caps
```kconfig
# Copyright (c) 2026 Espressif Systems (Shanghai) Co., Ltd.
# SPDX-License-Identifier: Apache-2.0

config ESP32_SOC_FLASH_SUPPORTED
	bool
	default y

config ESP32_SOC_PM_SUPPORT_VDDSDIO_PD
	bool
	default y
```

## soc/espressif/esp32s2/Kconfig.defconfig
```kconfig
# Copyright (c) 2023 Espressif Systems (Shanghai) Co., Ltd.
# SPDX-License-Identifier: Apache-2.0

if SOC_SERIES_ESP32S2

configdefault CACHE_MANAGEMENT
	default y

choice CACHE_TYPE
	default EXTERNAL_CACHE if CACHE_MANAGEMENT
endchoice

config MAIN_STACK_SIZE
	default 2048

if PM && TICKLESS_KERNEL

choice XTENSA_TIMER_LPM_TIMER
	default XTENSA_TIMER_LPM_TIMER_HOOK
endchoice

endif # PM && TICKLESS_KERNEL

endif # SOC_SERIES_ESP32S2
```

## soc/espressif/esp32s2/Kconfig.defconfig.series
```kconfig
# Copyright (c) 2023 Espressif Systems (Shanghai) Co., Ltd.
# SPDX-License-Identifier: Apache-2.0

if SOC_SERIES_ESP32S2

config SYS_CLOCK_HW_CYCLES_PER_SEC
	default $(dt_node_int_prop_int,/cpus/cpu@0,clock-frequency)

config XTENSA_CCOUNT_HZ
	default SYS_CLOCK_HW_CYCLES_PER_SEC

config MP_MAX_NUM_CPUS
	default 1

config ISR_STACK_SIZE
	default 2048

config ESPTOOLPY_FLASHFREQ_80M
	default y

config FLASH_SIZE
	default $(dt_node_reg_size_int,/soc/flash-controller@3f402000/flash@0,0)

config FLASH_BASE_ADDRESS
	default $(dt_node_reg_addr_hex,/soc/flash-controller@3f402000/flash@0)

endif # SOC_SERIES_ESP32S2
```

## soc/espressif/esp32s2/Kconfig.mac
```kconfig
# Copyright (c) 2024 Espressif Systems (Shanghai) Co., Ltd.
# SPDX-License-Identifier: Apache-2.0

if SOC_SERIES_ESP32S2

choice ESP32S2_UNIVERSAL_MAC_ADDRESSES
	bool "Number of universally administered (by IEEE) MAC address"
	default ESP32S2_UNIVERSAL_MAC_ADDRESSES_TWO
	help
	  Configure the number of universally administered (by IEEE) MAC addresses.
	  During initialization, MAC addresses for each network interface are generated or
	  derived from a single base MAC address. If the number of universal MAC addresses is two,
	  all interfaces (WiFi station, WiFi softap) receive a universally administered MAC
	  address.
	  They are generated sequentially by adding 0, and 1 (respectively) to the final octet of
	  the base MAC address. If the number of universal MAC addresses is one, only WiFi station
	  receives a universally administered MAC address.
	  The WiFi softap receives local MAC addresses. It's derived from the universal WiFi
	  station MAC addresses.
	  When using the default (Espressif-assigned) base MAC address, either setting can be used.
	  When using a custom universal MAC address range, the correct setting will depend on the
	  allocation of MAC addresses in this range (either 1 or 2 per device).

config ESP32S2_UNIVERSAL_MAC_ADDRESSES_ONE
	bool "One"
	select ESP_MAC_UNIVERSAL_MAC_ADDRESSES_ONE
	select ESP_MAC_ADDR_UNIVERSE_WIFI_STA

config ESP32S2_UNIVERSAL_MAC_ADDRESSES_TWO
	bool "Two"
	select ESP_MAC_UNIVERSAL_MAC_ADDRESSES_TWO
	select ESP_MAC_ADDR_UNIVERSE_WIFI_STA
	select ESP_MAC_ADDR_UNIVERSE_WIFI_AP

endchoice # ESP32S2_UNIVERSAL_MAC_ADDRESSES

config ESP32S2_UNIVERSAL_MAC_ADDRESSES
	int
	default 1 if ESP32S2_UNIVERSAL_MAC_ADDRESSES_ONE
	default 2 if ESP32S2_UNIVERSAL_MAC_ADDRESSES_TWO

endif # SOC_SERIES_ESP32S2
```
