## soc/espressif/common/Kconfig.flash
```kconfig
# Copyright (c) 2024 Espressif Systems (Shanghai) Co., Ltd.
# SPDX-License-Identifier: Apache-2.0

if SOC_FAMILY_ESPRESSIF_ESP32

config MMU_PAGE_SIZE
	hex
	default 0x10000

config SPI_FLASH_VENDOR_MXIC_SUPPORTED
	bool
	default y

config SPI_FLASH_SUPPORT_ISSI_CHIP
	bool "ISSI"
	default y
	help
	  Enable this to support auto detection of ISSI chips if chip vendor not directly
	  given by ``chip_drv`` member of the chip struct. This adds support for variant
	  chips, however will extend detecting time.

config SPI_FLASH_SUPPORT_MXIC_CHIP
	bool "MXIC"
	default y
	help
	  Enable this to support auto detection of MXIC chips if chip vendor not directly
	  given by ``chip_drv`` member of the chip struct. This adds support for variant
	  chips, however will extend detecting time.

config SPI_FLASH_SUPPORT_GD_CHIP
	bool "GigaDevice"
	default y
	help
	  Enable this to support auto detection of GD (GigaDevice) chips if chip vendor not
	  directly given by ``chip_drv`` member of the chip struct. If you are using Wrover
	  modules, please don't disable this, otherwise your flash may not work in 4-bit
	  mode.

	  This adds support for variant chips, however will extend detecting time and image
	  size. Note that the default chip driver supports the GD chips with product ID
	  60H.

config SPI_FLASH_SUPPORT_WINBOND_CHIP
	bool "Winbond"
	default y
	help
	  Enable this to support auto detection of Winbond chips if chip vendor not directly
	  given by ``chip_drv`` member of the chip struct. This adds support for variant
	  chips, however will extend detecting time.

config SPI_FLASH_SUPPORT_BOYA_CHIP
	bool "BOYA"
	default y if !SOC_SERIES_ESP32
	help
	  Enable this to support auto detection of BOYA chips if chip vendor not directly
	  given by ``chip_drv`` member of the chip struct. This adds support for variant
	  chips, however will extend detecting time.

config SPI_FLASH_SUPPORT_TH_CHIP
	bool "TH"
	default y if !SOC_SERIES_ESP32
	help
	  Enable this to support auto detection of TH chips if chip vendor not directly
	  given by ``chip_drv`` member of the chip struct. This adds support for variant
	  chips, however will extend detecting time.

config SPI_FLASH_SUPPORT_MXIC_OPI_CHIP
	bool "mxic (opi)"
	depends on SOC_SERIES_ESP32S3
	default y
	help
	  Enable this to support auto detection of Octal MXIC chips if chip vendor not directly
	  given by ``chip_drv`` member of the chip struct. This adds support for variant
	  chips, however will extend detecting time.

config SPI_FLASH_ROM_DRIVER_PATCH
	bool "SPI flash ROM driver patched functions"
	default y
	help
	  Enable this flag to use patched versions of SPI flash ROM driver functions.
	  This option should be enabled, if any one of the following is true: (1) need to write
	  to flash on ESP32-D2WD; (2) main SPI flash is connected to non-default pins; (3) main
	  SPI flash chip is manufactured by ISSI.

config BOOTLOADER_FLASH_XMC_SUPPORT
	bool "Support flash chips of XMC (READ HELP FIRST)"
	default y
	help
	  Perform the startup flow recommended by XMC. Please consult XMC for the details of this flow.
	  XMC chips will be forbidden to be used, when this option is disabled.

	  DON'T DISABLE THIS UNLESS YOU KNOW WHAT YOU ARE DOING.

choice BOOTLOADER_VDDSDIO_BOOST
	bool "VDDSDIO LDO voltage"
	default BOOTLOADER_VDDSDIO_BOOST_1_9V
	depends on !SOC_SERIES_ESP32C2 && !SOC_SERIES_ESP32C3 && !SOC_SERIES_ESP32C6
	help
	  If this option is enabled, and VDDSDIO LDO is set to 1.8V (using eFuse
	  or MTDI bootstrapping pin), bootloader will change LDO settings to
	  output 1.9V instead. This helps prevent flash chip from browning out
	  during flash programming operations.

	  This option has no effect if VDDSDIO is set to 3.3V, or if the internal
	  VDDSDIO regulator is disabled via eFuse.

	config BOOTLOADER_VDDSDIO_BOOST_1_8V
		bool "1.8V"
		depends on !ESPTOOLPY_FLASHFREQ_80M
	config BOOTLOADER_VDDSDIO_BOOST_1_9V
		bool "1.9V"
endchoice

config BOOTLOADER_REGION_PROTECTION_ENABLE
	bool "Protect unmapped memory regions from unintended accesses"
	default y
	help
	  Protects the unmapped memory regions of the entire address space from unintended accesses.
	  This will ensure that an exception will be triggered whenever the CPU performs a memory
	  operation on unmapped regions of the address space.

config SPI_FLASH_HPM_ENABLE
	bool
	depends on SOC_SERIES_ESP32S3
	default n
	help
	  This option is invisible, and will be selected automatically
	  when ``ESPTOOLPY_FLASHFREQ_120M`` is selected.

endif # SOC_FAMILY_ESPRESSIF_ESP32
```

## soc/espressif/common/Kconfig.spiram
```kconfig
# Copyright (c) 2024 Espressif Systems (Shanghai) Co., Ltd.
# SPDX-License-Identifier: Apache-2.0

if SOC_SERIES_ESP32 || SOC_SERIES_ESP32S2 || SOC_SERIES_ESP32S3

ESP32_PSRAM0_NODE_PATH := $(dt_nodelabel_path,psram0)

config ESP_SPIRAM
	bool "Support for external, SPI-connected RAM"
	default n if MCUBOOT
	default n if ESP32_USE_UNSUPPORTED_REVISION && SOC_SERIES_ESP32
	select SHARED_MULTI_HEAP
	help
	  This enables support for an external SPI RAM chip, connected in
	  parallel with the main SPI flash chip.

menu "SPI RAM config"
	depends on ESP_SPIRAM

config ESP_SPIRAM_HEAP_SIZE
	int "Size of SPIRAM heap"
	default 262134 if SYS_HEAP_SMALL_ONLY
	default 1048576 if !SYS_HEAP_SMALL_ONLY
	help
	  Specify size of SPIRAM heap.

config ESP_SPIRAM_MEMTEST
	bool "Run memory test on SPI RAM initialization"
	default y
	help
	  Runs a memory test on initialization. Disable this for faster startup.

choice SPIRAM_MODE
	prompt "Mode (QUAD/OCT) of SPI RAM chip in use"
	default SPIRAM_MODE_QUAD

config SPIRAM_MODE_QUAD
	bool "Quad Mode PSRAM"

config SPIRAM_MODE_OCT
	bool "Octal Mode PSRAM"
	depends on SOC_SERIES_ESP32S3

endchoice # SPIRAM_MODE

choice SPIRAM_TYPE
	prompt "Type of SPI RAM chip in use"
	default SPIRAM_TYPE_ESPPSRAM16 if SPIRAM_MODE_QUAD
	default SPIRAM_TYPE_ESPPSRAM64

config SPIRAM_TYPE_ESPPSRAM16
	bool "ESP-PSRAM16 or APS1604"
	depends on SPIRAM_MODE_QUAD && (ESP_SPIRAM_SIZE = 2097152)

config SPIRAM_TYPE_ESPPSRAM32
	bool "ESP-PSRAM32 or IS25WP032"
	depends on SPIRAM_MODE_QUAD && (ESP_SPIRAM_SIZE = 4194304)

config SPIRAM_TYPE_ESPPSRAM64
	bool "ESP-PSRAM64, LY68L6400 or APS6408"
	depends on (ESP_SPIRAM_SIZE = 8388608)

endchoice # SPIRAM_TYPE

config ESP_SPIRAM_SIZE
	int "Size of SPIRAM part"
	default $(dt_node_int_prop_int,$(ESP32_PSRAM0_NODE_PATH),size) if $(dt_nodelabel_enabled,psram0)
	default 0
	help
	  Specify size of SPIRAM part.
	  NOTE: In ESP32, if SPIRAM size is greater than 4MB,
	  only lower 4MB can be allocated using k_malloc().

choice SPIRAM_SPEED
	prompt "Set RAM clock speed"
	default SPIRAM_SPEED_40M
	help
	  Select the speed for the SPI RAM chip.

config SPIRAM_SPEED_20M
	bool "20MHz clock speed"
	depends on SOC_SERIES_ESP32S2

config SPIRAM_SPEED_26M
	bool "26MHz clock speed"
	depends on SOC_SERIES_ESP32S2

config SPIRAM_SPEED_40M
	bool "40MHz clock speed"

config SPIRAM_SPEED_80M
	bool "80MHz clock speed"
	depends on ESPTOOLPY_FLASHFREQ_80M

config SPIRAM_SPEED_120M
	bool "120MHz clock speed"
	depends on SPIRAM_MODE_QUAD && SOC_SERIES_ESP32S3

endchoice # SPIRAM_SPEED

config SPIRAM_SPEED
	int
	default 120 if SPIRAM_SPEED_120M
	default 80 if SPIRAM_SPEED_80M
	default 40 if SPIRAM_SPEED_40M || SPIRAM_SPEED_26M || SPIRAM_SPEED_20M

config SPIRAM_CLK_IO
	int
	depends on SOC_SERIES_ESP32S2 || SOC_SERIES_ESP32S3
	default 30

config SPIRAM_CS_IO
	int
	depends on SOC_SERIES_ESP32S2 || SOC_SERIES_ESP32S3
	default 26

config SPIRAM_FETCH_INSTRUCTIONS
	bool "Move Instructions in Flash to PSRAM"
	depends on SOC_SERIES_ESP32S2 || SOC_SERIES_ESP32S3
	help
	  If enabled, instructions in flash will be moved into PSRAM on startup.
	  If SPIRAM_RODATA is also enabled, code that requires execution during an SPI1 Flash operation
	  can forgo being placed in IRAM, thus optimizing RAM usage (see External RAM documentation
	  for more details).

config SPIRAM_RODATA
	bool "Move Read-Only Data in Flash to PSRAM"
	depends on SOC_SERIES_ESP32S2 || SOC_SERIES_ESP32S3
	help
	  If enabled, rodata in flash will be moved into PSRAM on startup.
	  If SPIRAM_FETCH_INSTRUCTIONS is also enabled, code that requires execution during an SPI1 Flash operation
	  can forgo being placed in IRAM, thus optimizing RAM usage (see External RAM documentation
	  for more details).

config SPIRAM_ECC_ENABLE
	bool "Allow enabling SPI RAM ECC"
	depends on SPIRAM_MODE_OCT && SOC_SERIES_ESP32S3
	help
	  Enable MSPI Error-Correcting Code function when accessing SPIRAM.
	  If enabled, 1/16 of the SPI RAM total size will be reserved for error-correcting code.

if SOC_SERIES_ESP32

menu "PSRAM clock and cs IO for ESP32-DOWD"

config D0WD_PSRAM_CLK_IO
	int "PSRAM CLK IO number"
	range 0 33
	default 17
	help
	  The PSRAM CLOCK IO can be any unused GPIO, user can config it based on hardware design. If user use
	  1.8V flash and 1.8V psram, this value can only be one of 6, 7, 8, 9, 10, 11, 16, 17.

config D0WD_PSRAM_CS_IO
	int "PSRAM CS IO number"
	range 0 33
	default 16
	help
	  The PSRAM CS IO can be any unused GPIO, user can config it based on hardware design. If user use
	  1.8V flash and 1.8V psram, this value can only be one of 6, 7, 8, 9, 10, 11, 16, 17.

endmenu # PSRAM clock and cs IO for ESP32-DOWD

menu "PSRAM clock and cs IO for ESP32-D2WD"

config D2WD_PSRAM_CLK_IO
	int "PSRAM CLK IO number"
	range 0 33
	default 9
	help
	  User can config it based on hardware design. For ESP32-D2WD chip, the psram can only be 1.8V psram,
	  so this value can only be one of 6, 7, 8, 9, 10, 11, 16, 17.

config D2WD_PSRAM_CS_IO
	int "PSRAM CS IO number"
	range 0 33
	default 10
	help
	  User can config it based on hardware design. For ESP32-D2WD chip, the psram can only be 1.8V psram,
	  so this value can only be one of 6, 7, 8, 9, 10, 11, 16, 17.

endmenu # PSRAM clock and cs IO for ESP32-D2WD

menu "PSRAM clock and cs IO for ESP32-PICO"

config PICO_PSRAM_CS_IO
	int "PSRAM CS IO number"
	range 0 33
	default 10
	help
	  The PSRAM CS IO can be any unused GPIO, user can config it based on hardware design.

	  For ESP32-PICO chip, the psram share clock with flash, so user do not need to configure the clock
	  IO For the reference hardware design, please refer to
	  https://www.espressif.com/sites/default/files/documentation/esp32-pico-d4_datasheet_en.pdf

endmenu # PSRAM clock and cs IO for ESP32-PICO

config SPIRAM_CUSTOM_SPIWP_SD3_PIN
	bool "Use custom SPI PSRAM WP(SD3) Pin when flash pins set in eFuse (read help)"
	depends on ESPTOOLPY_FLASHMODE_DIO || ESPTOOLPY_FLASHMODE_DOUT
	help
	  This setting is only used if the SPI flash pins have been overridden by setting the eFuses
	  SPI_PAD_CONFIG_xxx, and the SPI flash mode is DIO or DOUT.

	  When this is the case, the eFuse config only defines 3 of the 4 Quad I/O data pins. The WP pin (aka
	  ESP32 pin "SD_DATA_3" or SPI flash pin "IO2") is not specified in eFuse. The psram only has QPI
	  mode, so a WP pin setting is necessary.

	  If this config item is set to N (default), the correct WP pin will be automatically used for any
	  Espressif chip or module with integrated flash. If a custom setting is needed, set this config item
	  to Y and specify the GPIO number connected to the WP pin.

	  When flash mode is set to QIO or QOUT, the PSRAM WP pin will be set the same as the SPI Flash WP pin
	  configured in the bootloader.

config SPIRAM_SPIWP_SD3_PIN
	int "Custom SPI PSRAM WP(SD3) Pin"
	depends on SPIRAM_CUSTOM_SPIWP_SD3_PIN
	range 0 33
	default 7
	help
	  The option "Use custom SPI PSRAM WP(SD3) pin" must be set or this value is ignored

	  If burning a customized set of SPI flash pins in eFuse and using DIO or DOUT mode for flash, set this
	  value to the GPIO number of the SPIRAM WP pin.

endif # SOC_SERIES_ESP32

endmenu # ESP_SPIRAM

endif # SOC_SERIES_ESP32 || SOC_SERIES_ESP32S2 || SOC_SERIES_ESP32S3
```

## soc/espressif/common/Kconfig.wifi
```kconfig
# Copyright (c) 2024 Espressif Systems (Shanghai) Co., Ltd.
# SPDX-License-Identifier: Apache-2.0

if SOC_FAMILY_ESPRESSIF_ESP32

menu "ESP32 Wi-Fi config"

config ESP_WIFI_MAX_THREAD_PRIORITY
	int "Maximum work queue thread priority"
	default 7
	help
	  Maximum priority of thread used for processing driver work queue items.

config ESP32_WIFI_TIMER_TASK_PRIO
	int "Wi-Fi timer task priority"
	default 2
	range 0 ESP_WIFI_MAX_THREAD_PRIORITY


config ESP32_PHY_MAX_WIFI_TX_POWER
	int "Max Wi-Fi/BLE TX power (dBm)"
	range 10 20
	default 20
	help
	  Set maximum transmit power for Wi-Fi radio. Actual transmit power for high
	  data rates may be lower than this setting.

config ESP32_PHY_MAX_TX_POWER
	int
	default ESP32_PHY_MAX_WIFI_TX_POWER

choice ESP_WIFI_HEAP
	prompt "Wifi adapter heap in use"
	default ESP_WIFI_HEAP_RUNTIME

	config ESP_WIFI_HEAP_RUNTIME
		bool "Wifi adapter use ESP runtime heap"
		depends on ESP_RUNTIME_HEAP

	config ESP_WIFI_HEAP_SPIRAM
		bool "Wifi adapter use SPIRAM heap"
		depends on ESP_SPIRAM

	config ESP_WIFI_HEAP_SYSTEM
		bool "Wifi adapter use system heap"

endchoice # ESP_WIFI_HEAP

endmenu # ESP32 Wi-Fi config

endif # SOC_FAMILY_ESPRESSIF_ESP32
```

## soc/espressif/esp32/Kconfig.soc
```kconfig
# Copyright (c) 2023 Espressif Systems (Shanghai) Co., Ltd.
# SPDX-License-Identifier: Apache-2.0

config SOC_SERIES_ESP32
	bool
	select SOC_FAMILY_ESPRESSIF_ESP32
	help
	  ESP32 Series

config SOC_ESP32
	bool
	select SOC_SERIES_ESP32
	help
	  ESP32

config SOC_ESP32_PROCPU
	bool
	help
	  This hidden configuration defines that build is targeted for PROCPU (core 0).

config SOC_ESP32_APPCPU
	bool
	help
	  This hidden configuration defines that build is targeted for APPCPU (core 1).

config SOC_SERIES
	default "esp32" if SOC_SERIES_ESP32

config SOC
	default "esp32" if SOC_SERIES_ESP32

config SOC_TOOLCHAIN_NAME
	string
	default "espressif_esp32" if SOC_SERIES_ESP32
```

## soc/espressif/esp32c2/Kconfig.soc
```kconfig
# Copyright (c) 2024 Espressif Systems (Shanghai) Co., Ltd.
# SPDX-License-Identifier: Apache-2.0

config SOC_SERIES_ESP32C2
	bool
	select SOC_FAMILY_ESPRESSIF_ESP32

config SOC_ESP32C2
	bool
	select SOC_SERIES_ESP32C2

config SOC_SERIES
	default "esp32c2" if SOC_SERIES_ESP32C2

config SOC
	default "esp32c2" if SOC_ESP32C2
```
