## soc/snps/qemu_arc/Kconfig.defconfig
```kconfig
# Copyright (c) 2020 Synopsys, Inc. All rights reserved.
# SPDX-License-Identifier: Apache-2.0

if SOC_QEMU_ARC

config SYS_CLOCK_HW_CYCLES_PER_SEC
	default 10000000

config RGF_NUM_BANKS
	default 1

config ARC_FIRQ
	default n

config NUM_IRQ_PRIO_LEVELS
	default 15

config NUM_IRQS
	default 26

# Technically ARC HS supports MPUv3, but not v2. But given MPUv3
# is the same as v2 but with minimal region size of 32 bytes, we
# may assume MPUv3 is just a subset of MPUv2.

config ARC_MPU_VER
	default 2

endif
```

## soc/snps/qemu_arc/Kconfig.soc
```kconfig
# Copyright (c) 2020 Synopsys, Inc. All rights reserved.
# SPDX-License-Identifier: Apache-2.0

config SOC_QEMU_ARC
	bool

config SOC_QEMU_ARC_EM
	bool
	select SOC_QEMU_ARC

config SOC_QEMU_ARC_HS
	bool
	select SOC_QEMU_ARC

config SOC_QEMU_ARC_HS5X
	bool
	select SOC_QEMU_ARC

config SOC_QEMU_ARC_HS6X
	bool
	select SOC_QEMU_ARC

config SOC_SERIES
	default "qemu_arc" if SOC_QEMU_ARC

config SOC
	default "qemu_arc_em" if SOC_QEMU_ARC_EM
	default "qemu_arc_hs" if SOC_QEMU_ARC_HS
	default "qemu_arc_hs5x" if SOC_QEMU_ARC_HS5X
	default "qemu_arc_hs6x" if SOC_QEMU_ARC_HS6X
```

## soc/soc_legacy/arc/snps_arc_hsdk4xd/Kconfig.defconfig
```kconfig
# Copyright (c) 2023 Synopsys, Inc. All rights reserved.
# SPDX-License-Identifier: Apache-2.0

if SOC_ARC_HSDK4XD

config SOC
	default "snps_arc_hsdk4xd"

config CPU_HS4X
	default y

config NUM_IRQ_PRIO_LEVELS
	# This processor supports 2 priority levels:
	# 0 for Fast Interrupts (FIRQs) and 1 for Regular Interrupts (IRQs).
	default 2

config NUM_IRQS
	# must be > the highest interrupt number used
	default 88

config RGF_NUM_BANKS
	# Actually cpu has 4 banks but zephys currently supports up to 2
	default 2

config SYS_CLOCK_HW_CYCLES_PER_SEC
	default 500000000

config ARC_FIRQ
	default y

config CODE_DENSITY
	default y

config ARCV2_TIMER_IRQ_PRIORITY
	default 1

config ARC_CONNECT
	default y

config MP_MAX_NUM_CPUS
	default 4

config UART_NS16550_ACCESS_WORD_ONLY
	default y
	depends on UART_NS16550

config ARC_HAS_ACCL_REGS
	default y

config ARC_EARLY_SOC_INIT
	default y

config ARC_HAS_STACK_CHECKING
	default n

endif # SOC_ARC_HS4XD
```

## soc/soc_legacy/arc/snps_nsim/Kconfig.defconfig
```kconfig
# Copyright (c) 2018 Synopsys, Inc. All rights reserved.
# SPDX-License-Identifier: Apache-2.0

if SOC_NSIM

config SOC
	default "snps_nsim"

config XIP
	default n

source "soc/soc_legacy/arc/snps_nsim/Kconfig.defconfig.em"
source "soc/soc_legacy/arc/snps_nsim/Kconfig.defconfig.em11d"
source "soc/soc_legacy/arc/snps_nsim/Kconfig.defconfig.em7d_v22"
source "soc/soc_legacy/arc/snps_nsim/Kconfig.defconfig.sem"
source "soc/soc_legacy/arc/snps_nsim/Kconfig.defconfig.hs"
source "soc/soc_legacy/arc/snps_nsim/Kconfig.defconfig.hs_smp"
source "soc/soc_legacy/arc/snps_nsim/Kconfig.defconfig.vpx5"
source "soc/soc_legacy/arc/snps_nsim/Kconfig.defconfig.hs6x"
source "soc/soc_legacy/arc/snps_nsim/Kconfig.defconfig.hs6x_smp"
source "soc/soc_legacy/arc/snps_nsim/Kconfig.defconfig.hs_mpuv6"
source "soc/soc_legacy/arc/snps_nsim/Kconfig.defconfig.hs5x"
source "soc/soc_legacy/arc/snps_nsim/Kconfig.defconfig.hs5x_smp"

endif # SOC_NSIM
```

## soc/soc_legacy/arc/snps_nsim/Kconfig.defconfig.hs5x_smp
```kconfig
# Copyright (c) 2022 Synopsys, Inc.
# SPDX-License-Identifier: Apache-2.0

if SOC_NSIM_HS5X_SMP

config CPU_HS5X
	default y

config NUM_IRQ_PRIO_LEVELS
	# This processor supports 16 priority levels:
	default 2

config NUM_IRQS
	# must be > the highest interrupt number used
	default 30

config SYS_CLOCK_HW_CYCLES_PER_SEC
	default 5000000

config CACHE_MANAGEMENT
	default y

config ARC_CONNECT
	default y

config MP_MAX_NUM_CPUS
	default 2

endif # SOC_NSIM_HS5X_SMP
```

## soc/soc_legacy/arc/snps_qemu/Kconfig
```kconfig
# Copyright (c) 2020 Synopsys, Inc. All rights reserved.
# SPDX-License-Identifier: Apache-2.0

choice
	prompt "ARC QEMU SoC Selection"
	default SOC_QEMU_ARC_HS
	depends on SOC_QEMU_ARC

config SOC_QEMU_ARC_EM
	bool "Synopsys ARC EM in QEMU"

config SOC_QEMU_ARC_HS
	bool "Synopsys ARC HS in QEMU"

config SOC_QEMU_ARC_HS6X
	bool "Synopsys ARC HS6x in QEMU"

config SOC_QEMU_ARC_HS5X
	bool "Synopsys ARC HS5x in QEMU"

endchoice
```

## soc/soc_legacy/arc/snps_qemu/Kconfig.defconfig.em
```kconfig
# Copyright (c) 2020 Synopsys, Inc. All rights reserved.
# SPDX-License-Identifier: Apache-2.0

if SOC_QEMU_ARC_EM

config CPU_EM4
	default y

endif
```

## soc/soc_legacy/arm/ambiq/Kconfig.soc
```kconfig
# SPDX-License-Identifier: Apache-2.0
#
# Copyright (c) 2023 Antmicro <www.antmicro.com>

source "soc/soc_legacy/arm/ambiq/*/Kconfig.series"
```

## soc/soc_legacy/arm/arm/Kconfig.defconfig
```kconfig
# ARM LTD SoC configuration options

# Copyright (c) 2016 Linaro Limited
# SPDX-License-Identifier: Apache-2.0

source "soc/soc_legacy/arm/arm/*/Kconfig.defconfig.series"
```

## soc/soc_legacy/arm/arm/beetle/Kconfig.series
```kconfig
# ARM LTD Beetle SoC configuration options

# Copyright (c) 2016 Linaro Limited
# SPDX-License-Identifier: Apache-2.0

config SOC_SERIES_BEETLE
	bool "Arm Beetle MCU Series"
	select ARM
	select CPU_CORTEX_M3
	select SOC_FAMILY_ARM
	select CPU_HAS_ARM_MPU
	select CPU_CORTEX_M_HAS_DWT
	help
	  Enable support for Beetle MCU Series
```

## soc/soc_legacy/arm/arm/fvp_aemv8r_aarch32/Kconfig.series
```kconfig
# Copyright (c) 2022 IoT.bzh
# SPDX-License-Identifier: Apache-2.0

config SOC_SERIES_FVP_AEMV8R_AARCH32
	bool "ARM FVP AEMv8R AArch32 Series"
	select ARM
	select SOC_FAMILY_ARM
	help
	  Enable support for ARM FVP AEMv8R AArch32 Series
```

## soc/soc_legacy/arm/arm/mps2/Kconfig.series
```kconfig
# Copyright (c) 2017 Linaro Limited
# SPDX-License-Identifier: Apache-2.0

config SOC_SERIES_MPS2
	bool "Arm MPS2 MCU Series"
	select ARM
	select SOC_FAMILY_ARM
	select GPIO_MMIO32 if GPIO
	help
	  Enable support for ARM MPS2 MCU Series
```

## soc/soc_legacy/arm/arm/musca_s1/Kconfig.defconfig.musca_s1
```kconfig
# Copyright (c) 2019-2020 Linaro Limited
# SPDX-License-Identifier: Apache-2.0

if SOC_V2M_MUSCA_S1

config SOC
	default "musca_s1"

config NUM_IRQS
	default 96

endif
```

## soc/soc_legacy/arm/arm/musca_s1/Kconfig.series
```kconfig
# Copyright (c) 2019-2020 Linaro Limited
# SPDX-License-Identifier: Apache-2.0

config SOC_SERIES_MUSCA_S1
	bool "Arm v2m MUSCA-S1 MCU Series"
	select ARM
	select SOC_FAMILY_ARM
	select BUILD_OUTPUT_HEX
	help
	  Enable support for Arm V2M Musca-S1 MCU Series
```

## soc/soc_legacy/arm/aspeed/Kconfig.defconfig
```kconfig
# SPDX-License-Identifier: Apache-2.0
#
# Copyright (c) 2021 ASPEED Technology Inc.

source "soc/soc_legacy/arm/aspeed/*/Kconfig.defconfig.series"
```

## soc/soc_legacy/arm/atmel_sam/Kconfig.soc
```kconfig
# Atmel SAM MCU series selection

# Copyright (c) 2016 Piotr Mienkowski
# SPDX-License-Identifier: Apache-2.0

source "soc/soc_legacy/arm/atmel_sam/*/Kconfig.series"
```

## soc/soc_legacy/arm/atmel_sam/sam4l/Kconfig.defconfig.series
```kconfig
# Copyright (c) 2020 Gerson Fernando Budke <nandojve@gmail.com>
# SPDX-License-Identifier: Apache-2.0

if SOC_SERIES_SAM4L

config SOC_SERIES
	default "sam4l"

config SOC_PART_NUMBER
	default "sam4ls8c" if SOC_PART_NUMBER_SAM4LS8C
	default "sam4ls8b" if SOC_PART_NUMBER_SAM4LS8B
	default "sam4ls8a" if SOC_PART_NUMBER_SAM4LS8A
	default "sam4ls4c" if SOC_PART_NUMBER_SAM4LS4C
	default "sam4ls4b" if SOC_PART_NUMBER_SAM4LS4B
	default "sam4ls4a" if SOC_PART_NUMBER_SAM4LS4A
	default "sam4ls2c" if SOC_PART_NUMBER_SAM4LS2C
	default "sam4ls2b" if SOC_PART_NUMBER_SAM4LS2B
	default "sam4ls2a" if SOC_PART_NUMBER_SAM4LS2A
	default "sam4lc8c" if SOC_PART_NUMBER_SAM4LC8C
	default "sam4lc8b" if SOC_PART_NUMBER_SAM4LC8B
	default "sam4lc8a" if SOC_PART_NUMBER_SAM4LC8A
	default "sam4lc4c" if SOC_PART_NUMBER_SAM4LC4C
	default "sam4lc4b" if SOC_PART_NUMBER_SAM4LC4B
	default "sam4lc4a" if SOC_PART_NUMBER_SAM4LC4A
	default "sam4lc2c" if SOC_PART_NUMBER_SAM4LC2C
	default "sam4lc2b" if SOC_PART_NUMBER_SAM4LC2B
	default "sam4lc2a" if SOC_PART_NUMBER_SAM4LC2A

#
# SAM4L family has total 43 peripherals capable of
# generating interrupts.
#
config NUM_IRQS
	default 80

# Configure default device drivers. If a feature is supported by more than one
# device driver the default configuration will be placed in the board defconfig
# file.

config USART_SAM
	default y
	depends on SERIAL

endif # SOC_SERIES_SAM4L
```

## soc/soc_legacy/arm/atmel_sam0/Kconfig.soc
```kconfig
# Atmel SAM0 MCU series selection

# Copyright (c) 2017 Google LLC.
# SPDX-License-Identifier: Apache-2.0

source "soc/soc_legacy/arm/atmel_sam0/*/Kconfig.series"
```

## soc/soc_legacy/arm/atmel_sam0/common/Kconfig.samd2x
```kconfig
# SPDX-License-Identifier: Apache-2.0

if SOC_SERIES_SAMD20 || SOC_SERIES_SAMD21 || SOC_SERIES_SAMR21

config SOC_ATMEL_SAMD_NVM_WAIT_STATES
	int "NVM wait states"
	default 1
	help
	  Wait states to set for NVM. Consult the datasheet as these are highly
	  dependent on the device operationg conditions.

config SOC_ATMEL_SAMD_OSC32K
	bool "Internal 32.768 kHz RC oscillator"
	help
	  Enable the internal 32.768 kHz RC oscillator at startup.
	  This can then be selected as the main clock reference for the SOC.

config SOC_ATMEL_SAMD_OSC8M
	bool "Internal 8 MHz RC oscillator"
	help
	  Enable the internal 8 MHz RC oscillator at startup.
	  This can then be selected as the main clock reference for the SOC.

config SOC_ATMEL_SAMD_XOSC32K
	bool "External 32.768 kHz clock source"
	help
	  Enable the external 32.768 kHz clock source at startup.
	  This can then be selected as the main clock reference for the SOC.

config SOC_ATMEL_SAMD_XOSC32K_CRYSTAL
	bool "External 32.768 kHz clock is a crystal oscillator"
	depends on SOC_ATMEL_SAMD_XOSC32K
	default y
	help
	  Enable the crystal oscillator (if disabled, expect a clock signal on
	  XIN32).

config SOC_ATMEL_SAMD_XOSC
	bool "External 0.4..32 MHz clock source"
	help
	  Enable the external 0.4..32 MHz clock source at startup.
	  This can then be selected as the main clock reference for the SOC.

config SOC_ATMEL_SAMD_XOSC_CRYSTAL
	bool "External 0.4..32 MHz clock is a crystal oscillator"
	depends on SOC_ATMEL_SAMD_XOSC
	default y
	help
	  Enable the crystal oscillator (if disabled, expect a clock signal on
	  XIN).

config SOC_ATMEL_SAMD_XOSC_FREQ_HZ
	int "External 0.4..32 MHz clock oscillator frequency"
	range 400000 32000000
	default 8000000
	depends on SOC_ATMEL_SAMD_XOSC
	help
	  External 0.4..32 MHz clock oscillator reference frequency.

choice
	prompt "Main clock reference"
	default SOC_ATMEL_SAMD_DEFAULT_AS_MAIN
	help
	  Selects the clock that will be used for the DFLL48M's reference.
	  Main clocks, such as the CPU and AHB clocks will be derived from
	  DFLL48M.

config SOC_ATMEL_SAMD_DEFAULT_AS_MAIN
	bool "DEFAULT"
	help
	  This choice will leave all clocks to their current state.
	  This can be the default reset state or a state set by a bootloader.

config SOC_ATMEL_SAMD_OSC32K_AS_MAIN
	bool "OSC32K"
	depends on SOC_ATMEL_SAMD_OSC32K

config SOC_ATMEL_SAMD_XOSC32K_AS_MAIN
	bool "XOSC32K"
	depends on SOC_ATMEL_SAMD_XOSC32K

config SOC_ATMEL_SAMD_OSC8M_AS_MAIN
	bool "OSC8M"
	depends on SOC_ATMEL_SAMD_OSC8M

config SOC_ATMEL_SAMD_XOSC_AS_MAIN
	bool "XOSC"
	depends on SOC_ATMEL_SAMD_XOSC

endchoice

endif # SOC_SERIES_SAMD20 || SOC_SERIES_SAMD21 || SOC_SERIES_SAMR21
```

## soc/soc_legacy/arm/atmel_sam0/common/Kconfig.samd5x
```kconfig
# Copyright (c) 2019 ML!PA Consulting GmbH
# SPDX-License-Identifier: Apache-2.0

if SOC_SERIES_SAMD51 || SOC_SERIES_SAME51 || SOC_SERIES_SAME53 || SOC_SERIES_SAME54

config SOC_ATMEL_SAMD5X_XOSC32K
	bool "The external 32 kHz crystal oscillator"
	help
	  Say y to enable the external 32 kHZ crystal oscillator at
	  startup.  This can then be selected as the main clock source
	  for the SOC.

choice
	prompt "Main clock source"
	help
	  Selects the clock that the main clocks, such as the CPU
	  clock and AHB clock, will be derived from.

config SOC_ATMEL_SAMD5X_XOSC32K_AS_MAIN
	depends on SOC_ATMEL_SAMD5X_XOSC32K
	bool "XOSC32K"

config SOC_ATMEL_SAMD5X_OSCULP32K_AS_MAIN
	bool "OSCULP32K"

endchoice

endif
```

## soc/soc_legacy/arm/atmel_sam0/samc21/Kconfig.defconfig.series
```kconfig
# Atmel SAMC MCU series configuration options

# Copyright (c) 2022 Kamil Serwus
# SPDX-License-Identifier: Apache-2.0

if SOC_SERIES_SAMC21

config SOC_SERIES
	default "samc21"

config SOC_PART_NUMBER
	default "samc21e15a" if SOC_PART_NUMBER_SAMC21E15A
	default "samc21e16a" if SOC_PART_NUMBER_SAMC21E16A
	default "samc21e17a" if SOC_PART_NUMBER_SAMC21E17A
	default "samc21e18a" if SOC_PART_NUMBER_SAMC21E18A
	default "samc21g15a" if SOC_PART_NUMBER_SAMC21G15A
	default "samc21g16a" if SOC_PART_NUMBER_SAMC21G16A
	default "samc21g17a" if SOC_PART_NUMBER_SAMC21G17A
	default "samc21g18a" if SOC_PART_NUMBER_SAMC21G18A
	default "samc21j15a" if SOC_PART_NUMBER_SAMC21J15A
	default "samc21j16a" if SOC_PART_NUMBER_SAMC21J16A
	default "samc21j17a" if SOC_PART_NUMBER_SAMC21J17A
	default "samc21j17au" if SOC_PART_NUMBER_SAMC21J17AU
	default "samc21j18a" if SOC_PART_NUMBER_SAMC21J18A
	default "samc21j18au" if SOC_PART_NUMBER_SAMC21J18AU
	default "samc21n17a" if SOC_PART_NUMBER_SAMC21N17A
	default "samc21n18a" if SOC_PART_NUMBER_SAMC21N18A

config NUM_IRQS
	default 32

config SYS_CLOCK_HW_CYCLES_PER_SEC
	default	$(dt_node_int_prop_int,/cpus/cpu@0,clock-frequency)

endif # SOC_SERIES_SAMC21
```

## soc/soc_legacy/arm/atmel_sam0/samd20/Kconfig.series
```kconfig
# Atmel SAMD20 MCU series

# Copyright (c) 2018 Sean Nyekjaer
# Copyright (c) 2023 Gerson Fernando Budke <nandojve@gmail.com>
# SPDX-License-Identifier: Apache-2.0

config SOC_SERIES_SAMD20
	bool "Atmel SAMD20 MCU"
	select ARM
	select CPU_CORTEX_M0PLUS
	select CPU_CORTEX_M_HAS_SYSTICK
	select CPU_CORTEX_M_HAS_VTOR
	select SOC_FAMILY_SAM0
	select PLATFORM_SPECIFIC_INIT
	select ASF
	help
	  Enable support for Atmel SAMD20 Cortex-M0+ microcontrollers.
```

## soc/soc_legacy/arm/atmel_sam0/samd21/Kconfig.series
```kconfig
# Atmel SAMD21 MCU series

# Copyright (c) 2017 Google LLC.
# Copyright (c) 2023 Gerson Fernando Budke <nandojve@gmail.com>
# SPDX-License-Identifier: Apache-2.0

config SOC_SERIES_SAMD21
	bool "Atmel SAMD21 MCU"
	select ARM
	select CPU_CORTEX_M0PLUS
	select CPU_CORTEX_M_HAS_SYSTICK
	select CPU_CORTEX_M_HAS_VTOR
	select SOC_FAMILY_SAM0
	select PLATFORM_SPECIFIC_INIT
	select ASF
	help
	  Enable support for Atmel SAMD21 Cortex-M0+ microcontrollers.
```

## soc/soc_legacy/arm/atmel_sam0/samd51/Kconfig.defconfig.series
```kconfig
# Atmel SAMD51 MCU series configuration options

# Copyright (c) 2019 ML!PA Consulting GmbH
# SPDX-License-Identifier: Apache-2.0

if SOC_SERIES_SAMD51

config SOC_SERIES
	string
	default "samd51"

config SOC_PART_NUMBER
	string
	default "samd51g18a" if SOC_PART_NUMBER_SAMD51G18A
	default "samd51g19a" if SOC_PART_NUMBER_SAMD51G19A
	default "samd51j18a" if SOC_PART_NUMBER_SAMD51J18A
	default "samd51j19a" if SOC_PART_NUMBER_SAMD51J19A
	default "samd51j20a" if SOC_PART_NUMBER_SAMD51J20A
	default "samd51n19a" if SOC_PART_NUMBER_SAMD51N19A
	default "samd51n20a" if SOC_PART_NUMBER_SAMD51N20A
	default "samd51p19a" if SOC_PART_NUMBER_SAMD51P19A
	default "samd51p20a" if SOC_PART_NUMBER_SAMD51P20A

config NUM_IRQS
	int
	default 137

config ROM_START_OFFSET
	default 0x400 if BOOTLOADER_MCUBOOT

config SYS_CLOCK_HW_CYCLES_PER_SEC
	int
	default 120000000

endif # SOC_SERIES_SAMD51
```
