## soc/soc_legacy/arm/atmel_sam0/samd51/Kconfig.soc
```kconfig
# Atmel SAMD51 MCU series

# Copyright (c) 2019 ML!PA Consulting GmbH
# SPDX-License-Identifier: Apache-2.0

choice
	prompt "Atmel SAMD51 MCU Selection"
	depends on SOC_SERIES_SAMD51

config SOC_PART_NUMBER_SAMD51G18A
	bool "SAMD51G18A"

config SOC_PART_NUMBER_SAMD51G19A
	bool "SAMD51G19A"

config SOC_PART_NUMBER_SAMD51J18A
	bool "SAMD51J18A"

config SOC_PART_NUMBER_SAMD51J19A
	bool "SAMD51J19A"

config SOC_PART_NUMBER_SAMD51J20A
	bool "SAMD51J20A"

config SOC_PART_NUMBER_SAMD51N19A
	bool "SAMD51N19A"

config SOC_PART_NUMBER_SAMD51N20A
	bool "SAMD51N20A"

config SOC_PART_NUMBER_SAMD51P19A
	bool "SAMD51P19A"

config SOC_PART_NUMBER_SAMD51P20A
	bool "SAMD51P20A"

endchoice
```
