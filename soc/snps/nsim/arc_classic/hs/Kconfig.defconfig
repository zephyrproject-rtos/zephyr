## soc/snps/nsim/arc_classic/hs/Kconfig.defconfig
```kconfig
# Copyright (c) 2024 Synopsys, Inc.
# SPDX-License-Identifier: Apache-2.0

if SOC_SERIES_NSIM_HS

rsource "Kconfig.defconfig.hs*"

endif # SOC_SERIES_NSIM_HS
```

## soc/snps/nsim/arc_classic/hs/Kconfig.defconfig.hs6x
```kconfig
# Copyright (c) 2021 Synopsys, Inc.
# SPDX-License-Identifier: Apache-2.0

if SOC_NSIM_HS6X

config CPU_HS6X
	default y

config NUM_IRQ_PRIO_LEVELS
	# This processor supports 16 priority levels:
	default 2

config NUM_IRQS
	# must be > the highest interrupt number used
	default 30

config SYS_CLOCK_HW_CYCLES_PER_SEC
	default 50000000

config CACHE_MANAGEMENT
	default y

endif # SOC_NSIM_HS6X
```

## soc/snps/nsim/arc_classic/hs/Kconfig.defconfig.hs6x_smp
```kconfig
# Copyright (c) 2021 Synopsys, Inc.
# SPDX-License-Identifier: Apache-2.0

if SOC_NSIM_HS6X_SMP

config CPU_HS6X
	default y

config NUM_IRQ_PRIO_LEVELS
	# This processor supports 16 priority levels:
	default 2

config NUM_IRQS
	# must be > the highest interrupt number used
	default 30

config SYS_CLOCK_HW_CYCLES_PER_SEC
	# SMP simulation is slower than single core, 1 Mhz seems reasonable match with wallclock
	default 1000000

config CACHE_MANAGEMENT
	default y

config ARC_CONNECT
	default y

config MP_MAX_NUM_CPUS
	default 2

endif # SOC_NSIM_HS6X_SMP
```

## soc/snps/nsim/arc_classic/hs/Kconfig.soc
```kconfig
# Copyright (c) 2024 Synopsys, Inc.
# SPDX-License-Identifier: Apache-2.0

config SOC_SERIES_NSIM_HS
	bool
	select SOC_FAMILY_NSIM_ARC_CLASSIC

config SOC_SERIES
	default "nsim_hs" if SOC_SERIES_NSIM_HS

config SOC_NSIM_HS
	bool
	select SOC_SERIES_NSIM_HS

config SOC_NSIM_HS_SMP
	bool
	select SOC_SERIES_NSIM_HS

config SOC_NSIM_HS_MPUV6
	bool
	select SOC_SERIES_NSIM_HS

config SOC_NSIM_HS5X
	bool
	select SOC_SERIES_NSIM_HS

config SOC_NSIM_HS5X_SMP
	bool
	select SOC_SERIES_NSIM_HS

config SOC_NSIM_HS6X
	bool
	select SOC_SERIES_NSIM_HS

config SOC_NSIM_HS6X_SMP
	bool
	select SOC_SERIES_NSIM_HS

config SOC
	default "nsim_hs" if SOC_NSIM_HS
	default "nsim_hs_smp" if SOC_NSIM_HS_SMP
	default "nsim_hs_mpuv6" if SOC_NSIM_HS_MPUV6
	default "nsim_hs5x" if SOC_NSIM_HS5X
	default "nsim_hs5x_smp" if SOC_NSIM_HS5X_SMP
	default "nsim_hs6x" if SOC_NSIM_HS6X
	default "nsim_hs6x_smp" if SOC_NSIM_HS6X_SMP
```

## soc/snps/nsim/arc_classic/sem/Kconfig
```kconfig
# Copyright (c) 2024 Synopsys, Inc.
# SPDX-License-Identifier: Apache-2.0

config SOC_SERIES_NSIM_SEM
	select ARC
	select CPU_HAS_MPU
	select CPU_HAS_FPU
	select ARC_HAS_SECURE
```

## soc/snps/nsim/arc_classic/sem/Kconfig.defconfig
```kconfig
# Copyright (c) 2018 Synopsys, Inc. All rights reserved.
# SPDX-License-Identifier: Apache-2.0

if SOC_NSIM_SEM

config CPU_EM4_FPUDA
	default y

config NUM_IRQ_PRIO_LEVELS
	# This processor supports 4 priority levels:
	# 0 for Fast Interrupts (FIRQs) and 1-3 for Regular Interrupts (IRQs).
	default 4

config NUM_IRQS
	# must be > the highest interrupt number used
	default 30

config ARC_MPU_VER
	default 4

config RGF_NUM_BANKS
	default 1

config SYS_CLOCK_HW_CYCLES_PER_SEC
	default 5000000

config HARVARD
	default y

config ARC_FIRQ
	default n

config CACHE_MANAGEMENT
	default y

config ARC_HAS_ACCL_REGS
	default y

endif # SOC_NSIM_SEM
```

## soc/snps/nsim/arc_classic/sem/Kconfig.soc
```kconfig
# Copyright (c) 2024 Synopsys, Inc.
# SPDX-License-Identifier: Apache-2.0

config SOC_SERIES_NSIM_SEM
	bool
	select SOC_FAMILY_NSIM_ARC_CLASSIC

config SOC_SERIES
	default "nsim_sem" if SOC_SERIES_NSIM_SEM

config SOC_NSIM_SEM
	bool
	select SOC_SERIES_NSIM_SEM

config SOC
	default "nsim_sem" if SOC_NSIM_SEM
```

## soc/snps/nsim/arc_classic/vpx5/Kconfig
```kconfig
# Copyright (c) 2024 Synopsys, Inc.
# SPDX-License-Identifier: Apache-2.0

config SOC_SERIES_NSIM_VPX5
	select ARC
```

## soc/snps/nsim/arc_classic/vpx5/Kconfig.soc
```kconfig
# Copyright (c) 2024 Synopsys, Inc.
# SPDX-License-Identifier: Apache-2.0

config SOC_SERIES_NSIM_VPX5
	bool
	select SOC_FAMILY_NSIM_ARC_CLASSIC

config SOC_SERIES
	default "nsim_vpx5" if SOC_SERIES_NSIM_VPX5

config SOC_NSIM_VPX5
	bool
	select SOC_SERIES_NSIM_VPX5
	help
	  Synopsys ARC VPX5 in nSIM

config SOC
	default "nsim_vpx5" if SOC_NSIM_VPX5
```

## soc/snps/nsim/arc_v/Kconfig.defconfig
```kconfig
# Copyright (c) 2024 Synopsys, Inc.
# SPDX-License-Identifier: Apache-2.0

if SOC_FAMILY_NSIM_ARC_V

rsource "*/Kconfig.defconfig"

endif # SOC_FAMILY_NSIM_ARC_V
```

## soc/snps/nsim/arc_v/Kconfig.soc
```kconfig
# Copyright (c) 2024 Synopsys, Inc.
# SPDX-License-Identifier: Apache-2.0

config SOC_FAMILY_NSIM_ARC_V
	bool

config SOC_FAMILY
	default "nsim_arc_v" if SOC_FAMILY_NSIM_ARC_V

rsource "*/Kconfig.soc"
```

## soc/snps/nsim/arc_v/rhx/Kconfig
```kconfig
# Copyright (c) 2024 Synopsys, Inc.
# SPDX-License-Identifier: Apache-2.0

config SOC_SERIES_RHX
	select RISCV
	select RISCV_PRIVILEGED
	select RISCV_SOC_HAS_GP_RELATIVE_ADDRESSING
	select INCLUDE_RESET_VECTOR
	imply XIP
```

## soc/snps/nsim/arc_v/rhx/Kconfig.defconfig
```kconfig
# Copyright (c) 2024 Synopsys, Inc.
# SPDX-License-Identifier: Apache-2.0

if SOC_SERIES_RHX

config SYS_CLOCK_HW_CYCLES_PER_SEC
	default $(dt_node_int_prop_int,/cpus/cpu@0,clock-frequency)

config NUM_IRQS
	default 32

config PMP_SLOTS
	default 16

config PMP_GRANULARITY
	default 8

config RISCV_PMP
	default y

config RISCV_SOC_INTERRUPT_INIT
	default y

endif # SOC_SERIES_RHX
```

## soc/snps/nsim/arc_v/rhx/Kconfig.soc
```kconfig
# Copyright (c) 2024 Synopsys, Inc.
# SPDX-License-Identifier: Apache-2.0

config SOC_SERIES_RHX
	bool
	select SOC_FAMILY_NSIM_ARC_V

config SOC_SERIES
	default "rhx" if SOC_SERIES_RHX

config SOC_RHX100
	bool
	select SOC_SERIES_RHX

config SOC
	default "rhx100" if SOC_RHX100
```

## soc/snps/nsim/arc_v/rmx/Kconfig
```kconfig
# Copyright (c) 2024 Synopsys, Inc.
# SPDX-License-Identifier: Apache-2.0

config SOC_SERIES_NSIM_ARC_V_RMX
	bool

	select RISCV
	select RISCV_PRIVILEGED
	select RISCV_ISA_RV32I
	select RISCV_ISA_EXT_M
	select RISCV_ISA_EXT_A
	select RISCV_ISA_EXT_C
	select RISCV_ISA_EXT_ZICSR
	select RISCV_ISA_EXT_ZIFENCEI
	select RISCV_SOC_HAS_GP_RELATIVE_ADDRESSING
	select INCLUDE_RESET_VECTOR
	imply XIP
```

## soc/snps/nsim/arc_v/rmx/Kconfig.defconfig
```kconfig
# Copyright (c) 2024 Synopsys, Inc.
# SPDX-License-Identifier: Apache-2.0

if SOC_SERIES_RMX

config SYS_CLOCK_HW_CYCLES_PER_SEC
	default $(dt_node_int_prop_int,/cpus/cpu@0,clock-frequency)

config RISCV_SOC_INTERRUPT_INIT
	default y

config MULTI_LEVEL_INTERRUPTS
	default n

config NUM_IRQS
	default 18

config RISCV_PMP
	default y

config PMP_SLOTS
	default 16

config PMP_GRANULARITY
	default 8

endif # SOC_SERIES_RMX
```

## soc/snps/nsim/arc_v/rmx/Kconfig.soc
```kconfig
# Copyright (c) 2024 Synopsys, Inc.
# SPDX-License-Identifier: Apache-2.0

config SOC_SERIES_NSIM_ARC_V_RMX
	bool
	select SOC_FAMILY_NSIM_ARC_V

config SOC_SERIES
	default "rmx" if SOC_SERIES_NSIM_ARC_V_RMX

config SOC_NSIM_ARC_V_RMX100
	bool
	select SOC_SERIES_NSIM_ARC_V_RMX

config SOC
	default "rmx100" if SOC_NSIM_ARC_V_RMX100
```

## soc/snps/nsim/arc_v/rmx5xx/Kconfig.defconfig
```kconfig
# Copyright (c) 2024 Synopsys, Inc.
# SPDX-License-Identifier: Apache-2.0

if SOC_SERIES_RMX5XX

config RISCV_SOC_INTERRUPT_INIT
	default y

config RISCV_GP
	default y

config MULTI_LEVEL_INTERRUPTS
	default n

config 2ND_LVL_ISR_TBL_OFFSET
	default 12

config 2ND_LVL_INTR_00_OFFSET
	default 11

config MAX_IRQ_PER_AGGREGATOR
	default 52

config NUM_IRQS
	default 64

endif # SOC_SERIES_RMX5XX
```

## soc/snps/nsim_riscv/Kconfig.soc
```kconfig
# Copyright (c) 2024 Synopsys, Inc.
# SPDX-License-Identifier: Apache-2.0

config SOC_FAMILY_NSIM_RISCV
	bool

config SOC_FAMILY
	default "nsim_riscv" if SOC_FAMILY_NSIM_RISCV

rsource "*/Kconfig.soc"
```

## soc/snps/nsim_riscv/rmx5xx/Kconfig
```kconfig
# Copyright (c) 2024 Synopsys, Inc.
# SPDX-License-Identifier: Apache-2.0

config SOC_SERIES_RMX5XX
	bool

	select RISCV
	select RISCV_PRIVILEGED
	select RISCV_HAS_PLIC
	select RISCV_ISA_RV32I
	select RISCV_ISA_EXT_G
#	G by-default includes the following:
#			RISCV_ISA_EXT_M
#			RISCV_ISA_EXT_A
#			RISCV_ISA_EXT_F
#			RISCV_ISA_EXT_D
#			RISCV_ISA_EXT_ZICSR
#			RISCV_ISA_EXT_ZIFENCEI
	select RISCV_ISA_EXT_C
#	select RISCV_ISA_EXT_V # V is not supported by zephyr
	select ATOMIC_OPERATIONS_BUILTIN
	select INCLUDE_RESET_VECTOR
```

## soc/snps/nsim_riscv/rmx5xx/Kconfig.soc
```kconfig
# Copyright (c) 2024 Synopsys, Inc.
# SPDX-License-Identifier: Apache-2.0

config SOC_SERIES_RMX5XX
	bool
	select SOC_FAMILY_NSIM_RISCV

config SOC_SERIES
	default "rmx5xx" if SOC_SERIES_RMX5XX

config SOC_RMX500
	bool
	select SOC_SERIES_RMX5XX

config SOC
	default "rmx500" if SOC_RMX500
```

## soc/snps/nsim_rv/Kconfig.defconfig
```kconfig
# Copyright (c) 2024 Synopsys, Inc.
# SPDX-License-Identifier: Apache-2.0

if SOC_FAMILY_NSIM_RV

rsource "*/Kconfig.defconfig"

endif # SOC_FAMILY_NSIM_RV
```

## soc/snps/nsim_rv/Kconfig.soc
```kconfig
# Copyright (c) 2024 Synopsys, Inc.
# SPDX-License-Identifier: Apache-2.0

config SOC_FAMILY_NSIM_RV
	bool

config SOC_FAMILY
	default "nsim_rv" if SOC_FAMILY_NSIM_RV

rsource "*/Kconfig.soc"
```

## soc/snps/nsim_rv/rmx500/Kconfig.soc
```kconfig
# Copyright (c) 2024 Synopsys, Inc.
# SPDX-License-Identifier: Apache-2.0

config SOC_SERIES_NSIM_RV_RMX500
	bool
	select SOC_FAMILY_NSIM_RV

config SOC_SERIES
	default "rmx500" if SOC_SERIES_NSIM_RV_RMX500

config SOC_NSIM_RV_RMX500
	bool
	select SOC_SERIES_NSIM_RV_RMX500

config SOC
	default "rmx500" if SOC_NSIM_RV_RMX500
```

## soc/snps/qemu_arc/Kconfig
```kconfig
# Copyright (c) 2020 Synopsys, Inc. All rights reserved.
# SPDX-License-Identifier: Apache-2.0

config SOC_QEMU_ARC
	select ARC
	select CPU_HAS_MPU

config SOC_QEMU_ARC_EM
	select CPU_EM4

config SOC_QEMU_ARC_HS
	select CPU_HS3X

config SOC_QEMU_ARC_HS5X
	select CPU_HS5X

config SOC_QEMU_ARC_HS6X
	select CPU_HS6X
```
