## soc/cypress/psoc6/Kconfig.soc
```kconfig
# Cypress Semiconductor PSoC6 series configuration options
# Copyright (c) 2018, Cypress
# Copyright (c) 2020, ATL Electronics
# SPDX-License-Identifier: Apache-2.0

config SOC_SERIES_PSOC6
	bool
	select SOC_FAMILY_INFINEON_CAT1

config SOC_SERIES_PSOC62
	bool
	select SOC_FAMILY_PSOC6
	help
	  Enable support for Cypress PSoC6 MCU series

config SOC_SERIES_PSOC63
	bool
	select SOC_FAMILY_PSOC6
	help
	  Enable support for Cypress PSoC6-BLE MCU series

# Cypress PSoC™ 6 MCU lines
config SOC_SERIES_PSOC_60
	bool
	select SOC_SERIES_PSOC6
	help
	  Enable support for Infineon PSoC™ 60 MCU series

config SOC_SERIES_PSOC_61
	bool
	select SOC_SERIES_PSOC6
	help
	  Enable support for Infineon PSoC™ 61 MCU series

config SOC_SERIES_PSOC_62
	bool
	select SOC_SERIES_PSOC6
	help
	  Enable support for Infineon PSoC™ 62 MCU series

config SOC_SERIES_PSOC_63
	bool
	select SOC_SERIES_PSOC6
	help
	  Enable support for Infineon PSoC™ 63 MCU series

config SOC_SERIES_PSOC_64
	bool
	select SOC_SERIES_PSOC6
	help
	  Enable support for Infineon PSoC™ 64 MCU series

config SOC_CY8C6247_M0
	bool
	select SOC_SERIES_PSOC62

config SOC_CY8C6247_M4
	bool
	select SOC_SERIES_PSOC62

config SOC_CY8C6347_M0
	bool
	select SOC_SERIES_PSOC63

config SOC_CY8C6347_M4
	bool
	select SOC_SERIES_PSOC63

config SOC_PART_NUMBER_CY8C6247BZI_D54
	bool
	depends on SOC_SERIES_PSOC62
	help
	  CY8C6247BZI_D54

config SOC_PART_NUMBER_CY8C6347BZI_BLD53
	bool
	depends on SOC_SERIES_PSOC63
	help
	  CY8C6347BZI_BLD53

# Infineon PSoC6 die
config SOC_DIE_PSOC6
	bool
	select SOC_FAMILY_INFINEON_CAT1A

# Infineon PSoC6_01 die
config SOC_DIE_PSOC6_01
	bool
	select SOC_DIE_PSOC6

# Infineon PSoC6_02 die
config SOC_DIE_PSOC6_02
	bool
	select SOC_DIE_PSOC6

# Infineon PSoC6_03 die
config SOC_DIE_PSOC6_03
	bool
	select SOC_DIE_PSOC6

# Infineon PSoC6_04 die
config SOC_DIE_PSOC6_04
	bool
	select SOC_DIE_PSOC6

# Infineon soc packages
config SOC_PACKAGE_PSOC6_01_124_BGA
	bool

config SOC_PACKAGE_PSOC6_01_116_BGA_BLE
	bool

config SOC_PACKAGE_PSOC6_01_104_M_CSP_BLE
	bool

config SOC_PACKAGE_PSOC6_01_80_WLCSP
	bool

config SOC_PACKAGE_PSOC6_01_116_BGA_USB
	bool

config SOC_PACKAGE_PSOC6_01_124_BGA_SIP
	bool

config SOC_PACKAGE_PSOC6_01_43_SMT
	bool

config SOC_PACKAGE_PSOC6_01_104_M_CSP_BLE_USB
	bool

config SOC_PACKAGE_PSOC6_01_68_QFN_BLE
	bool

config SOC_PACKAGE_PSOC6_02_124_BGA
	bool

config SOC_PACKAGE_PSOC6_02_128_TQFP
	bool

config SOC_PACKAGE_PSOC6_02_100_WLCSP
	bool

config SOC_PACKAGE_PSOC6_02_68_QFN
	bool

config SOC_PACKAGE_PSOC6_03_100_TQFP
	bool

config SOC_PACKAGE_PSOC6_03_68_QFN
	bool

config SOC_PACKAGE_PSOC6_03_49_WLCSP
	bool

config SOC_PACKAGE_PSOC6_04_64_TQFP
	bool

config SOC_PACKAGE_PSOC6_04_68_QFN
	bool

config SOC_PACKAGE_PSOC6_04_80_TQFP
	bool

# Infineon PSoC6_01 series MCUs
config SOC_CY8C6036BZI_F04
	bool
	select SOC_DIE_PSOC6_01
	select SOC_PACKAGE_PSOC6_01_124_BGA
	select SOC_SERIES_PSOC_60

config SOC_CY8C6016BZI_F04
	bool
	select SOC_DIE_PSOC6_01
	select SOC_PACKAGE_PSOC6_01_124_BGA
	select SOC_SERIES_PSOC_60

config SOC_CY8C6116BZI_F54
	bool
	select SOC_DIE_PSOC6_01
	select SOC_PACKAGE_PSOC6_01_124_BGA
	select SOC_SERIES_PSOC_61

config SOC_CY8C6136BZI_F14
	bool
	select SOC_DIE_PSOC6_01
	select SOC_PACKAGE_PSOC6_01_124_BGA
	select SOC_SERIES_PSOC_61

config SOC_CY8C6136BZI_F34
	bool
	select SOC_DIE_PSOC6_01
	select SOC_PACKAGE_PSOC6_01_124_BGA
	select SOC_SERIES_PSOC_61

config SOC_CY8C6137BZI_F14
	bool
	select SOC_DIE_PSOC6_01
	select SOC_PACKAGE_PSOC6_01_124_BGA
	select SOC_SERIES_PSOC_61

config SOC_CY8C6137BZI_F34
	bool
	select SOC_DIE_PSOC6_01
	select SOC_PACKAGE_PSOC6_01_124_BGA
	select SOC_SERIES_PSOC_61

config SOC_CY8C6137BZI_F54
	bool
	select SOC_DIE_PSOC6_01
	select SOC_PACKAGE_PSOC6_01_124_BGA
	select SOC_SERIES_PSOC_61

config SOC_CY8C6117BZI_F34
	bool
	select SOC_DIE_PSOC6_01
	select SOC_PACKAGE_PSOC6_01_124_BGA
	select SOC_SERIES_PSOC_61

config SOC_CY8C6246BZI_D04
	bool
	select SOC_DIE_PSOC6_01
	select SOC_PACKAGE_PSOC6_01_124_BGA
	select SOC_SERIES_PSOC_62

config SOC_CY8C6247BZI_D44
	bool
	select SOC_DIE_PSOC6_01
	select SOC_PACKAGE_PSOC6_01_124_BGA
	select SOC_SERIES_PSOC_62

config SOC_CY8C6247BZI_D34
	bool
	select SOC_DIE_PSOC6_01
	select SOC_PACKAGE_PSOC6_01_124_BGA
	select SOC_SERIES_PSOC_62

config SOC_CY8C6247BZI_D54
	bool
	select SOC_DIE_PSOC6_01
	select SOC_PACKAGE_PSOC6_01_124_BGA
	select SOC_SERIES_PSOC_62

config SOC_CY8C6336BZI_BLF03
	bool
	select SOC_DIE_PSOC6_01
	select SOC_PACKAGE_PSOC6_01_116_BGA_BLE
	select SOC_SERIES_PSOC_63

config SOC_CY8C6316BZI_BLF03
	bool
	select SOC_DIE_PSOC6_01
	select SOC_PACKAGE_PSOC6_01_116_BGA_BLE
	select SOC_SERIES_PSOC_63

config SOC_CY8C6316BZI_BLF53
	bool
	select SOC_DIE_PSOC6_01
	select SOC_PACKAGE_PSOC6_01_116_BGA_BLE
	select SOC_SERIES_PSOC_63

config SOC_CY8C6336BZI_BLD13
	bool
	select SOC_DIE_PSOC6_01
	select SOC_PACKAGE_PSOC6_01_116_BGA_BLE
	select SOC_SERIES_PSOC_63

config SOC_CY8C6347BZI_BLD43
	bool
	select SOC_DIE_PSOC6_01
	select SOC_PACKAGE_PSOC6_01_116_BGA_BLE
	select SOC_SERIES_PSOC_63

config SOC_CY8C6347BZI_BLD33
	bool
	select SOC_DIE_PSOC6_01
	select SOC_PACKAGE_PSOC6_01_116_BGA_BLE
	select SOC_SERIES_PSOC_63

config SOC_CY8C6347BZI_BLD53
	bool
	select SOC_DIE_PSOC6_01
	select SOC_PACKAGE_PSOC6_01_116_BGA_BLE
	select SOC_SERIES_PSOC_63

config SOC_CY8C6347FMI_BLD13
	bool
	select SOC_DIE_PSOC6_01
	select SOC_PACKAGE_PSOC6_01_104_M_CSP_BLE
	select SOC_SERIES_PSOC_63

config SOC_CY8C6347FMI_BLD43
	bool
	select SOC_DIE_PSOC6_01
	select SOC_PACKAGE_PSOC6_01_104_M_CSP_BLE
	select SOC_SERIES_PSOC_63

config SOC_CY8C6347FMI_BLD33
	bool
	select SOC_DIE_PSOC6_01
	select SOC_PACKAGE_PSOC6_01_104_M_CSP_BLE
	select SOC_SERIES_PSOC_63

config SOC_CY8C6347FMI_BLD53
	bool
	select SOC_DIE_PSOC6_01
	select SOC_PACKAGE_PSOC6_01_104_M_CSP_BLE
	select SOC_SERIES_PSOC_63

config SOC_CY8C6137FDI_F02
	bool
	select SOC_DIE_PSOC6_01
	select SOC_PACKAGE_PSOC6_01_80_WLCSP
	select SOC_SERIES_PSOC_61

config SOC_CY8C6117FDI_F02
	bool
	select SOC_DIE_PSOC6_01
	select SOC_PACKAGE_PSOC6_01_80_WLCSP
	select SOC_SERIES_PSOC_61

config SOC_CY8C6247FDI_D02
	bool
	select SOC_DIE_PSOC6_01
	select SOC_PACKAGE_PSOC6_01_80_WLCSP
	select SOC_SERIES_PSOC_62

config SOC_CY8C6247FDI_D32
	bool
	select SOC_DIE_PSOC6_01
	select SOC_PACKAGE_PSOC6_01_80_WLCSP
	select SOC_SERIES_PSOC_62

config SOC_CY8C6336BZI_BUD13
	bool
	select SOC_DIE_PSOC6_01
	select SOC_PACKAGE_PSOC6_01_116_BGA_USB
	select SOC_SERIES_PSOC_63

config SOC_CY8C6347BZI_BUD43
	bool
	select SOC_DIE_PSOC6_01
	select SOC_PACKAGE_PSOC6_01_116_BGA_USB
	select SOC_SERIES_PSOC_63

config SOC_CY8C6347BZI_BUD33
	bool
	select SOC_DIE_PSOC6_01
	select SOC_PACKAGE_PSOC6_01_116_BGA_USB
	select SOC_SERIES_PSOC_63

config SOC_CY8C6347BZI_BUD53
	bool
	select SOC_DIE_PSOC6_01
	select SOC_PACKAGE_PSOC6_01_116_BGA_USB
	select SOC_SERIES_PSOC_63

config SOC_CY8C6337BZI_BLF13
	bool
	select SOC_DIE_PSOC6_01
	select SOC_PACKAGE_PSOC6_01_116_BGA_BLE
	select SOC_SERIES_PSOC_63

config SOC_CY8C6136FDI_F42
	bool
	select SOC_DIE_PSOC6_01
	select SOC_PACKAGE_PSOC6_01_80_WLCSP
	select SOC_SERIES_PSOC_61

config SOC_CY8C6247FDI_D52
	bool
	select SOC_DIE_PSOC6_01
	select SOC_PACKAGE_PSOC6_01_80_WLCSP
	select SOC_SERIES_PSOC_62

config SOC_CY8C6136FTI_F42
	bool
	select SOC_DIE_PSOC6_01
	select SOC_PACKAGE_PSOC6_01_80_WLCSP
	select SOC_SERIES_PSOC_61

config SOC_CY8C6247FTI_D52
	bool
	select SOC_DIE_PSOC6_01
	select SOC_PACKAGE_PSOC6_01_80_WLCSP
	select SOC_SERIES_PSOC_62

config SOC_CY8C6247BZI_AUD54
	bool
	select SOC_DIE_PSOC6_01
	select SOC_PACKAGE_PSOC6_01_124_BGA
	select SOC_SERIES_PSOC_62

config SOC_CY8C6336BZI_BLF04
	bool
	select SOC_DIE_PSOC6_01
	select SOC_PACKAGE_PSOC6_01_124_BGA_SIP
	select SOC_SERIES_PSOC_63

config SOC_CY8C6316BZI_BLF04
	bool
	select SOC_DIE_PSOC6_01
	select SOC_PACKAGE_PSOC6_01_124_BGA_SIP
	select SOC_SERIES_PSOC_63

config SOC_CY8C6316BZI_BLF54
	bool
	select SOC_DIE_PSOC6_01
	select SOC_PACKAGE_PSOC6_01_124_BGA_SIP
	select SOC_SERIES_PSOC_63

config SOC_CY8C6336BZI_BLD14
	bool
	select SOC_DIE_PSOC6_01
	select SOC_PACKAGE_PSOC6_01_124_BGA_SIP
	select SOC_SERIES_PSOC_63

config SOC_CY8C6347BZI_BLD44
	bool
	select SOC_DIE_PSOC6_01
	select SOC_PACKAGE_PSOC6_01_124_BGA_SIP
	select SOC_SERIES_PSOC_63

config SOC_CY8C6347BZI_BLD34
	bool
	select SOC_DIE_PSOC6_01
	select SOC_PACKAGE_PSOC6_01_124_BGA_SIP
	select SOC_SERIES_PSOC_63

config SOC_CY8C6347BZI_BLD54
	bool
	select SOC_DIE_PSOC6_01
	select SOC_PACKAGE_PSOC6_01_124_BGA_SIP
	select SOC_SERIES_PSOC_63

config SOC_CY8C6247BFI_D54
	bool
	select SOC_DIE_PSOC6_01
	select SOC_PACKAGE_PSOC6_01_124_BGA
	select SOC_SERIES_PSOC_62

config SOC_CYBLE_416045_02
	bool
	select SOC_DIE_PSOC6_01
	select SOC_PACKAGE_PSOC6_01_116_BGA_BLE
	select SOC_SERIES_PSOC_63

config SOC_CY8C6347FMI_BUD53
	bool
	select SOC_DIE_PSOC6_01
	select SOC_PACKAGE_PSOC6_01_104_M_CSP_BLE_USB
	select SOC_SERIES_PSOC_63

config SOC_CY8C6347FMI_BUD13
	bool
	select SOC_DIE_PSOC6_01
	select SOC_PACKAGE_PSOC6_01_104_M_CSP_BLE_USB
	select SOC_SERIES_PSOC_63

config SOC_CY8C6347FMI_BUD43
	bool
	select SOC_DIE_PSOC6_01
	select SOC_PACKAGE_PSOC6_01_104_M_CSP_BLE_USB
	select SOC_SERIES_PSOC_63

config SOC_CY8C6347FMI_BUD33
	bool
	select SOC_DIE_PSOC6_01
	select SOC_PACKAGE_PSOC6_01_104_M_CSP_BLE_USB
	select SOC_SERIES_PSOC_63

config SOC_CY8C6137WI_F54
	bool
	select SOC_DIE_PSOC6_01
	select SOC_PACKAGE_PSOC6_01_124_BGA
	select SOC_SERIES_PSOC_61

config SOC_CY8C6117WI_F34
	bool
	select SOC_DIE_PSOC6_01
	select SOC_PACKAGE_PSOC6_01_124_BGA
	select SOC_SERIES_PSOC_61

config SOC_CY8C6247WI_D54
	bool
	select SOC_DIE_PSOC6_01
	select SOC_PACKAGE_PSOC6_01_124_BGA
	select SOC_SERIES_PSOC_62

config SOC_CY8C6336LQI_BLF02
	bool
	select SOC_DIE_PSOC6_01
	select SOC_PACKAGE_PSOC6_01_68_QFN_BLE
	select SOC_SERIES_PSOC_63

config SOC_CY8C6336LQI_BLF42
	bool
	select SOC_DIE_PSOC6_01
	select SOC_PACKAGE_PSOC6_01_68_QFN_BLE
	select SOC_SERIES_PSOC_63

config SOC_CY8C6347LQI_BLD52
	bool
	select SOC_DIE_PSOC6_01
	select SOC_PACKAGE_PSOC6_01_68_QFN_BLE
	select SOC_SERIES_PSOC_63

config SOC_CYB06447BZI_BLD54
	bool
	select SOC_DIE_PSOC6_01
	select SOC_PACKAGE_PSOC6_01_124_BGA_SIP
	select SOC_SERIES_PSOC_64

config SOC_CYB06447BZI_BLD53
	bool
	select SOC_DIE_PSOC6_01
	select SOC_PACKAGE_PSOC6_01_116_BGA_BLE
	select SOC_SERIES_PSOC_64

config SOC_CYB06447BZI_D54
	bool
	select SOC_DIE_PSOC6_01
	select SOC_PACKAGE_PSOC6_01_124_BGA
	select SOC_SERIES_PSOC_64

# Infineon PSoC6_02 series MCUs
config SOC_CYB0644ABZI_S2D44
	bool
	select SOC_DIE_PSOC6_02
	select SOC_PACKAGE_PSOC6_02_124_BGA
	select SOC_SERIES_PSOC_64

config SOC_CYS0644ABZI_S2D44
	bool
	select SOC_DIE_PSOC6_02
	select SOC_PACKAGE_PSOC6_02_124_BGA
	select SOC_SERIES_PSOC_64

config SOC_CY8C624ABZI_S2D44A0
	bool
	select SOC_DIE_PSOC6_02
	select SOC_PACKAGE_PSOC6_02_124_BGA
	select SOC_SERIES_PSOC_62

config SOC_CY8C624ABZI_S2D44
	bool
	select SOC_DIE_PSOC6_02
	select SOC_PACKAGE_PSOC6_02_124_BGA
	select SOC_SERIES_PSOC_62

config SOC_CY8C624AAZI_S2D44
	bool
	select SOC_DIE_PSOC6_02
	select SOC_PACKAGE_PSOC6_02_128_TQFP
	select SOC_SERIES_PSOC_62

config SOC_CY8C624AFNI_S2D43
	bool
	select SOC_DIE_PSOC6_02
	select SOC_PACKAGE_PSOC6_02_100_WLCSP
	select SOC_SERIES_PSOC_62

config SOC_CY8C624ABZI_S2D04
	bool
	select SOC_DIE_PSOC6_02
	select SOC_PACKAGE_PSOC6_02_124_BGA
	select SOC_SERIES_PSOC_62

config SOC_CY8C624ABZI_S2D14
	bool
	select SOC_DIE_PSOC6_02
	select SOC_PACKAGE_PSOC6_02_124_BGA
	select SOC_SERIES_PSOC_62

config SOC_CY8C624AAZI_S2D14
	bool
	select SOC_DIE_PSOC6_02
	select SOC_PACKAGE_PSOC6_02_128_TQFP
	select SOC_SERIES_PSOC_62

config SOC_CY8C6248AZI_S2D14
	bool
	select SOC_DIE_PSOC6_02
	select SOC_PACKAGE_PSOC6_02_128_TQFP
	select SOC_SERIES_PSOC_62

config SOC_CY8C6248BZI_S2D44
	bool
	select SOC_DIE_PSOC6_02
	select SOC_PACKAGE_PSOC6_02_124_BGA
	select SOC_SERIES_PSOC_62

config SOC_CY8C6248AZI_S2D44
	bool
	select SOC_DIE_PSOC6_02
	select SOC_PACKAGE_PSOC6_02_128_TQFP
	select SOC_SERIES_PSOC_62

config SOC_CY8C6248FNI_S2D43
	bool
	select SOC_DIE_PSOC6_02
	select SOC_PACKAGE_PSOC6_02_100_WLCSP
	select SOC_SERIES_PSOC_62

config SOC_CY8C614ABZI_S2F04
	bool
	select SOC_DIE_PSOC6_02
	select SOC_PACKAGE_PSOC6_02_124_BGA
	select SOC_SERIES_PSOC_61

config SOC_CY8C614AAZI_S2F04
	bool
	select SOC_DIE_PSOC6_02
	select SOC_PACKAGE_PSOC6_02_128_TQFP
	select SOC_SERIES_PSOC_61

config SOC_CY8C614AFNI_S2F03
	bool
	select SOC_DIE_PSOC6_02
	select SOC_PACKAGE_PSOC6_02_100_WLCSP
	select SOC_SERIES_PSOC_61

config SOC_CY8C614AAZI_S2F14
	bool
	select SOC_DIE_PSOC6_02
	select SOC_PACKAGE_PSOC6_02_128_TQFP
	select SOC_SERIES_PSOC_61

config SOC_CY8C614ABZI_S2F44
	bool
	select SOC_DIE_PSOC6_02
	select SOC_PACKAGE_PSOC6_02_124_BGA
	select SOC_SERIES_PSOC_61

config SOC_CY8C614AAZI_S2F44
	bool
	select SOC_DIE_PSOC6_02
	select SOC_PACKAGE_PSOC6_02_128_TQFP
	select SOC_SERIES_PSOC_61

config SOC_CY8C614AFNI_S2F43
	bool
	select SOC_DIE_PSOC6_02
	select SOC_PACKAGE_PSOC6_02_100_WLCSP
	select SOC_SERIES_PSOC_61

config SOC_CY8C6148BZI_S2F44
	bool
	select SOC_DIE_PSOC6_02
	select SOC_PACKAGE_PSOC6_02_124_BGA
	select SOC_SERIES_PSOC_61

config SOC_CY8C6148AZI_S2F44
	bool
	select SOC_DIE_PSOC6_02
	select SOC_PACKAGE_PSOC6_02_128_TQFP
	select SOC_SERIES_PSOC_61

config SOC_CY8C6148FNI_S2F43
	bool
	select SOC_DIE_PSOC6_02
	select SOC_PACKAGE_PSOC6_02_100_WLCSP
	select SOC_SERIES_PSOC_61

config SOC_CY8C624ABZI_D44
	bool
	select SOC_DIE_PSOC6_02
	select SOC_PACKAGE_PSOC6_02_124_BGA
	select SOC_SERIES_PSOC_62

config SOC_CY8C624ALQI_S2D42
	bool
	select SOC_DIE_PSOC6_02
	select SOC_PACKAGE_PSOC6_02_68_QFN
	select SOC_SERIES_PSOC_62

config SOC_CY8C624ALQI_S2D02
	bool
	select SOC_DIE_PSOC6_02
	select SOC_PACKAGE_PSOC6_02_68_QFN
	select SOC_SERIES_PSOC_62

config SOC_CY8C6248LQI_S2D42
	bool
	select SOC_DIE_PSOC6_02
	select SOC_PACKAGE_PSOC6_02_68_QFN
	select SOC_SERIES_PSOC_62

config SOC_CY8C6248LQI_S2D02
	bool
	select SOC_DIE_PSOC6_02
	select SOC_PACKAGE_PSOC6_02_68_QFN
	select SOC_SERIES_PSOC_62

config SOC_CY8C614ALQI_S2F42
	bool
	select SOC_DIE_PSOC6_02
	select SOC_PACKAGE_PSOC6_02_68_QFN
	select SOC_SERIES_PSOC_61

config SOC_CY8C614ALQI_S2F02
	bool
	select SOC_DIE_PSOC6_02
	select SOC_PACKAGE_PSOC6_02_68_QFN
	select SOC_SERIES_PSOC_61

config SOC_CY8C6148LQI_S2F42
	bool
	select SOC_DIE_PSOC6_02
	select SOC_PACKAGE_PSOC6_02_68_QFN
	select SOC_SERIES_PSOC_61

config SOC_CY8C6148LQI_S2F02
	bool
	select SOC_DIE_PSOC6_02
	select SOC_PACKAGE_PSOC6_02_68_QFN
	select SOC_SERIES_PSOC_61

# Infineon PSoC6_04 series MCUs
config SOC_CY8C6244AZI_S4D92
	bool
	select SOC_DIE_PSOC6_04
	select SOC_PACKAGE_PSOC6_04_64_TQFP
	select SOC_SERIES_PSOC_62

config SOC_CY8C6244LQI_S4D92
	bool
	select SOC_DIE_PSOC6_04
	select SOC_PACKAGE_PSOC6_04_68_QFN
	select SOC_SERIES_PSOC_62

config SOC_CY8C6244AZI_S4D93
	bool
	select SOC_DIE_PSOC6_04
	select SOC_PACKAGE_PSOC6_04_80_TQFP
	select SOC_SERIES_PSOC_62

config SOC_CY8C6244AZI_S4D82
	bool
	select SOC_DIE_PSOC6_04
	select SOC_PACKAGE_PSOC6_04_64_TQFP
	select SOC_SERIES_PSOC_62

config SOC_CY8C6244LQI_S4D82
	bool
	select SOC_DIE_PSOC6_04
	select SOC_PACKAGE_PSOC6_04_68_QFN
	select SOC_SERIES_PSOC_62

config SOC_CY8C6244AZI_S4D83
	bool
	select SOC_DIE_PSOC6_04
	select SOC_PACKAGE_PSOC6_04_80_TQFP
	select SOC_SERIES_PSOC_62

config SOC_CY8C6244AZI_S4D62
	bool
	select SOC_DIE_PSOC6_04
	select SOC_PACKAGE_PSOC6_04_64_TQFP
	select SOC_SERIES_PSOC_62

config SOC_CY8C6244LQI_S4D62
	bool
	select SOC_DIE_PSOC6_04
	select SOC_PACKAGE_PSOC6_04_68_QFN
	select SOC_SERIES_PSOC_62

config SOC_CY8C6244AZI_S4D12
	bool
	select SOC_DIE_PSOC6_04
	select SOC_PACKAGE_PSOC6_04_64_TQFP
	select SOC_SERIES_PSOC_62

config SOC_CY8C6244LQI_S4D12
	bool
	select SOC_DIE_PSOC6_04
	select SOC_PACKAGE_PSOC6_04_68_QFN
	select SOC_SERIES_PSOC_62

config SOC_CY8C6144AZI_S4F92
	bool
	select SOC_DIE_PSOC6_04
	select SOC_PACKAGE_PSOC6_04_64_TQFP
	select SOC_SERIES_PSOC_61

config SOC_CY8C6144LQI_S4F92
	bool
	select SOC_DIE_PSOC6_04
	select SOC_PACKAGE_PSOC6_04_68_QFN
	select SOC_SERIES_PSOC_61

config SOC_CY8C6144AZI_S4F93
	bool
	select SOC_DIE_PSOC6_04
	select SOC_PACKAGE_PSOC6_04_80_TQFP
	select SOC_SERIES_PSOC_61

config SOC_CY8C6144AZI_S4F82
	bool
	select SOC_DIE_PSOC6_04
	select SOC_PACKAGE_PSOC6_04_64_TQFP
	select SOC_SERIES_PSOC_61

config SOC_CY8C6144LQI_S4F82
	bool
	select SOC_DIE_PSOC6_04
	select SOC_PACKAGE_PSOC6_04_68_QFN
	select SOC_SERIES_PSOC_61

config SOC_CY8C6144AZI_S4F83
	bool
	select SOC_DIE_PSOC6_04
	select SOC_PACKAGE_PSOC6_04_80_TQFP
	select SOC_SERIES_PSOC_61

config SOC_CY8C6144AZI_S4F62
	bool
	select SOC_DIE_PSOC6_04
	select SOC_PACKAGE_PSOC6_04_64_TQFP
	select SOC_SERIES_PSOC_61

config SOC_CY8C6144LQI_S4F62
	bool
	select SOC_DIE_PSOC6_04
	select SOC_PACKAGE_PSOC6_04_68_QFN
	select SOC_SERIES_PSOC_61

config SOC_CY8C6144AZI_S4F12
	bool
	select SOC_DIE_PSOC6_04
	select SOC_PACKAGE_PSOC6_04_64_TQFP
	select SOC_SERIES_PSOC_61

config SOC_CY8C6144LQI_S4F12
	bool
	select SOC_DIE_PSOC6_04
	select SOC_PACKAGE_PSOC6_04_68_QFN
	select SOC_SERIES_PSOC_61

config SOC_SERIES
	default "psoc62" if SOC_SERIES_PSOC62
	default "psoc63" if SOC_SERIES_PSOC63
	default "psoc6" if SOC_SERIES_PSOC6

config SOC
	default "cy8c6247" if SOC_CY8C6247_M0 || SOC_CY8C6247_M4
	default "cy8c6347" if SOC_CY8C6247_M4 || SOC_CY8C6347_M4
	default "cy8c6036bzi_f04" if SOC_CY8C6036BZI_F04
	default "cy8c6016bzi_f04" if SOC_CY8C6016BZI_F04
	default "cy8c6116bzi_f54" if SOC_CY8C6116BZI_F54
	default "cy8c6136bzi_f14" if SOC_CY8C6136BZI_F14
	default "cy8c6136bzi_f34" if SOC_CY8C6136BZI_F34
	default "cy8c6137bzi_f14" if SOC_CY8C6137BZI_F14
	default "cy8c6137bzi_f34" if SOC_CY8C6137BZI_F34
	default "cy8c6137bzi_f54" if SOC_CY8C6137BZI_F54
	default "cy8c6117bzi_f34" if SOC_CY8C6117BZI_F34
	default "cy8c6246bzi_d04" if SOC_CY8C6246BZI_D04
	default "cy8c6247bzi_d44" if SOC_CY8C6247BZI_D44
	default "cy8c6247bzi_d34" if SOC_CY8C6247BZI_D34
	default "cy8c6247bzi_d54" if SOC_CY8C6247BZI_D54
	default "cy8c6336bzi_blf03" if SOC_CY8C6336BZI_BLF03
	default "cy8c6316bzi_blf03" if SOC_CY8C6316BZI_BLF03
	default "cy8c6316bzi_blf53" if SOC_CY8C6316BZI_BLF53
	default "cy8c6336bzi_bld13" if SOC_CY8C6336BZI_BLD13
	default "cy8c6347bzi_bld43" if SOC_CY8C6347BZI_BLD43
	default "cy8c6347bzi_bld33" if SOC_CY8C6347BZI_BLD33
	default "cy8c6347bzi_bld53" if SOC_CY8C6347BZI_BLD53
	default "cy8c6347fmi_bld13" if SOC_CY8C6347FMI_BLD13
	default "cy8c6347fmi_bld43" if SOC_CY8C6347FMI_BLD43
	default "cy8c6347fmi_bld33" if SOC_CY8C6347FMI_BLD33
	default "cy8c6347fmi_bld53" if SOC_CY8C6347FMI_BLD53
	default "cy8c6137fdi_f02" if SOC_CY8C6137FDI_F02
	default "cy8c6117fdi_f02" if SOC_CY8C6117FDI_F02
	default "cy8c6247fdi_d02" if SOC_CY8C6247FDI_D02
	default "cy8c6247fdi_d32" if SOC_CY8C6247FDI_D32
	default "cy8c6336bzi_bud13" if SOC_CY8C6336BZI_BUD13
	default "cy8c6347bzi_bud43" if SOC_CY8C6347BZI_BUD43
	default "cy8c6347bzi_bud33" if SOC_CY8C6347BZI_BUD33
	default "cy8c6347bzi_bud53" if SOC_CY8C6347BZI_BUD53
	default "cy8c6337bzi_blf13" if SOC_CY8C6337BZI_BLF13
	default "cy8c6136fdi_f42" if SOC_CY8C6136FDI_F42
	default "cy8c6247fdi_d52" if SOC_CY8C6247FDI_D52
	default "cy8c6136fti_f42" if SOC_CY8C6136FTI_F42
	default "cy8c6247fti_d52" if SOC_CY8C6247FTI_D52
	default "cy8c6247bzi_aud54" if SOC_CY8C6247BZI_AUD54
	default "cy8c6336bzi_blf04" if SOC_CY8C6336BZI_BLF04
	default "cy8c6316bzi_blf04" if SOC_CY8C6316BZI_BLF04
	default "cy8c6316bzi_blf54" if SOC_CY8C6316BZI_BLF54
	default "cy8c6336bzi_bld14" if SOC_CY8C6336BZI_BLD14
	default "cy8c6347bzi_bld44" if SOC_CY8C6347BZI_BLD44
	default "cy8c6347bzi_bld34" if SOC_CY8C6347BZI_BLD34
	default "cy8c6347bzi_bld54" if SOC_CY8C6347BZI_BLD54
	default "cy8c6247bfi_d54" if SOC_CY8C6247BFI_D54
	default "cyble_416045_02" if SOC_CYBLE_416045_02
	default "cy8c6347fmi_bud53" if SOC_CY8C6347FMI_BUD53
	default "cy8c6347fmi_bud13" if SOC_CY8C6347FMI_BUD13
	default "cy8c6347fmi_bud43" if SOC_CY8C6347FMI_BUD43
	default "cy8c6347fmi_bud33" if SOC_CY8C6347FMI_BUD33
	default "cy8c6137wi_f54" if SOC_CY8C6137WI_F54
	default "cy8c6117wi_f34" if SOC_CY8C6117WI_F34
	default "cy8c6247wi_d54" if SOC_CY8C6247WI_D54
	default "cy8c6336lqi_blf02" if SOC_CY8C6336LQI_BLF02
	default "cy8c6336lqi_blf42" if SOC_CY8C6336LQI_BLF42
	default "cy8c6347lqi_bld52" if SOC_CY8C6347LQI_BLD52
	default "cyb06447bzi_bld54" if SOC_CYB06447BZI_BLD54
	default "cyb06447bzi_bld53" if SOC_CYB06447BZI_BLD53
	default "cyb06447bzi_d54" if SOC_CYB06447BZI_D54
	default "cyb0644abzi_s2d44" if SOC_CYB0644ABZI_S2D44
	default "cys0644abzi_s2d44" if SOC_CYS0644ABZI_S2D44
	default "cy8c624abzi_s2d44a0" if SOC_CY8C624ABZI_S2D44A0
	default "cy8c624abzi_s2d44" if SOC_CY8C624ABZI_S2D44
	default "cy8c624aazi_s2d44" if SOC_CY8C624AAZI_S2D44
	default "cy8c624afni_s2d43" if SOC_CY8C624AFNI_S2D43
	default "cy8c624abzi_s2d04" if SOC_CY8C624ABZI_S2D04
	default "cy8c624abzi_s2d14" if SOC_CY8C624ABZI_S2D14
	default "cy8c624aazi_s2d14" if SOC_CY8C624AAZI_S2D14
	default "cy8c6248azi_s2d14" if SOC_CY8C6248AZI_S2D14
	default "cy8c6248bzi_s2d44" if SOC_CY8C6248BZI_S2D44
	default "cy8c6248azi_s2d44" if SOC_CY8C6248AZI_S2D44
	default "cy8c6248fni_s2d43" if SOC_CY8C6248FNI_S2D43
	default "cy8c614abzi_s2f04" if SOC_CY8C614ABZI_S2F04
	default "cy8c614aazi_s2f04" if SOC_CY8C614AAZI_S2F04
	default "cy8c614afni_s2f03" if SOC_CY8C614AFNI_S2F03
	default "cy8c614aazi_s2f14" if SOC_CY8C614AAZI_S2F14
	default "cy8c614abzi_s2f44" if SOC_CY8C614ABZI_S2F44
	default "cy8c614aazi_s2f44" if SOC_CY8C614AAZI_S2F44
	default "cy8c614afni_s2f43" if SOC_CY8C614AFNI_S2F43
	default "cy8c6148bzi_s2f44" if SOC_CY8C6148BZI_S2F44
	default "cy8c6148azi_s2f44" if SOC_CY8C6148AZI_S2F44
	default "cy8c6148fni_s2f43" if SOC_CY8C6148FNI_S2F43
	default "cy8c624abzi_d44" if SOC_CY8C624ABZI_D44
	default "cy8c624alqi_s2d42" if SOC_CY8C624ALQI_S2D42
	default "cy8c624alqi_s2d02" if SOC_CY8C624ALQI_S2D02
	default "cy8c6248lqi_s2d42" if SOC_CY8C6248LQI_S2D42
	default "cy8c6248lqi_s2d02" if SOC_CY8C6248LQI_S2D02
	default "cy8c614alqi_s2f42" if SOC_CY8C614ALQI_S2F42
	default "cy8c614alqi_s2f02" if SOC_CY8C614ALQI_S2F02
	default "cy8c6148lqi_s2f42" if SOC_CY8C6148LQI_S2F42
	default "cy8c6148lqi_s2f02" if SOC_CY8C6148LQI_S2F02
	default "cy8c6244azi_s4d92" if SOC_CY8C6244AZI_S4D92
	default "cy8c6244lqi_s4d92" if SOC_CY8C6244LQI_S4D92
	default "cy8c6244azi_s4d93" if SOC_CY8C6244AZI_S4D93
	default "cy8c6244azi_s4d82" if SOC_CY8C6244AZI_S4D82
	default "cy8c6244lqi_s4d82" if SOC_CY8C6244LQI_S4D82
	default "cy8c6244azi_s4d83" if SOC_CY8C6244AZI_S4D83
	default "cy8c6244azi_s4d62" if SOC_CY8C6244AZI_S4D62
	default "cy8c6244lqi_s4d62" if SOC_CY8C6244LQI_S4D62
	default "cy8c6244azi_s4d12" if SOC_CY8C6244AZI_S4D12
	default "cy8c6244lqi_s4d12" if SOC_CY8C6244LQI_S4D12
	default "cy8c6144azi_s4f92" if SOC_CY8C6144AZI_S4F92
	default "cy8c6144lqi_s4f92" if SOC_CY8C6144LQI_S4F92
	default "cy8c6144azi_s4f93" if SOC_CY8C6144AZI_S4F93
	default "cy8c6144azi_s4f82" if SOC_CY8C6144AZI_S4F82
	default "cy8c6144lqi_s4f82" if SOC_CY8C6144LQI_S4F82
	default "cy8c6144azi_s4f83" if SOC_CY8C6144AZI_S4F83
	default "cy8c6144azi_s4f62" if SOC_CY8C6144AZI_S4F62
	default "cy8c6144lqi_s4f62" if SOC_CY8C6144LQI_S4F62
	default "cy8c6144azi_s4f12" if SOC_CY8C6144AZI_S4F12
	default "cy8c6144lqi_s4f12" if SOC_CY8C6144LQI_S4F12

config SOC_PART_NUMBER
	default "CY8C6247BZI_D54" if SOC_PART_NUMBER_CY8C6247BZI_D54
	default "CY8C6347BZI_BLD53" if SOC_PART_NUMBER_CY8C6347BZI_BLD53
	default "CY8C6036BZI_F04" if SOC_CY8C6036BZI_F04
	default "CY8C6016BZI_F04" if SOC_CY8C6016BZI_F04
	default "CY8C6116BZI_F54" if SOC_CY8C6116BZI_F54
	default "CY8C6136BZI_F14" if SOC_CY8C6136BZI_F14
	default "CY8C6136BZI_F34" if SOC_CY8C6136BZI_F34
	default "CY8C6137BZI_F14" if SOC_CY8C6137BZI_F14
	default "CY8C6137BZI_F34" if SOC_CY8C6137BZI_F34
	default "CY8C6137BZI_F54" if SOC_CY8C6137BZI_F54
	default "CY8C6117BZI_F34" if SOC_CY8C6117BZI_F34
	default "CY8C6246BZI_D04" if SOC_CY8C6246BZI_D04
	default "CY8C6247BZI_D44" if SOC_CY8C6247BZI_D44
	default "CY8C6247BZI_D34" if SOC_CY8C6247BZI_D34
	default "CY8C6247BZI_D54" if SOC_CY8C6247BZI_D54
	default "CY8C6336BZI_BLF03" if SOC_CY8C6336BZI_BLF03
	default "CY8C6316BZI_BLF03" if SOC_CY8C6316BZI_BLF03
	default "CY8C6316BZI_BLF53" if SOC_CY8C6316BZI_BLF53
	default "CY8C6336BZI_BLD13" if SOC_CY8C6336BZI_BLD13
	default "CY8C6347BZI_BLD43" if SOC_CY8C6347BZI_BLD43
	default "CY8C6347BZI_BLD33" if SOC_CY8C6347BZI_BLD33
	default "CY8C6347BZI_BLD53" if SOC_CY8C6347BZI_BLD53
	default "CY8C6347FMI_BLD13" if SOC_CY8C6347FMI_BLD13
	default "CY8C6347FMI_BLD43" if SOC_CY8C6347FMI_BLD43
	default "CY8C6347FMI_BLD33" if SOC_CY8C6347FMI_BLD33
	default "CY8C6347FMI_BLD53" if SOC_CY8C6347FMI_BLD53
	default "CY8C6137FDI_F02" if SOC_CY8C6137FDI_F02
	default "CY8C6117FDI_F02" if SOC_CY8C6117FDI_F02
	default "CY8C6247FDI_D02" if SOC_CY8C6247FDI_D02
	default "CY8C6247FDI_D32" if SOC_CY8C6247FDI_D32
	default "CY8C6336BZI_BUD13" if SOC_CY8C6336BZI_BUD13
	default "CY8C6347BZI_BUD43" if SOC_CY8C6347BZI_BUD43
	default "CY8C6347BZI_BUD33" if SOC_CY8C6347BZI_BUD33
	default "CY8C6347BZI_BUD53" if SOC_CY8C6347BZI_BUD53
	default "CY8C6337BZI_BLF13" if SOC_CY8C6337BZI_BLF13
	default "CY8C6136FDI_F42" if SOC_CY8C6136FDI_F42
	default "CY8C6247FDI_D52" if SOC_CY8C6247FDI_D52
	default "CY8C6136FTI_F42" if SOC_CY8C6136FTI_F42
	default "CY8C6247FTI_D52" if SOC_CY8C6247FTI_D52
	default "CY8C6247BZI_AUD54" if SOC_CY8C6247BZI_AUD54
	default "CY8C6336BZI_BLF04" if SOC_CY8C6336BZI_BLF04
	default "CY8C6316BZI_BLF04" if SOC_CY8C6316BZI_BLF04
	default "CY8C6316BZI_BLF54" if SOC_CY8C6316BZI_BLF54
	default "CY8C6336BZI_BLD14" if SOC_CY8C6336BZI_BLD14
	default "CY8C6347BZI_BLD44" if SOC_CY8C6347BZI_BLD44
	default "CY8C6347BZI_BLD34" if SOC_CY8C6347BZI_BLD34
	default "CY8C6347BZI_BLD54" if SOC_CY8C6347BZI_BLD54
	default "CY8C6247BFI_D54" if SOC_CY8C6247BFI_D54
	default "CYBLE_416045_02_device" if SOC_CYBLE_416045_02
	default "CY8C6347FMI_BUD53" if SOC_CY8C6347FMI_BUD53
	default "CY8C6347FMI_BUD13" if SOC_CY8C6347FMI_BUD13
	default "CY8C6347FMI_BUD43" if SOC_CY8C6347FMI_BUD43
	default "CY8C6347FMI_BUD33" if SOC_CY8C6347FMI_BUD33
	default "CY8C6137WI_F54" if SOC_CY8C6137WI_F54
	default "CY8C6117WI_F34" if SOC_CY8C6117WI_F34
	default "CY8C6247WI_D54" if SOC_CY8C6247WI_D54
	default "CY8C6336LQI_BLF02" if SOC_CY8C6336LQI_BLF02
	default "CY8C6336LQI_BLF42" if SOC_CY8C6336LQI_BLF42
	default "CY8C6347LQI_BLD52" if SOC_CY8C6347LQI_BLD52
	default "CYB06447BZI_BLD54" if SOC_CYB06447BZI_BLD54
	default "CYB06447BZI_BLD53" if SOC_CYB06447BZI_BLD53
	default "CYB06447BZI_D54" if SOC_CYB06447BZI_D54
	default "CYB0644ABZI_S2D44" if SOC_CYB0644ABZI_S2D44
	default "CYS0644ABZI_S2D44" if SOC_CYS0644ABZI_S2D44
	default "CY8C624ABZI_S2D44A0" if SOC_CY8C624ABZI_S2D44A0
	default "CY8C624ABZI_S2D44" if SOC_CY8C624ABZI_S2D44
	default "CY8C624AAZI_S2D44" if SOC_CY8C624AAZI_S2D44
	default "CY8C624AFNI_S2D43" if SOC_CY8C624AFNI_S2D43
	default "CY8C624ABZI_S2D04" if SOC_CY8C624ABZI_S2D04
	default "CY8C624ABZI_S2D14" if SOC_CY8C624ABZI_S2D14
	default "CY8C624AAZI_S2D14" if SOC_CY8C624AAZI_S2D14
	default "CY8C6248AZI_S2D14" if SOC_CY8C6248AZI_S2D14
	default "CY8C6248BZI_S2D44" if SOC_CY8C6248BZI_S2D44
	default "CY8C6248AZI_S2D44" if SOC_CY8C6248AZI_S2D44
	default "CY8C6248FNI_S2D43" if SOC_CY8C6248FNI_S2D43
	default "CY8C614ABZI_S2F04" if SOC_CY8C614ABZI_S2F04
	default "CY8C614AAZI_S2F04" if SOC_CY8C614AAZI_S2F04
	default "CY8C614AFNI_S2F03" if SOC_CY8C614AFNI_S2F03
	default "CY8C614AAZI_S2F14" if SOC_CY8C614AAZI_S2F14
	default "CY8C614ABZI_S2F44" if SOC_CY8C614ABZI_S2F44
	default "CY8C614AAZI_S2F44" if SOC_CY8C614AAZI_S2F44
	default "CY8C614AFNI_S2F43" if SOC_CY8C614AFNI_S2F43
	default "CY8C6148BZI_S2F44" if SOC_CY8C6148BZI_S2F44
	default "CY8C6148AZI_S2F44" if SOC_CY8C6148AZI_S2F44
	default "CY8C6148FNI_S2F43" if SOC_CY8C6148FNI_S2F43
	default "CY8C624ABZI_D44" if SOC_CY8C624ABZI_D44
	default "CY8C624ALQI_S2D42" if SOC_CY8C624ALQI_S2D42
	default "CY8C624ALQI_S2D02" if SOC_CY8C624ALQI_S2D02
	default "CY8C6248LQI_S2D42" if SOC_CY8C6248LQI_S2D42
	default "CY8C6248LQI_S2D02" if SOC_CY8C6248LQI_S2D02
	default "CY8C614ALQI_S2F42" if SOC_CY8C614ALQI_S2F42
	default "CY8C614ALQI_S2F02" if SOC_CY8C614ALQI_S2F02
	default "CY8C6148LQI_S2F42" if SOC_CY8C6148LQI_S2F42
	default "CY8C6148LQI_S2F02" if SOC_CY8C6148LQI_S2F02
	default "CY8C6244AZI_S4D92" if SOC_CY8C6244AZI_S4D92
	default "CY8C6244LQI_S4D92" if SOC_CY8C6244LQI_S4D92
	default "CY8C6244AZI_S4D93" if SOC_CY8C6244AZI_S4D93
	default "CY8C6244AZI_S4D82" if SOC_CY8C6244AZI_S4D82
	default "CY8C6244LQI_S4D82" if SOC_CY8C6244LQI_S4D82
	default "CY8C6244AZI_S4D83" if SOC_CY8C6244AZI_S4D83
	default "CY8C6244AZI_S4D62" if SOC_CY8C6244AZI_S4D62
	default "CY8C6244LQI_S4D62" if SOC_CY8C6244LQI_S4D62
	default "CY8C6244AZI_S4D12" if SOC_CY8C6244AZI_S4D12
	default "CY8C6244LQI_S4D12" if SOC_CY8C6244LQI_S4D12
	default "CY8C6144AZI_S4F92" if SOC_CY8C6144AZI_S4F92
	default "CY8C6144LQI_S4F92" if SOC_CY8C6144LQI_S4F92
	default "CY8C6144AZI_S4F93" if SOC_CY8C6144AZI_S4F93
	default "CY8C6144AZI_S4F82" if SOC_CY8C6144AZI_S4F82
	default "CY8C6144LQI_S4F82" if SOC_CY8C6144LQI_S4F82
	default "CY8C6144AZI_S4F83" if SOC_CY8C6144AZI_S4F83
	default "CY8C6144AZI_S4F62" if SOC_CY8C6144AZI_S4F62
	default "CY8C6144LQI_S4F62" if SOC_CY8C6144LQI_S4F62
	default "CY8C6144AZI_S4F12" if SOC_CY8C6144AZI_S4F12
	default "CY8C6144LQI_S4F12" if SOC_CY8C6144LQI_S4F12
```
