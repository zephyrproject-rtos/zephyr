## soc/cypress/psoc6/new/Kconfig.defconfig.psoc6_01
```kconfig
# Copyright (c) 2022 Cypress Semiconductor Corporation (an Infineon company) or
# an affiliate of Cypress Semiconductor Corporation
# SPDX-License-Identifier: Apache-2.0

# Infineon PSoC6_01 based MCU default configuration

if SOC_DIE_PSOC6_01

config NUM_IRQS
	default 32 if CPU_CORTEX_M0PLUS
	default 147 if CPU_CORTEX_M4

# add additional die specific params

endif # SOC_DIE_PSOC6_01
```

## soc/cypress/psoc6/new/Kconfig.defconfig.psoc6_04
```kconfig
# Copyright (c) 2022 Cypress Semiconductor Corporation (an Infineon company) or
# an affiliate of Cypress Semiconductor Corporation
# Copyright (c) David Ullmann
# SPDX-License-Identifier: Apache-2.0

# Infineon PSoC6_04 based MCU default configuration

if SOC_DIE_PSOC6_04

config NUM_IRQS
	default 16 if CPU_CORTEX_M0PLUS
	default 175 if CPU_CORTEX_M4

endif # SOC_DIE_PSOC6_04
```

## soc/cypress/psoc6/old/Kconfig.defconfig.psoc6_m0
```kconfig
# Cypress PSoC6 CM0 platform configuration options
# Copyright (c) 2018, Cypress
# SPDX-License-Identifier: Apache-2.0

if SOC_CY8C6247_M0 || SOC_CY8C6347_M0

config NUM_IRQS
	default 32

endif # SOC_CY8C6247_M0 || SOC_CY8C6347_M0
```

## soc/cypress/psoc6/old/Kconfig.defconfig.psoc6_m4
```kconfig
# Cypress PSoC6 CM4 platform configuration options
# Copyright (c) 2018, Cypress
# SPDX-License-Identifier: Apache-2.0

if SOC_CY8C6247_M4 || SOC_CY8C6347_M4

config NUM_IRQS
	default 147

endif # SOC_CY8C6247_M4 || SOC_CY8C6347_M4
```

## soc/efinix/sapphire/Kconfig
```kconfig
# Copyright (c) 2023 Efinix Inc.
# SPDX-License-Identifier: Apache-2.0

config SOC_EFINIX_SAPPHIRE
	select INCLUDE_RESET_VECTOR
	select RISCV
	select RISCV_PRIVILEGED
	select RISCV_HAS_PLIC
	imply XIP
```

## soc/efinix/sapphire/Kconfig.defconfig
```kconfig
# Copyright (c) 2023 Efinix Inc.
# SPDX-License-Identifier: Apache-2.0

if SOC_EFINIX_SAPPHIRE

config SYS_CLOCK_HW_CYCLES_PER_SEC
	default 100000000

config RISCV_SOC_INTERRUPT_INIT
	default y

config NUM_IRQS
	default 36

config 2ND_LVL_INTR_00_OFFSET
	default 11

endif # SOC_EFINIX_SAPPHIRE
```

## soc/efinix/sapphire/Kconfig.soc
```kconfig
# Copyright (c) 2023 Efinix Inc.
# SPDX-License-Identifier: Apache-2.0

config SOC_EFINIX_SAPPHIRE
	bool
	help
	  Efinix Sapphire VexRiscv system implementation

config SOC
	default "efinix_sapphire" if SOC_EFINIX_SAPPHIRE
```

## soc/egis/Kconfig
```kconfig
# Copyright (c) 2025 Egis Technology Inc.
# SPDX-License-Identifier: Apache-2.0

if SOC_EGIS_ET171

rsource "*/Kconfig"

endif # SOC_EGIS_ET171
```

## soc/egis/Kconfig.soc
```kconfig
# Copyright (c) 2025 Egis Technology Inc.
# SPDX-License-Identifier: Apache-2.0

rsource "*/Kconfig.soc"
```

## soc/egis/et171/Kconfig
```kconfig
# Copyright (c) 2025 Egis Technology Inc.
# SPDX-License-Identifier: Apache-2.0

config SOC_EGIS_ET171
	imply XIP
	select RISCV
	select RISCV_PRIVILEGED
	select RISCV_HAS_PLIC
	select RISCV_SOC_HAS_GP_RELATIVE_ADDRESSING
	select RISCV_ISA_RV32I
	select RISCV_ISA_EXT_M
	select RISCV_ISA_EXT_A
	select RISCV_ISA_EXT_C
	select RISCV_ISA_EXT_F
	select RISCV_ISA_EXT_ZICSR
	select RISCV_ISA_EXT_ZIFENCEI
	select CPU_HAS_DCACHE
	select CPU_HAS_ICACHE
	select CPU_HAS_ANDES_EXECIT
	select CPU_HAS_ANDES_HWDSP
	select CPU_HAS_ANDES_PFT
	select RISCV_SOC_CONTEXT_SAVE if RISCV_CUSTOM_CSR_ANDES_HWDSP
	select RISCV_SOC_CONTEXT_SAVE if RISCV_CUSTOM_CSR_ANDES_PFT
	select RISCV_PMP
	select HAS_FLASH_LOAD_OFFSET
	select SOC_EARLY_INIT_HOOK

config SOC_EGIS_ET171_FIRMWARE_VERSION
	hex "Firmware version"
	default 0xAAAAAAAA
	help
	  Firmware version info of bin header

config SOC_EGIS_ET171_VENDOR_FIRMWARE_SIZE
	hex "The firmware size in the binary header"
	default 0x0 # 0 means unused
	help
	  Customize the firmware size info in the binary header.
	  Unused if zero.
```

## soc/egis/et171/Kconfig.defconfig
```kconfig
# Copyright (c) 2025 Egis Technology Inc.
# SPDX-License-Identifier: Apache-2.0

if SOC_EGIS_ET171

rsource "Kconfig.defconfig.et171"

config SYS_CLOCK_HW_CYCLES_PER_SEC
	default $(dt_node_int_prop_int,/clocks/clk_mtimer,clock-frequency)

config KERNEL_ENTRY
	default "entry"

config RISCV_GENERIC_TOOLCHAIN
	default n if "$(ZEPHYR_TOOLCHAIN_VARIANT)" != "zephyr"

config RISCV_SOC_INTERRUPT_INIT
	default y

config PMP_NO_NA4
	default y

config PMP_GRANULARITY
	default 8

config 2ND_LVL_ISR_TBL_OFFSET
	default 12

config 2ND_LVL_INTR_00_OFFSET
	default 11

config 2ND_LVL_INTR_01_OFFSET
	default 3

config MAX_IRQ_PER_AGGREGATOR
	default 52

config NUM_2ND_LEVEL_AGGREGATORS
	default 2

config NUM_IRQS
	default 116

choice CACHE_TYPE
	default EXTERNAL_CACHE
endchoice

endif # SOC_EGIS_ET171
```

## soc/egis/et171/Kconfig.defconfig.et171
```kconfig
# Copyright (c) 2025 Egis Technology Inc.
# SPDX-License-Identifier: Apache-2.0

if SOC_EGIS_ET171

config SYS_CLOCK_TICKS_PER_SEC
	default 100 if (!ICACHE || XIP)

config MAIN_STACK_SIZE
	default 2048

config IDLE_STACK_SIZE
	default 1536

config LINKER_USE_RELAX
	default n if XIP

endif # SOC_EGIS_ET171
```

## soc/egis/et171/Kconfig.soc
```kconfig
# Copyright (c) 2025 Egis Technology Inc.
# SPDX-License-Identifier: Apache-2.0

config SOC_EGIS_ET171
	bool
	help
	  Egis ET171 SoC implementation

config SOC
	default "et171" if SOC_EGIS_ET171
```

## soc/elan/em32f967/Kconfig
```kconfig
# Copyright (c) 2025 Elan Microelectronics Corps.
# SPDX-License-Identifier: Apache-2.0

config SOC_EM32F967
	select ARM
	select CPU_CORTEX_M4
	select CPU_HAS_ARM_MPU
```

## soc/elan/em32f967/Kconfig.defconfig
```kconfig
# Copyright (c) 2025 Elan Microelectronics Corps.
# SPDX-License-Identifier: Apache-2.0

if SOC_EM32F967

config NUM_IRQS
	default 64

config SYS_CLOCK_HW_CYCLES_PER_SEC
	default $(dt_node_int_prop_int,/system-clock,clock-frequency)

config BUILD_OUTPUT_BIN
	default y

config BUILD_OUTPUT_HEX
	default y

endif # SOC_EM32F967
```

## soc/elan/em32f967/Kconfig.soc
```kconfig
# Copyright (c) 2025 Elan Microelectronics Corp.
# SPDX-License-Identifier: Apache-2.0

config SOC_EM32F967
	bool
	help
	  ELAN EM32F967

config SOC
	default "em32f967" if SOC_EM32F967
```

## soc/ene/kb106x/Kconfig
```kconfig
# Copyright (c) 2025 ENE Technology Inc.
# SPDX-License-Identifier: Apache-2.0

config SOC_FAMILY_KB106X
	select BUILD_OUTPUT_HEX
	select BUILD_OUTPUT_BIN
	select HAS_SEGGER_RTT if ZEPHYR_SEGGER_MODULE

if SOC_FAMILY_KB106X

rsource "*/Kconfig"

endif # SOC_FAMILY_KB106X
```

## soc/ene/kb106x/Kconfig.defconfig
```kconfig
# Copyright (c) 2025 ENE Technology Inc.
# SPDX-License-Identifier: Apache-2.0

if SOC_FAMILY_KB106X

rsource "*/Kconfig.defconfig"

endif # SOC_FAMILY_KB106X
```

## soc/ene/kb106x/Kconfig.soc
```kconfig
# Copyright (c) 2025 ENE Technology Inc.
# SPDX-License-Identifier: Apache-2.0

config SOC_FAMILY_KB106X
	bool

config SOC_FAMILY
	default "kb106x" if SOC_FAMILY_KB106X

rsource "*/Kconfig.soc"
```

## soc/ene/kb106x/kb106x/Kconfig
```kconfig
# Copyright (c) 2025 ENE Technology Inc.
# SPDX-License-Identifier: Apache-2.0

config SOC_SERIES_KB106X
	select ARM
	select CPU_CORTEX_M3
	select HAS_PM
	select SOC_EARLY_INIT_HOOK
```

## soc/ene/kb106x/kb106x/Kconfig.defconfig
```kconfig
# Copyright (c) 2025 ENE Technology Inc.
# SPDX-License-Identifier: Apache-2.0

if SOC_SERIES_KB106X

config NUM_IRQS
	default 64

config SYS_CLOCK_HW_CYCLES_PER_SEC
	default $(dt_node_int_prop_int,/cpus/cpu@0,clock-frequency)

config BUILD_OUTPUT_BIN
	default y

config BUILD_OUTPUT_HEX
	default y

config OUTPUT_DISASSEMBLY
	default y

config OUTPUT_DISASSEMBLE_ALL
	default n

endif # SOC_SERIES_KB106X
```

## soc/ene/kb106x/kb106x/Kconfig.soc
```kconfig
# Copyright (c) 2025 ENE Technology Inc.
# SPDX-License-Identifier: Apache-2.0

config SOC_SERIES_KB106X
	bool
	select SOC_FAMILY_KB106X
	help
	  Enable support for ENE KB106X Cortex-M3 MCU series

config SOC_SERIES
	default "kb106x" if SOC_SERIES_KB106X

config SOC_KB1062
	bool
	select SOC_SERIES_KB106X

config SOC_KB1064
	bool
	select SOC_SERIES_KB106X

config SOC
	default "kb1062" if SOC_KB1062
	default "kb1064" if SOC_KB1064
```

## soc/ene/kb1200/Kconfig
```kconfig
# Copyright (c) 2024 ENE Technology Inc.
# SPDX-License-Identifier: Apache-2.0

config SOC_KB1200
	select ARM
	select CPU_CORTEX_M4
	select CPU_HAS_ARM_MPU
	select CPU_CORTEX_M_HAS_DWT
	select CPU_HAS_FPU
```

## soc/ene/kb1200/Kconfig.defconfig
```kconfig
# Copyright (c) 2023 ENE Technology Inc.
# SPDX-License-Identifier: Apache-2.0

if SOC_KB1200

config NUM_IRQS
	default 64

config SYS_CLOCK_HW_CYCLES_PER_SEC
	default $(dt_node_int_prop_int,/cpus/cpu@0,clock-frequency)

config BUILD_OUTPUT_BIN
	default y

config BUILD_OUTPUT_HEX
	default y

endif # SOC_KB1200
```
