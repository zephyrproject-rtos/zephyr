## soc/bflb/Kconfig
```kconfig
# Copyright (c) 2021-2025 ATL Electronics
#
# SPDX-License-Identifier: Apache-2.0

if SOC_FAMILY_BFLB

rsource "*/Kconfig"

endif # SOC_FAMILY_BFLB
```

## soc/bflb/Kconfig.soc
```kconfig
# Copyright (c) 2021-2025 ATL Electronics
#
# SPDX-License-Identifier: Apache-2.0

config SOC_FAMILY_BFLB
	bool

config SOC_FAMILY
	default "bflb" if SOC_FAMILY_BFLB

rsource "*/Kconfig.soc"
```

## soc/bflb/bl60x/Kconfig
```kconfig
# Copyright (c) 2021-2025 ATL Electronics
#
# SPDX-License-Identifier: Apache-2.0

config SOC_SERIES_BL60X
	select RISCV
	select RISCV_MACHINE_TIMER
	select RISCV_ISA_RV32I
	select RISCV_ISA_EXT_M
	select RISCV_ISA_EXT_A
	select RISCV_ISA_EXT_C
	select RISCV_ISA_EXT_ZICSR
	select RISCV_ISA_EXT_ZIFENCEI
	select ATOMIC_OPERATIONS_C
	select CPU_HAS_FPU
	select INCLUDE_RESET_VECTOR
	select SOC_EARLY_INIT_HOOK
	select XIP
```

## soc/bflb/bl60x/Kconfig.soc
```kconfig
# Copyright (c) 2021-2025 ATL Electronics
#
# SPDX-License-Identifier: Apache-2.0

config SOC_SERIES_BL60X
	bool
	select SOC_FAMILY_BOUFFALOLAB_BFLB
	help
	  Enable support for BouffaloLab BL6xx MCU series

config SOC_SERIES
	default "bl60x" if SOC_SERIES_BL60X

config SOC_BL602C00Q2I
	bool
	select SOC_SERIES_BL60X

config SOC_BL602C20Q2I
	bool
	select SOC_SERIES_BL60X

config SOC_BL602C20Q2IS
	bool
	select SOC_SERIES_BL60X

config SOC_BL602C40Q2IS
	bool
	select SOC_SERIES_BL60X

config SOC_BL602l10Q2H
	bool
	select SOC_SERIES_BL60X

config SOC_BL602l20Q2H
	bool
	select SOC_SERIES_BL60X

config SOC_BL604E20Q2I
	bool
	select SOC_SERIES_BL60X

config SOC
	default "bl602c00q2i"  if SOC_BL602C00Q2I
	default "bl602c20q2i"  if SOC_BL602C20Q2I
	default "bl602c20q2is" if SOC_BL602C20Q2IS
	default "bl602c40q2is" if SOC_BL602C40Q2IS
	default "bl602l10q2h"  if SOC_BL602l10Q2H
	default "bl602l20q2h"  if SOC_BL602l20Q2H
	default "bl604e20q2i"  if SOC_BL604E20Q2I
```

## soc/bflb/bl616cl/Kconfig
```kconfig
# Copyright (c) 2026 MASSDRIVER EI (massdriver.space)
#
# SPDX-License-Identifier: Apache-2.0

config SOC_SERIES_BL616CL
	select CACHE_MANAGEMENT
	select CLOCK_CONTROL
	select CPU_HAS_DCACHE
	select CPU_HAS_ICACHE
	select CPU_XUANTIE_E907
	select OTP
	select RISCV
	select SOC_EARLY_INIT_HOOK
	select SOC_PREP_HOOK
	select USE_DT_CODE_PARTITION
	imply CODE_DATA_RELOCATION
	imply FLASH
	imply FPU
	imply XIP
```

## soc/bflb/bl616cl/Kconfig.soc
```kconfig
# Copyright (c) 2026 MASSDRIVER EI (massdriver.space)
#
# SPDX-License-Identifier: Apache-2.0

config SOC_SERIES_BL616CL
	bool
	select SOC_FAMILY_BFLB
	help
	  Enable support for BouffaloLab BL616CL MCU series

config SOC_SERIES
	default "bl616cl" if SOC_SERIES_BL616CL

config SOC_BL616CL3240
	bool
	select SOC_SERIES_BL616CL

config SOC_BL616CL3250
	bool
	select SOC_SERIES_BL616CL

config SOC_BL616CL3260
	bool
	select SOC_SERIES_BL616CL

config SOC_BL616CL4845
	bool
	select SOC_SERIES_BL616CL

config SOC_BL616CL4855
	bool
	select SOC_SERIES_BL616CL

config SOC_BL616CL4865
	bool
	select SOC_SERIES_BL616CL

config SOC_BL616CL4846
	bool
	select SOC_SERIES_BL616CL

config SOC_BL616CL4856
	bool
	select SOC_SERIES_BL616CL

config SOC_BL616CL4866
	bool
	select SOC_SERIES_BL616CL

config SOC
	default "bl616cl3240" if SOC_BL616CL3240
	default "bl616cl3250" if SOC_BL616CL3250
	default "bl616cl3260" if SOC_BL616CL3260
	default "bl616cl4845" if SOC_BL616CL4845
	default "bl616cl4855" if SOC_BL616CL4855
	default "bl616cl4865" if SOC_BL616CL4865
	default "bl616cl4846" if SOC_BL616CL4846
	default "bl616cl4856" if SOC_BL616CL4856
	default "bl616cl4866" if SOC_BL616CL4866
```

## soc/bflb/bl61x/Kconfig
```kconfig
# Copyright (c) 2024-2026 MASSDRIVER EI (massdriver.space)
#
# SPDX-License-Identifier: Apache-2.0

config SOC_SERIES_BL61X
	select CACHE_MANAGEMENT
	select CLOCK_CONTROL
	select CPU_HAS_DCACHE
	select CPU_HAS_ICACHE
	select CPU_XUANTIE_E907
	select OTP
	select RISCV
	select SOC_EARLY_INIT_HOOK
	select SOC_PREP_HOOK
	select USE_DT_CODE_PARTITION
	imply CODE_DATA_RELOCATION
	imply FLASH
	imply FPU
	imply REGULATOR
	imply XIP

config BFLB_BL61X_WL_RMEM_SIZE
	int "PHY/RF retention memory size (bytes)"
	default 8192
	depends on BT_BFLB_BL61X || WIFI_BFLB
	help
	  Size in bytes of the static buffer passed to wl_cfg_get() for
	  PHY/RF calibration data. The buffer persists for the lifetime
	  of the application. 8192 matches the Bouffalo SDK default.
```

## soc/bflb/bl61x/Kconfig.defconfig
```kconfig
# Copyright (c) 2025 MASSDRIVER EI (massdriver.space)
#
# SPDX-License-Identifier: Apache-2.0

if SOC_SERIES_BL61X

config SYS_CLOCK_TICKS_PER_SEC
	default 5000

config NUM_IRQS
	default 96

config ARCH_SW_ISR_TABLE_ALIGN
	default 64

config RISCV_MCAUSE_EXCEPTION_MASK
	default 0xFFF

endif # SOC_SERIES_BL61X
```

## soc/bflb/bl61x/Kconfig.soc
```kconfig
# Copyright (c) 2024-2025 MASSDRIVER EI (massdriver.space)
#
# SPDX-License-Identifier: Apache-2.0

config SOC_SERIES_BL61X
	bool
	select SOC_FAMILY_BFLB
	help
	  Enable support for BouffaloLab BL6xx MCU series

config SOC_SERIES
	default "bl61x" if SOC_SERIES_BL61X

config SOC_BL616C50Q2I
	bool
	select SOC_SERIES_BL61X

config SOC_BL616S50Q2I
	bool
	select SOC_SERIES_BL61X

config SOC_BL618M05Q2I
	bool
	select SOC_SERIES_BL61X

config SOC_BL618M50Q2I
	bool
	select SOC_SERIES_BL61X

config SOC_BL618M65Q2I
	bool
	select SOC_SERIES_BL61X

config SOC
	default "bl616c50q2i" if SOC_BL616C50Q2I
	default "bl616s50q2i" if SOC_BL616S50Q2I
	default "bl618m05q2i" if SOC_BL618M05Q2I
	default "bl618m50q2i" if SOC_BL618M50Q2I
	default "bl618m65q2i" if SOC_BL618M65Q2I
```

## soc/bflb/bl70x/Kconfig
```kconfig
# Copyright (c) 2025 MASSDRIVER EI (massdriver.space)
#
# SPDX-License-Identifier: Apache-2.0

config SOC_SERIES_BL70X
	select ATOMIC_OPERATIONS_C
	select CLOCK_CONTROL
	select CODE_DATA_RELOCATION
	select CPU_HAS_FPU
	select FLOAT_HARD
	select FPU
	select GEN_IRQ_VECTOR_TABLE
	select INCLUDE_RESET_VECTOR
	select RISCV
	select RISCV_HAS_CLIC
	select RISCV_MACHINE_TIMER
	select RISCV_PRIVILEGED
	select RISCV_ISA_RV32I
	select RISCV_ISA_EXT_M
	select RISCV_ISA_EXT_A
	select RISCV_ISA_EXT_F
	select RISCV_ISA_EXT_C
	select RISCV_ISA_EXT_ZICSR
	select RISCV_ISA_EXT_ZIFENCEI
	select RISCV_VECTORED_MODE
	select SOC_EARLY_INIT_HOOK
	select SOC_PREP_HOOK
	select SYSCON
	select XIP
```

## soc/bflb/bl70x/Kconfig.defconfig
```kconfig
# Copyright (c) 2025 MASSDRIVER EI (massdriver.space)
#
# SPDX-License-Identifier: Apache-2.0

if SOC_SERIES_BL70X

# On BL702, BL704 and BL706, not all values work, here is a list of some that work:
# 2000, 1000, 100, 10, 1
config SYS_CLOCK_TICKS_PER_SEC
	default 2000

config NUM_IRQS
	default 80

config ARCH_SW_ISR_TABLE_ALIGN
	default 64

config RISCV_MCAUSE_EXCEPTION_MASK
	default 0x3FF

endif # SOC_SERIES_BL70X
```

## soc/bflb/bl70x/Kconfig.soc
```kconfig
# Copyright (c) 2025 MASSDRIVER EI (massdriver.space)
#
# SPDX-License-Identifier: Apache-2.0

config SOC_SERIES_BL70X
	bool
	select SOC_FAMILY_BFLB
	help
	  Enable support for BouffaloLab BL6xx MCU series

config SOC_SERIES
	default "bl70x" if SOC_SERIES_BL70X

config SOC_BL702SA0Q2I
	bool
	select SOC_SERIES_BL70X

config SOC_BL702S10Q2I
	bool
	select SOC_SERIES_BL70X

config SOC_BL702C10Q2H
	bool
	select SOC_SERIES_BL70X

config SOC_BL706C10Q2I
	bool
	select SOC_SERIES_BL70X

config SOC_BL706S10Q2I
	bool
	select SOC_SERIES_BL70X

config SOC_BL706C22Q2I
	bool
	select SOC_SERIES_BL70X

config SOC
	default "bl702sa0q2i" if SOC_BL702SA0Q2I
	default "bl702s10q2i" if SOC_BL702S10Q2I
	default "bl702c10q2h" if SOC_BL702C10Q2H
	default "bl706c10q2i" if SOC_BL706C10Q2I
	default "bl706s10q2i" if SOC_BL706S10Q2I
	default "bl706c22q2i" if SOC_BL706C22Q2I
```

## soc/bflb/bl70xl/Kconfig.defconfig
```kconfig
# Copyright The Zephyr Project Contributors
#
# SPDX-License-Identifier: Apache-2.0

if SOC_SERIES_BL70XL

config SYS_CLOCK_TICKS_PER_SEC
	default 1000

config NUM_IRQS
	default 80

config ARCH_SW_ISR_TABLE_ALIGN
	default 64

config RISCV_MCAUSE_EXCEPTION_MASK
	default 0x3FF

choice CACHE_TYPE
	default EXTERNAL_CACHE
endchoice

endif # SOC_SERIES_BL70XL
```

## soc/bflb/bl70xl/Kconfig.soc
```kconfig
# Copyright The Zephyr Project Contributors
#
# SPDX-License-Identifier: Apache-2.0

config SOC_SERIES_BL70XL
	bool
	select SOC_FAMILY_BFLB
	help
	  Enable support for BouffaloLab BL70XL MCU series

config SOC_SERIES
	default "bl70xl" if SOC_SERIES_BL70XL

config SOC_BL702L10Q2I
	bool
	select SOC_SERIES_BL70XL

config SOC_BL704L10Q2I
	bool
	select SOC_SERIES_BL70XL

config SOC_BL704L22Q2H
	bool
	select SOC_SERIES_BL70XL

config SOC
	default "bl702l10q2i" if SOC_BL702L10Q2I
	default "bl704l10q2i" if SOC_BL704L10Q2I
	default "bl704l22q2h" if SOC_BL704L22Q2H
```

## soc/blackberry/qnxhv_vm/Kconfig
```kconfig
# Copyright (c) 2025 TOKITA Hiroshi
# SPDX-License-Identifier: Apache-2.0

config SOC_QNXHV_VM
	select ARM64
	select ARM_ARCH_TIMER if SYS_CLOCK_EXISTS
	select CPU_CORTEX_A72
```

## soc/blackberry/qnxhv_vm/Kconfig.defconfig
```kconfig
# Copyright (c) 2025 TOKITA Hiroshi
# SPDX-License-Identifier: Apache-2.0

if SOC_QNXHV_VM

DT_TIMER_PATH := $(dt_nodelabel_path,timer)

config SYS_CLOCK_HW_CYCLES_PER_SEC
	default $(dt_node_int_prop_int,$(DT_TIMER_PATH),clock-frequency)

config NUM_IRQS
	default 256

endif
```

## soc/blackberry/qnxhv_vm/Kconfig.soc
```kconfig
# Copyright (c) 2025 TOKITA Hiroshi
# SPDX-License-Identifier: Apache-2.0

config SOC_QNXHV_VM
	bool

config SOC
	default "qnxhv_vm" if SOC_QNXHV_VM
```

## soc/bouffalolab/Kconfig.defconfig
```kconfig
# Copyright (c) 2021-2025 ATL Electronics
#
# SPDX-License-Identifier: Apache-2.0

if SOC_FAMILY_BOUFFALOLAB_BFLB

config SYS_CLOCK_HW_CYCLES_PER_SEC
	default $(dt_node_int_prop_int,/cpus/cpu@0,clock-frequency)

rsource "*/Kconfig.defconfig"

endif # SOC_FAMILY_BOUFFALOLAB_BFLB
```

## soc/bouffalolab/bl6/Kconfig
```kconfig
# Copyright (c) 2021-2024 ATL Electronics
#
# SPDX-License-Identifier: Apache-2.0

config SOC_SERIES_BL6
	select RISCV
	select RISCV_HAS_CPU_IDLE
	select RISCV_MACHINE_TIMER
	select RISCV_PRIVILEGED
	select ATOMIC_OPERATIONS_C
	select COMPRESSED_ISA
	select CPU_HAS_FPU
	select INCLUDE_RESET_VECTOR
	select SOC_EARLY_INIT_HOOK
	select XIP

	select RISCV_ISA_RV32I
	select RISCV_ISA_EXT_M
	select RISCV_ISA_EXT_A
	select RISCV_ISA_EXT_C
	select RISCV_ISA_EXT_ZICSR
	select RISCV_ISA_EXT_ZIFENCEI
```

## soc/bouffalolab/bl6/Kconfig.defconfig
```kconfig
# Copyright (c) 2021-2024 ATL Electronics
#
# SPDX-License-Identifier: Apache-2.0

if SOC_SERIES_BL6

config SYS_CLOCK_HW_CYCLES_PER_SEC
	default 192000000

config NUM_IRQS
	default 80

config RISCV_RESERVED_IRQ_ISR_TABLES_OFFSET
	default 0

config RISCV_TRAP_HANDLER_ALIGNMENT
	default 8

endif   # SOC_SERIES_BL6
```

## soc/bouffalolab/bl60x/Kconfig
```kconfig
# Copyright (c) 2021-2024 ATL Electronics
# Copyright (c) 2024 MASSDRIVER EI (massdriver.space)
#
# SPDX-License-Identifier: Apache-2.0

config SOC_SERIES_BL60X
	select RISCV
	select RISCV_MACHINE_TIMER
	select RISCV_PRIVILEGED
	select RISCV_HAS_CLIC
	select RISCV_VECTORED_MODE
	select ATOMIC_OPERATIONS_C
	select CODE_DATA_RELOCATION
	select CPU_HAS_FPU
	select GEN_IRQ_VECTOR_TABLE
	select INCLUDE_RESET_VECTOR
	select SOC_EARLY_INIT_HOOK
	select XIP

	select RISCV_ISA_RV32I
	select RISCV_ISA_EXT_M
	select RISCV_ISA_EXT_A
	select RISCV_ISA_EXT_F
	select RISCV_ISA_EXT_C
	select RISCV_ISA_EXT_ZICSR
	select RISCV_ISA_EXT_ZIFENCEI
```

## soc/bouffalolab/bl60x/Kconfig.defconfig
```kconfig
# Copyright (c) 2021-2025 ATL Electronics
#
# SPDX-License-Identifier: Apache-2.0

if SOC_SERIES_BL60X

config NUM_IRQS
	default 80

endif # SOC_SERIES_BL60X
```

## soc/brcm/bcm2710/Kconfig
```kconfig
# Copyright (c) 2026 Jonathan Elliot Peace <jep@alphabetiq.com>
# SPDX-License-Identifier: Apache-2.0

config SOC_BCM2710
	select ARM64
	select CPU_CORTEX_A53
	select ARM_ARCH_TIMER if SYS_CLOCK_EXISTS
	select ARM_CUSTOM_INTERRUPT_CONTROLLER
	select SOC_PER_CORE_INIT_HOOK if SMP
```

## soc/brcm/bcm2710/Kconfig.soc
```kconfig
# Copyright (c) 2026 Jonathan Elliot Peace <jep@alphabetiq.com>
# SPDX-License-Identifier: Apache-2.0

config SOC_BCM2710
	bool

config SOC
	default "bcm2710" if SOC_BCM2710
```

## soc/brcm/bcm2711/Kconfig.defconfig
```kconfig
# Copyright 2023 honglin leng <a909204013@gmail.com>
# SPDX-License-Identifier: Apache-2.0

if SOC_BCM2711

config NUM_IRQS
	default 260

config SYS_CLOCK_HW_CYCLES_PER_SEC
	default $(dt_node_int_prop_int,/cpus/cpu@0,clock-frequency)

config CACHE_MANAGEMENT
	default y

endif
```
