## soc/tsi/skylp_v1/Kconfig.soc
```kconfig
# Copyright (c) 2024 Renesas Electronics Corporation
# SPDX-License-Identifier: Apache-2.0


config SOC_SERIES_SKYLP_V1
	bool
	select SOC_FAMILY_ARM
	help
	  Enable support for ARM MPS3 MCU Series

config SOC_SKYLP
	bool
	select SOC_SERIES_SKYP_V1
	help
	  skylp

config SOC_SKYLP_M85
	bool
	select SOC_SKYLP
	help
	  skylp_m85

config SOC_SERIES
	default "skylp_v1" if SOC_SERIES_SKYLP_V1

config SOC
	default "skylp" if SOC_SKYLP
```

## soc/tsi/skyp_v1/Kconfig.defconfig
```kconfig
# Copyright (c) 2024 Renesas Electronics Corporation
# SPDX-License-Identifier: Apache-2.0

if SOC_SERIES_SKYP_V1

config SYS_CLOCK_HW_CYCLES_PER_SEC
	default 25000000

config NUM_IRQS
	default 128

endif # SOC_SERIES_SKYP_V1
```

## soc/tsi/skyp_v1/Kconfig.soc
```kconfig
# Copyright (c) 2024 Renesas Electronics Corporation
# SPDX-License-Identifier: Apache-2.0


config SOC_SERIES_SKYP_V1
	bool
	select SOC_FAMILY_ARM
	help
	  Enable support for ARM MPS3 MCU Series

config SOC_SKYP
	bool
	select SOC_SERIES_SKYP_V1
	help
	  skyp

config SOC_SKYP_M85
	bool
	select SOC_SKYP
	help
	  skyp_m85

config SOC_SERIES
	default "skyp_v1" if SOC_SERIES_SKYP_V1

config SOC
	default "skyp" if SOC_SKYP
```

## soc/v2/arm/Kconfig.soc
```kconfig
# Copyright (c) 2024 Nordic Semiconductor ASA
# SPDX-License-Identifier: Apache-2.0

config SOC_FAMILY_ARM64
	bool

config SOC_FAMILY
	default "arm64" if SOC_FAMILY_ARM64

rsource "*/Kconfig.soc"
```

## soc/v2/arm/fvp_aemv8a/Kconfig.defconfig
```kconfig
# Copyright (c) 2021 Carlo Caione <ccaione@baylibre.com>
# SPDX-License-Identifier: Apache-2.0

if SOC_SERIES_FVP_AEMV8A

config SYS_CLOCK_HW_CYCLES_PER_SEC
	default 100000000

config NUM_IRQS
	default 16384 if GIC_V3_ITS
	default 128 if !GIC_V3_ITS

if SOC_FVP_BASE_REVC_2XAEMV8A

# Workaround for not being able to have commas in macro arguments
DT_CHOSEN_Z_FLASH := zephyr,flash

config FLASH_SIZE
	default $(dt_chosen_reg_size_int,$(DT_CHOSEN_Z_FLASH),0,K)

config FLASH_BASE_ADDRESS
	default $(dt_chosen_reg_addr_hex,$(DT_CHOSEN_Z_FLASH))

endif # SOC_FVP_BASE_REVC_2XAEMV8A

endif # SOC_SERIES_FVP_AEMV8A
```

## soc/v2/broadcom/bcm_vk/Kconfig
```kconfig
# SPDX-License-Identifier: Apache-2.0
#
# Copyright 2020 Broadcom.
#

if SOC_FAMILY_BCMVK

rsource "*/Kconfig"

endif
```

## soc/v2/gaisler/leon3/Kconfig.defconfig
```kconfig
# Copyright (c) 2019-2020 Cobham Gaisler AB
# SPDX-License-Identifier: Apache-2.0

if SOC_LEON3

config SYS_CLOCK_HW_CYCLES_PER_SEC
	default 40000000

endif
```

## soc/v2/intel/atom/Kconfig.soc
```kconfig
# Copyright (c) 2024 Intel Corporation.
#
# SPDX-License-Identifier: Apache-2.0

config SOC_ATOM
	bool

config SOC
	default "atom" if SOC_ATOM
```

## soc/v2/qemu_malta/Kconfig.defconfig
```kconfig
# Copyright (c) 2020 Antony Pavlov <antonynpavlov@gmail.com>
#
# SPDX-License-Identifier: Apache-2.0

if SOC_QEMU_MALTA

config SYS_CLOCK_HW_CYCLES_PER_SEC
	default 200000000

config NUM_IRQS
	default 8

endif # SOC_QEMU_MALTA
```

## soc/v2/qemu_malta/Kconfig.soc
```kconfig
# Copyright (c) 2020 Antony Pavlov <antonynpavlov@gmail.com>
#
# SPDX-License-Identifier: Apache-2.0

config SOC_QEMU_MALTA
	bool

config SOC
	default "qemu_malta" if SOC_QEMU_MALTA
```

## soc/v2/raspberry_pi/Kconfig
```kconfig
# Raspberry Pi (RP) MCU line

# Copyright (c) 2021 Nordic Semiconductor ASA
# Copyright (c) 2021 Yonatan Schachter
# SPDX-License-Identifier: Apache-2.0

rsource "*/Kconfig"
```

## soc/v2/raspberry_pi/rp2/Kconfig
```kconfig
# Raspberry Pi RP2XXX MCU line

# Copyright (c) 2021 Nordic Semiconductor ASA
# Copyright (c) 2021 Yonatan Schachter
# SPDX-License-Identifier: Apache-2.0

config SOC_SERIES_RP2XXX
	select ARM
	select CPU_CORTEX_M0PLUS
	select CPU_CORTEX_M_HAS_SYSTICK
	select CPU_CORTEX_M_HAS_VTOR
	select CPU_HAS_ARM_MPU
	select HAS_RPI_PICO
	select XIP
	select HAS_SEGGER_RTT if ZEPHYR_SEGGER_MODULE
	help
	  Enable support for Raspberry Pi RP2 MCU series

config RP2_REQUIRES_SECOND_STAGE_BOOT
	bool
	default y if FLASH_LOAD_OFFSET = 0x100

# Flash type used by the SoC. The board should select the one used.

config RP2_FLASH_W25Q080
	bool
	help
	  Configure RP2 to use a W25Q080 flash chip, or similar. Should be selected
	  by the board definition, not the user.

config RP2_FLASH_GENERIC_03H
	bool
	help
	  Configure RP2 to use a flash chip supporting the standard 03h command.
	  Should be selected by the board definition, not the user.

config RP2_FLASH_IS25LP080
	bool
	help
	  Configure RP2 to use a IS25LP080 flash chip, or similar. Should be selected
	  by the board definition, not the user.

config RP2_FLASH_W25X10CL
	bool
	help
	  Configure RP2 to use a W25X10CL flash chip, or similar. Should be selected
	  by the board definition, not the user.

config RP2_FLASH_AT25SF128A
	bool
	help
	  Configure RP2 to use a AT25SF128A flash chip, or similar. Should be selected
	  by the board definition, not the user.
```

## soc/v2/riscv/Kconfig.defconfig
```kconfig
# Copyright (c) 2024 Meta
# SPDX-License-Identifier: Apache-2.0

rsource "*/Kconfig.defconfig"
```

## soc/v2/riscv/renode_virt/Kconfig.soc
```kconfig
# Copyright (c) 2023 Meta
# SPDX-License-Identifier: Apache-2.0

config SOC_RISCV32_VIRTUAL_RENODE
	bool

config SOC
	default "renode_virt"
	depends on SOC_RISCV32_VIRTUAL_RENODE
```

## soc/v2/rockchip/rk3568/Kconfig
```kconfig
# Copyright 2022 HNU-ESNL
# Copyright 2022 openEuler SIG-Zephyr
# SPDX-License-Identifier: Apache-2.0

config SOC_SERIES_RK3568
	select ARM64
	select CPU_CORTEX_A55
	select ARM_ARCH_TIMER
	select GIC_V3
```

## soc/v2/st/stm32/Kconfig
```kconfig
# Copyright (c) 2024 STMicroelectronics
# SPDX-License-Identifier: Apache-2.0

config SOC_FAMILY_STM32
	select HAS_SEGGER_RTT if ZEPHYR_SEGGER_MODULE
	select STM32_ENABLE_DEBUG_SLEEP_STOP if DEBUG || ZTEST
	select BUILD_OUTPUT_HEX

rsource "*/Kconfig"

# STM32 wide symbols definitions

# Workaround for not being able to have commas in macro arguments
DT_CHOSEN_Z_CCM := zephyr,ccm

config STM32_CCM
	def_bool $(dt_chosen_enabled,$(DT_CHOSEN_Z_CCM))

config USE_STM32_ASSERT
	depends on ASSERT
	bool "STM32Cube HAL and LL drivers asserts"
	help
	  Enable asserts in STM32Cube HAL and LL drivers.

config STM32_BACKUP_SRAM
	bool "STM32 Backup SRAM"
	depends on DT_HAS_ST_STM32_BACKUP_SRAM_ENABLED
	help
	  Enable support for STM32 backup SRAM.

config STM32_ENABLE_DEBUG_SLEEP_STOP
	bool "Allow debugger attach in stop/sleep Mode"
	help
	  Some STM32 parts disable the DBGMCU in sleep/stop modes because
	  of power consumption. As a side-effects this prevents
	  debuggers from attaching w/o resetting the target. This
	  effectivly destroys the use-case of `west attach`. Also
	  SEGGER RTT and similar technologies need this.
```

## soc/v2/st_stm32/stm32f0/Kconfig.defconfig.stm32f070xb
```kconfig
# ST Microelectronics STM32F070XB MCU

# Copyright (c) 2018 qianfan Zhao
# SPDX-License-Identifier: Apache-2.0

if SOC_STM32F070XB

config NUM_IRQS
	default 32

endif # SOC_STM32F070XB
```

## soc/v2/st_stm32/stm32f0/Kconfig.defconfig.stm32f098xx
```kconfig
# ST Microelectronics STM32F098XX MCU

# Copyright (c) 2019 The Chromium OS Authors
# SPDX-License-Identifier: Apache-2.0

if SOC_STM32F098XX

config NUM_IRQS
	default 31

endif # SOC_STM32F098xx
```

## soc/v2/st_stm32/stm32f1/Kconfig.defconfig.stm32f105xx
```kconfig
# ST Microelectronics STM32F105XC MCU

# Copyright (c) 2019 Argentum Systems Ltd.
# SPDX-License-Identifier: Apache-2.0

if SOC_STM32F105XC || SOC_STM32F105XB

config NUM_IRQS
	int
	default 68

endif # SOC_STM32F105XC || STM32F105XB
```

## soc/v2/st_stm32/stm32f1/Kconfig.defconfig.stm32f107xc
```kconfig
# ST Microelectronics STM32F107XC MCU

# Copyright (c) 2016 RnDity Sp. z o.o.
# SPDX-License-Identifier: Apache-2.0

if SOC_STM32F107XC

config NUM_IRQS
	default 68

endif # SOC_STM32F107XC
```

## soc/wch/ch32v/Kconfig
```kconfig
# Copyright (c) 2024 Michael Hope
# SPDX-License-Identifier: Apache-2.0

config SOC_FAMILY_CH32V
	select RISCV
	select BUILD_OUTPUT_HEX
	select CH32V00X_SYSTICK
	select ATOMIC_OPERATIONS_C
	imply XIP

if SOC_FAMILY_CH32V

rsource "*/Kconfig"

endif # SOC_FAMILY_CH32V
```

## soc/wch/ch32v/Kconfig.soc
```kconfig
# Copyright (c) 2024 Michael Hope
# Copyright (c) 2024 Jianxiong Gu
# SPDX-License-Identifier: Apache-2.0

config SOC_FAMILY_CH32V
	bool

config SOC_FAMILY
	default "ch32v" if SOC_FAMILY_CH32V

rsource "*/Kconfig.soc"
```

## soc/wch/ch32v/ch32h41x/Kconfig
```kconfig
# Copyright (c) 2026 Liu Changjie
# SPDX-License-Identifier: Apache-2.0

config SOC_CH32H417_BOOT_V5F
	bool "Wake the V5F application core during early boot"
	depends on SOC_CH32H417_V3F
	default y
	# SOC_EARLY_INIT_HOOK is defined in kernel/Kconfig.init, which is not
	# loaded by the SoC-only Kconfig.soc.* compliance environment, so the
	# select must live in this (full-tree) Kconfig rather than Kconfig.soc.*.
	select SOC_EARLY_INIT_HOOK
	help
	  When enabled, the V3F boot core wakes the V5F application core (image
	  linked at 0x08010000, programmed at flash offset 0x10000) from
	  soc_early_init_hook(). Disable this when running the V3F core standalone,
	  with no V5F application image programmed, so the boot core does not jump
	  to a non-existent or invalid program.
```

## soc/wch/ch32v/ch32h41x/Kconfig.defconfig
```kconfig
# Copyright (c) 2026 Liu Changjie
# SPDX-License-Identifier: Apache-2.0

if SOC_SERIES_CH32H41X

config SYS_CLOCK_HW_CYCLES_PER_SEC
	default $(dt_node_int_prop_int,/cpus/cpu@1,clock-frequency) if SOC_CH32H417_V5F
	default $(dt_node_int_prop_int,/cpus/cpu@0,clock-frequency)

config CLOCK_CONTROL
	default y if !SOC_CH32H417_V3F

rsource "Kconfig.defconfig.*"

endif # SOC_SERIES_CH32H41X
```

## soc/wch/ch32v/ch32h41x/Kconfig.defconfig.ch32h417
```kconfig
# Copyright (c) 2026 Liu Changjie
# SPDX-License-Identifier: Apache-2.0

if SOC_CH32H417

config VECTOR_TABLE_SIZE
	default 256

config NUM_IRQS
	default 256

endif # SOC_CH32H417

if SOC_CH32H417_V3F

config RV_BOOT_HART
	default 0

endif # SOC_CH32H417_V3F

if SOC_CH32H417_V5F

# On the CH32H417 the QingKe V5F core is hart 1 (the V3F boot core is hart 0).
config RV_BOOT_HART
	default 1

endif # SOC_CH32H417_V5F
```
