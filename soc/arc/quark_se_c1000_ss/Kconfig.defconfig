## soc/arc/quark_se_c1000_ss/Kconfig.defconfig
```kconfig
#
# Copyright (c) 2014 Wind River Systems, Inc.
# Copyright (c) 2015-2016 Intel Corporation
#
# SPDX-License-Identifier: Apache-2.0
#

if SOC_QUARK_SE_C1000_SS

config SOC
	default "quark_se_c1000_ss"

config NUM_IRQ_PRIO_LEVELS
	# This processor supports only 2 priority levels:
	# 0 for Fast Interrupts (FIRQs) and 1 for Regular Interrupts (IRQs).
	default 2

config NUM_IRQS
	# must be > the highest interrupt number used
	default 68

config RGF_NUM_BANKS
	default 2

config SYS_CLOCK_HW_CYCLES_PER_SEC
	default 32000000

config HARVARD
	default n

config QMSI
	default y

if COUNTER

config RTC_QMSI
	default y

endif # RTC

if PWM
config PWM_QMSI
	default y
endif # PWM

if PINMUX
config PINMUX_QMSI
	default y
endif

if GPIO

config GPIO_QMSI
	default n

if GPIO_QMSI

config GPIO_QMSI_0
	default y

config GPIO_QMSI_1
	default y

endif # GPIO_QMSI

config GPIO_QMSI_SS
	default y

if GPIO_QMSI_SS

config GPIO_QMSI_SS_0
	default y

config GPIO_QMSI_SS_1
	default y

endif # GPIO_QMSI_SS

endif # GPIO


if I2C

config I2C_QMSI
	default n

if I2C_QMSI
config I2C_0
	default y

config I2C_1
	default y

config I2C_SDA_SETUP
	default 2

config I2C_SDA_TX_HOLD
	default 16

config I2C_SDA_RX_HOLD
	default 24

endif

config I2C_QMSI_SS
	default y

if I2C_QMSI_SS
config I2C_SS_0
	default y

config I2C_SS_1
	default y

config I2C_SS_SDA_SETUP
	default 2

config I2C_SS_SDA_HOLD
	default 10

endif

endif # I2C

if ADC
config ADC_DW
	default y
endif

if BT_H4

config UART_QMSI_0
	default y

config UART_QMSI_0_HW_FC
	default y

endif # BT_H4

if UART_QMSI

config UART_QMSI_1
	default y

endif # UART_QMSI

if SPI

config SPI_DW
	default y

if SPI_DW

config SPI_DW_FIFO_DEPTH
	default 7

config CLOCK_CONTROL
	default y

config CLOCK_CONTROL_QUARK_SE
	default y

config CLOCK_CONTROL_QUARK_SE_SENSOR
	default y

config SPI_0
	default y

config SPI_DW_PORT_0_INTERRUPT_SINGLE_LINE
	default n

config SPI_DW_PORT_0_CLOCK_GATE
	default y

config SPI_DW_PORT_0_CLOCK_GATE_DRV_NAME
	default CLOCK_CONTROL_QUARK_SE_SENSOR_DRV_NAME

config SPI_DW_PORT_0_CLOCK_GATE_SUBSYS
	default 3

config SPI_1
	default y

config SPI_DW_PORT_1_INTERRUPT_SINGLE_LINE
	default n

config SPI_DW_PORT_1_CLOCK_GATE
	default y

config SPI_DW_PORT_1_CLOCK_GATE_DRV_NAME
	default CLOCK_CONTROL_QUARK_SE_SENSOR_DRV_NAME

config SPI_DW_PORT_1_CLOCK_GATE_SUBSYS
	default 4

endif # SPI_DW
endif # SPI

if AIO_COMPARATOR

config AIO_COMPARATOR_QMSI
	default y

endif # AIO_COMPARATOR

if WATCHDOG

config WDT_QMSI
	default y
endif # WATCHDOG

if DMA

config DMA_QMSI
	default y

endif # DMA

if COUNTER

config AON_COUNTER_QMSI
	default y

config AON_TIMER_QMSI
	default y

config AON_TIMER_IRQ_PRI
	default 0

endif # COUNTER

endif #SOC_QUARK_SE_C1000_SS
```

## soc/arc/quark_se_c1000_ss/Kconfig.soc
```kconfig
# SPDX-License-Identifier: Apache-2.0

config SOC_QUARK_SE_C1000_SS
	bool "Intel Quark SE C1000- Sensor Sub System"
	select HAS_SYS_POWER_STATE_SLEEP_1
	select HAS_SYS_POWER_STATE_SLEEP_2
	select HAS_SYS_POWER_STATE_DEEP_SLEEP_1
	select HAS_SYS_POWER_STATE_DEEP_SLEEP_2
	select HAS_SYS_POWER_STATE_DEEP_SLEEP_3
	select HAS_QMSI
	select HAS_SPI_DW
```

## soc/arc/snps_arc_axs/Kconfig.defconfig
```kconfig
# Copyright (c) 2020 Synopsys, Inc. All rights reserved.
# SPDX-License-Identifier: Apache-2.0

if SOC_ARC_AXS

config SOC
	default "snps_arc_axs"

config NUM_IRQ_PRIO_LEVELS
	# This processor supports 2 priority levels:
	# 0 for Fast Interrupts (FIRQs) and 1 for Regular Interrupts (IRQs).
	default 2

config NUM_IRQS
	# must be > the highest interrupt number used
	default 88

config RGF_NUM_BANKS
	default 2

config SYS_CLOCK_HW_CYCLES_PER_SEC
	default 100000000

config ARC_FIRQ
	default y

config CODE_DENSITY
	default y

config ARCV2_TIMER_IRQ_PRIORITY
	default 1

config HARVARD
	default n

if SERIAL

config UART_NS16550
	default y

endif # SERIAL

if UART_CONSOLE

config UART_NS16550_PORT_2
	default y

config UART_NS16550_ACCESS_WORD_ONLY
	default y

endif # UART_CONSOLE

endif # ARC_AXS
```

## soc/arc/snps_arc_axs/Kconfig.soc
```kconfig
# Copyright (c) 2020 Synopsys, Inc. All rights reserved.
# SPDX-License-Identifier: Apache-2.0

config SOC_ARC_AXS
	bool "Synopsys ARC AXS SoC"
	select ARC
	select CPU_HAS_FPU
```

## soc/arc/snps_arc_hs4xd/Kconfig.soc
```kconfig
# Copyright (c) 2019 Synopsys, Inc. All rights reserved.
# SPDX-License-Identifier: Apache-2.0

config SOC_ARC_HS4XD
	bool "Synopsys ARC HS4XD SoC"
	select ARC
	select CPU_HAS_FPU
	select CPU_HAS_DSP
```

## soc/arc/snps_arc_hsdk/Kconfig.defconfig
```kconfig
# Copyright (c) 2019 Synopsys, Inc. All rights reserved.
# SPDX-License-Identifier: Apache-2.0

if SOC_ARC_HSDK

config SOC
	default "snps_arc_hsdk"

config CPU_HS3X
	default y

config NUM_IRQ_PRIO_LEVELS
	# This processor supports 2 priority levels:
	# 0 for Fast Interrupts (FIRQs) and 1 for Regular Interrupts (IRQs).
	default 2

config NUM_IRQS
	# must be > the highest interrupt number used
	default 88

config RGF_NUM_BANKS
	default 2

config SYS_CLOCK_HW_CYCLES_PER_SEC
	default 500000000

config ARC_FIRQ
	default y

config CODE_DENSITY
	default y

config ARCV2_TIMER_IRQ_PRIORITY
	default 1

config ARC_CONNECT
	default y

config MP_NUM_CPUS
	default 4

config UART_NS16550
	default y
	depends on SERIAL

config UART_NS16550_ACCESS_WORD_ONLY
	default y
	depends on UART_NS16550

config ARC_HAS_ACCL_REGS
	default y

endif # ARC_HSDK
```

## soc/arc/snps_arc_hsdk/Kconfig.soc
```kconfig
# Copyright (c) 2019 Synopsys, Inc. All rights reserved.
# SPDX-License-Identifier: Apache-2.0

config SOC_ARC_HSDK
	bool "Synopsys ARC HSDK SoC"
	select ARC
	select CPU_HAS_FPU
```

## soc/arc/snps_arc_hsdk4xd/Kconfig.soc
```kconfig
# Copyright (c) 2023 Synopsys, Inc. All rights reserved.
# SPDX-License-Identifier: Apache-2.0

config SOC_ARC_HSDK4XD
	bool "Synopsys ARC HSDK4XD SoC"
	select ARC
	select CPU_HAS_FPU
	select ARC_HAS_DSP
```

## soc/arc/snps_arc_iot/Kconfig.defconfig
```kconfig
# Copyright (c) 2014 Wind River Systems, Inc.
# Copyright (c) 2018 Synopsys, Inc. All rights reserved.
# SPDX-License-Identifier: Apache-2.0

if SOC_ARC_IOT

config SOC
	default "snps_arc_iot"

config CPU_EM4_FPUS
	default y

config NUM_IRQ_PRIO_LEVELS
	# This processor supports 4 priority levels:
	# 0 for Fast Interrupts (FIRQs) and 1-3 for Regular Interrupts (IRQs).
	default 4

config ARC_MPU_VER
	default 2

config NUM_IRQS
	# must be > the highest interrupt number used
	default 95

config RGF_NUM_BANKS
	default 2

config SYS_CLOCK_HW_CYCLES_PER_SEC
	default 144000000

config HARVARD
	default y

config ARC_FIRQ
	default y

config UART_NS16550
	default y
	depends on SERIAL

config UART_NS16550_ACCESS_IOPORT
	default y

endif # ARC_IOT
```

## soc/arc/snps_arc_iot/Kconfig.soc
```kconfig
#
# Copyright (c) 2014 Wind River Systems, Inc.
# Copyright (c) 2018 Synopsys, Inc. All rights reserved.
#
# SPDX-License-Identifier: Apache-2.0
#

config SOC_ARC_IOT
	bool "Synopsys ARC IoT SoC"
	select CPU_HAS_MPU
	select CPU_HAS_FPU
```

## soc/arc/snps_emsdp/Kconfig
```kconfig
# Copyright (c) 2019 Synopsys, Inc. All rights reserved.
# SPDX-License-Identifier: Apache-2.0

config SOC_EMSDP_EM4
	bool
	select CPU_HAS_MPU
	help
	  Synopsys ARC EM4 of EMSDP

config SOC_EMSDP_EM6
	bool
	select CPU_HAS_MPU
	help
	  Synopsys ARC EM6 of EMSDP

config SOC_EMSDP_EM5D
	bool
	select CPU_HAS_MPU
	select CPU_HAS_FPU
	help
	  Synopsys ARC EM5D of EMSDP

config SOC_EMSDP_EM7D
	bool
	select CPU_HAS_MPU
	select CPU_HAS_FPU
	help
	  Synopsys ARC EM7D of EMSDP

config SOC_EMSDP_EM7D_ESP
	bool
	select CPU_HAS_MPU
	select CPU_HAS_FPU
	select ARC_HAS_SECURE
	help
	  Synopsys ARC EM7D+ESP of EMSDP"

config SOC_EMSDP_EM9D
	bool
	select CPU_HAS_MPU
	select CPU_HAS_FPU
	help
	  Synopsys ARC EM9D of EMSDP

config SOC_EMSDP_EM11D
	bool
	select CPU_HAS_MPU
	select CPU_HAS_FPU
	help
	  Synopsys ARC EM11D of EMSDP
```

## soc/arc/snps_emsdp/Kconfig.defconfig
```kconfig
# Copyright (c) 2019 Synopsys, Inc. All rights reserved.
# SPDX-License-Identifier: Apache-2.0

if SOC_ARC_EMSDP

config SOC
	default "snps_emsdp"

config NUM_IRQ_PRIO_LEVELS
	# This processor supports 4 priority levels:
	# 0 for Fast Interrupts (FIRQs) and 1-3 for Regular Interrupts (IRQs).
	default 4

source "soc/arc/snps_emsdp/Kconfig.defconfig.em4"
source "soc/arc/snps_emsdp/Kconfig.defconfig.em5d"
source "soc/arc/snps_emsdp/Kconfig.defconfig.em6"
source "soc/arc/snps_emsdp/Kconfig.defconfig.em7d"
source "soc/arc/snps_emsdp/Kconfig.defconfig.em7d_esp"
source "soc/arc/snps_emsdp/Kconfig.defconfig.em9d"
source "soc/arc/snps_emsdp/Kconfig.defconfig.em11d"


endif # SOC_ARC_EMSDP
```

## soc/arc/snps_emsdp/Kconfig.defconfig.em11d
```kconfig
#
# Copyright (c) 2019 Synopsys, Inc. All rights reserved.
#
# SPDX-License-Identifier: Apache-2.0
#

if SOC_EMSDP_EM11D

config SYS_CLOCK_HW_CYCLES_PER_SEC
	default 40000000

config CPU_EM4_FPUDA
	default y

config ARC_MPU_VER
	default 2

config RGF_NUM_BANKS
	default 2

config HARVARD
	default y

config ARC_FIRQ
	default y

config CACHE_FLUSHING
	default y

config FP_FPU_DA
	default y

config MAIN_STACK_SIZE
	default 2048

config IDLE_STACK_SIZE
	default 2048

if ZTEST

config ZTEST_STACKSIZE
	default 2048

endif # ZTEST

endif #SOC_EMSDP_EM11D
```

## soc/arc/snps_emsdp/Kconfig.defconfig.em5d
```kconfig
# Copyright (c) 2019 Synopsys, Inc. All rights reserved.
# SPDX-License-Identifier: Apache-2.0

if SOC_EMSDP_EM5D

config SYS_CLOCK_HW_CYCLES_PER_SEC
	default 40000000

config CPU_EM4_FPUDA
	default y

config ARC_MPU_VER
	default 2

config RGF_NUM_BANKS
	default 2

config HARVARD
	default y

config ARC_FIRQ
	default y

config CACHE_FLUSHING
	default n

config FP_FPU_DA
	default y

config MAIN_STACK_SIZE
	default 2048

config IDLE_STACK_SIZE
	default 2048

config ZTEST_STACKSIZE
	default 2048
	depends on ZTEST

config NUM_IRQS
	default 111

endif # SOC_EMSDP_EM5D
```

## soc/arc/snps_emsdp/Kconfig.defconfig.em6
```kconfig
# Copyright (c) 2019 Synopsys, Inc. All rights reserved.
# SPDX-License-Identifier: Apache-2.0

if SOC_EMSDP_EM6

config SYS_CLOCK_HW_CYCLES_PER_SEC
	default 50000000

config CPU_EM6
	default y

config ARC_MPU_VER
	default 2

config RGF_NUM_BANKS
	default 2

config HARVARD
	default y

config ARC_FIRQ
	default y

config CACHE_MANAGEMENT
	default y

config FP_FPU_DA
	default n

config MAIN_STACK_SIZE
	default 2048

config IDLE_STACK_SIZE
	default 2048

config ZTEST_STACKSIZE
	default 2048
	depends on ZTEST

config NUM_IRQS
	default 113

endif # SOC_EMSDP_EM6
```

## soc/arc/snps_emsdp/Kconfig.defconfig.em7d
```kconfig
#
# Copyright (c) 2019 Synopsys, Inc. All rights reserved.
#
# SPDX-License-Identifier: Apache-2.0
#

if SOC_EMSDP_EM7D

config CPU_EM4_FPUDA
	def_bool y

config ARC_MPU_VER
	default 2

config RGF_NUM_BANKS
	default 2

config HARVARD
	default y

config ARC_FIRQ
	default y

config CACHE_FLUSHING
	default y

config FP_FPU_DA
	def_bool y

if (ARC_MPU_VER = 2)

config MAIN_STACK_SIZE
	default 2048

config IDLE_STACK_SIZE
	default 2048

if ZTEST

config ZTEST_STACKSIZE
	default 2048

endif # ZTEST

endif # ARC_MPU_VER

endif #SOC_EMSDP_EM7D
```

## soc/arc/snps_emsdp/Kconfig.defconfig.em7d_esp
```kconfig
# Copyright (c) 2019 Synopsys, Inc. All rights reserved.
# SPDX-License-Identifier: Apache-2.0

if SOC_EMSDP_EM7D_ESP

config SYS_CLOCK_HW_CYCLES_PER_SEC
	default 50000000

config CPU_EM4_FPUDA
	default y

config ARC_MPU_VER
	default 3

config RGF_NUM_BANKS
	default 1

config HARVARD
	default y

config ARC_FIRQ
	default n

config CACHE_MANAGEMENT
	default y

config FP_FPU_DA
	default y

config NUM_IRQS
	default 112

endif # SOC_EMSDP_EM7D_ESP
```

## soc/arc/snps_emsdp/Kconfig.soc
```kconfig
#
# Copyright (c) 2019 Synopsys, Inc. All rights reserved.
#
# SPDX-License-Identifier: Apache-2.0
#

config SOC_ARC_EMSDP
	bool "Synopsys ARC EM Software Development Platform"
```

## soc/arc/snps_emsk/Kconfig
```kconfig
# Copyright (c) 2014 Wind River Systems, Inc.
# Copyright (c) 2018 Synopsys, Inc. All rights reserved.
# SPDX-License-Identifier: Apache-2.0

config SOC_EMSK_EM7D
	bool
	select CPU_HAS_MPU
	help
	  Synopsys ARC EM7D of EMSK

config SOC_EMSK_EM11D
	bool
	select CPU_HAS_FPU
	help
	  Synopsys ARC EM11D of EMSK

config SOC_EMSK_EM9D
	bool
	select CPU_HAS_FPU
	help
	  Synopsys ARC EM9D of EMSK
```

## soc/arc/snps_emsk/Kconfig.defconfig
```kconfig
#
# Copyright (c) 2014 Wind River Systems, Inc.
# Copyright (c) 2018 Synopsys, Inc. All rights reserved.
#
# SPDX-License-Identifier: Apache-2.0
#

if SOC_EMSK

config SOC
	string
	default "snps_emsk"

source "soc/arc/snps_emsk/Kconfig.defconfig.em7d"
source "soc/arc/snps_emsk/Kconfig.defconfig.em11d"
source "soc/arc/snps_emsk/Kconfig.defconfig.em9d"

endif #SOC_EMSK
```

## soc/arc/snps_emsk/Kconfig.defconfig.em11d
```kconfig
# Copyright (c) 2014 Wind River Systems, Inc.
# Copyright (c) 2018 Synopsys, Inc. All rights reserved.
# SPDX-License-Identifier: Apache-2.0

if SOC_EMSK_EM11D

config CPU_EM4_FPUDA
	default y

config NUM_IRQ_PRIO_LEVELS
	# This processor supports 4 priority levels:
	# 0 for Fast Interrupts (FIRQs) and 1-3 for Regular Interrupts (IRQs).
	default 4

config NUM_IRQS
	# must be > the highest interrupt number used
	default 38 if BOARD_EM_STARTERKIT_R23
	default 36 if BOARD_EM_STARTERKIT_R22

config RGF_NUM_BANKS
	default 2

config SYS_CLOCK_HW_CYCLES_PER_SEC
	default 20000000

config HARVARD
	default n

config CACHE_MANAGEMENT
	default y

config FP_FPU_DA
	default y

endif # SOC_EMSK_EM11D
```

## soc/arc/snps_emsk/Kconfig.defconfig.em7d
```kconfig
#
# Copyright (c) 2014 Wind River Systems, Inc.
# Copyright (c) 2018 Synopsys, Inc. All rights reserved.
#
# SPDX-License-Identifier: Apache-2.0
#

if SOC_EMSK_EM7D

config CPU_EM4_DMIPS
	default y

config NUM_IRQ_PRIO_LEVELS
	# This processor supports 4 priority levels:
	# 0 for Fast Interrupts (FIRQs) and 1-3 for Regular Interrupts (IRQs).
	default 4

config NUM_IRQS
	# must be > the highest interrupt number used
	default 38 if BOARD_EM_STARTERKIT_R23
	default 36 if BOARD_EM_STARTERKIT_R22

config ARC_MPU_VER
	default 3 if BOARD_EM_STARTERKIT_R23
	default 2 if BOARD_EM_STARTERKIT_R22

config RGF_NUM_BANKS
	default 1

config SYS_CLOCK_HW_CYCLES_PER_SEC
	default 25000000 if BOARD_EM_STARTERKIT_R23
	default 30000000 if BOARD_EM_STARTERKIT_R22

config HARVARD
	default y

config ARC_FIRQ
	default n if BOARD_EM_STARTERKIT_R23
	default y if BOARD_EM_STARTERKIT_R22

config CACHE_FLUSHING
	default y

if (ARC_MPU_VER = 2)

config MAIN_STACK_SIZE
	default 2048

config IDLE_STACK_SIZE
	default 2048

if ZTEST

config ZTEST_STACKSIZE
	default 2048

endif # ZTEST

endif # ARC_MPU_VER

endif #SOC_EMSK_EM7D
```

## soc/arc/snps_emsk/Kconfig.soc
```kconfig
# Copyright (c) 2014 Wind River Systems, Inc.
# Copyright (c) 2018 Synopsys, Inc. All rights reserved.
# SPDX-License-Identifier: Apache-2.0

config SOC_EMSK
	bool "Synopsys ARC EM Starter Kit SoC"
	select ARC
```
