## soc/arc/snps_nsim/Kconfig
```kconfig
# Copyright (c) 2018 Synopsys, Inc. All rights reserved.
# SPDX-License-Identifier: Apache-2.0

choice
	prompt "ARC nSIM SoC Selection"
	default SOC_NSIM_EM
	depends on SOC_NSIM

config SOC_NSIM_EM
	bool "Synopsys ARC EM in nSIM"
	select CPU_HAS_MPU

config SOC_NSIM_EM7D_V22
	bool "Synopsys ARC EM7D_V22 in nSIM"
	select CPU_HAS_MPU
	select CPU_HAS_FPU

config SOC_NSIM_EM11D
	bool "Synopsys ARC EM11D in nSIM"
	select CPU_HAS_MPU
	select ARC_HAS_DSP

config SOC_NSIM_SEM
	bool "Synopsys ARC SEM in nSIM"
	select CPU_HAS_MPU
	select CPU_HAS_FPU
	select ARC_HAS_SECURE

config SOC_NSIM_HS
	bool "Synopsys ARC HS in nSIM"
	select CPU_HAS_FPU
	select CPU_HAS_MPU

config SOC_NSIM_HS_SMP
	bool "Multi-core Synopsys ARC HS in nSIM"
	select CPU_HAS_FPU

config SOC_NSIM_HS_MPUV6
	bool "Synopsys ARC HS with MPU v6 in nSIM"
	select CPU_HAS_MPU
	select CPU_HAS_FPU

config SOC_NSIM_VPX5
	bool "Synopsys ARC VPX5 in nSIM"

config SOC_NSIM_HS6X
	bool "Synopsys ARC HS6x in nSIM"

config SOC_NSIM_HS6X_SMP
	bool "Multi-core Synopsys ARC HS6x in nSIM"

config SOC_NSIM_HS5X
	bool "Synopsys ARC HS5x in nSIM"

config SOC_NSIM_HS5X_SMP
	bool "Multi-core Synopsys ARC HS5x in nSIM"

endchoice
```

## soc/arc/snps_nsim/Kconfig.defconfig
```kconfig
# Copyright (c) 2018 Synopsys, Inc. All rights reserved.
# SPDX-License-Identifier: Apache-2.0

if SOC_NSIM

config SOC
	default "snps_nsim"

config XIP
	default n

source "soc/arc/snps_nsim/Kconfig.defconfig.em"
source "soc/arc/snps_nsim/Kconfig.defconfig.em11d"
source "soc/arc/snps_nsim/Kconfig.defconfig.em7d_v22"
source "soc/arc/snps_nsim/Kconfig.defconfig.sem"
source "soc/arc/snps_nsim/Kconfig.defconfig.hs"
source "soc/arc/snps_nsim/Kconfig.defconfig.hs_smp"
source "soc/arc/snps_nsim/Kconfig.defconfig.hs6x"
source "soc/arc/snps_nsim/Kconfig.defconfig.hs6x_smp"
source "soc/arc/snps_nsim/Kconfig.defconfig.hs_mpuv6"
source "soc/arc/snps_nsim/Kconfig.defconfig.hs5x"
source "soc/arc/snps_nsim/Kconfig.defconfig.hs5x_smp"

endif # SOC_NSIM
```
