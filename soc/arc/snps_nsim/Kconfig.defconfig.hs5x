## soc/arc/snps_nsim/Kconfig.defconfig.hs5x
```kconfig
# Copyright (c) 2022 Synopsys, Inc.
# SPDX-License-Identifier: Apache-2.0

if SOC_NSIM_HS5X

config CPU_HS5X
	default y

config NUM_IRQ_PRIO_LEVELS
	# This processor supports 16 priority levels:
	default 2

config NUM_IRQS
	# must be > the highest interrupt number used
	default 30

config SYS_CLOCK_HW_CYCLES_PER_SEC
	default 5000000

config CACHE_MANAGEMENT
	default y

config ARC_HAS_ACCL_REGS
	default y

endif # SOC_NSIM_HS5X
```

## soc/arc/snps_nsim/Kconfig.defconfig.hs_smp
```kconfig
# Copyright (c) 2019 Synopsys, Inc. All rights reserved.
# SPDX-License-Identifier: Apache-2.0

if SOC_NSIM_HS_SMP

config CPU_HS3X
	default y

config NUM_IRQ_PRIO_LEVELS
	# This processor supports 16 priority levels:
	# 0 for Fast Interrupts (FIRQs) and 1-15 for Regular Interrupts (IRQs).
	default 2

config NUM_IRQS
	# must be > the highest interrupt number used
	default 88

config RGF_NUM_BANKS
	default 2

config SYS_CLOCK_HW_CYCLES_PER_SEC
        # SMP simulation is slower than single core, 1 Mhz seems reasonable match with wallclock
	default 1000000

config ARC_FIRQ
	default y

config CACHE_MANAGEMENT
	default y

config ARC_CONNECT
	default y

config MP_NUM_CPUS
	default 2

endif # SOC_NSIM_HS_SMP
```

## soc/arc/snps_nsim/Kconfig.defconfig.sem
```kconfig
#
# Copyright (c) 2018 Synopsys, Inc. All rights reserved.
#
# SPDX-License-Identifier: Apache-2.0
#

if SOC_NSIM_SEM

config CPU_EM4_DMIPS
	def_bool y

config NUM_IRQ_PRIO_LEVELS
	# This processor supports 4 priority levels:
	# 0 for Fast Interrupts (FIRQs) and 1-3 for Regular Interrupts (IRQs).
	default 4

config NUM_IRQS
	# must be > the highest interrupt number used
	default 22

config ARC_MPU_VER
	default 3

config RGF_NUM_BANKS
	default 1

config SYS_CLOCK_HW_CYCLES_PER_SEC
	default 10000000

config HARVARD
	def_bool y

config ARC_FIRQ
	def_bool n

config CACHE_FLUSHING
	def_bool y

endif #SOC_NSIM_SEM
```

## soc/arc/snps_nsim/Kconfig.soc
```kconfig
#
# Copyright (c) 2018 Synopsys, Inc. All rights reserved.
#
# SPDX-License-Identifier: Apache-2.0
#

config SOC_NSIM
	bool "Synopsys nSIM simulator for ARC cores"
```

## soc/arc/snps_qemu/Kconfig
```kconfig
# Copyright (c) 2020 Synopsys, Inc. All rights reserved.
# SPDX-License-Identifier: Apache-2.0

config SOC_QEMU_ARC_EM
	bool
	help
	  Synopsys ARC EM in QEMU

config SOC_QEMU_ARC_HS
	bool
	help
	  Synopsys ARC HS in QEMU

config SOC_QEMU_ARC_HS6X
	bool
	help
	  Synopsys ARC HS6x in QEMU

config SOC_QEMU_ARC_HS5X
	bool
	help
	  Synopsys ARC HS5x in QEMU
```

## soc/arc/snps_qemu/Kconfig.defconfig
```kconfig
# Copyright (c) 2020 Synopsys, Inc. All rights reserved.
# SPDX-License-Identifier: Apache-2.0

if SOC_QEMU_ARC

config SOC
	string
	default "snps_qemu"

config SYS_CLOCK_HW_CYCLES_PER_SEC
	int
	default 10000000

config UART_CONSOLE_ON_DEV_NAME
	string
	default "UART_0"

config RGF_NUM_BANKS
	default 1

config ARC_FIRQ
	default n

config NUM_IRQ_PRIO_LEVELS
	default 15

config NUM_IRQS
	default 25

# Technically ARC HS supports MPUv3, but not v2. But given MPUv3
# is the same as v2 but with minimal region size of 32 bytes, we
# may assume MPUv3 is just a subset of MPUv2.

config ARC_MPU_VER
	default 2

source "soc/arc/snps_qemu/Kconfig.defconfig.em"
source "soc/arc/snps_qemu/Kconfig.defconfig.hs"
source "soc/arc/snps_qemu/Kconfig.defconfig.hs6x"

endif
```

## soc/arc/snps_qemu/Kconfig.defconfig.hs
```kconfig
# Copyright (c) 2021 Synopsys, Inc. All rights reserved.
# SPDX-License-Identifier: Apache-2.0

if SOC_QEMU_ARC_HS

config CPU_HS3X
	default y

endif
```

## soc/arc/snps_qemu/Kconfig.defconfig.hs5x
```kconfig
# Copyright (c) 2022 Synopsys, Inc. All rights reserved.
# SPDX-License-Identifier: Apache-2.0

if SOC_QEMU_ARC_HS5X

config CPU_HS5X
	default y

endif
```

## soc/arc/snps_qemu/Kconfig.defconfig.hs6x
```kconfig
# Copyright (c) 2021 Synopsys, Inc. All rights reserved.
# SPDX-License-Identifier: Apache-2.0

if SOC_QEMU_ARC_HS6X

config CPU_HS6X
	default y

endif
```

## soc/arc/snps_qemu/Kconfig.soc
```kconfig
# Copyright (c) 2020 Synopsys, Inc. All rights reserved.
# SPDX-License-Identifier: Apache-2.0

config SOC_QEMU_ARC
	bool "QEMU emulation of ARC cores"
	select ARC
```

## soc/arm/Kconfig
```kconfig
# Copyright (c) 2024 Nordic Semiconductor ASA
# SPDX-License-Identifier: Apache-2.0

if SOC_FAMILY_ARM || SOC_FAMILY_ARM64

rsource "*/Kconfig"

endif # SOC_FAMILY_ARM || SOC_FAMILY_ARM64
```

## soc/arm/actions/Kconfig
```kconfig
# Copyright (c) 2019, Manivannan Sadhasivam <mani@kernel.org>
# SPDX-License-Identifier: Apache-2.0

config SOC_FAMILY_ACTIONS
	bool
	select BUILD_OUTPUT_HEX

if SOC_FAMILY_ACTIONS

config SOC_FAMILY
	string
	default "actions"

source "soc/arm/actions/*/Kconfig.soc"

endif # SOC_FAMILY_ACTIONS
```

## soc/arm/actions/Kconfig.defconfig
```kconfig
# Copyright (c) 2019, Manivannan Sadhasivam <mani@kernel.org>
# SPDX-License-Identifier: Apache-2.0

source "soc/arm/actions/*/Kconfig.defconfig.series"
```

## soc/arm/actions/atb110x/Kconfig.defconfig.atb1103
```kconfig
# ATB1103 SoC defconfig

# Copyright (c) 2019, Manivannan Sadhasivam <mani@kernel.org>
# SPDX-License-Identifier: Apache-2.0

if SOC_ATB1103

config SOC
	default "atb1103"

config SYS_CLOCK_HW_CYCLES_PER_SEC
	default 32000000

endif # SOC_ATB1103
```

## soc/arm/actions/atb110x/Kconfig.defconfig.series
```kconfig
# ATB110X series

# Copyright (c) 2019, Manivannan Sadhasivam <mani@kernel.org>
# SPDX-License-Identifier: Apache-2.0

if SOC_SERIES_ATB110X

config SOC_SERIES
	default "atb110x"

config NUM_IRQS
	# must be >= the highest interrupt number used
	default 32

config ISR_STACK_SIZE
	default 640

source "soc/arm/actions/atb110x/Kconfig.defconfig.atb1103"

endif # SOC_SERIES_ATB110X
```

## soc/arm/actions/atb110x/Kconfig.series
```kconfig
# ATB110X series

# Copyright (c) 2019, Manivannan Sadhasivam <mani@kernel.org>
# SPDX-License-Identifier: Apache-2.0

config SOC_SERIES_ATB110X
	bool "ATB110X Series"
	select ARM
	select CPU_CORTEX_M0
	select CPU_CORTEX_M_HAS_SYSTICK
	select SOC_FAMILY_ACTIONS
	select XIP
	help
	  Enable support for ATB110X MCU series
```

## soc/arm/actions/atb110x/Kconfig.soc
```kconfig
# ATB110x core series

# Copyright (c) 2019, Manivannan Sadhasivam <mani@kernel.org>
# SPDX-License-Identifier: Apache-2.0

choice
	prompt "ATB110x Selection"
	depends on SOC_SERIES_ATB110X

config SOC_ATB1103
	bool "SOC_ATB1103"

endchoice

config ATB110X_BOOT_HEADER
	bool "Enable the boot header for Actions Semi ATB110X MCUs"
	default y
	help
	  Enable data structures required by the boot ROM to boot the
	  application from integrated flash memory.
```

## soc/arm/adi/Kconfig
```kconfig
# Analog Devices MAX32 MCU series

# Copyright (c) 2023 Analog Devices, Inc.
# SPDX-License-Identifier: Apache-2.0

config SOC_FAMILY_ADI
	bool "Select ADI family"

if SOC_FAMILY_ADI

config SOC_FAMILY
	string
	default "adi"

source "soc/arm/adi/*/Kconfig.soc"

endif # SOC_FAMILY_ADI
```

## soc/arm/adi/Kconfig.defconfig
```kconfig
# SPDX-License-Identifier: Apache-2.0

source "soc/arm/adi/*/Kconfig.defconfig.series"
```

## soc/arm/adi/Kconfig.soc
```kconfig
# Analog Devices MAX32 MCU series

# Copyright (c) 2023 Analog Devices, Inc.
# SPDX-License-Identifier: Apache-2.0

source "soc/arm/adi/*/Kconfig.series"
```

## soc/arm/adi/max32/Kconfig.defconfig.max32665
```kconfig
# Analog Devices MAX32665 MCU

# Copyright (c) 2023 Analog Devices, Inc.
# SPDX-License-Identifier: Apache-2.0

if SOC_MAX32665

config SOC
	default "max32665"

config NUM_IRQS
	default 110

endif # SOC_MAX32665
```

## soc/arm/adi/max32/Kconfig.defconfig.max32666
```kconfig
# Analog Devices MAX32665 MCU

# Copyright (c) 2023 Analog Devices, Inc.
# SPDX-License-Identifier: Apache-2.0

if SOC_MAX32666

config SOC
	default "max32666"

config NUM_IRQS
	default 110

config SERIAL_SUPPORT_INTERRUPT
	bool
	default n

endif # SOC_MAX32666
```

## soc/arm/adi/max32/Kconfig.defconfig.series
```kconfig
# Analog Devices MAX32 MCU series

# Copyright (c) 2023 Analog Devices, Inc.
# SPDX-License-Identifier: Apache-2.0

if SOC_SERIES_MAX32

source "soc/arm/adi/max32/Kconfig.defconfig.max32*"

config SOC_SERIES
	default "max32"

config SRAM_VECTOR_TABLE
	default y

endif # SOC_SERIES_MAX32
```

## soc/arm/adi/max32/Kconfig.series
```kconfig
# Analog Devices MAX32 MCU series

# Copyright (c) 2023 Analog Devices, Inc.
# SPDX-License-Identifier: Apache-2.0

config SOC_SERIES_MAX32
	bool "MAX32XXX Series MCU"
	select ARM
	select CPU_CORTEX_M4
	select CPU_CORTEX_M4_HAS_VECTOR_TABLE_REMAP
	select SOC_FAMILY_MAX32
	select CPU_CORTEX_M_HAS_SYSTICK
	select SOC_FAMILY_ADI
	help
	  Enable support for MAX32 MCU series
```

## soc/arm/adi/max32/Kconfig.soc
```kconfig
# Analog Devices MAX32 MCU series

# Copyright (c) 2023 Analog Devices, Inc.
# SPDX-License-Identifier: Apache-2.0

choice
	prompt "MAX32XXX MCU Selection"
	depends on SOC_SERIES_MAX32

config SOC_MAX32665
	bool "MAX32665"

config SOC_MAX32666
	bool "MAX32666"

endchoice
```
