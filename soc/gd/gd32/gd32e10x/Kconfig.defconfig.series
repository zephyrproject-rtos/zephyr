## soc/gd/gd32/gd32e10x/Kconfig.defconfig.series
```kconfig
# Copyright (c) 2021 YuLong Yao <feilongphone@gmail.com>
# SPDX-License-Identifier: Apache-2.0

if SOC_SERIES_GD32E10X

rsource "Kconfig.defconfig.gd32*"

endif # SOC_SERIES_GD32E10X
```

## soc/gd/gd32/gd32e10x/Kconfig.soc
```kconfig
# Copyright (c) 2021 YuLong Yao <feilongphone@gmail.com>
# SPDX-License-Identifier: Apache-2.0

config SOC_SERIES_GD32E10X
	bool
	select SOC_FAMILY_GD_GD32
	help
	  Enable support for GigaDevice GD32E10X MCU series

config SOC_SERIES
	default "gd32e10x" if SOC_SERIES_GD32E10X

config SOC_GD32E103
	bool
	select SOC_SERIES_GD32E10X

config SOC
	default "gd32e103" if SOC_GD32E103
```

## soc/gd/gd32/gd32e50x/Kconfig
```kconfig
# Copyright (c) 2022, Teslabs Engineering S.L.
# SPDX-License-Identifier: Apache-2.0

config SOC_SERIES_GD32E50X
	select ARM
	select CPU_HAS_ARM_MPU
	select CPU_HAS_FPU
	select CPU_CORTEX_M33
	select ARMV8_M_DSP
	select GD32_HAS_AFIO_PINMUX
	select GD32_HAS_IRC_40K
	select SOC_EARLY_INIT_HOOK
```

## soc/gd/gd32/gd32e50x/Kconfig.defconfig.gd32e507
```kconfig
# Copyright (c) 2022 Teslabs Engineering S.L.
# SPDX-License-Identifier: Apache-2.0

if SOC_GD32E507

config SYS_CLOCK_HW_CYCLES_PER_SEC
	default $(dt_node_int_prop_int,/cpus/cpu@0,clock-frequency)

config NUM_IRQS
	default 88

endif # SOC_GD32E507
```

## soc/gd/gd32/gd32e50x/Kconfig.defconfig.series
```kconfig
# Copyright (c) 2022, Teslabs Engineering S.L.
# SPDX-License-Identifier: Apache-2.0

if SOC_SERIES_GD32E50X

rsource "Kconfig.defconfig.gd32*"

endif # SOC_SERIES_GD32E50X
```

## soc/gd/gd32/gd32e50x/Kconfig.soc
```kconfig
# Copyright (c) 2022, Teslabs Engineering S.L.
# SPDX-License-Identifier: Apache-2.0

config SOC_SERIES_GD32E50X
	bool
	select SOC_FAMILY_GD_GD32
	help
	  Enable support for GigaDevice GD32E50X MCU series

config SOC_SERIES
	default "gd32e50x" if SOC_SERIES_GD32E50X

config SOC_GD32E507
	bool
	select SOC_SERIES_GD32E50X

config SOC
	default "gd32e507" if SOC_GD32E507
```

## soc/gd/gd32/gd32f3x0/Kconfig
```kconfig
# Copyright (c) 2021 BrainCo Inc.
# SPDX-License-Identifier: Apache-2.0

config SOC_SERIES_GD32F3X0
	select ARM
	select CPU_HAS_FPU
	select CPU_CORTEX_M4
	select GD32_HAS_AF_PINMUX
	select GD32_HAS_IRC_40K
```

## soc/gd/gd32/gd32f3x0/Kconfig.defconfig.series
```kconfig
# Copyright (c) 2021 BrainCo Inc.
# SPDX-License-Identifier: Apache-2.0

if SOC_SERIES_GD32F3X0

rsource "Kconfig.defconfig.gd32*"

endif # SOC_SERIES_GD32F3X0
```

## soc/gd/gd32/gd32f3x0/Kconfig.soc
```kconfig
# Copyright (c) 2021 BrainCo Inc.
# SPDX-License-Identifier: Apache-2.0

config SOC_SERIES_GD32F3X0
	bool
	select SOC_FAMILY_GD_GD32
	help
	  Enable support for GigaDevice GD32F3X0 MCU series

config SOC_SERIES
	default "gd32f3x0" if SOC_SERIES_GD32F3X0

config SOC_GD32F350
	bool
	select SOC_SERIES_GD32F3X0

config SOC
	default "gd32f350" if SOC_GD32F350
```

## soc/gd/gd32/gd32f403/Kconfig
```kconfig
# Copyright (c) 2021, ATL Electronics
# SPDX-License-Identifier: Apache-2.0

config SOC_SERIES_GD32F403
	select ARM
	select CPU_HAS_ARM_MPU
	select CPU_HAS_FPU
	select CPU_CORTEX_M4
	select CPU_CORTEX_M_HAS_SYSTICK
	select CPU_CORTEX_M_HAS_VTOR
	select GD32_HAS_AFIO_PINMUX
	select GD32_HAS_IRC_40K
```

## soc/gd/gd32/gd32f403/Kconfig.soc
```kconfig
# Copyright (c) 2021, ATL Electronics
# SPDX-License-Identifier: Apache-2.0

config SOC_SERIES_GD32F403
	bool
	select SOC_FAMILY_GD_GD32
	help
	  Enable support for GigaDevice GD32F403 MCU series

config SOC_SERIES
	default "gd32f403" if SOC_SERIES_GD32F403

config SOC_GD32F403
	bool
	select SOC_SERIES_GD32F403

config SOC
	default "gd32f403" if SOC_GD32F403
```

## soc/gd/gd32/gd32f4xx/Kconfig
```kconfig
# Copyright (c) 2021, Teslabs Engineering S.L.
# SPDX-License-Identifier: Apache-2.0

config SOC_SERIES_GD32F4XX
	select ARM
	select CPU_HAS_ARM_MPU
	select CPU_HAS_FPU
	select CPU_CORTEX_M4
	select GD32_HAS_AF_PINMUX
	select GD32_HAS_IRC_32K
	select SOC_EARLY_INIT_HOOK
```

## soc/gd/gd32/gd32f4xx/Kconfig.defconfig.gd32f407
```kconfig
# Copyright (c) 2022 TOKITA Hiroshi <tokita.hiroshi@gmail.com>
# SPDX-License-Identifier: Apache-2.0

if SOC_GD32F407

config SYS_CLOCK_HW_CYCLES_PER_SEC
	default $(dt_node_int_prop_int,/cpus/cpu@0,clock-frequency)

config NUM_IRQS
	default 91

endif # SOC_GD32F407
```

## soc/gd/gd32/gd32f4xx/Kconfig.defconfig.series
```kconfig
# Copyright (c) 2021, Teslabs Engineering S.L.
# SPDX-License-Identifier: Apache-2.0

if SOC_SERIES_GD32F4XX

rsource "Kconfig.defconfig.gd32*"

endif # SOC_SERIES_GD32F4XX
```

## soc/gd/gd32/gd32f4xx/Kconfig.soc
```kconfig
# Copyright (c) 2021, Teslabs Engineering S.L.
# Copyright (c) 2022, Rtone.
# SPDX-License-Identifier: Apache-2.0

config SOC_SERIES_GD32F4XX
	bool
	select SOC_FAMILY_GD_GD32
	help
	  Enable support for GigaDevice GD32F4XX MCU series

config SOC_SERIES
	default "gd32f4xx" if SOC_SERIES_GD32F4XX

config SOC_GD32F405
	bool
	select SOC_SERIES_GD32F4XX

config SOC_GD32F407
	bool
	select SOC_SERIES_GD32F4XX

config SOC_GD32F450
	bool
	select SOC_SERIES_GD32F4XX

config SOC_GD32F470
	bool
	select SOC_SERIES_GD32F4XX

config SOC
	default "gd32f405" if SOC_GD32F405
	default "gd32f407" if SOC_GD32F407
	default "gd32f450" if SOC_GD32F450
	default "gd32f470" if SOC_GD32F470
```

## soc/gd/gd32/gd32l23x/Kconfig
```kconfig
# Copyright (c) 2022 BrainCo Inc.
# SPDX-License-Identifier: Apache-2.0

config SOC_SERIES_GD32L23X
	select ARM
	select CPU_CORTEX_M23
	select CPU_CORTEX_M_HAS_SYSTICK
	select CPU_CORTEX_M_HAS_VTOR
	select GD32_HAS_AF_PINMUX
	select GD32_HAS_IRC_32K
```

## soc/gd/gd32/gd32l23x/Kconfig.defconfig.series
```kconfig
# Copyright (c) 2022 BrainCo Inc.
# SPDX-License-Identifier: Apache-2.0

if SOC_SERIES_GD32L23X

rsource "Kconfig.defconfig.gd32*"

endif # SOC_SERIES_GD32L23X
```

## soc/gd/gd32/gd32l23x/Kconfig.soc
```kconfig
# Copyright (c) 2022 BrainCo Inc.
# SPDX-License-Identifier: Apache-2.0

config SOC_SERIES_GD32L23X
	bool
	select SOC_FAMILY_GD_GD32
	help
	  Enable support for GigaDevice GD32L23X MCU series

config SOC_SERIES
	default "gd32l23x" if SOC_SERIES_GD32L23X

config SOC_GD32L233
	bool
	select SOC_SERIES_GD32L23X

config SOC
	default "gd32l233" if SOC_GD32L233
```

## soc/gd/gd32/gd32vf103/Kconfig
```kconfig
# GD32VF103 SOC implementation

# Copyright (c) 2021 Tokita, Hiroshi <tokita.hiroshi@gmail.com>
# SPDX-License-Identifier: Apache-2.0

config SOC_SERIES_GD32VF103
	select RISCV
	select RISCV_PRIVILEGED
	select RISCV_ISA_RV32I
	select RISCV_ISA_EXT_M
	select RISCV_ISA_EXT_A
	select RISCV_ISA_EXT_C
	select RISCV_ISA_EXT_ZICSR
	select RISCV_ISA_EXT_ZIFENCEI
	select RISCV_HAS_CLIC
	select ATOMIC_OPERATIONS_C
	select INCLUDE_RESET_VECTOR
	select GD32_HAS_AFIO_PINMUX
	select GD32_HAS_IRC_40K
	select XIP
```

## soc/gd/gd32/gd32vf103/Kconfig.defconfig.series
```kconfig
# Copyright (c) 2021 Tokita, Hiroshi <tokita.hiroshi@gmail.com>
# SPDX-License-Identifier: Apache-2.0

if SOC_SERIES_GD32VF103

rsource "Kconfig.defconfig.gd32*"

endif # SOC_SERIES_GD32VF103
```

## soc/gd_gd32/gd32f403/Kconfig.defconfig.series
```kconfig
# Copyright (c) 2021, ATL Electronics
# SPDX-License-Identifier: Apache-2.0

if SOC_SERIES_GD32F403

rsource "Kconfig.defconfig.gd32*"

endif # SOC_SERIES_GD32F403
```

## soc/gd_gd32/gd32l23x/Kconfig.defconfig.series
```kconfig
# Copyright (c) 2022 BrainCo Inc.
# SPDX-License-Identifier: Apache-2.0

if SOC_SERIES_GD32L23X

config SOC_SERIES
	default "gd32l23x"

rsource "Kconfig.defconfig.gd32*"

endif # SOC_SERIES_GD32L23X
```

## soc/gd_gd32/gd32vf103/Kconfig.soc
```kconfig
# GD32VF103 SOC configuration options

# Copyright (c) 2021 Tokita, Hiroshi <tokita.hiroshi@gmail.com>
# SPDX-License-Identifier: Apache-2.0

config SOC_SERIES_GD32VF103
	bool
	select SOC_FAMILY_GD_GD32
	help
	  Enable support for GigaDevice GD32VF103 MCU series

config SOC_SERIES
	default "gd32vf103" if SOC_SERIES_GD32VF103

config SOC_GD32VF103
	bool
	select SOC_SERIES_GD32VF103

config SOC
	default "gd32vf103" if SOC_GD32VF103
```

## soc/ia32/Kconfig.defconfig
```kconfig
# Generic PC platform configuration options

# Copyright (c) 2014-2015 Wind River Systems, Inc.
# Copyright (c) 2024 Intel Corporation
#
# SPDX-License-Identifier: Apache-2.0

if SOC_IA32

config SYS_CLOCK_HW_CYCLES_PER_SEC
	default 25000000  if HPET_TIMER

endif
```

## soc/ia32/Kconfig.soc
```kconfig
# Copyright (c) 2024 Intel Corporation
#
# SPDX-License-Identifier: Apache-2.0

config SOC_IA32
	bool

config SOC
	default "ia32" if SOC_IA32
```
