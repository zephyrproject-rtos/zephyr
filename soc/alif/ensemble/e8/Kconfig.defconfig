## soc/alif/ensemble/e8/Kconfig.defconfig
```kconfig
# Copyright (c) 2025 Alif Semiconductor
# SPDX-License-Identifier: Apache-2.0

if SOC_SERIES_E8

rsource "Kconfig.defconfig.*"

endif # SOC_SERIES_E8
```

## soc/alif/ensemble/e8/Kconfig.defconfig.ae822fa0e5597ls0_apss
```kconfig
# SPDX-FileCopyrightText: Copyright Alif Semiconductor
# SPDX-License-Identifier: Apache-2.0

if SOC_AE822FA0E5597LS0_APSS

config NUM_IRQS
	# INTIDs 0-31 are SGIs and PPIs; in Ensemble, SPIs
	# occupy INTIDs 32-500 (inclusive).
	default 501

config SYS_CLOCK_HW_CYCLES_PER_SEC
	default $(dt_node_int_prop_int,/timer,clock-frequency)

endif # SOC_AE822FA0E5597LS0_APSS
```

## soc/alif/ensemble/e8/Kconfig.defconfig.ae822fa0e5597ls0_rtss_he
```kconfig
# Copyright (c) 2025 Alif Semiconductor
# SPDX-License-Identifier: Apache-2.0

if SOC_AE822FA0E5597LS0_RTSS_HE

config NUM_IRQS
	default 480

config SYS_CLOCK_HW_CYCLES_PER_SEC
	default $(dt_node_int_prop_int,/cpus/cpu@0,clock-frequency)

endif # SOC_AE822FA0E5597LS0_RTSS_HE
```

## soc/alif/ensemble/e8/Kconfig.soc
```kconfig
# Copyright (c) 2025 Alif Semiconductor
# SPDX-License-Identifier: Apache-2.0

config SOC_SERIES_E8
	bool
	select SOC_FAMILY_ENSEMBLE

config SOC_SERIES
	default "e8" if SOC_SERIES_E8

config SOC_AE822FA0E5597LS0
	bool
	select SOC_SERIES_E8
	help
	  Alif Ensemble E8 (AE822FA0E5597LS0)

config SOC_AE822FA0E5597LS0_RTSS_HE
	bool
	select SOC_AE822FA0E5597LS0
	help
	  AE822FA0E5597LS0 High Efficiency Real Time Subsystem (RTSS-HE).
	  Cortex-M55 core optimized for power efficiency with a maximum frequency of 160 MHz.

config SOC_AE822FA0E5597LS0_RTSS_HP
	bool
	select SOC_AE822FA0E5597LS0
	help
	  AE822FA0E5597LS0 High Performance Real Time Subsystem (RTSS-HP).
	  Cortex-M55 core optimized for compute performance with a maximum frequency of 400 MHz.

config SOC
	default "ae822fa0e5597ls0" if SOC_AE822FA0E5597LS0
```

## soc/allwinner/sun50i_h618/Kconfig
```kconfig
# Copyright (c) 2026 Khai Do
# SPDX-License-Identifier: Apache-2.0

config SOC_SUN50I_H618
	select ARM64
	select CPU_CORTEX_A53
	select ARM_ARCH_TIMER
	select SYS_CLOCK_EXISTS
```

## soc/allwinner/sun50i_h618/Kconfig.defconfig
```kconfig
# Copyright (c) 2026 Khai Do
# SPDX-License-Identifier: Apache-2.0

if SOC_SUN50I_H618

config NUM_IRQS
	default 160

config SYS_CLOCK_HW_CYCLES_PER_SEC
	default $(dt_node_int_prop_int,/timer,clock-frequency)

config STATIC_INIT_GNU
	default y

configdefault UART_NS16550_DW8250_DW_APB
	default y

configdefault UART_NS16550_ACCESS_WORD_ONLY
	default y

endif
```

## soc/allwinner/sun50i_h618/Kconfig.soc
```kconfig
# Copyright (c) 2026 Khai Do
# SPDX-License-Identifier: Apache-2.0

config SOC_SUN50I_H618
	bool

config SOC
	default "sun50i_h618" if SOC_SUN50I_H618
```

## soc/allwinner/sun8i_h3/Kconfig
```kconfig
# Copyright (c) 2025 Muhammad Waleed Badar
# SPDX-License-Identifier: Apache-2.0

config SOC_SUN8I_H3
	select ARM
	select CPU_CORTEX_A7
	select ARM_ARCH_TIMER
	select SYS_CLOCK_EXISTS
```

## soc/allwinner/sun8i_h3/Kconfig.defconfig
```kconfig
# Copyright (c) 2025 Muhammad Waleed Badar
# SPDX-License-Identifier: Apache-2.0

if SOC_SUN8I_H3

config NUM_IRQS
	default 156

config SYS_CLOCK_HW_CYCLES_PER_SEC
	default $(dt_node_int_prop_int,/cpus/cpu@0,clock-frequency)

if SERIAL

config UART_NS16550
	default y

config UART_NS16550_DW8250_DW_APB
	default y

config UART_NS16550_ACCESS_WORD_ONLY
	default y

endif # SERIAL

endif
```

## soc/allwinner/sun8i_h3/Kconfig.soc
```kconfig
# Copyright (c) 2025 Muhammad Waleed Badar
# SPDX-License-Identifier: Apache-2.0

config SOC_SUN8I_H3
	bool

config SOC
	default "sun8i_h3" if SOC_SUN8I_H3
```

## soc/altr/qemu_nios2/Kconfig
```kconfig
# Copyright (c) 2018 Intel Corporation
# SPDX-License-Identifier: Apache-2.0

config SOC_QEMU_NIOS2
	select NIOS2
	select HAS_MUL_INSTRUCTION
	select HAS_DIV_INSTRUCTION
	select HAS_MULX_INSTRUCTION
```

## soc/altr/qemu_nios2/Kconfig.defconfig
```kconfig
# Copyright (c) 2018 Intel Corporation
# SPDX-License-Identifier: Apache-2.0

if SOC_QEMU_NIOS2

config SYS_CLOCK_HW_CYCLES_PER_SEC
	default 50000000

endif
```

## soc/altr/qemu_nios2/Kconfig.soc
```kconfig
# Copyright (c) 2018 Intel Corporation
# SPDX-License-Identifier: Apache-2.0

config SOC_QEMU_NIOS2
	bool

config SOC
	default "qemu_nios2" if SOC_QEMU_NIOS2
```

## soc/altr/zephyr_nios2f/Kconfig
```kconfig
# Copyright (c) 2016 Intel Corporation
# SPDX-License-Identifier: Apache-2.0

config SOC_ZEPHYR_NIOS2F
	select NIOS2
	select HAS_MUL_INSTRUCTION
	select HAS_DIV_INSTRUCTION
```

## soc/altr/zephyr_nios2f/Kconfig.defconfig
```kconfig
# Copyright (c) 2016 Intel Corporation
# SPDX-License-Identifier: Apache-2.0

if SOC_ZEPHYR_NIOS2F

config SYS_CLOCK_HW_CYCLES_PER_SEC
	default 50000000

config ALTERA_AVALON_SYSID
	def_bool y

config ALTERA_AVALON_QSPI
	def_bool y
	depends on SOC_FLASH_NIOS2_QSPI

config ALTERA_AVALON_I2C
	def_bool y
	depends on I2C_NIOS2

config ALTERA_AVALON_MSGDMA
	def_bool y
	depends on DMA_NIOS2_MSGDMA

endif # SOC_ZEPHYR_NIOS2F
```

## soc/altr/zephyr_nios2f/Kconfig.soc
```kconfig
# Copyright (c) 2016 Intel Corporation
# SPDX-License-Identifier: Apache-2.0

config SOC_ZEPHYR_NIOS2F
	bool

config SOC
	default "zephyr_nios2f" if SOC_ZEPHYR_NIOS2F
```

## soc/ambiq/Kconfig
```kconfig
# SPDX-License-Identifier: Apache-2.0
#
# Copyright (c) 2023 Antmicro <www.antmicro.com>

if SOC_FAMILY_AMBIQ

config SOC_AMBIQ_BT_SUPPORTED
	bool

config PM_DEVICE_RUNTIME_DISABLE_CONSOLE
	bool "Keep console UART active"
	depends on UART_CONSOLE
	depends on PM_DEVICE_RUNTIME
	default y
	help
	  Leave the zephyr_console UART out of runtime power management.
	  Enable this in samples/tests that log from interrupt context while
	  CONFIG_PM_DEVICE_RUNTIME_DEFAULT_ENABLE is set.

config SOC_AMBIQ_HAS_PUF
	bool "Ambiq PUF support"
	help
	  This option enables the Ambiq PUF support.
	  It is required for the true random number generator.

config SOC_AMBIQ_DMA_BUFF_LOCATION
	hex "Byte offset to SRAM_BASE_ADDRESS"
	default 0x50000
	help
	  This option specifies the cacheable/desigated DMA buffers' start address.

config SOC_AMBIQ_DMA_BUFF_ALIGNMENT
	int "Byte alignment of the DMA buffer"
	default DCACHE_LINE_SIZE if DCACHE
	default 1
	help
	  This option specifies the DMA buffers' alignment.

config SOC_AMBIQ_DCACHE_SIZE
	int
	help
	  This describes the DCache size if present in the SoC.

config SOC_AMBIQ_HAS_CLKMGR
	bool "Ambiq clock manager support"
	help
	  This option enables the Ambiq clock manager support.

config SOC_AMBIQ_HAS_CRM
	bool "Ambiq Clock and Reset Management (CRM) support"
	help
	  This option enables the Ambiq Clock and Reset Management (CRM) support.

config SOC_AMBIQ_HAS_RSS
	bool "Ambiq Radio subsystem manager support"
	help
	  This option enables the radio subsystem manager functions.

rsource "*/Kconfig"

endif # SOC_FAMILY_AMBIQ
```

## soc/ambiq/Kconfig.defconfig
```kconfig
# SPDX-License-Identifier: Apache-2.0
#
# Copyright (c) 2023 Antmicro <www.antmicro.com>

if SOC_FAMILY_AMBIQ

rsource "*/Kconfig.defconfig"

config CORTEX_M_SYSTICK
	default n if AMBIQ_STIMER_TIMER

config SYS_CLOCK_TICKS_PER_SEC
	default 1024

endif # SOC_FAMILY_AMBIQ
```

## soc/ambiq/Kconfig.soc
```kconfig
# SPDX-License-Identifier: Apache-2.0
#
# Copyright (c) 2023 Antmicro <www.antmicro.com>

config SOC_FAMILY_AMBIQ
	bool

config SOC_FAMILY
	default "ambiq" if SOC_FAMILY_AMBIQ

rsource "*/Kconfig.soc"
```

## soc/ambiq/apollo2x/Kconfig
```kconfig
# SPDX-License-Identifier: Apache-2.0
#
# Copyright (c) 2025 Linumiz GmbH
# Author : Sri Surya  <srisurya@linumiz.com>

config SOC_SERIES_APOLLO2X
	select ARM
	select CPU_CORTEX_M4
	select CPU_CORTEX_M_HAS_DWT
	select CPU_HAS_FPU
	select CPU_HAS_ARM_MPU
	select HAS_SWO
	select AMBIQ_HAL
	select SOC_EARLY_INIT_HOOK
```

## soc/ambiq/apollo2x/Kconfig.defconfig
```kconfig
# SPDX-License-Identifier: Apache-2.0
#
# Copyright (c) 2025 Linumiz GmbH
# Author : Sri Surya  <srisurya@linumiz.com>

if SOC_APOLLO2

config NUM_IRQS
	default 32

DT_CLK_SYS_PATH := $(dt_nodelabel_path,sys_clk)

config SYS_CLOCK_HW_CYCLES_PER_SEC
	default $(dt_node_int_prop_int,$(DT_CLK_SYS_PATH),clock-frequency)

endif
```

## soc/ambiq/apollo2x/Kconfig.soc
```kconfig
# SPDX-License-Identifier: Apache-2.0
#
# Copyright (c) 2025 Linumiz GmbH
# Author : Sri Surya  <srisurya@linumiz.com>

config SOC_SERIES_APOLLO2X
	bool
	select SOC_FAMILY_AMBIQ
	help
	  Apollo2 Series MCU

config SOC_APOLLO2
	bool
	select SOC_SERIES_APOLLO2X
	help
	  Apollo2

config SOC_SERIES
	default "apollo2x" if SOC_SERIES_APOLLO2X

config SOC
	default "apollo2" if SOC_APOLLO2
```

## soc/ambiq/apollo3x/Kconfig
```kconfig
# SPDX-License-Identifier: Apache-2.0
#
# Copyright (c) 2023 Ambiq Micro Inc. <www.ambiq.com>

config SOC_SERIES_APOLLO3X
	select ARM
	select CPU_CORTEX_M4
	select CPU_CORTEX_M_HAS_DWT
	select CPU_HAS_FPU
	select CPU_HAS_ARM_MPU
	select HAS_SWO
	select AMBIQ_HAL
	select HAS_PM
	select SOC_EARLY_INIT_HOOK

config SOC_APOLLO3P_BLUE
	select SOC_AMBIQ_BT_SUPPORTED

config SOC_APOLLO3_BLUE
	select SOC_AMBIQ_BT_SUPPORTED
```

## soc/ambiq/apollo3x/Kconfig.defconfig.apollo3_blue
```kconfig
# SPDX-License-Identifier: Apache-2.0
#
# Copyright (c) 2023 Ambiq Micro Inc. <www.ambiq.com>

if SOC_APOLLO3_BLUE

config NUM_IRQS
	default 31

config MAIN_STACK_SIZE
	default 2048 if BT

if BT

config BT_BUF_ACL_TX_COUNT
	default 4

config BT_BUF_CMD_TX_SIZE
	default 255

config BT_BUF_EVT_RX_SIZE
	default 255

config BT_BUF_ACL_TX_SIZE
	default 251

config BT_BUF_ACL_RX_SIZE
	default 251

# L2CAP SDU/PDU TX MTU
# BT_L2CAP_RX_MTU = CONFIG_BT_BUF_ACL_RX_SIZE - BT_L2CAP_HDR_SIZE
config BT_L2CAP_TX_MTU
	default 247

config BT_HCI_ACL_FLOW_CONTROL
	default n

endif # BT

endif # SOC_APOLLO3_BLUE
```

## soc/ambiq/apollo3x/Kconfig.defconfig.apollo3p_blue
```kconfig
# SPDX-License-Identifier: Apache-2.0
#
# Copyright (c) 2023 Ambiq Micro Inc. <www.ambiq.com>

if SOC_APOLLO3P_BLUE

config NUM_IRQS
	default 33

endif # SOC_APOLLO3P_BLUE
```
