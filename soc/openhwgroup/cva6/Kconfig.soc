## soc/openhwgroup/cva6/Kconfig.soc
```kconfig
#Copyright 2024 CISPA Helmholtz Center for Information Security gGmbH
#SPDX-License-Identifier: Apache-2.0

config SOC_FAMILY_OPENHWGROUP_CVA6
	bool
	help
	  CVA6 RISC-V CPUs, commonly used as soft cores on FPGAs.
	  There is a 64-bit version with imafdc extensions and sv39 MMU and
	  several 32-bit configurations, optionally with up to imafdc and sv32 MMU.

config SOC_FAMILY
	default "openhwgroup_cva6" if SOC_FAMILY_OPENHWGROUP_CVA6

rsource "*/Kconfig.soc"
```

## soc/openhwgroup/cva6/cv32a6/Kconfig
```kconfig
# Copyright 2024 CISPA Helmholtz Center for Information Security gGmbH
# SPDX-License-Identifier: Apache-2.0
# RISCV32 OpenHW Group cva6 configuration options

config SOC_CV32A6
	select RISCV
	select RISCV_PRIVILEGED
	select ATOMIC_OPERATIONS_BUILTIN
	select RISCV_HAS_PLIC
	select USE_SWITCH_SUPPORTED
	select USE_SWITCH
	select SCHED_IPI_SUPPORTED
	select RISCV_ISA_RV32I
	select RISCV_ISA_EXT_M
	select RISCV_ISA_EXT_A
	select RISCV_ISA_EXT_ZICSR
	select RISCV_ISA_EXT_ZIFENCEI
	select CPU_HAS_DCACHE
	select CPU_HAS_ICACHE
```

## soc/openhwgroup/cva6/cv32a6/Kconfig.soc
```kconfig
# Copyright 2024 CISPA Helmholtz Center for Information Security gGmbH
# SPDX-License-Identifier: Apache-2.0

config SOC_SERIES_CV32A6
	bool
	select SOC_FAMILY_OPENHWGROUP_CVA6
	help
	  CVA6 32-bit RISC-V CPUs, commonly used as soft cores on FPGAs.
	  This configuration works with the upstream project (https://github.com/openhwgroup/cva6).

config SOC_CV32A6
	bool
	select SOC_SERIES_CV32A6
	help
	  Minimal CVA6 core in 32-bit configuration: ima extensions, no MMU or PMP,
	  SoC with CLINT, PLIC, UART, SPI, and Ethernet (Xilinx or lowRISC).

config SOC_SERIES
	default "cv32a6" if SOC_SERIES_CV32A6

config SOC
	default "cv32a6" if SOC_CV32A6
```

## soc/openhwgroup/cva6/cv64a6/Kconfig
```kconfig
# Copyright 2024 CISPA Helmholtz Center for Information Security gGmbH
# SPDX-License-Identifier: Apache-2.0
# RISCV64 OpenHW Group cva6 configuration options

# Shared properties
config SOC_CV64A6
	select RISCV
	select RISCV_PRIVILEGED
	select RISCV_HAS_PLIC
	select USE_SWITCH_SUPPORTED
	select USE_SWITCH
	select SCHED_IPI_SUPPORTED
	select CPU_HAS_DCACHE
	select CPU_HAS_ICACHE
```

## soc/openhwgroup/cva6/cv64a6/Kconfig.soc
```kconfig
# Copyright 2024 CISPA Helmholtz Center for Information Security gGmbH
# SPDX-License-Identifier: Apache-2.0

config SOC_SERIES_CV64A6
	bool
	select SOC_FAMILY_OPENHWGROUP_CVA6
	help
	  CVA6 64-bit RISC-V CPUs, commonly used as soft cores on FPGAs.
	  This configuration works with the upstream project (https://github.com/openhwgroup/cva6)
	  as well as the forked project with support for the Xilinx AXI Ethernet Subsystem
	  (https://github.com/cispa/CVA6-Vivado-Project-with-Xilinx-AXI-Ethernet).

config SOC_CV64A6_IMAFDC
	bool
	select SOC_SERIES_CV64A6
	help
	  Standard CVA6 core in 64-bit configuration: SV39 MMU and SoC with CLINT, PLIC, UART,
	  SPI, and Ethernet (Xilinx or lowRISC). Supports imafdc instruction sets.

config SOC_CV64A6_IMAC
	bool
	select SOC_SERIES_CV64A6
	help
	  Minimal CVA6 core in 64-bit configuration: SV39 MMU and SoC with CLINT, PLIC, UART,
	  SPI, and Ethernet (Xilinx or lowRISC). Supports imac instruction sets.

config SOC_SERIES
	default "cv64a6" if SOC_SERIES_CV64A6

config SOC
	default "cv64a6_imac" if SOC_CV64A6_IMAC
	default "cv64a6_imafdc" if SOC_CV64A6_IMAFDC
```

## soc/openisa/rv32m1/Kconfig
```kconfig
# Copyright (c) 2018 Foundries.io Ltd
# SPDX-License-Identifier: Apache-2.0

config SOC_OPENISA_RV32M1
	select RISCV
	select XIP
	select HAS_RV32M1_LPUART
	select HAS_RV32M1_LPI2C
	select HAS_RV32M1_LPSPI
	select HAS_RV32M1_TPM
	select VEGA_SDK_HAL
	select RISCV_SOC_INTERRUPT_INIT
	select CLOCK_CONTROL
	select HAS_RV32M1_FTFX
	select HAS_FLASH_LOAD_OFFSET
	select BUILD_OUTPUT_HEX
	select RISCV_ISA_RV32I
	select RISCV_ISA_EXT_M
	select RISCV_ISA_EXT_C
	select RISCV_ISA_EXT_ZICSR
	select RISCV_ISA_EXT_ZIFENCEI
	select RISCV_CUSTOM_CSR
	select RISCV_CUSTOM_CSR_RI5CY if SOC_OPENISA_RV32M1_RI5CY
	select RISCV_CUSTOM_CSR_ZERO_RISCY if SOC_OPENISA_RV32M1_ZERO_RISCY
	select SOC_EARLY_INIT_HOOK
```

## soc/openisa/rv32m1/Kconfig.defconfig
```kconfig
# RV32M1 SoC RISC-V core default configuration values

# Copyright (c) 2018 Foundries.io Ltd
# SPDX-License-Identifier: Apache-2.0

if SOC_OPENISA_RV32M1

# 32 from event unit + 32 * (1 + max enabled INTMUX channel)
config NUM_IRQS
	default 288 if RV32M1_INTMUX_CHANNEL_7
	default 256 if RV32M1_INTMUX_CHANNEL_6
	default 224 if RV32M1_INTMUX_CHANNEL_5
	default 192 if RV32M1_INTMUX_CHANNEL_4
	default 160 if RV32M1_INTMUX_CHANNEL_3
	default 128 if RV32M1_INTMUX_CHANNEL_2
	default 96 if RV32M1_INTMUX_CHANNEL_1
	default 64 if RV32M1_INTMUX_CHANNEL_0
	default 32

config RISCV_GENERIC_TOOLCHAIN
	default y if "$(ZEPHYR_TOOLCHAIN_VARIANT)" = "zephyr"
	default n

config RISCV_SOC_CONTEXT_SAVE
	default y if SOC_OPENISA_RV32M1_RI5CY

config RISCV_SOC_OFFSETS
	default y

config RISCV_SOC_INTERRUPT_INIT
	default y

config RISCV_MCAUSE_EXCEPTION_MASK
	default 0x1F

# We need to disable the watchdog out of reset, as it's enabled by
# default. Use the WDOG_INIT hook for doing that.
config WDOG_INIT
	def_bool y

config SYS_CLOCK_HW_CYCLES_PER_SEC
	default 8000000

if MULTI_LEVEL_INTERRUPTS

config MAX_IRQ_PER_AGGREGATOR
	default 32

config 2ND_LEVEL_INTERRUPTS
	default y

config 2ND_LVL_ISR_TBL_OFFSET
	default 32

config NUM_2ND_LEVEL_AGGREGATORS
	default 8 if RV32M1_INTMUX_CHANNEL_7
	default 7 if RV32M1_INTMUX_CHANNEL_6
	default 6 if RV32M1_INTMUX_CHANNEL_5
	default 5 if RV32M1_INTMUX_CHANNEL_4
	default 4 if RV32M1_INTMUX_CHANNEL_3
	default 3 if RV32M1_INTMUX_CHANNEL_2
	default 2 if RV32M1_INTMUX_CHANNEL_1
	default 1		# just channel 0

config 2ND_LVL_INTR_00_OFFSET
	default 24

config 2ND_LVL_INTR_01_OFFSET
	int
	default 25

config 2ND_LVL_INTR_02_OFFSET
	int
	default 26

config 2ND_LVL_INTR_03_OFFSET
	int
	default 27

config 2ND_LVL_INTR_04_OFFSET
	int
	default 28

config 2ND_LVL_INTR_05_OFFSET
	int
	default 29

config 2ND_LVL_INTR_06_OFFSET
	int
	default 30

config 2ND_LVL_INTR_07_OFFSET
	int
	default 31

config RV32M1_INTMUX_CHANNEL_0
	default y

config RV32M1_INTMUX_CHANNEL_1
	default y

config RV32M1_INTMUX_CHANNEL_2
	default y

config RV32M1_INTMUX_CHANNEL_3
	default y

config RV32M1_INTMUX_CHANNEL_4
	default y

config RV32M1_INTMUX_CHANNEL_5
	default y

config RV32M1_INTMUX_CHANNEL_6
	default y

config RV32M1_INTMUX_CHANNEL_7
	default y

endif # MULTI_LEVEL_INTERRUPTS

endif # SOC_OPENISA_RV32M1
```

## soc/openisa/rv32m1/Kconfig.soc
```kconfig
# Copyright (c) 2018 Foundries.io Ltd
# SPDX-License-Identifier: Apache-2.0

config SOC_OPENISA_RV32M1
	bool
	help
	  Enable support for OpenISA RV32M1 RISC-V processors. Choose
	  this option to target the RI5CY or ZERO-RISCY core. This
	  option should not be used to target either Arm core.

config SOC_OPENISA_RV32M1_RI5CY
	bool
	select SOC_OPENISA_RV32M1
	help
	  OpenISA RV32M1 RI5CY core

config SOC_OPENISA_RV32M1_ZERO_RISCY
	bool
	select SOC_OPENISA_RV32M1
	help
	  OpenISA RV32M1 ZERO-RISCY core

config SOC
	default "openisa_rv32m1" if SOC_OPENISA_RV32M1
```

## soc/posix/inf_clock/Kconfig
```kconfig
# Copyright (c) 2023 Nordic Semiconductor ASA
# SPDX-License-Identifier: Apache-2.0

config NATIVE_SIMULATOR_CPU_N
	int "CPU Number this image targets"
	range 0 15
	default 0
	depends on NATIVE_LIBRARY
	help
	  Which native simulator embedded CPU number is this image targeting.
	  This option is only applicable for targets which use the
	  native simulator as their runner.

config NATIVE_SIMULATOR_PRIMARY_MCU_INDEX
	int "Which CPU is the primary/preferred"
	default 0
	depends on NATIVE_LIBRARY
	help
	  On a multi MCU device, which MCU is the preferred one.
	  This MCU will for example have its tests command line parameters presented
	  without any prefix. Note that an MCU being primary does not imply it will be
	  the first one to boot.
```

## soc/posix/inf_clock/Kconfig.defconfig
```kconfig
#
# Copyright (c) 2017 Intel Corporation
#
# SPDX-License-Identifier: Apache-2.0
#

if SOC_POSIX

config SOC
	default "inf_clock"

endif
```

## soc/posix/inf_clock/Kconfig.soc
```kconfig
config SOC_POSIX
	bool "Native POSIX port"
	help
	  SOC for to the POSIX arch. It emulates a CPU running at an infinitely fast
	  clock. That means the CPU will always run in zero time until completion after
	  each wake reason (e.g. interrupts), before going back to idle. Note that an
	  infinite loop in the code which does not sleep the CPU will cause the process
	  to appear "hung", as simulated time does not advance while the CPU does not
	  sleep. Therefore do not use busy waits while waiting for something to happen
	  (if needed use k_busy_wait()).
	  Note that the interrupt handling is provided by the board.
```

## soc/qemu/hexagon/Kconfig
```kconfig
# SPDX-License-Identifier: Apache-2.0
# Copyright (c) Qualcomm Technologies, Inc. and/or its subsidiaries.

config SOC_QEMU_HEXAGON_VIRT
	select HEXAGON
	select GEN_ISR_TABLES
```

## soc/qemu/hexagon/Kconfig.defconfig
```kconfig
# SPDX-License-Identifier: Apache-2.0
# Copyright (c) Qualcomm Technologies, Inc. and/or its subsidiaries.

if SOC_QEMU_HEXAGON_VIRT

config SYS_CLOCK_HW_CYCLES_PER_SEC
	default $(dt_node_int_prop_int,/cpus/cpu@0,clock-frequency)

config NUM_IRQS
	default 64

endif # SOC_QEMU_HEXAGON_VIRT
```

## soc/qemu/hexagon/Kconfig.soc
```kconfig
# SPDX-License-Identifier: Apache-2.0
# Copyright (c) Qualcomm Technologies, Inc. and/or its subsidiaries.

config SOC_QEMU_HEXAGON_VIRT
	bool

config SOC
	default "qemu_hexagon_virt" if SOC_QEMU_HEXAGON_VIRT
```

## soc/qemu/malta/Kconfig
```kconfig
# Copyright (c) 2020 Antony Pavlov <antonynpavlov@gmail.com>
#
# SPDX-License-Identifier: Apache-2.0

config SOC_QEMU_MALTA
	select MIPS
```

## soc/qemu/or1k/Kconfig
```kconfig
#
# Copyright (c) 2025 NVIDIA Corporation <jholdsworth@nvidia.com>
#
# SPDX-License-Identifier: Apache-2.0
#

config SOC_QEMU_OR1K
	select OPENRISC
```

## soc/qemu/or1k/Kconfig.defconfig
```kconfig
#
# Copyright (c) 2025 NVIDIA Corporation <jholdsworth@nvidia.com>
#
# SPDX-License-Identifier: Apache-2.0
#

if SOC_QEMU_OR1K

config SYS_CLOCK_HW_CYCLES_PER_SEC
	default 20000000

config NUM_IRQS
	default 32

endif # SOC_QEMU_OR1K
```

## soc/qemu/or1k/Kconfig.soc
```kconfig
#
# Copyright (c) 2025 NVIDIA Corporation <jholdsworth@nvidia.com>
#
# SPDX-License-Identifier: Apache-2.0
#

config SOC_QEMU_OR1K
	bool

config SOC
	default "qemu_or1k" if SOC_QEMU_OR1K
```

## soc/qemu/tc3x/Kconfig
```kconfig
# Copyright (c) 2026 Infineon Technologies AG
#
# SPDX-License-Identifier: Apache-2.0

config SOC_QEMU_TC3X
	select SOC_TC39xB
```

## soc/qemu/tc3x/Kconfig.soc
```kconfig
# SPDX-License-Identifier: Apache-2.0

config SOC_QEMU_TC3X
	bool

config SOC
	default "qemu_tc3x" if SOC_QEMU_TC3X
```

## soc/qemu/tc4x/Kconfig
```kconfig
# Copyright (c) 2026 Infineon Technologies AG
#
# SPDX-License-Identifier: Apache-2.0

config SOC_QEMU_TC4X
	select SOC_TC4D7XP
```

## soc/qemu/tc4x/Kconfig.defconfig
```kconfig
# Copyright (c) 2026 Infineon Technologies AG
#
# SPDX-License-Identifier: Apache-2.0

if TEST
# Increase the default CSA count to pass the tests
config TRICORE_CSA_COUNT
	default 384
endif
```

## soc/qemu/tc4x/Kconfig.soc
```kconfig
# SPDX-License-Identifier: Apache-2.0

config SOC_QEMU_TC4X
	bool

config SOC
	default "qemu_tc4x" if SOC_QEMU_TC4X
```

## soc/qemu/virt_riscv/Kconfig
```kconfig
# Copyright (c) 2024 Antmicro <www.antmicro.com>
# SPDX-License-Identifier: Apache-2.0

config SOC_FAMILY_QEMU_VIRT_RISCV
	select INCLUDE_RESET_VECTOR
	select RISCV
	select RISCV_PRIVILEGED
	select RISCV_SOC_HAS_GP_RELATIVE_ADDRESSING
	imply XIP

if SOC_FAMILY_QEMU_VIRT_RISCV

rsource "*/Kconfig"

endif # SOC_FAMILY_QEMU_VIRT_RISCV
```

## soc/qemu/virt_riscv/Kconfig.defconfig
```kconfig
# Copyright (c) 2020 Cobham Gaisler AB
# Copyright (c) 2024 Antmicro <www.antmicro.com>
# SPDX-License-Identifier: Apache-2.0

if SOC_FAMILY_QEMU_VIRT_RISCV

config SYS_CLOCK_HW_CYCLES_PER_SEC
	default 10000000

config RISCV_SOC_INTERRUPT_INIT
	default y

config 2ND_LVL_ISR_TBL_OFFSET
	default 12

config 2ND_LVL_INTR_00_OFFSET
	default 11

config 2ND_LEVEL_INTERRUPT_BITS
	default 11

config MAX_IRQ_PER_AGGREGATOR
	default 1024

config NUM_IRQS
	default 1036

config PMP_SLOTS
	default 16

endif # SOC_FAMILY_QEMU_VIRT_RISCV

# AIA variant configuration
if SOC_QEMU_VIRT_RISCV32_AIA

config SYS_CLOCK_HW_CYCLES_PER_SEC
	default 10000000

config RISCV_SOC_INTERRUPT_INIT
	default y

# AIA uses direct EIID addressing (no multi-level encoding)
config NUM_IRQS
	default 256

config GEN_IRQ_START_VECTOR
	default 0

config PMP_SLOTS
	default 16

endif # SOC_QEMU_VIRT_RISCV32_AIA
```
