## soc/spike/spike_virt_riscv32/Kconfig.soc
```kconfig
# Copyright (c) 2024 Tim-Marek Thomas <thomas@sra.uni-hannover.de>
# SPDX-License-Identifier: Apache-2.0
config SOC_SPIKE_VIRT_RISCV32
	bool
	select SOC_FAMILY_SPIKE_VIRT_RISCV

config SOC
	default "spike_virt_riscv32" if SOC_SPIKE_VIRT_RISCV32
```

## soc/spike/spike_virt_riscv64/Kconfig
```kconfig
# Copyright (c) 2024 Tim-Marek Thomas <thomas@sra.uni-hannover.de>
# SPDX-License-Identifier: Apache-2.0
config SOC_SPIKE_VIRT_RISCV64
	select 64BIT
	select CPU_HAS_FPU
	select RISCV_ISA_RV64I
	select RISCV_ISA_EXT_ZICSR
	select RISCV_ISA_EXT_ZIFENCEI
```

## soc/spike/spike_virt_riscv64/Kconfig.soc
```kconfig
# Copyright (c) 2024 Tim-Marek Thomas <thomas@sra.uni-hannover.de>
# SPDX-License-Identifier: Apache-2.0
config SOC_SPIKE_VIRT_RISCV64
	bool
	select SOC_FAMILY_SPIKE_VIRT_RISCV

config SOC
	default "spike_virt_riscv64" if SOC_SPIKE_VIRT_RISCV64
```

## soc/spike/virt_riscv/spike_virt_riscv64/Kconfig.soc
```kconfig
# Copyright (c) 2024 Antmicro <www.antmicro.com>
# SPDX-License-Identifier: Apache-2.0

config SOC_SPIKE_VIRT_RISCV64
	bool
	select SOC_FAMILY_SPIKE_VIRT_RISCV

config SOC
	default "spike_virt_riscv64" if SOC_SPIKE_VIRT_RISCV64
```

## soc/st/stm32/Kconfig
```kconfig
# Copyright (c) 2024 STMicroelectronics
# SPDX-License-Identifier: Apache-2.0

config SOC_FAMILY_STM32
	select HAS_SEGGER_RTT if ZEPHYR_SEGGER_MODULE
	select STM32_ENABLE_DEBUG_SLEEP_STOP if ZTEST
	select BUILD_OUTPUT_HEX

if SOC_FAMILY_STM32

rsource "*/Kconfig"

# Kconfig options used to configure the family-wide code
# found in `common/` are declared in `common/Kconfig`.
# Some options are also shared by multiple series, but not
# used by this family-wide common code; instead, they are
# consumed by certain drivers, SoC-specific code or the
# STM32Cube HAL module.
#
# (Please indicate as a comment where each option is consumed)

# This option is consumed by the HAL module
config USE_STM32_ASSERT
	depends on ASSERT
	bool "STM32Cube HAL and LL drivers asserts"
	help
	  Enable asserts in STM32Cube HAL and LL drivers.

config HAS_STM32_FLASH_PREFETCH
	bool
	help
	  Hidden symbol selected by SoCs which support flash prefetch.

# This option is consumed by `soc.c` of applicable series
config STM32_FLASH_PREFETCH
	bool "Flash prefetch buffer"
	default y
	depends on HAS_STM32_FLASH_PREFETCH
	help
	  Enable flash prefetch. For power efficiency, it is recommended to
	  be enabled when flash is accessed through a cache memory. Flash
	  prefetch also improves performances a bit.

# This option is consumed by external flash drivers
config STM32_APP_IN_EXT_FLASH
	bool
	help
	  Allows the SoC clock driver to correctly initialize the
	  Q/O/XSPI controller clocks when the application is residing
	  in external Flash and is chainloaded with MCUboot.
	  Whether the app is eXecuted in Place (XiP) depends on the MCUboot mode used.

endif # SOC_FAMILY_STM32
```

## soc/st/stm32/Kconfig.defconfig
```kconfig
# ST Microelectronics STM32 all MCU lines

# Copyright (c) 2017, I-SENSE group of ICCS
# SPDX-License-Identifier: Apache-2.0

# Default configurations applied to the whole STM32 family

if SOC_FAMILY_STM32

# Source series Kconfig files first, so SoCs
# can override the defaults given here
rsource "*/Kconfig.defconfig"

config CACHE_STM32
	default y if EXTERNAL_CACHE

config CLOCK_CONTROL
	default y

config CORTEX_M_SYSTICK
	default n if STM32_LPTIM_TIMER

# Reduce kernel stack sizes to fit MCUs with 8 KiB RAM or less
config MAIN_STACK_SIZE
	default 320 if SRAM_SIZE <= 2
	default 512 if SRAM_SIZE <= 4
	default 640 if SRAM_SIZE <= 8

config IDLE_STACK_SIZE
	default 100 if SRAM_SIZE <= 2
	default 150 if SRAM_SIZE <= 4
	default 200 if SRAM_SIZE <= 8

config ISR_STACK_SIZE
	default 256 if SRAM_SIZE <= 2
	default 512 if SRAM_SIZE <= 8

DT_STM32_RCC_PATH := $(dt_nodelabel_path,rcc)
DT_STM32_RCC_CLOCK_FREQ := $(dt_node_int_prop_int,$(DT_STM32_RCC_PATH),clock-frequency)

DT_STM32WB0_RADIO_TIMER_PATH := $(dt_nodelabel_path,radio_timer)
DT_STM32WB0_TIMER_FREQ := $(dt_node_int_prop_int,$(DT_STM32WB0_RADIO_TIMER_PATH),compensated-timer-freq)

DT_ST_PRESCALER := st,prescaler
DT_STM32_LPTIM_PATH := $(dt_nodelabel_path,stm32_lp_tick_source)

DT_CHOSEN_Z_FLASH := zephyr,flash

DT_CHOSEN_FLASH_NODE := $(dt_chosen_path,$(DT_CHOSEN_Z_FLASH))
DT_CHOSEN_FLASH_PARENT := $(dt_node_parent,$(DT_CHOSEN_FLASH_NODE))
DT_FLASH_PARENT_IS_XSPI := $(dt_node_has_compat,$(DT_CHOSEN_FLASH_PARENT),$(DT_COMPAT_ST_STM32_XSPI))
DT_FLASH_PARENT_IS_OSPI := $(dt_node_has_compat,$(DT_CHOSEN_FLASH_PARENT),$(DT_COMPAT_ST_STM32_OSPI))
DT_FLASH_PARENT_IS_QSPI := $(dt_node_has_compat,$(DT_CHOSEN_FLASH_PARENT),$(DT_COMPAT_ST_STM32_QSPI))

DT_CHOSEN_Z_FLASH_CTRL := zephyr,flash-controller
DT_CHOSEN_FLASH_CTRL_NODE := $(dt_chosen_path,$(DT_CHOSEN_Z_FLASH_CTRL))
DT_FLASH_CTRL_IS_XSPI_NOR  := $(dt_node_has_compat,$(DT_CHOSEN_FLASH_CTRL_NODE),$(DT_COMPAT_ST_STM32_XSPI_NOR))

config SYS_CLOCK_HW_CYCLES_PER_SEC
	default "$(DT_STM32WB0_TIMER_FREQ)" if STM32WB0_RADIO_TIMER
	default "$(DT_STM32_RCC_CLOCK_FREQ)" if "$(dt_nodelabel_enabled,rcc)"

config LOG_BACKEND_SWO_REF_FREQ_HZ
	default "$(DT_STM32_RCC_CLOCK_FREQ)" if "$(dt_nodelabel_enabled,rcc)"
	depends on LOG_BACKEND_SWO

# If sysclock is not LPTIM, tick of 10000 is too high for a frequency lower than 32MHz
config SYS_CLOCK_TICKS_PER_SEC
	default 8000 if SYS_CLOCK_HW_CYCLES_PER_SEC <= 32000000
	depends on !STM32_LPTIM_TIMER

# set the tick per sec as a divider of the LPTIM clock source
# with a minimum value of 4096 for SYS_CLOCK_TICKS_PER_SEC to keep
# SYS_CLOCK_TICKS_PER_SEC not too high compared to the LPTIM counter clock
config SYS_CLOCK_TICKS_PER_SEC
	default 4096 if "$(dt_node_int_prop_int,$(DT_STM32_LPTIM_PATH),$(DT_ST_PRESCALER))" < 16
	default 2048 if "$(dt_node_int_prop_int,$(DT_STM32_LPTIM_PATH),$(DT_ST_PRESCALER))" = 16
	default 1024 if "$(dt_node_int_prop_int,$(DT_STM32_LPTIM_PATH),$(DT_ST_PRESCALER))" = 32
	default  512 if "$(dt_node_int_prop_int,$(DT_STM32_LPTIM_PATH),$(DT_ST_PRESCALER))" = 64
	default  256 if "$(dt_node_int_prop_int,$(DT_STM32_LPTIM_PATH),$(DT_ST_PRESCALER))" = 128
	depends on STM32_LPTIM_TIMER && STM32_LPTIM_CLOCK_LSE

config SYS_CLOCK_TICKS_PER_SEC
	default 4000 if "$(dt_node_int_prop_int,$(DT_STM32_LPTIM_PATH),$(DT_ST_PRESCALER))" < 16
	default 2000 if "$(dt_node_int_prop_int,$(DT_STM32_LPTIM_PATH),$(DT_ST_PRESCALER))" = 16
	default 1000 if "$(dt_node_int_prop_int,$(DT_STM32_LPTIM_PATH),$(DT_ST_PRESCALER))" = 32
	default  500 if "$(dt_node_int_prop_int,$(DT_STM32_LPTIM_PATH),$(DT_ST_PRESCALER))" = 64
	default  250 if "$(dt_node_int_prop_int,$(DT_STM32_LPTIM_PATH),$(DT_ST_PRESCALER))" = 128
	depends on STM32_LPTIM_TIMER && STM32_LPTIM_CLOCK_LSI

config CLOCK_CONTROL_INIT_PRIORITY
	default 1
	depends on CLOCK_CONTROL

# Get flash configuration for NS image from dts flash partition
config USE_DT_CODE_PARTITION
	default y if TRUSTED_EXECUTION_NONSECURE

config BUILD_WITH_TFM
	default y if TRUSTED_EXECUTION_NONSECURE

config FLASH_BASE_ADDRESS
	default $(dt_node_reg_addr_hex,$(DT_CHOSEN_FLASH_PARENT),1) \
		if $(DT_FLASH_PARENT_IS_XSPI) || $(DT_FLASH_PARENT_IS_OSPI) || $(DT_FLASH_PARENT_IS_QSPI)
	default $(dt_chosen_reg_addr_hex,$(DT_CHOSEN_Z_FLASH))

config STM32_APP_IN_EXT_FLASH
	default $(DT_FLASH_PARENT_IS_XSPI) || $(DT_FLASH_CTRL_IS_XSPI_NOR)

# The XSPI PSRAM driver creates a SMH region with attribute SMH_REG_ATTR_EXTERNAL (2)
# If applicable set the LTDC / VIDEO_BUFFER SMH attribute to SMH_REG_ATTR_EXTERNAL (2)
# in order to be able to allocate from the XSPI PSRAM
if MEMC_STM32_XSPI_PSRAM && SHARED_MULTI_HEAP

config STM32_LTDC_FB_SMH_ATTRIBUTE
	default 2 if STM32_LTDC_FB_USE_SHARED_MULTI_HEAP

config VIDEO_BUFFER_SMH_ATTRIBUTE
	default 2 if VIDEO_BUFFER_USE_SHARED_MULTI_HEAP

endif # MEMC_STM32_XSPI_PSRAM && SHARED_MULTI_HEAP

config VIDEO_BUFFER_POOL_ALIGN
	default 16 if VIDEO_STM32_DCMIPP

config STM32_BACKUP_PROTECTION
	default y if !SOC_SERIES_STM32C0X && !SOC_SERIES_STM32WB0X

endif # SOC_FAMILY_STM32
```

## soc/st/stm32/Kconfig.soc
```kconfig
# ST Microelectronics STM32 MCU line

# Copyright (c) 2016 Open-RnD Sp. z o.o.
# SPDX-License-Identifier: Apache-2.0

config SOC_FAMILY_STM32
	bool

config SOC_FAMILY
	default "stm32" if SOC_FAMILY_STM32

rsource "*/Kconfig.soc"
```

## soc/st/stm32/common/Kconfig
```kconfig
# Copyright (c) 2025 STMicroelectronics
# SPDX-License-Identifier: Apache-2.0
#
# Kconfig options for STM32 family-wide code
#
# The following options are used to enable or configure
# code in `soc/st/stm32/common` which is shared between
# multiple STM32 series.
#

# Workaround for not being able to have commas in macro arguments
DT_CHOSEN_Z_CCM := zephyr,ccm

config STM32_CCM
	def_bool $(dt_chosen_enabled,$(DT_CHOSEN_Z_CCM))

config STM32_BACKUP_SRAM
	bool "STM32 Backup SRAM"
	default y
	depends on DT_HAS_ST_STM32_BACKUP_SRAM_ENABLED
	help
	  Enable support for STM32 backup SRAM.

config STM32_BACKUP_SRAM_INIT_PRIORITY
	int "STM32 Backup SRAM init priority"
	default APPLICATION_INIT_PRIORITY
	depends on STM32_BACKUP_SRAM
	help
	  STM32 Backup SRAM device initialization priority.

config STM32_ENABLE_DEBUG_SLEEP_STOP
	bool "Allow debugger attach in stop/sleep Mode"
	default y if DEBUG
	help
	  Some STM32 parts disable the DBGMCU in sleep/stop modes because
	  of power consumption. As a side-effects this prevents
	  debuggers from attaching w/o resetting the target. This
	  effectively destroys the use-case of `west attach`. Also
	  SEGGER RTT and similar technologies need this.

config SWJ_ANALOG_PRIORITY
	int "SWJ DP port to analog routine initialization priority"
	default 49
	help
	  Initialization priority of the routine within the PRE_KERNEL1 level.
	  This priority must be greater than GPIO_INIT_PRIORITY and lower than
	  UART_INIT_PRIORITY.

config STM32_WKUP_PINS
	bool "STM32 PWR Wake-up Pins"
	depends on DT_HAS_ST_STM32_PWR_ENABLED
	help
	  Enable support for STM32 PWR wake-up pins.

config STM32_BACKUP_PROTECTION
	bool "SoC has backup domain protection access"
	help
	  Enabled for SoCs for which access protection to backup domain
	  resources needs to be explicitly handled.
```

## soc/st/stm32/common/Kconfig.defconfig
```kconfig
if SOC_SERIES_STM32N6X && DT_HAS_ST_STM32_IOCELL_ENABLED

config OTP
	default y

config NVMEM
	default y

endif # SOC_SERIES_STM32N6X && DT_HAS_ST_STM32_IOCELL_ENABLED
```

## soc/st/stm32/stm32c0x/Kconfig
```kconfig
# STMicroelectronics STM32C0 MCU series

# Copyright (c) 2023 Benjamin Björnsson <benjamin.bjornsson@gmail.com>
# SPDX-License-Identifier: Apache-2.0

config SOC_SERIES_STM32C0X
	select ARM
	select CPU_CORTEX_M0PLUS
	select CPU_CORTEX_M_HAS_VTOR
	select CPU_HAS_ARM_MPU
	select HAS_STM32CUBE
	select CPU_CORTEX_M_HAS_SYSTICK
	select HAS_POWEROFF
	select SOC_EARLY_INIT_HOOK
```

## soc/st/stm32/stm32c0x/Kconfig.defconfig
```kconfig
# STMicroelectronics STM32C0 MCU line

# Copyright (c) 2023 Benjamin Björnsson <benjamin.bjornsson@gmail.com>
# SPDX-License-Identifier: Apache-2.0

if SOC_SERIES_STM32C0X

if PM

config COUNTER
	default y

config COUNTER_RTC_STM32_SUBSECONDS
	default y if DT_HAS_ST_STM32_RTC_ENABLED

endif # PM

endif # SOC_SERIES_STM32C0X
```

## soc/st/stm32/stm32c0x/Kconfig.defconfig.stm32c011xx
```kconfig
# STMicroelectronics STM32C011xx MCU

# Copyright (c) 2024 Kickmaker
# SPDX-License-Identifier: Apache-2.0

if SOC_STM32C011XX

config NUM_IRQS
	default 29

endif # SOC_STM32C011XX
```

## soc/st/stm32/stm32c0x/Kconfig.defconfig.stm32c031xx
```kconfig
# STMicroelectronics STM32C031xx MCU

# Copyright (c) 2023 Benjamin Björnsson <benjamin.bjornsson@gmail.com>
# SPDX-License-Identifier: Apache-2.0

if SOC_STM32C031XX

config NUM_IRQS
	default 29

endif # SOC_STM32C031XX
```

## soc/st/stm32/stm32c0x/Kconfig.defconfig.stm32c051xx
```kconfig
# STMicroelectronics STM32C051xx MCU

# Copyright (c) 2024 STMicroelectronics
# Copyright (c) 2025 Thomas Stranger
# SPDX-License-Identifier: Apache-2.0

if SOC_STM32C051XX

config NUM_IRQS
	default 29

endif # SOC_STM32C051XX
```

## soc/st/stm32/stm32c0x/Kconfig.defconfig.stm32c071xx
```kconfig
# STMicroelectronics STM32C071xx MCU

# Copyright (c) 2024 STMicroelectronics
# SPDX-License-Identifier: Apache-2.0

if SOC_STM32C071XX

config NUM_IRQS
	default 29

endif # SOC_STM32C071XX
```

## soc/st/stm32/stm32c0x/Kconfig.defconfig.stm32c091xx
```kconfig
# STMicroelectronics STM32C091xx MCU

# Copyright (c) 2024 STMicroelectronics
# Copyright (c) 2025 Thomas Stranger
# SPDX-License-Identifier: Apache-2.0

if SOC_STM32C091XX

config NUM_IRQS
	default 30

endif # SOC_STM32C091XX
```

## soc/st/stm32/stm32c0x/Kconfig.defconfig.stm32c092xx
```kconfig
# STMicroelectronics STM32C092xx MCU

# Copyright (c) 2024 STMicroelectronics
# Copyright (c) 2025 Thomas Stranger
# SPDX-License-Identifier: Apache-2.0

if SOC_STM32C092XX

config NUM_IRQS
	default 32

endif # SOC_STM32C092XX
```

## soc/st/stm32/stm32c0x/Kconfig.soc
```kconfig
# STMicroelectronics STM32C0 MCU line

# Copyright (c) 2023 Benjamin Björnsson <benjamin.bjornsson@gmail.com>
# SPDX-License-Identifier: Apache-2.0

config SOC_SERIES_STM32C0X
	bool
	select SOC_FAMILY_STM32

config SOC_SERIES
	default "stm32c0x" if SOC_SERIES_STM32C0X

config SOC_STM32C011XX
	bool
	select SOC_SERIES_STM32C0X

config SOC_STM32C031XX
	bool
	select SOC_SERIES_STM32C0X

config SOC_STM32C071XX
	bool
	select SOC_SERIES_STM32C0X

config SOC
	default "stm32c011xx" if SOC_STM32C011XX
	default "stm32c031xx" if SOC_STM32C031XX
	default "stm32c071xx" if SOC_STM32C071XX
```

## soc/st/stm32/stm32c5x/Kconfig.defconfig
```kconfig
# STMicroelectronics STM32C5 MCU line

# Copyright (c) 2026 STMicroelectronics
# SPDX-License-Identifier: Apache-2.0

if SOC_SERIES_STM32C5X

rsource "Kconfig.defconfig.stm32c5*"

config ROM_START_OFFSET
	default 0x400 if BOOTLOADER_MCUBOOT

config ICACHE
	default y

config CACHE_MANAGEMENT
	default y

choice CACHE_TYPE
	default EXTERNAL_CACHE
endchoice

endif # SOC_SERIES_STM32C5X
```

## soc/st/stm32/stm32c5x/Kconfig.defconfig.stm32c531xx
```kconfig
# STMicroelectronics STM32C531XX MCU

# Copyright (c) 2026 STMicroelectronics
# SPDX-License-Identifier: Apache-2.0

if SOC_STM32C531XX

config NUM_IRQS
	default 89

endif # SOC_STM32C531XX
```

## soc/st/stm32/stm32c5x/Kconfig.defconfig.stm32c532xx
```kconfig
# STMicroelectronics STM32C532XX MCU

# Copyright (c) 2026 STMicroelectronics
# SPDX-License-Identifier: Apache-2.0

if SOC_STM32C532XX

config NUM_IRQS
	default 89

endif # SOC_STM32C532XX
```

## soc/st/stm32/stm32c5x/Kconfig.defconfig.stm32c542xx
```kconfig
# STMicroelectronics STM32C542XX MCU

# Copyright (c) 2026 STMicroelectronics
# SPDX-License-Identifier: Apache-2.0

if SOC_STM32C542XX

config NUM_IRQS
	default 89

endif # SOC_STM32C542XX
```

## soc/st/stm32/stm32c5x/Kconfig.defconfig.stm32c551xx
```kconfig
# STMicroelectronics STM32C551XX MCU

# Copyright (c) 2026 STMicroelectronics
# SPDX-License-Identifier: Apache-2.0

if SOC_STM32C551XX

config NUM_IRQS
	default 82

endif # SOC_STM32C551XX
```

## soc/st/stm32/stm32c5x/Kconfig.defconfig.stm32c552xx
```kconfig
# STMicroelectronics STM32C552XX MCU

# Copyright (c) 2026 STMicroelectronics
# SPDX-License-Identifier: Apache-2.0

if SOC_STM32C552XX

config NUM_IRQS
	default 82

endif # SOC_STM32C552XX
```

## soc/st/stm32/stm32c5x/Kconfig.defconfig.stm32c562xx
```kconfig
# STMicroelectronics STM32C562XX MCU

# Copyright (c) 2026 STMicroelectronics
# SPDX-License-Identifier: Apache-2.0

if SOC_STM32C562XX

config NUM_IRQS
	default 82

endif # SOC_STM32C562XX
```
