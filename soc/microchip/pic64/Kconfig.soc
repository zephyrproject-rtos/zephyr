## soc/microchip/pic64/Kconfig.soc
```kconfig
# Copyright (c) 2025 Microchip Technology Inc
# SPDX-License-Identifier: Apache-2.0

config SOC_FAMILY_MICROCHIP_PIC64
	bool

config SOC_FAMILY
	default "microchip_pic64" if SOC_FAMILY_MICROCHIP_PIC64

rsource "*/Kconfig.soc"
```

## soc/microchip/pic64/pic64gx/Kconfig
```kconfig
# RISCV64 Microchip PIC64GX SOC configuration options

# Copyright (c) 2025 Microchip Technology Inc
# SPDX-License-Identifier: Apache-2.0

config SOC_SERIES_PIC64GX
	select RISCV
	select RISCV_PRIVILEGED
	select RISCV_HAS_PLIC
	select RISCV_PMP
	select RISCV_SOC_HAS_GP_RELATIVE_ADDRESSING
	imply XIP

config SOC_PIC64GX1000
	bool
	select SCHED_IPI_SUPPORTED
	select ATOMIC_OPERATIONS_BUILTIN
	select INCLUDE_RESET_VECTOR
	select RISCV_SOC_HAS_GP_RELATIVE_ADDRESSING
	select USE_SWITCH_SUPPORTED
	select USE_SWITCH
```

## soc/microchip/pic64/pic64gx/Kconfig.defconfig
```kconfig
# Copyright (c) 2025 Microchip Technology Inc
# SPDX-License-Identifier: Apache-2.0

if SOC_SERIES_PIC64GX

rsource "Kconfig.defconfig.pic64gx*"

# PIC64GX should be configured so that the mtimer clock is 1MHz independent of the CPU clock...

config SYS_CLOCK_HW_CYCLES_PER_SEC
	default 1000000

config RISCV_SOC_INTERRUPT_INIT
	default y

config 2ND_LVL_ISR_TBL_OFFSET
	default 12

config 2ND_LVL_INTR_00_OFFSET
	default 11

config MAX_IRQ_PER_AGGREGATOR
	default 186

config NUM_IRQS
	default 198

endif # SOC_SERIES_PIC64GX
```

## soc/microchip/pic64/pic64gx/Kconfig.defconfig.pic64gx1000_u54
```kconfig
# Copyright (c) 2025 Microchip Technology Inc
# SPDX-License-Identifier: Apache-2.0

if SOC_PIC64GX1000_U54

DT_COMPAT_SIFIVE_U54 := sifive,u54

config MP_MAX_NUM_CPUS
	default $(dt_compat_enabled_num,$(DT_COMPAT_SIFIVE_U54))

config RV_BOOT_HART
	default 1 if ($(dt_path_enabled,/cpus/cpu@1))
	default 2 if ($(dt_path_enabled,/cpus/cpu@2))
	default 3 if ($(dt_path_enabled,/cpus/cpu@3))
	default 4 if ($(dt_path_enabled,/cpus/cpu@4))

endif
```

## soc/microchip/pic64/pic64gx/Kconfig.soc
```kconfig
# RISCV64 Microchip PIC64GX SOC configuration options

# Copyright (c) 2025 Microchip Technology Inc
# SPDX-License-Identifier: Apache-2.0

config SOC_SERIES_PIC64GX
	bool
	select SOC_FAMILY_MICROCHIP_PIC64
	help
	  Enable support for Microchip PIC64GX SoC.

config SOC_PIC64GX1000
	bool
	select SOC_SERIES_PIC64GX

config SOC_PIC64GX1000_U54
	bool
	select SOC_PIC64GX1000

config SOC_PIC64GX1000_E51
	bool
	select SOC_PIC64GX1000

config SOC_SERIES
	default "pic64gx" if SOC_SERIES_PIC64GX

config SOC
	default "pic64gx1000" if SOC_PIC64GX1000
```

## soc/microchip/sam/Kconfig
```kconfig
# Copyright (C) 2025 Microchip Technology Inc. and its subsidiaries
#
# SPDX-License-Identifier: Apache-2.0
#

config SOC_SERIES_SAMA7G5
	select ARM
	select MICROCHIP_SAM
	select CPU_CORTEX_A7
	select SOC_EARLY_INIT_HOOK
```

## soc/microchip/sam/Kconfig.defconfig
```kconfig
# Copyright (C) 2025 Microchip Technology Inc. and its subsidiaries
#
# SPDX-License-Identifier: Apache-2.0
#

if SOC_FAMILY_MICROCHIP_SAM

rsource "*/Kconfig.defconfig"

config CLOCK_CONTROL
	default y

config MFD
	default y
	depends on DT_HAS_MICROCHIP_SAM_FLEXCOM_ENABLED

endif # SOC_FAMILY_MICROCHIP_SAM
```

## soc/microchip/sam/Kconfig.soc
```kconfig
# Copyright (C) 2025 Microchip Technology Inc. and its subsidiaries
#
# SPDX-License-Identifier: Apache-2.0
#

config SOC_FAMILY_MICROCHIP_SAM
	bool

config SOC_FAMILY
	default "microchip_sam" if SOC_FAMILY_MICROCHIP_SAM

rsource "*/Kconfig.soc"
```

## soc/microchip/sam/sam9/sam9x7/Kconfig.soc
```kconfig
# Copyright (C) 2025 Microchip Technology Inc. and its subsidiaries
#
# SPDX-License-Identifier: Apache-2.0
#

config SOC_SERIES_SAM9X7
	bool
	select SOC_FAMILY_MICROCHIP_SAM9
	help
	  Enable support for Microchip SAM9X7 Microprocessors.

config SOC_SERIES
	default "sam9x7" if SOC_SERIES_SAM9X7

config SOC_SAM9X70
	bool
	select SOC_SERIES_SAM9X7

config SOC_SAM9X72
	bool
	select SOC_SERIES_SAM9X7

config SOC_SAM9X75
	bool
	select SOC_SERIES_SAM9X7

config SOC_SAM9X75D1G
	bool
	select SOC_SAM9X75

config SOC_SAM9X75D1GN2
	bool
	select SOC_SAM9X75

config SOC_SAM9X75D2G
	bool
	select SOC_SAM9X75

config SOC_SAM9X75D2GN4
	bool
	select SOC_SAM9X75

config SOC_SAM9X75D5M
	bool
	select SOC_SAM9X75

config SOC_SAM9X75D5MN0
	bool
	select SOC_SAM9X75

config SOC
	default "sam9x70" if SOC_SAM9X70
	default "sam9x72" if SOC_SAM9X72
	default "sam9x75" if SOC_SAM9X75
	default "sam9x75d1g" if SOC_SAM9X75D1G
	default "sam9x75d1gn2" if SOC_SAM9X75D1GN2
	default "sam9x75d2g" if SOC_SAM9X75D2G
	default "sam9x75d2gn4" if SOC_SAM9X75D2GN4
	default "sam9x75d5m" if SOC_SAM9X75D5M
	default "sam9x75d5mn0" if SOC_SAM9X75D5MN0
```

## soc/microchip/sam/sam_d5x_e5x/Kconfig
```kconfig
# Copyright (c) 2025 Microchip Technology Inc.
# SPDX-License-Identifier: Apache-2.0

config SOC_FAMILY_MICROCHIP_SAM_D5X_E5X
	select ARM
	select MICROCHIP_SAM
	select CPU_CORTEX_M4
	select CPU_CORTEX_M_HAS_DWT
	select CPU_HAS_ARM_MPU
	select CPU_HAS_FPU
	select CLOCK_CONTROL
	select HAS_CMSIS_CORE
	select HAS_SEGGER_RTT if ZEPHYR_SEGGER_MODULE
```

## soc/microchip/sam/sam_d5x_e5x/Kconfig.defconfig
```kconfig
# Copyright (c) 2025 Microchip Technology Inc.
# SPDX-License-Identifier: Apache-2.0

if SOC_FAMILY_MICROCHIP_SAM_D5X_E5X

config NUM_IRQS
	default 137

config ROM_START_OFFSET
	default 0x400 if BOOTLOADER_MCUBOOT

config SYS_CLOCK_HW_CYCLES_PER_SEC
	default $(dt_node_int_prop_int,/cpus/cpu@0,clock-frequency)

endif # SOC_FAMILY_MICROCHIP_SAM_D5X_E5X
```

## soc/microchip/sam/sam_d5x_e5x/Kconfig.soc
```kconfig
# Copyright (c) 2025 Microchip Technology Inc.
# SPDX-License-Identifier: Apache-2.0

config SOC_FAMILY_MICROCHIP_SAM_D5X_E5X
	bool

config SOC_FAMILY
	default "microchip_sam_d5x_e5x" if SOC_FAMILY_MICROCHIP_SAM_D5X_E5X

# List of Peripheral IPs available in SOC_FAMILY_MICROCHIP_SAM_D5X_E5X family
if SOC_FAMILY_MICROCHIP_SAM_D5X_E5X

config PINCTRL_MCHP_PORT_U2210_2_2_0
	bool
	default y
	help
	  Enable PORT pinctrl peripheral IP version 2.2.0 (U2210).

config UART_MCHP_SERCOM_U2201_5_0_0
	bool
	default y
	help
	  Enable SERCOM UART peripheral IP version 5.0.0 (U2201).

endif # SOC_FAMILY_MICROCHIP_SAM_D5X_E5X

rsource "*/Kconfig.soc"
```

## soc/microchip/sam/sam_d5x_e5x/atsamd51/Kconfig.soc
```kconfig
# Copyright (c) 2025 Microchip Technology Inc.
# SPDX-License-Identifier: Apache-2.0

config SOC_SERIES_ATSAMD51
	bool
	select SOC_FAMILY_MICROCHIP_SAM_D5X_E5X
	help
	  Enable support for Microchip SAMD51 Cortex-M4F microcontrollers.

config SOC_SERIES
	default "atsamd51" if SOC_SERIES_ATSAMD51

config SOC_ATSAMD51G18A
	bool
	select SOC_SERIES_ATSAMD51

config SOC_ATSAMD51G19A
	bool
	select SOC_SERIES_ATSAMD51

config SOC_ATSAMD51J18A
	bool
	select SOC_SERIES_ATSAMD51

config SOC_ATSAMD51J19A
	bool
	select SOC_SERIES_ATSAMD51

config SOC_ATSAMD51J20A
	bool
	select SOC_SERIES_ATSAMD51

config SOC_ATSAMD51N19A
	bool
	select SOC_SERIES_ATSAMD51

config SOC_ATSAMD51N20A
	bool
	select SOC_SERIES_ATSAMD51

config SOC_ATSAMD51P19A
	bool
	select SOC_SERIES_ATSAMD51

config SOC_ATSAMD51P20A
	bool
	select SOC_SERIES_ATSAMD51

config SOC
	default "atsamd51g18a" if SOC_ATSAMD51G18A
	default "atsamd51g19a" if SOC_ATSAMD51G19A
	default "atsamd51j18a" if SOC_ATSAMD51J18A
	default "atsamd51j19a" if SOC_ATSAMD51J19A
	default "atsamd51j20a" if SOC_ATSAMD51J20A
	default "atsamd51n19a" if SOC_ATSAMD51N19A
	default "atsamd51n20a" if SOC_ATSAMD51N20A
	default "atsamd51p19a" if SOC_ATSAMD51P19A
	default "atsamd51p20a" if SOC_ATSAMD51P20A
```

## soc/microchip/sam/sam_d5x_e5x/atsame51/Kconfig.soc
```kconfig
# Copyright (c) 2025 Microchip Technology Inc.
# SPDX-License-Identifier: Apache-2.0

config SOC_SERIES_ATSAME51
	bool
	select SOC_FAMILY_MICROCHIP_SAM_D5X_E5X
	help
	  Enable support for Microchip SAME51 Cortex-M4F microcontrollers.

config SOC_SERIES
	default "atsame51" if SOC_SERIES_ATSAME51

config SOC_ATSAME51G18A
	bool
	select SOC_SERIES_ATSAME51

config SOC_ATSAME51G19A
	bool
	select SOC_SERIES_ATSAME51

config SOC_ATSAME51J18A
	bool
	select SOC_SERIES_ATSAME51

config SOC_ATSAME51J19A
	bool
	select SOC_SERIES_ATSAME51

config SOC_ATSAME51J20A
	bool
	select SOC_SERIES_ATSAME51

config SOC_ATSAME51N19A
	bool
	select SOC_SERIES_ATSAME51

config SOC_ATSAME51N20A
	bool
	select SOC_SERIES_ATSAME51

config SOC
	default "atsame51g18a" if SOC_ATSAME51G18A
	default "atsame51g19a" if SOC_ATSAME51G19A
	default "atsame51j18a" if SOC_ATSAME51J18A
	default "atsame51j19a" if SOC_ATSAME51J19A
	default "atsame51j20a" if SOC_ATSAME51J20A
	default "atsame51n19a" if SOC_ATSAME51N19A
	default "atsame51n20a" if SOC_ATSAME51N20A
```

## soc/microchip/sam/sam_d5x_e5x/atsame53/Kconfig.soc
```kconfig
# Copyright (c) 2025 Microchip Technology Inc.
# SPDX-License-Identifier: Apache-2.0

config SOC_SERIES_ATSAME53
	bool
	select SOC_FAMILY_MICROCHIP_SAM_D5X_E5X
	help
	  Enable support for Microchip SAME53 Cortex-M4F microcontrollers.

config SOC_SERIES
	default "atsame53" if SOC_SERIES_ATSAME53

config SOC_ATSAME53J18A
	bool
	select SOC_SERIES_ATSAME53

config SOC_ATSAME53J19A
	bool
	select SOC_SERIES_ATSAME53

config SOC_ATSAME53J20A
	bool
	select SOC_SERIES_ATSAME53

config SOC_ATSAME53N19A
	bool
	select SOC_SERIES_ATSAME53

config SOC_ATSAME53N20A
	bool
	select SOC_SERIES_ATSAME53

config SOC
	default "atsame53j18a" if SOC_ATSAME53J18A
	default "atsame53j19a" if SOC_ATSAME53J19A
	default "atsame53j20a" if SOC_ATSAME53J20A
	default "atsame53n19a" if SOC_ATSAME53N19A
	default "atsame53n20a" if SOC_ATSAME53N20A
```

## soc/microchip/sam/sam_d5x_e5x/atsame54/Kconfig.soc
```kconfig
# Copyright (c) 2025 Microchip Technology Inc.
# SPDX-License-Identifier: Apache-2.0

config SOC_SERIES_ATSAME54
	bool
	select SOC_FAMILY_MICROCHIP_SAM_D5X_E5X
	help
	  Enable support for Microchip SAME54 Cortex-M4F microcontrollers.

config SOC_SERIES
	default "atsame54" if SOC_SERIES_ATSAME54

config SOC_ATSAME54N19A
	bool
	select SOC_SERIES_ATSAME54

config SOC_ATSAME54N20A
	bool
	select SOC_SERIES_ATSAME54

config SOC_ATSAME54P19A
	bool
	select SOC_SERIES_ATSAME54

config SOC_ATSAME54P20A
	bool
	select SOC_SERIES_ATSAME54

config SOC
	default "atsame54n19a" if SOC_ATSAME54N19A
	default "atsame54n20a" if SOC_ATSAME54N20A
	default "atsame54p19a" if SOC_ATSAME54P19A
	default "atsame54p20a" if SOC_ATSAME54P20A
```

## soc/microchip/sam/sama5/Kconfig
```kconfig
# Copyright (C) 2026 Microchip Technology Inc.
#
# SPDX-License-Identifier: Apache-2.0
#

config SOC_FAMILY_MICROCHIP_SAMA5
	select MICROCHIP_SAM
	select ARM
	select CPU_CORTEX_A5
	select MMU
	select CACHE_MANAGEMENT
	select ARM_CUSTOM_INTERRUPT_CONTROLLER
```

## soc/microchip/sam/sama5/Kconfig.defconfig
```kconfig
# Copyright (C) 2026 Microchip Technology Inc.
#
# SPDX-License-Identifier: Apache-2.0
#

if SOC_FAMILY_MICROCHIP_SAMA5

configdefault SOC_EARLY_INIT_HOOK
	default y

configdefault CLOCK_CONTROL
	default y

endif # SOC_FAMILY_MICROCHIP_SAMA5

rsource "*/Kconfig.defconfig"
```

## soc/microchip/sam/sama5/Kconfig.soc
```kconfig
# Copyright (C) 2026 Microchip Technology Inc.
#
# SPDX-License-Identifier: Apache-2.0
#

config SOC_FAMILY_MICROCHIP_SAMA5
	bool
	help
	  Enable support for Microchip SAMA5 Cortex-A Microprocessors.

config SOC_FAMILY
	default "microchip_sama5" if SOC_FAMILY_MICROCHIP_SAMA5

rsource "*/Kconfig.soc"
```

## soc/microchip/sam/sama5/sama5d2/Kconfig.defconfig
```kconfig
# Copyright (C) 2026 Microchip Technology Inc.
#
# SPDX-License-Identifier: Apache-2.0
#

if SOC_SERIES_SAMA5D2

configdefault NUM_IRQS
	default 110

configdefault SYS_CLOCK_HW_CYCLES_PER_SEC
	default $(dt_node_int_prop_int,/soc/timer@f8048030,clock-frequency)

configdefault SYS_CLOCK_TICKS_PER_SEC
	default 1000

endif # SOC_SERIES_SAMA5D2
```

## soc/microchip/sam/sama5/sama5d2/Kconfig.soc
```kconfig
# Copyright (C) 2026 Microchip Technology Inc.
#
# SPDX-License-Identifier: Apache-2.0
#

config SOC_SERIES_SAMA5D2
	bool
	select SOC_FAMILY_MICROCHIP_SAMA5
	help
	  Enable support for Microchip SAMA5D2 Cortex-A Microprocessors.

config SOC_SERIES_SAMA5D27SOM
	bool
	select SOC_SERIES_SAMA5D2
	help
	  Enable support for Microchip SAMA5D2 System-On-Module (SOM).

config SOC_SERIES_SAMA5D29
	bool
	select SOC_SERIES_SAMA5D2
	help
	  Enable support for Microchip SAMA5D29 Cortex-A Microprocessors.

config SOC_SERIES
	default "sama5d2" if SOC_SERIES_SAMA5D2

config SOC_SAMA5D21
	bool
	select SOC_SERIES_SAMA5D2

config SOC_SAMA5D22
	bool
	select SOC_SERIES_SAMA5D2

config SOC_SAMA5D225CD1M
	bool
	select SOC_SERIES_SAMA5D2

config SOC_SAMA5D23
	bool
	select SOC_SERIES_SAMA5D2

config SOC_SAMA5D24
	bool
	select SOC_SERIES_SAMA5D2

config SOC_SAMA5D26
	bool
	select SOC_SERIES_SAMA5D2

config SOC_SAMA5D27
	bool
	select SOC_SERIES_SAMA5D2

config SOC_SAMA5D27CD1G
	bool
	select SOC_SERIES_SAMA5D2

config SOC_SAMA5D27CD5M
	bool
	select SOC_SERIES_SAMA5D2

config SOC_SAMA5D27CLD1G
	bool
	select SOC_SERIES_SAMA5D2

config SOC_SAMA5D27CLD2G
	bool
	select SOC_SERIES_SAMA5D2

config SOC_SAMA5D28
	bool
	select SOC_SERIES_SAMA5D2

config SOC_SAMA5D28CD1G
	bool
	select SOC_SERIES_SAMA5D2

config SOC_SAMA5D28CLD1G
	bool
	select SOC_SERIES_SAMA5D2

config SOC_SAMA5D28CLD2G
	bool
	select SOC_SERIES_SAMA5D2

config SOC_SAMA5D27SOM1
	bool
	select SOC_SERIES_SAMA5D27SOM

config SOC_SAMA5D27WLSOM1
	bool
	select SOC_SERIES_SAMA5D27SOM

config SOC_SAMA5D29
	bool
	select SOC_SERIES_SAMA5D29

config SOC_SAMA5D29TA100
	bool
	select SOC_SERIES_SAMA5D29

config SOC
	default"sama5d21" if SOC_SAMA5D21
	default"sama5d22" if SOC_SAMA5D22
	default"sama5d225cd1m" if SOC_SAMA5D225CD1M
	default"sama5d23" if SOC_SAMA5D23
	default"sama5d24" if SOC_SAMA5D24
	default"sama5d26" if SOC_SAMA5D26
	default"sama5d27" if SOC_SAMA5D27
	default"sama5d27cd1g" if SOC_SAMA5D27CD1G
	default"sama5d27cd5m" if SOC_SAMA5D27CD5M
	default"sama5d27cld1g" if SOC_SAMA5D27CLD1G
	default"sama5d27cld2g" if SOC_SAMA5D27CLD2G
	default"sama5d28" if SOC_SAMA5D28
	default"sama5d28cd1g" if SOC_SAMA5D28CD1G
	default"sama5d28cld1g" if SOC_SAMA5D28CLD1G
	default"sama5d28cld2g" if SOC_SAMA5D28CLD2G
	default"sama5d27som1" if SOC_SAMA5D27SOM1
	default"sama5d27wlsom1" if SOC_SAMA5D27WLSOM1
	default"sama5d29" if SOC_SAMA5D29
	default"sama5d29ta100" if SOC_SAMA5D29TA100
```

## soc/microchip/sam/sama7/Kconfig
```kconfig
# Copyright (C) 2025 Microchip Technology Inc. and its subsidiaries
#
# SPDX-License-Identifier: Apache-2.0
#

config SOC_FAMILY_MICROCHIP_SAMA7
	select MICROCHIP_SAM
	select ARM
	select CPU_CORTEX_A7
	select MMU
	select CACHE_MANAGEMENT
```

## soc/microchip/sam/sama7/Kconfig.defconfig
```kconfig
# Copyright (C) 2025 Microchip Technology Inc. and its subsidiaries
#
# SPDX-License-Identifier: Apache-2.0
#

if SOC_FAMILY_MICROCHIP_SAMA7

configdefault SOC_EARLY_INIT_HOOK
	default y

configdefault CLOCK_CONTROL
	default y

endif # SOC_FAMILY_MICROCHIP_SAMA7

rsource "*/Kconfig.defconfig"
```

## soc/microchip/sam/sama7/Kconfig.soc
```kconfig
# Copyright (C) 2025 Microchip Technology Inc. and its subsidiaries
#
# SPDX-License-Identifier: Apache-2.0
#

config SOC_FAMILY_MICROCHIP_SAMA7
	bool
	help
	  Enable support for Microchip SAMA7 Cortex-A Microprocessors.

config SOC_FAMILY
	default "microchip_sama7" if SOC_FAMILY_MICROCHIP_SAMA7

rsource "*/Kconfig.soc"
```

## soc/microchip/sam/sama7/sama7d6/Kconfig.defconfig
```kconfig
# Copyright (C) 2025 Microchip Technology Inc. and its subsidiaries
#
# SPDX-License-Identifier: Apache-2.0
#

if SOC_SERIES_SAMA7D6

configdefault NUM_IRQS
	default 189

configdefault SYS_CLOCK_HW_CYCLES_PER_SEC
	default $(dt_node_int_prop_int,/soc/timer@e1800000,clock-frequency)

endif # SOC_SERIES_SAMA7D6
```
