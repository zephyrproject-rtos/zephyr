## soc/nxp/mcx/mcxa/Kconfig.soc
```kconfig
# Copyright 2024-2026 NXP
# SPDX-License-Identifier: Apache-2.0

config SOC_FAMILY_MCXA
	bool

config SOC_FAMILY
	default "mcxa" if SOC_FAMILY_MCXA

config SOC_SERIES_MCXA1X3
	bool
	select SOC_FAMILY_MCXA

config SOC_SERIES_MCXA1X6
	bool
	select SOC_FAMILY_MCXA

config SOC_SERIES_MCXAXX6
	bool
	select SOC_FAMILY_MCXA

config SOC_SERIES_MCXAXX4
	bool
	select SOC_FAMILY_MCXA

config SOC_SERIES_MCXAXX7
	bool
	select SOC_FAMILY_MCXA

config SOC_SERIES
	default "mcxa1x3" if SOC_SERIES_MCXA1X3
	default "mcxa1x6" if SOC_SERIES_MCXA1X6
	default "mcxaxx6" if SOC_SERIES_MCXAXX6
	default "mcxaxx4" if SOC_SERIES_MCXAXX4
	default "mcxaxx7" if SOC_SERIES_MCXAXX7

config SOC_MCXA153
	bool
	select SOC_SERIES_MCXA1X3

config SOC_MCXA144
	bool
	select SOC_SERIES_MCXA1X6

config SOC_MCXA145
	bool
	select SOC_SERIES_MCXA1X6

config SOC_MCXA146
	bool
	select SOC_SERIES_MCXA1X6

config SOC_MCXA154
	bool
	select SOC_SERIES_MCXA1X6

config SOC_MCXA155
	bool
	select SOC_SERIES_MCXA1X6

config SOC_MCXA156
	bool
	select SOC_SERIES_MCXA1X6

config SOC_MCXA175
	bool
	select SOC_SERIES_MCXAXX6

config SOC_MCXA176
	bool
	select SOC_SERIES_MCXAXX6

config SOC_MCXA185
	bool
	select SOC_SERIES_MCXAXX6

config SOC_MCXA186
	bool
	select SOC_SERIES_MCXAXX6

config SOC_MCXA255
	bool
	select SOC_SERIES_MCXAXX6

config SOC_MCXA256
	bool
	select SOC_SERIES_MCXAXX6

config SOC_MCXA265
	bool
	select SOC_SERIES_MCXAXX6

config SOC_MCXA345
	bool
	select SOC_SERIES_MCXAXX6

config SOC_MCXA355
	bool
	select SOC_SERIES_MCXAXX6

config SOC_MCXA356
	bool
	select SOC_SERIES_MCXAXX6

config SOC_MCXA365
	bool
	select SOC_SERIES_MCXAXX6

config SOC_MCXA346
	bool
	select SOC_SERIES_MCXAXX6

config SOC_MCXA266
	bool
	select SOC_SERIES_MCXAXX6

config SOC_MCXA366
	bool
	select SOC_SERIES_MCXAXX6

config SOC_MCXA537
	bool
	select SOC_SERIES_MCXAXX7

config SOC_MCXA536
	bool
	select SOC_SERIES_MCXAXX7

config SOC_MCXA557
	bool
	select SOC_SERIES_MCXAXX7

config SOC_MCXA556
	bool
	select SOC_SERIES_MCXAXX7

config SOC_MCXA567
	bool
	select SOC_SERIES_MCXAXX7

config SOC_MCXA566
	bool
	select SOC_SERIES_MCXAXX7

config SOC_MCXA577
	bool
	select SOC_SERIES_MCXAXX7

config SOC_MCXA457
	bool
	select SOC_SERIES_MCXAXX7

config SOC_MCXA456
	bool
	select SOC_SERIES_MCXAXX7

config SOC_MCXA287
	bool
	select SOC_SERIES_MCXAXX7

config SOC_MCXA286
	bool
	select SOC_SERIES_MCXAXX7

config SOC_MCXA344
	bool
	select SOC_SERIES_MCXAXX4

config SOC
	default "mcxa153" if SOC_MCXA153
	default "mcxa144" if SOC_MCXA144
	default "mcxa145" if SOC_MCXA145
	default "mcxa146" if SOC_MCXA146
	default "mcxa154" if SOC_MCXA154
	default "mcxa155" if SOC_MCXA155
	default "mcxa156" if SOC_MCXA156
	default "mcxa175" if SOC_MCXA175
	default "mcxa176" if SOC_MCXA176
	default "mcxa185" if SOC_MCXA185
	default "mcxa186" if SOC_MCXA186
	default "mcxa255" if SOC_MCXA255
	default "mcxa256" if SOC_MCXA256
	default "mcxa265" if SOC_MCXA265
	default "mcxa345" if SOC_MCXA345
	default "mcxa355" if SOC_MCXA355
	default "mcxa356" if SOC_MCXA356
	default "mcxa365" if SOC_MCXA365
	default "mcxa346" if SOC_MCXA346
	default "mcxa266" if SOC_MCXA266
	default "mcxa366" if SOC_MCXA366
	default "mcxa344" if SOC_MCXA344
	default "mcxa537" if SOC_MCXA537
	default "mcxa536" if SOC_MCXA536
	default "mcxa557" if SOC_MCXA557
	default "mcxa556" if SOC_MCXA556
	default "mcxa567" if SOC_MCXA567
	default "mcxa566" if SOC_MCXA566
	default "mcxa577" if SOC_MCXA577
	default "mcxa457" if SOC_MCXA457
	default "mcxa456" if SOC_MCXA456
	default "mcxa287" if SOC_MCXA287
	default "mcxa286" if SOC_MCXA286

config SOC_PART_NUMBER_MCXA153VFM
	bool
	select SOC_MCXA153

config SOC_PART_NUMBER_MCXA153VFT
	bool
	select SOC_MCXA153

config SOC_PART_NUMBER_MCXA153VLF
	bool
	select SOC_MCXA153

config SOC_PART_NUMBER_MCXA153VLH
	bool
	select SOC_MCXA153

config SOC_PART_NUMBER_MCXA144VPJ
	bool
	select SOC_MCXA144

config SOC_PART_NUMBER_MCXA144VLL
	bool
	select SOC_MCXA144

config SOC_PART_NUMBER_MCXA144VMP
	bool
	select SOC_MCXA144

config SOC_PART_NUMBER_MCXA144VFT
	bool
	select SOC_MCXA144

config SOC_PART_NUMBER_MCXA144VLH
	bool
	select SOC_MCXA144

config SOC_PART_NUMBER_MCXA145VPJ
	bool
	select SOC_MCXA145

config SOC_PART_NUMBER_MCXA145VLL
	bool
	select SOC_MCXA145

config SOC_PART_NUMBER_MCXA145VMP
	bool
	select SOC_MCXA145

config SOC_PART_NUMBER_MCXA145VFT
	bool
	select SOC_MCXA145

config SOC_PART_NUMBER_MCXA145VLH
	bool
	select SOC_MCXA145

config SOC_PART_NUMBER_MCXA146VPJ
	bool
	select SOC_MCXA146

config SOC_PART_NUMBER_MCXA146VLL
	bool
	select SOC_MCXA146

config SOC_PART_NUMBER_MCXA146VMP
	bool
	select SOC_MCXA146

config SOC_PART_NUMBER_MCXA146VFT
	bool
	select SOC_MCXA146

config SOC_PART_NUMBER_MCXA146VLH
	bool
	select SOC_MCXA146

config SOC_PART_NUMBER_MCXA154VPJ
	bool
	select SOC_MCXA154

config SOC_PART_NUMBER_MCXA154VLL
	bool
	select SOC_MCXA154

config SOC_PART_NUMBER_MCXA154VMP
	bool
	select SOC_MCXA154

config SOC_PART_NUMBER_MCXA154VFT
	bool
	select SOC_MCXA154

config SOC_PART_NUMBER_MCXA154VLH
	bool
	select SOC_MCXA154

config SOC_PART_NUMBER_MCXA155VPJ
	bool
	select SOC_MCXA155

config SOC_PART_NUMBER_MCXA155VLL
	bool
	select SOC_MCXA155

config SOC_PART_NUMBER_MCXA155VMP
	bool
	select SOC_MCXA155

config SOC_PART_NUMBER_MCXA155VFT
	bool
	select SOC_MCXA155

config SOC_PART_NUMBER_MCXA155VLH
	bool
	select SOC_MCXA155

config SOC_PART_NUMBER_MCXA156VPJ
	bool
	select SOC_MCXA156

config SOC_PART_NUMBER_MCXA156VLL
	bool
	select SOC_MCXA156

config SOC_PART_NUMBER_MCXA156VMP
	bool
	select SOC_MCXA156

config SOC_PART_NUMBER_MCXA156VFT
	bool
	select SOC_MCXA156

config SOC_PART_NUMBER_MCXA156VLH
	bool
	select SOC_MCXA156

config SOC_PART_NUMBER_MCXA175VLQ
	bool
	select SOC_MCXA175

config SOC_PART_NUMBER_MCXA175VLL
	bool
	select SOC_MCXA175

config SOC_PART_NUMBER_MCXA175VLH
	bool
	select SOC_MCXA175

config SOC_PART_NUMBER_MCXA175VPN
	bool
	select SOC_MCXA175

config SOC_PART_NUMBER_MCXA176VLQ
	bool
	select SOC_MCXA176

config SOC_PART_NUMBER_MCXA176VLL
	bool
	select SOC_MCXA176

config SOC_PART_NUMBER_MCXA176VLH
	bool
	select SOC_MCXA176

config SOC_PART_NUMBER_MCXA176VPN
	bool
	select SOC_MCXA176

config SOC_PART_NUMBER_MCXA185VLQ
	bool
	select SOC_MCXA185

config SOC_PART_NUMBER_MCXA185VLL
	bool
	select SOC_MCXA185

config SOC_PART_NUMBER_MCXA185VLH
	bool
	select SOC_MCXA185

config SOC_PART_NUMBER_MCXA185VPN
	bool
	select SOC_MCXA185

config SOC_PART_NUMBER_MCXA186VLQ
	bool
	select SOC_MCXA186

config SOC_PART_NUMBER_MCXA186VLL
	bool
	select SOC_MCXA186

config SOC_PART_NUMBER_MCXA186VLH
	bool
	select SOC_MCXA186

config SOC_PART_NUMBER_MCXA186VPN
	bool
	select SOC_MCXA186

config SOC_PART_NUMBER_MCXA255VLQ
	bool
	select SOC_MCXA255

config SOC_PART_NUMBER_MCXA255VLL
	bool
	select SOC_MCXA255

config SOC_PART_NUMBER_MCXA255VLH
	bool
	select SOC_MCXA255

config SOC_PART_NUMBER_MCXA255VPN
	bool
	select SOC_MCXA255

config SOC_PART_NUMBER_MCXA256VLQ
	bool
	select SOC_MCXA256

config SOC_PART_NUMBER_MCXA256VLL
	bool
	select SOC_MCXA256

config SOC_PART_NUMBER_MCXA256VLH
	bool
	select SOC_MCXA256

config SOC_PART_NUMBER_MCXA256VPN
	bool
	select SOC_MCXA256

config SOC_PART_NUMBER_MCXA265VLQ
	bool
	select SOC_MCXA265

config SOC_PART_NUMBER_MCXA265VLL
	bool
	select SOC_MCXA265

config SOC_PART_NUMBER_MCXA265VLH
	bool
	select SOC_MCXA265

config SOC_PART_NUMBER_MCXA265VPN
	bool
	select SOC_MCXA265

config SOC_PART_NUMBER_MCXA345VLQ
	bool
	select SOC_MCXA345

config SOC_PART_NUMBER_MCXA345VLL
	bool
	select SOC_MCXA345

config SOC_PART_NUMBER_MCXA345VLH
	bool
	select SOC_MCXA345

config SOC_PART_NUMBER_MCXA345VPN
	bool
	select SOC_MCXA345

config SOC_PART_NUMBER_MCXA355VLQ
	bool
	select SOC_MCXA355

config SOC_PART_NUMBER_MCXA355VLL
	bool
	select SOC_MCXA355

config SOC_PART_NUMBER_MCXA355VLH
	bool
	select SOC_MCXA355

config SOC_PART_NUMBER_MCXA355VPN
	bool
	select SOC_MCXA355

config SOC_PART_NUMBER_MCXA356VLQ
	bool
	select SOC_MCXA356

config SOC_PART_NUMBER_MCXA356VLL
	bool
	select SOC_MCXA356

config SOC_PART_NUMBER_MCXA356VLH
	bool
	select SOC_MCXA356

config SOC_PART_NUMBER_MCXA356VPN
	bool
	select SOC_MCXA356

config SOC_PART_NUMBER_MCXA365VLQ
	bool
	select SOC_MCXA365

config SOC_PART_NUMBER_MCXA365VLL
	bool
	select SOC_MCXA365

config SOC_PART_NUMBER_MCXA365VLH
	bool
	select SOC_MCXA365

config SOC_PART_NUMBER_MCXA365VPN
	bool
	select SOC_MCXA365

config SOC_PART_NUMBER_MCXA346VLQ
	bool
	select SOC_MCXA346

config SOC_PART_NUMBER_MCXA346VLL
	bool
	select SOC_MCXA346

config SOC_PART_NUMBER_MCXA346VLH
	bool
	select SOC_MCXA346

config SOC_PART_NUMBER_MCXA346VPN
	bool
	select SOC_MCXA346

config SOC_PART_NUMBER_MCXA266VLQ
	bool
	select SOC_MCXA266

config SOC_PART_NUMBER_MCXA266VLL
	bool
	select SOC_MCXA266

config SOC_PART_NUMBER_MCXA266VLH
	bool
	select SOC_MCXA266

config SOC_PART_NUMBER_MCXA266VPN
	bool
	select SOC_MCXA266

config SOC_PART_NUMBER_MCXA366VLQ
	bool
	select SOC_MCXA366

config SOC_PART_NUMBER_MCXA366VLL
	bool
	select SOC_MCXA366

config SOC_PART_NUMBER_MCXA366VLH
	bool
	select SOC_MCXA366

config SOC_PART_NUMBER_MCXA366VPN
	bool
	select SOC_MCXA366

config SOC_PART_NUMBER_MCXA344VFM
	bool
	select SOC_MCXA344

config SOC_PART_NUMBER_MCXA344VLF
	bool
	select SOC_MCXA344

config SOC_PART_NUMBER_MCXA344VLH
	bool
	select SOC_MCXA344

config SOC_PART_NUMBER_MCXA344VLL
	bool
	select SOC_MCXA344

config SOC_PART_NUMBER_MCXA577VLQ
	bool
	select SOC_MCXA577

config SOC_PART_NUMBER_MCXA537VLQ
	bool
	select SOC_MCXA537

config SOC_PART_NUMBER_MCXA537VLL
	bool
	select SOC_MCXA537

config SOC_PART_NUMBER_MCXA537VPN
	bool
	select SOC_MCXA537

config SOC_PART_NUMBER_MCXA536VLQ
	bool
	select SOC_MCXA536

config SOC_PART_NUMBER_MCXA536VLL
	bool
	select SOC_MCXA536

config SOC_PART_NUMBER_MCXA536VPN
	bool
	select SOC_MCXA536

config SOC_PART_NUMBER_MCXA567VLQ
	bool
	select SOC_MCXA567

config SOC_PART_NUMBER_MCXA567VLL
	bool
	select SOC_MCXA567

config SOC_PART_NUMBER_MCXA567VPN
	bool
	select SOC_MCXA567

config SOC_PART_NUMBER_MCXA567VASR
	bool
	select SOC_MCXA567

config SOC_PART_NUMBER_MCXA567VAPR
	bool
	select SOC_MCXA567

config SOC_PART_NUMBER_MCXA566VLQ
	bool
	select SOC_MCXA566

config SOC_PART_NUMBER_MCXA566VLL
	bool
	select SOC_MCXA566

config SOC_PART_NUMBER_MCXA566VPN
	bool
	select SOC_MCXA566

config SOC_PART_NUMBER_MCXA557VPN
	bool
	select SOC_MCXA557

config SOC_PART_NUMBER_MCXA557BVPN
	bool
	select SOC_MCXA557

config SOC_PART_NUMBER_MCXA556VPN
	bool
	select SOC_MCXA556

config SOC_PART_NUMBER_MCXA556BVPN
	bool
	select SOC_MCXA556

config SOC_PART_NUMBER_MCXA577VLL
	bool
	select SOC_MCXA577

config SOC_PART_NUMBER_MCXA577VPN
	bool
	select SOC_MCXA577

config SOC_PART_NUMBER_MCXA577VASR
	bool
	select SOC_MCXA577

config SOC_PART_NUMBER_MCXA577VAPR
	bool
	select SOC_MCXA577

config SOC_PART_NUMBER_MCXA457VLQ
	bool
	select SOC_MCXA457

config SOC_PART_NUMBER_MCXA457VLL
	bool
	select SOC_MCXA457

config SOC_PART_NUMBER_MCXA457VPN
	bool
	select SOC_MCXA457

config SOC_PART_NUMBER_MCXA457VASR
	bool
	select SOC_MCXA457

config SOC_PART_NUMBER_MCXA456VLQ
	bool
	select SOC_MCXA456

config SOC_PART_NUMBER_MCXA456VLL
	bool
	select SOC_MCXA456

config SOC_PART_NUMBER_MCXA456VPN
	bool
	select SOC_MCXA456

config SOC_PART_NUMBER_MCXA287VLQ
	bool
	select SOC_MCXA287

config SOC_PART_NUMBER_MCXA287VLL
	bool
	select SOC_MCXA287

config SOC_PART_NUMBER_MCXA287VPN
	bool
	select SOC_MCXA287

config SOC_PART_NUMBER_MCXA287VASR
	bool
	select SOC_MCXA287

config SOC_PART_NUMBER_MCXA287VAPR
	bool
	select SOC_MCXA287

config SOC_PART_NUMBER_MCXA286VLQ
	bool
	select SOC_MCXA286

config SOC_PART_NUMBER_MCXA286VLL
	bool
	select SOC_MCXA286

config SOC_PART_NUMBER_MCXA286VPN
	bool
	select SOC_MCXA286

config SOC_PART_NUMBER_MCXA286VASR
	bool
	select SOC_MCXA286

config SOC_PART_NUMBER_MCXA286VAPR
	bool
	select SOC_MCXA286

config SOC_PART_NUMBER
	default "MCXA153VFM" if SOC_PART_NUMBER_MCXA153VFM
	default "MCXA153VFT" if SOC_PART_NUMBER_MCXA153VFT
	default "MCXA153VLF" if SOC_PART_NUMBER_MCXA153VLF
	default "MCXA153VLH" if SOC_PART_NUMBER_MCXA153VLH
	default "MCXA144VPJ" if SOC_PART_NUMBER_MCXA144VPJ
	default "MCXA144VLL" if SOC_PART_NUMBER_MCXA144VLL
	default "MCXA144VMP" if SOC_PART_NUMBER_MCXA144VMP
	default "MCXA144VFT" if SOC_PART_NUMBER_MCXA144VFT
	default "MCXA144VLH" if SOC_PART_NUMBER_MCXA144VLH
	default "MCXA145VPJ" if SOC_PART_NUMBER_MCXA145VPJ
	default "MCXA145VLL" if SOC_PART_NUMBER_MCXA145VLL
	default "MCXA145VMP" if SOC_PART_NUMBER_MCXA145VMP
	default "MCXA145VFT" if SOC_PART_NUMBER_MCXA145VFT
	default "MCXA145VLH" if SOC_PART_NUMBER_MCXA145VLH
	default "MCXA146VPJ" if SOC_PART_NUMBER_MCXA146VPJ
	default "MCXA146VLL" if SOC_PART_NUMBER_MCXA146VLL
	default "MCXA146VMP" if SOC_PART_NUMBER_MCXA146VMP
	default "MCXA146VFT" if SOC_PART_NUMBER_MCXA146VFT
	default "MCXA146VLH" if SOC_PART_NUMBER_MCXA146VLH
	default "MCXA154VPJ" if SOC_PART_NUMBER_MCXA154VPJ
	default "MCXA154VLL" if SOC_PART_NUMBER_MCXA154VLL
	default "MCXA154VMP" if SOC_PART_NUMBER_MCXA154VMP
	default "MCXA154VFT" if SOC_PART_NUMBER_MCXA154VFT
	default "MCXA154VLH" if SOC_PART_NUMBER_MCXA154VLH
	default "MCXA155VPJ" if SOC_PART_NUMBER_MCXA155VPJ
	default "MCXA155VLL" if SOC_PART_NUMBER_MCXA155VLL
	default "MCXA155VMP" if SOC_PART_NUMBER_MCXA155VMP
	default "MCXA155VFT" if SOC_PART_NUMBER_MCXA155VFT
	default "MCXA155VLH" if SOC_PART_NUMBER_MCXA155VLH
	default "MCXA156VPJ" if SOC_PART_NUMBER_MCXA156VPJ
	default "MCXA156VLL" if SOC_PART_NUMBER_MCXA156VLL
	default "MCXA156VMP" if SOC_PART_NUMBER_MCXA156VMP
	default "MCXA156VFT" if SOC_PART_NUMBER_MCXA156VFT
	default "MCXA156VLH" if SOC_PART_NUMBER_MCXA156VLH
	default "MCXA175VLQ" if SOC_PART_NUMBER_MCXA175VLQ
	default "MCXA175VLL" if SOC_PART_NUMBER_MCXA175VLL
	default "MCXA175VLH" if SOC_PART_NUMBER_MCXA175VLH
	default "MCXA175VPN" if SOC_PART_NUMBER_MCXA175VPN
	default "MCXA176VLQ" if SOC_PART_NUMBER_MCXA176VLQ
	default "MCXA176VLL" if SOC_PART_NUMBER_MCXA176VLL
	default "MCXA176VLH" if SOC_PART_NUMBER_MCXA176VLH
	default "MCXA176VPN" if SOC_PART_NUMBER_MCXA176VPN
	default "MCXA185VLQ" if SOC_PART_NUMBER_MCXA185VLQ
	default "MCXA185VLL" if SOC_PART_NUMBER_MCXA185VLL
	default "MCXA185VLH" if SOC_PART_NUMBER_MCXA185VLH
	default "MCXA185VPN" if SOC_PART_NUMBER_MCXA185VPN
	default "MCXA186VLQ" if SOC_PART_NUMBER_MCXA186VLQ
	default "MCXA186VLL" if SOC_PART_NUMBER_MCXA186VLL
	default "MCXA186VLH" if SOC_PART_NUMBER_MCXA186VLH
	default "MCXA186VPN" if SOC_PART_NUMBER_MCXA186VPN
	default "MCXA255VLQ" if SOC_PART_NUMBER_MCXA255VLQ
	default "MCXA255VLL" if SOC_PART_NUMBER_MCXA255VLL
	default "MCXA255VLH" if SOC_PART_NUMBER_MCXA255VLH
	default "MCXA255VPN" if SOC_PART_NUMBER_MCXA255VPN
	default "MCXA256VLQ" if SOC_PART_NUMBER_MCXA256VLQ
	default "MCXA256VLL" if SOC_PART_NUMBER_MCXA256VLL
	default "MCXA256VLH" if SOC_PART_NUMBER_MCXA256VLH
	default "MCXA256VPN" if SOC_PART_NUMBER_MCXA256VPN
	default "MCXA265VLQ" if SOC_PART_NUMBER_MCXA265VLQ
	default "MCXA265VLL" if SOC_PART_NUMBER_MCXA265VLL
	default "MCXA265VLH" if SOC_PART_NUMBER_MCXA265VLH
	default "MCXA265VPN" if SOC_PART_NUMBER_MCXA265VPN
	default "MCXA345VLQ" if SOC_PART_NUMBER_MCXA345VLQ
	default "MCXA345VLL" if SOC_PART_NUMBER_MCXA345VLL
	default "MCXA345VLH" if SOC_PART_NUMBER_MCXA345VLH
	default "MCXA345VPN" if SOC_PART_NUMBER_MCXA345VPN
	default "MCXA355VLQ" if SOC_PART_NUMBER_MCXA355VLQ
	default "MCXA355VLL" if SOC_PART_NUMBER_MCXA355VLL
	default "MCXA355VLH" if SOC_PART_NUMBER_MCXA355VLH
	default "MCXA355VPN" if SOC_PART_NUMBER_MCXA355VPN
	default "MCXA356VLQ" if SOC_PART_NUMBER_MCXA356VLQ
	default "MCXA356VLL" if SOC_PART_NUMBER_MCXA356VLL
	default "MCXA356VLH" if SOC_PART_NUMBER_MCXA356VLH
	default "MCXA356VPN" if SOC_PART_NUMBER_MCXA356VPN
	default "MCXA365VLQ" if SOC_PART_NUMBER_MCXA365VLQ
	default "MCXA365VLL" if SOC_PART_NUMBER_MCXA365VLL
	default "MCXA365VLH" if SOC_PART_NUMBER_MCXA365VLH
	default "MCXA365VPN" if SOC_PART_NUMBER_MCXA365VPN
	default "MCXA346VLQ" if SOC_PART_NUMBER_MCXA346VLQ
	default "MCXA346VLL" if SOC_PART_NUMBER_MCXA346VLL
	default "MCXA346VLH" if SOC_PART_NUMBER_MCXA346VLH
	default "MCXA346VPN" if SOC_PART_NUMBER_MCXA346VPN
	default "MCXA266VLQ" if SOC_PART_NUMBER_MCXA266VLQ
	default "MCXA266VLL" if SOC_PART_NUMBER_MCXA266VLL
	default "MCXA266VLH" if SOC_PART_NUMBER_MCXA266VLH
	default "MCXA266VPN" if SOC_PART_NUMBER_MCXA266VPN
	default "MCXA366VLQ" if SOC_PART_NUMBER_MCXA366VLQ
	default "MCXA366VLL" if SOC_PART_NUMBER_MCXA366VLL
	default "MCXA366VLH" if SOC_PART_NUMBER_MCXA366VLH
	default "MCXA366VPN" if SOC_PART_NUMBER_MCXA366VPN
	default "MCXA537VLQ" if SOC_PART_NUMBER_MCXA537VLQ
	default "MCXA537VLL" if SOC_PART_NUMBER_MCXA537VLL
	default "MCXA537VPN" if SOC_PART_NUMBER_MCXA537VPN
	default "MCXA536VLQ" if SOC_PART_NUMBER_MCXA536VLQ
	default "MCXA536VLL" if SOC_PART_NUMBER_MCXA536VLL
	default "MCXA536VPN" if SOC_PART_NUMBER_MCXA536VPN
	default "MCXA567VLQ" if SOC_PART_NUMBER_MCXA567VLQ
	default "MCXA567VLL" if SOC_PART_NUMBER_MCXA567VLL
	default "MCXA567VPN" if SOC_PART_NUMBER_MCXA567VPN
	default "MCXA567VASR" if SOC_PART_NUMBER_MCXA567VASR
	default "MCXA567VAPR" if SOC_PART_NUMBER_MCXA567VAPR
	default "MCXA566VLQ" if SOC_PART_NUMBER_MCXA566VLQ
	default "MCXA566VLL" if SOC_PART_NUMBER_MCXA566VLL
	default "MCXA566VPN" if SOC_PART_NUMBER_MCXA566VPN
	default "MCXA557VPN" if SOC_PART_NUMBER_MCXA557VPN
	default "MCXA557BVPN" if SOC_PART_NUMBER_MCXA557BVPN
	default "MCXA556VPN" if SOC_PART_NUMBER_MCXA556VPN
	default "MCXA556BVPN" if SOC_PART_NUMBER_MCXA556BVPN
	default "MCXA577VLL" if SOC_PART_NUMBER_MCXA577VLL
	default "MCXA577VLQ" if SOC_PART_NUMBER_MCXA577VLQ
	default "MCXA577VPN" if SOC_PART_NUMBER_MCXA577VPN
	default "MCXA577VASR" if SOC_PART_NUMBER_MCXA577VASR
	default "MCXA577VAPR" if SOC_PART_NUMBER_MCXA577VAPR
	default "MCXA457VLQ" if SOC_PART_NUMBER_MCXA457VLQ
	default "MCXA457VLL" if SOC_PART_NUMBER_MCXA457VLL
	default "MCXA457VPN" if SOC_PART_NUMBER_MCXA457VPN
	default "MCXA457VASR" if SOC_PART_NUMBER_MCXA457VASR
	default "MCXA456VLQ" if SOC_PART_NUMBER_MCXA456VLQ
	default "MCXA456VLL" if SOC_PART_NUMBER_MCXA456VLL
	default "MCXA456VPN" if SOC_PART_NUMBER_MCXA456VPN
	default "MCXA287VLQ" if SOC_PART_NUMBER_MCXA287VLQ
	default "MCXA287VLL" if SOC_PART_NUMBER_MCXA287VLL
	default "MCXA287VPN" if SOC_PART_NUMBER_MCXA287VPN
	default "MCXA287VASR" if SOC_PART_NUMBER_MCXA287VASR
	default "MCXA287VAPR" if SOC_PART_NUMBER_MCXA287VAPR
	default "MCXA286VLQ" if SOC_PART_NUMBER_MCXA286VLQ
	default "MCXA286VLL" if SOC_PART_NUMBER_MCXA286VLL
	default "MCXA286VPN" if SOC_PART_NUMBER_MCXA286VPN
	default "MCXA286VASR" if SOC_PART_NUMBER_MCXA286VASR
	default "MCXA286VAPR" if SOC_PART_NUMBER_MCXA286VAPR
	default "MCXA344VFM" if SOC_PART_NUMBER_MCXA344VFM
	default "MCXA344VLF" if SOC_PART_NUMBER_MCXA344VLF
	default "MCXA344VLH" if SOC_PART_NUMBER_MCXA344VLH
	default "MCXA344VLL" if SOC_PART_NUMBER_MCXA344VLL
```
