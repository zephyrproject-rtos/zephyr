## soc/nxp/mcx/mcxn/Kconfig.soc
```kconfig
# Copyright 2024 NXP
# SPDX-License-Identifier: Apache-2.0

config SOC_FAMILY_MCXN
	bool

config SOC_FAMILY
	default "mcxn" if SOC_FAMILY_MCXN

config SOC_MCXN947
	bool
	select SOC_FAMILY_MCXN

config SOC_MCXN947_CPU0
	bool
	select SOC_MCXN947

config SOC_MCXN947_CPU1
	bool
	select SOC_MCXN947

config SOC_MCXN947T
	bool
	select SOC_FAMILY_MCXN

config SOC_MCXN947T_CPU0
	bool
	select SOC_MCXN947T

config SOC_MCXN947T_CPU1
	bool
	select SOC_MCXN947T

config SOC_MCXN946
	bool
	select SOC_FAMILY_MCXN

config SOC_MCXN946_CPU0
	bool
	select SOC_MCXN946

config SOC_MCXN946_CPU1
	bool
	select SOC_MCXN946

config SOC_MCXN946T
	bool
	select SOC_FAMILY_MCXN

config SOC_MCXN946T_CPU0
	bool
	select SOC_MCXN946T

config SOC_MCXN946T_CPU1
	bool
	select SOC_MCXN946T

config SOC_MCXN557S
	bool
	select SOC_FAMILY_MCXN

config SOC_MCXN557S_CPU0
	bool
	select SOC_MCXN557S

config SOC_MCXN557S_CPU1
	bool
	select SOC_MCXN557S

config SOC_MCXN557T
	bool
	select SOC_FAMILY_MCXN

config SOC_MCXN557T_CPU0
	bool
	select SOC_MCXN557T

config SOC_MCXN557T_CPU1
	bool
	select SOC_MCXN557T

config SOC_MCXN556S
	bool
	select SOC_FAMILY_MCXN

config SOC_MCXN556S_CPU0
	bool
	select SOC_MCXN556S

config SOC_MCXN556S_CPU1
	bool
	select SOC_MCXN556S

config SOC_MCXN556T
	bool
	select SOC_FAMILY_MCXN

config SOC_MCXN556T_CPU0
	bool
	select SOC_MCXN556T

config SOC_MCXN556T_CPU1
	bool
	select SOC_MCXN556T

config SOC_MCXN547
	bool
	select SOC_FAMILY_MCXN

config SOC_MCXN547_CPU0
	bool
	select SOC_MCXN547

config SOC_MCXN547_CPU1
	bool
	select SOC_MCXN547

config SOC_MCXN547T
	bool
	select SOC_FAMILY_MCXN

config SOC_MCXN547T_CPU0
	bool
	select SOC_MCXN547T

config SOC_MCXN547T_CPU1
	bool
	select SOC_MCXN547T

config SOC_MCXN546
	bool
	select SOC_FAMILY_MCXN

config SOC_MCXN546_CPU0
	bool
	select SOC_MCXN546

config SOC_MCXN546_CPU1
	bool
	select SOC_MCXN546

config SOC_MCXN546T
	bool
	select SOC_FAMILY_MCXN

config SOC_MCXN546T_CPU0
	bool
	select SOC_MCXN546T

config SOC_MCXN546T_CPU1
	bool
	select SOC_MCXN546T

config SOC_MCXN537
	bool
	select SOC_FAMILY_MCXN

config SOC_MCXN537_CPU0
	bool
	select SOC_MCXN537

config SOC_MCXN537_CPU1
	bool
	select SOC_MCXN537

config SOC_MCXN537T
	bool
	select SOC_FAMILY_MCXN

config SOC_MCXN537T_CPU0
	bool
	select SOC_MCXN537T

config SOC_MCXN537T_CPU1
	bool
	select SOC_MCXN537T

config SOC_MCXN536
	bool
	select SOC_FAMILY_MCXN

config SOC_MCXN536_CPU0
	bool
	select SOC_MCXN536

config SOC_MCXN536_CPU1
	bool
	select SOC_MCXN536

config SOC_MCXN536T
	bool
	select SOC_FAMILY_MCXN

config SOC_MCXN536T_CPU0
	bool
	select SOC_MCXN536T

config SOC_MCXN536T_CPU1
	bool
	select SOC_MCXN536T

config SOC_MCXN527
	bool
	select SOC_FAMILY_MCXN

config SOC_MCXN527_CPU0
	bool
	select SOC_MCXN527

config SOC_MCXN527_CPU1
	bool
	select SOC_MCXN527

config SOC_MCXN527T
	bool
	select SOC_FAMILY_MCXN

config SOC_MCXN527T_CPU0
	bool
	select SOC_MCXN527T

config SOC_MCXN527T_CPU1
	bool
	select SOC_MCXN527T

config SOC_MCXN526
	bool
	select SOC_FAMILY_MCXN

config SOC_MCXN526_CPU0
	bool
	select SOC_MCXN526

config SOC_MCXN526_CPU1
	bool
	select SOC_MCXN526

config SOC_MCXN526T
	bool
	select SOC_FAMILY_MCXN

config SOC_MCXN526T_CPU0
	bool
	select SOC_MCXN526T

config SOC_MCXN526T_CPU1
	bool
	select SOC_MCXN526T

config SOC_MCXN247
	bool
	select SOC_FAMILY_MCXN

config SOC_MCXN247T
	bool
	select SOC_FAMILY_MCXN

config SOC_MCXN246
	bool
	select SOC_FAMILY_MCXN

config SOC_MCXN246T
	bool
	select SOC_FAMILY_MCXN

config SOC_MCXN236
	bool
	select SOC_FAMILY_MCXN

config SOC_MCXN235
	bool
	select SOC_FAMILY_MCXN

config SOC
	default "mcxn947" if SOC_MCXN947
	default "mcxn947t" if SOC_MCXN947T
	default "mcxn946" if SOC_MCXN946
	default "mcxn946t" if SOC_MCXN946T
	default "mcxn557s" if SOC_MCXN557S
	default "mcxn557t" if SOC_MCXN557T
	default "mcxn556s" if SOC_MCXN556S
	default "mcxn556t" if SOC_MCXN556T
	default "mcxn547" if SOC_MCXN547
	default "mcxn547t" if SOC_MCXN547T
	default "mcxn546" if SOC_MCXN546
	default "mcxn546t" if SOC_MCXN546T
	default "mcxn537" if SOC_MCXN537
	default "mcxn537t" if SOC_MCXN537T
	default "mcxn536" if SOC_MCXN536
	default "mcxn536t" if SOC_MCXN536T
	default "mcxn527" if SOC_MCXN527
	default "mcxn527t" if SOC_MCXN527T
	default "mcxn526" if SOC_MCXN526
	default "mcxn526t" if SOC_MCXN526T
	default "mcxn247" if SOC_MCXN247
	default "mcxn247t" if SOC_MCXN247T
	default "mcxn246" if SOC_MCXN246
	default "mcxn246t" if SOC_MCXN246T
	default "mcxn236" if SOC_MCXN236
	default "mcxn235" if SOC_MCXN235

config SOC_PART_NUMBER_MCXN947VDF
	bool
	select SOC_MCXN947

config SOC_PART_NUMBER_MCXN947VPB
	bool
	select SOC_MCXN947

config SOC_PART_NUMBER_MCXN947VAB
	bool
	select SOC_MCXN947

config SOC_PART_NUMBER_MCXN947VNL
	bool
	select SOC_MCXN947

config SOC_PART_NUMBER_MCXN947VKL
	bool
	select SOC_MCXN947

config SOC_PART_NUMBER_MCXN947TVDF
	bool
	select SOC_MCXN947T

config SOC_PART_NUMBER_MCXN947TVKL
	bool
	select SOC_MCXN947T

config SOC_PART_NUMBER_MCXN947TVPB
	bool
	select SOC_MCXN947T

config SOC_PART_NUMBER_MCXN947TVAB
	bool
	select SOC_MCXN947T

config SOC_PART_NUMBER_MCXN946VDF
	bool
	select SOC_MCXN946

config SOC_PART_NUMBER_MCXN946VPB
	bool
	select SOC_MCXN946

config SOC_PART_NUMBER_MCXN946VAB
	bool
	select SOC_MCXN946

config SOC_PART_NUMBER_MCXN946VNL
	bool
	select SOC_MCXN946

config SOC_PART_NUMBER_MCXN946VKL
	bool
	select SOC_MCXN946

config SOC_PART_NUMBER_MCXN946TVDF
	bool
	select SOC_MCXN946T

config SOC_PART_NUMBER_MCXN946TVKL
	bool
	select SOC_MCXN946T

config SOC_PART_NUMBER_MCXN946TVPB
	bool
	select SOC_MCXN946T

config SOC_PART_NUMBER_MCXN946TVAB
	bool
	select SOC_MCXN946T

config SOC_PART_NUMBER_MCXN557SCDF
	bool
	select SOC_MCXN557S

config SOC_PART_NUMBER_MCXN557TCDF
	bool
	select SOC_MCXN557T

config SOC_PART_NUMBER_MCXN557TVDF
	bool
	select SOC_MCXN557T

config SOC_PART_NUMBER_MCXN557TVAB
	bool
	select SOC_MCXN557T

config SOC_PART_NUMBER_MCXN557TCAB
	bool
	select SOC_MCXN557T

config SOC_PART_NUMBER_MCXN556SCDF
	bool
	select SOC_MCXN556S

config SOC_PART_NUMBER_MCXN556TCDF
	bool
	select SOC_MCXN556T

config SOC_PART_NUMBER_MCXN556TVDF
	bool
	select SOC_MCXN556T

config SOC_PART_NUMBER_MCXN556TVAB
	bool
	select SOC_MCXN556T

config SOC_PART_NUMBER_MCXN556TCAB
	bool
	select SOC_MCXN556T

config SOC_PART_NUMBER_MCXN547VDF
	bool
	select SOC_MCXN547

config SOC_PART_NUMBER_MCXN547VPB
	bool
	select SOC_MCXN547

config SOC_PART_NUMBER_MCXN547VAB
	bool
	select SOC_MCXN547

config SOC_PART_NUMBER_MCXN547VNL
	bool
	select SOC_MCXN547

config SOC_PART_NUMBER_MCXN547VKL
	bool
	select SOC_MCXN547

config SOC_PART_NUMBER_MCXN547TVDF
	bool
	select SOC_MCXN547T

config SOC_PART_NUMBER_MCXN547TVKL
	bool
	select SOC_MCXN547T

config SOC_PART_NUMBER_MCXN547TVPB
	bool
	select SOC_MCXN547T

config SOC_PART_NUMBER_MCXN547TVAB
	bool
	select SOC_MCXN547T

config SOC_PART_NUMBER_MCXN546VDF
	bool
	select SOC_MCXN546

config SOC_PART_NUMBER_MCXN546VPB
	bool
	select SOC_MCXN546

config SOC_PART_NUMBER_MCXN546VAB
	bool
	select SOC_MCXN546

config SOC_PART_NUMBER_MCXN546VNL
	bool
	select SOC_MCXN546

config SOC_PART_NUMBER_MCXN546VKL
	bool
	select SOC_MCXN546

config SOC_PART_NUMBER_MCXN546TVDF
	bool
	select SOC_MCXN546T

config SOC_PART_NUMBER_MCXN546TVKL
	bool
	select SOC_MCXN546T

config SOC_PART_NUMBER_MCXN546TVPB
	bool
	select SOC_MCXN546T

config SOC_PART_NUMBER_MCXN546TVAB
	bool
	select SOC_MCXN546T

config SOC_PART_NUMBER_MCXN537VDF
	bool
	select SOC_MCXN537

config SOC_PART_NUMBER_MCXN537VPB
	bool
	select SOC_MCXN537

config SOC_PART_NUMBER_MCXN537VAB
	bool
	select SOC_MCXN537

config SOC_PART_NUMBER_MCXN537VKL
	bool
	select SOC_MCXN537

config SOC_PART_NUMBER_MCXN537TVDF
	bool
	select SOC_MCXN537T

config SOC_PART_NUMBER_MCXN537TVKL
	bool
	select SOC_MCXN537T

config SOC_PART_NUMBER_MCXN537TVPB
	bool
	select SOC_MCXN537T

config SOC_PART_NUMBER_MCXN537TVAB
	bool
	select SOC_MCXN537T

config SOC_PART_NUMBER_MCXN536VDF
	bool
	select SOC_MCXN536

config SOC_PART_NUMBER_MCXN536VPB
	bool
	select SOC_MCXN536

config SOC_PART_NUMBER_MCXN536VAB
	bool
	select SOC_MCXN536

config SOC_PART_NUMBER_MCXN536VKL
	bool
	select SOC_MCXN536

config SOC_PART_NUMBER_MCXN536TVDF
	bool
	select SOC_MCXN536T

config SOC_PART_NUMBER_MCXN536TVKL
	bool
	select SOC_MCXN536T

config SOC_PART_NUMBER_MCXN536TVPB
	bool
	select SOC_MCXN536T

config SOC_PART_NUMBER_MCXN536TVAB
	bool
	select SOC_MCXN536T

config SOC_PART_NUMBER_MCXN527VDF
	bool
	select SOC_MCXN527

config SOC_PART_NUMBER_MCXN527VKL
	bool
	select SOC_MCXN527

config SOC_PART_NUMBER_MCXN527VAB
	bool
	select SOC_MCXN527

config SOC_PART_NUMBER_MCXN527TVDF
	bool
	select SOC_MCXN527T

config SOC_PART_NUMBER_MCXN527TVKL
	bool
	select SOC_MCXN527T

config SOC_PART_NUMBER_MCXN527TVAB
	bool
	select SOC_MCXN527T

config SOC_PART_NUMBER_MCXN526VDF
	bool
	select SOC_MCXN526

config SOC_PART_NUMBER_MCXN526VKL
	bool
	select SOC_MCXN526

config SOC_PART_NUMBER_MCXN526TVDF
	bool
	select SOC_MCXN526T

config SOC_PART_NUMBER_MCXN526TVKL
	bool
	select SOC_MCXN526T

config SOC_PART_NUMBER_MCXN247VDF
	bool
	select SOC_MCXN247

config SOC_PART_NUMBER_MCXN247VPB
	bool
	select SOC_MCXN247

config SOC_PART_NUMBER_MCXN247VAB
	bool
	select SOC_MCXN247

config SOC_PART_NUMBER_MCXN247VKL
	bool
	select SOC_MCXN247

config SOC_PART_NUMBER_MCXN247TVDF
	bool
	select SOC_MCXN247T

config SOC_PART_NUMBER_MCXN247TVKL
	bool
	select SOC_MCXN247T

config SOC_PART_NUMBER_MCXN247TVPB
	bool
	select SOC_MCXN247T

config SOC_PART_NUMBER_MCXN247TVAB
	bool
	select SOC_MCXN247T

config SOC_PART_NUMBER_MCXN246VAB
	bool
	select SOC_MCXN246

config SOC_PART_NUMBER_MCXN246TVAB
	bool
	select SOC_MCXN246T

config SOC_PART_NUMBER_MCXN236VDF
	bool
	select SOC_MCXN236

config SOC_PART_NUMBER_MCXN236VPB
	bool
	select SOC_MCXN236

config SOC_PART_NUMBER_MCXN236VNL
	bool
	select SOC_MCXN236

config SOC_PART_NUMBER_MCXN236VKL
	bool
	select SOC_MCXN236

config SOC_PART_NUMBER_MCXN235VDF
	bool
	select SOC_MCXN235

config SOC_PART_NUMBER_MCXN235VPB
	bool
	select SOC_MCXN235

config SOC_PART_NUMBER_MCXN235VNL
	bool
	select SOC_MCXN235

config SOC_PART_NUMBER_MCXN235VKL
	bool
	select SOC_MCXN235

config SOC_PART_NUMBER
	default "MCXN947VDF" if SOC_PART_NUMBER_MCXN947VDF
	default "MCXN947VPB" if SOC_PART_NUMBER_MCXN947VPB
	default "MCXN947VAB" if SOC_PART_NUMBER_MCXN947VAB
	default "MCXN947VNL" if SOC_PART_NUMBER_MCXN947VNL
	default "MCXN947VKL" if SOC_PART_NUMBER_MCXN947VKL
	default "MCXN947TVDF" if SOC_PART_NUMBER_MCXN947TVDF
	default "MCXN947TVKL" if SOC_PART_NUMBER_MCXN947TVKL
	default "MCXN947TVPB" if SOC_PART_NUMBER_MCXN947TVPB
	default "MCXN947TVAB" if SOC_PART_NUMBER_MCXN947TVAB
	default "MCXN946VDF" if SOC_PART_NUMBER_MCXN946VDF
	default "MCXN946VPB" if SOC_PART_NUMBER_MCXN946VPB
	default "MCXN946VAB" if SOC_PART_NUMBER_MCXN946VAB
	default "MCXN946VNL" if SOC_PART_NUMBER_MCXN946VNL
	default "MCXN946VKL" if SOC_PART_NUMBER_MCXN946VKL
	default "MCXN946TVDF" if SOC_PART_NUMBER_MCXN946TVDF
	default "MCXN946TVKL" if SOC_PART_NUMBER_MCXN946TVKL
	default "MCXN946TVPB" if SOC_PART_NUMBER_MCXN946TVPB
	default "MCXN946TVAB" if SOC_PART_NUMBER_MCXN946TVAB
	default "MCXN557SCDF" if SOC_PART_NUMBER_MCXN557SCDF
	default "MCXN557TCDF" if SOC_PART_NUMBER_MCXN557TCDF
	default "MCXN557TVDF" if SOC_PART_NUMBER_MCXN557TVDF
	default "MCXN557TVAB" if SOC_PART_NUMBER_MCXN557TVAB
	default "MCXN557TCAB" if SOC_PART_NUMBER_MCXN557TCAB
	default "MCXN556SCDF" if SOC_PART_NUMBER_MCXN556SCDF
	default "MCXN556TCDF" if SOC_PART_NUMBER_MCXN556TCDF
	default "MCXN556TVDF" if SOC_PART_NUMBER_MCXN556TVDF
	default "MCXN556TVAB" if SOC_PART_NUMBER_MCXN556TVAB
	default "MCXN556TCAB" if SOC_PART_NUMBER_MCXN556TCAB
	default "MCXN547VDF" if SOC_PART_NUMBER_MCXN547VDF
	default "MCXN547VPB" if SOC_PART_NUMBER_MCXN547VPB
	default "MCXN547VAB" if SOC_PART_NUMBER_MCXN547VAB
	default "MCXN547VNL" if SOC_PART_NUMBER_MCXN547VNL
	default "MCXN547VKL" if SOC_PART_NUMBER_MCXN547VKL
	default "MCXN547TVDF" if SOC_PART_NUMBER_MCXN547TVDF
	default "MCXN547TVKL" if SOC_PART_NUMBER_MCXN547TVKL
	default "MCXN547TVPB" if SOC_PART_NUMBER_MCXN547TVPB
	default "MCXN547TVAB" if SOC_PART_NUMBER_MCXN547TVAB
	default "MCXN546VDF" if SOC_PART_NUMBER_MCXN546VDF
	default "MCXN546VPB" if SOC_PART_NUMBER_MCXN546VPB
	default "MCXN546VAB" if SOC_PART_NUMBER_MCXN546VAB
	default "MCXN546VNL" if SOC_PART_NUMBER_MCXN546VNL
	default "MCXN546VKL" if SOC_PART_NUMBER_MCXN546VKL
	default "MCXN546TVDF" if SOC_PART_NUMBER_MCXN546TVDF
	default "MCXN546TVKL" if SOC_PART_NUMBER_MCXN546TVKL
	default "MCXN546TVPB" if SOC_PART_NUMBER_MCXN546TVPB
	default "MCXN546TVAB" if SOC_PART_NUMBER_MCXN546TVAB
	default "MCXN537VDF" if SOC_PART_NUMBER_MCXN537VDF
	default "MCXN537VPB" if SOC_PART_NUMBER_MCXN537VPB
	default "MCXN537VAB" if SOC_PART_NUMBER_MCXN537VAB
	default "MCXN537VKL" if SOC_PART_NUMBER_MCXN537VKL
	default "MCXN537TVDF" if SOC_PART_NUMBER_MCXN537TVDF
	default "MCXN537TVKL" if SOC_PART_NUMBER_MCXN537TVKL
	default "MCXN537TVPB" if SOC_PART_NUMBER_MCXN537TVPB
	default "MCXN537TVAB" if SOC_PART_NUMBER_MCXN537TVAB
	default "MCXN536VDF" if SOC_PART_NUMBER_MCXN536VDF
	default "MCXN536VPB" if SOC_PART_NUMBER_MCXN536VPB
	default "MCXN536VAB" if SOC_PART_NUMBER_MCXN536VAB
	default "MCXN536VKL" if SOC_PART_NUMBER_MCXN536VKL
	default "MCXN536TVDF" if SOC_PART_NUMBER_MCXN536TVDF
	default "MCXN536TVKL" if SOC_PART_NUMBER_MCXN536TVKL
	default "MCXN536TVPB" if SOC_PART_NUMBER_MCXN536TVPB
	default "MCXN536TVAB" if SOC_PART_NUMBER_MCXN536TVAB
	default "MCXN527VDF" if SOC_PART_NUMBER_MCXN527VDF
	default "MCXN527VKL" if SOC_PART_NUMBER_MCXN527VKL
	default "MCXN527VAB" if SOC_PART_NUMBER_MCXN527VAB
	default "MCXN527TVDF" if SOC_PART_NUMBER_MCXN527TVDF
	default "MCXN527TVKL" if SOC_PART_NUMBER_MCXN527TVKL
	default "MCXN527TVAB" if SOC_PART_NUMBER_MCXN527TVAB
	default "MCXN526VDF" if SOC_PART_NUMBER_MCXN526VDF
	default "MCXN526VKL" if SOC_PART_NUMBER_MCXN526VKL
	default "MCXN526TVDF" if SOC_PART_NUMBER_MCXN526TVDF
	default "MCXN526TVKL" if SOC_PART_NUMBER_MCXN526TVKL
	default "MCXN247VDF" if SOC_PART_NUMBER_MCXN247VDF
	default "MCXN247VPB" if SOC_PART_NUMBER_MCXN247VPB
	default "MCXN247VAB" if SOC_PART_NUMBER_MCXN247VAB
	default "MCXN247VKL" if SOC_PART_NUMBER_MCXN247VKL
	default "MCXN247TVDF" if SOC_PART_NUMBER_MCXN247TVDF
	default "MCXN247TVKL" if SOC_PART_NUMBER_MCXN247TVKL
	default "MCXN247TVPB" if SOC_PART_NUMBER_MCXN247TVPB
	default "MCXN247TVAB" if SOC_PART_NUMBER_MCXN247TVAB
	default "MCXN246VAB" if SOC_PART_NUMBER_MCXN246VAB
	default "MCXN246TVAB" if SOC_PART_NUMBER_MCXN246TVAB
	default "MCXN236VDF" if SOC_PART_NUMBER_MCXN236VDF
	default "MCXN236VPB" if SOC_PART_NUMBER_MCXN236VPB
	default "MCXN236VNL" if SOC_PART_NUMBER_MCXN236VNL
	default "MCXN236VKL" if SOC_PART_NUMBER_MCXN236VKL
	default "MCXN235VDF" if SOC_PART_NUMBER_MCXN235VDF
	default "MCXN235VPB" if SOC_PART_NUMBER_MCXN235VPB
	default "MCXN235VNL" if SOC_PART_NUMBER_MCXN235VNL
	default "MCXN235VKL" if SOC_PART_NUMBER_MCXN235VKL
```
