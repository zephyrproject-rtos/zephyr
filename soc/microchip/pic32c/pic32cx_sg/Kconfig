## soc/microchip/pic32c/pic32cx_sg/Kconfig
```kconfig
# Copyright (c) 2025-2026 Microchip Technology Inc.
# SPDX-License-Identifier: Apache-2.0

config SOC_FAMILY_MICROCHIP_PIC32CX_SG
	select ARM
	select ARM_ON_ENTER_CPU_IDLE_HOOK if PM
	select MICROCHIP_PIC32C
	select CPU_CORTEX_M4
	select CPU_CORTEX_M_HAS_DWT
	select CPU_HAS_ARM_MPU
	select CPU_HAS_FPU
	select CLOCK_CONTROL
	select HAS_CMSIS_CORE
	select HAS_PM
	select HAS_SEGGER_RTT if ZEPHYR_SEGGER_MODULE
	select PIN_DRIVE_STRENGTH if PINCTRL
```

## soc/microchip/pic32c/pic32cz_ca/pic32cz_ca70/Kconfig.soc
```kconfig
# SPDX-FileCopyrightText: Copyright The Zephyr Project Contributors
# SPDX-License-Identifier: Apache-2.0

config SOC_SERIES_PIC32CZ_CA70
	bool
	select SOC_FAMILY_MICROCHIP_PIC32CZ_CA
	help
	  Enable support for Microchip PIC32CZ CA70 Cortex-M7 microcontrollers.

config SOC_SERIES
	default "pic32cz_ca70" if SOC_SERIES_PIC32CZ_CA70

config SOC_PIC32CZ2051CA70064
	bool
	select SOC_SERIES_PIC32CZ_CA70

config SOC_PIC32CZ2051CA70100
	bool
	select SOC_SERIES_PIC32CZ_CA70

config SOC_PIC32CZ2051CA70144
	bool
	select SOC_SERIES_PIC32CZ_CA70

config SOC
	default "pic32cz2051ca70064" if SOC_PIC32CZ2051CA70064
	default "pic32cz2051ca70100" if SOC_PIC32CZ2051CA70100
	default "pic32cz2051ca70144" if SOC_PIC32CZ2051CA70144
```

## soc/nordic/nrf54l/Kconfig.sysbuild
```kconfig
# Copyright (c) 2025 Nordic Semiconductor ASA
# SPDX-License-Identifier: Apache-2.0

if SOC_NRF54L05_CPUFLPR || SOC_NRF54L10_CPUFLPR || SOC_NRF54L15_CPUFLPR || \
	SOC_NRF54LM20A_CPUFLPR || SOC_NRF54LM20B_CPUFLPR || SOC_NRF54LV10A_CPUFLPR

config HAS_NORDIC_VPR_LAUNCHER_IMAGE
	default y

endif

config IRONSIDE_TE
	bool
	help
	  IronSide TE provides the roots of trust and a set of secure services.
	  It replaces MCUboot: the application is a non-secure image signed with
	  the IronSide Integration Kit tooling and booted by the IronSide TE UROT.

# IronSide TE is the bootloader, so MCUboot must not be built alongside it.
configdefault SUPPORT_BOOTLOADER_MCUBOOT_ZEPHYR
	default n if IRONSIDE_TE
```

## soc/nxp/imx/imx9/imx937/Kconfig.defconfig.mimx937.m7
```kconfig
# Copyright 2026 NXP
# SPDX-License-Identifier: Apache-2.0

if SOC_MIMX9375_M7

DT_CHOSEN_Z_FLASH := zephyr,flash

configdefault MCUX_CORE_SUFFIX
	default "_cm7"

# Multi-level interrupts
configdefault MULTI_LEVEL_INTERRUPTS
	default y

configdefault 1ST_LEVEL_INTERRUPT_BITS
	default 8

configdefault MAX_IRQ_PER_AGGREGATOR
	default 16

configdefault 2ND_LEVEL_INTERRUPTS
	default y

configdefault 2ND_LVL_ISR_TBL_OFFSET
	default 234

configdefault NUM_2ND_LEVEL_AGGREGATORS
	default 1

configdefault 2ND_LEVEL_INTERRUPT_BITS
	default 8

configdefault 2ND_LVL_INTR_00_OFFSET
	default 224

configdefault 3RD_LEVEL_INTERRUPTS
	default n

configdefault NUM_IRQS
	default 250 # 2ND_LVL_ISR_TBL_OFFSET + MAX_IRQ_PER_AGGREGATOR * NUM_2ND_LEVEL_AGGREGATORS

configdefault MCUX_LPTMR_TIMER
	default y if !COUNTER_MCUX_LPTMR

DT_CHOSEN_ZEPHYR_SYSTEM_TIMER := zephyr,system-timer
DT_CHOSEN_ZEPHYR_SYSTEM_TIMER_PATH := $(dt_chosen_path,$(DT_CHOSEN_ZEPHYR_SYSTEM_TIMER))

configdefault CORTEX_M_SYSTICK
	default n if MCUX_LPTMR_TIMER

configdefault SYS_CLOCK_HW_CYCLES_PER_SEC
	default $(dt_node_int_prop_int,/cpus/cpu@0,clock-frequency) if CORTEX_M_SYSTICK
	default $(dt_node_int_prop_int,$(DT_CHOSEN_ZEPHYR_SYSTEM_TIMER_PATH),clock-frequency) if MCUX_LPTMR_TIMER

configdefault SYS_CLOCK_TICKS_PER_SEC
	default 1024 if MCUX_LPTMR_TIMER
	default 1000 if CORTEX_M_SYSTICK

configdefault CACHE_MANAGEMENT
	default y

configdefault ETH_NXP_IMX_MSGINTR
	default 2

if PM

# PM code that runs from the idle loop has a large
# Footprint. Hence increase the size when PM is enabled.
configdefault IDLE_STACK_SIZE
	default 640

endif

if PM_DEVICE

configdefault POWER_DOMAIN
	default y

endif # PM_DEVICE

configdefault ROM_START_OFFSET
	default 0x800 if BOOTLOADER_MCUBOOT

endif # SOC_MIMX9375_M7
```

## soc/nxp/imx/imx9/imx937/Kconfig.soc
```kconfig
# Copyright 2026 NXP
# SPDX-License-Identifier: Apache-2.0

config SOC_MIMX9375
	bool
	select SOC_SERIES_IMX9

config SOC_MIMX9375_M7
	bool
	select SOC_MIMX9375
	help
	  NXP i.MX937 M7

configdefault SOC
	default "mimx9375" if SOC_MIMX9375

config SOC_PART_NUMBER_MIMX9375XXVZX
	bool

configdefault SOC_PART_NUMBER
	default "MIMX9375xxVZx" if SOC_PART_NUMBER_MIMX9375XXVZX
```

## soc/nxp/imx/imx9/imx943/Kconfig.defconfig.mimx94398.m7_0
```kconfig
# SPDX-FileCopyrightText: Copyright 2025-2026 NXP
# SPDX-License-Identifier: Apache-2.0

if SOC_MIMX94398_M7_0

DT_CHOSEN_Z_FLASH := zephyr,flash

configdefault FLASH_SIZE
	default $(dt_chosen_reg_size_int,$(DT_CHOSEN_Z_FLASH),0,K)

configdefault FLASH_BASE_ADDRESS
	default $(dt_chosen_reg_addr_hex,$(DT_CHOSEN_Z_FLASH))

configdefault MCUX_CORE_SUFFIX
	default "_cm7_core0" if SOC_MIMX94398_M7_0

configdefault NUM_IRQS
	default 1070

configdefault CORTEX_M_SYSTICK
	default n if MCUX_GPT_TIMER

configdefault SYS_CLOCK_HW_CYCLES_PER_SEC
	default $(dt_node_int_prop_int,/cpus/cpu@0,clock-frequency) if CORTEX_M_SYSTICK
	default 32768 if MCUX_GPT_TIMER

configdefault ETH_NXP_IMX_MSGINTR
	default 1

configdefault CACHE_MANAGEMENT
	default y

# Multi-level interrupts
configdefault MULTI_LEVEL_INTERRUPTS
	default y

configdefault 1ST_LEVEL_INTERRUPT_BITS
	default 9

configdefault MAX_IRQ_PER_AGGREGATOR
	default 64

configdefault 2ND_LEVEL_INTERRUPTS
	default y

configdefault 2ND_LVL_ISR_TBL_OFFSET
	default 238

configdefault NUM_2ND_LEVEL_AGGREGATORS
	default 8

configdefault 2ND_LEVEL_INTERRUPT_BITS
	default 10

configdefault 2ND_LVL_INTR_00_OFFSET
	default 224

configdefault 2ND_LVL_INTR_01_OFFSET
	default 225

configdefault 2ND_LVL_INTR_02_OFFSET
	default 226

configdefault 2ND_LVL_INTR_03_OFFSET
	default 227

configdefault 2ND_LVL_INTR_04_OFFSET
	default 228

configdefault 2ND_LVL_INTR_05_OFFSET
	default 229

configdefault 2ND_LVL_INTR_06_OFFSET
	default 230

configdefault 2ND_LVL_INTR_07_OFFSET
	default 231

configdefault 3RD_LEVEL_INTERRUPTS
	default n

if PM

configdefault IDLE_STACK_SIZE
	default 640

configdefault PM_S2RAM
	default y

configdefault HAS_PM_S2RAM_CUSTOM_MARKING
	default y

configdefault MCUX_GPT_TIMER
	default y

configdefault SYS_CLOCK_TICKS_PER_SEC
	default 1024

endif

configdefault DMA_TCD_QUEUE_SIZE
	default 4

endif # SOC_MIMX94398_M7_0
```
