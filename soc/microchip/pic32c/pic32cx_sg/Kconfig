## soc/nxp/rw/Kconfig.defconfig.wifi
```kconfig
# Copyright 2022-2026 NXP
# SPDX-License-Identifier: Apache-2.0

choice NXP_WIFI_PART
	default NXP_RW610
endchoice # NXP_WIFI_PART

if NETWORKING

if NET_DHCPV4_SERVER

config NET_DHCPV4_SERVER_ADDR_COUNT
	default 32

config NET_DHCPV4_SERVER_ICMP_PROBE_TIMEOUT
	default 100

endif # NET_DHCPV4_SERVER

if NET_L2_WIFI_MGMT

configdefault WIFI_MGMT_AP_MAX_NUM_STA
	default 8 if NXP_WIFI_SOFTAP_SUPPORT

configdefault WIFI_SHELL_MAX_AP_STA
	default 8

endif # NET_L2_WIFI_MGMT

endif # NETWORKING

if WIFI_NM_HOSTAPD_AP

config WIFI_NM_HOSTAPD_REGULATORY_REGION
	default "US"

endif # WIFI_NM_HOSTAPD_AP

if NXP_WIFI_FW_DEBUG

config NXP_FW_DUMP_FLASH_START_ADDR
	default 0x0B000000

endif # NXP_WIFI_FW_DEBUG

if NXP_WIFI_PRESET

source "drivers/wifi/nxp/Kconfig.preset"

if NETWORKING

configdefault NET_PKT_RX_COUNT
	default 36

configdefault NET_PKT_TX_COUNT
	default 36

configdefault NET_BUF_RX_COUNT
	default 40

configdefault NET_BUF_TX_COUNT
	default 40

if NET_TCP

configdefault NET_TCP_MAX_SEND_WINDOW_SIZE
	default 46720

configdefault NET_TCP_MAX_RECV_WINDOW_SIZE
	default 46720

endif # NET_TCP

endif # NETWORKING

endif # NXP_WIFI_PRESET
```

## soc/phytium/Kconfig
```kconfig
# Copyright (c) 2026 Process Mission
# SPDX-License-Identifier: Apache-2.0

if SOC_FAMILY_PHYTIUM

rsource "*/Kconfig"

endif
```

## soc/phytium/Kconfig.soc
```kconfig
# Copyright (c) 2026 Process Mission
# SPDX-License-Identifier: Apache-2.0

config SOC_FAMILY_PHYTIUM
	bool

config SOC_FAMILY
	default "phytium" if SOC_FAMILY_PHYTIUM

rsource "*/Kconfig.soc"
```

## soc/phytium/pe2204/Kconfig
```kconfig
# Copyright (c) 2026 Process Mission
# SPDX-License-Identifier: Apache-2.0

config SOC_PE2204
	select ARM64
	select CPU_CORTEX_A72
	select ARM_ARCH_TIMER if SYS_CLOCK_EXISTS
```

## soc/phytium/pe2204/Kconfig.soc
```kconfig
# Copyright (c) 2026 Process Mission
# SPDX-License-Identifier: Apache-2.0

config SOC_PE2204
	bool
	select SOC_FAMILY_PHYTIUM
	help
	  Phytium E2000Q (PE2204) SoC.

config SOC
	default "pe2204" if SOC_PE2204
```

## soc/racyics/edgevision/Kconfig
```kconfig
# SPDX-FileCopyrightText: Copyright 2026 sensry.io
# SPDX-License-Identifier: Apache-2.0

config SOC_EDGEVISION_M4
	select CPU_CORTEX_M4
	select ARM

config SOC_EDGEVISION_M85
	select CPU_CORTEX_M85
	select ARM
```

## soc/racyics/edgevision/Kconfig.defconfig
```kconfig
# SPDX-FileCopyrightText: Copyright 2026 sensry.io
# SPDX-License-Identifier: Apache-2.0

if SOC_EDGEVISION

configdefault INCLUDE_RESET_VECTOR
	default y

configdefault GEN_IRQ_VECTOR_TABLE
	default y

configdefault NUM_IRQS
	default 32

configdefault DYNAMIC_INTERRUPTS
	default y

configdefault GEN_ISR_TABLES
	default y

configdefault SYS_CLOCK_HW_CYCLES_PER_SEC
	default $(dt_node_int_prop_int,/cpus/cpu@0,clock-frequency) if CORTEX_M_SYSTICK

configdefault SYS_CLOCK_TICKS_PER_SEC
	default 1000

configdefault USE_DT_CODE_PARTITION
	default y

configdefault INIT_STACKS
	default y

endif
```

## soc/racyics/edgevision/Kconfig.soc
```kconfig
# SPDX-FileCopyrightText: Copyright 2026 sensry.io
# SPDX-License-Identifier: Apache-2.0

config SOC_EDGEVISION
	bool

config SOC_EDGEVISION_M4
	bool
	select SOC_EDGEVISION
	help
	  Enable the Edgevision Cortex-M4 core.

config SOC_EDGEVISION_M85
	bool
	select SOC_EDGEVISION
	help
	  Enable the Edgevision Cortex-M85 core.

config SOC
	default "edgevision" if SOC_EDGEVISION
```

## soc/raspberrypi/rpi_pico/rp2350/Kconfig
```kconfig
# Raspberry Pi RP235XX MCU line

# Copyright (c) 2024 Andrew Featherstone
# SPDX-License-Identifier: Apache-2.0

config SOC_SERIES_RP2350
	select HAS_RPI_PICO
	select HAS_SEGGER_RTT if ZEPHYR_SEGGER_MODULE
	select SOC_RESET_HOOK
	imply XIP
	select CLOCK_CONTROL_RPI_PICO if PM_S2RAM
	select HAS_PM if ARM
	select HAS_PM_S2RAM_CUSTOM_MARKING if PM_S2RAM
	select PICOSDK_USE_POWMAN if PM_S2RAM
	select TICKLESS_KERNEL if PM_S2RAM

config SOC_RP2350A_HAZARD3
	select DEPRECATED

config SOC_RP2350A_HAZARD3_0
	select ARCH_HAS_RAMFUNC_SUPPORT if XIP
	select HAS_FLASH_LOAD_OFFSET
	select INCLUDE_RESET_VECTOR
	select RISCV

config SOC_RP2350A_M33
	select DEPRECATED

config SOC_RP2350A_M33_0
	select ARM
	select ARM_TRUSTZONE_M
	select CPU_CORTEX_M_HAS_SYSTICK
	select CPU_CORTEX_M_HAS_VTOR
	select CPU_CORTEX_M33
	select CPU_HAS_ARM_MPU
	select CPU_HAS_ARM_SAU
	select CPU_HAS_FPU
	select ARMV8_M_DSP

config SOC_RP2350A_M33_1
	select ARM
	select ARM_TRUSTZONE_M
	select CPU_CORTEX_M_HAS_SYSTICK
	select CPU_CORTEX_M_HAS_VTOR
	select CPU_CORTEX_M33
	select CPU_HAS_ARM_MPU
	select CPU_HAS_ARM_SAU
	select CPU_HAS_FPU
	select ARMV8_M_DSP
	select SOC_FAMILY_RPI_PICO_CPU1

config SOC_RP2350A_M33_SMP
	select SOC_RP2350_M33_SMP

config SOC_RP2350B_HAZARD3
	select DEPRECATED

config SOC_RP2350B_HAZARD3_0
	select ARCH_HAS_RAMFUNC_SUPPORT if XIP
	select HAS_FLASH_LOAD_OFFSET
	select INCLUDE_RESET_VECTOR
	select RISCV

config SOC_RP2350B_M33
	select DEPRECATED

config SOC_RP2350B_M33_0
	select ARM
	select ARM_TRUSTZONE_M
	select CPU_CORTEX_M_HAS_SYSTICK
	select CPU_CORTEX_M_HAS_VTOR
	select CPU_CORTEX_M33
	select CPU_HAS_ARM_MPU
	select CPU_HAS_ARM_SAU
	select CPU_HAS_FPU
	select ARMV8_M_DSP

config SOC_RP2350B_M33_1
	select ARM
	select ARM_TRUSTZONE_M
	select CPU_CORTEX_M_HAS_SYSTICK
	select CPU_CORTEX_M_HAS_VTOR
	select CPU_CORTEX_M33
	select CPU_HAS_ARM_MPU
	select CPU_HAS_ARM_SAU
	select CPU_HAS_FPU
	select ARMV8_M_DSP
	select SOC_FAMILY_RPI_PICO_CPU1

config SOC_RP2350B_M33_SMP
	select SOC_RP2350_M33_SMP

config SOC_RP2350_M33_SMP
	bool
	help
	  Both Cortex-M33 cores of an RP2350 run one SMP image.
	select ARM
	select ARM_TRUSTZONE_M
	select CPU_CORTEX_M_HAS_SYSTICK
	select CPU_CORTEX_M_HAS_VTOR
	select CPU_CORTEX_M33
	select CPU_HAS_ARM_MPU
	select CPU_HAS_ARM_SAU
	select CPU_HAS_FPU
	select ARMV8_M_DSP
	select SOC_PER_CORE_INIT_HOOK if SMP || MP_MAX_NUM_CPUS > 1
	select SCHED_IPI_SUPPORTED if SMP
	select ARCH_HAS_DIRECTED_IPIS if SMP

if SOC_SERIES_RP2350

config RP2_REQUIRES_IMAGE_DEFINITION_BLOCK
	bool
	# IMAGE_DEF should be used to define the image for booting CPU0
	default y if !SOC_FAMILY_RPI_PICO_CPU1
	help
	  Include an Image Definition Block (IMAGE_DEF) to enable the bootroom in
	  RP23XX devices to consider this a valid image in flash.

config RPI_PICO_SIGNING_KEY
	string "Secure boot signing key"
	help
	  Provide a path to the private key to sign the image for secure boot.
	  The key must be in PEM format and match the expectations of the
	  picotool utility. Please see picotool documentation for details.
	  Setting this config option enables west sign command
	  to produce a signed ELF file. If this is not provided west sign
	  cannot be used.

config RPI_PICO_SMP_FLASH_PARK
	bool "Park the other core in RAM while flash is written or erased"
	default y
	depends on SOC_SERIES_RP2350 && SMP && MP_MAX_NUM_CPUS > 1
	help
	  Writing or erasing the flash takes the XIP interface away from both
	  cores. This option adds rp2350_smp_park_other() and
	  rp2350_smp_unpark_other(), which stop the other core in a loop in RAM
	  with all of its interrupts masked. It uses doorbell 1 of the SIO; doorbell
	  0 is the scheduler IPI. The flash driver needs it with SMP.

if RPI_PICO_SMP_FLASH_PARK

config RPI_PICO_SMP_FLASH_PARK_SHORT_WAIT_US
	int "Time to wait for the other core to park before trying again (microseconds)"
	default 100
	range 10 10000
	help
	  The other core may be waiting for this one with its interrupts masked,
	  for example in the cross-CPU abort of a thread. After this time the
	  request is withdrawn and this core takes the interrupts that are
	  pending for it before the request is made again.

config RPI_PICO_SMP_FLASH_PARK_TIMEOUT_MS
	int "Total time to try to park the other core before giving up (milliseconds)"
	default 100
	range 1 60000
	help
	  The flash driver gives up with -EBUSY when the other core cannot be
	  parked in this time. It applies to each page written and each erase
	  unit, not to a whole write or erase call.

config RPI_PICO_SMP_FLASH_PARK_DIAG
	bool "Count parking requests (for tests)"
	help
	  Exposes rp2350_smp_park_stats. Not for production images: it adds a
	  read of TIMER1 to the loop of the parked core.

endif # RPI_PICO_SMP_FLASH_PARK

endif # SOC_SERIES_RP2350
```
