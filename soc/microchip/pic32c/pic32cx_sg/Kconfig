## soc/nxp/mcx/mcxc/Kconfig.soc
```kconfig
# Copyright 2024 NXP
# SPDX-License-Identifier: Apache-2.0

config SOC_FAMILY_MCXC
	bool

config SOC_FAMILY
	default "mcxc" if SOC_FAMILY_MCXC

config SOC_MCXC141
	bool
	select SOC_FAMILY_MCXC

config SOC_MCXC142
	bool
	select SOC_FAMILY_MCXC

config SOC_MCXC143
	bool
	select SOC_FAMILY_MCXC

config SOC_MCXC144
	bool
	select SOC_FAMILY_MCXC

config SOC_MCXC242
	bool
	select SOC_FAMILY_MCXC

config SOC_MCXC243
	bool
	select SOC_FAMILY_MCXC

config SOC_MCXC244
	bool
	select SOC_FAMILY_MCXC

config SOC_MCXC443
	bool
	select SOC_FAMILY_MCXC

config SOC_MCXC444
	bool
	select SOC_FAMILY_MCXC

config SOC
	default "mcxc141" if SOC_MCXC141
	default "mcxc142" if SOC_MCXC142
	default "mcxc143" if SOC_MCXC143
	default "mcxc144" if SOC_MCXC144
	default "mcxc242" if SOC_MCXC242
	default "mcxc243" if SOC_MCXC243
	default "mcxc244" if SOC_MCXC244
	default "mcxc443" if SOC_MCXC443
	default "mcxc444" if SOC_MCXC444

config SOC_PART_NUMBER_MCXC141VLH
	bool
	select SOC_MCXC141

config SOC_PART_NUMBER_MCXC141VFM
	bool
	select SOC_MCXC141

config SOC_PART_NUMBER_MCXC142VFM
	bool
	select SOC_MCXC142

config SOC_PART_NUMBER_MCXC143VFT
	bool
	select SOC_MCXC143

config SOC_PART_NUMBER_MCXC143VFM
	bool
	select SOC_MCXC143

config SOC_PART_NUMBER_MCXC144VFM
	bool
	select SOC_MCXC144

config SOC_PART_NUMBER_MCXC144VFT
	bool
	select SOC_MCXC144

config SOC_PART_NUMBER_MCXC242VLH
	bool
	select SOC_MCXC242

config SOC_PART_NUMBER_MCXC242VFM
	bool
	select SOC_MCXC242

config SOC_PART_NUMBER_MCXC243VFT
	bool
	select SOC_MCXC243

config SOC_PART_NUMBER_MCXC244VFT
	bool
	select SOC_MCXC244

config SOC_PART_NUMBER_MCXC244VFM
	bool
	select SOC_MCXC244

config SOC_PART_NUMBER_MCXC443VLH
	bool
	select SOC_MCXC443

config SOC_PART_NUMBER_MCXC443VMP
	bool
	select SOC_MCXC443

config SOC_PART_NUMBER_MCXC444VLH
	bool
	select SOC_MCXC444

config SOC_PART_NUMBER_MCXC444VMP
	bool
	select SOC_MCXC444

config SOC_PART_NUMBER
	default "MCXC141VLH" if SOC_PART_NUMBER_MCXC141VLH
	default "MCXC141VFM" if SOC_PART_NUMBER_MCXC141VFM
	default "MCXC142VFM" if SOC_PART_NUMBER_MCXC142VFM
	default "MCXC143VFT" if SOC_PART_NUMBER_MCXC143VFT
	default "MCXC143VFM" if SOC_PART_NUMBER_MCXC143VFM
	default "MCXC144VFM" if SOC_PART_NUMBER_MCXC144VFM
	default "MCXC144VFT" if SOC_PART_NUMBER_MCXC144VFT
	default "MCXC242VLH" if SOC_PART_NUMBER_MCXC242VLH
	default "MCXC242VFM" if SOC_PART_NUMBER_MCXC242VFM
	default "MCXC243VFT" if SOC_PART_NUMBER_MCXC243VFT
	default "MCXC244VFT" if SOC_PART_NUMBER_MCXC244VFT
	default "MCXC244VFM" if SOC_PART_NUMBER_MCXC244VFM
	default "MCXC443VLH" if SOC_PART_NUMBER_MCXC443VLH
	default "MCXC443VMP" if SOC_PART_NUMBER_MCXC443VMP
	default "MCXC444VLH" if SOC_PART_NUMBER_MCXC444VLH
	default "MCXC444VMP" if SOC_PART_NUMBER_MCXC444VMP
```

## soc/nxp/mcx/mcxe/common/Kconfig
```kconfig
# Copyright 2026 NXP
# SPDX-License-Identifier: Apache-2.0

config NXP_LCU
	bool "NXP LCU controller"
	default y
	depends on DT_HAS_NXP_LCU_ENABLED
	depends on CLOCK_CONTROL
	help
	  Enable the NXP logic control unit controller with exclusive ownership
	  of each logic cell, LUT configuration, filtering and output gating.

if NXP_LCU

config NXP_LCU_INIT_PRIORITY
	int "LCU initialization priority"
	default 45
	help
	  Must be later than clock initialization and earlier than LCU consumers.

module = NXP_LCU
module-str = nxp_lcu
source "subsys/logging/Kconfig.template.log_config"

endif # NXP_LCU
```

## soc/nxp/mcx/mcxn/Kconfig
```kconfig
# Copyright 2024-2025 NXP
# SPDX-License-Identifier: Apache-2.0

config SOC_FAMILY_MCXN
	select HAS_SEGGER_RTT if ZEPHYR_SEGGER_MODULE
	select CLOCK_CONTROL
	select ARM
	select HAS_MCUX
	select CPU_CORTEX_M_HAS_SYSTICK
	select CPU_CORTEX_M_HAS_DWT

config SOC_FAMILY_MCXN_DUAL_CORE_CPU0
	bool
	select CPU_CORTEX_M33
	select CPU_HAS_ARM_SAU
	select CPU_HAS_ARM_MPU
	select CPU_HAS_FPU
	select ARMV8_M_DSP
	select SOC_RESET_HOOK
	select SOC_EARLY_RESET_HOOK if PM_S2RAM
	select ARM_TRUSTZONE_M
	select HAS_MCUX_CACHE
	select CPU_HAS_ICACHE
	select HAS_MCUX_SYSCON_LPCAC
	select HAS_MCUX_ELS_PKC
	select HAS_PM
	select WUC if PM
	select HAS_POWEROFF

config SOC_FAMILY_MCXN_DUAL_CORE_CPU1
	bool
	select CPU_CORTEX_M33
	# Secondary core does not have FPU/MPU/SAU/DSP extensions enabled.

config SOC_FAMILY_MCXN_SINGLE_CORE
	bool
	select CPU_CORTEX_M33
	select CPU_HAS_ARM_SAU
	select CPU_HAS_ARM_MPU
	select CPU_HAS_FPU
	select ARMV8_M_DSP
	select SOC_RESET_HOOK
	select SOC_EARLY_RESET_HOOK if PM_S2RAM
	select ARM_TRUSTZONE_M
	select HAS_CPU_FREQ
	select CPU_HAS_ICACHE
	select HAS_MCUX_SYSCON_LPCAC
	select HAS_MCUX_ELS_PKC
	select HAS_PM
	select WUC if PM
	select HAS_POWEROFF

config SOC_MCXN947_CPU0
	select SOC_FAMILY_MCXN_DUAL_CORE_CPU0

config SOC_MCXN947_CPU1
	select SOC_FAMILY_MCXN_DUAL_CORE_CPU1

config SOC_MCXN947T_CPU0
	select SOC_FAMILY_MCXN_DUAL_CORE_CPU0

config SOC_MCXN947T_CPU1
	select SOC_FAMILY_MCXN_DUAL_CORE_CPU1

config SOC_MCXN946_CPU0
	select SOC_FAMILY_MCXN_DUAL_CORE_CPU0

config SOC_MCXN946_CPU1
	select SOC_FAMILY_MCXN_DUAL_CORE_CPU1

config SOC_MCXN946T_CPU0
	select SOC_FAMILY_MCXN_DUAL_CORE_CPU0

config SOC_MCXN946T_CPU1
	select SOC_FAMILY_MCXN_DUAL_CORE_CPU1

config SOC_MCXN547_CPU0
	select SOC_FAMILY_MCXN_DUAL_CORE_CPU0

config SOC_MCXN547_CPU1
	select SOC_FAMILY_MCXN_DUAL_CORE_CPU1

config SOC_MCXN547T_CPU0
	select SOC_FAMILY_MCXN_DUAL_CORE_CPU0

config SOC_MCXN547T_CPU1
	select SOC_FAMILY_MCXN_DUAL_CORE_CPU1

config SOC_MCXN546_CPU0
	select SOC_FAMILY_MCXN_DUAL_CORE_CPU0

config SOC_MCXN546_CPU1
	select SOC_FAMILY_MCXN_DUAL_CORE_CPU1

config SOC_MCXN546T_CPU0
	select SOC_FAMILY_MCXN_DUAL_CORE_CPU0

config SOC_MCXN546T_CPU1
	select SOC_FAMILY_MCXN_DUAL_CORE_CPU1

config SOC_MCXN557S_CPU0
	select SOC_FAMILY_MCXN_DUAL_CORE_CPU0

config SOC_MCXN557S_CPU1
	select SOC_FAMILY_MCXN_DUAL_CORE_CPU1

config SOC_MCXN557T_CPU0
	select SOC_FAMILY_MCXN_DUAL_CORE_CPU0

config SOC_MCXN557T_CPU1
	select SOC_FAMILY_MCXN_DUAL_CORE_CPU1

config SOC_MCXN556S_CPU0
	select SOC_FAMILY_MCXN_DUAL_CORE_CPU0

config SOC_MCXN556S_CPU1
	select SOC_FAMILY_MCXN_DUAL_CORE_CPU1

config SOC_MCXN556T_CPU0
	select SOC_FAMILY_MCXN_DUAL_CORE_CPU0

config SOC_MCXN556T_CPU1
	select SOC_FAMILY_MCXN_DUAL_CORE_CPU1

config SOC_MCXN537_CPU0
	select SOC_FAMILY_MCXN_DUAL_CORE_CPU0

config SOC_MCXN537_CPU1
	select SOC_FAMILY_MCXN_DUAL_CORE_CPU1

config SOC_MCXN537T_CPU0
	select SOC_FAMILY_MCXN_DUAL_CORE_CPU0

config SOC_MCXN537T_CPU1
	select SOC_FAMILY_MCXN_DUAL_CORE_CPU1

config SOC_MCXN536_CPU0
	select SOC_FAMILY_MCXN_DUAL_CORE_CPU0

config SOC_MCXN536_CPU1
	select SOC_FAMILY_MCXN_DUAL_CORE_CPU1

config SOC_MCXN536T_CPU0
	select SOC_FAMILY_MCXN_DUAL_CORE_CPU0

config SOC_MCXN536T_CPU1
	select SOC_FAMILY_MCXN_DUAL_CORE_CPU1

config SOC_MCXN527_CPU0
	select SOC_FAMILY_MCXN_DUAL_CORE_CPU0

config SOC_MCXN527_CPU1
	select SOC_FAMILY_MCXN_DUAL_CORE_CPU1

config SOC_MCXN527T_CPU0
	select SOC_FAMILY_MCXN_DUAL_CORE_CPU0

config SOC_MCXN527T_CPU1
	select SOC_FAMILY_MCXN_DUAL_CORE_CPU1

config SOC_MCXN526_CPU0
	select SOC_FAMILY_MCXN_DUAL_CORE_CPU0

config SOC_MCXN526_CPU1
	select SOC_FAMILY_MCXN_DUAL_CORE_CPU1

config SOC_MCXN526T_CPU0
	select SOC_FAMILY_MCXN_DUAL_CORE_CPU0

config SOC_MCXN526T_CPU1
	select SOC_FAMILY_MCXN_DUAL_CORE_CPU1

config SOC_MCXN236
	select SOC_FAMILY_MCXN_SINGLE_CORE

config SOC_MCXN235
	select SOC_FAMILY_MCXN_SINGLE_CORE

config SOC_MCXN247
	select SOC_FAMILY_MCXN_SINGLE_CORE
	select HAS_MCUX_CACHE

config SOC_MCXN247T
	select SOC_FAMILY_MCXN_SINGLE_CORE
	select HAS_MCUX_CACHE

config SOC_MCXN246
	select SOC_FAMILY_MCXN_SINGLE_CORE
	select HAS_MCUX_CACHE

config SOC_MCXN246T
	select SOC_FAMILY_MCXN_SINGLE_CORE
	select HAS_MCUX_CACHE

if SOC_FAMILY_MCXN

config SOC_FAMILY_MCXN_DEBUG_IN_LOW_POWER
	bool "Keep the debug logic enabled in low power modes"
	depends on PM
	help
	  Leave the debug logic operational while the core is in a low power
	  mode (CMC DBGCTL[SOD] cleared) so that a debug probe keeps its
	  connection across suspend and resume, at the cost of a higher low
	  power current.

	  Say n to shut the debug logic off on low power entry. A suspended
	  target can then no longer be halted, inspected or reflashed without
	  a reset.

	  Power modes that gate the whole core power domain, such as Deep Power
	  Down, lose the debug logic regardless of this option.

if SOC_MCXN947 || SOC_MCXN947T || SOC_MCXN946 || SOC_MCXN946T || \
	SOC_MCXN557S || SOC_MCXN557T || SOC_MCXN556S || SOC_MCXN556T || \
	SOC_MCXN547 || SOC_MCXN547T || SOC_MCXN546 || SOC_MCXN546T || \
	SOC_MCXN537 || SOC_MCXN537T || SOC_MCXN536 || SOC_MCXN536T || \
	SOC_MCXN527 || SOC_MCXN527T || SOC_MCXN526 || SOC_MCXN526T

config SECOND_CORE_MCUX
	bool "MCXN secondary core"
	depends on HAS_MCUX
	select SOC_LATE_INIT_HOOK if SOC_MCXN947_CPU0 || SOC_MCXN947T_CPU0 || \
		SOC_MCXN946_CPU0 || SOC_MCXN946T_CPU0 || SOC_MCXN557S_CPU0 || \
		SOC_MCXN557T_CPU0 || SOC_MCXN556S_CPU0 || SOC_MCXN556T_CPU0 || \
		SOC_MCXN547_CPU0 || SOC_MCXN547T_CPU0 || SOC_MCXN546_CPU0 || \
		SOC_MCXN546T_CPU0 || SOC_MCXN537_CPU0 || SOC_MCXN537T_CPU0 || \
		SOC_MCXN536_CPU0 || SOC_MCXN536T_CPU0 || SOC_MCXN527_CPU0 || \
		SOC_MCXN527T_CPU0 || SOC_MCXN526_CPU0 || SOC_MCXN526T_CPU0
	help
	  Indicates the second core will be enabled, and the part will run
	  in dual core mode.

config FLASH_DISABLE_CACHE64
	bool "Disable the CACHE64 cache for FlexSPI flash accesses"
	help
	  Disable cache64 cache.

config MCUX_CORE_SUFFIX
	default "_cm33_core0" if SOC_MCXN947_CPU0 || SOC_MCXN947T_CPU0 || \
		SOC_MCXN946_CPU0 || SOC_MCXN946T_CPU0 || SOC_MCXN557S_CPU0 || \
		SOC_MCXN557T_CPU0 || SOC_MCXN556S_CPU0 || SOC_MCXN556T_CPU0 || \
		SOC_MCXN547_CPU0 || SOC_MCXN547T_CPU0 || SOC_MCXN546_CPU0 || \
		SOC_MCXN546T_CPU0 || SOC_MCXN537_CPU0 || SOC_MCXN537T_CPU0 || \
		SOC_MCXN536_CPU0 || SOC_MCXN536T_CPU0 || SOC_MCXN527_CPU0 || \
		SOC_MCXN527T_CPU0 || SOC_MCXN526_CPU0 || SOC_MCXN526T_CPU0
	default "_cm33_core1" if SOC_MCXN947_CPU1 || SOC_MCXN947T_CPU1 || \
		SOC_MCXN946_CPU1 || SOC_MCXN946T_CPU1 || SOC_MCXN557S_CPU1 || \
		SOC_MCXN557T_CPU1 || SOC_MCXN556S_CPU1 || SOC_MCXN556T_CPU1 || \
		SOC_MCXN547_CPU1 || SOC_MCXN547T_CPU1 || SOC_MCXN546_CPU1 || \
		SOC_MCXN546T_CPU1 || SOC_MCXN537_CPU1 || SOC_MCXN537T_CPU1 || \
		SOC_MCXN536_CPU1 || SOC_MCXN536T_CPU1 || SOC_MCXN527_CPU1 || \
		SOC_MCXN527T_CPU1 || SOC_MCXN526_CPU1 || SOC_MCXN526T_CPU1
endif

if SECOND_CORE_MCUX

config SECOND_CORE_MCUX_ACCESS_LEVEL
	int "default TrustZone access level for secondary core"
	default 3
	help
	  Configures AHBSC MASTER_SEC_LEVEL register for the cpu1 before cpu1 is
	  enabled.
endif

config NXP_FLEXSPI_BOOT_HEADER
	bool "Boot header"
	default y if FLASH_MCUX_FLEXSPI_XIP && !BOOTLOADER_MCUBOOT

	help
	  Enable data structures required by the boot ROM to boot the
	  application from an external flash device.

if NXP_FLEXSPI_BOOT_HEADER

config FLEXSPI_CONFIG_BLOCK_OFFSET
	hex "FlexSPI config block offset"
	default 0x400
	help
	  FlexSPI configuration block consists of parameters regarding specific
	  flash devices including read command sequence, quad mode enablement
	  sequence (optional), etc. The boot ROM expects FlexSPI configuration
	  parameter to be presented in serial nor flash.

endif # NXP_FLEXSPI_BOOT_HEADER

rsource "../../common/Kconfig.flexspi_xip"

endif # SOC_FAMILY_MCXN
```
