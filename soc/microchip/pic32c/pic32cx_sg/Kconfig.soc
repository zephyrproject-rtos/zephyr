## soc/microchip/pic32c/pic32cx_sg/Kconfig.soc
```kconfig
# Copyright (c) 2025 Microchip Technology Inc.
# SPDX-License-Identifier: Apache-2.0

config SOC_FAMILY_MICROCHIP_PIC32CX_SG
	bool

config SOC_FAMILY
	default "microchip_pic32cx_sg" if SOC_FAMILY_MICROCHIP_PIC32CX_SG

rsource "*/Kconfig.soc"
```

## soc/microchip/pic32c/pic32cx_sg/pic32cx_sg41/Kconfig.soc
```kconfig
# Copyright (c) 2025 Microchip Technology Inc.
# SPDX-License-Identifier: Apache-2.0

config SOC_SERIES_PIC32CX_SG41
	bool
	select SOC_FAMILY_MICROCHIP_PIC32CX_SG
	help
	  Enable support for Microchip PIC32CX SG41 Cortex-M4F microcontrollers.

config SOC_SERIES
	default "pic32cx_sg41" if SOC_SERIES_PIC32CX_SG41

config SOC_PIC32CX1025SG41064
	bool
	select SOC_SERIES_PIC32CX_SG41

config SOC_PIC32CX1025SG41080
	bool
	select SOC_SERIES_PIC32CX_SG41

config SOC_PIC32CX1025SG41100
	bool
	select SOC_SERIES_PIC32CX_SG41

config SOC_PIC32CX1025SG41128
	bool
	select SOC_SERIES_PIC32CX_SG41

config SOC
	default "pic32cx1025sg41064" if SOC_PIC32CX1025SG41064
	default "pic32cx1025sg41080" if SOC_PIC32CX1025SG41080
	default "pic32cx1025sg41100" if SOC_PIC32CX1025SG41100
	default "pic32cx1025sg41128" if SOC_PIC32CX1025SG41128
```

## soc/microchip/pic32c/pic32cx_sg/pic32cx_sg60/Kconfig.soc
```kconfig
# Copyright (c) 2025 Microchip Technology Inc.
# SPDX-License-Identifier: Apache-2.0

config SOC_SERIES_PIC32CX_SG60
	bool
	select SOC_FAMILY_MICROCHIP_PIC32CX_SG
	help
	  Enable support for Microchip PIC32CX SG60 Cortex-M4F microcontrollers.

config SOC_SERIES
	default "pic32cx_sg60" if SOC_SERIES_PIC32CX_SG60

config SOC_PIC32CX1025SG60100
	bool
	select SOC_SERIES_PIC32CX_SG60

config SOC_PIC32CX1025SG60128
	bool
	select SOC_SERIES_PIC32CX_SG60

config SOC
	default "pic32cx1025sg60100" if SOC_PIC32CX1025SG60100
	default "pic32cx1025sg60128" if SOC_PIC32CX1025SG60128
```

## soc/microchip/pic32c/pic32cx_sg/pic32cx_sg61/Kconfig.soc
```kconfig
# Copyright (c) 2025 Microchip Technology Inc.
# SPDX-License-Identifier: Apache-2.0

config SOC_SERIES_PIC32CX_SG61
	bool
	select SOC_FAMILY_MICROCHIP_PIC32CX_SG
	help
	  Enable support for Microchip PIC32CX SG61 Cortex-M4F microcontrollers.

config SOC_SERIES
	default "pic32cx_sg61" if SOC_SERIES_PIC32CX_SG61

config SOC_PIC32CX1025SG61100
	bool
	select SOC_SERIES_PIC32CX_SG61

config SOC_PIC32CX1025SG61128
	bool
	select SOC_SERIES_PIC32CX_SG61

config SOC
	default "pic32cx1025sg61100" if SOC_PIC32CX1025SG61100
	default "pic32cx1025sg61128" if SOC_PIC32CX1025SG61128
```

## soc/microchip/pic32c/pic32cz_ca/Kconfig
```kconfig
# Copyright (c) 2025 Microchip Technology Inc.
# SPDX-License-Identifier: Apache-2.0

config SOC_FAMILY_MICROCHIP_PIC32CZ_CA
	select ARM
	select MICROCHIP_PIC32C
	select CPU_CORTEX_M7
	select CPU_CORTEX_M_HAS_SYSTICK
	select CPU_CORTEX_M_HAS_VTOR
	select CPU_HAS_ARM_MPU
	select CPU_HAS_FPU_DOUBLE_PRECISION
	select CPU_CORTEX_M_HAS_DWT
	select CPU_HAS_ICACHE
	select CPU_HAS_DCACHE
	select INIT_ARCH_HW_AT_BOOT
	select HAS_SWO
	select XIP
	select HAS_POWEROFF
```

## soc/microchip/pic32c/pic32cz_ca/Kconfig.soc
```kconfig
# Copyright (c) 2025 Microchip Technology Inc.
# SPDX-License-Identifier: Apache-2.0

config SOC_FAMILY_MICROCHIP_PIC32CZ_CA
	bool

config SOC_FAMILY
	default "microchip_pic32cz_ca" if SOC_FAMILY_MICROCHIP_PIC32CZ_CA

rsource "*/Kconfig.soc"
```

## soc/microchip/pic32c/pic32cz_ca/pic32cz_ca80/Kconfig.soc
```kconfig
# Copyright (c) 2025 Microchip Technology Inc.
# SPDX-License-Identifier: Apache-2.0

config SOC_SERIES_PIC32CZ_CA80
	bool
	select SOC_FAMILY_MICROCHIP_PIC32CZ_CA
	help
	  Enable support for Microchip PIC32CZ CA80 Cortex-M7 microcontrollers.

config SOC_SERIES
	default "pic32cz_ca80" if SOC_SERIES_PIC32CZ_CA80

config SOC_PIC32CZ2051CA80100
	bool
	select SOC_SERIES_PIC32CZ_CA80

config SOC_PIC32CZ2051CA80144
	bool
	select SOC_SERIES_PIC32CZ_CA80

config SOC_PIC32CZ2051CA80176
	bool
	select SOC_SERIES_PIC32CZ_CA80

config SOC_PIC32CZ2051CA80208
	bool
	select SOC_SERIES_PIC32CZ_CA80

config SOC_PIC32CZ4010CA80100
	bool
	select SOC_SERIES_PIC32CZ_CA80

config SOC_PIC32CZ4010CA80144
	bool
	select SOC_SERIES_PIC32CZ_CA80

config SOC_PIC32CZ4010CA80176
	bool
	select SOC_SERIES_PIC32CZ_CA80

config SOC_PIC32CZ4010CA80208
	bool
	select SOC_SERIES_PIC32CZ_CA80

config SOC_PIC32CZ8110CA80100
	bool
	select SOC_SERIES_PIC32CZ_CA80

config SOC_PIC32CZ8110CA80144
	bool
	select SOC_SERIES_PIC32CZ_CA80

config SOC_PIC32CZ8110CA80176
	bool
	select SOC_SERIES_PIC32CZ_CA80

config SOC_PIC32CZ8110CA80208
	bool
	select SOC_SERIES_PIC32CZ_CA80

config SOC
	default "pic32cz2051ca80100" if SOC_PIC32CZ2051CA80100
	default "pic32cz2051ca80144" if SOC_PIC32CZ2051CA80144
	default "pic32cz2051ca80176" if SOC_PIC32CZ2051CA80176
	default "pic32cz2051ca80208" if SOC_PIC32CZ2051CA80208
	default "pic32cz4010ca80100" if SOC_PIC32CZ4010CA80100
	default "pic32cz4010ca80144" if SOC_PIC32CZ4010CA80144
	default "pic32cz4010ca80176" if SOC_PIC32CZ4010CA80176
	default "pic32cz4010ca80208" if SOC_PIC32CZ4010CA80208
	default "pic32cz8110ca80100" if SOC_PIC32CZ8110CA80100
	default "pic32cz8110ca80144" if SOC_PIC32CZ8110CA80144
	default "pic32cz8110ca80176" if SOC_PIC32CZ8110CA80176
	default "pic32cz8110ca80208" if SOC_PIC32CZ8110CA80208
```

## soc/microchip/pic32c/pic32cz_ca/pic32cz_ca90/Kconfig.soc
```kconfig
# Copyright (c) 2025 Microchip Technology Inc.
# SPDX-License-Identifier: Apache-2.0

config SOC_SERIES_PIC32CZ_CA90
	bool
	select SOC_FAMILY_MICROCHIP_PIC32CZ_CA
	help
	  Enable support for Microchip PIC32CZ CA90 Cortex-M7 microcontrollers.

config SOC_SERIES
	default "pic32cz_ca90" if SOC_SERIES_PIC32CZ_CA90

config SOC_PIC32CZ2051CA90100
	bool
	select SOC_SERIES_PIC32CZ_CA90

config SOC_PIC32CZ2051CA90144
	bool
	select SOC_SERIES_PIC32CZ_CA90

config SOC_PIC32CZ2051CA90176
	bool
	select SOC_SERIES_PIC32CZ_CA90

config SOC_PIC32CZ2051CA90208
	bool
	select SOC_SERIES_PIC32CZ_CA90

config SOC_PIC32CZ4010CA90100
	bool
	select SOC_SERIES_PIC32CZ_CA90

config SOC_PIC32CZ4010CA90144
	bool
	select SOC_SERIES_PIC32CZ_CA90

config SOC_PIC32CZ4010CA90176
	bool
	select SOC_SERIES_PIC32CZ_CA90

config SOC_PIC32CZ4010CA90208
	bool
	select SOC_SERIES_PIC32CZ_CA90

config SOC_PIC32CZ8110CA90100
	bool
	select SOC_SERIES_PIC32CZ_CA90

config SOC_PIC32CZ8110CA90144
	bool
	select SOC_SERIES_PIC32CZ_CA90

config SOC_PIC32CZ8110CA90176
	bool
	select SOC_SERIES_PIC32CZ_CA90

config SOC_PIC32CZ8110CA90208
	bool
	select SOC_SERIES_PIC32CZ_CA90

config SOC
	default "pic32cz2051ca90100" if SOC_PIC32CZ2051CA90100
	default "pic32cz2051ca90144" if SOC_PIC32CZ2051CA90144
	default "pic32cz2051ca90176" if SOC_PIC32CZ2051CA90176
	default "pic32cz2051ca90208" if SOC_PIC32CZ2051CA90208
	default "pic32cz4010ca90100" if SOC_PIC32CZ4010CA90100
	default "pic32cz4010ca90144" if SOC_PIC32CZ4010CA90144
	default "pic32cz4010ca90176" if SOC_PIC32CZ4010CA90176
	default "pic32cz4010ca90208" if SOC_PIC32CZ4010CA90208
	default "pic32cz8110ca90100" if SOC_PIC32CZ8110CA90100
	default "pic32cz8110ca90144" if SOC_PIC32CZ8110CA90144
	default "pic32cz8110ca90176" if SOC_PIC32CZ8110CA90176
	default "pic32cz8110ca90208" if SOC_PIC32CZ8110CA90208
```

## soc/microchip/pic32c/pic32cz_ca/pic32cz_ca91/Kconfig.soc
```kconfig
# Copyright (c) 2025 Microchip Technology Inc.
# SPDX-License-Identifier: Apache-2.0

config SOC_SERIES_PIC32CZ_CA91
	bool
	select SOC_FAMILY_MICROCHIP_PIC32CZ_CA
	help
	  Enable support for Microchip PIC32CZ CA91 Cortex-M7 microcontrollers.

config SOC_SERIES
	default "pic32cz_ca91" if SOC_SERIES_PIC32CZ_CA91

config SOC_PIC32CZ2051CA91100
	bool
	select SOC_SERIES_PIC32CZ_CA91

config SOC_PIC32CZ2051CA91144
	bool
	select SOC_SERIES_PIC32CZ_CA91

config SOC_PIC32CZ2051CA91176
	bool
	select SOC_SERIES_PIC32CZ_CA91

config SOC_PIC32CZ4010CA91100
	bool
	select SOC_SERIES_PIC32CZ_CA91

config SOC_PIC32CZ4010CA91144
	bool
	select SOC_SERIES_PIC32CZ_CA91

config SOC_PIC32CZ4010CA91176
	bool
	select SOC_SERIES_PIC32CZ_CA91

config SOC_PIC32CZ4010CA91208
	bool
	select SOC_SERIES_PIC32CZ_CA91

config SOC
	default "pic32cz2051ca91100" if SOC_PIC32CZ2051CA91100
	default "pic32cz2051ca91144" if SOC_PIC32CZ2051CA91144
	default "pic32cz2051ca91176" if SOC_PIC32CZ2051CA91176
	default "pic32cz4010ca91100" if SOC_PIC32CZ4010CA91100
	default "pic32cz4010ca91144" if SOC_PIC32CZ4010CA91144
	default "pic32cz4010ca91176" if SOC_PIC32CZ4010CA91176
	default "pic32cz4010ca91208" if SOC_PIC32CZ4010CA91208
```

## soc/microchip/pic32cmmc/Kconfig
```kconfig
# Copyright (c) 2025 GP Orcullo
# SPDX-License-Identifier: Apache-2.0

config SOC_FAMILY_MICROCHIP_PIC32CMMC
	select HAS_SEGGER_RTT if ZEPHYR_SEGGER_MODULE

if SOC_FAMILY_MICROCHIP_PIC32CMMC

rsource "*/Kconfig"

endif # SOC_FAMILY_MICROCHIP_PIC32CMMC
```

## soc/microchip/pic32cmmc/Kconfig.defconfig
```kconfig
# Microchip PIC32CM MCU family default config options

# Copyright (c) 2025 GP Orcullo
# SPDX-License-Identifier: Apache-2.0

if SOC_FAMILY_MICROCHIP_PIC32CMMC

rsource "*/Kconfig.defconfig"

config SYS_CLOCK_HW_CYCLES_PER_SEC
	default $(dt_node_int_prop_int,/cpus/cpu@0,clock-frequency)

endif # SOC_FAMILY_MICROCHIP_PIC32CMMC
```

## soc/microchip/pic32cmmc/Kconfig.soc
```kconfig
# Copyright (c) 2025 GP Orcullo
# SPDX-License-Identifier: Apache-2.0

config SOC_FAMILY_MICROCHIP_PIC32CMMC
	bool

config SOC_FAMILY
	default "microchip_pic32cmmc" if SOC_FAMILY_MICROCHIP_PIC32CMMC

rsource "*/Kconfig.soc"
```

## soc/microchip/pic32cmmc/pic32cmmc00/Kconfig
```kconfig
# Microchip PIC32CM MC00 series

# Copyright (c) 2025 GP Orcullo
# SPDX-License-Identifier: Apache-2.0

config SOC_SERIES_PIC32CMMC00
	select ARM
	select CPU_CORTEX_M0PLUS
	select CPU_CORTEX_M_HAS_SYSTICK
	select CPU_CORTEX_M_HAS_VTOR
	select SOC_RESET_HOOK
```

## soc/microchip/pic32cmmc/pic32cmmc00/Kconfig.defconfig
```kconfig
# Microchip PIC32CM MC00 series config options

# Copyright (c) 2025 GP Orcullo
# SPDX-License-Identifier: Apache-2.0

if SOC_SERIES_PIC32CMMC00

config NUM_IRQS
	default 32

endif # SOC_SERIES_PIC32CMMC00
```

## soc/microchip/pic32cmmc/pic32cmmc00/Kconfig.soc
```kconfig
# Microchip PIC32CM MC00 series

# Copyright (c) 2025 GP Orcullo
# SPDX-License-Identifier: Apache-2.0

config SOC_SERIES_PIC32CMMC00
	bool
	select SOC_FAMILY_MICROCHIP_PIC32CMMC
	help
	  Enable support for Microhip PIC32CM MC00 Cortex-M0+ microcontrollers.

config SOC_SERIES
	default "pic32cmmc00" if SOC_SERIES_PIC32CMMC00

config SOC_PIC32CM6408MC00032
	bool
	select SOC_SERIES_PIC32CMMC00

config SOC_PIC32CM6408MC00048
	bool
	select SOC_SERIES_PIC32CMMC00

config SOC_PIC32CM1216MC00032
	bool
	select SOC_SERIES_PIC32CMMC00

config SOC_PIC32CM1216MC00048
	bool
	select SOC_SERIES_PIC32CMMC00

config SOC
	default "pic32cm6408mc00032" if SOC_PIC32CM6408MC00032
	default "pic32cm6408mc00048" if SOC_PIC32CM6408MC00048
	default "pic32cm1216mc00032" if SOC_PIC32CM1216MC00032
	default "pic32cm1216mc00048" if SOC_PIC32CM1216MC00048
```

## soc/microchip/pic32cxsg/Kconfig
```kconfig
# Microchip PIC32CXSG MCU family configuration options

# Copyright (c) 2024 Microchip
# SPDX-License-Identifier: Apache-2.0

config SOC_FAMILY_MICROCHIP_PIC32CXSG
	select PIC32C
	select HAS_SEGGER_RTT if ZEPHYR_SEGGER_MODULE

if SOC_FAMILY_MICROCHIP_PIC32CXSG

rsource "common/Kconfig.pic32cxsg"
rsource "*/Kconfig"

endif # SOC_FAMILY_MICROCHIP_PIC32CXSG
```

## soc/microchip/pic32cxsg/Kconfig.defconfig
```kconfig
# Microchip PIC32CXSG MCU family default configuration options

# Copyright (c) 2024 Microchip

# SPDX-License-Identifier: Apache-2.0

if SOC_FAMILY_MICROCHIP_PIC32CXSG

rsource "*/Kconfig.defconfig"

config GPIO
	default y

config SYS_CLOCK_HW_CYCLES_PER_SEC
	default $(dt_node_int_prop_int,/cpus/cpu@0,clock-frequency)

if USB_DEVICE_DRIVER

config HEAP_MEM_POOL_ADD_SIZE_SOC
	def_int 1024

endif # USB_DEVICE_DRIVER

endif # SOC_FAMILY_MICROCHIP_PIC32CXSG
```

## soc/microchip/pic32cxsg/Kconfig.soc
```kconfig
# Microchip PIC32CXSG MCU family

# Copyright (c) 2024 Microchip

# SPDX-License-Identifier: Apache-2.0

config SOC_FAMILY_MICROCHIP_PIC32CXSG
	bool

config SOC_FAMILY
	default "microchip_pic32cxsg" if SOC_FAMILY_MICROCHIP_PIC32CXSG

rsource "*/Kconfig.soc"
```

## soc/microchip/pic32cxsg/common/Kconfig.pic32cxsg
```kconfig
# Copyright (c) 2024 Microchip

# SPDX-License-Identifier: Apache-2.0

if SOC_FAMILY_MICROCHIP_PIC32CXSG

config SOC_MICROCHIP_PIC32CXSG_XOSC32K
	bool "The external 32 kHz crystal oscillator"
	default y if DT_HAS_ATMEL_SAM0_OSC32KCTRL_ENABLED
	help
	  Enable gclk device tree node to use 32K crystal
	  as clock source. If not enabled the soc will be
	  configured for internal oscillator.

endif
```

## soc/microchip/pic32cxsg/pic32cxsg41/Kconfig.defconfig
```kconfig
# Microchip PIC32CXSG MCU series configuration options

# Copyright (c) 2024 Microchip

# SPDX-License-Identifier: Apache-2.0

if SOC_SERIES_PIC32CXSG41

config NUM_IRQS
	default 137

config ROM_START_OFFSET
	default 0x400 if BOOTLOADER_MCUBOOT

endif # SOC_SERIES_PIC32CXSG41
```

## soc/microchip/pic32cxsg/pic32cxsg41/Kconfig.soc
```kconfig
# Microchip PIC29CXSG41 MCU series

# Copyright (c) 2024 Microchip

# SPDX-License-Identifier: Apache-2.0

config SOC_SERIES_PIC32CXSG41
	bool
	select SOC_FAMILY_MICROCHIP_PIC32CXSG
	help
	  Enable support for Microchip PIC32CXSG Cortex-M4F microcontrollers.

config SOC_SERIES
	default "pic32cxsg41" if SOC_SERIES_PIC32CXSG41

config SOC_PIC32CX1025SG41064
	bool
	select SOC_SERIES_PIC32CXSG41

config SOC_PIC32CX1025SG41080
	bool
	select SOC_SERIES_PIC32CXSG41

config SOC_PIC32CX1025SG41100
	bool
	select SOC_SERIES_PIC32CXSG41

config SOC_PIC32CX1025SG41128
	bool
	select SOC_SERIES_PIC32CXSG41

config SOC
	default "pic32cx1025sg41064" if SOC_PIC32CX1025SG41064
	default "pic32cx1025sg41080" if SOC_PIC32CX1025SG41080
	default "pic32cx1025sg41100" if SOC_PIC32CX1025SG41100
	default "pic32cx1025sg41128" if SOC_PIC32CX1025SG41128
```

## soc/microchip/pic32cxsg/pic32cxsg60/Kconfig.soc
```kconfig
# Microchip PIC32CXSG60 MCU series

# Copyright (c) 2024 Microchip

# SPDX-License-Identifier: Apache-2.0

config SOC_SERIES_PIC32CXSG60
	bool
	select SOC_FAMILY_MICROCHIP_PIC32CXSG
	help
	  Enable support for Microchip PIC32CXSG Cortex-M4F microcontrollers.

config SOC_SERIES
	default "pic32cxsg60" if SOC_SERIES_PIC32CXSG60

config SOC_PIC32CX1025SG60100
	bool
	select SOC_SERIES_PIC32CXSG60

config SOC_PIC32CX1025SG60128
	bool
	select SOC_SERIES_PIC32CXSG60

config SOC
	default "pic32cx1025sg60100" if SOC_PIC32CX1025SG60100
	default "pic32cx1025sg60128" if SOC_PIC32CX1025SG60128
```

## soc/microchip/pic32cxsg/pic32cxsg61/Kconfig
```kconfig
# Microchip PIC32CXSG MCU series

# Copyright (c) 2024 Microchip

# SPDX-License-Identifier: Apache-2.0

config SOC_SERIES_PIC32CXSG61
	select ARM
	select CPU_CORTEX_M4
	select CPU_CORTEX_M_HAS_DWT
	select CPU_HAS_ARM_MPU
	select CPU_HAS_FPU
	select PLATFORM_SPECIFIC_INIT
```

## soc/microchip/pic32cxsg/pic32cxsg61/Kconfig.soc
```kconfig
# Microchip PIC32CXSG61 MCU series

# Copyright (c) 2024 Microchip

# SPDX-License-Identifier: Apache-2.0

config SOC_SERIES_PIC32CXSG61
	bool
	select SOC_FAMILY_MICROCHIP_PIC32CXSG
	help
	  Enable support for Microchip PIC32CXSG Cortex-M4F microcontrollers.

config SOC_SERIES
	default "pic32cxsg61" if SOC_SERIES_PIC32CXSG61

config SOC_PIC32CX1025SG61100
	bool
	select SOC_SERIES_PIC32CXSG61

config SOC_PIC32CX1025SG61128
	bool
	select SOC_SERIES_PIC32CXSG61

config SOC
	default "pic32cx1025sg61100" if SOC_PIC32CX1025SG61100
	default "pic32cx1025sg61128" if SOC_PIC32CX1025SG61128
```

## soc/microchip/pic64/Kconfig.defconfig
```kconfig
# Copyright (c) 2025 Microchip Technology Inc
# SPDX-License-Identifier: Apache-2.0

if SOC_FAMILY_MICROCHIP_PIC64

rsource "*/Kconfig.defconfig"

endif # SOC_FAMILY_MICROCHIP_PIC64
```
