## soc/microchip/sam/sama7/sama7d6/Kconfig.soc
```kconfig
# Copyright (C) 2025 Microchip Technology Inc. and its subsidiaries
#
# SPDX-License-Identifier: Apache-2.0
#

config SOC_SERIES_SAMA7D6
	bool
	select SOC_FAMILY_MICROCHIP_SAMA7
	help
	  Enable support for Microchip SAMA7D6 Cortex-A Microprocessors.

config SOC_SERIES
	default "sama7d6" if SOC_SERIES_SAMA7D6

config SOC_SAMA7D65
	bool
	select SOC_SERIES_SAMA7D6

config SOC_SAMA7D65D1G
	bool
	select SOC_SERIES_SAMA7D6

config SOC_SAMA7D65D1GN2
	bool
	select SOC_SERIES_SAMA7D6

config SOC_SAMA7D65D2G
	bool
	select SOC_SERIES_SAMA7D6

config SOC_SAMA7D65D2GN8
	bool
	select SOC_SERIES_SAMA7D6

config SOC_SAMA7D65D5M
	bool
	select SOC_SERIES_SAMA7D6

config SOC
	default "sama7d65" if SOC_SAMA7D65
	default "sama7d65d1g" if SOC_SAMA7D65D1G
	default "sama7d65d1gn2" if SOC_SAMA7D65D1GN2
	default "sama7d65d2g" if SOC_SAMA7D65D2G
	default "sama7d65d2gn8" if SOC_SAMA7D65D2GN8
	default "sama7d65d5m" if SOC_SAMA7D65D5M
```

## soc/microchip/sam/sama7/sama7g5/Kconfig.defconfig
```kconfig
# Copyright (C) 2025 Microchip Technology Inc. and its subsidiaries
#
# SPDX-License-Identifier: Apache-2.0
#

if SOC_SERIES_SAMA7G5

configdefault NUM_IRQS
	default 187

configdefault SYS_CLOCK_HW_CYCLES_PER_SEC
	default $(dt_node_int_prop_int,/soc/timer@e1800000,clock-frequency)

endif # SOC_SERIES_SAMA7G5
```

## soc/microchip/sam/sama7/sama7g5/Kconfig.soc
```kconfig
# Copyright (C) 2025 Microchip Technology Inc. and its subsidiaries
#
# SPDX-License-Identifier: Apache-2.0
#

config SOC_SERIES_SAMA7G5
	bool
	select SOC_FAMILY_MICROCHIP_SAMA7
	help
	  Enable support for Microchip SAMA7G5 Cortex-A Microprocessors.

config SOC_SERIES
	default "sama7g5" if SOC_SERIES_SAMA7G5

config SOC_SAMA7G54
	bool
	select SOC_SERIES_SAMA7G5

config SOC_SAMA7G54D1G
	bool
	select SOC_SERIES_SAMA7G5

config SOC_SAMA7G54D1GN0
	bool
	select SOC_SERIES_SAMA7G5

config SOC_SAMA7G54D1GN2
	bool
	select SOC_SERIES_SAMA7G5

config SOC_SAMA7G54D2G
	bool
	select SOC_SERIES_SAMA7G5

config SOC_SAMA7G54D2GN4
	bool
	select SOC_SERIES_SAMA7G5

config SOC_SAMA7G54D4G
	bool
	select SOC_SERIES_SAMA7G5

config SOC
	default "sama7g54" if SOC_SAMA7G54
	default "sama7g54d1g" if SOC_SAMA7G54D1G
	default "sama7g54d1gn0" if SOC_SAMA7G54D1GN0
	default "sama7g54d1gn2" if SOC_SAMA7G54D1GN2
	default "sama7g54d2g" if SOC_SAMA7G54D2G
	default "sama7g54d2gn4" if SOC_SAMA7G54D2GN4
	default "sama7g54d4g" if SOC_SAMA7G54D4G
```

## soc/microchip/sam/sama7/sama7g5/Kconfig.soc.sama7g54
```kconfig
# Copyright (C) 2025 Microchip Technology Inc. and its subsidiaries
#
# SPDX-License-Identifier: Apache-2.0
#

config SOC_SAMA7G54
	bool
	select SOC_SERIES_SAMA7G5

config SOC
	default "sama7g54" if SOC_SAMA7G54
```

## soc/microchip/sam/sama7d6/Kconfig.soc.sama7d65
```kconfig
# Copyright (C) 2025 Microchip Technology Inc. and its subsidiaries
#
# SPDX-License-Identifier: Apache-2.0
#

config SOC_SAMA7D65
	bool
	select SOC_SERIES_SAMA7D6

config SOC
	default "sama7d65" if SOC_SAMA7D65
```

## soc/microchip/sam/sama7g5/Kconfig.defconfig
```kconfig
# Copyright (C) 2025 Microchip Technology Inc. and its subsidiaries
#
# SPDX-License-Identifier: Apache-2.0
#

if SOC_SERIES_SAMA7G5

config NUM_IRQS
	default 187

config SYS_CLOCK_HW_CYCLES_PER_SEC
	default $(dt_node_int_prop_int,/soc/timer@e1800000,clock-frequency)

config MMU
	default y

config CACHE_MANAGEMENT
	default y

endif # SOC_SERIES_SAMA7G5
```

## soc/microchip/sam/sama7g5/Kconfig.soc
```kconfig
# Copyright (C) 2025 Microchip Technology Inc. and its subsidiaries
#
# SPDX-License-Identifier: Apache-2.0
#

config SOC_SERIES_SAMA7G5
	bool
	select SOC_FAMILY_MICROCHIP_SAM
	help
	  Enable support for Microchip SAM Microprocessors.

config SOC_SERIES
	default "sama7g5" if SOC_SERIES_SAMA7G5

rsource "Kconfig.soc.sam*"
```

## soc/microchip/smartfusion2/Kconfig
```kconfig
## SPDX-FileCopyrightText: Copyright Bavariamatic GmbH
## SPDX-License-Identifier: Apache-2.0

config SOC_SERIES_SMARTFUSION2
	select ARM
	select CPU_CORTEX_M3
	select CPU_HAS_ARM_MPU
	select CPU_CORTEX_M_HAS_DWT
	select SOC_EARLY_INIT_HOOK
```

## soc/microchip/smartfusion2/Kconfig.defconfig
```kconfig
## SPDX-FileCopyrightText: Copyright Bavariamatic GmbH
## SPDX-License-Identifier: Apache-2.0

if SOC_SERIES_SMARTFUSION2

config NUM_IRQS
	default 82

config SYS_CLOCK_HW_CYCLES_PER_SEC
	default $(dt_node_int_prop_int,/cpus/cpu@0,clock-frequency)

endif
```

## soc/microchip/smartfusion2/Kconfig.soc
```kconfig
## SPDX-FileCopyrightText: Copyright Bavariamatic GmbH
## SPDX-License-Identifier: Apache-2.0

config SOC_FAMILY_MICROCHIP
	bool

config SOC_FAMILY
	default "microchip" if SOC_FAMILY_MICROCHIP

config SOC_SERIES_SMARTFUSION2
	bool
	select SOC_FAMILY_MICROCHIP
	help
	  Microchip SmartFusion2 series.

config SOC_M2S010
	bool
	select SOC_SERIES_SMARTFUSION2
	help
	  Microchip SmartFusion2 M2S010.

config SOC_SERIES
	default "smartfusion2" if SOC_SERIES_SMARTFUSION2

config SOC
	default "m2s010" if SOC_M2S010
```

## soc/mips/mt76x8/Kconfig.defconfig
```kconfig
# Copyright (c) 2021 Antony Pavlov <antonynpavlov@gmail.com>
#
# SPDX-License-Identifier: Apache-2.0

if SOC_MT76X8

config SOC
	default "mt76x8"

config SYS_CLOCK_HW_CYCLES_PER_SEC
	default 580000000

config NUM_IRQS
	default 8

endif # SOC_MT76X8
```

## soc/mips/mt76x8/Kconfig.soc
```kconfig
# Copyright (c) 2021 Antony Pavlov <antonynpavlov@gmail.com>
#
# SPDX-License-Identifier: Apache-2.0

config SOC_MT76X8
	bool "Mediatek MT76x8"
	select MIPS
```

## soc/native/inf_clock/Kconfig
```kconfig
# Copyright (c) 2023 Nordic Semiconductor ASA
# SPDX-License-Identifier: Apache-2.0

config SOC_POSIX
	select ARCH_POSIX
	select CPU_HAS_FPU
	select HAS_CPU_FREQ

if SOC_POSIX

config NATIVE_SIMULATOR_MCU_N
	int "CPU Number this image targets"
	range 0 15
	default 0
	help
	  Which native simulator microcontroller/CPU number is this image targeting.
	  This option is only applicable for targets which use the
	  native simulator as their runner.

config NATIVE_SIMULATOR_NUMBER_MCUS
	int "Total number of MCUs this target has"
	range 1 16
	default 1
	help
	  How many AMP MCUs does this target have in total.

config NATIVE_SIMULATOR_PRIMARY_MCU_INDEX
	int "Which CPU is the primary/preferred"
	default 0
	help
	  On a multi MCU device, which MCU is the preferred one.
	  This MCU will for example have its tests command line parameters presented
	  without any prefix. Note that an MCU being primary does not imply it will be
	  the first one to boot, or even that it will boot automatically.

config NATIVE_SIMULATOR_EXTRA_IMAGE_PATHS
	string "Other cores images to include"
	help
	  This option can be used to provide the native simulator with other MCUs/Cores images which have
	  been produced by either other Zephyr builds or different OS builds.
	  So you can, for ex., use this application build to produce one core image, and at the same time
	  have it produce the final link with the native simulator runner and the other MCU images.

config NATIVE_SIMULATOR_AUTOSTART_MCU
	bool "Auto-start this MCU"
	help
	  Automatically start the MCU this Zephyr image is built for during HW boot,
	  even if in other circumstances this MCU would not start automatically (for ex. because
	  another core is meant to release its reset).
	  If that MCU was, by HW design, going to start at HW boot anyhow, this option does nothing.
	  This option is meant to facilitate development.

endif # SOC_POSIX
```

## soc/neorv32/Kconfig
```kconfig
# Copyright (c) 2021,2025 Henrik Brix Andersen <henrik@brixandersen.dk>
# SPDX-License-Identifier: Apache-2.0

config SOC_NEORV32
	select RISCV
	select RISCV_PRIVILEGED
	select RISCV_SOC_HAS_GP_RELATIVE_ADDRESSING
	select RISCV_ISA_EXT_ZICSR
	select RISCV_ISA_EXT_ZIFENCEI
	imply XIP

if SOC_NEORV32

config SOC_NEORV32_VERSION
	hex
	default 0x01110200
	help
	  The targeted NEORV32 version as BCD-coded number. The format is
	  identical to that of the NEORV32 Machine implementation ID (mimpid)
	  register.

config SOC_NEORV32_READ_FREQUENCY_AT_RUNTIME
	bool "Read the NEORV32 clock frequency at runtime"
	default y
	depends on !$(dt_node_has_prop,/cpus/cpu@0,clock-frequency)
	depends on SYS_CLOCK_EXISTS
	select SOC_EARLY_INIT_HOOK
	select TIMER_READS_ITS_FREQUENCY_AT_RUNTIME
	help
	  If enabled, the NEORV32 clock frequency will be read from SYSINFO during boot. This
	  results in small overhead, which can be avoided by setting the clock-frequency property of
	  the cpu@0 devicetree node if the frequency is known at build-time.

endif # SOC_NEORV32
```

## soc/neorv32/Kconfig.defconfig
```kconfig
# Copyright (c) 2021,2025 Henrik Brix Andersen <henrik@brixandersen.dk>
# SPDX-License-Identifier: Apache-2.0

if SOC_NEORV32

config SYS_CLOCK_HW_CYCLES_PER_SEC
	default $(dt_node_int_prop_int,/cpus/cpu@0,clock-frequency) if !SOC_NEORV32_READ_FREQUENCY_AT_RUNTIME

config NUM_IRQS
	default 32

config SYSCON
	default y

endif # SOC_NEORV32
```

## soc/neorv32/Kconfig.soc
```kconfig
# Copyright (c) 2021 Henrik Brix Andersen <henrik@brixandersen.dk>
# SPDX-License-Identifier: Apache-2.0

config SOC_NEORV32
	bool
	help
	  NEORV32 Processor (SoC).

	  The NEORV32 CPU implementation must have the following RISC-V ISA
	  extensions enabled in order to support Zephyr:
	  - Zicsr (always enabled)
	  - Zifencei (always enabled)
	  - Zicntr

config SOC
	default "neorv32" if SOC_NEORV32
```

## soc/nios2/nios2-qemu/Kconfig.defconfig
```kconfig
# SPDX-License-Identifier: Apache-2.0

if SOC_NIOS2_QEMU

config SOC
	default "nios2-qemu"

config SYS_CLOCK_HW_CYCLES_PER_SEC
	default 50000000

endif
```

## soc/nios2/nios2-qemu/Kconfig.soc
```kconfig
# SPDX-License-Identifier: Apache-2.0

config SOC_NIOS2_QEMU
	bool "Nios II - Experimental QEMU emulation"
	select NIOS2
	select HAS_MUL_INSTRUCTION
	select HAS_DIV_INSTRUCTION
	select HAS_MULX_INSTRUCTION
```

## soc/nios2/nios2f-zephyr/Kconfig.defconfig
```kconfig
# SPDX-License-Identifier: Apache-2.0

if SOC_NIOS2F_ZEPHYR

config SOC
	default "nios2f-zephyr"

config SYS_CLOCK_HW_CYCLES_PER_SEC
	default 50000000

config ALTERA_AVALON_SYSID
	def_bool y

config ALTERA_AVALON_QSPI
	def_bool y
	depends on SOC_FLASH_NIOS2_QSPI

config ALTERA_AVALON_I2C
	def_bool y
	depends on I2C_NIOS2

config ALTERA_AVALON_MSGDMA
	def_bool y
	depends on DMA_NIOS2_MSGDMA

endif # SOC_NIOS2F_ZEPHYR
```

## soc/nios2/nios2f-zephyr/Kconfig.soc
```kconfig
# SPDX-License-Identifier: Apache-2.0

config SOC_NIOS2F_ZEPHYR
	bool "Nios IIf - Zephyr Golden Configuration"
	select HAS_MUL_INSTRUCTION
	select HAS_DIV_INSTRUCTION
```
