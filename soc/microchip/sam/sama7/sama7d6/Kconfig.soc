## soc/nordic/Kconfig
```kconfig
# Nordic Semiconductor nRFx MCU line

# Copyright (c) 2016-2018 Nordic Semiconductor ASA
# SPDX-License-Identifier: Apache-2.0

# This file is contains Zephyr build system Kconfig references and is not
# re-usable outside the Zephyr tree.

config SOC_FAMILY_NORDIC_NRF
	select SOC_COMPATIBLE_NRF
	select SOC_RESET_HOOK if ARM
	select CMSIS_CORE_HAS_SYSTEM_CORE_CLOCK if ARM

if SOC_FAMILY_NORDIC_NRF

rsource "common/Kconfig.peripherals"
rsource "*/Kconfig"

config NRF_SOC_SECURE_SUPPORTED
	def_bool !TRUSTED_EXECUTION_NONSECURE || (BUILD_WITH_TFM && TFM_PARTITION_PLATFORM)
	depends on !SOC_SERIES_NRF54HX
	depends on !SOC_SERIES_NRF92X
	help
	  Hidden function to indicate that the soc_secure functions are
	  available.
	  The functions are always available when not in non-secure.
	  For non-secure the functions must redirect to secure services exposed
	  by the secure firmware.

config BUILD_WITH_TFM
	default y if TRUSTED_EXECUTION_NONSECURE
	help
	  By default, if we build for a Non-Secure version of the board,
	  enable building with TF-M as the Secure Execution Environment.

if BUILD_WITH_TFM

config TFM_FLASH_MERGED_BINARY
	default y
	help
	  By default, if we build with TF-M, instruct build system to
	  flash the combined TF-M (Secure) & Zephyr (Non Secure) image

config TFM_LOG_LEVEL_SILENCE
	default y if !$(dt_nodelabel_has_prop,uart1,pinctrl-names)
	help
	  Disable TF-M secure output if the uart1 node has not assigned GPIO
	  pins using pinctrl.

config TFM_NRF_NS_STORAGE
	bool "TF-M non-secure storage partition"
	default y

endif # BUILD_WITH_TFM


config NRF_MPU_FLASH_REGION_SIZE
	hex
	default 0x1000
	depends on HAS_HW_NRF_MPU
	help
	  FLASH region size for the NRF_MPU peripheral.

config NRF_BPROT_FLASH_REGION_SIZE
	hex
	default $(dt_node_int_prop_hex,$(DT_CHOSEN_ZEPHYR_FLASH),erase-block-size)
	depends on HAS_HW_NRF_BPROT
	help
	  FLASH region size for the NRF_BPROT peripheral (nRF52).

config NRF_ACL_FLASH_REGION_SIZE
	hex
	default $(dt_node_int_prop_hex,$(DT_CHOSEN_ZEPHYR_FLASH),erase-block-size)
	depends on HAS_HW_NRF_ACL
	help
	  FLASH region size for the NRF_ACL peripheral.

config NFCT_PINS_AS_GPIOS
	bool "[DEPRECATED] NFCT pins as GPIOs"
	depends on $(dt_has_compat,$(DT_COMPAT_NORDIC_NRF_NFCT))
	select DEPRECATED
	help
	  Two pins are usually reserved for NFC in SoCs that implement the
	  NFCT peripheral. This option switches them to normal GPIO mode.
	  HW enabling happens once in the device lifetime, during the first
	  system startup. Disabling this option will not switch back these
	  pins to NFCT mode. Doing this requires UICR erase prior to
	  flashing device using the image which has this option disabled.

	  NFC pins in nRF52 series: P0.09 and P0.10
	  NFC pins in nRF5340: P0.02 and P0.03

	  This option is deprecated, please use devicetree to configure NFCT
	  pins as GPIOS like this:

	  &uicr {
	      nfct-pins-as-gpios;
	  };

choice NRF_APPROTECT_HANDLING
	bool "APPROTECT handling"
	depends on SOC_SERIES_NRF52X || SOC_SERIES_NRF53X || SOC_NRF54L_CPUAPP_COMMON || \
		   SOC_SERIES_NRF91X
	default NRF_APPROTECT_DISABLE if SOC_NRF54L_CPUAPP_COMMON
	default NRF_APPROTECT_USE_UICR
	help
	  Specifies how the SystemInit() function should handle the APPROTECT
	  mechanism.

config NRF_APPROTECT_DISABLE
	bool "Disable"
	depends on SOC_NRF54L_CPUAPP_COMMON
	help
	  When this option is selected, the SystemInit() disables
	  the APPROTECT mechanism.

config NRF_APPROTECT_USE_UICR
	bool "Use UICR"
	depends on SOC_SERIES_NRF52X || SOC_SERIES_NRF53X || SOC_SERIES_NRF91X
	help
	  When this option is selected, the SystemInit() function loads the
	  firmware branch state of the APPROTECT mechanism from UICR, so if
	  UICR->APPROTECT is disabled, CTRLAP->APPROTECT will be disabled.

config NRF_APPROTECT_LOCK
	bool "Lock"
	help
	  When this option is selected, the SystemInit() function locks
	  the firmware branch of the APPROTECT mechanism, preventing it
	  from being opened.

config NRF_APPROTECT_USER_HANDLING
	bool "Allow user handling"
	depends on !SOC_SERIES_NRF52X
	help
	  When this option is selected, the SystemInit() function does not
	  touch the APPROTECT mechanism, allowing the user code to handle it
	  at later stages, for example, to implement authenticated debug.

endchoice

choice NRF_SECURE_APPROTECT_HANDLING
	bool "Secure APPROTECT handling"
	depends on SOC_NRF5340_CPUAPP || SOC_NRF54L_CPUAPP_COMMON || SOC_SERIES_NRF91X
	default NRF_SECURE_APPROTECT_DISABLE if SOC_NRF54L_CPUAPP_COMMON
	default NRF_SECURE_APPROTECT_USE_UICR
	help
	  Specifies how the SystemInit() function should handle the secure
	  APPROTECT mechanism.

config NRF_SECURE_APPROTECT_DISABLE
	bool "Disable"
	depends on SOC_NRF54L_CPUAPP_COMMON
	help
	  When this option is selected, the SystemInit() disables
	  the secure APPROTECT mechanism.

config NRF_SECURE_APPROTECT_USE_UICR
	bool "Use UICR"
	depends on SOC_NRF5340_CPUAPP || SOC_SERIES_NRF91X
	help
	  When this option is selected, the SystemInit() function loads the
	  firmware branch state of the secure APPROTECT mechanism from UICR,
	  so if UICR->SECUREAPPROTECT is disabled, CTRLAP->SECUREAPPROTECT
	  will be disabled.

config NRF_SECURE_APPROTECT_LOCK
	bool "Lock"
	help
	  When this option is selected, the SystemInit() function locks the
	  firmware branch of the secure APPROTECT mechanism, preventing it
	  from being opened.

config NRF_SECURE_APPROTECT_USER_HANDLING
	bool "Allow user handling"
	depends on !SOC_SERIES_NRF52X
	help
	  When this option is selected, the SystemInit() function does not
	  touch the secure APPROTECT mechanism, allowing the user code to
	  handle it at later stages, for example, to implement authenticated
	  debug.

endchoice

config NRF_TRACE_PORT
	bool "nRF TPIU"
	depends on !SOC_SERIES_NRF51X
	help
	  Enable this option to initialize the TPIU (Trace Port Interface
	  Unit) for tracing using a hardware probe. If disabled, the trace
	  pins will be used as GPIO.

config NRF_PLATFORM_HALTIUM
	bool
	help
	  SoC series based on the Nordic nRF Haltium platform need to select
	  this option. This allows to easily enable common functionality on
	  SoCs based on the Haltium platform.

config DEPRECATED_UART_NRFX_UARTE_LEGACY_SHIM
	bool
	default y if !UART_NRFX_UARTE_LEGACY_SHIM
	select DEPRECATED

endif # SOC_FAMILY_NORDIC_NRF
```

## soc/nordic/Kconfig.defconfig
```kconfig
# Nordic Semiconductor nRFx MCU line

# Copyright (c) 2016-2018 Nordic Semiconductor ASA
# SPDX-License-Identifier: Apache-2.0

if SOC_FAMILY_NORDIC_NRF

rsource "*/Kconfig.defconfig"

config CLOCK_CONTROL
	default y if SYS_CLOCK_EXISTS && !SOC_SERIES_NRF54H && !SOC_SERIES_NRF92 && !RISCV_CORE_NORDIC_VPR

config SYS_CLOCK_TICKS_PER_SEC
	default 128 if !TICKLESS_KERNEL
	default 31250  if NRF_GRTC_TIMER
	default 32768

config ARCH_HAS_CUSTOM_BUSY_WAIT
	default y if ARM && !QEMU_TARGET

config BUILD_OUTPUT_HEX
	default y

if !CORTEX_M_DWT && NRF_RTC_TIMER
config SOC_HAS_TIMING_FUNCTIONS
	default y
endif

config GPIO
	default y
	depends on SPI

config UART_USE_RUNTIME_CONFIGURE
	default n

endif # SOC_FAMILY_NORDIC_NRF
```

## soc/nordic/Kconfig.soc
```kconfig
# Copyright (c) 2022 Nordic Semiconductor ASA

# SPDX-License-Identifier: Apache-2.0

config SOC_FAMILY_NORDIC_NRF
	bool

config SOC_FAMILY
	default "nordic_nrf" if SOC_FAMILY_NORDIC_NRF

rsource "*/Kconfig.soc"
```

## soc/nordic/Kconfig.sysbuild
```kconfig
# Copyright (c) 2024 Nordic Semiconductor ASA
# SPDX-License-Identifier: Apache-2.0

config HAS_NORDIC_VPR_LAUNCHER_IMAGE
	bool

config HAS_NORDIC_COPROC_LAUNCHER_IMAGE
	bool

config NORDIC_COPROC_LAUNCHER
	bool "Nordic coprocessor launcher"
	default y
	depends on HAS_NORDIC_COPROC_LAUNCHER_IMAGE

rsource "common/uicr/Kconfig.sysbuild"
rsource "common/vpr/Kconfig.sysbuild"
orsource "*/Kconfig.sysbuild"
```

## soc/nordic/common/Kconfig
```kconfig
# Copyright (c) 2024 Nordic Semiconductor ASA
# SPDX-License-Identifier: Apache-2.0

config HAS_NORDIC_DMM
	bool

config HAS_NORDIC_RAM_CTRL
	bool

config NRF_FORCE_RAM_ON_REBOOT
	bool "Force all RAM blocks to be powered on before rebooting"
	depends on HAS_NORDIC_RAM_CTRL
	help
	  RAM power configuration is preserved through soft reset,
	  meaning that there is a risk of accessing powered off RAM blocks
	  when booting in different application (i.e. bootloader).
	  Force all RAM blocks to be powered on before triggering soft reset
	  to prevent this from happening.

config NRF_SYS_EVENT
	bool "nRF system event support"
	select NRFX_POWER if !NRF_PLATFORM_HALTIUM

config SOC_NRF_FORCE_CONSTLAT
	bool "Force constant latency mode in system ON"
	depends on NRF_SYS_EVENT && !RISCV
	help
	  In constant latency mode the CPU wakeup latency and the PPI task response
	  will be constant and kept at a minimum. This is secured by forcing a set
	  of base resources on while in sleep. The advantage of having a constant
	  and predictable latency will be at the cost of having increased power consumption.

config MRAM_LATENCY
	bool "MRAM latency manager"
	depends on NRFS_HAS_MRAM_SERVICE
	select ONOFF
	select NRFS_MRAM_SERVICE_ENABLED

if MRAM_LATENCY

config MRAM_LATENCY_SYNC_TIMEOUT
	int "Timeout in synchronous request"
	default 1000
	help
	  Timeout is given in milliseconds.

config MRAM_LATENCY_AUTO_REQ
	bool "Request MRAM without latency at start"
	help
	  When enabled then MRAM configuration without latency is requested
	  during the initialization and is kept enabled until the mram_latency API user
	  calls mram_no_latency_sync_release().

module = MRAM_LATENCY
module-str = mram_latency
source "subsys/logging/Kconfig.template.log_config"

endif # MRAM_LATENCY

if HAS_NORDIC_DMM

config DMM_HEAP_CHUNKS
	int "Number of chunks in the DMM heap"
	default 32
	help
	  DMM is using a simplified heap which is using 32 bit mask to allocate
	  required buffer which consists of contiguous chunks. If there are many
	  small buffers used with DMM it is possible that allocation will fail.
	  Number of chunks is a trade-off between performance and granularity.
	  Must be multiply of 32.

config DMM_STATS
	bool "Usage statistics"

endif # HAS_NORDIC_DMM

rsource "vpr/Kconfig"
rsource "uicr/Kconfig"
```
