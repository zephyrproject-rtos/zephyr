## soc/microchip/miv/miv/Kconfig.soc
```kconfig
# RISCV32_MIV configuration options

# Copyright (c) 2018 Antmicro <www.antmicro.com>
# SPDX-License-Identifier: Apache-2.0

config SOC_SERIES_MIV
	bool
	select SOC_FAMILY_MICROCHIP_MIV
	help
	  Microchip Mi-V implementation#

config SOC_MIV
	bool
	select SOC_SERIES_MIV
	help
	  Microchip Mi-V system implementation

config SOC_SERIES
	default "miv" if SOC_SERIES_MIV

config SOC
	default "miv" if SOC_MIV
```

## soc/microchip/miv/pic64gx/Kconfig.defconfig.series
```kconfig
# Copyright (c) 2024 Microchip Technology Inc
# SPDX-License-Identifier: Apache-2.0

if SOC_SERIES_PIC64GX

config SOC_SERIES
	default "pic64gx"

config SYS_CLOCK_HW_CYCLES_PER_SEC
	default 1000000

config RISCV_SOC_INTERRUPT_INIT
	default y

config RISCV_GP
	default y

config 2ND_LVL_ISR_TBL_OFFSET
	default 0

config 2ND_LVL_INTR_00_OFFSET
	default 11

config MAX_IRQ_PER_AGGREGATOR
	default 186

config NUM_IRQS
	default 186

endif # SOC_SERIES_PIC64GX
```

## soc/microchip/miv/pic64gx/Kconfig.series
```kconfig
# RISCV64_MIV implementation

# Copyright (c) 2024 Antmicro <www.antmicro.com>
# SPDX-License-Identifier: Apache-2.0

config SOC_SERIES_PIC64GX
	bool "Microchip RV64 implementation"
	select SOC_FAMILY_MICROCHIP_MIV
	select RISCV
	select RISCV_PRIVILEGED
	select RISCV_HAS_PLIC
	help
	  Enable support for Microchip RISCV 64bit
```

## soc/microchip/miv/pic64gx/Kconfig.soc
```kconfig
# RISCV64_MIV Microchip PIC64GX configuration options

# Copyright (c) 2024 Microchip Technology Inc
# SPDX-License-Identifier: Apache-2.0

choice
	prompt "Microchip Polarfire SOC implementation"
	depends on SOC_SERIES_PIC64GX

config SOC_PIC64GX
	bool "Microchip PIC64GX system implementation"
	select ATOMIC_OPERATIONS_BUILTIN
	select RISCV_GP
	select USE_SWITCH_SUPPORTED
	select USE_SWITCH
	select CPU_HAS_FPU
	select SCHED_IPI_SUPPORTED
	select RISCV_ISA_RV64I
	select RISCV_ISA_EXT_M
	select RISCV_ISA_EXT_A
	select RISCV_ISA_EXT_C
	select RISCV_ISA_EXT_ZICSR
	select RISCV_ISA_EXT_ZIFENCEI

endchoice
```

## soc/microchip/miv/polarfire/Kconfig
```kconfig
# RISCV64_MIV Microchip Polarfire SOC configuration options

# Copyright (c) 2020-2021 Microchip Technology Inc
# SPDX-License-Identifier: Apache-2.0

config SOC_SERIES_POLARFIRE
	select RISCV
	select RISCV_PRIVILEGED
	select RISCV_HAS_PLIC
	select RISCV_SOC_HAS_GP_RELATIVE_ADDRESSING
	imply XIP

config SOC_POLARFIRE
	select 64BIT
	select SCHED_IPI_SUPPORTED
	select ATOMIC_OPERATIONS_BUILTIN
	select RISCV_SOC_HAS_GP_RELATIVE_ADDRESSING
	select USE_SWITCH_SUPPORTED
	select USE_SWITCH

config SOC_POLARFIRE_U54
	select CPU_HAS_FPU
	select CPU_HAS_FPU_DOUBLE_PRECISION
	select RISCV_ISA_RV64I
	select RISCV_ISA_EXT_G
	select RISCV_ISA_EXT_C

config SOC_POLARFIRE_E51
	select RISCV_ISA_RV64I
	select RISCV_ISA_EXT_M
	select RISCV_ISA_EXT_A
	select RISCV_ISA_EXT_C
	select RISCV_ISA_EXT_ZICSR
	select RISCV_ISA_EXT_ZIFENCEI

config MPFS_HAL
	depends on SOC_POLARFIRE
	bool "Microchip Polarfire SOC hardware abstracton layer"
	select HAS_MPFS_HAL
```

## soc/microchip/miv/polarfire/Kconfig.defconfig.polarfire_u54
```kconfig
# Copyright (c) 2024 Antmicro
# SPDX-License-Identifier: Apache-2.0

if SOC_POLARFIRE_U54

config MP_MAX_NUM_CPUS
	default 4

endif
```

## soc/microchip/miv/polarfire/Kconfig.soc
```kconfig
# RISCV64_MIV Microchip Polarfire SOC configuration options

# Copyright (c) 2020-2021 Microchip Technology Inc
# SPDX-License-Identifier: Apache-2.0

config SOC_SERIES_POLARFIRE
	bool
	select SOC_FAMILY_MICROCHIP_MIV
	help
	  Microchip RV64 implementation

config SOC_POLARFIRE
	bool
	select SOC_SERIES_POLARFIRE
	help
	  Microchip MPFS system implementation

config SOC_POLARFIRE_U54
	bool
	select SOC_POLARFIRE

config SOC_POLARFIRE_E51
	bool
	select SOC_POLARFIRE

config SOC_SERIES
	default "polarfire" if SOC_SERIES_POLARFIRE

config SOC
	default "polarfire" if SOC_POLARFIRE
```

## soc/microchip/pic32c/pic32ck_sg_gc/Kconfig
```kconfig
# Copyright (c) 2026 Microchip Technology Inc.
# SPDX-License-Identifier: Apache-2.0

config SOC_FAMILY_MICROCHIP_PIC32CK_SG_GC
	select ARM
	select MICROCHIP_PIC32C
	select CPU_CORTEX_M33
	select CPU_CORTEX_M_HAS_SYSTICK
	select CPU_CORTEX_M_HAS_VTOR
	select CPU_HAS_ARM_MPU
	select ARMV8_M_DSP
	select CPU_HAS_FPU
	select CPU_CORTEX_M_HAS_DWT
```

## soc/microchip/pic32c/pic32ck_sg_gc/Kconfig.soc
```kconfig
# Copyright (c) 2026 Microchip Technology Inc.
# SPDX-License-Identifier: Apache-2.0

config SOC_FAMILY_MICROCHIP_PIC32CK_SG_GC
	bool

config SOC_FAMILY
	default "microchip_pic32ck_sg_gc" if SOC_FAMILY_MICROCHIP_PIC32CK_SG_GC

rsource "*/Kconfig.soc"
```

## soc/microchip/pic32c/pic32ck_sg_gc/pic32ck_gc00/Kconfig.soc
```kconfig
# Copyright (c) 2026 Microchip Technology Inc.
# SPDX-License-Identifier: Apache-2.0

config SOC_SERIES_PIC32CK_GC00
	bool
	select SOC_FAMILY_MICROCHIP_PIC32CK_SG_GC
	help
	  Enable support for Microchip PIC32CK GC00 Cortex-M33 microcontrollers.

config SOC_SERIES
	default "pic32ck_gc00" if SOC_SERIES_PIC32CK_GC00

config SOC_PIC32CK0512GC00064
	bool
	select SOC_SERIES_PIC32CK_GC00

config SOC_PIC32CK0512GC00100
	bool
	select SOC_SERIES_PIC32CK_GC00

config SOC_PIC32CK1012GC00048
	bool
	select SOC_SERIES_PIC32CK_GC00

config SOC_PIC32CK1012GC00064
	bool
	select SOC_SERIES_PIC32CK_GC00

config SOC_PIC32CK1012GC00100
	bool
	select SOC_SERIES_PIC32CK_GC00

config SOC_PIC32CK1025GC00064
	bool
	select SOC_SERIES_PIC32CK_GC00

config SOC_PIC32CK1025GC00100
	bool
	select SOC_SERIES_PIC32CK_GC00

config SOC_PIC32CK2051GC00064
	bool
	select SOC_SERIES_PIC32CK_GC00

config SOC_PIC32CK2051GC00100
	bool
	select SOC_SERIES_PIC32CK_GC00

config SOC_PIC32CK2051GC00144
	bool
	select SOC_SERIES_PIC32CK_GC00

config SOC
	default "pic32ck0512gc00064" if SOC_PIC32CK0512GC00064
	default "pic32ck0512gc00100" if SOC_PIC32CK0512GC00100
	default "pic32ck1012gc00048" if SOC_PIC32CK1012GC00048
	default "pic32ck1012gc00064" if SOC_PIC32CK1012GC00064
	default "pic32ck1012gc00100" if SOC_PIC32CK1012GC00100
	default "pic32ck1025gc00064" if SOC_PIC32CK1025GC00064
	default "pic32ck1025gc00100" if SOC_PIC32CK1025GC00100
	default "pic32ck2051gc00064" if SOC_PIC32CK2051GC00064
	default "pic32ck2051gc00100" if SOC_PIC32CK2051GC00100
	default "pic32ck2051gc00144" if SOC_PIC32CK2051GC00144
```

## soc/microchip/pic32c/pic32ck_sg_gc/pic32ck_gc01/Kconfig.soc
```kconfig
# Copyright (c) 2026 Microchip Technology Inc.
# SPDX-License-Identifier: Apache-2.0

config SOC_SERIES_PIC32CK_GC01
	bool
	select SOC_FAMILY_MICROCHIP_PIC32CK_SG_GC
	help
	  Enable support for Microchip PIC32CK GC01 Cortex-M33 microcontrollers.

config SOC_SERIES
	default "pic32ck_gc01" if SOC_SERIES_PIC32CK_GC01

config SOC_PIC32CK0512GC01064
	bool
	select SOC_SERIES_PIC32CK_GC01

config SOC_PIC32CK0512GC01100
	bool
	select SOC_SERIES_PIC32CK_GC01

config SOC_PIC32CK1012GC01048
	bool
	select SOC_SERIES_PIC32CK_GC01

config SOC_PIC32CK1012GC01064
	bool
	select SOC_SERIES_PIC32CK_GC01

config SOC_PIC32CK1012GC01100
	bool
	select SOC_SERIES_PIC32CK_GC01

config SOC_PIC32CK1025GC01064
	bool
	select SOC_SERIES_PIC32CK_GC01

config SOC_PIC32CK1025GC01100
	bool
	select SOC_SERIES_PIC32CK_GC01

config SOC_PIC32CK2051GC01064
	bool
	select SOC_SERIES_PIC32CK_GC01

config SOC_PIC32CK2051GC01100
	bool
	select SOC_SERIES_PIC32CK_GC01

config SOC_PIC32CK2051GC01144
	bool
	select SOC_SERIES_PIC32CK_GC01

config SOC
	default "pic32ck0512gc01064" if SOC_PIC32CK0512GC01064
	default "pic32ck0512gc01100" if SOC_PIC32CK0512GC01100
	default "pic32ck1012gc01048" if SOC_PIC32CK1012GC01048
	default "pic32ck1012gc01064" if SOC_PIC32CK1012GC01064
	default "pic32ck1012gc01100" if SOC_PIC32CK1012GC01100
	default "pic32ck1025gc01064" if SOC_PIC32CK1025GC01064
	default "pic32ck1025gc01100" if SOC_PIC32CK1025GC01100
	default "pic32ck2051gc01064" if SOC_PIC32CK2051GC01064
	default "pic32ck2051gc01100" if SOC_PIC32CK2051GC01100
	default "pic32ck2051gc01144" if SOC_PIC32CK2051GC01144
```

## soc/microchip/pic32c/pic32ck_sg_gc/pic32ck_sg00/Kconfig.soc
```kconfig
# Copyright (c) 2026 Microchip Technology Inc.
# SPDX-License-Identifier: Apache-2.0

config SOC_SERIES_PIC32CK_SG00
	bool
	select SOC_FAMILY_MICROCHIP_PIC32CK_SG_GC
	help
	  Enable support for Microchip PIC32CK SG00 Cortex-M33 microcontrollers.

config SOC_SERIES
	default "pic32ck_sg00" if SOC_SERIES_PIC32CK_SG00

config SOC_PIC32CK0512SG00064
	bool
	select SOC_SERIES_PIC32CK_SG00

config SOC_PIC32CK0512SG00100
	bool
	select SOC_SERIES_PIC32CK_SG00

config SOC_PIC32CK1012SG00048
	bool
	select SOC_SERIES_PIC32CK_SG00

config SOC_PIC32CK1012SG00064
	bool
	select SOC_SERIES_PIC32CK_SG00

config SOC_PIC32CK1012SG00100
	bool
	select SOC_SERIES_PIC32CK_SG00

config SOC_PIC32CK1025SG00064
	bool
	select SOC_SERIES_PIC32CK_SG00

config SOC_PIC32CK1025SG00100
	bool
	select SOC_SERIES_PIC32CK_SG00

config SOC_PIC32CK1025SG00144
	bool
	select SOC_SERIES_PIC32CK_SG00

config SOC_PIC32CK2051SG00064
	bool
	select SOC_SERIES_PIC32CK_SG00

config SOC_PIC32CK2051SG00100
	bool
	select SOC_SERIES_PIC32CK_SG00

config SOC_PIC32CK2051SG00144
	bool
	select SOC_SERIES_PIC32CK_SG00

config SOC
	default "pic32ck0512sg00064" if SOC_PIC32CK0512SG00064
	default "pic32ck0512sg00100" if SOC_PIC32CK0512SG00100
	default "pic32ck1012sg00048" if SOC_PIC32CK1012SG00048
	default "pic32ck1012sg00064" if SOC_PIC32CK1012SG00064
	default "pic32ck1012sg00100" if SOC_PIC32CK1012SG00100
	default "pic32ck1025sg00064" if SOC_PIC32CK1025SG00064
	default "pic32ck1025sg00100" if SOC_PIC32CK1025SG00100
	default "pic32ck1025sg00144" if SOC_PIC32CK1025SG00144
	default "pic32ck2051sg00064" if SOC_PIC32CK2051SG00064
	default "pic32ck2051sg00100" if SOC_PIC32CK2051SG00100
	default "pic32ck2051sg00144" if SOC_PIC32CK2051SG00144
```

## soc/microchip/pic32c/pic32ck_sg_gc/pic32ck_sg01/Kconfig.soc
```kconfig
# Copyright (c) 2026 Microchip Technology Inc.
# SPDX-License-Identifier: Apache-2.0

config SOC_SERIES_PIC32CK_SG01
	bool
	select SOC_FAMILY_MICROCHIP_PIC32CK_SG_GC
	help
	  Enable support for Microchip PIC32CK SG01 Cortex-M33 microcontrollers.

config SOC_SERIES
	default "pic32ck_sg01" if SOC_SERIES_PIC32CK_SG01

config SOC_PIC32CK0512SG01064
	bool
	select SOC_SERIES_PIC32CK_SG01

config SOC_PIC32CK0512SG01100
	bool
	select SOC_SERIES_PIC32CK_SG01

config SOC_PIC32CK1012SG01048
	bool
	select SOC_SERIES_PIC32CK_SG01

config SOC_PIC32CK1012SG01064
	bool
	select SOC_SERIES_PIC32CK_SG01

config SOC_PIC32CK1012SG01100
	bool
	select SOC_SERIES_PIC32CK_SG01

config SOC_PIC32CK1025SG01064
	bool
	select SOC_SERIES_PIC32CK_SG01

config SOC_PIC32CK1025SG01100
	bool
	select SOC_SERIES_PIC32CK_SG01

config SOC_PIC32CK1025SG01144
	bool
	select SOC_SERIES_PIC32CK_SG01

config SOC_PIC32CK2051SG01064
	bool
	select SOC_SERIES_PIC32CK_SG01

config SOC_PIC32CK2051SG01100
	bool
	select SOC_SERIES_PIC32CK_SG01

config SOC_PIC32CK2051SG01144
	bool
	select SOC_SERIES_PIC32CK_SG01

config SOC
	default "pic32ck0512sg01064" if SOC_PIC32CK0512SG01064
	default "pic32ck0512sg01100" if SOC_PIC32CK0512SG01100
	default "pic32ck1012sg01048" if SOC_PIC32CK1012SG01048
	default "pic32ck1012sg01064" if SOC_PIC32CK1012SG01064
	default "pic32ck1012sg01100" if SOC_PIC32CK1012SG01100
	default "pic32ck1025sg01064" if SOC_PIC32CK1025SG01064
	default "pic32ck1025sg01100" if SOC_PIC32CK1025SG01100
	default "pic32ck1025sg01144" if SOC_PIC32CK1025SG01144
	default "pic32ck2051sg01064" if SOC_PIC32CK2051SG01064
	default "pic32ck2051sg01100" if SOC_PIC32CK2051SG01100
	default "pic32ck2051sg01144" if SOC_PIC32CK2051SG01144
```

## soc/microchip/pic32c/pic32cm_jh/Kconfig
```kconfig
# Copyright (c) 2025 Microchip Technology Inc.
# SPDX-License-Identifier: Apache-2.0

config SOC_FAMILY_MICROCHIP_PIC32CM_JH
	select ARM
	select MICROCHIP_PIC32C
	select CPU_CORTEX_M0PLUS
	select CPU_CORTEX_M_HAS_SYSTICK
	select CPU_CORTEX_M_HAS_VTOR
	select CPU_HAS_ARM_MPU
	select SOC_RESET_HOOK
	select CLOCK_CONTROL
```

## soc/microchip/pic32c/pic32cm_jh/Kconfig.defconfig
```kconfig
# Copyright (c) 2025 Microchip Technology Inc.
# SPDX-License-Identifier: Apache-2.0

if SOC_FAMILY_MICROCHIP_PIC32CM_JH

config NUM_IRQS
	default 32

config SYS_CLOCK_HW_CYCLES_PER_SEC
	default $(dt_node_int_prop_int,/cpus/cpu@0,clock-frequency)

endif # SOC_FAMILY_MICROCHIP_PIC32CM_JH
```

## soc/microchip/pic32c/pic32cm_jh/Kconfig.soc
```kconfig
# Copyright (c) 2025 Microchip Technology Inc.
# SPDX-License-Identifier: Apache-2.0

config SOC_FAMILY_MICROCHIP_PIC32CM_JH
	bool

config SOC_FAMILY
	default "microchip_pic32cm_jh" if SOC_FAMILY_MICROCHIP_PIC32CM_JH

# List of Peripheral IPs available in SOC_FAMILY_MICROCHIP_PIC32CM_JH family
if SOC_FAMILY_MICROCHIP_PIC32CM_JH

config GPIO_MCHP_PORT_U2210_3_1_0
	bool
	default y
	help
	  Enable PORT GPIO peripheral IP version id="U2210" version="3.1.0".

config PINCTRL_MCHP_PORT_U2210_3_1_0
	bool
	default y
	help
	  Enable PORT pinctrl peripheral IP version 3.1.0 (U2210).

endif # SOC_FAMILY_MICROCHIP_PIC32CM_JH

rsource "*/Kconfig.soc"
```

## soc/microchip/pic32c/pic32cm_jh/pic32cm_jh00/Kconfig.soc
```kconfig
# Copyright (c) 2025 Microchip Technology Inc.
# SPDX-License-Identifier: Apache-2.0

config SOC_SERIES_PIC32CM_JH00
	bool
	select SOC_FAMILY_MICROCHIP_PIC32CM_JH
	help
	  Enable support for Microchip PIC32CM JH00 Cortex-M0+ microcontrollers.

config SOC_SERIES
	default "pic32cm_jh00" if SOC_SERIES_PIC32CM_JH00

config SOC_PIC32CM2532JH00032
	bool
	select SOC_SERIES_PIC32CM_JH00

config SOC_PIC32CM5164JH00032
	bool
	select SOC_SERIES_PIC32CM_JH00

config SOC_PIC32CM2532JH00048
	bool
	select SOC_SERIES_PIC32CM_JH00

config SOC_PIC32CM5164JH00048
	bool
	select SOC_SERIES_PIC32CM_JH00

config SOC_PIC32CM2532JH00064
	bool
	select SOC_SERIES_PIC32CM_JH00

config SOC_PIC32CM5164JH00064
	bool
	select SOC_SERIES_PIC32CM_JH00

config SOC_PIC32CM2532JH00100
	bool
	select SOC_SERIES_PIC32CM_JH00

config SOC_PIC32CM5164JH00100
	bool
	select SOC_SERIES_PIC32CM_JH00

config SOC
	default "pic32cm2532jh00032" if SOC_PIC32CM2532JH00032
	default "pic32cm5164jh00032" if SOC_PIC32CM5164JH00032
	default "pic32cm2532jh00048" if SOC_PIC32CM2532JH00048
	default "pic32cm5164jh00048" if SOC_PIC32CM5164JH00048
	default "pic32cm2532jh00064" if SOC_PIC32CM2532JH00064
	default "pic32cm5164jh00064" if SOC_PIC32CM5164JH00064
	default "pic32cm2532jh00100" if SOC_PIC32CM2532JH00100
	default "pic32cm5164jh00100" if SOC_PIC32CM5164JH00100
```

## soc/microchip/pic32c/pic32cm_jh/pic32cm_jh01/Kconfig.soc
```kconfig
# Copyright (c) 2025 Microchip Technology Inc.
# SPDX-License-Identifier: Apache-2.0

config SOC_SERIES_PIC32CM_JH01
	bool
	select SOC_FAMILY_MICROCHIP_PIC32CM_JH
	help
	  Enable support for Microchip PIC32CM JH01 Cortex-M0+ microcontrollers.

config SOC_SERIES
	default "pic32cm_jh01" if SOC_SERIES_PIC32CM_JH01

config SOC_PIC32CM2532JH01032
	bool
	select SOC_SERIES_PIC32CM_JH01

config SOC_PIC32CM5164JH01032
	bool
	select SOC_SERIES_PIC32CM_JH01

config SOC_PIC32CM2532JH01048
	bool
	select SOC_SERIES_PIC32CM_JH01

config SOC_PIC32CM5164JH01048
	bool
	select SOC_SERIES_PIC32CM_JH01

config SOC_PIC32CM2532JH01064
	bool
	select SOC_SERIES_PIC32CM_JH01

config SOC_PIC32CM5164JH01064
	bool
	select SOC_SERIES_PIC32CM_JH01

config SOC_PIC32CM2532JH01100
	bool
	select SOC_SERIES_PIC32CM_JH01

config SOC_PIC32CM5164JH01100
	bool
	select SOC_SERIES_PIC32CM_JH01

config SOC_PIC32CM1216JH01032
	bool
	select SOC_SERIES_PIC32CM_JH01

config SOC_PIC32CM1216JH01048
	bool
	select SOC_SERIES_PIC32CM_JH01

config SOC
	default "pic32cm2532jh01032" if SOC_PIC32CM2532JH01032
	default "pic32cm5164jh01032" if SOC_PIC32CM5164JH01032
	default "pic32cm2532jh01048" if SOC_PIC32CM2532JH01048
	default "pic32cm5164jh01048" if SOC_PIC32CM5164JH01048
	default "pic32cm2532jh01064" if SOC_PIC32CM2532JH01064
	default "pic32cm5164jh01064" if SOC_PIC32CM5164JH01064
	default "pic32cm2532jh01100" if SOC_PIC32CM2532JH01100
	default "pic32cm5164jh01100" if SOC_PIC32CM5164JH01100
	default "pic32cm1216jh01032" if SOC_PIC32CM1216JH01032
	default "pic32cm1216jh01048" if SOC_PIC32CM1216JH01048
```
