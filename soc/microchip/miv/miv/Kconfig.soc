## soc/microchip/pic32c/pic32cm_pl/Kconfig
```kconfig
# Copyright (c) 2026 Microchip Technology Inc.
# SPDX-License-Identifier: Apache-2.0

config SOC_FAMILY_MICROCHIP_PIC32CM_PL
	select ARM
	select MICROCHIP_PIC32C
	select CPU_CORTEX_M0PLUS
	select CPU_CORTEX_M_HAS_SYSTICK
	select CPU_CORTEX_M_HAS_VTOR
	select PIN_SLEW_RATE if PINCTRL
```

## soc/microchip/pic32c/pic32cm_pl/Kconfig.soc
```kconfig
# Copyright (c) 2026 Microchip Technology Inc.
# SPDX-License-Identifier: Apache-2.0

config SOC_FAMILY_MICROCHIP_PIC32CM_PL
	bool

config SOC_FAMILY
	default "microchip_pic32cm_pl" if SOC_FAMILY_MICROCHIP_PIC32CM_PL

rsource "*/Kconfig.soc"
```

## soc/microchip/pic32c/pic32cm_pl/pic32cm_pl10/Kconfig.soc
```kconfig
# Copyright (c) 2026 Microchip Technology Inc.
# SPDX-License-Identifier: Apache-2.0

config SOC_SERIES_PIC32CM_PL10
	bool
	select SOC_FAMILY_MICROCHIP_PIC32CM_PL
	help
	  Enable support for Microchip PIC32CM PL10 Cortex-M0+ microcontrollers.

config SOC_SERIES
	default "pic32cm_pl10" if SOC_SERIES_PIC32CM_PL10

config SOC_PIC32CM6408PL10028
	bool
	select SOC_SERIES_PIC32CM_PL10

config SOC_PIC32CM6408PL10032
	bool
	select SOC_SERIES_PIC32CM_PL10

config SOC_PIC32CM6408PL10048
	bool
	select SOC_SERIES_PIC32CM_PL10

config SOC_PIC32CM6408PL10064
	bool
	select SOC_SERIES_PIC32CM_PL10

config SOC
	default "pic32cm6408pl10028" if SOC_PIC32CM6408PL10028
	default "pic32cm6408pl10032" if SOC_PIC32CM6408PL10032
	default "pic32cm6408pl10048" if SOC_PIC32CM6408PL10048
	default "pic32cm6408pl10064" if SOC_PIC32CM6408PL10064
```

## soc/microchip/pic32c/pic32cm_sg_gc/Kconfig
```kconfig
# Copyright (c) 2026 Microchip Technology Inc.
# SPDX-License-Identifier: Apache-2.0

config SOC_FAMILY_MICROCHIP_PIC32CM_SG_GC
	select ARM
	select MICROCHIP_PIC32C
	select CPU_CORTEX_M23
	select CPU_CORTEX_M_HAS_SYSTICK
	select CPU_CORTEX_M_HAS_VTOR
	select CPU_HAS_ARM_MPU
	select HAS_CMSIS_CORE
	select SOC_RESET_HOOK
```

## soc/microchip/pic32c/pic32cm_sg_gc/Kconfig.soc
```kconfig
# Copyright (c) 2026 Microchip Technology Inc.
# SPDX-License-Identifier: Apache-2.0

config SOC_FAMILY_MICROCHIP_PIC32CM_SG_GC
	bool

config SOC_FAMILY
	default "microchip_pic32cm_sg_gc" if SOC_FAMILY_MICROCHIP_PIC32CM_SG_GC

rsource "*/Kconfig.soc"
```

## soc/microchip/pic32c/pic32cm_sg_gc/pic32cm_gc00/Kconfig.soc
```kconfig
# Copyright (c) 2026 Microchip Technology Inc.
# SPDX-License-Identifier: Apache-2.0

config SOC_SERIES_PIC32CM_GC00
	bool
	select SOC_FAMILY_MICROCHIP_PIC32CM_SG_GC
	help
	  Enable support for Microchip PIC32CM GC00 Cortex-M23 microcontrollers.

config SOC_SERIES
	default "pic32cm_gc00" if SOC_SERIES_PIC32CM_GC00

config SOC_PIC32CM5112GC00048
	bool
	select SOC_SERIES_PIC32CM_GC00

config SOC_PIC32CM5112GC00064
	bool
	select SOC_SERIES_PIC32CM_GC00

config SOC_PIC32CM5112GC00100
	bool
	select SOC_SERIES_PIC32CM_GC00

config SOC
	default "pic32cm5112gc00048" if SOC_PIC32CM5112GC00048
	default "pic32cm5112gc00064" if SOC_PIC32CM5112GC00064
	default "pic32cm5112gc00100" if SOC_PIC32CM5112GC00100
```

## soc/microchip/pic32c/pic32cm_sg_gc/pic32cm_sg00/Kconfig.soc
```kconfig
# Copyright (c) 2026 Microchip Technology Inc.
# SPDX-License-Identifier: Apache-2.0

config SOC_SERIES_PIC32CM_SG00
	bool
	select SOC_FAMILY_MICROCHIP_PIC32CM_SG_GC
	help
	  Enable support for Microchip PIC32CM SG00 Cortex-M23 microcontrollers.

config SOC_SERIES
	default "pic32cm_sg00" if SOC_SERIES_PIC32CM_SG00

config SOC_PIC32CM5112SG00048
	bool
	select SOC_SERIES_PIC32CM_SG00

config SOC_PIC32CM5112SG00064
	bool
	select SOC_SERIES_PIC32CM_SG00

config SOC_PIC32CM5112SG00100
	bool
	select SOC_SERIES_PIC32CM_SG00

config SOC
	default "pic32cm5112sg00048" if SOC_PIC32CM5112SG00048
	default "pic32cm5112sg00064" if SOC_PIC32CM5112SG00064
	default "pic32cm5112sg00100" if SOC_PIC32CM5112SG00100
```
