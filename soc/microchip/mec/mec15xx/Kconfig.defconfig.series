## soc/microchip/mec/mec15xx/Kconfig.defconfig.series
```kconfig
# Microchip MEC MCU series configuration options

# Copyright (c) 2018 Intel Corporation
# SPDX-License-Identifier: Apache-2.0

if SOC_SERIES_MEC15XX

config NUM_IRQS
	# must be >= the highest interrupt number used
	# - include the UART interrupts
	# All NVIC external sources.
	default 174

rsource "Kconfig.defconfig.mec1501*"

config CORTEX_M_SYSTICK
	depends on !MCHP_XEC_RTOS_TIMER

config SYS_CLOCK_HW_CYCLES_PER_SEC
	default $(dt_node_int_prop_int,/cpus/cpu@0,clock-frequency) if CORTEX_M_SYSTICK
	default $(dt_node_int_prop_int,/soc/timer@40007400,clock-frequency) if MCHP_XEC_RTOS_TIMER

if MCHP_XEC_RTOS_TIMER
config SYS_CLOCK_TICKS_PER_SEC
	default $(dt_node_int_prop_int,/soc/timer@40007400,clock-frequency)

config SOC_HAS_TIMING_FUNCTIONS
	default y if !CORTEX_M_DWT

config ARCH_HAS_CUSTOM_BUSY_WAIT
	default y

endif # MCHP_XEC_RTOS_TIMER

endif # SOC_SERIES_MEC15XX
```

## soc/microchip/mec/mec15xx/Kconfig.soc
```kconfig
# Microchip MEC1501 MCU core series

# Copyright (c) 2018 Intel Corporation
# SPDX-License-Identifier: Apache-2.0

config SOC_SERIES_MEC15XX
	bool
	select SOC_FAMILY_MICROCHIP_MEC
	help
	  Enable support for Microchip MEC Cortex-M4 MCU series

config SOC_SERIES
	default "mec15xx" if SOC_SERIES_MEC15XX

config SOC_MEC1501_HSZ
	bool
	select SOC_SERIES_MEC15XX

config SOC
	default "mec1501_hsz" if SOC_MEC1501_HSZ
```

## soc/microchip/mec/mec165xb/Kconfig
```kconfig
# Microchip MEC165XB MCU core series

# Copyright (c) 2025 Microchip Technology Inc.
# SPDX-License-Identifier: Apache-2.0

config SOC_SERIES_MEC165XB
	select ARM
	select CPU_CORTEX_M4
	select CPU_CORTEX_M_HAS_DWT
	select CPU_HAS_ARM_MPU
	select HAS_SWO
	select HAS_MEC5_HAL
	select SOC_PREP_HOOK
```

## soc/microchip/mec/mec165xb/Kconfig.defconfig.series
```kconfig
# Copyright (c) 2025 Microchip Technology Inc.
# SPDX-License-Identifier: Apache-2.0

# Microchip MEC165xB MCU series configuration options

if SOC_SERIES_MEC165XB

config NUM_IRQS
	# must be >= the highest interrupt number used
	# - include the UART interrupts
	# All NVIC external sources.
	default 198

config CORTEX_M_SYSTICK
	depends on !MCHP_XEC_RTOS_TIMER

config SYS_CLOCK_HW_CYCLES_PER_SEC
	default $(dt_node_int_prop_int,/cpus/cpu@0,clock-frequency) if CORTEX_M_SYSTICK
	default $(dt_node_int_prop_int,/soc/timer@40007400,clock-frequency) if MCHP_XEC_RTOS_TIMER

if MCHP_XEC_RTOS_TIMER

config SYS_CLOCK_TICKS_PER_SEC
	default $(dt_node_int_prop_int,/soc/timer@40007400,clock-frequency)

endif # MCHP_XEC_RTOS_TIMER

config ARCH_HAS_CUSTOM_BUSY_WAIT
	default y

endif # SOC_SERIES_MEC165XB
```

## soc/microchip/mec/mec165xb/Kconfig.soc
```kconfig
# Copyright (c) 2025 Microchip Technology Inc.
# SPDX-License-Identifier: Apache-2.0

# Microchip MEC165xB MCU core series

config SOC_SERIES_MEC165XB
	bool
	select SOC_FAMILY_MICROCHIP_MEC
	help
	  Enable support for Microchip MEC Cortex-M4 MCU series

config SOC_SERIES
	default "mec165xb" if SOC_SERIES_MEC165XB

config SOC_MEC1653B_NSZ
	bool
	select SOC_SERIES_MEC165XB

config SOC
	default "mec1653b_nsz" if SOC_MEC1653B_NSZ
```

## soc/microchip/mec/mec172x/Kconfig
```kconfig
# Microchip MEC172X MCU core series

# Copyright (c) 2021 Microchip Technology Inc.
# SPDX-License-Identifier: Apache-2.0

config SOC_SERIES_MEC172X
	select ARM
	select CPU_CORTEX_M4
	select CPU_CORTEX_M_HAS_DWT
	select CPU_HAS_FPU
	select CPU_HAS_ARM_MPU
	select HAS_SWO
	select HAS_PM

if SOC_SERIES_MEC172X

config RTOS_TIMER
	bool "MEC172x RTOS Timer(32KHz) as kernel timer"

choice
	prompt "MEC172x debug interface general configuration"
	default SOC_MEC172X_DEBUG_WITHOUT_TRACING
	depends on SOC_SERIES_MEC172X
	help
	  Select Debug SoC interface support for MEC172X SoC family

	config SOC_MEC172X_DEBUG_DISABLED
		bool "Disable debug support"
		help
		  Debug port is disabled, JTAG/SWD cannot be enabled. JTAG_RST#
		  pin is ignored. All other JTAG pins can be used as GPIOs
		  or other non-JTAG alternate functions.

	config SOC_MEC172X_DEBUG_WITHOUT_TRACING
		bool "Debug support via Serial wire debug"
		help
		  JTAG port in SWD mode. I2C09 and ADC00-03 can be used.

	config SOC_MEC172X_DEBUG_AND_TRACING
		bool "Debug support via Serial wire debug with tracing enabled"
		help
		  JTAG port is enabled in SWD mode. Refer to tracing options
		  to see if ADC00-03 can be used or not.
endchoice

choice
	prompt "MEC172X debug interface trace configuration"
	default SOC_MEC172X_DEBUG_AND_ETM_TRACING
	depends on SOC_MEC172X_DEBUG_AND_TRACING
	help
	  Select tracing mode for debug interface

	config SOC_MEC172X_DEBUG_AND_ETM_TRACING
		bool "Debug support via Serial wire debug"
		help
		  JTAG port in SWD mode and ETM as tracing method.
		  I2C09 can be used, but ADC00-03 cannot.

	config SOC_MEC172X_DEBUG_AND_SWV_TRACING
		bool "debug support via Serial Wire Debug and Viewer"
		help
		  JTAG port in SWD mode and SWV as tracing method.
		  I2C09 cannot be used. ADC00-03 can be used.
endchoice

# GPIO initialization depends on ECIA initialization, which happen at
# CONFIG_KERNEL_INIT_PRIORITY_DEFAULT, so GPIO_INIT_PRIORITY needs to be
# higher than that.
if GPIO

config GPIO_INIT_PRIORITY
	default 41

endif # GPIO

endif # SOC_SERIES_MEC172X
```

## soc/microchip/mec/mec172x/Kconfig.defconfig.mec172xnlj
```kconfig
# Microchip MEC172XNLJ MCU

# Copyright (c) 2022 Silicom Connectivity Solutions
# SPDX-License-Identifier: Apache-2.0

if SOC_MEC172X_NLJ

config GPIO
	default y

config ESPI_XEC_V2
	default y
	depends on ESPI

config EEPROM_XEC
	default y
	depends on EEPROM

endif # SOC_MEC172X_NLJ
```

## soc/microchip/mec/mec172x/Kconfig.defconfig.series
```kconfig
# Microchip MEC MCU series configuration options

# Copyright (c) 2021 Microchip Technology Inc.
# SPDX-License-Identifier: Apache-2.0

if SOC_SERIES_MEC172X

config NUM_IRQS
	# must be >= the highest interrupt number used
	# - include the UART interrupts
	# All NVIC external sources.
	default 181

rsource "Kconfig.defconfig.mec172x*"

config CORTEX_M_SYSTICK
	depends on !MCHP_XEC_RTOS_TIMER

config SYS_CLOCK_HW_CYCLES_PER_SEC
	default $(dt_node_int_prop_int,/cpus/cpu@0,clock-frequency) if CORTEX_M_SYSTICK
	default $(dt_node_int_prop_int,/soc/timer@40007400,clock-frequency) if MCHP_XEC_RTOS_TIMER

if MCHP_XEC_RTOS_TIMER
config SYS_CLOCK_TICKS_PER_SEC
	default $(dt_node_int_prop_int,/soc/timer@40007400,clock-frequency)

config SOC_HAS_TIMING_FUNCTIONS
	default y if !CORTEX_M_DWT

config ARCH_HAS_CUSTOM_BUSY_WAIT
	default y

endif # MCHP_XEC_RTOS_TIMER

config PS2_XEC
	default y
	depends on PS2

endif # SOC_SERIES_MEC172X
```

## soc/microchip/mec/mec172x/Kconfig.soc
```kconfig
# Microchip MEC172x MCU core series

# Copyright (c) 2021 Microchip Technology Inc.
# SPDX-License-Identifier: Apache-2.0

config SOC_SERIES_MEC172X
	bool
	select SOC_FAMILY_MICROCHIP_MEC
	help
	  Enable support for Microchip MEC Cortex-M4F MCU series

config SOC_SERIES
	default "mec172x" if SOC_SERIES_MEC172X

config SOC_MEC172X_NSZ
	bool
	select SOC_SERIES_MEC172X

config SOC_MEC172X_NLJ
	bool
	select SOC_SERIES_MEC172X

config SOC
	default "mec172x_nsz" if SOC_MEC172X_NSZ
	default "mec172x_nlj" if SOC_MEC172X_NLJ
```

## soc/microchip/mec/mec174x/Kconfig
```kconfig
# Microchip MEC174X MCU core series

# Copyright (c) 2024 Microchip Technology Inc.
# SPDX-License-Identifier: Apache-2.0

config SOC_SERIES_MEC174X
	select ARM
	select CPU_CORTEX_M4
	select CPU_CORTEX_M_HAS_DWT
	select CPU_HAS_FPU
	select CPU_HAS_ARM_MPU
	select HAS_SWO
	select HAS_MEC5_HAL
	select SOC_PREP_HOOK

if SOC_SERIES_MEC174X

endif # SOC_SERIES_MEC174X
```

## soc/microchip/mec/mec174x/Kconfig.defconfig.mec1743qsz
```kconfig
# Copyright (c) 2024 Microchip Technology Inc.
# SPDX-License-Identifier: Apache-2.0

# Microchip MEC1743QSZ MCU using MEC5 HAL
# Q = 480KB total SRAM
# SZ = 144 pin package

if SOC_MEC1743_QSZ

config GPIO
	default y

config PINCTRL
	default y

endif # SOC_MEC1743_QSZ
```

## soc/microchip/mec/mec174x/Kconfig.defconfig.series
```kconfig
# Copyright (c) 2024 Microchip Technology Inc.
# SPDX-License-Identifier: Apache-2.0

# Microchip MEC174x MCU series configuration options

if SOC_SERIES_MEC174X

config NUM_IRQS
	# must be >= the highest interrupt number used
	# - include the UART interrupts
	# All NVIC external sources.
	default 194

config SYS_CLOCK_HW_CYCLES_PER_SEC
	default 32768 if MCHP_MEC5_KTIMER
	default 96000000

config SYS_CLOCK_TICKS_PER_SEC
	default 32768 if MCHP_MEC5_KTIMER
	default 1000

config CORTEX_M_SYSTICK
	depends on !MCHP_MEC5_KTIMER

endif # SOC_SERIES_MEC174X
```

## soc/microchip/mec/mec174x/Kconfig.soc
```kconfig
# Copyright (c) 2024 Microchip Technology Inc.
# SPDX-License-Identifier: Apache-2.0

# Microchip MEC174x MCU core series

config SOC_SERIES_MEC174X
	bool
	select SOC_FAMILY_MICROCHIP_MEC
	help
	  Enable support for Microchip MEC Cortex-M4F MCU series

config SOC_SERIES
	default "mec174x" if SOC_SERIES_MEC174X

config SOC_MEC1743_QLJ
	bool
	select SOC_SERIES_MEC174X

config SOC_MEC1743_QSZ
	bool
	select SOC_SERIES_MEC174X

config SOC
	default "mec1743_qlj" if SOC_MEC1743_QLJ
	default "mec1743_qsz" if SOC_MEC1743_QSZ
```

## soc/microchip/mec/mec175x/Kconfig
```kconfig
# Microchip MEC175X MCU core series

# Copyright (c) 2024 Microchip Technology Inc.
# SPDX-License-Identifier: Apache-2.0

config SOC_SERIES_MEC175X
	select ARM
	select CPU_CORTEX_M4
	select CPU_CORTEX_M_HAS_DWT
	select CPU_HAS_FPU
	select CPU_HAS_ARM_MPU
	select HAS_SWO
	select HAS_MEC5_HAL
	select HAS_PM

if SOC_SERIES_MEC175X

config RTOS_TIMER
	bool "MEC175x RTOS Timer(32KHz) as kernel timer"

endif # SOC_SERIES_MEC175X
```

## soc/microchip/mec/mec175x/Kconfig.defconfig.mec1753qlj
```kconfig
# Copyright (c) 2024 Microchip Technology Inc.
# SPDX-License-Identifier: Apache-2.0

# Microchip MEC1753QLJ MCU using MEC5 HAL
# Q = 480KB total SRAM
# LJ = 176 pin package

if SOC_MEC1753_QLJ

config GPIO
	default y

config PINCTRL
	default y

endif # SOC_MEC1753_QLJ
```

## soc/microchip/mec/mec175x/Kconfig.defconfig.series
```kconfig
# Copyright (c) 2024 Microchip Technology Inc.
# SPDX-License-Identifier: Apache-2.0

# Microchip MEC175x MCU series configuration options

if SOC_SERIES_MEC175X

config NUM_IRQS
	# must be >= the highest interrupt number used
	# - include the UART interrupts
	# All NVIC external sources.
	default 198

config CORTEX_M_SYSTICK
	depends on !MCHP_MEC5_KTIMER

config SYS_CLOCK_HW_CYCLES_PER_SEC
	default $(dt_node_int_prop_int,/cpus/cpu@0,clock-frequency) if CORTEX_M_SYSTICK
	default $(dt_node_int_prop_int,/soc/timer@40007400,clock-frequency) if MCHP_MEC5_KTIMER

if MCHP_MEC5_KTIMER
config SYS_CLOCK_TICKS_PER_SEC
	default $(dt_node_int_prop_int,/soc/timer@40007400,clock-frequency)
endif # MCHP_MEC5_KTIMER

endif # SOC_SERIES_MEC175X
```

## soc/microchip/mec/mec175x/Kconfig.soc
```kconfig
# Copyright (c) 2024 Microchip Technology Inc.
# SPDX-License-Identifier: Apache-2.0

# Microchip MEC175x MCU core series

config SOC_SERIES_MEC175X
	bool
	select SOC_FAMILY_MICROCHIP_MEC
	help
	  Enable support for Microchip MEC Cortex-M4F MCU series

config SOC_SERIES
	default "mec175x" if SOC_SERIES_MEC175X

config SOC_MEC1753_QLJ
	bool
	select SOC_SERIES_MEC175X

config SOC_MEC1753_QSZ
	bool
	select SOC_SERIES_MEC175X

config SOC
	default "mec1753_qlj" if SOC_MEC1753_QLJ
	default "mec1753_qsz" if SOC_MEC1753_QSZ
```

## soc/microchip/mec/mech172x/Kconfig
```kconfig
# Microchip MECH172X MCU core series using MEC5 HAL and DTSI

# Copyright (c) 2024 Microchip Technology Inc.
# SPDX-License-Identifier: Apache-2.0

config SOC_SERIES_MECH172X
	select ARM
	select CPU_CORTEX_M4
	select CPU_CORTEX_M_HAS_DWT
	select CPU_HAS_FPU
	select CPU_HAS_ARM_MPU
	select HAS_SWO
	select HAS_MEC5_HAL
	select SOC_PREP_HOOK

if SOC_SERIES_MECH172X

endif # SOC_SERIES_MECH172X
```

## soc/microchip/mec/mech172x/Kconfig.defconfig.mech1723nlj
```kconfig
# Copyright (c) 2024 Microchip Technology Inc.
# SPDX-License-Identifier: Apache-2.0

# Microchip MECH1723N-LJ MCU using MEC5 HAL
# N = 416KB total SRAM
# LJ = 176 pin package

if SOC_MECH1723_NLJ

config GPIO
	default y

config PINCTRL
	default y

endif # SOC_MECH1723_NLJ
```

## soc/microchip/mec/mech172x/Kconfig.defconfig.mech1723nsz
```kconfig
# Copyright (c) 2024 Microchip Technology Inc.
# SPDX-License-Identifier: Apache-2.0

# Microchip MECH1723N-SZ MCU using MEC5 HAL
# N = 416KB total SRAM
# SZ = 144 pin package

if SOC_MECH1723_NSZ

config GPIO
	default y

config PINCTRL
	default y

endif # SOC_MECH1723_NSZ
```

## soc/microchip/mec/mech172x/Kconfig.defconfig.series
```kconfig
# Copyright (c) 2024 Microchip Technology Inc.
# SPDX-License-Identifier: Apache-2.0

# Microchip MECH172x MCU series configuration options

if SOC_SERIES_MECH172X

config NUM_IRQS
	# must be >= the highest interrupt number used
	# - include the UART interrupts
	# All NVIC external sources.
	default 181

config CORTEX_M_SYSTICK
	depends on !MCHP_MEC5_KTIMER

config SYS_CLOCK_HW_CYCLES_PER_SEC
	default $(dt_node_int_prop_int,/cpus/cpu@0,clock-frequency) if CORTEX_M_SYSTICK
	default $(dt_node_int_prop_int,/soc/timer@40007400,clock-frequency) if MCHP_MEC5_KTIMER

if MCHP_MEC5_KTIMER
config SYS_CLOCK_TICKS_PER_SEC
	default $(dt_node_int_prop_int,/soc/timer@40007400,clock-frequency)
endif # MCHP_MEC5_KTIMER

endif # SOC_SERIES_MECH172X
```

## soc/microchip/mec/mech172x/Kconfig.soc
```kconfig
# Copyright (c) 2024 Microchip Technology Inc.
# SPDX-License-Identifier: Apache-2.0

# Microchip MECH172x MCU core series

config SOC_SERIES_MECH172X
	bool
	select SOC_FAMILY_MICROCHIP_MEC
	help
	  Enable support for Microchip MEC Cortex-M4F MCU series

config SOC_SERIES
	default "mech172x" if SOC_SERIES_MECH172X

config SOC_MECH1723_NLJ
	bool
	select SOC_SERIES_MECH172X

config SOC_MECH1723_NSZ
	bool
	select SOC_SERIES_MECH172X

config SOC
	default "mech1723_nlj" if SOC_MECH1723_NLJ
	default "mech1723_nsz" if SOC_MECH1723_NSZ
```

## soc/microchip/miv/Kconfig.soc
```kconfig
# Copyright (c) 2024 Nordic Semiconductor ASA
# SPDX-License-Identifier: Apache-2.0

config SOC_FAMILY_MICROCHIP_MIV
	bool

config SOC_FAMILY
	default "microchip_miv" if SOC_FAMILY_MICROCHIP_MIV

rsource "*/Kconfig.soc"
```

## soc/microchip/miv/miv/Kconfig
```kconfig
# RISCV32_MIV configuration options

# Copyright (c) 2018 Antmicro <www.antmicro.com>
# SPDX-License-Identifier: Apache-2.0

config SOC_SERIES_MIV
	select RISCV
	select RISCV_PRIVILEGED
	select RISCV_HAS_PLIC
	select RISCV_SOC_HAS_GP_RELATIVE_ADDRESSING
	imply XIP

config SOC_MIV
	select INCLUDE_RESET_VECTOR
```

## soc/microchip/miv/miv/Kconfig.defconfig
```kconfig
# SPDX-License-Identifier: Apache-2.0
# Copyright (c) 2018 Antmicro <www.antmicro.com>

if SOC_SERIES_MIV

config SYS_CLOCK_HW_CYCLES_PER_SEC
	default 4000000

config RISCV_SOC_INTERRUPT_INIT
	default y

config 2ND_LVL_ISR_TBL_OFFSET
	default 12

config 2ND_LVL_INTR_00_OFFSET
	default 11

config MAX_IRQ_PER_AGGREGATOR
	default 30

config NUM_IRQS
	default 42

endif # SOC_SERIES_MIV
```
