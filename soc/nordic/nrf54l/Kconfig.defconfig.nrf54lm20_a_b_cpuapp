## soc/nordic/nrf54l/Kconfig.defconfig.nrf54lm20_a_b_cpuapp
```kconfig
# Nordic Semiconductor nRF54LM20A and nRF54LM20B MCUs

# Copyright (c) 2025 Nordic Semiconductor ASA
# SPDX-License-Identifier: Apache-2.0


if SOC_NRF54LM20A_CPUAPP || SOC_NRF54LM20B_CPUAPP

config NUM_IRQS
	default 290

endif # SOC_NRF54LM20A_CPUAPP || SOC_NRF54LM20B_CPUAPP
```

## soc/nordic/nrf54l/Kconfig.defconfig.nrf54lm20a_enga_cpuapp
```kconfig
# Nordic Semiconductor nRF54LM20A MCU

# Copyright (c) 2025 Nordic Semiconductor ASA
# SPDX-License-Identifier: Apache-2.0


if SOC_NRF54LM20A_ENGA_CPUAPP

config NUM_IRQS
	default 290

endif # SOC_NRF54LM20A_ENGA_CPUAPP
```

## soc/nordic/nrf54l/Kconfig.defconfig.nrf54lm20a_enga_cpuflpr
```kconfig
# Nordic Semiconductor nRF54LM20A MCU

# Copyright (c) 2025 Nordic Semiconductor ASA
# SPDX-License-Identifier: Apache-2.0

if SOC_NRF54LM20A_ENGA_CPUFLPR

config NUM_IRQS
	default 287

endif # SOC_NRF54LM20A_ENGA_CPUFLPR
```

## soc/nordic/nrf54l/Kconfig.defconfig.nrf54lv10a
```kconfig
# Nordic Semiconductor nRF54LV10A MCU

# Copyright (c) 2024 Nordic Semiconductor ASA
# SPDX-License-Identifier: Apache-2.0

if SOC_NRF54LV10A_CPUAPP

# Maxumum RRAM write buffer size on nRF54LV10A is different from other RRAM devices.
config NRF_RRAM_WRITE_BUFFER_SIZE
	default 16
	range 0 16

endif # SOC_NRF54LV10A_CPUAPP
```

## soc/nordic/nrf54l/Kconfig.defconfig.nrf54lv10a_cpuapp
```kconfig
# Nordic Semiconductor nRF54LV10A MCU, APP CPU

# Copyright (c) 2024 Nordic Semiconductor ASA
# SPDX-License-Identifier: Apache-2.0

if SOC_NRF54LV10A_CPUAPP

config NUM_IRQS
	default 290

endif # SOC_NRF54LV10A_CPUAPP
```

## soc/nordic/nrf54l/Kconfig.defconfig.nrf54lv10a_cpuflpr
```kconfig
# Nordic Semiconductor nRF54LV10A MCU, FLPR CPU

# Copyright (c) 2025 Nordic Semiconductor ASA
# SPDX-License-Identifier: Apache-2.0

if SOC_NRF54LV10A_CPUFLPR

config NUM_IRQS
	default 287

endif # SOC_NRF54LV10A_CPUFLPR
```

## soc/nordic/nrf54l/Kconfig.soc
```kconfig
# Nordic Semiconductor nRF54L MCU line

# Copyright (c) 2024 Nordic Semiconductor ASA
# SPDX-License-Identifier: Apache-2.0

config SOC_SERIES_NRF54L
	bool
	select SOC_FAMILY_NORDIC_NRF
	help
	  Nordic Semiconductor nRF54L series MCU

config SOC_SERIES_NRF54LX
	bool
	select SOC_SERIES_NRF54L
	help
	  Deprecated Kconfig, use SOC_SERIES_NRF54L instead

config SOC_SERIES
	default "nrf54l" if SOC_SERIES_NRF54L

config SOC_NRF54L05
	bool
	select SOC_SERIES_NRF54L
	help
	  NRF54L05

config SOC_NRF54L05_CPUAPP
	bool
	select SOC_NRF54L05
	help
	  NRF54L05 CPUAPP

config SOC_NRF54L05_CPUFLPR
	bool
	select SOC_NRF54L05
	help
	  NRF54L05 CPUFLPR

config SOC_NRF54L10
	bool
	select SOC_SERIES_NRF54L
	help
	  NRF54L10

config SOC_NRF54L10_CPUAPP
	bool
	select SOC_NRF54L10
	help
	  NRF54L10 CPUAPP

config SOC_NRF54L10_CPUFLPR
	bool
	select SOC_NRF54L10
	help
	  NRF54L10 CPUFLPR

config SOC_NRF54L15
	bool
	select SOC_SERIES_NRF54L
	help
	  NRF54L15

config SOC_NRF54L15_CPUAPP
	bool
	select SOC_NRF54L15
	help
	  NRF54L15 CPUAPP

config SOC_NRF54L15_CPUFLPR
	bool
	select SOC_NRF54L15
	help
	  NRF54L15 CPUFLPR

config SOC_NRF54LM20A
	bool
	select SOC_SERIES_NRF54L
	help
	  NRF54LM20A

config SOC_NRF54LM20A_CPUAPP
	bool
	select SOC_NRF54LM20A
	help
	  NRF54LM20A CPUAPP

config SOC_NRF54LM20A_CPUFLPR
	bool
	select SOC_NRF54LM20A
	help
	  NRF54LM20A CPUFLPR

config SOC_NRF54LM20B
	bool
	select SOC_SERIES_NRF54L
	help
	  NRF54LM20B

config SOC_NRF54LM20B_CPUAPP
	bool
	select SOC_NRF54LM20B
	help
	  NRF54LM20B CPUAPP

config SOC_NRF54LM20B_CPUFLPR
	bool
	select SOC_NRF54LM20B
	help
	  NRF54LM20B CPUFLPR

config SOC
	default "nrf54l05" if SOC_NRF54L05
	default "nrf54l10" if SOC_NRF54L10
	default "nrf54l15" if SOC_NRF54L15
	default "nrf54lm20a" if SOC_NRF54LM20A
	default "nrf54lm20b" if SOC_NRF54LM20B
```

## soc/nordic/nrf54l/Kconfig.sysbuild
```kconfig
# Copyright (c) 2025 Nordic Semiconductor ASA
# SPDX-License-Identifier: Apache-2.0

if SOC_NRF54L15_CPUFLPR || SOC_NRF54LM20A_ENGA_CPUFLPR

config HAS_NORDIC_VPR_LAUNCHER_IMAGE
	default y

endif
```

## soc/nordic/nrf71/Kconfig
```kconfig
# Nordic Semiconductor nRF71 MCU line

# Copyright (c) 2025 Nordic Semiconductor ASA
# SPDX-License-Identifier: Apache-2.0

config SOC_SERIES_NRF71
	select SOC_COMPATIBLE_NRF71
	select HAS_NRFX
	select HAS_NORDIC_DRIVERS
	select HAS_SEGGER_RTT if ZEPHYR_SEGGER_MODULE
	select SOC_EARLY_INIT_HOOK
	select SOC_RESET_HOOK
	select NRF_PLATFORM_LUMOS

config SOC_NRF7120_ENGA_CPUAPP
	select ARM
	select ARMV8_M_DSP
	select CPU_CORTEX_M33
	select CPU_HAS_ARM_MPU
	select CPU_HAS_ICACHE
	select CPU_HAS_ARM_SAU
	select CPU_HAS_FPU
	select HAS_HW_NRF_RADIO_IEEE802154
	select HAS_POWEROFF
	select HAS_SWO

config SOC_NRF7120_ENGA_CPUFLPR
	select RISCV_CORE_NORDIC_VPR

if SOC_SERIES_NRF71

config SOC_NRF71_WIFI_DAP
	bool "nRF71 Wi-Fi Debug access port for debugging"
	help
	  This controls the Wi-Fi AHB Debug AP (DAP) for debugging nRF71 Wi-Fi cores.

endif # SOC_SERIES_NRF71
```

## soc/nordic/nrf71/Kconfig.defconfig
```kconfig
# Nordic Semiconductor nRF71 MCU line

# Copyright (c) 2025 Nordic Semiconductor ASA
# SPDX-License-Identifier: Apache-2.0

if SOC_SERIES_NRF71

rsource "Kconfig.defconfig.nrf71*"

if ARM

config CORTEX_M_SYSTICK
	default !NRF_GRTC_TIMER

config CACHE_NRF_CACHE
	default y

config CACHE_MANAGEMENT
	default y

choice CACHE_TYPE
	default EXTERNAL_CACHE
endchoice

endif # ARM

if RISCV

DT_CHOSEN_Z_SRAM = zephyr,sram
DT_CHOSEN_Z_CODE = zephyr,code-partition

config BUILD_OUTPUT_ADJUST_LMA
	depends on !XIP
	default "$(dt_chosen_partition_addr_hex,$(DT_CHOSEN_Z_CODE)) - \
		$(dt_chosen_reg_addr_hex,$(DT_CHOSEN_Z_SRAM))"

endif # RISCV

config SYS_CLOCK_HW_CYCLES_PER_SEC
	default $(dt_nodelabel_int_prop,grtc,clock-frequency) if NRF_GRTC_TIMER

config MSPI_DW_DDR
	default n

endif # SOC_SERIES_NRF71
```

## soc/nordic/nrf71/Kconfig.defconfig.nrf7120_enga_cpuapp
```kconfig
# Nordic Semiconductor nRF7120 MCU

# Copyright (c) 2025 Nordic Semiconductor ASA
# SPDX-License-Identifier: Apache-2.0

if SOC_NRF7120_ENGA_CPUAPP

config NUM_IRQS
	default 304

endif # SOC_NRF7120_ENGA_CPUAPP
```

## soc/nordic/nrf71/Kconfig.defconfig.nrf7120_enga_cpuflpr
```kconfig
# Nordic Semiconductor nRF7120 MCU

# Copyright (c) 2025 Nordic Semiconductor ASA
# SPDX-License-Identifier: Apache-2.0

if SOC_NRF7120_ENGA_CPUFLPR

# VREGUSB, LFXO, LFRC, HFXO64M, AUXPLL interrupts aren't used in drivers so we can minimise
# the gen_isr_table by setting NUM_IRQS to 270 (CLOCK_POWER) + 1 + 16 (reserved for RISC-V)
config NUM_IRQS
	default 287

# As FLPR has limited memory most of tests does not fit with asserts enabled.
config ASSERT
	default n

endif # SOC_NRF7120_ENGA_CPUFLPR
```

## soc/nordic/nrf71/Kconfig.sysbuild
```kconfig
# Copyright (c) 2026 Nordic Semiconductor ASA
# SPDX-License-Identifier: Apache-2.0

if SOC_NRF7120_ENGA_CPUFLPR

config HAS_NORDIC_VPR_LAUNCHER_IMAGE
	default y

endif

config SOC_NRF71_GENERATE_UICR
	bool "Generate nRF71 UICR hex"
	depends on SOC_SERIES_NRF71
	default y
	help
	  When enabled, a UICR generator image is included in the build.
	  This generates a standalone hex containing UICR values derived from
	  the devicetree (nordic,nrf71-uicr binding).
```

## soc/nordic/nrf91/Kconfig
```kconfig
# Nordic Semiconductor nRF91 MCU line

# Copyright (c) 2018 Nordic Semiconductor ASA
# SPDX-License-Identifier: Apache-2.0

config SOC_SERIES_NRF91X
	select ARM
	select CPU_CORTEX_M33
	select CPU_CORTEX_M_HAS_DWT
	select CPU_HAS_ARM_MPU
	select CPU_HAS_NRF_IDAU
	select CPU_HAS_FPU
	select ARMV8_M_DSP
	imply XIP
	select HAS_NRFX
	select HAS_SEGGER_RTT if ZEPHYR_SEGGER_MODULE
	select HAS_POWEROFF

if SOC_SERIES_NRF91X

config NRF_SPU_FLASH_REGION_SIZE
	hex
	default 0x8000
	help
	  FLASH region size for the NRF_SPU peripheral

config  NRF_TRUSTZONE_FLASH_REGION_SIZE
	hex
	default NRF_SPU_FLASH_REGION_SIZE
	help
	  Define the flash region size from a TrustZone perspective.
	  This is used when we set the security attributes(S/NSC/NS) of a region
	  in TrustZone enabled devices.
	  In practice this option defines the granularity of the security attributes,
	  i.e. the smallest region that can be set to secure or non-secure.

config NRF_SPU_RAM_REGION_SIZE
	hex
	default 0x2000
	help
	  RAM region size for the NRF_SPU peripheral

config NRF_ENABLE_ICACHE
	bool "Instruction cache (I-Cache)"
	default y

config  NRF_TRUSTZONE_RAM_REGION_SIZE
	hex
	default NRF_SPU_RAM_REGION_SIZE
	help
	  Define the RAM region size from a TrustZone perspective.
	  This is used when we set the security attributes(S/NSC/NS) of a region
	  in TrustZone enabled devices.
	  In practice this option defines the granularity of the security attributes,
	  i.e. the smallest region that can be set to secure or non-secure.

endif # SOC_SERIES_NRF91X
```

## soc/nordic/nrf91/Kconfig.defconfig
```kconfig
# Nordic Semiconductor nRF91 MCU line

# Copyright (c) 2018 Nordic Semiconductor ASA
# SPDX-License-Identifier: Apache-2.0

if SOC_SERIES_NRF91X

rsource "Kconfig.defconfig.nrf91*"

config SYS_CLOCK_HW_CYCLES_PER_SEC
	default $(dt_nodelabel_int_prop,rtc1,clock-frequency)

endif # SOC_SERIES_NRF91X
```

## soc/nordic/nrf91/Kconfig.defconfig.nrf9120
```kconfig
# Nordic Semiconductor nRF9120 MCU

# Copyright (c) 2023 Nordic Semiconductor ASA
# SPDX-License-Identifier: Apache-2.0

if SOC_NRF9120

config NUM_IRQS
	default 65

endif # SOC_NRF9120
```

## soc/nordic/nrf91/Kconfig.defconfig.nrf9151_LACA
```kconfig
# Nordic Semiconductor nRF9151 MCU

# Copyright (c) 2023 Nordic Semiconductor ASA
# SPDX-License-Identifier: Apache-2.0

if SOC_NRF9151_LACA

config NUM_IRQS
	default 65

endif # SOC_NRF9151_LACA
```

## soc/nordic/nrf91/Kconfig.defconfig.nrf9160_SICA
```kconfig
# Nordic Semiconductor nRF9160 MCU

# Copyright (c) 2018 Nordic Semiconductor ASA
# SPDX-License-Identifier: Apache-2.0

if SOC_NRF9160_SICA

config NUM_IRQS
	default 65

endif # SOC_NRF9160_SICA
```

## soc/nordic/nrf91/Kconfig.soc
```kconfig
# Nordic Semiconductor nRF91 MCU line

# Copyright (c) 2018 Nordic Semiconductor ASA
# SPDX-License-Identifier: Apache-2.0

config SOC_SERIES_NRF91X
	select SOC_FAMILY_NORDIC_NRF
	help
	  Enable support for NRF91 MCU series

config SOC_NRF9120
	bool
	select SOC_SERIES_NRF91X

config SOC_NRF9160
	bool
	select SOC_SERIES_NRF91X

config SOC_NRF9160_SICA
	bool
	select SOC_NRF9160

config SOC
	default "nrf9160" if SOC_NRF9160_SICA
	default "nrf9120" if SOC_NRF9120
```

## soc/nordic/nrf92/Kconfig
```kconfig
# Nordic Semiconductor nRF92 MCU line

# Copyright (c) 2024 Nordic Semiconductor ASA
# SPDX-License-Identifier: Apache-2.0

config SOC_SERIES_NRF92X
	select HAS_NRFS
	select HAS_NRFX
	select HAS_NORDIC_DRIVERS
	select NRF_PLATFORM_HALTIUM

config SOC_NRF9230_ENGB_CPUAPP
	select ARM
	select ARMV8_M_DSP
	select CPU_CORTEX_M33
	select CPU_HAS_ARM_MPU
	select CPU_HAS_ARM_SAU
	select CPU_HAS_DCACHE
	select CPU_HAS_ICACHE
	select CPU_HAS_FPU
	select CPU_HAS_CUSTOM_FIXED_SOC_MPU_REGIONS
	select HAS_NORDIC_DMM
	select HAS_SEGGER_RTT if ZEPHYR_SEGGER_MODULE
	select NRFS_HAS_CLOCK_SERVICE
	select NRFS_HAS_MRAM_SERVICE
	select NRFS_HAS_PMIC_SERVICE
	select NRFS_HAS_TEMP_SERVICE
	select NRFS_HAS_VBUS_DETECTOR_SERVICE

config SOC_NRF9230_ENGB_CPURAD
	select ARM
	select ARMV8_M_DSP
	select CPU_CORTEX_M33
	select CPU_HAS_ARM_MPU
	select CPU_HAS_ARM_SAU
	select CPU_HAS_DCACHE
	select CPU_HAS_ICACHE
	select CPU_HAS_FPU
	select CPU_HAS_CUSTOM_FIXED_SOC_MPU_REGIONS
	select HAS_NORDIC_DMM
	select HAS_SEGGER_RTT if ZEPHYR_SEGGER_MODULE
	select NRFS_HAS_CLOCK_SERVICE
	select NRFS_HAS_MRAM_SERVICE
	select NRFS_HAS_PMIC_SERVICE
	select NRFS_HAS_TEMP_SERVICE

config SOC_NRF9230_ENGB_CPUPPR
	depends on RISCV_CORE_NORDIC_VPR
```

## soc/nordic/nrf92/Kconfig.defconfig
```kconfig
# Nordic Semiconductor nRF92 MCU line

# Copyright (c) 2024 Nordic Semiconductor ASA
# SPDX-License-Identifier: Apache-2.0

if SOC_SERIES_NRF92X

rsource "Kconfig.defconfig.nrf92*"

if ARM

config CACHE_NRF_CACHE
	default y if EXTERNAL_CACHE

endif # ARM

if RISCV

DT_CHOSEN_Z_SRAM = zephyr,sram
DT_CHOSEN_Z_CODE = zephyr,code-partition

config BUILD_OUTPUT_ADJUST_LMA
	depends on !XIP
	default "$(dt_chosen_partition_addr_hex,$(DT_CHOSEN_Z_CODE)) - \
		 $(dt_chosen_reg_addr_hex,$(DT_CHOSEN_Z_SRAM))"

config BUILD_OUTPUT_HEX
	default y

config SYS_CLOCK_HW_CYCLES_PER_SEC
	default 1000000 if NRF_GRTC_TIMER

endif # RISCV

config SPI_DW_HSSI
	default y if SPI_DW

config SPI_DW_ACCESS_WORD_ONLY
	default y if SPI_DW

endif # SOC_SERIES_NRF92X
```

## soc/nordic/nrf92/Kconfig.defconfig.nrf9280_cpuapp
```kconfig
# Nordic Semiconductor nRF9280 Application MCU

# Copyright (c) 2024 Nordic Semiconductor ASA
# SPDX-License-Identifier: Apache-2.0

if SOC_NRF9280_CPUAPP

config NUM_IRQS
	default 471

config NRF_REGTOOL_GENERATE_UICR
	default y

endif # SOC_NRF9280_CPUAPP
```

## soc/nordic/nrf92/Kconfig.defconfig.nrf9280_cpuppr
```kconfig
# Copyright (c) 2024 Nordic Semiconductor ASA
# SPDX-License-Identifier: Apache-2.0

if SOC_NRF9280_CPUPPR

config NUM_IRQS
	default 496

config RV_BOOT_HART
	default 13 if SOC_NRF9230_ENGB

# As FLPR has limited memory most of tests does not fit with asserts enabled.
config ASSERT
	default n

endif # SOC_NRF9280_CPUPPR
```

## soc/nordic/nrf92/Kconfig.defconfig.nrf9280_cpurad
```kconfig
# Nordic Semiconductor nRF9280 Radio MCU

# Copyright (c) 2024 Nordic Semiconductor ASA
# SPDX-License-Identifier: Apache-2.0

if SOC_NRF9280_CPURAD

config NUM_IRQS
	default 471

endif # SOC_NRF9280_CPURAD
```

## soc/nordic/nrf92/Kconfig.soc
```kconfig
# Nordic Semiconductor nRF9280 MCU line

# Copyright (c) 2024 Nordic Semiconductor ASA
# SPDX-License-Identifier: Apache-2.0

# Similarly to other nRF91 family products, the nRF9280 is a
# SiP (System-in-Package) consisting of the nRF9230 SoC and
# additional components such as PMIC and others.
# Additionally, the nRF9230 contains several CPUs, similarly
# to the nRF54h20 SoC.
#
# Like it's done for the nRF91 family, let the nRF9280 SiP
# be represented by nRF9280 "SoC" in top-level SoC definitions
# and user-configurable Kconfigs, since that's what visible to users.
#
# Keep a nRF9230 Kconfig for the SoC under the hood, complete with
# the engineering version, because that's what the MDK/nrfx expects
# as build target, and so that its definition can also be re-used
# for other SiPs.

config SOC_NRF9230_ENGB
	bool
	select SOC_SERIES_NRF92X

config SOC_NRF9230_ENGB_CPUAPP
	bool
	select SOC_NRF9230_ENGB

config SOC_NRF9230_ENGB_CPURAD
	bool
	select SOC_NRF9230_ENGB

config SOC_NRF9230_ENGB_CPUPPR
	bool
	select SOC_NRF9230_ENGB

# The SiP selects the actual SoC complete with engineer revision and appropriate CPU
config SOC_NRF9280
	bool
	select SOC_NRF9230_ENGB_CPUAPP if SOC_NRF9280_CPUAPP
	select SOC_NRF9230_ENGB_CPURAD if SOC_NRF9280_CPURAD
	select SOC_NRF9230_ENGB_CPUPPR if SOC_NRF9280_CPUPPR
	help
	  nRF9280 SiP

# The CPU select the "SoC" (SiP)
config SOC_NRF9280_CPUAPP
	bool
	select SOC_NRF9280
	help
	  nRF9280 CPUAPP

config SOC_NRF9280_CPURAD
	bool
	select SOC_NRF9280
	help
	  nRF9280 CPURAD

config SOC_NRF9280_CPUPPR
	bool
	select SOC_NRF9280
	help
	  nRF9280 CPUPPR

config SOC
	default "nrf9280" if SOC_NRF9280
```
