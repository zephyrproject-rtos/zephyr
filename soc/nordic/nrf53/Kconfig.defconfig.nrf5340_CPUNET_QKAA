## soc/nordic/nrf54l/Kconfig.defconfig.nrf54l15_cpuflpr
```kconfig
# Nordic Semiconductor nRF54L15 MCU

# Copyright (c) 2024 Nordic Semiconductor ASA
# SPDX-License-Identifier: Apache-2.0

if SOC_NRF54L15_CPUFLPR

config NUM_IRQS
	default 287

# As FLPR has limited memory most of tests does not fit with asserts enabled.
config ASSERT
	default n

endif # SOC_NRF54L15_CPUFLPR
```

## soc/nordic/nrf54l/Kconfig.defconfig.nrf54l15_enga_cpuflpr
```kconfig
# Nordic Semiconductor nRF54L15 MCU

# Copyright (c) 2024 Nordic Semiconductor ASA
# SPDX-License-Identifier: Apache-2.0

if SOC_NRF54L15_ENGA_CPUFLPR

config RISCV_HAS_CPU_IDLE
	bool

config NUM_IRQS
	int
	default 287
# As FLPR has limited memory most of tests does not fit with asserts enabled.
config ASSERT
	default n

endif # SOC_NRF54L15_ENGA_CPUFLPR
```

## soc/nordic/nrf54l/Kconfig.defconfig.nrf54l20_enga_cpuapp
```kconfig
# Nordic Semiconductor nRF54L20 MCU

# Copyright (c) 2024 Nordic Semiconductor ASA
# SPDX-License-Identifier: Apache-2.0

if SOC_NRF54L20_ENGA_CPUAPP

config NUM_IRQS
	default 274

endif # SOC_NRF54L20_ENGA_CPUAPP
```

## soc/nordic/nrf54l/Kconfig.defconfig.nrf54l20_enga_cpuflpr
```kconfig
# Nordic Semiconductor nRF54L20 MCU

# Copyright (c) 2025 Nordic Semiconductor ASA
# SPDX-License-Identifier: Apache-2.0

if SOC_NRF54L20_ENGA_CPUFLPR

config NUM_IRQS
	default 287

endif # SOC_NRF54L20_ENGA_CPUFLPR
```

## soc/nordic/nrf54l/Kconfig.defconfig.nrf54l_05_10_15_cpuapp
```kconfig
# Nordic Semiconductor nRF54 L05, L10 and L15 MCUs

# Copyright (c) 2024 Nordic Semiconductor ASA
# SPDX-License-Identifier: Apache-2.0

if SOC_NRF54L05_CPUAPP || SOC_NRF54L10_CPUAPP || SOC_NRF54L15_CPUAPP

config NUM_IRQS
	default 271

endif # SOC_NRF54L05_CPUAPP || SOC_NRF54L10_CPUAPP || SOC_NRF54L15_CPUAPP
```

## soc/nordic/nrf54l/Kconfig.defconfig.nrf54l_05_10_15_cpuflpr
```kconfig
# Nordic Semiconductor nRF54 L05, L10 and L15 MCUs

# Copyright (c) 2024 Nordic Semiconductor ASA
# SPDX-License-Identifier: Apache-2.0

if SOC_NRF54L05_CPUFLPR || SOC_NRF54L10_CPUFLPR || SOC_NRF54L15_CPUFLPR

config NUM_IRQS
	default 287

# As FLPR has limited memory most of tests does not fit with asserts enabled.
config ASSERT
	default n

endif # SOC_NRF54L05_CPUFLPR || SOC_NRF54L10_CPUFLPR || SOC_NRF54L15_CPUFLPR
```
