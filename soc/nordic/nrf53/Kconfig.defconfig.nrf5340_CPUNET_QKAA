## soc/nordic/nrf53/Kconfig.defconfig.nrf5340_CPUNET_QKAA
```kconfig
# Nordic Semiconductor nRF5340 Network MCU

# Copyright (c) 2019 Nordic Semiconductor ASA
# SPDX-License-Identifier: Apache-2.0

if SOC_NRF5340_CPUNET_QKAA

config NUM_IRQS
	default 30

config IEEE802154_NRF5
	default y
	depends on IEEE802154

config LOG_DOMAIN_NAME
	default "net"

endif # SOC_NRF5340_CPUNET_QKAA
```

## soc/nordic/nrf53/Kconfig.soc
```kconfig
# Nordic Semiconductor nRF53 MCU line, Zephyr hw model v2 compliant

# Copyright (c) 2023 Nordic Semiconductor ASA
# SPDX-License-Identifier: Apache-2.0

config SOC_SERIES_NRF53
	bool
	select SOC_FAMILY_NORDIC_NRF
	help
	 Enable support for NRF53 MCU series

config SOC_SERIES_NRF53X
	bool
	select SOC_SERIES_NRF53
	help
	  Deprecated Kconfig, use SOC_SERIES_NRF53 instead

config SOC_SERIES
	default "nrf53" if SOC_SERIES_NRF53

config SOC_NRF5340_CPUAPP
	bool
	select SOC_SERIES_NRF53

config SOC_NRF5340_CPUNET
	bool
	select SOC_SERIES_NRF53

config SOC_NRF5340_CPUAPP_QKAA
	bool
	select SOC_NRF5340_CPUAPP

config SOC_NRF5340_CPUNET_QKAA
	bool
	select SOC_NRF5340_CPUNET

config SOC
	default "nrf5340" if SOC_NRF5340_CPUAPP_QKAA || SOC_NRF5340_CPUNET_QKAA
```

## soc/nordic/nrf53/Kconfig.sync_rtc_ipm
```kconfig
# nRF IPM driver configuration

# Copyright (c) 2021 Nordic Semiconductor ASA
# SPDX-License-Identifier: Apache-2.0

config IPM_MSG_CH_$(ipm_num)_ENABLE
	default y
	depends on NRF53_SYNC_RTC_IPM_IN = $(ipm_num)

config IPM_MSG_CH_$(ipm_num)_RX
	default y
	depends on NRF53_SYNC_RTC_IPM_IN = $(ipm_num)
```

## soc/nordic/nrf53/Kconfig.sysbuild
```kconfig
# Copyright 2026 Nordic Semiconductor ASA
# SPDX-License-Identifier: Apache-2.0

if SOC_NRF5340_CPUNET

config HAS_NORDIC_COPROC_LAUNCHER_IMAGE
	default y

endif
```

## soc/nordic/nrf54h/Kconfig
```kconfig
# Nordic Semiconductor nRF54H MCU line

# Copyright (c) 2024 Nordic Semiconductor ASA
# SPDX-License-Identifier: Apache-2.0

config SOC_SERIES_NRF54HX
	select HAS_NRFS
	select HAS_NRFX
	select HAS_NORDIC_DRIVERS
	select SOC_EARLY_INIT_HOOK if ARM
	select NRF_PLATFORM_HALTIUM
	select EXPERIMENTAL if MCUBOOT

config SOC_NRF54H20_CPUAPP_COMMON
	bool
	select ARM
	select ARMV8_M_DSP
	select CPU_CORTEX_M33
	select CPU_CORTEX_M_HAS_DWT
	select CPU_HAS_ARM_MPU
	select CPU_HAS_ARM_SAU
	select CPU_HAS_DCACHE
	select CPU_HAS_ICACHE
	select CPU_HAS_FPU
	select CPU_HAS_CUSTOM_FIXED_SOC_MPU_REGIONS
	select HAS_NORDIC_DMM
	select HAS_NORDIC_RAM_CTRL
	select HAS_SEGGER_RTT if ZEPHYR_SEGGER_MODULE
	select NRFS_HAS_AUDIOPLL_SERVICE
	select NRFS_HAS_CLOCK_SERVICE
	select NRFS_HAS_GDFS_SERVICE
	select NRFS_HAS_GDPWR_SERVICE
	select NRFS_HAS_MRAM_SERVICE
	select NRFS_HAS_SWEXT_SERVICE
	select NRFS_HAS_TEMP_SERVICE
	select NRFS_HAS_VBUS_DETECTOR_SERVICE
	select HAS_PM
	select HAS_PM_S2RAM_CUSTOM_MARKING
	select HAS_POWEROFF

config SOC_NRF54H20_CPUAPP
	select SOC_NRF54H20_CPUAPP_COMMON

config SOC_NRF54H20_CPURAD_COMMON
	bool
	select ARM
	select ARMV8_M_DSP
	select CPU_CORTEX_M33
	select CPU_CORTEX_M_HAS_DWT
	select CPU_HAS_ARM_MPU
	select CPU_HAS_ARM_SAU
	select CPU_HAS_DCACHE
	select CPU_HAS_ICACHE
	select CPU_HAS_FPU
	select CPU_HAS_CUSTOM_FIXED_SOC_MPU_REGIONS
	select HAS_SEGGER_RTT if ZEPHYR_SEGGER_MODULE
	select NRFS_HAS_AUDIOPLL_SERVICE
	select NRFS_HAS_CLOCK_SERVICE
	select NRFS_HAS_GDFS_SERVICE
	select NRFS_HAS_GDPWR_SERVICE
	select NRFS_HAS_MRAM_SERVICE
	select NRFS_HAS_SWEXT_SERVICE
	select NRFS_HAS_TEMP_SERVICE
	select NRFS_HAS_VBUS_DETECTOR_SERVICE
	select HAS_NORDIC_DMM
	select HAS_NORDIC_RAM_CTRL
	select HAS_PM
	select HAS_PM_S2RAM_CUSTOM_MARKING
	select HAS_POWEROFF

config SOC_NRF54H20_TDD_ENABLE
	bool "Power and configure the trace and debug domain (TDD)"
	depends on SOC_NRF54H20_CPUAPP
	select NRF_IRONSIDE_TDD_SERVICE
	select SOC_LATE_INIT_HOOK
	help
	  This will at application boot time request that the trace and
	  debug domain (TDD) is powered up and configured.
	  This allows configuring the coresight peripherals from
	  the application domain.

config SOC_NRF54H20_CPURAD_ENABLE
	bool "Boot the nRF54H20 Radio core"
	default y if NRF_802154_SER_HOST || BT_HCI_HOST
	depends on SOC_NRF54H20_CPUAPP
	select NRF_IRONSIDE_CPUCONF_SERVICE
	select SOC_LATE_INIT_HOOK
	help
	  This will at application boot time enable clock to the
	  Radiocore, and also power will be requested to the Radiocore
	  subsystem. The Radiocore will then start executing instructions.

if SOC_NRF54H20_CPURAD_ENABLE

config SOC_NRF54H20_CPURAD_ENABLE_CHECK_VTOR
	bool "Check VTOR before booting Radio core"
	default y
	help
	  Verify that VTOR is not 0xFFFFFFFF before booting the Radiocore.

config SOC_NRF54H20_CPURAD_ENABLE_DEBUG_WAIT
	bool "Boot the Radio core in DEBUGWAIT mode"
	help
	  Halt the Radio core immediately after reset. This ensures that a
	  debugger can attach and take control from the very first
	  instruction.

endif # SOC_NRF54H20_CPURAD_ENABLE

config SOC_NRF54H20_CPURAD
	select SOC_NRF54H20_CPURAD_COMMON

config SOC_NRF54H20_CPUPPR
	select RISCV_CORE_NORDIC_VPR

config SOC_NRF54H20_CPUFLPR
	select RISCV_CORE_NORDIC_VPR

rsource "bicr/Kconfig"
```

## soc/nordic/nrf54h/Kconfig.defconfig
```kconfig
# Nordic Semiconductor nRF54H MCU line

# Copyright (c) 2024 Nordic Semiconductor ASA
# SPDX-License-Identifier: Apache-2.0

if SOC_SERIES_NRF54HX

rsource "Kconfig.defconfig.nrf54h*"

if ARM

config CACHE_NRF_CACHE
	default y if EXTERNAL_CACHE

endif # ARM

if RISCV

DT_CHOSEN_Z_SRAM = zephyr,sram
DT_CHOSEN_Z_CODE = zephyr,code-partition

config BUILD_OUTPUT_ADJUST_LMA
	depends on !XIP
	default "$(dt_chosen_partition_addr_hex,$(DT_CHOSEN_Z_CODE)) - \
		 $(dt_chosen_reg_addr_hex,$(DT_CHOSEN_Z_SRAM))"

config BUILD_OUTPUT_HEX
	default y

endif # RISCV

config SPI_DW_HSSI
	default y if SPI_DW

config SPI_DW_ACCESS_WORD_ONLY
	default y if SPI_DW

if PM

config PM_DEVICE
	default y

endif # PM

if PM_DEVICE

config PM_DEVICE_RUNTIME
	default y

config DEVICE_DEPS
	default y

config PM_DEVICE_POWER_DOMAIN
	default y

endif # PM_DEVICE

config SYS_CLOCK_HW_CYCLES_PER_SEC
	default $(dt_nodelabel_int_prop,grtc,clock-frequency) if NRF_GRTC_TIMER

endif # SOC_SERIES_NRF54HX
```

## soc/nordic/nrf54h/Kconfig.defconfig.nrf54h20_cpuapp
```kconfig
# Nordic Semiconductor nRF54H20 Application MCU

# Copyright (c) 2024 Nordic Semiconductor ASA
# SPDX-License-Identifier: Apache-2.0

if SOC_NRF54H20_CPUAPP

config NUM_IRQS
	default 471

config SHELL_BACKEND_SERIAL
	default n if DEBUG_NRF_ETR_SHELL

config POWER_DOMAIN
	default y

config CODE_DATA_RELOCATION
	default y if (PM || POWEROFF) && !MCUBOOT

endif # SOC_NRF54H20_CPUAPP
```

## soc/nordic/nrf54h/Kconfig.defconfig.nrf54h20_cpuflpr
```kconfig
# Copyright (c) 2024 Nordic Semiconductor ASA
# SPDX-License-Identifier: Apache-2.0

if SOC_NRF54H20_CPUFLPR || SOC_NRF54H20_ENGB_CPUFLPR

config NUM_IRQS
	default 496

# As FLPR has limited memory most of tests does not fit with asserts enabled.
config ASSERT
	default n

endif # SOC_NRF54H20_CPUFLPR || SOC_NRF54H20_ENGB_CPUFLPR
```

## soc/nordic/nrf54h/Kconfig.defconfig.nrf54h20_cpurad
```kconfig
# Nordic Semiconductor nRF54H20 Radio MCU

# Copyright (c) 2024 Nordic Semiconductor ASA
# SPDX-License-Identifier: Apache-2.0

if SOC_NRF54H20_CPURAD

config NUM_IRQS
	default 471

config PM
	default y

config POWER_DOMAIN
	default y

endif # SOC_NRF54H20_CPURAD
```

## soc/nordic/nrf54h/Kconfig.soc
```kconfig
# Nordic Semiconductor nRF54H MCU line

# Copyright (c) 2024 Nordic Semiconductor ASA
# SPDX-License-Identifier: Apache-2.0

config SOC_SERIES_NRF54H
	bool
	select SOC_FAMILY_NORDIC_NRF
	help
	  Nordic Semiconductor nRF54H series MCU

config SOC_SERIES_NRF54HX
	bool
	select SOC_SERIES_NRF54H
	help
	  Deprecated Kconfig, use SOC_SERIES_NRF54H instead

config SOC_SERIES
	default "nrf54h" if SOC_SERIES_NRF54H

config SOC_NRF54H20
	bool
	select SOC_SERIES_NRF54H
	help
	  nRF54H20

config SOC_NRF54H20_CPUAPP
	bool
	select SOC_NRF54H20
	help
	  nRF54H20 CPUAPP

config SOC_NRF54H20_CPURAD
	bool
	select SOC_NRF54H20
	help
	  nRF54H20 CPURAD

config SOC_NRF54H20_CPUPPR
	bool
	select SOC_NRF54H20
	help
	  nRF54H20 CPUPPR

config SOC_NRF54H20_CPUFLPR
	bool
	select SOC_NRF54H20
	help
	  nRF54H20 CPUFLPR

config SOC
	default "nrf54h20" if SOC_NRF54H20
```

## soc/nordic/nrf54h/Kconfig.sysbuild
```kconfig
# Copyright (c) 2025 Nordic Semiconductor ASA
# SPDX-License-Identifier: Apache-2.0

if SOC_NRF54H20_CPUPPR || SOC_NRF54H20_CPUFLPR

config HAS_NORDIC_VPR_LAUNCHER_IMAGE
	default y

endif
```

## soc/nordic/nrf54h/bicr/Kconfig
```kconfig
# Copyright (c) 2024 Nordic Semiconductor
# SPDX-License-Identifier: Apache-2.0

config SOC_NRF54H20_GENERATE_BICR
	bool "Generate nRF54H20 BICR file"
	depends on SOC_NRF54H20_CPUAPP
	default y
	help
	  This option generates a BICR file for the board being used. Board
	  directory must contain a "bicr.json" file for this option to work.

config SOC_NRF54H20_BICR_NAME
	string "Name of nRF54H20 BICR file to use"
	depends on SOC_NRF54H20_GENERATE_BICR
	default "bicr.json"
	help
	  The file will be searched for in application folder first, then
	  board folder if not found. The application can select a bicr by
	  setting CONFIG_SOC_NRF54H20_BICR_NAME="some_bicr.json"
```

## soc/nordic/nrf54h/gpd/Kconfig
```kconfig
# Copyright (c) 2024 Nordic Semiconductor
# SPDX-License-Identifier: Apache-2.0

config SOC_NRF54H20_GPD
	bool "Global Power Domain service"
	imply NRFS
	imply NRFS_GDPWR_SERVICE_ENABLED
	select ONOFF
	default y if !MCUBOOT && (SOC_NRF54H20_CPUAPP || SOC_NRF54H20_CPURAD)
	help
	  This option enables the Global Power Domain service.
```

## soc/nordic/nrf54h/ironside/se/Kconfig
```kconfig
# Copyright (c) 2025 Nordic Semiconductor
# SPDX-License-Identifier: Apache-2.0

config SOC_NRF54H20_IRONSIDE_SE_BOOT_REPORT
	bool "Nordic IRONside SE boot report"
	default y if SOC_NRF54H20_CPUAPP
	depends on SOC_NRF54H20_IRON
	help
	  This option enables parsing of the Boot Report populated by Nordic IRONside SE.

config SOC_NRF54H20_IRONSIDE_SE_BOOT_REPORT_MAGIC
	hex
	default 0x4d69546f
	help
	  Constant used to check if an Nordic IRONside SE boot report has been written.
```

## soc/nordic/nrf54l/Kconfig
```kconfig
# Nordic Semiconductor nRF54 MCU line

# Copyright (c) 2024 Nordic Semiconductor ASA
# SPDX-License-Identifier: Apache-2.0

config SOC_SERIES_NRF54L
	select SOC_COMPATIBLE_NRF54LX
	select HAS_NRFX
	select HAS_NORDIC_DRIVERS
	select HAS_SEGGER_RTT if ZEPHYR_SEGGER_MODULE
	select NRF_PLATFORM_LUMOS

config SOC_SERIES_NRF54LX
	select DEPRECATED

config SOC_NRF54L_CPUAPP_COMMON
	bool
	select ARM
	select CPU_CORTEX_M33
	select CPU_CORTEX_M_HAS_DWT
	select CPU_HAS_ICACHE
	select HAS_POWEROFF
	select HAS_NORDIC_RAM_CTRL

config SOC_NRF54L05_CPUAPP
	select SOC_NRF54L_CPUAPP_COMMON
	select ARMV8_M_DSP
	select CPU_HAS_ARM_MPU
	select CPU_HAS_ARM_SAU
	select CPU_HAS_FPU
	select HAS_SWO

config SOC_NRF54L10_CPUAPP
	select SOC_NRF54L_CPUAPP_COMMON
	select ARMV8_M_DSP
	select CPU_HAS_ARM_MPU
	select CPU_HAS_ARM_SAU
	select CPU_HAS_FPU
	select HAS_SWO

config SOC_NRF54L15_CPUAPP
	select SOC_NRF54L_CPUAPP_COMMON
	select SOC_COMPATIBLE_NRF54L15
	select SOC_COMPATIBLE_NRF54L15_CPUAPP
	select ARMV8_M_DSP
	select CPU_HAS_ARM_MPU
	select CPU_HAS_ARM_SAU
	select CPU_HAS_FPU
	select HAS_SWO

config SOC_NRF54LM20A_CPUAPP
	select SOC_NRF54L_CPUAPP_COMMON
	select SOC_COMPATIBLE_NRF54LM20A
	select SOC_COMPATIBLE_NRF54LM20A_CPUAPP
	select ARMV8_M_DSP
	select CPU_HAS_ARM_MPU
	select CPU_HAS_ARM_SAU
	select CPU_HAS_FPU
	select HAS_SWO

config SOC_NRF54LM20B_CPUAPP
	select SOC_NRF54L_CPUAPP_COMMON
	select SOC_COMPATIBLE_NRF54LM20A
	select SOC_COMPATIBLE_NRF54LM20A_CPUAPP
	select ARMV8_M_DSP
	select CPU_HAS_ARM_MPU
	select CPU_HAS_ARM_SAU
	select CPU_HAS_FPU
	select HAS_SWO

config SOC_NRF54L05_CPUFLPR
	select RISCV_CORE_NORDIC_VPR

config SOC_NRF54L10_CPUFLPR
	select RISCV_CORE_NORDIC_VPR

config SOC_NRF54L15_CPUFLPR
	select RISCV_CORE_NORDIC_VPR
	select SOC_COMPATIBLE_NRF54L15

config SOC_NRF54LM20A_CPUFLPR
	select RISCV_CORE_NORDIC_VPR

config SOC_NRF54LM20B_CPUFLPR
	select RISCV_CORE_NORDIC_VPR

if SOC_SERIES_NRF54L

config SOC_NRF54LX_DISABLE_FICR_TRIMCNF
	bool "Disable trimming of the device"
	default y if TRUSTED_EXECUTION_NONSECURE
	help
	  Disable trimming of the device. When the device is trimmed it
	  will copy all the trimming values from FICR into the target
	  addresses.

config SOC_NRF54LX_SKIP_GLITCHDETECTOR_DISABLE
	bool "Skip disabling glitch detector"
	default y if TRUSTED_EXECUTION_NONSECURE
	help
	  With this option, the glitch detector is not disabled during system initialization.
	  The CPU runs with the default state of glitch detector.

config SOC_NRF54L_ANOMALY_56_WORKAROUND
	bool "Apply workaround 56 for nRF54L SoCs"
	default y
	help
	   This option enables configuration workaround 56 for nRF54L Series SoCs.

config SOC_NRF54LM20A_DEVELOP_IN_NRF54LM20B
	bool
	help
	  The nrf54lm20dk board can be used to develop the nRF54LM20A or nRF54LM20B SoCs
	  onto the nRF54LM20B DK. This symbol needs to be considered by certain system
	  initialization functionality residing in SoC erratas.

config SOC_NRF54L10_DEVELOP_IN_NRF54L15
	bool
	help
	  The nrf54l15dk board can be used to develop the nRF54L10 SoC onto the nRF54L15 DK.
	  This symbol needs to be considered by certain system initialization functionality
	  residing in system_nrf54l.c and SoC erratas.

config SOC_NRF54L05_DEVELOP_IN_NRF54L15
	bool
	help
	  The nrf54l15dk board can be used to develop the nRF54L05 SoC onto the nRF54L15 DK.
	  This symbol needs to be considered by certain system initialization functionality
	  residing in system_nrf54l.c and SoC erratas.

endif # SOC_SERIES_NRF54L
```

## soc/nordic/nrf54l/Kconfig.defconfig
```kconfig
# Nordic Semiconductor nRF54L MCU line

# Copyright (c) 2024 Nordic Semiconductor ASA
# SPDX-License-Identifier: Apache-2.0

if SOC_SERIES_NRF54LX

rsource "Kconfig.defconfig.nrf54l*"

if ARM

config CORTEX_M_SYSTICK
	default !NRF_GRTC_TIMER

# Start SYSCOUNTER on driver init
config NRF_GRTC_START_SYSCOUNTER
	default NRF_GRTC_TIMER

config CACHE_NRF_CACHE
	default y if EXTERNAL_CACHE

config CACHE_MANAGEMENT
	default y

choice CACHE_TYPE
	default EXTERNAL_CACHE
endchoice

# MPU-based null-pointer dereferencing detection cannot
# be applied as the (0x0 - 0x400) is unmapped for this target.
choice NULL_POINTER_EXCEPTION_DETECTION
	default NULL_POINTER_EXCEPTION_DETECTION_NONE
endchoice

config ROM_START_OFFSET
	default 0x800 if BOOTLOADER_MCUBOOT

endif # ARM

if RISCV

DT_CHOSEN_Z_SRAM = zephyr,sram
DT_CHOSEN_Z_CODE = zephyr,code-partition

config BUILD_OUTPUT_ADJUST_LMA
	depends on !XIP
	default "$(dt_chosen_partition_addr_hex,$(DT_CHOSEN_Z_CODE)) - \
		 $(dt_chosen_reg_addr_hex,$(DT_CHOSEN_Z_SRAM))"

endif # RISCV

config SYS_CLOCK_HW_CYCLES_PER_SEC
	default $(dt_nodelabel_int_prop,grtc,clock-frequency) if NRF_GRTC_TIMER

endif # SOC_SERIES_NRF54LX
```

## soc/nordic/nrf54l/Kconfig.defconfig.nrf54l09_enga_cpuapp
```kconfig
# Nordic Semiconductor nRF54L09 MCU

# Copyright (c) 2024 Nordic Semiconductor ASA
# SPDX-License-Identifier: Apache-2.0

if SOC_NRF54L09_ENGA_CPUAPP

config NUM_IRQS
	default 274

config IEEE802154_NRF5
	default IEEE802154

endif # SOC_NRF54L09_ENGA_CPUAPP
```

## soc/nordic/nrf54l/Kconfig.defconfig.nrf54l09_enga_cpuflpr
```kconfig
# Nordic Semiconductor nRF54L09 MCU

# Copyright (c) 2025 Nordic Semiconductor ASA
# SPDX-License-Identifier: Apache-2.0

if SOC_NRF54L09_ENGA_CPUFLPR

config NUM_IRQS
	default 287

endif # SOC_NRF54L09_ENGA_CPUFLPR
```

## soc/nordic/nrf54l/Kconfig.defconfig.nrf54l15_cpuapp
```kconfig
# Nordic Semiconductor nRF54L15 MCU

# Copyright (c) 2024 Nordic Semiconductor ASA
# SPDX-License-Identifier: Apache-2.0

if SOC_NRF54L15_CPUAPP

config NUM_IRQS
	default 271

endif # SOC_NRF54L15_CPUAPP
```
