## soc/nordic/common/Kconfig.clock_config
```kconfig
# Copyright (c) 2025 Nordic Semiconductor ASA
# SPDX-License-Identifier: Apache-2.0

SOC_DT_LFXO_PATH := $(dt_nodelabel_path,lfxo)
SOC_DT_LFXO_ENABLED := $(dt_path_enabled,$(SOC_DT_LFXO_PATH))
SOC_DT_LFXO_LOAD_CAPS_EXTERNAL := $(dt_node_str_prop_equals,$(SOC_DT_LFXO_PATH),load-capacitors,external)
SOC_DT_LFXO_HAS_LOAD_CAP := $(dt_node_has_prop,$(SOC_DT_LFXO_PATH),load-capacitance-femtofarad)
SOC_DT_LFXO_LOAD_CAP := $(dt_node_int_prop_int,$(SOC_DT_LFXO_PATH),load-capacitance-femtofarad)

config SOC_HAS_LFXO
	bool "SoC has LFXO available"
	default $(SOC_DT_LFXO_ENABLED)

if SOC_HAS_LFXO

choice SOC_LFXO_LOAD_CAPS
	prompt "LFXO load capacitor selection"
	default SOC_LFXO_LOAD_CAPS_EXTERNAL if $(SOC_DT_LFXO_LOAD_CAPS_EXTERNAL)
	default SOC_LFXO_LOAD_CAPS_INTERNAL

config SOC_LFXO_LOAD_CAPS_EXTERNAL
	bool "Use external load capacitors for LFXO"

config SOC_LFXO_LOAD_CAPS_INTERNAL
	bool "Use internal load capacitors for LFXO"

endchoice # SOC_LFXO_LOAD_CAPS

if SOC_LFXO_LOAD_CAPS_INTERNAL

config SOC_LFXO_INTERNAL_LOAD_CAP
	int "Internal load capacitance for LFXO"
	default $(SOC_DT_LFXO_LOAD_CAP) if $(SOC_DT_LFXO_HAS_LOAD_CAP)
	default 17000

endif # SOC_LFXO_LOAD_CAPS_INTERNAL

endif # SOC_HAS_LFXO

SOC_DT_HFXO_PATH := $(dt_nodelabel_path,hfxo)
SOC_DT_HFXO_ENABLED := $(dt_path_enabled,$(SOC_DT_HFXO_PATH))
SOC_DT_HFXO_HAS_STARTUP_TIME := $(dt_node_has_prop,$(SOC_DT_HFXO_PATH),startup-time-us)
SOC_DT_HFXO_STARTUP_TIME := $(dt_node_int_prop_int,$(SOC_DT_HFXO_PATH),startup-time-us)
SOC_DT_HFXO_LOAD_CAPS_EXTERNAL := $(dt_node_str_prop_equals,$(SOC_DT_HFXO_PATH),load-capacitors,external)
SOC_DT_HFXO_HAS_LOAD_CAP := $(dt_node_has_prop,$(SOC_DT_HFXO_PATH),load-capacitance-femtofarad)
SOC_DT_HFXO_LOAD_CAP := $(dt_node_int_prop_int,$(SOC_DT_HFXO_PATH),load-capacitance-femtofarad)

config SOC_HAS_HFXO
	bool "SoC has HFXO available"
	default $(SOC_DT_HFXO_ENABLED)

if SOC_HAS_HFXO

config SOC_HFXO_STARTUP_TIME
	int "Startup time of HFXO in microseconds"
	default $(SOC_DT_HFXO_STARTUP_TIME) if $(SOC_DT_HFXO_HAS_STARTUP_TIME)
	default 1650

choice SOC_HFXO_LOAD_CAPS
	prompt "HFXO load capacitor selection"
	default SOC_HFXO_LOAD_CAPS_EXTERNAL if $(SOC_DT_HFXO_LOAD_CAPS_EXTERNAL)
	default SOC_HFXO_LOAD_CAPS_INTERNAL

config SOC_HFXO_LOAD_CAPS_EXTERNAL
	bool "Use external load capacitors for HFXO"

config SOC_HFXO_LOAD_CAPS_INTERNAL
	bool "Use internal load capacitors for HFXO"

endchoice # SOC_HFXO_LOAD_CAPS

if SOC_HFXO_LOAD_CAPS_INTERNAL

config SOC_HFXO_INTERNAL_LOAD_CAP
	int "Internal load capacitance for HFXO"
	default $(SOC_DT_HFXO_LOAD_CAP) if $(SOC_DT_HFXO_HAS_LOAD_CAP)
	default 15000

endif # SOC_HFXO_LOAD_CAPS_INTERNAL

endif # SOC_HAS_HFXO
```

## soc/nordic/common/Kconfig.defconfig
```kconfig
# Copyright (c) 2024 Nordic Semiconductor ASA
# SPDX-License-Identifier: Apache-2.0

if RISCV_CORE_NORDIC_VPR

rsource "vpr/Kconfig.defconfig"

endif # RISCV_CORE_NORDIC_VPR

config PM_DEVICE_RUNTIME_DEFAULT_ENABLE
	default y if PM_DEVICE_RUNTIME
```

## soc/nordic/common/Kconfig.peripherals
```kconfig
# Nordic Semiconductor nRFx MCU peripherals list.

# Copyright (c) 2018 Nordic Semiconductor ASA
# SPDX-License-Identifier: Apache-2.0

config HAS_HW_NRF_ACL
	def_bool $(dt_compat_enabled,$(DT_COMPAT_NORDIC_NRF_ACL))

config HAS_HW_NRF_ADC
	def_bool $(dt_compat_enabled,$(DT_COMPAT_NORDIC_NRF_ADC))

config HAS_HW_NRF_BPROT
	def_bool $(dt_compat_enabled,$(DT_COMPAT_NORDIC_NRF_BPROT))

config HAS_HW_NRF_CC310
	def_bool $(dt_compat_enabled,$(DT_COMPAT_ARM_CRYPTOCELL_310))

config HAS_HW_NRF_CC312
	def_bool $(dt_compat_enabled,$(DT_COMPAT_ARM_CRYPTOCELL_312))

config HAS_HW_NRF_CCM
	def_bool $(dt_compat_enabled,$(DT_COMPAT_NORDIC_NRF_CCM))

config HAS_HW_NRF_CCM_LFLEN_8BIT
	def_bool $(dt_nodelabel_bool_prop,ccm,length-field-length-8-bits)

config HAS_HW_NRF_CCM_HEADERMASK
	def_bool $(dt_nodelabel_bool_prop,ccm,headermask-supported)

config HAS_HW_NRF_CLOCK
	def_bool $(dt_compat_enabled,$(DT_COMPAT_NORDIC_NRF_CLOCK))

config HAS_HW_NRF_COMP
	def_bool $(dt_compat_enabled,$(DT_COMPAT_NORDIC_NRF_COMP))

config HAS_HW_NRF_CTRLAP
	def_bool $(dt_compat_enabled,$(DT_COMPAT_NORDIC_NRF_CTRLAPPERI))

config HAS_HW_NRF_DCNF
	def_bool $(dt_compat_enabled,$(DT_COMPAT_NORDIC_NRF_DCNF))

config HAS_HW_NRF_DPPIC
	def_bool $(dt_compat_enabled,$(DT_COMPAT_NORDIC_NRF_DPPIC))

config HAS_HW_NRF_ECB
	def_bool $(dt_compat_enabled,$(DT_COMPAT_NORDIC_NRF_ECB))

config HAS_HW_NRF_EGU0
	def_bool $(dt_nodelabel_enabled_with_compat,egu0,$(DT_COMPAT_NORDIC_NRF_EGU))

config HAS_HW_NRF_EGU1
	def_bool $(dt_nodelabel_enabled_with_compat,egu1,$(DT_COMPAT_NORDIC_NRF_EGU))

config HAS_HW_NRF_EGU2
	def_bool $(dt_nodelabel_enabled_with_compat,egu2,$(DT_COMPAT_NORDIC_NRF_EGU))

config HAS_HW_NRF_EGU3
	def_bool $(dt_nodelabel_enabled_with_compat,egu3,$(DT_COMPAT_NORDIC_NRF_EGU))

config HAS_HW_NRF_EGU4
	def_bool $(dt_nodelabel_enabled_with_compat,egu4,$(DT_COMPAT_NORDIC_NRF_EGU))

config HAS_HW_NRF_EGU5
	def_bool $(dt_nodelabel_enabled_with_compat,egu5,$(DT_COMPAT_NORDIC_NRF_EGU))

config HAS_HW_NRF_EGU020
	def_bool $(dt_nodelabel_enabled_with_compat,egu020,$(DT_COMPAT_NORDIC_NRF_EGU))

config HAS_HW_NRF_GPIO0
	def_bool $(dt_nodelabel_enabled_with_compat,gpio0,$(DT_COMPAT_NORDIC_NRF_GPIO))

config HAS_HW_NRF_GPIO1
	def_bool $(dt_nodelabel_enabled_with_compat,gpio1,$(DT_COMPAT_NORDIC_NRF_GPIO))

config HAS_HW_NRF_GPIO2
	def_bool $(dt_nodelabel_enabled_with_compat,gpio2,$(DT_COMPAT_NORDIC_NRF_GPIO))

config HAS_HW_NRF_GPIOTE0
	def_bool $(dt_nodelabel_enabled_with_compat,gpiote0,$(DT_COMPAT_NORDIC_NRF_GPIOTE))

config HAS_HW_NRF_GPIOTE1
	def_bool $(dt_nodelabel_enabled_with_compat,gpiote1,$(DT_COMPAT_NORDIC_NRF_GPIOTE))

config HAS_HW_NRF_GPIOTE20
	def_bool $(dt_nodelabel_enabled_with_compat,gpiote20,$(DT_COMPAT_NORDIC_NRF_GPIOTE))

config HAS_HW_NRF_GPIOTE30
	def_bool $(dt_nodelabel_enabled_with_compat,gpiote30,$(DT_COMPAT_NORDIC_NRF_GPIOTE))

config HAS_HW_NRF_GPIOTE130
	def_bool $(dt_nodelabel_enabled_with_compat,gpiote130,$(DT_COMPAT_NORDIC_NRF_GPIOTE))

config HAS_HW_NRF_GPIOTE131
	def_bool $(dt_nodelabel_enabled_with_compat,gpiote131,$(DT_COMPAT_NORDIC_NRF_GPIOTE))

config HAS_HW_NRF_GRTC
	def_bool $(dt_compat_enabled,$(DT_COMPAT_NORDIC_NRF_GRTC))

config HAS_HW_NRF_KMU
	def_bool $(dt_compat_enabled,$(DT_COMPAT_NORDIC_NRF_KMU))

config HAS_HW_NRF_LPCOMP
	def_bool $(dt_compat_enabled,$(DT_COMPAT_NORDIC_NRF_LPCOMP))

config HAS_HW_NRF_MPU
	def_bool $(dt_compat_enabled,$(DT_COMPAT_NORDIC_NRF_MPU))

config HAS_HW_NRF_MUTEX
	def_bool $(dt_compat_enabled,$(DT_COMPAT_NORDIC_NRF_MUTEX))

config HAS_HW_NRF_MWU
	def_bool $(dt_compat_enabled,$(DT_COMPAT_NORDIC_NRF_MWU))

config HAS_HW_NRF_NFCT
	def_bool $(dt_compat_enabled,$(DT_COMPAT_NORDIC_NRF_NFCT)) || \
		 $(dt_compat_enabled,$(DT_COMPAT_NORDIC_NRF_NFCT_V2))

config HAS_HW_NRF_NVMC_PE
	def_bool $(dt_nodelabel_bool_prop,flash_controller,partial-erase)

config HAS_HW_NRF_OSCILLATORS
	def_bool $(dt_compat_enabled,$(DT_COMPAT_NORDIC_NRF_OSCILLATORS))

config HAS_HW_NRF_POWER
	def_bool $(dt_compat_enabled,$(DT_COMPAT_NORDIC_NRF_POWER))

config HAS_HW_NRF_PPI
	def_bool $(dt_compat_enabled,$(DT_COMPAT_NORDIC_NRF_PPI))

config HAS_HW_NRF_QSPI
	def_bool $(dt_compat_enabled,$(DT_COMPAT_NORDIC_NRF_QSPI))

config HAS_HW_NRF_RADIO_BLE_2M
	def_bool $(dt_nodelabel_bool_prop,radio,ble-2mbps-supported)

config HAS_HW_NRF_RADIO_BLE_CODED
	def_bool $(dt_nodelabel_bool_prop,radio,ble-coded-phy-supported)

config HAS_HW_NRF_RADIO_CS
	def_bool $(dt_nodelabel_bool_prop,radio,ble-cs-supported)

config HAS_HW_NRF_RADIO_DFE
	def_bool $(dt_nodelabel_bool_prop,radio,dfe-supported)

config HAS_HW_NRF_RADIO_IEEE802154
	def_bool $(dt_nodelabel_bool_prop,radio,ieee802154-supported)

config HAS_HW_NRF_RADIO_TX_PWR_HIGH
	def_bool $(dt_nodelabel_bool_prop,radio,radio-tx-high-power-supported)

config HAS_HW_NRF_REGULATORS
	def_bool $(dt_compat_enabled,$(DT_COMPAT_NORDIC_NRF_REGULATORS))

config HAS_HW_NRF_RESET
	def_bool $(dt_compat_enabled,$(DT_COMPAT_NORDIC_NRF_RESET))

config HAS_HW_NRF_RNG
	def_bool $(dt_compat_enabled,$(DT_COMPAT_NORDIC_NRF_RNG))

config HAS_HW_NRF_RTC0
	def_bool $(dt_nodelabel_enabled_with_compat,rtc0,$(DT_COMPAT_NORDIC_NRF_RTC))

config HAS_HW_NRF_RTC1
	def_bool $(dt_nodelabel_enabled_with_compat,rtc1,$(DT_COMPAT_NORDIC_NRF_RTC))

config HAS_HW_NRF_RTC2
	def_bool $(dt_nodelabel_enabled_with_compat,rtc2,$(DT_COMPAT_NORDIC_NRF_RTC))

config HAS_HW_NRF_RTC130
	def_bool $(dt_nodelabel_enabled_with_compat,rtc130,$(DT_COMPAT_NORDIC_NRF_RTC))

config HAS_HW_NRF_RTC131
	def_bool $(dt_nodelabel_enabled_with_compat,rtc131,$(DT_COMPAT_NORDIC_NRF_RTC))

config HAS_HW_NRF_SAADC
	def_bool $(dt_compat_enabled,$(DT_COMPAT_NORDIC_NRF_SAADC))

config HAS_HW_NRF_SPI0
	def_bool $(dt_nodelabel_enabled_with_compat,spi0,$(DT_COMPAT_NORDIC_NRF_SPI))

config HAS_HW_NRF_SPI1
	def_bool $(dt_nodelabel_enabled_with_compat,spi1,$(DT_COMPAT_NORDIC_NRF_SPI))

config HAS_HW_NRF_SPI2
	def_bool $(dt_nodelabel_enabled_with_compat,spi2,$(DT_COMPAT_NORDIC_NRF_SPI))

config HAS_HW_NRF_SPU
	def_bool $(dt_compat_enabled,$(DT_COMPAT_NORDIC_NRF_SPU))

config HAS_HW_NRF_SWI0
	def_bool $(dt_nodelabel_enabled_with_compat,swi0,$(DT_COMPAT_NORDIC_NRF_SWI))

config HAS_HW_NRF_SWI1
	def_bool $(dt_nodelabel_enabled_with_compat,swi1,$(DT_COMPAT_NORDIC_NRF_SWI))

config HAS_HW_NRF_SWI2
	def_bool $(dt_nodelabel_enabled_with_compat,swi2,$(DT_COMPAT_NORDIC_NRF_SWI))

config HAS_HW_NRF_SWI3
	def_bool $(dt_nodelabel_enabled_with_compat,swi3,$(DT_COMPAT_NORDIC_NRF_SWI))

config HAS_HW_NRF_SWI4
	def_bool $(dt_nodelabel_enabled_with_compat,swi4,$(DT_COMPAT_NORDIC_NRF_SWI))

config HAS_HW_NRF_SWI5
	def_bool $(dt_nodelabel_enabled_with_compat,swi5,$(DT_COMPAT_NORDIC_NRF_SWI))

config HAS_HW_NRF_TDM
	def_bool $(dt_nodelabel_enabled_with_compat,tdm,$(DT_COMPAT_NORDIC_NRF_TDM))

config HAS_HW_NRF_TDM130
	def_bool $(dt_nodelabel_enabled_with_compat,tdm130,$(DT_COMPAT_NORDIC_NRF_TDM))

config HAS_HW_NRF_TDM131
	def_bool $(dt_nodelabel_enabled_with_compat,tdm131,$(DT_COMPAT_NORDIC_NRF_TDM))

config HAS_HW_NRF_TEMP
	def_bool $(dt_compat_enabled,$(DT_COMPAT_NORDIC_NRF_TEMP))

config HAS_HW_NRF_TIMER0
	def_bool $(dt_nodelabel_enabled_with_compat,timer0,$(DT_COMPAT_NORDIC_NRF_TIMER))

config HAS_HW_NRF_TIMER1
	def_bool $(dt_nodelabel_enabled_with_compat,timer1,$(DT_COMPAT_NORDIC_NRF_TIMER))

config HAS_HW_NRF_TIMER2
	def_bool $(dt_nodelabel_enabled_with_compat,timer2,$(DT_COMPAT_NORDIC_NRF_TIMER))

config HAS_HW_NRF_TIMER3
	def_bool $(dt_nodelabel_enabled_with_compat,timer3,$(DT_COMPAT_NORDIC_NRF_TIMER))

config HAS_HW_NRF_TIMER4
	def_bool $(dt_nodelabel_enabled_with_compat,timer4,$(DT_COMPAT_NORDIC_NRF_TIMER))

config HAS_HW_NRF_TIMER00
	def_bool $(dt_nodelabel_enabled_with_compat,timer00,$(DT_COMPAT_NORDIC_NRF_TIMER))

config HAS_HW_NRF_TIMER10
	def_bool $(dt_nodelabel_enabled_with_compat,timer10,$(DT_COMPAT_NORDIC_NRF_TIMER))

config HAS_HW_NRF_TIMER20
	def_bool $(dt_nodelabel_enabled_with_compat,timer20,$(DT_COMPAT_NORDIC_NRF_TIMER))

config HAS_HW_NRF_TIMER21
	def_bool $(dt_nodelabel_enabled_with_compat,timer21,$(DT_COMPAT_NORDIC_NRF_TIMER))

config HAS_HW_NRF_TIMER22
	def_bool $(dt_nodelabel_enabled_with_compat,timer22,$(DT_COMPAT_NORDIC_NRF_TIMER))

config HAS_HW_NRF_TIMER23
	def_bool $(dt_nodelabel_enabled_with_compat,timer23,$(DT_COMPAT_NORDIC_NRF_TIMER))

config HAS_HW_NRF_TIMER24
	def_bool $(dt_nodelabel_enabled_with_compat,timer24,$(DT_COMPAT_NORDIC_NRF_TIMER))

config HAS_HW_NRF_TIMER020
	def_bool $(dt_nodelabel_enabled_with_compat,timer020,$(DT_COMPAT_NORDIC_NRF_TIMER))

config HAS_HW_NRF_TIMER021
	def_bool $(dt_nodelabel_enabled_with_compat,timer021,$(DT_COMPAT_NORDIC_NRF_TIMER))

config HAS_HW_NRF_TIMER022
	def_bool $(dt_nodelabel_enabled_with_compat,timer022,$(DT_COMPAT_NORDIC_NRF_TIMER))

config HAS_HW_NRF_TIMER120
	def_bool $(dt_nodelabel_enabled_with_compat,timer120,$(DT_COMPAT_NORDIC_NRF_TIMER))

config HAS_HW_NRF_TIMER121
	def_bool $(dt_nodelabel_enabled_with_compat,timer121,$(DT_COMPAT_NORDIC_NRF_TIMER))

config HAS_HW_NRF_TIMER130
	def_bool $(dt_nodelabel_enabled_with_compat,timer130,$(DT_COMPAT_NORDIC_NRF_TIMER))

config HAS_HW_NRF_TIMER131
	def_bool $(dt_nodelabel_enabled_with_compat,timer131,$(DT_COMPAT_NORDIC_NRF_TIMER))

config HAS_HW_NRF_TIMER132
	def_bool $(dt_nodelabel_enabled_with_compat,timer132,$(DT_COMPAT_NORDIC_NRF_TIMER))

config HAS_HW_NRF_TIMER133
	def_bool $(dt_nodelabel_enabled_with_compat,timer133,$(DT_COMPAT_NORDIC_NRF_TIMER))

config HAS_HW_NRF_TIMER134
	def_bool $(dt_nodelabel_enabled_with_compat,timer134,$(DT_COMPAT_NORDIC_NRF_TIMER))

config HAS_HW_NRF_TIMER135
	def_bool $(dt_nodelabel_enabled_with_compat,timer135,$(DT_COMPAT_NORDIC_NRF_TIMER))

config HAS_HW_NRF_TIMER136
	def_bool $(dt_nodelabel_enabled_with_compat,timer136,$(DT_COMPAT_NORDIC_NRF_TIMER))

config HAS_HW_NRF_TIMER137
	def_bool $(dt_nodelabel_enabled_with_compat,timer137,$(DT_COMPAT_NORDIC_NRF_TIMER))

config HAS_HW_NRF_TWI0
	def_bool $(dt_nodelabel_enabled_with_compat,i2c0,$(DT_COMPAT_NORDIC_NRF_TWI))

config HAS_HW_NRF_TWI1
	def_bool $(dt_nodelabel_enabled_with_compat,i2c1,$(DT_COMPAT_NORDIC_NRF_TWI))

config HAS_HW_NRF_UART0
	def_bool $(dt_nodelabel_enabled_with_compat,uart0,$(DT_COMPAT_NORDIC_NRF_UART))

config HAS_HW_NRF_UARTE0
	def_bool $(dt_nodelabel_enabled_with_compat,uart0,$(DT_COMPAT_NORDIC_NRF_UARTE))

config HAS_HW_NRF_UARTE1
	def_bool $(dt_nodelabel_enabled_with_compat,uart1,$(DT_COMPAT_NORDIC_NRF_UARTE))

config HAS_HW_NRF_UARTE2
	def_bool $(dt_nodelabel_enabled_with_compat,uart2,$(DT_COMPAT_NORDIC_NRF_UARTE))

config HAS_HW_NRF_UARTE3
	def_bool $(dt_nodelabel_enabled_with_compat,uart3,$(DT_COMPAT_NORDIC_NRF_UARTE))

config HAS_HW_NRF_UARTE00
	def_bool $(dt_nodelabel_enabled_with_compat,uart00,$(DT_COMPAT_NORDIC_NRF_UARTE))

config HAS_HW_NRF_UARTE20
	def_bool $(dt_nodelabel_enabled_with_compat,uart20,$(DT_COMPAT_NORDIC_NRF_UARTE))

config HAS_HW_NRF_UARTE21
	def_bool $(dt_nodelabel_enabled_with_compat,uart21,$(DT_COMPAT_NORDIC_NRF_UARTE))

config HAS_HW_NRF_UARTE22
	def_bool $(dt_nodelabel_enabled_with_compat,uart22,$(DT_COMPAT_NORDIC_NRF_UARTE))

config HAS_HW_NRF_UARTE23
	def_bool $(dt_nodelabel_enabled_with_compat,uart23,$(DT_COMPAT_NORDIC_NRF_UARTE))

config HAS_HW_NRF_UARTE24
	def_bool $(dt_nodelabel_enabled_with_compat,uart24,$(DT_COMPAT_NORDIC_NRF_UARTE))

config HAS_HW_NRF_UARTE30
	def_bool $(dt_nodelabel_enabled_with_compat,uart30,$(DT_COMPAT_NORDIC_NRF_UARTE))

config HAS_HW_NRF_UARTE120
	def_bool $(dt_nodelabel_enabled_with_compat,uart120,$(DT_COMPAT_NORDIC_NRF_UARTE))

config HAS_HW_NRF_UARTE130
	def_bool $(dt_nodelabel_enabled_with_compat,uart130,$(DT_COMPAT_NORDIC_NRF_UARTE))

config HAS_HW_NRF_UARTE131
	def_bool $(dt_nodelabel_enabled_with_compat,uart131,$(DT_COMPAT_NORDIC_NRF_UARTE))

config HAS_HW_NRF_UARTE132
	def_bool $(dt_nodelabel_enabled_with_compat,uart132,$(DT_COMPAT_NORDIC_NRF_UARTE))

config HAS_HW_NRF_UARTE133
	def_bool $(dt_nodelabel_enabled_with_compat,uart133,$(DT_COMPAT_NORDIC_NRF_UARTE))

config HAS_HW_NRF_UARTE134
	def_bool $(dt_nodelabel_enabled_with_compat,uart134,$(DT_COMPAT_NORDIC_NRF_UARTE))

config HAS_HW_NRF_UARTE135
	def_bool $(dt_nodelabel_enabled_with_compat,uart135,$(DT_COMPAT_NORDIC_NRF_UARTE))

config HAS_HW_NRF_UARTE136
	def_bool $(dt_nodelabel_enabled_with_compat,uart136,$(DT_COMPAT_NORDIC_NRF_UARTE))

config HAS_HW_NRF_UARTE137
	def_bool $(dt_nodelabel_enabled_with_compat,uart137,$(DT_COMPAT_NORDIC_NRF_UARTE))

config HAS_HW_NRF_USBD
	def_bool $(dt_compat_enabled,$(DT_COMPAT_NORDIC_NRF_USBD))

config HAS_HW_NRF_USBREG
	def_bool $(dt_compat_enabled,$(DT_COMPAT_NORDIC_NRF_USBREG))

config HAS_HW_NRF_VMC
	def_bool $(dt_compat_enabled,$(DT_COMPAT_NORDIC_NRF_VMC))
```
