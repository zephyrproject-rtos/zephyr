## soc/nordic/common/Kconfig.regulator
```kconfig
# Copyright (c) 2025 Nordic Semiconductor ASA
# SPDX-License-Identifier: Apache-2.0

SOC_DT_VREGMAIN_PATH := $(dt_nodelabel_path,vregmain)
SOC_DT_VREGMAIN_HAS_INITIAL_MODE := $(dt_node_has_prop,$(SOC_DT_VREGMAIN_PATH),regulator-initial-mode)
SOC_DT_VREGMAIN_INITIAL_MODE := $(dt_node_int_prop_int,$(SOC_DT_VREGMAIN_PATH),regulator-initial-mode)

config SOC_VREGMAIN_INITIAL_MODE
	int "Initial mode of VREGMAIN volage regulator"
	default $(SOC_DT_VREGMAIN_INITIAL_MODE) if $(SOC_DT_VREGMAIN_HAS_INITIAL_MODE)
	default 1
```

## soc/nordic/common/Kconfig.tfm
```kconfig
if BUILD_WITH_TFM && (SOC_SERIES_NRF54L || SOC_SERIES_NRF71)

DT_NRF_MPC := $(dt_nodelabel_path,nrf_mpc)

config NRF_TRUSTZONE_FLASH_REGION_SIZE
	hex
	default $(dt_node_int_prop_hex,$(DT_NRF_MPC),override-granularity)
	help
	  This defines the flash region size from the TrustZone perspective.
	  It is used when configuring the TrustZone and when setting alignments
	  requirements for the partitions.
	  This abstraction allows us to configure TrustZone without depending
	  on peripheral-specific symbols.

config NRF_TRUSTZONE_RAM_REGION_SIZE
	hex
	default $(dt_node_int_prop_hex,$(DT_NRF_MPC),override-granularity)
	help
	  This defines the RAM region size from the TrustZone perspective.
	  It is used when configuring the TrustZone and when setting alignments
	  requirements for the partitions.
	  This abstraction allows us to configure TrustZone without depending
	  on peripheral specific symbols.

endif # BUILD_WITH_TFM
```

## soc/nordic/common/uicr/Kconfig
```kconfig
# Copyright (c) 2025 Nordic Semiconductor ASA
# SPDX-License-Identifier: Apache-2.0

config IS_IRONSIDE_SE_SECONDARY_IMAGE
	bool "Ironside SE secondary image indicator (informative only, do not change)"
	help
	  This Kconfig is set by sysbuild to indicate that this image is a
	  secondary firmware for Ironside SE. This is used by the UICR generation
	  system to determine which PERIPHCONF partition to use.

config IS_GEN_UICR_IMAGE
	bool "UICR generator image indicator (informative only, do not change)"
	help
	  This Kconfig is automatically set when building the gen_uicr image.
	  It indicates that this is the UICR generator utility image and enables
	  the UICR generator configuration options.

# Source UICR generator options when building the gen_uicr image
# All options are disabled by default unless IS_GEN_UICR_IMAGE is set
rsource "Kconfig.gen_uicr"
```

## soc/nordic/common/uicr/Kconfig.sysbuild
```kconfig
# Copyright (c) 2025 Nordic Semiconductor ASA
# SPDX-License-Identifier: Apache-2.0

config NRF_GENERATE_UICR
	bool "Generate UICR artifacts"
	depends on SOC_SERIES_NRF54H || SOC_SERIES_NRF92
	default y
	help
	  When enabled, a UICR generator image is included in the build.
	  This generates binary configuration artifacts based on the Kconfig and device tree
	  of the UICR generator image. See the UICR generator options for further details.

config NRF_HALTIUM_GENERATE_UICR
	bool "[DEPRECATED] Renamed to NRF_GENERATE_UICR"
	depends on SOC_SERIES_NRF54H || SOC_SERIES_NRF92
	select DEPRECATED
	select NRF_GENERATE_UICR
	help
	  This option has been renamed. Use NRF_GENERATE_UICR instead.
	  The old name is kept temporarily so that existing sysbuild.conf files
	  continue to build, with a deprecation warning.
```

## soc/nordic/common/uicr/Kconfig.template.gen_uicr_snapshot_region
```kconfig
# Copyright (c) 2026 Nordic Semiconductor ASA
# SPDX-License-Identifier: Apache-2.0

config GEN_UICR_SNAPSHOT_REGION_$(index)
	bool "UICR.SNAPSHOT region"
	depends on GEN_UICR_SNAPSHOT_REGIONS
	help
	  When enabled, configures a UICR.SNAPSHOT region.

config GEN_UICR_SNAPSHOT_REGION_$(index)_ADDRESS
	hex "UICR.SNAPSHOT region start address"
	range 0x0e030000 0x0e1ff000
	depends on GEN_UICR_SNAPSHOT_REGION_$(index)
	help
	  UICR.SNAPSHOT region start address. Must be aligned to a 1 KB boundary.

config GEN_UICR_SNAPSHOT_REGION_$(index)_SIZE_BYTES
	int "UICR.SNAPSHOT region size in bytes"
	range 1024 1048576
	depends on GEN_UICR_SNAPSHOT_REGION_$(index)
	help
	  Size of the snapshot region in bytes. Must be a multiple of 1024.
```

## soc/nordic/common/uicr/gen_uicr/Kconfig
```kconfig
# Copyright (c) 2025 Nordic Semiconductor ASA
# SPDX-License-Identifier: Apache-2.0

config IS_GEN_UICR_IMAGE
	default y

source "Kconfig.zephyr"
```

## soc/nordic/common/vpr/Kconfig
```kconfig
# Copyright (c) 2024 Nordic Semiconductor ASA
# SPDX-License-Identifier: Apache-2.0

config RISCV_CORE_NORDIC_VPR
	bool
	select RISCV
	select RISCV_PRIVILEGED
	select RISCV_VECTORED_MODE
	select RISCV_SOC_HAS_ISR_STACKING
	select RISCV_SOC_HAS_GP_RELATIVE_ADDRESSING
	select RISCV_HAS_CLIC
	select RISCV_SOC_CONTEXT_SAVE
	select HAS_FLASH_LOAD_OFFSET
	select ARCH_HAS_CUSTOM_CPU_IDLE if !SOC_SERIES_NRF54L
	select ARCH_HAS_CUSTOM_CPU_ATOMIC_IDLE if !SOC_SERIES_NRF54L
	select INCLUDE_RESET_VECTOR
	imply XIP
	help
	  Enable support for the RISC-V Nordic VPR core.

choice NORDIC_VPR_SLEEP_MODE
	prompt "Default sleep mode"
	depends on RISCV_CORE_NORDIC_VPR
	default NORDIC_VPR_SLEEP if SOC_NRF54H20_CPUFLPR
	default NORDIC_VPR_DEEPSLEEP if SOC_NRF54H20_CPUPPR
	default NORDIC_VPR_HIBERNATE

config NORDIC_VPR_SLEEP
	bool "Sleep"
	help
	  Significantly higher power consumption but very short wake up time.

config NORDIC_VPR_DEEPSLEEP
	bool "Deep sleep"
	depends on SOC_NRF54H20_CPUPPR
	help
	  Deep sleep can reach less than 5 uA in system-on-idle state only on nRF54H20.
	  Wake up time is comparable to the 'sleep' mode.

config NORDIC_VPR_HIBERNATE
	bool "Hibernation"
	depends on !SOC_NRF54H20
	help
	  It has the lowest power consumption and it must be used to reach less than 5 uA in
	  the system-on-idle state on targets other than nRF54H20. It has slightly longer
	  wake up time (additional 1 us). Hibernation is using a RAM block to store the VPR
	  state and parent core must configure the memory so that it is powered on and retained.

endchoice
```

## soc/nordic/common/vpr/Kconfig.defconfig
```kconfig
# Copyright (c) 2024 Nordic Semiconductor ASA
# SPDX-License-Identifier: Apache-2.0

config RISCV_MCAUSE_EXCEPTION_MASK
	default 0xFFF

config GEN_ISR_TABLES
	default n

config GEN_SW_ISR_TABLE
	default n

config GEN_IRQ_VECTOR_TABLE
	default n

config RISCV_ALWAYS_SWITCH_THROUGH_ECALL
	default y if MULTITHREADING
```

## soc/nordic/common/vpr/Kconfig.sysbuild
```kconfig
# Copyright (c) 2024 Nordic Semiconductor ASA
# SPDX-License-Identifier: Apache-2.0

config VPR_LAUNCHER
	bool "VPR launcher"
	default y
	depends on HAS_NORDIC_VPR_LAUNCHER_IMAGE
	help
	  Include VPR launcher in build.
	  VPR launcher is a minimal sample built for an ARM core that starts given VPR core.
	  It is based on samples/basic/minimal with an appropriate snippet.
```

## soc/nordic/ironside/Kconfig
```kconfig
# Copyright (c) 2025 Nordic Semiconductor ASA
# SPDX-License-Identifier: Apache-2.0

config NRF_IRONSIDE
	bool
	depends on SOC_NRF54H20 || SOC_NRF9280_IRON
	help
	  This is selected by drivers interacting with Nordic IronSide firmware.

config NRF_IRONSIDE_CALL
	bool
	depends on DT_HAS_NORDIC_IRONSIDE_CALL_ENABLED
	select NRF_IRONSIDE
	select EVENTS
	select MBOX
	help
	  This is selected by features that require support for IronSide calls.

if NRF_IRONSIDE_CALL

config NRF_IRONSIDE_CALL_INIT_PRIORITY
	int "IronSide calls' initialization priority"
	default 41
	help
	  Initialization priority of IronSide calls. It must be below MBOX_INIT_PRIORITY,
	  but higher than the priority of any feature that selects NRF_IRONSIDE_CALL.

endif # NRF_IRONSIDE_CALL

menu "Nordic IronSide services"
	depends on SOC_NRF54H20 || SOC_NRF9280_IRON

config NRF_IRONSIDE_CPUCONF_SERVICE
	bool "IronSide CPUCONF service"
	depends on SOC_NRF54H20_CPUAPP || SOC_NRF9280_CPUAPP
	select NRF_IRONSIDE_CALL
	help
	  Service used to boot local domain cores.

config NRF_IRONSIDE_TDD_SERVICE
	bool "IronSide TDD service"
	select NRF_IRONSIDE_CALL
	help
	  Service used to control the trace and debug domain.

config NRF_IRONSIDE_UPDATE_SERVICE
	bool "IronSide update service"
	select NRF_IRONSIDE_CALL
	help
	  Service used to update the IronSide SE firmware.

config NRF_IRONSIDE_BOOT_REPORT
	bool "IronSide boot report"
	depends on $(dt_nodelabel_exists,ironside_se_boot_report)
	select NRF_IRONSIDE
	help
	  Support for parsing the Boot Report populated by Nordic IronSide firmware.

config NRF_IRONSIDE_BOOTMODE_SERVICE
	bool "IronSide boot mode service"
	select NRF_IRONSIDE_CALL
	help
	  Service used to reboot into secondary firmware boot mode.

config NRF_IRONSIDE_DVFS_SERVICE
	bool "IronSide DVFS service"
	depends on SOC_NRF54H20_CPUAPP
	select NRF_IRONSIDE_CALL
	help
	  Service used to handle DVFS operating point requests.

if NRF_IRONSIDE_DVFS_SERVICE

config NRF_IRONSIDE_ABB_STATUSANA_CHECK_MAX_ATTEMPTS
	int "IRONSside DVFS ABB analog status check maximum attempts"
	range 0 255
	default 50
	help
	  Maximum attempts with 10us intervals before busy status will be reported.

endif # NRF_IRONSIDE_DVFS_SERVICE

endmenu
```

## soc/nordic/nrf51/Kconfig
```kconfig
# Nordic Semiconductor nRF51 MCU line

# Copyright (c) 2016 Linaro Limited
# Copyright (c) 2018 Nordic Semiconductor ASA
# SPDX-License-Identifier: Apache-2.0

config SOC_SERIES_NRF51X
	select ARM
	select CPU_CORTEX_M0
	imply XIP
	select HAS_NRFX
	select HAS_SEGGER_RTT if ZEPHYR_SEGGER_MODULE
	select HAS_POWEROFF
```

## soc/nordic/nrf51/Kconfig.defconfig
```kconfig
# Nordic Semiconductor nRF51 MCU line

# Copyright (c) 2016 Linaro Limited
# Copyright (c) 2018 Nordic Semiconductor ASA
# SPDX-License-Identifier: Apache-2.0

if SOC_SERIES_NRF51

config NUM_IRQS
	default 26

config SYS_CLOCK_HW_CYCLES_PER_SEC
	default $(dt_nodelabel_int_prop,rtc1,clock-frequency)

# Disable the dedicated Bluetooth long workqueue to save RAM (its thread stack
# and control block). The long-running operations it would otherwise isolate
# (ECDH and the GATT database hash) fall back to the system workqueue.
configdefault BT_LONG_WQ
	default n

# With the long workqueue disabled, ECDH runs on the system workqueue instead.
# Size the system workqueue stack so that it can accommodate it.
configdefault SYSTEM_WORKQUEUE_STACK_SIZE
	default 1280 if BT_ECC && !BT_LONG_WQ

endif # SOC_SERIES_NRF51
```

## soc/nordic/nrf51/Kconfig.soc
```kconfig
# Nordic Semiconductor nRF51 MCU line

# Copyright (c) 2016 Linaro Limited
# SPDX-License-Identifier: Apache-2.0

config SOC_SERIES_NRF51
	bool
	select SOC_FAMILY_NORDIC_NRF
	help
	  Enable support for NRF51 MCU series

config SOC_SERIES_NRF51X
	bool
	select SOC_SERIES_NRF51
	help
	  Deprecated Kconfig, use SOC_SERIES_NRF51 instead

config SOC_SERIES
	default "nrf51" if SOC_SERIES_NRF51

config SOC_NRF51822_QFAA
	bool
	select SOC_SERIES_NRF51

config SOC_NRF51822_QFAB
	bool
	select SOC_SERIES_NRF51

config SOC_NRF51822_QFAC
	bool
	select SOC_SERIES_NRF51

config SOC
	default "nrf51822" if SOC_NRF51822_QFAA || SOC_NRF51822_QFAB || SOC_NRF51822_QFAC
```

## soc/nordic/nrf52/Kconfig
```kconfig
# Nordic Semiconductor nRF52 MCU line

# Copyright (c) 2016-2023 Nordic Semiconductor ASA
# SPDX-License-Identifier: Apache-2.0

config SOC_SERIES_NRF52X
	select ARM
	select SOC_COMPATIBLE_NRF52X
	select CPU_CORTEX_M4
	select CPU_HAS_ARM_MPU
	imply XIP
	select HAS_NRFX
	select HAS_NORDIC_DRIVERS
	select HAS_SEGGER_RTT if ZEPHYR_SEGGER_MODULE
	select HAS_SWO
	select HAS_POWEROFF

config SOC_NRF52832
	select CPU_CORTEX_M_HAS_DWT
	select CPU_HAS_FPU

config SOC_NRF52833
	select SOC_COMPATIBLE_NRF52833
	select CPU_CORTEX_M_HAS_DWT
	select CPU_HAS_FPU

config SOC_NRF52840
	select CPU_CORTEX_M_HAS_DWT
	select CPU_HAS_FPU

if SOC_SERIES_NRF52X

config SOC_DCDC_NRF52X
	bool
	select DEPRECATED
	help
	  This option is deprecated, use devicetree instead. Example
	  configuration:

	  &reg/reg1 {
	    regulator-initial-mode = <NRF5X_REG_MODE_DCDC>;
	  };

	  Enable nRF52 series System on Chip DC/DC converter.

config SOC_DCDC_NRF52X_HV
	bool
	depends on SOC_NRF52840_QIAA
	select DEPRECATED
	help
	  This option is deprecated, use devicetree instead. Example
	  configuration:

	  &reg0 {
	    status = "okay";
	  };

	  Enable nRF52 series System on Chip High Voltage DC/DC converter.

config GPIO_AS_PINRESET
	bool "[DEPRECATED] GPIO as pin reset (reset button)"
	select DEPRECATED
	help
	  This option is deprecated, use devicetree instead. Example
	  configuration:

	  &uicr {
	      gpio-as-nreset;
	  };

config NRF_ENABLE_ICACHE
	bool "The instruction cache (I-Cache)"
	depends on SOC_NRF52832 || SOC_NRF52833 || SOC_NRF52840
	default y

config NRF52_ANOMALY_132_DELAY_US
	int "Anomaly 132 workaround delay (microseconds)"
	default 330
	range 0 330
	depends on NRF52_ANOMALY_132_WORKAROUND
	help
	  Due to Anomaly 132 LF RC source may not start if restarted in certain
	  window after stopping (230 us to 330 us). Software reset also stops the
	  clock so if clock is initiated in certain window, the clock may also fail
	  to start at reboot. A delay is added before starting LF clock to ensure
	  that anomaly conditions are not met. Delay should be long enough to ensure
	  that clock is started later than 330 us after reset. If crystal oscillator
	  (XO) is used then low frequency clock initially starts with RC and then
	  seamlessly switches to XO which has much longer startup time thus,
	  depending on application, workaround may also need to be applied.
	  Additional drivers initialization increases initialization time and delay
	  may be shortened. Workaround is disabled by setting delay to 0.

config NRF52_ANOMALY_198_WORKAROUND
	bool "Anomaly 198 workaround"
	default y
	depends on SOC_NRF52840
	depends on NRFX_SPIM3
	help
	  This anomaly applies to IC revisions "Engineering B" up to "3", the most
	  recent one.

config NRF52_ANOMALY_109_WORKAROUND
	bool "Anomaly 109 workaround"
	default y
	depends on SOC_NRF52832
	depends on NRFX_SPIS || NRFX_SPIM || NRFX_TWIM || NRFX_PWM
	help
	  Due to Anomaly 109 the first byte sent out by these peripherals is
	  sometimes wrong. This occurs when the system enters IDLE and stops the
	  64MHz clock at the same time as the peripheral that is using DMA is started.
	  This anomaly applies to IC revisions up to "3", the most recent one.

config NRF52_ANOMALY_109_WORKAROUND_EGU_INSTANCE
	int "Anomaly 109 workaround EGU instance"
	depends on NRF52_ANOMALY_109_WORKAROUND
	range 0 5
	default 5
	help
	  EGU instance used by the nRF52 Anomaly 109 workaround for PWM.

endif # SOC_SERIES_NRF52X
```

## soc/nordic/nrf52/Kconfig.defconfig
```kconfig
# Nordic Semiconductor nRF52 MCU line

# Copyright (c) 2016-2018 Nordic Semiconductor ASA
# SPDX-License-Identifier: Apache-2.0

if SOC_SERIES_NRF52X

rsource "Kconfig.defconfig.nrf52*"

config SYS_CLOCK_HW_CYCLES_PER_SEC
	default $(dt_nodelabel_int_prop,rtc1,clock-frequency)

endif # SOC_SERIES_NRF52X
```

## soc/nordic/nrf52/Kconfig.defconfig.nrf52811_QFAA
```kconfig
# Nordic Semiconductor nRF52811 MCU

# Copyright (c) 2019 Nordic Semiconductor ASA
# SPDX-License-Identifier: Apache-2.0

if SOC_NRF52811_QFAA

config NUM_IRQS
	default 30

endif # SOC_NRF52811_QFAA
```

## soc/nordic/nrf52/Kconfig.defconfig.nrf52833_QIAA
```kconfig
# Nordic Semiconductor nRF52833 MCU

# Copyright (c) 2019 Nordic Semiconductor ASA
# SPDX-License-Identifier: Apache-2.0

if SOC_NRF52833_QIAA

config NUM_IRQS
	default 48

config BUILD_OUTPUT_UF2_FAMILY_ID
	default "0x621e937a"

endif # SOC_NRF52833_QIAA
```

## soc/nordic/nrf52/Kconfig.defconfig.nrf52840_QIAA
```kconfig
# Nordic Semiconductor nRF52840 MCU

# Copyright (c) 2016 Nordic Semiconductor ASA
# SPDX-License-Identifier: Apache-2.0

if SOC_NRF52840_QIAA

config NUM_IRQS
	default 48

config BUILD_OUTPUT_UF2_FAMILY_ID
	default "0xada52840"

endif # SOC_NRF52840_QIAA
```
