## soc/st/stm32/stm32f1x/Kconfig.soc
```kconfig
# ST Microelectronics STM32F1 MCU line

# Copyright (c) 2016 Open-RnD Sp. z o.o.
# Copyright (c) RnDity Sp. z o.o.
# SPDX-License-Identifier: Apache-2.0

config SOC_SERIES_STM32F1X
	bool
	select SOC_FAMILY_STM32

config SOC_SERIES
	default "stm32f1x" if SOC_SERIES_STM32F1X

config SOC_STM32F100XB
	bool
	select SOC_SERIES_STM32F1X

config SOC_STM32F100XE
	bool
	select SOC_SERIES_STM32F1X

config SOC_STM32F103XE
	bool
	select SOC_SERIES_STM32F1X
	select SOC_STM32F10X_DENSITY_DEVICE

config SOC_STM32F103XB
	bool
	select SOC_SERIES_STM32F1X
	select SOC_STM32F10X_DENSITY_DEVICE

config SOC_STM32F103X8
	bool
	select SOC_SERIES_STM32F1X
	select SOC_STM32F10X_DENSITY_DEVICE

config SOC_STM32F105XB
	bool
	select SOC_SERIES_STM32F1X
	select SOC_STM32F10X_CONNECTIVITY_LINE_DEVICE

config SOC_STM32F105XC
	bool
	select SOC_SERIES_STM32F1X
	select SOC_STM32F10X_CONNECTIVITY_LINE_DEVICE

config SOC_STM32F107XC
	bool
	select SOC_SERIES_STM32F1X
	select SOC_STM32F10X_CONNECTIVITY_LINE_DEVICE

config SOC_STM32F10X_DENSITY_DEVICE
	bool
	help
	  STM32F101xx, STM32F102xx, STM32F103xx:
	  * Low density Value line devices
	  * Medium density Value line devices
	  * High density Value line devices
	  * XL-density devices Value line devices

config SOC_STM32F10X_CONNECTIVITY_LINE_DEVICE
	bool
	help
	  Connectivity line devices are STM32F105xx and STM32F107xx
	  microcontrollers.  They are intended for applications where
	  connectivity and real-time performances are required such as
	  industrial control, control panels for security applications, UPS or
	  home audio.  For STM32F107xx also the Ethernet MAC is available.

config SOC
	default "stm32f100xb" if SOC_STM32F100XB
	default "stm32f100xe" if SOC_STM32F100XE
	default "stm32f103xb" if SOC_STM32F103XB || SOC_STM32F103X8
	default "stm32f103xe" if SOC_STM32F103XE
	default "stm32f105xc" if SOC_STM32F105XC || SOC_STM32F105XB
	default "stm32f107xc" if SOC_STM32F107XC
```

## soc/st/stm32/stm32f2/Kconfig.defconfig
```kconfig
# STMicroelectronics STM32F2 MCU line

# Copyright (c) 2018 qianfan Zhao <qianfanguijin@163.com>
# SPDX-License-Identifier: Apache-2.0

# Kconfig symbols common to STM32F2 series

if SOC_SERIES_STM32F2X

rsource "Kconfig.defconfig.stm32f2*"

endif # SOC_SERIES_STM32F2X
```

## soc/st/stm32/stm32f2x/Kconfig.defconfig
```kconfig
# STMicroelectronics STM32F2 MCU line

# Copyright (c) 2018 qianfan Zhao <qianfanguijin@163.com>
# SPDX-License-Identifier: Apache-2.0

# Kconfig symbols common to STM32F2 series

if SOC_SERIES_STM32F2X

configdefault SHARED_INTERRUPTS
	default y if $(dt_nodelabel_enabled,timers1) && $(dt_nodelabel_enabled,timers9)
	default y if $(dt_nodelabel_enabled,timers1) && $(dt_nodelabel_enabled,timers10)
	default y if $(dt_nodelabel_enabled,timers1) && $(dt_nodelabel_enabled,timers11)
	default y if $(dt_nodelabel_enabled,timers8) && $(dt_nodelabel_enabled,timers12)
	default y if $(dt_nodelabel_enabled,timers8) && $(dt_nodelabel_enabled,timers13)
	default y if $(dt_nodelabel_enabled,timers8) && $(dt_nodelabel_enabled,timers14)

config BUILD_OUTPUT_UF2_FAMILY_ID
	default "0x5d1a0a2e"

endif # SOC_SERIES_STM32F2X
```

## soc/st/stm32/stm32f2x/Kconfig.defconfig.stm32f205xx
```kconfig
# STMicroelectronics stm32f205 MCU

# Copyright (c) 2021 Manuel Forcen <manuforcen@gmail.com
# SPDX-License-Identifier: Apache-2.0

if SOC_STM32F205XX

config NUM_IRQS
	default 81

endif
```

## soc/st/stm32/stm32f2x/Kconfig.defconfig.stm32f207xx
```kconfig
# STMicroelectronics stm32f207 MCU

# Copyright (c) 2018 qianfan Zhao <qianfanguijin@163.com>
# SPDX-License-Identifier: Apache-2.0

if SOC_STM32F207XX

config NUM_IRQS
	default 81

endif
```

## soc/st/stm32/stm32f2x/Kconfig.soc
```kconfig
# STMicroelectronics stm32f2 MCU line

# Copyright (c) 2018 qianfan Zhao <qianfanguijin@163.com>
# SPDX-License-Identifier: Apache-2.0

config SOC_SERIES_STM32F2X
	bool
	select SOC_FAMILY_STM32

config SOC_SERIES
	default "stm32f2x" if SOC_SERIES_STM32F2X

config SOC_STM32F205XX
	bool
	select SOC_SERIES_STM32F2X

config SOC_STM32F207XX
	bool
	select SOC_SERIES_STM32F2X

config SOC
	default "stm32f205xx" if SOC_STM32F205XX
	default "stm32f207xx" if SOC_STM32F207XX
```

## soc/st/stm32/stm32f3x/Kconfig
```kconfig
# STMicroelectronics STM32F3 MCU series

# Copyright (c) 2016 RnDity Sp. z o.o.
# SPDX-License-Identifier: Apache-2.0

config SOC_SERIES_STM32F3X
	select ARM
	select CPU_CORTEX_M4
	select CPU_CORTEX_M_HAS_DWT
	select CPU_HAS_FPU
	select HAS_STM32CUBE
	select HAS_SWO
```

## soc/st/stm32/stm32f3x/Kconfig.defconfig
```kconfig
# STMicroelectronics STM32F3 MCU line

# Copyright (c) 2016 RnDity Sp. z o.o.
# SPDX-License-Identifier: Apache-2.0

# Kconfig symbols common to STM32F3 series

if SOC_SERIES_STM32F3X

rsource "Kconfig.defconfig.stm32f3*"

configdefault SHARED_INTERRUPTS
	default y if $(dt_nodelabel_enabled,timers1) && $(dt_nodelabel_enabled,timers15)
	default y if $(dt_nodelabel_enabled,timers1) && $(dt_nodelabel_enabled,timers16)
	default y if $(dt_nodelabel_enabled,timers1) && $(dt_nodelabel_enabled,timers17)

config BUILD_OUTPUT_UF2_FAMILY_ID
	default "0x6b846188"

endif # SOC_SERIES_STM32F3X
```

## soc/st/stm32/stm32f3x/Kconfig.defconfig.stm32f302x8
```kconfig
# STMicroelectronics STM32F302X8 MCU

# Copyright (c) 2018 Seitz & Associates
# SPDX-License-Identifier: Apache-2.0

if SOC_STM32F302X8

config NUM_IRQS
	default 82

endif # SOC_STM32F302X8
```
