## soc/st/stm32/stm32c5x/Kconfig.defconfig.stm32c591xx
```kconfig
# STMicroelectronics STM32C591XX MCU

# Copyright (c) 2026 STMicroelectronics
# SPDX-License-Identifier: Apache-2.0

if SOC_STM32C591XX

config NUM_IRQS
	default 99

endif # SOC_STM32C591XX
```

## soc/st/stm32/stm32c5x/Kconfig.defconfig.stm32c593xx
```kconfig
# STMicroelectronics STM32C593XX MCU

# Copyright (c) 2026 STMicroelectronics
# SPDX-License-Identifier: Apache-2.0

if SOC_STM32C593XX

config NUM_IRQS
	default 99

endif # SOC_STM32C593XX
```

## soc/st/stm32/stm32c5x/Kconfig.defconfig.stm32c5a3xx
```kconfig
# STMicroelectronics STM32C5A3XX MCU

# Copyright (c) 2026 STMicroelectronics
# SPDX-License-Identifier: Apache-2.0

if SOC_STM32C5A3XX

config NUM_IRQS
	default 99

endif # SOC_STM32C5A3XX
```

## soc/st/stm32/stm32c5x/Kconfig.soc
```kconfig
# STMicroelectronics STM32C5 MCU line

# Copyright (c) 2026 STMicroelectronics
# SPDX-License-Identifier: Apache-2.0

config SOC_SERIES_STM32C5X
	bool
	select SOC_FAMILY_STM32

config SOC_SERIES
	default "stm32c5x" if SOC_SERIES_STM32C5X

config SOC_STM32C531XX
	bool
	select SOC_SERIES_STM32C5X

config SOC_STM32C532XX
	bool
	select SOC_SERIES_STM32C5X

config SOC_STM32C542XX
	bool
	select SOC_SERIES_STM32C5X

config SOC_STM32C551XX
	bool
	select SOC_SERIES_STM32C5X

config SOC_STM32C552XX
	bool
	select SOC_SERIES_STM32C5X

config SOC_STM32C562XX
	bool
	select SOC_SERIES_STM32C5X

config SOC_STM32C591XX
	bool
	select SOC_SERIES_STM32C5X

config SOC_STM32C593XX
	bool
	select SOC_SERIES_STM32C5X

config SOC_STM32C5A3XX
	bool
	select SOC_SERIES_STM32C5X

config SOC
	default "stm32c531xx" if SOC_STM32C531XX
	default "stm32c532xx" if SOC_STM32C532XX
	default "stm32c542xx" if SOC_STM32C542XX
	default "stm32c551xx" if SOC_STM32C551XX
	default "stm32c552xx" if SOC_STM32C552XX
	default "stm32c562xx" if SOC_STM32C562XX
	default "stm32c591xx" if SOC_STM32C591XX
	default "stm32c593xx" if SOC_STM32C593XX
	default "stm32c5a3xx" if SOC_STM32C5A3XX
```

## soc/st/stm32/stm32f0x/Kconfig.defconfig
```kconfig
# ST Microelectronics STM32F0 MCU line

# Copyright (c) 2017 RnDity Sp. z o.o.
# SPDX-License-Identifier: Apache-2.0

# Kconfig symbols common to STM32F0 series

if SOC_SERIES_STM32F0X

# STM32F030x4 must be exposed as STM32F030x6 at HAL level.
# STM32F072x8 must be exposed as STM32F072xB at HAL level.
configdefault STM32CUBE_SOC_NAME_OVERRIDE
	default "stm32f030x6" if SOC_STM32F030X4
	default "stm32f072xb" if SOC_STM32F072X8

config SRAM_VECTOR_TABLE
	default y

# adjust the fallback because of the LSI oscillator characteristics
config TASK_WDT_HW_FALLBACK_DELAY
	depends on TASK_WDT_HW_FALLBACK
	default 100

# USARTs 3-8 share IRQn 29 on various F0 variants (f030Xc, f070Xb, f071,
# f072, f091, f098).  The exact set of nodes present depends on the SoC;
# dt_nodelabel_enabled evaluates to false for nodes that do not exist, so
# listing all pairwise combinations here is safe.
# Note: the C(6,N) combinations below were generated programmatically.
#
# SHARED_IRQ_MAX_NUM_CLIENTS: set to the total count of enabled UART
# instances on IRQn 29.  Because Kconfig defaults are evaluated in order,
# list from highest to lowest.  Only variants with >=3 enabled instances
# need an explicit entry (the Kconfig default of 2 covers pairs).
configdefault SHARED_IRQ_MAX_NUM_CLIENTS
	# All six (f091/f098 only)
	default 6 if $(dt_nodelabel_enabled,usart3) && $(dt_nodelabel_enabled,usart4) \
		&& $(dt_nodelabel_enabled,usart5) && $(dt_nodelabel_enabled,usart6) \
		&& $(dt_nodelabel_enabled,usart7) && $(dt_nodelabel_enabled,usart8)
	# Five of six (f091/f098)
	default 5 if $(dt_nodelabel_enabled,usart3) && $(dt_nodelabel_enabled,usart4) \
		&& $(dt_nodelabel_enabled,usart5) && $(dt_nodelabel_enabled,usart6) \
		&& $(dt_nodelabel_enabled,usart7)
	default 5 if $(dt_nodelabel_enabled,usart3) && $(dt_nodelabel_enabled,usart4) \
		&& $(dt_nodelabel_enabled,usart5) && $(dt_nodelabel_enabled,usart6) \
		&& $(dt_nodelabel_enabled,usart8)
	default 5 if $(dt_nodelabel_enabled,usart3) && $(dt_nodelabel_enabled,usart4) \
		&& $(dt_nodelabel_enabled,usart5) && $(dt_nodelabel_enabled,usart7) \
		&& $(dt_nodelabel_enabled,usart8)
	default 5 if $(dt_nodelabel_enabled,usart3) && $(dt_nodelabel_enabled,usart4) \
		&& $(dt_nodelabel_enabled,usart6) && $(dt_nodelabel_enabled,usart7) \
		&& $(dt_nodelabel_enabled,usart8)
	default 5 if $(dt_nodelabel_enabled,usart3) && $(dt_nodelabel_enabled,usart5) \
		&& $(dt_nodelabel_enabled,usart6) && $(dt_nodelabel_enabled,usart7) \
		&& $(dt_nodelabel_enabled,usart8)
	default 5 if $(dt_nodelabel_enabled,usart4) && $(dt_nodelabel_enabled,usart5) \
		&& $(dt_nodelabel_enabled,usart6) && $(dt_nodelabel_enabled,usart7) \
		&& $(dt_nodelabel_enabled,usart8)
	# Four of six (f030Xc or f091/f098 with some disabled)
	default 4 if $(dt_nodelabel_enabled,usart3) && $(dt_nodelabel_enabled,usart4) \
		&& $(dt_nodelabel_enabled,usart5) && $(dt_nodelabel_enabled,usart6)
	default 4 if $(dt_nodelabel_enabled,usart3) && $(dt_nodelabel_enabled,usart4) \
		&& $(dt_nodelabel_enabled,usart5) && $(dt_nodelabel_enabled,usart7)
	default 4 if $(dt_nodelabel_enabled,usart3) && $(dt_nodelabel_enabled,usart4) \
		&& $(dt_nodelabel_enabled,usart5) && $(dt_nodelabel_enabled,usart8)
	default 4 if $(dt_nodelabel_enabled,usart3) && $(dt_nodelabel_enabled,usart4) \
		&& $(dt_nodelabel_enabled,usart6) && $(dt_nodelabel_enabled,usart7)
	default 4 if $(dt_nodelabel_enabled,usart3) && $(dt_nodelabel_enabled,usart4) \
		&& $(dt_nodelabel_enabled,usart6) && $(dt_nodelabel_enabled,usart8)
	default 4 if $(dt_nodelabel_enabled,usart3) && $(dt_nodelabel_enabled,usart4) \
		&& $(dt_nodelabel_enabled,usart7) && $(dt_nodelabel_enabled,usart8)
	default 4 if $(dt_nodelabel_enabled,usart3) && $(dt_nodelabel_enabled,usart5) \
		&& $(dt_nodelabel_enabled,usart6) && $(dt_nodelabel_enabled,usart7)
	default 4 if $(dt_nodelabel_enabled,usart3) && $(dt_nodelabel_enabled,usart5) \
		&& $(dt_nodelabel_enabled,usart6) && $(dt_nodelabel_enabled,usart8)
	default 4 if $(dt_nodelabel_enabled,usart3) && $(dt_nodelabel_enabled,usart5) \
		&& $(dt_nodelabel_enabled,usart7) && $(dt_nodelabel_enabled,usart8)
	default 4 if $(dt_nodelabel_enabled,usart3) && $(dt_nodelabel_enabled,usart6) \
		&& $(dt_nodelabel_enabled,usart7) && $(dt_nodelabel_enabled,usart8)
	default 4 if $(dt_nodelabel_enabled,usart4) && $(dt_nodelabel_enabled,usart5) \
		&& $(dt_nodelabel_enabled,usart6) && $(dt_nodelabel_enabled,usart7)
	default 4 if $(dt_nodelabel_enabled,usart4) && $(dt_nodelabel_enabled,usart5) \
		&& $(dt_nodelabel_enabled,usart6) && $(dt_nodelabel_enabled,usart8)
	default 4 if $(dt_nodelabel_enabled,usart4) && $(dt_nodelabel_enabled,usart5) \
		&& $(dt_nodelabel_enabled,usart7) && $(dt_nodelabel_enabled,usart8)
	default 4 if $(dt_nodelabel_enabled,usart4) && $(dt_nodelabel_enabled,usart6) \
		&& $(dt_nodelabel_enabled,usart7) && $(dt_nodelabel_enabled,usart8)
	default 4 if $(dt_nodelabel_enabled,usart5) && $(dt_nodelabel_enabled,usart6) \
		&& $(dt_nodelabel_enabled,usart7) && $(dt_nodelabel_enabled,usart8)
	# Three of six
	default 3 if $(dt_nodelabel_enabled,usart3) && $(dt_nodelabel_enabled,usart4) \
		&& $(dt_nodelabel_enabled,usart5)
	default 3 if $(dt_nodelabel_enabled,usart3) && $(dt_nodelabel_enabled,usart4) \
		&& $(dt_nodelabel_enabled,usart6)
	default 3 if $(dt_nodelabel_enabled,usart3) && $(dt_nodelabel_enabled,usart4) \
		&& $(dt_nodelabel_enabled,usart7)
	default 3 if $(dt_nodelabel_enabled,usart3) && $(dt_nodelabel_enabled,usart4) \
		&& $(dt_nodelabel_enabled,usart8)
	default 3 if $(dt_nodelabel_enabled,usart3) && $(dt_nodelabel_enabled,usart5) \
		&& $(dt_nodelabel_enabled,usart6)
	default 3 if $(dt_nodelabel_enabled,usart3) && $(dt_nodelabel_enabled,usart5) \
		&& $(dt_nodelabel_enabled,usart7)
	default 3 if $(dt_nodelabel_enabled,usart3) && $(dt_nodelabel_enabled,usart5) \
		&& $(dt_nodelabel_enabled,usart8)
	default 3 if $(dt_nodelabel_enabled,usart3) && $(dt_nodelabel_enabled,usart6) \
		&& $(dt_nodelabel_enabled,usart7)
	default 3 if $(dt_nodelabel_enabled,usart3) && $(dt_nodelabel_enabled,usart6) \
		&& $(dt_nodelabel_enabled,usart8)
	default 3 if $(dt_nodelabel_enabled,usart3) && $(dt_nodelabel_enabled,usart7) \
		&& $(dt_nodelabel_enabled,usart8)
	default 3 if $(dt_nodelabel_enabled,usart4) && $(dt_nodelabel_enabled,usart5) \
		&& $(dt_nodelabel_enabled,usart6)
	default 3 if $(dt_nodelabel_enabled,usart4) && $(dt_nodelabel_enabled,usart5) \
		&& $(dt_nodelabel_enabled,usart7)
	default 3 if $(dt_nodelabel_enabled,usart4) && $(dt_nodelabel_enabled,usart5) \
		&& $(dt_nodelabel_enabled,usart8)
	default 3 if $(dt_nodelabel_enabled,usart4) && $(dt_nodelabel_enabled,usart6) \
		&& $(dt_nodelabel_enabled,usart7)
	default 3 if $(dt_nodelabel_enabled,usart4) && $(dt_nodelabel_enabled,usart6) \
		&& $(dt_nodelabel_enabled,usart8)
	default 3 if $(dt_nodelabel_enabled,usart4) && $(dt_nodelabel_enabled,usart7) \
		&& $(dt_nodelabel_enabled,usart8)
	default 3 if $(dt_nodelabel_enabled,usart5) && $(dt_nodelabel_enabled,usart6) \
		&& $(dt_nodelabel_enabled,usart7)
	default 3 if $(dt_nodelabel_enabled,usart5) && $(dt_nodelabel_enabled,usart6) \
		&& $(dt_nodelabel_enabled,usart8)
	default 3 if $(dt_nodelabel_enabled,usart5) && $(dt_nodelabel_enabled,usart7) \
		&& $(dt_nodelabel_enabled,usart8)
	default 3 if $(dt_nodelabel_enabled,usart6) && $(dt_nodelabel_enabled,usart7) \
		&& $(dt_nodelabel_enabled,usart8)

configdefault SHARED_INTERRUPTS
	# USART3/4/5/6/7/8 : IRQn 29 (subset depends on SoC variant)
	default y if $(dt_nodelabel_enabled,usart3) && $(dt_nodelabel_enabled,usart4)
	default y if $(dt_nodelabel_enabled,usart3) && $(dt_nodelabel_enabled,usart5)
	default y if $(dt_nodelabel_enabled,usart3) && $(dt_nodelabel_enabled,usart6)
	default y if $(dt_nodelabel_enabled,usart3) && $(dt_nodelabel_enabled,usart7)
	default y if $(dt_nodelabel_enabled,usart3) && $(dt_nodelabel_enabled,usart8)
	default y if $(dt_nodelabel_enabled,usart4) && $(dt_nodelabel_enabled,usart5)
	default y if $(dt_nodelabel_enabled,usart4) && $(dt_nodelabel_enabled,usart6)
	default y if $(dt_nodelabel_enabled,usart4) && $(dt_nodelabel_enabled,usart7)
	default y if $(dt_nodelabel_enabled,usart4) && $(dt_nodelabel_enabled,usart8)
	default y if $(dt_nodelabel_enabled,usart5) && $(dt_nodelabel_enabled,usart6)
	default y if $(dt_nodelabel_enabled,usart5) && $(dt_nodelabel_enabled,usart7)
	default y if $(dt_nodelabel_enabled,usart5) && $(dt_nodelabel_enabled,usart8)
	default y if $(dt_nodelabel_enabled,usart6) && $(dt_nodelabel_enabled,usart7)
	default y if $(dt_nodelabel_enabled,usart6) && $(dt_nodelabel_enabled,usart8)
	default y if $(dt_nodelabel_enabled,usart7) && $(dt_nodelabel_enabled,usart8)

config BUILD_OUTPUT_UF2_FAMILY_ID
	default "0x647824b6"

endif # SOC_SERIES_STM32F0X
```

## soc/st/stm32/stm32f0x/Kconfig.defconfig.stm32f030x4
```kconfig
# Copyright (c) 2019 Antony Pavlov <antonynpavlov@gmail.com>
# SPDX-License-Identifier: Apache-2.0

if SOC_STM32F030X4

config NUM_IRQS
	default 28

endif # SOC_STM32F030X4
```

## soc/st/stm32/stm32f0x/Kconfig.defconfig.stm32f030x6
```kconfig
# Copyright (c) 2022 William MARTIN <william.martin@power-lan.com>
# SPDX-License-Identifier: Apache-2.0

if SOC_STM32F030X6

config NUM_IRQS
	default 28

endif # SOC_STM32F030X6
```

## soc/st/stm32/stm32f0x/Kconfig.defconfig.stm32f030xc
```kconfig
# Copyright (c) 2020 Brian Kubisiak <brian@kubisiak.com>
# SPDX-License-Identifier: Apache-2.0

if SOC_STM32F030XC

config NUM_IRQS
	default 31

endif # SOC_STM32F030XC
```

## soc/st/stm32/stm32f0x/Kconfig.defconfig.stm32f031x6
```kconfig
# ST Microelectronics STM32F031X6 MCU

# Copyright (c) 2021 Sebastian Schwabe <sebastian.schwabe@mailbox.tu-dresden.de>
# SPDX-License-Identifier: Apache-2.0

if SOC_STM32F031X6

config NUM_IRQS
	default 28

# Reduce kernel stack sizes to fit in 4 KiB RAM
config MAIN_STACK_SIZE
	default 512

config IDLE_STACK_SIZE
	default 150

config ISR_STACK_SIZE
	default 512

endif # SOC_STM32F031X6
```

## soc/st/stm32/stm32f0x/Kconfig.defconfig.stm32f042x6
```kconfig
# ST Microelectronics STM32F042X6 MCU

# Copyright (c) 2023 STMicroelectronics
# SPDX-License-Identifier: Apache-2.0

if SOC_STM32F042X6

config NUM_IRQS
	default 32

endif # SOC_STM32F042X6
```

## soc/st/stm32/stm32f0x/Kconfig.defconfig.stm32f051x8
```kconfig
# ST Microelectronics STM32F051X8 MCU

# Copyright (c) 2018 Nathan Tsoi
# SPDX-License-Identifier: Apache-2.0

if SOC_STM32F051X8

config NUM_IRQS
	default 31

endif # SOC_STM32F051X8
```

## soc/st/stm32/stm32f0x/Kconfig.defconfig.stm32f072x8
```kconfig
# ST Microelectronics STM32F072X8 MCU

# Copyright (c) 2024, Jonas Otto
# SPDX-License-Identifier: Apache-2.0

if SOC_STM32F072X8

config NUM_IRQS
	default 32

endif # SOC_STM32F072X8
```

## soc/st/stm32/stm32f0x/Kconfig.soc
```kconfig
# ST Microelectronics STM32F0 MCU line

# Copyright (c) 2017 RnDity Sp. z o.o.
# SPDX-License-Identifier: Apache-2.0

config SOC_SERIES_STM32F0X
	bool
	select SOC_FAMILY_STM32

config SOC_SERIES
	default "stm32f0x" if SOC_SERIES_STM32F0X

config SOC_STM32F030X4
	bool
	select SOC_SERIES_STM32F0X

config SOC_STM32F030X6
	bool
	select SOC_SERIES_STM32F0X

config SOC_STM32F030X8
	bool
	select SOC_SERIES_STM32F0X

config SOC_STM32F030XC
	bool
	select SOC_SERIES_STM32F0X

config SOC_STM32F031X6
	bool
	select SOC_SERIES_STM32F0X

config SOC_STM32F042X6
	bool
	select SOC_SERIES_STM32F0X

config SOC_STM32F051X8
	bool
	select SOC_SERIES_STM32F0X

config SOC_STM32F070XB
	bool
	select SOC_SERIES_STM32F0X

config SOC_STM32F072X8
	bool
	select SOC_SERIES_STM32F0X

config SOC_STM32F072XB
	bool
	select SOC_SERIES_STM32F0X

config SOC_STM32F091XC
	bool
	select SOC_SERIES_STM32F0X

config SOC_STM32F098XX
	bool
	select SOC_SERIES_STM32F0X

# STM32F0 Cube package advises to use 'stm32f030x6' code
# for both STM32F030x4 and STM32F030x6
config SOC
	default "stm32f030x6" if SOC_STM32F030X4 || SOC_STM32F030X6
	default "stm32f030x8" if SOC_STM32F030X8
	default "stm32f030xc" if SOC_STM32F030XC
	default "stm32f031x6" if SOC_STM32F031X6
	default "stm32f042x6" if SOC_STM32F042X6
	default "stm32f051x8" if SOC_STM32F051X8
	default "stm32f070xb" if SOC_STM32F070XB
	default "stm32f072xb" if SOC_STM32F072X8 || SOC_STM32F072XB
	default "stm32f091xc" if SOC_STM32F091XC
	default "stm32f098xx" if SOC_STM32F098XX
```

## soc/st/stm32/stm32f1x/Kconfig
```kconfig
# ST Microelectronics STM32F1 MCU series

# Copyright (c) 2016 Open-RnD Sp. z o.o.
# SPDX-License-Identifier: Apache-2.0

config SOC_SERIES_STM32F1X
	select ARM
	select CPU_CORTEX_M3
	select CPU_CORTEX_M_HAS_DWT
	select HAS_STM32CUBE
	select HAS_SWO
	select SOC_EARLY_INIT_HOOK
```

## soc/st/stm32/stm32f1x/Kconfig.defconfig
```kconfig
# ST Microelectronics STM32F1 MCU line

# Copyright (c) 2016 Open-RnD Sp. z o.o.
# SPDX-License-Identifier: Apache-2.0

# Kconfig symbols common to STM32F1 series

if SOC_SERIES_STM32F1X

# STM32F103x8 must be exposed as STM32F103xB at HAL level.
# STM32F105xB must be exposed as STM32F105xC at HAL level.
configdefault STM32CUBE_SOC_NAME_OVERRIDE
	default "stm32f103xb" if SOC_STM32F103X8
	default "stm32f105xc" if SOC_STM32F105XB

# adjust the fallback because of the LSI oscaillator characteristics
config TASK_WDT_HW_FALLBACK_DELAY
	depends on TASK_WDT_HW_FALLBACK
	default 200

if PM

config COUNTER
	default y

endif # PM

config BUILD_OUTPUT_UF2_FAMILY_ID
	default "0x5ee21072" if SOC_STM32F103XE

endif # SOC_SERIES_STM32F1X
```

## soc/st/stm32/stm32f1x/Kconfig.defconfig.stm32f100xx
```kconfig
# STMicroelectronics STM32F100XX MCU

# Copyright (c) 2020, Jonas Eriksson, Up to Code AB
# SPDX-License-Identifier: Apache-2.0

if SOC_STM32F100XB

config NUM_IRQS
	default 56

endif # SOC_STM32F100XB

if SOC_STM32F100XE

config NUM_IRQS
	default 61

endif # SOC_STM32F100XE
```
