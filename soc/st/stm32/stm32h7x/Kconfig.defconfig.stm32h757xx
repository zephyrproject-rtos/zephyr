## soc/st/stm32/stm32h7x/Kconfig.defconfig.stm32h757xx
```kconfig
# ST STM32H757X MCU configuration options
#
# Copyright (c) 2024 Grinn sp. z o.o.
#
# SPDX-License-Identifier: Apache-2.0

if SOC_STM32H757XX_M7 || SOC_STM32H757XX_M4

config STM32H7_DUAL_CORE
	default y

config NUM_IRQS
	default 150

endif # SOC_STM32H757XX_M7 || SOC_STM32H757XX_M4
```

## soc/st/stm32/stm32h7x/Kconfig.defconfig.stm32h7a3xx
```kconfig
# ST STM32H7A3X MCU configuration options

# Copyright (c) 2021 Electrolance Solutions
# SPDX-License-Identifier: Apache-2.0

if SOC_STM32H7A3XX || SOC_STM32H7A3XXQ

config NUM_IRQS
	default 155

endif # SOC_STM32H7A3XX || SOC_STM32H7A3XXQ
```

## soc/st/stm32/stm32h7x/Kconfig.defconfig.stm32h7b3xx
```kconfig
# ST STM32H7B3X MCU configuration options

# Copyright (c) 2022 Byte-Lab d.o.o <dev@byte-lab.com>
# SPDX-License-Identifier: Apache-2.0

if SOC_STM32H7B3XX || SOC_STM32H7B3XXQ

config NUM_IRQS
	default 155

endif # SOC_STM32H7B3XX || SOC_STM32H7B3XXQ
```

## soc/st/stm32/stm32h7x/Kconfig.soc
```kconfig
# ST Microelectronics STM32H7 MCU line

# Copyright (c) 2019 Linaro Limited
# Copyright (c) 2020 Teslabs Engineering S.L.
# Copyright (c) 2021 Electrolance Solutions
# SPDX-License-Identifier: Apache-2.0

config SOC_SERIES_STM32H7X
	bool
	select SOC_FAMILY_STM32

config SOC_SERIES
	default "stm32h7x" if SOC_SERIES_STM32H7X

config SOC_STM32H723XX
	bool
	select SOC_SERIES_STM32H7X

config SOC_STM32H725XX
	bool
	select SOC_SERIES_STM32H7X

config SOC_STM32H730XX
	bool
	select SOC_SERIES_STM32H7X

config SOC_STM32H730XXQ
	bool
	select SOC_SERIES_STM32H7X

config SOC_STM32H735XX
	bool
	select SOC_SERIES_STM32H7X

config SOC_STM32H743XX
	bool
	select SOC_SERIES_STM32H7X

config SOC_STM32H745XX_M7
	bool
	select SOC_SERIES_STM32H7X

config SOC_STM32H745XX_M4
	bool
	select SOC_SERIES_STM32H7X

config SOC_STM32H747XX_M7
	bool
	select SOC_SERIES_STM32H7X

config SOC_STM32H747XX_M4
	bool
	select SOC_SERIES_STM32H7X

config SOC_STM32H750XX
	bool
	select SOC_SERIES_STM32H7X

config SOC_STM32H753XX
	bool
	select SOC_SERIES_STM32H7X

config SOC_STM32H755XX_M4
	bool
	select SOC_SERIES_STM32H7X

config SOC_STM32H755XX_M7
	bool
	select SOC_SERIES_STM32H7X

config SOC_STM32H757XX_M4
	bool
	select SOC_SERIES_STM32H7X

config SOC_STM32H757XX_M7
	bool
	select SOC_SERIES_STM32H7X

config SOC_STM32H7A3XX
	bool
	select SOC_SERIES_STM32H7X

config SOC_STM32H7A3XXQ
	bool
	select SOC_SERIES_STM32H7X

config SOC_STM32H7B0XX
	bool
	select SOC_SERIES_STM32H7X

config SOC_STM32H7B0XXQ
	bool
	select SOC_SERIES_STM32H7X

config SOC_STM32H7B3XX
	bool
	select SOC_SERIES_STM32H7X

config SOC_STM32H7B3XXQ
	bool
	select SOC_SERIES_STM32H7X

config SOC
	default "stm32h7a3xx" if SOC_STM32H7A3XX
	default "stm32h7a3xxq" if SOC_STM32H7A3XXQ
	default "stm32h7b0xx" if SOC_STM32H7B0XX
	default "stm32h7b0xxq" if SOC_STM32H7B0XXQ
	default "stm32h7b3xx" if SOC_STM32H7B3XX
	default "stm32h7b3xxq"if SOC_STM32H7B3XXQ
	default "stm32h723xx" if SOC_STM32H723XX
	default "stm32h725xx" if SOC_STM32H725XX
	default "stm32h730xx" if SOC_STM32H730XX
	default "stm32h730xxq" if SOC_STM32H730XXQ
	default "stm32h735xx" if SOC_STM32H735XX
	default "stm32h743xx" if SOC_STM32H743XX
	default "stm32h745xx" if SOC_STM32H745XX_M7 || SOC_STM32H745XX_M4
	default "stm32h747xx" if SOC_STM32H747XX_M7 || SOC_STM32H747XX_M4
	default "stm32h750xx" if SOC_STM32H750XX
	default "stm32h753xx" if SOC_STM32H753XX
	default "stm32h755xx" if SOC_STM32H755XX_M7 || SOC_STM32H755XX_M4
	default "stm32h757xx" if SOC_STM32H757XX_M7 || SOC_STM32H757XX_M4
```

## soc/st/stm32/stm32l0x/Kconfig
```kconfig
# ST Microelectronics STM32L0 MCU series

# Copyright (c) 2018 Endre Karlson <endre.karlson@gmail.com>
# SPDX-License-Identifier: Apache-2.0

config SOC_SERIES_STM32L0X
	select ARM
	select CPU_CORTEX_M0PLUS
	select CPU_CORTEX_M_HAS_VTOR
	select HAS_STM32CUBE
	select CPU_CORTEX_M_HAS_SYSTICK
	select HAS_PM
	select SOC_EARLY_INIT_HOOK

config SOC_STM32L051XX
	select CPU_HAS_ARM_MPU

config SOC_STM32L053XX
	select CPU_HAS_ARM_MPU

config SOC_STM32L071XX
	select CPU_HAS_ARM_MPU

config SOC_STM32L072XX
	select CPU_HAS_ARM_MPU

config SOC_STM32L073XX
	select CPU_HAS_ARM_MPU

config SOC_STM32L081XX
	select CPU_HAS_ARM_MPU
```

## soc/st/stm32/stm32l0x/Kconfig.defconfig
```kconfig
# ST Microelectronics STM32L0 MCU line

# Copyright (c) 2018 Endre Karlson <endre.karlson@gmail.com>
# SPDX-License-Identifier: Apache-2.0

# Kconfig symbols common to STM32L0 series

if SOC_SERIES_STM32L0X

# adjust the fallback because of the LSI oscillator characteristics
config TASK_WDT_HW_FALLBACK_DELAY
	depends on TASK_WDT_HW_FALLBACK
	default 200

configdefault SHARED_INTERRUPTS
	# USART4 - USART5 : IRQn 14
	default y if $(dt_nodelabel_enabled,usart4) && $(dt_nodelabel_enabled,usart5)

endif # SOC_SERIES_STM32L0X
```

## soc/st/stm32/stm32l0x/Kconfig.defconfig.stm32l010x6
```kconfig
# ST Microelectronics STM32L010XX MCU
#
# Copyright (c) 2023 OS Systems
# SPDX-License-Identifier: Apache-2.0

if SOC_STM32L010X6

config NUM_IRQS
	default 30

endif # SOC_STM32L010X6
```

## soc/st/stm32/stm32l0x/Kconfig.defconfig.stm32l010xb
```kconfig
# ST Microelectronics STM32L010XX MCU
#
# Copyright (c) 2021 Wouter Cappelle <wouter.cappelle@crodeon.com>
# SPDX-License-Identifier: Apache-2.0

if SOC_STM32L010XB

config NUM_IRQS
	default 30

endif # SOC_STM32L010XB
```

## soc/st/stm32/stm32l0x/Kconfig.defconfig.stm32l011xx
```kconfig
# ST Microelectronics STM32L011XX MCU
#
# Copyright (c) 2019-2020 Grinn
# SPDX-License-Identifier: Apache-2.0

if SOC_STM32L011XX

config NUM_IRQS
	default 32

endif # SOC_STM32L011XX
```

## soc/st/stm32/stm32l0x/Kconfig.defconfig.stm32l031xx
```kconfig
# ST Microelectronics STM32L031XX MCU

# Copyright (c) 2020 Steven Daglish <s.c.daglish@gmail.com>
# SPDX-License-Identifier: Apache-2.0

if SOC_STM32L031XX

config NUM_IRQS
	default 32

endif # SOC_STM32L031XX
```

## soc/st/stm32/stm32l0x/Kconfig.defconfig.stm32l051xx
```kconfig
# ST Microelectronics STM32L051XX MCU

# Copyright (c) 2021 Nomono AS
# SPDX-License-Identifier: Apache-2.0

if SOC_STM32L051XX

config NUM_IRQS
	default 32

endif # SOC_STM32L051XX
```

## soc/st/stm32/stm32l0x/Kconfig.defconfig.stm32l053xx
```kconfig
# ST Microelectronics STM32L053X8 MCU

# Copyright (c) 2018 Anthony Kreft <anthony.kreft@gmail.com>
# SPDX-License-Identifier: Apache-2.0

if SOC_STM32L053XX

config NUM_IRQS
	default 32

endif # SOC_STM32L053XX
```

## soc/st/stm32/stm32l0x/Kconfig.defconfig.stm32l072xx
```kconfig
# ST Microelectronics STM32L072XZ MCU

# Copyright (c) 2018 Endre Karlson <endre.karlson@gmail.com>
# SPDX-License-Identifier: Apache-2.0

if SOC_STM32L072XX

config NUM_IRQS
	default 32

endif # SOC_STM32L072XX
```

## soc/st/stm32/stm32l0x/Kconfig.defconfig.stm32l073xx
```kconfig
# ST Microelectronics STM32L073XZ MCU

# Copyright (c) 2018 Ilya Tagunov <tagunil@gmail.com>
# SPDX-License-Identifier: Apache-2.0

if SOC_STM32L073XX

config NUM_IRQS
	default 32

endif # SOC_STM32L073XX
```

## soc/st/stm32/stm32l0x/Kconfig.defconfig.stm32l081xx
```kconfig
# ST Microelectronics STM32L081XX MCU

# Copyright (c) 2023 Caspar Friedrich <c.s.w.friedrich@gmail.com>
# SPDX-License-Identifier: Apache-2.0

if SOC_STM32L081XX

config NUM_IRQS
	default 32

endif # SOC_STM32L081XX
```

## soc/st/stm32/stm32l0x/Kconfig.defconfig.stm32l083xx
```kconfig
# ST Microelectronics STM32L083XX MCU

# Copyright (c) 2018 Ilya Tagunov <tagunil@gmail.com>
# Copyright (c) 2025 HARDWARIO a.s.
# SPDX-License-Identifier: Apache-2.0

if SOC_STM32L083XX

config NUM_IRQS
	default 32

endif # SOC_STM32L083XX
```

## soc/st/stm32/stm32l0x/Kconfig.soc
```kconfig
# ST Microelectronics STM32L0 MCU line

# Copyright (c) 2018 Endre Karlson <endre.karlson@gmail.com>
# Copyright (c) 2021 Nomono AS
# Copyright (c) 2023 OS Systems
#
# SPDX-License-Identifier: Apache-2.0

config SOC_SERIES_STM32L0X
	bool
	select SOC_FAMILY_STM32

config SOC_SERIES
	default "stm32l0x" if SOC_SERIES_STM32L0X

config SOC_STM32L010X4
	bool
	select SOC_SERIES_STM32L0X

config SOC_STM32L010X6
	bool
	select SOC_SERIES_STM32L0X

config SOC_STM32L010X8
	bool
	select SOC_SERIES_STM32L0X

config SOC_STM32L010XB
	bool
	select SOC_SERIES_STM32L0X

config SOC_STM32L011XX
	bool
	select SOC_SERIES_STM32L0X

config SOC_STM32L031XX
	bool
	select SOC_SERIES_STM32L0X

config SOC_STM32L051XX
	bool
	select SOC_SERIES_STM32L0X

config SOC_STM32L053XX
	bool
	select SOC_SERIES_STM32L0X

config SOC_STM32L071XX
	bool
	select SOC_SERIES_STM32L0X

config SOC_STM32L072XX
	bool
	select SOC_SERIES_STM32L0X

config SOC_STM32L073XX
	bool
	select SOC_SERIES_STM32L0X

config SOC_STM32L081XX
	bool
	select SOC_SERIES_STM32L0X

config SOC_STM32L083XX
	bool
	select SOC_SERIES_STM32L0X

config SOC
	default "stm32l010x4" if SOC_STM32L010X4
	default "stm32l010x6" if SOC_STM32L010X6
	default "stm32l010x8" if SOC_STM32L010X8
	default "stm32l010xb" if SOC_STM32L010XB
	default "stm32l011xx" if SOC_STM32L011XX
	default "stm32l031xx" if SOC_STM32L031XX
	default "stm32l051xx" if SOC_STM32L051XX
	default "stm32l053xx" if SOC_STM32L053XX
	default "stm32l071xx" if SOC_STM32L071XX
	default "stm32l072xx" if SOC_STM32L072XX
	default "stm32l073xx" if SOC_STM32L073XX
	default "stm32l081xx" if SOC_STM32L081XX
	default "stm32l083xx" if SOC_STM32L083XX
```

## soc/st/stm32/stm32l1/Kconfig.defconfig.stm32l151xb
```kconfig
# STMicroelectronics STM32L151XB MCU

# Copyright (c) 2019 Linaro Ltd.
# SPDX-License-Identifier: Apache-2.0

if SOC_STM32L151XB

config NUM_IRQS
	default 45

endif # SOC_STM32L151XB
```

## soc/st/stm32/stm32l1/Kconfig.soc
```kconfig
# STMicroelectronics STM32L1 MCU line

# Copyright (c) 2019 Linaro Ltd.
# SPDX-License-Identifier: Apache-2.0

config SOC_SERIES_STM32L1X
	bool
	select SOC_FAMILY_STM32

config SOC_SERIES
	default "stm32l1x" if SOC_SERIES_STM32L1X

config SOC_STM32L151XB
	bool
	select SOC_SERIES_STM32L1X

config SOC_STM32L151XBA
	bool
	select SOC_SERIES_STM32L1X

config SOC_STM32L151XC
	bool
	select SOC_SERIES_STM32L1X

config SOC_STM32L152XC
	bool
	select SOC_SERIES_STM32L1X

config SOC_STM32L152XE
	bool
	select SOC_SERIES_STM32L1X

config SOC
	default "stm32l151xb" if SOC_STM32L151XB
	default "stm32l151xba" if SOC_STM32L151XBA
	default "stm32l151xc" if SOC_STM32L151XC
	default "stm32l152xc" if SOC_STM32L152XC
	default "stm32l152xe" if SOC_STM32L152XE
```

## soc/st/stm32/stm32l1x/Kconfig
```kconfig
# STMicroelectronics STM32L1 MCU series

# Copyright (c) 2019 Linaro Ltd.
# SPDX-License-Identifier: Apache-2.0

config SOC_SERIES_STM32L1X
	select ARM
	select CPU_CORTEX_M3
	select CPU_CORTEX_M_HAS_DWT
	select CPU_HAS_ARM_MPU
	select HAS_PM
	select HAS_POWEROFF
	select HAS_STM32CUBE
	select HAS_STM32_FLASH_PREFETCH
	select HAS_SWO
	select SOC_EARLY_INIT_HOOK
```

## soc/st/stm32/stm32l1x/Kconfig.defconfig
```kconfig
# STMicroelectronics STM32L1 MCU line

# Copyright (c) 2019 Linaro Ltd.
# SPDX-License-Identifier: Apache-2.0

if SOC_SERIES_STM32L1X

configdefault NUM_IRQS
	default 46 if SOC_STM32L100XB
	default 45 if SOC_STM32L151XB || \
		      SOC_STM32L151XBA
	default 57 if SOC_STM32L151XC || \
		      SOC_STM32L152XC || \
		      SOC_STM32L152XE

# adjust the fallback because of the LSI oscaillator characteristics
config TASK_WDT_HW_FALLBACK_DELAY
	depends on TASK_WDT_HW_FALLBACK
	default 200

if PM

config COUNTER
	default y

endif # PM

endif # SOC_SERIES_STM32L1X
```

## soc/st/stm32/stm32l1x/Kconfig.defconfig.stm32l100xb
```kconfig
# STMicroelectronics STM32L100XB MCU

# Copyright (c) 2025 Conny Marco Menebröcker
# SPDX-License-Identifier: Apache-2.0

if SOC_STM32L100XB

config NUM_IRQS
	default 46

endif # SOC_STM32L100XB
```

## soc/st/stm32/stm32l1x/Kconfig.defconfig.stm32l151xc
```kconfig
# STMicroelectronics STM32L151XC MCU

# Copyright (c) 2020 Abel Sensors
# SPDX-License-Identifier: Apache-2.0

if SOC_STM32L151XC

# Based on stm32cube number of interrupts+1, not datasheet
config NUM_IRQS
	default 57

endif # SOC_STM32L151XC
```

## soc/st/stm32/stm32l1x/Kconfig.defconfig.stm32l152xc
```kconfig
# STMicroelectronics STM32L152XC MCU

# Copyright (c) 2020 Abel Sensors
# SPDX-License-Identifier: Apache-2.0

if SOC_STM32L152XC

config NUM_IRQS
	int
	default 57

endif # SOC_STM32L152XC
```

## soc/st/stm32/stm32l1x/Kconfig.defconfig.stm32l152xe
```kconfig
# ST Microelectronics STM32L152XE MCU

# Copyright (c) 2019 Antony Pavlov <antonynpavlov@gmail.com>
# SPDX-License-Identifier: Apache-2.0

if SOC_STM32L152XE

config NUM_IRQS
	default 57

endif # SOC_STM32L152XE
```
