## soc/st/stm32/stm32wb/Kconfig
```kconfig
# ST Microelectronics STM32WB MCU series

# Copyright (c) 2019 Linaro Limited
# SPDX-License-Identifier: Apache-2.0

config SOC_SERIES_STM32WBX
	select ARM
	select CPU_CORTEX_M4
	select CPU_CORTEX_M_HAS_DWT
	select CPU_HAS_FPU
	select HAS_STM32CUBE
	select CPU_HAS_ARM_MPU
	select HAS_SWO
	select HAS_PM
	select HAS_POWEROFF
```

## soc/st/stm32/stm32wb0x/Kconfig.defconfig
```kconfig
# STMicroelectronics STM32WB0 MCU series

# Copyright (c) 2024 STMicroelectronics
# SPDX-License-Identifier: Apache-2.0

if SOC_SERIES_STM32WB0X

config NUM_IRQS
	default 32

if STM32WB0_RADIO_TIMER

config SYS_CLOCK_TICKS_PER_SEC
	default 10240

config CORTEX_M_SYSTICK
	default n

endif # STM32WB0_RADIO_TIMER

if BT

configdefault SYSTEM_WORKQUEUE_STACK_SIZE
	default 1152

config BT_AUTO_PHY_UPDATE
	default n

config BT_AUTO_DATA_LEN_UPDATE
	default n

config BT_HCI_ACL_FLOW_CONTROL
	default n

endif # BT

endif # SOC_SERIES_STM32WB0X
```

## soc/st/stm32/stm32wb0x/Kconfig.soc
```kconfig
# STMicroelectronics STM32WB0 MCU series

# Copyright (c) 2024 STMicroelectronics
# SPDX-License-Identifier: Apache-2.0

config SOC_SERIES_STM32WB0X
	bool
	select SOC_FAMILY_STM32

config SOC_SERIES
	default "stm32wb0x" if SOC_SERIES_STM32WB0X

config SOC_STM32WB05XX
	bool
	select SOC_SERIES_STM32WB0X

config SOC_STM32WB06XX
	bool
	select SOC_SERIES_STM32WB0X

config SOC_STM32WB07XX
	bool
	select SOC_SERIES_STM32WB0X

config SOC_STM32WB09XX
	bool
	select SOC_SERIES_STM32WB0X

config SOC
	default "stm32wb05" if SOC_STM32WB05XX
	default "stm32wb06" if SOC_STM32WB06XX
	default "stm32wb07" if SOC_STM32WB07XX
	default "stm32wb09" if SOC_STM32WB09XX
```

## soc/st/stm32/stm32wbax/Kconfig
```kconfig
# ST Microelectronics STM32WBA MCU series

# Copyright (c) 2023 STMicroelectronics
# SPDX-License-Identifier: Apache-2.0

config SOC_SERIES_STM32WBAX
	select ARM
	select CPU_CORTEX_M33
	select ARM_TRUSTZONE_M
	select CPU_HAS_ARM_SAU
	select CPU_HAS_ARM_MPU
	select CPU_HAS_FPU
	select ARMV8_M_DSP
	select CPU_CORTEX_M_HAS_DWT
	select HAS_STM32CUBE
	select HAS_STM32_FLASH_PREFETCH
	select USE_STM32_HAL_PWR_EX
	select USE_STM32_HAL_CORTEX
	select HAS_PM
	select HAS_POWEROFF
	select SOC_EARLY_INIT_HOOK
	select PM_DEVICE if PM
	select PM_DEVICE_RUNTIME if PM
	select PM_DEVICE_SYSTEM_MANAGED if PM

if SOC_SERIES_STM32WBAX

config STM32WBA_LL_THREAD_STACK_SIZE
	int "Stack size of the Link Layer thread"
	default 1536
	depends on BT_STM32WBA || IEEE802154_STM32WBA
	help
	  Link Layer thread stack size in bytes.

config STM32WBA_LL_THREAD_PRIO
	int "Link Layer thread priority"
	default 4
	depends on BT_STM32WBA || IEEE802154_STM32WBA
	help
	  This option sets the cooperative priority of the Link Layer thread.
	  The LL thread shall have a higher priority than the BLE CTLR thread and the upper layer
	  Zephyr stack threads associated to the BLE and IEEE 802.15.4 protocols such as the
	  BT Rx thread (BT_RX_PRIO), the BT long workqueue (BT_LONG_WQ_PRIO), the net mgmt thread,
	  the connection manager monitor thread, the udp thread...

config STM32WBA_BLE_CTLR_THREAD_STACK_SIZE
	int "Stack size of the BLE Controller thread"
	default 512
	depends on BT_STM32WBA
	help
	  BLE Controller thread stack size in bytes.

config STM32WBA_BLE_CTLR_THREAD_PRIO
	int "BLE Controller thread priority"
	depends on BT_STM32WBA
	default 14
	help
	  This option sets the cooperative priority of the BLE Controller thread.

endif # SOC_SERIES_STM32WBAX
```

## soc/st/stm32/stm32wbax/Kconfig.defconfig
```kconfig
# ST Microelectronics STM32WBA MCU line

# Copyright (c) 2023 STMicroelectronics
# SPDX-License-Identifier: Apache-2.0

if SOC_SERIES_STM32WBAX

rsource "Kconfig.defconfig.stm32wba*"

config STM32_LPTIM_TIMER
	default y if PM

config STM32_FLASH_PREFETCH
	default y

config BT_STM32WBA
	select DYNAMIC_INTERRUPTS
	select DYNAMIC_DIRECT_INTERRUPTS
	select ENTROPY_GENERATOR
	select USE_STM32_HAL_RAMCFG

if BT_STM32WBA

choice LIBC_IMPLEMENTATION
	default NEWLIB_LIBC
endchoice

choice LINKER_ORPHAN_CONFIGURATION
	default LINKER_ORPHAN_SECTION_PLACE
endchoice

config ENTROPY_STM32_CLK_CHECK
	default n

endif

if PM_S2RAM

config COUNTER
	default y

config COUNTER_RTC_STM32_SUBSECONDS
	default y

config STM32_LPTIM_STDBY_TIMER
	default y

config TICKLESS_KERNEL
	default y

config COUNTER_RTC_STM32_SAVE_VALUE_BETWEEN_RESETS
	default y

config IDLE_STACK_SIZE
	default 512

endif

endif # SOC_SERIES_STM32WBAX
```

## soc/st/stm32/stm32wbax/Kconfig.defconfig.stm32wba23xx
```kconfig
# ST Microelectronics STM32WBA23XX MCU

# Copyright (c) 2026 STMicroelectronics
# SPDX-License-Identifier: Apache-2.0

if SOC_STM32WBA23XX

config NUM_IRQS
	default 64

endif # SOC_STM32WBA23XX
```

## soc/st/stm32/stm32wbax/Kconfig.defconfig.stm32wba25xx
```kconfig
# ST Microelectronics STM32WBA25XX MCU

# Copyright (c) 2026 STMicroelectronics
# SPDX-License-Identifier: Apache-2.0

if SOC_STM32WBA25XX

config NUM_IRQS
	default 66

endif # SOC_STM32WBA25XX
```

## soc/st/stm32/stm32wbax/Kconfig.defconfig.stm32wba52xx
```kconfig
# ST Microelectronics STM32WBA52XX MCU

# Copyright (c) 2023 STMicroelectronics
# SPDX-License-Identifier: Apache-2.0

if SOC_STM32WBA52XX

config NUM_IRQS
	default 70

endif # SOC_STM32WBA52XX
```

## soc/st/stm32/stm32wbax/Kconfig.defconfig.stm32wba55xx
```kconfig
# ST Microelectronics STM32WBA55XX MCU

# Copyright (c) 2023 STMicroelectronics
# SPDX-License-Identifier: Apache-2.0

if SOC_STM32WBA55XX

config NUM_IRQS
	default 70

endif # SOC_STM32WBA55XX
```

## soc/st/stm32/stm32wbax/Kconfig.defconfig.stm32wba65xx
```kconfig
# ST Microelectronics STM32WBA65XX MCU

# Copyright (c) 2025 STMicroelectronics
# SPDX-License-Identifier: Apache-2.0

if SOC_STM32WBA65XX

# BL2 implementation not available yet
config TFM_BL2_NOT_SUPPORTED
	default y

config STM32_INT_FLASH_SECURE_BASE_ADDRESS
	default 0x0c000000

endif # SOC_STM32WBA65XX
```

## soc/st/stm32/stm32wbax/Kconfig.soc
```kconfig
# ST Microelectronics STM32WBA MCU line

# Copyright (c) 2023 STMicroelectronics
# SPDX-License-Identifier: Apache-2.0

config SOC_SERIES_STM32WBAX
	bool
	select SOC_FAMILY_STM32

config SOC_SERIES
	default "stm32wbax" if SOC_SERIES_STM32WBAX

config SOC_STM32WBA52XX
	bool
	select SOC_SERIES_STM32WBAX

config SOC_STM32WBA55XX
	bool
	select SOC_SERIES_STM32WBAX

config SOC
	default "stm32wba52xx" if SOC_STM32WBA52XX
	default "stm32wba55xx" if SOC_STM32WBA55XX
```

## soc/st/stm32/stm32wbx/Kconfig.defconfig.stm32wb55xx
```kconfig
# ST Microelectronics STM32WB55XX MCU

# Copyright (c) 2019 Linaro Limited
# SPDX-License-Identifier: Apache-2.0

if SOC_STM32WB55XX

config NUM_IRQS
	default 63

endif # SOC_STM32WB55XX
```

## soc/st/stm32/stm32wbx/Kconfig.soc
```kconfig
# ST Microelectronics STM32WB MCU line

# Copyright (c) 2019 Linaro Limited
# SPDX-License-Identifier: Apache-2.0

config SOC_SERIES_STM32WBX
	bool
	select SOC_FAMILY_STM32

config SOC_SERIES
	default "stm32wbx" if SOC_SERIES_STM32WBX

config SOC_STM32WB55XX
	bool
	select SOC_SERIES_STM32WBX

config SOC
	default "stm32wb55xx" if SOC_STM32WB55XX
```

## soc/st/stm32/stm32wlx/Kconfig
```kconfig
# STMicroelectronics STM32WL MCU series

# Copyright (c) 2020 STMicroelectronics.
# SPDX-License-Identifier: Apache-2.0

config SOC_SERIES_STM32WLX
	select ARM
	select CPU_CORTEX_M4
	select CPU_CORTEX_M_HAS_DWT
	select HAS_STM32CUBE
	select CPU_HAS_ARM_MPU
	select HAS_PM
	select HAS_POWEROFF
```

## soc/st/stm32/stm32wlx/Kconfig.defconfig
```kconfig
# STMicroelectronics STM32WL MCU line

# Copyright (c) 2020 STMicroelectronics.
# SPDX-License-Identifier: Apache-2.0

if SOC_SERIES_STM32WLX

configdefault NUM_IRQS
	default 62

endif # SOC_SERIES_STM32WLX
```

## soc/st/stm32/stm32wlx/Kconfig.defconfig.stm32wl54xx
```kconfig
# STMicroelectronics STM32WL54 MCU

# Copyright (c) 2021 Thomas Stranger
# SPDX-License-Identifier: Apache-2.0

if SOC_STM32WL54XX

config NUM_IRQS
	default 62

endif # SOC_STM32WL54XX
```

## soc/st/stm32/stm32wlx/Kconfig.soc
```kconfig
# STMicroelectronics STM32WL MCU line

# Copyright (c) 2020 STMicroelectronics.
# SPDX-License-Identifier: Apache-2.0

config SOC_SERIES_STM32WLX
	bool
	select SOC_FAMILY_STM32

config SOC_SERIES
	default "stm32wlx" if SOC_SERIES_STM32WLX

config SOC_STM32WLE4XX
	bool
	select SOC_SERIES_STM32WLX

config SOC_STM32WLE5XX
	bool
	select SOC_SERIES_STM32WLX

config SOC_STM32WL54XX
	bool
	select SOC_SERIES_STM32WLX

config SOC_STM32WL55XX
	bool
	select SOC_SERIES_STM32WLX

config SOC
	default "stm32wle4xx" if SOC_STM32WLE4XX
	default "stm32wle5xx" if SOC_STM32WLE5XX
	default "stm32wl54xx" if SOC_STM32WL54XX
	default "stm32wl55xx" if SOC_STM32WL55XX
```

## soc/starfive/jh71xx/Kconfig
```kconfig
# Copyright (c) 2021 Rajnesh Kanwal <rajnesh.kanwal49@gmail.com>
# SPDX-License-Identifier: Apache-2.0

config SOC_SERIES_STARFIVE_JH71XX
	select RISCV
	select RISCV_PRIVILEGED
	select RISCV_HAS_PLIC
	select RISCV_SOC_HAS_GP_RELATIVE_ADDRESSING
	imply XIP

config SOC_JH7100
	select INCLUDE_RESET_VECTOR

config SOC_JH7110
	select INCLUDE_RESET_VECTOR
```

## soc/starfive/jh71xx/Kconfig.defconfig
```kconfig
# Copyright (c) 2021 Rajnesh Kanwal <rajnesh.kanwal49@gmail.com>
# SPDX-License-Identifier: Apache-2.0

if SOC_SERIES_STARFIVE_JH71XX

config SYS_CLOCK_HW_CYCLES_PER_SEC
	default 6250000

config RISCV_SOC_INTERRUPT_INIT
	default y

config 2ND_LVL_ISR_TBL_OFFSET
	default 12

config 2ND_LVL_INTR_00_OFFSET
	default 11

config NUM_IRQS
	default 139

endif
```

## soc/starfive/jh71xx/Kconfig.soc
```kconfig
# Copyright (c) 2024 Nordic Semiconductor ASA
# SPDX-License-Identifier: Apache-2.0

config SOC_SERIES_STARFIVE_JH71XX
	bool

config SOC_JH7100
	bool
	select SOC_SERIES_STARFIVE_JH71XX

config SOC_JH7110
	bool
	select SOC_SERIES_STARFIVE_JH71XX

config SOC_SERIES
	default "starfive_jh71xx" if SOC_SERIES_STARFIVE_JH71XX

config SOC
	default "jh7100" if SOC_JH7100
	default "jh7110" if SOC_JH7110
```

## soc/syna/astra_sr/Kconfig
```kconfig
# SPDX-FileCopyrightText: Copyright (c) 2025 Synaptics Incorporated
# SPDX-License-Identifier: Apache-2.0

if SOC_FAMILY_SYNA_SR

rsource "*/Kconfig"

endif # SOC_FAMILY_SYNA_SR
```

## soc/syna/astra_sr/sr1xx/Kconfig.soc
```kconfig
# SPDX-FileCopyrightText: Copyright (c) 2025 Synaptics Incorporated
# SPDX-License-Identifier: Apache-2.0

config SOC_SERIES_SR1XX
	bool
	select SOC_FAMILY_SYNA_SR

config SOC_SERIES
	default "sr1xx" if SOC_SERIES_SR1XX

config SOC_SR100
	bool
	select SOC_SERIES_SR1XX

config SOC_SR100_M55
	bool
	select SOC_SR100
	help
	  SYNA SR100 M55

config SR100_RELEASE_M4_RESET
	bool "Take M4 out of reset"
	default n
	depends on SOC_SR100_M55
	help
	  Take M4 out of reset

config SOC_SR100_M4
	bool
	select SOC_SR100
	help
	  SYNA SR100 M4

config SOC
	default "sr100" if SOC_SR100
```

## soc/syna/sr100/Kconfig
```kconfig
# Copyright (c) 2025 Synaptics, Inc.
# SPDX-License-Identifier: Apache-2.0

config SOC_SR100
	select ARM
	select ARM_MPU
	select ARMV8_M_DSP
	select ARMV8_1_M_MVEI
	select ARMV8_1_M_MVEF
	select CLOCK_CONTROL
	select CPU_CORTEX_M55
	select DYNAMIC_INTERRUPTS
	select CPU_CORTEX_M_HAS_SYSTICK
	select CPU_CORTEX_M_HAS_DWT
	select CPU_HAS_ARM_MPU
	select CPU_HAS_ARM_SAU
	select CPU_HAS_DCACHE
	select CPU_HAS_ICACHE
	select CPU_HAS_FPU
	select UART_NS16550_ACCESS_WORD_ONLY if UART_NS16550
	select SERIAL_SUPPORT_ASYNC
	select HAS_CMSIS_CORE
	select SOC_EARLY_INIT_HOOK
	select RESET

config SOC_PART_NUMBER
	default "SR100" if SOC_SR100
```

## soc/syna/sr100/Kconfig.defconfig
```kconfig
# Copyright (c) 2025 Synaptics, Inc.
# SPDX-License-Identifier: Apache-2.0

if SOC_SERIES_SR100

config NUM_IRQS
	default 128

config SYS_CLOCK_HW_CYCLES_PER_SEC
	default $(dt_node_int_prop_int,/cpus/cpu@0,clock-frequency)

endif # SOC_SERIES_SR100
```

## soc/syna/sr100/Kconfig.soc
```kconfig
# Copyright (c) 2025 Synaptics, Inc.
# SPDX-License-Identifier: Apache-2.0

config SOC_SERIES_SR1XX
	bool

config SOC_SR100
	bool
	select SOC_SERIES_SR1XX

config SOC_SERIES
	default "sr1xx" if SOC_SERIES_SR1XX

config SOC
	default "sr100" if SOC_SR100
```
