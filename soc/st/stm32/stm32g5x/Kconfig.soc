## soc/st/stm32/stm32g5x/Kconfig.soc
```kconfig
# STMicroelectronics STM32G5 MCU line

# Copyright (c) 2026 STMicroelectronics
# SPDX-License-Identifier: Apache-2.0

config SOC_SERIES_STM32G5X
	bool
	select SOC_FAMILY_STM32

config SOC_SERIES
	default "stm32g5x" if SOC_SERIES_STM32G5X

config SOC_STM32G534XX
	bool
	select SOC_SERIES_STM32G5X

config SOC_STM32G544XX
	bool
	select SOC_SERIES_STM32G5X

config SOC_STM32G553XX
	bool
	select SOC_SERIES_STM32G5X

config SOC_STM32G554XX
	bool
	select SOC_SERIES_STM32G5X

config SOC_STM32G564XX
	bool
	select SOC_SERIES_STM32G5X

config SOC
	default "stm32g534xx" if SOC_STM32G534XX
	default "stm32g544xx" if SOC_STM32G544XX
	default "stm32g553xx" if SOC_STM32G553XX
	default "stm32g554xx" if SOC_STM32G554XX
	default "stm32g564xx" if SOC_STM32G564XX
```

## soc/st/stm32/stm32h7px/Kconfig
```kconfig
# STMicroelectronics STM32H7P MCU series
#
# SPDX-FileCopyrightText: Copyright (c) 2026 STMicroelectronics
# SPDX-License-Identifier: Apache-2.0

config SOC_SERIES_STM32H7PX
	# Architecture options & CPU model selection
	select ARM
	select CPU_CORTEX_M7
	# Hardware options
	select CPU_CORTEX_M_HAS_DWT
	select CPU_HAS_ARM_MPU
	select CPU_HAS_DCACHE
	select CPU_HAS_FPU
	select CPU_HAS_FPU_DOUBLE_PRECISION
	select CPU_HAS_ICACHE
	select HAS_SWO
	# Software options
	select SOC_EARLY_INIT_HOOK
	select SOC_EARLY_RESET_HOOK
	# STM32-specific options
	select HAS_STM32CUBE
	select STM32_HAL2
	select HAS_STM32_RTC_READ_GATED_BY_BKP_DOMAIN
```

## soc/st/stm32/stm32h7px/Kconfig.defconfig
```kconfig
# SPDX-FileCopyrightText: Copyright (c) 2026 STMicroelectronics
# SPDX-License-Identifier: Apache-2.0

if SOC_SERIES_STM32H7PX

configdefault CACHE_MANAGEMENT
	default y

endif # SOC_SERIES_STM32H7PX
```

## soc/st/stm32/stm32h7px/Kconfig.soc
```kconfig
# SPDX-FileCopyrightText: Copyright (c) 2026 STMicroelectronics
# SPDX-License-Identifier: Apache-2.0

config SOC_SERIES_STM32H7PX
	bool
	select SOC_FAMILY_STM32

config SOC_SERIES
	default "stm32h7px" if SOC_SERIES_STM32H7PX

config SOC_STM32H7P4XX
	bool
	select SOC_SERIES_STM32H7PX

config SOC_STM32H7P5XX
	bool
	select SOC_SERIES_STM32H7PX

config SOC
	default "stm32h7p4xx" if SOC_STM32H7P4XX
	default "stm32h7p5xx" if SOC_STM32H7P5XX
```

## soc/st/stm32/stm32h7rsx/Kconfig
```kconfig
# STMicroelectronics STM32H7RS MCU series

# Copyright (c) 2024 STMicroelectronics
# SPDX-License-Identifier: Apache-2.0

config SOC_SERIES_STM32H7RSX
	# Architecture options & CPU model selection
	select ARM
	select CPU_CORTEX_M7
	# Hardware options
	select CPU_CORTEX_M_HAS_DWT
	select CPU_HAS_ARM_MPU
	select CPU_HAS_DCACHE
	select CPU_HAS_FPU
	select CPU_HAS_FPU_DOUBLE_PRECISION
	select CPU_HAS_ICACHE
	select HAS_SWO
	# Software options
	select CPU_HAS_CUSTOM_FIXED_SOC_MPU_REGIONS
	select SOC_EARLY_INIT_HOOK
	# STM32-specific options
	select HAS_STM32CUBE
```

## soc/st/stm32/stm32h7rsx/Kconfig.defconfig
```kconfig
# STMicroelectronics STM32H7RS MCU line

# Copyright (c) 2026 STMicroelectronics
# SPDX-License-Identifier: Apache-2.0

if SOC_SERIES_STM32H7RSX

configdefault LV_DRAW_DMA2D_HAL_INCLUDE
	default "stm32h7rsxx.h" if LVGL && LV_USE_DRAW_DMA2D

endif # SOC_SERIES_STM32H7RSX
```

## soc/st/stm32/stm32l4x/Kconfig
```kconfig
# ST Microelectronics STM32L4 MCU series

# Copyright (c) 2016 Open-RnD Sp. z o.o.
# Copyright (c) 2016 BayLibre, SAS
# SPDX-License-Identifier: Apache-2.0

config SOC_SERIES_STM32L4X
	# Architecture options & CPU model selection
	select ARM
	select CPU_CORTEX_M4
	# Hardware options
	select CPU_CORTEX_M_HAS_DWT
	select CPU_HAS_ARM_MPU
	select CPU_HAS_FPU
	select HAS_SWO
	# Software options
	select HAS_PM
	select HAS_POWEROFF
	select PM_STATE_SET_IRQ_UNLOCKED
	select SOC_EARLY_INIT_HOOK
	# STM32-specific options
	select HAS_STM32CUBE
	select HAS_STM32_FLASH_PREFETCH
```

## soc/st/stm32/stm32mp13x/Kconfig
```kconfig
# STMicroelectronics STM32MP13 MPU series

# Copyright (c) 2025 STMicroelectronics
# SPDX-License-Identifier: Apache-2.0

config SOC_SERIES_STM32MP13X
	# Architecture options & CPU model selection
	select ARM
	select CPU_CORTEX_A7
	# Hardware options
	select ARM_ARCH_TIMER
	select CPU_HAS_FPU
	# Software options
	select KERNEL_DIRECT_MAP if MMU
	select SOC_EARLY_INIT_HOOK
	select SYS_CLOCK_EXISTS
	select XIP if !SOC_SERIES_STM32MP13X_FSBL
	# STM32-specific options
	select HAS_STM32CUBE

config SOC_SERIES_STM32MP13X_FSBL
	bool
	help
	  Build Zephyr for direct startup as an STM32MP13 first-stage image,
	  before DDR and the full clock tree have been initialized by a previous
	  boot stage. This enables the clock configuration and memory mappings
	  required to initialize external DDR.

config SOC_SERIES_STM32MP13X_DDR_INIT
	bool
	default y if DT_HAS_ST_STM32MP13_DDR_ENABLED
	depends on SOC_SERIES_STM32MP13X_FSBL
	select USE_STM32_HAL_DDR
	help
	  Initialize the STM32MP13 DDR (Double Data Rate) controller and PHY
	  (Physical Interface) from devicetree.

config SOC_SERIES_STM32MP13X_DDR_INIT_PRIORITY
	int
	default 2
	depends on SOC_SERIES_STM32MP13X_DDR_INIT
```

## soc/st/stm32/stm32mp13x/Kconfig.soc
```kconfig
# STMicroelectronics STM32MP13 MPU series

# Copyright (c) 2025 STMicroelectronics
# SPDX-License-Identifier: Apache-2.0

config SOC_SERIES_STM32MP13X
	bool
	select SOC_FAMILY_STM32

config SOC_SERIES
	default "stm32mp13x" if SOC_SERIES_STM32MP13X

config SOC_STM32MP131AXX
	bool
	select SOC_SERIES_STM32MP13X

config SOC_STM32MP131CXX
	bool
	select SOC_SERIES_STM32MP13X

config SOC_STM32MP131DXX
	bool
	select SOC_SERIES_STM32MP13X

config SOC_STM32MP131FXX
	bool
	select SOC_SERIES_STM32MP13X

config SOC_STM32MP133AXX
	bool
	select SOC_SERIES_STM32MP13X

config SOC_STM32MP133CXX
	bool
	select SOC_SERIES_STM32MP13X

config SOC_STM32MP133DXX
	bool
	select SOC_SERIES_STM32MP13X

config SOC_STM32MP133FXX
	bool
	select SOC_SERIES_STM32MP13X

config SOC_STM32MP135AXX
	bool
	select SOC_SERIES_STM32MP13X

config SOC_STM32MP135CXX
	bool
	select SOC_SERIES_STM32MP13X

config SOC_STM32MP135DXX
	bool
	select SOC_SERIES_STM32MP13X

config SOC_STM32MP135FXX
	bool
	select SOC_SERIES_STM32MP13X

config SOC
	default "stm32mp131axx" if SOC_STM32MP131AXX
	default "stm32mp131cxx" if SOC_STM32MP131CXX
	default "stm32mp131dxx" if SOC_STM32MP131DXX
	default "stm32mp131fxx" if SOC_STM32MP131FXX
	default "stm32mp133axx" if SOC_STM32MP133AXX
	default "stm32mp133cxx" if SOC_STM32MP133CXX
	default "stm32mp133dxx" if SOC_STM32MP133DXX
	default "stm32mp133fxx" if SOC_STM32MP133FXX
	default "stm32mp135axx" if SOC_STM32MP135AXX
	default "stm32mp135cxx" if SOC_STM32MP135CXX
	default "stm32mp135dxx" if SOC_STM32MP135DXX
	default "stm32mp135fxx" if SOC_STM32MP135FXX
```

## soc/st/stm32/stm32mp1x/Kconfig
```kconfig
# STMicroelectronics STM32MP1 MPU series

# Copyright (c) 2019 STMicroelectronics
# SPDX-License-Identifier: Apache-2.0

config SOC_SERIES_STM32MP1X
	# Architecture options & CPU model selection
	select ARM
	select CPU_CORTEX_M4
	# Hardware options
	select CPU_CORTEX_M_HAS_DWT
	select CPU_HAS_ARM_MPU
	select CPU_HAS_FPU
	# Software options
	select OPENAMP_RSC_TABLE if RAM_CONSOLE
	select SOC_EARLY_INIT_HOOK
	# STM32-specific options
	select HAS_STM32CUBE
```

## soc/st/stm32/stm32u0x/Kconfig
```kconfig
# ST Microelectronics STM32U0 MCU series

# Copyright (c) 2024 STMicroelectronics
# SPDX-License-Identifier: Apache-2.0

config SOC_SERIES_STM32U0X
	# Architecture options & CPU model selection
	select ARM
	select CPU_CORTEX_M0PLUS
	# Hardware options
	select CPU_CORTEX_M_HAS_SYSTICK
	select CPU_CORTEX_M_HAS_VTOR
	select CPU_HAS_ARM_MPU
	# Software options
	select HAS_PM
	select PM_STATE_SET_IRQ_UNLOCKED
	select SOC_EARLY_INIT_HOOK
	# STM32-specific options
	select HAS_STM32CUBE
	select HAS_STM32_FLASH_PREFETCH
```

## soc/st/stm32/stm32u3x/Kconfig.defconfig
```kconfig
# STMicroelectronics STM32U3 MCU series

# Copyright (c) 2025 STMicroelectronics
# SPDX-License-Identifier: Apache-2.0

if SOC_SERIES_STM32U3X

# BL2 implementation not available yet
config TFM_BL2_NOT_SUPPORTED
	default y

config STM32_INT_FLASH_SECURE_BASE_ADDRESS
	default 0x0c000000

configdefault CACHE_MANAGEMENT
	default y

choice CACHE_TYPE
	default EXTERNAL_CACHE
endchoice

if STM32_STOP3_LP_MODE

configdefault COUNTER
	default y

configdefault COUNTER_RTC_STM32_SUBSECONDS
	default y

configdefault STM32_LPTIM_STDBY_TIMER
	default y

configdefault TICKLESS_KERNEL
	default y

configdefault COUNTER_RTC_STM32_SAVE_VALUE_BETWEEN_RESETS
	default y

configdefault IDLE_STACK_SIZE
	default 512

endif # STM32_STOP3_LP_MODE

endif # SOC_SERIES_STM32U3X
```

## soc/st/stm32/stm32wbx/Kconfig
```kconfig
# ST Microelectronics STM32WB MCU series

# Copyright (c) 2019 Linaro Limited
# SPDX-License-Identifier: Apache-2.0

config SOC_SERIES_STM32WBX
	# Architecture options & CPU model selection
	select ARM
	select CPU_CORTEX_M4
	# Hardware options
	select CPU_CORTEX_M_HAS_DWT
	select CPU_HAS_ARM_MPU
	select CPU_HAS_FPU
	select HAS_SWO
	# Software options
	select HAS_PM
	select HAS_POWEROFF
	select PM_STATE_SET_IRQ_UNLOCKED
	select SOC_EARLY_INIT_HOOK
	# STM32-specific options
	select HAS_STM32CUBE
	select HAS_STM32_FLASH_PREFETCH
```

## soc/st/stm32/stm32wbx/Kconfig.defconfig
```kconfig
# ST Microelectronics STM32WB MCU line

# Copyright (c) 2019 Linaro Limited
# SPDX-License-Identifier: Apache-2.0

if SOC_SERIES_STM32WBX

configdefault SHARED_INTERRUPTS
	default y if $(dt_nodelabel_enabled,timers1) && $(dt_nodelabel_enabled,timers16)
	default y if $(dt_nodelabel_enabled,timers1) && $(dt_nodelabel_enabled,timers17)

config BT_USER_PHY_UPDATE
	default y if BT

config BUILD_OUTPUT_UF2_FAMILY_ID
	default "0x70d16653"

if BT_STM32_IPM_FW_INFO_CHECK

configdefault BT_FW_EXPECTED_VERSION_MAJOR
	default 1

configdefault BT_FW_EXPECTED_VERSION_MINOR
	default 24

configdefault BT_FW_EXPECTED_VERSION_SUB
	default 0

endif # BT_STM32_IPM_FW_INFO_CHECK

endif # SOC_SERIES_STM32WBX
```

## soc/st/stm32/stm32wl3x/Kconfig
```kconfig
# STMicroelectronics STM32WL3 MCU line

# Copyright (c) 2026 Anders Frandsen <anfran@anfran.dk>
# SPDX-License-Identifier: Apache-2.0

config SOC_SERIES_STM32WL3X
	# Architecture options & CPU model selection
	select ARM
	select CPU_CORTEX_M0PLUS
	# Hardware options
	select CPU_CORTEX_M_HAS_SYSTICK
	select CPU_CORTEX_M_HAS_VTOR
	select CPU_HAS_ARM_MPU
	# Software options
	select SOC_EARLY_INIT_HOOK
	# STM32-specific options
	select HAS_STM32CUBE
```

## soc/st/stm32/stm32wl3x/Kconfig.soc
```kconfig
# STMicroelectronics STM32WL3 MCU line

# Copyright (c) 2026 Anders Frandsen <anfran@anfran.dk>
# SPDX-License-Identifier: Apache-2.0

config SOC_SERIES_STM32WL3X
	bool
	select SOC_FAMILY_STM32

config SOC_SERIES
	default "stm32wl3x" if SOC_SERIES_STM32WL3X

config SOC_STM32WL30XX
	bool
	select SOC_SERIES_STM32WL3X

config SOC_STM32WL31XX
	bool
	select SOC_SERIES_STM32WL3X

config SOC_STM32WL33XX
	bool
	select SOC_SERIES_STM32WL3X

config SOC
	default "stm32wl30xx" if SOC_STM32WL30XX
	default "stm32wl31xx" if SOC_STM32WL31XX
	default "stm32wl33xx" if SOC_STM32WL33XX
```

## soc/syna/astra_sr/Kconfig.soc
```kconfig
# SPDX-FileCopyrightText: Copyright (c) 2025 Synaptics Incorporate
# SPDX-License-Identifier: Apache-2.0

config SOC_FAMILY_SYNA_ASTRA_SR
	bool

config SOC_FAMILY
	default "syna_astra_sr" if SOC_FAMILY_SYNA_ASTRA_SR

rsource "*/Kconfig.soc"
```

## soc/ti/am13/Kconfig
```kconfig
# Texas Instruments AM13 MCU Family
#
# Copyright (c) 2026 Texas Instruments Incorporated
#
# SPDX-License-Identifier: Apache-2.0

if SOC_FAMILY_TI_AM13

rsource "*/Kconfig"

config MSPM0_PERIPH_STARTUP_DELAY
	int
	default 16
	depends on SOC_SERIES_AM13E

endif # SOC_FAMILY_TI_AM13
```

## soc/ti/am13/Kconfig.defconfig
```kconfig
# Texas Instruments AM13 MCU Family
#
# Copyright (c) 2026 Texas Instruments Incorporated
#
# SPDX-License-Identifier: Apache-2.0

if SOC_FAMILY_TI_AM13

rsource "*/Kconfig.defconfig"

config SYSCON_INIT_PRIORITY
	default 20 if CLOCK_CONTROL_MSPM0

endif # SOC_FAMILY_TI_AM13
```

## soc/ti/am13/am13e/Kconfig
```kconfig
# Texas Instruments AM13E MCU Series
#
# Copyright (c) 2026 Texas Instruments Incorporated
#
# SPDX-License-Identifier: Apache-2.0

config SOC_AM13E23019
	select ARM
	select ARMV8_M_DSP
	select BUILD_OUTPUT_BIN
	select BUILD_OUTPUT_HEX
	select CPU_CORTEX_M33
	select CPU_CORTEX_M_HAS_SYSTICK
	select CPU_CORTEX_M_HAS_VTOR
	select CPU_HAS_ARM_MPU
	select CPU_HAS_FPU

config AM13E_SRAM_UNIFIED
	bool "Unified 128 KB SRAM layout (banks 0-3 via S-AHB)"
	select SOC_RESET_HOOK
	help
	  Switch SRAM3 from its C-AHB code-region alias to the S-AHB data-region
	  path so that all four 32 KB SRAM banks appear as one contiguous region.
```

## soc/ti/k3/am62ax/Kconfig
```kconfig
# Copyright (c) 2026 Texas Instruments Incorporated
# SPDX-License-Identifier: Apache-2.0

config SOC_SERIES_AM62AX_R5
	select ARM
	select CPU_CORTEX_R5
	select CPU_HAS_ARM_MPU
	select VFP_SP_D16
	select ARM_CUSTOM_INTERRUPT_CONTROLLER
	select TI_VIM
	select TI_DM_TIMER
	select UART_NS16550_ACCESS_WORD_ONLY if UART_NS16550
	select SOC_EARLY_INIT_HOOK
```

## soc/ti/k3/am62ax/Kconfig.soc
```kconfig
# Copyright (c) 2026 Texas Instruments
# SPDX-License-Identifier: Apache-2.0

config SOC_SERIES_AM62AX
	bool
	select SOC_FAMILY_TI_K3

config SOC_SERIES_AM62AX_R5
	bool
	select SOC_SERIES_AM62AX
	help
	  Enable support for AM62AX R5 Series.

config SOC_AM62A7_MCU_R5F0_0
	bool
	select SOC_SERIES_AM62AX_R5
```
