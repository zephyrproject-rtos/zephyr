## soc/st/stm32/stm32f7x/Kconfig.defconfig.stm32f767xx
```kconfig
# ST STM32F767ZI MCU configuration options

# Copyright (c) 2019 Roland Ma
# SPDX-License-Identifier: Apache-2.0

if SOC_STM32F767XX

config NUM_IRQS
	default 110

config CPU_HAS_FPU_DOUBLE_PRECISION
	default y

endif # SOC_STM32F767XX
```

## soc/st/stm32/stm32f7x/Kconfig.defconfig.stm32f769xx
```kconfig
# ST STM32F769XI MCU configuration options

# Copyright (c) 2018  Yong Jin
# SPDX-License-Identifier: Apache-2.0

if SOC_STM32F769XX

config NUM_IRQS
	default 110

config CPU_HAS_FPU_DOUBLE_PRECISION
	default y

endif # SOC_STM32F769XX
```

## soc/st/stm32/stm32f7x/Kconfig.defconfig.stm32f777xx
```kconfig
# ST STM32F777XI MCU configuration options
# Copyright (c) 2026 Anand Kumar <anandvtu16158@gmail.com>
# SPDX-License-Identifier: Apache-2.0

if SOC_STM32F777XX

configdefault CPU_HAS_FPU_DOUBLE_PRECISION
	default y

endif # SOC_STM32F777XX
```

## soc/st/stm32/stm32f7x/Kconfig.soc
```kconfig
# ST Microelectronics STM32F7 MCU line

# Copyright (c) 2018 Yurii Hamann
# Copyright (c) 2022, Rtone.
# Copyright (c) 2023, Rahul Arasikere.
# Copyright (c) 2023 Evan Perry Grove
# SPDX-License-Identifier: Apache-2.0

config SOC_SERIES_STM32F7X
	bool
	select SOC_FAMILY_STM32

config SOC_SERIES
	default "stm32f7x" if SOC_SERIES_STM32F7X

config SOC_STM32F722XX
	bool
	select SOC_SERIES_STM32F7X

config SOC_STM32F723XX
	bool
	select SOC_SERIES_STM32F7X

config SOC_STM32F745XX
	bool
	select SOC_SERIES_STM32F7X

config SOC_STM32F746XX
	bool
	select SOC_SERIES_STM32F7X

config SOC_STM32F756XX
	bool
	select SOC_SERIES_STM32F7X

config SOC_STM32F750XX
	bool
	select SOC_SERIES_STM32F7X

config SOC_STM32F765XX
	bool
	select SOC_SERIES_STM32F7X

config SOC_STM32F767XX
	bool
	select SOC_SERIES_STM32F7X

config SOC_STM32F769XX
	bool
	select SOC_SERIES_STM32F7X

config SOC
	default "stm32f722xx" if SOC_STM32F722XX
	default "stm32f723xx" if SOC_STM32F723XX
	default "stm32f745xx" if SOC_STM32F745XX
	default "stm32f746xx" if SOC_STM32F746XX
	default "stm32f750xx" if SOC_STM32F750XX
	default "stm32f756xx" if SOC_STM32F756XX
	default "stm32f765xx" if SOC_STM32F765XX
	default "stm32f767xx" if SOC_STM32F767XX
	default "stm32f769xx" if SOC_STM32F769XX
```

## soc/st/stm32/stm32g0/Kconfig.defconfig.stm32g030xx
```kconfig
# STMicroelectronics STM32G030xx MCU

# Copyright (c) 2020 Thomas Stranger
# SPDX-License-Identifier: Apache-2.0

if SOC_STM32G030XX

config NUM_IRQS
	default 29

endif # SOC_STM32G030XX
```

## soc/st/stm32/stm32g0/Kconfig.defconfig.stm32g050xx
```kconfig
# STMicroelectronics STM32G050xx MCU

# Copyright (c) 2020 Thomas Stranger
# SPDX-License-Identifier: Apache-2.0

if SOC_STM32G050XX

config NUM_IRQS
	default 29

endif # SOC_STM32G050XX
```

## soc/st/stm32/stm32g0/Kconfig.defconfig.stm32g0b1xx
```kconfig
# STMicroelectronics STM32G0B1xx MCU

# Copyright (c) 2020 Thomas Stranger
# SPDX-License-Identifier: Apache-2.0

if SOC_STM32G0B1XX

config NUM_IRQS
	default 31

if CAN_STM32_FDCAN

config SHARED_INTERRUPTS
	default y if $(dt_nodelabel_enabled,fdcan1) && $(dt_nodelabel_enabled,fdcan2)

endif # CAN_STM32_FDCAN

endif # SOC_STM32G0B1XX
```

## soc/st/stm32/stm32g0x/Kconfig.defconfig
```kconfig
# STMicroelectronics STM32G0 MCU line

# Copyright (c) 2019 Philippe Retornaz <philippe@shapescale.com>
# Copyright (c) 2019 STMicroelectronics
# Copyright (c) 2021 G-Technologies Sdn. Bhd.
# SPDX-License-Identifier: Apache-2.0

if SOC_SERIES_STM32G0X

rsource "Kconfig.defconfig.stm32g0*"

if UART_STM32

configdefault SHARED_IRQ_MAX_NUM_CLIENTS
	# LPUART1 - USART3/4/5/6 instances are all enabled
	default 5 if $(dt_nodelabel_enabled,usart3) && $(dt_nodelabel_enabled,usart4) && $(dt_nodelabel_enabled,usart5) && $(dt_nodelabel_enabled,usart6) && $(dt_nodelabel_enabled,lpuart1)
	# 4 out of 5 USART instances are enabled
	default 4 if $(dt_nodelabel_enabled,usart3) && $(dt_nodelabel_enabled,usart4) && $(dt_nodelabel_enabled,usart5) && $(dt_nodelabel_enabled,usart6)
	default 4 if $(dt_nodelabel_enabled,usart3) && $(dt_nodelabel_enabled,usart4) && $(dt_nodelabel_enabled,usart5) && $(dt_nodelabel_enabled,lpuart1)
	default 4 if $(dt_nodelabel_enabled,usart3) && $(dt_nodelabel_enabled,usart4) && $(dt_nodelabel_enabled,usart6) && $(dt_nodelabel_enabled,lpuart1)
	default 4 if $(dt_nodelabel_enabled,usart3) && $(dt_nodelabel_enabled,usart5) && $(dt_nodelabel_enabled,usart6) && $(dt_nodelabel_enabled,lpuart1)
	default 4 if $(dt_nodelabel_enabled,usart4) && $(dt_nodelabel_enabled,usart5) && $(dt_nodelabel_enabled,usart6) && $(dt_nodelabel_enabled,lpuart1)
	# 3 out of 5 USART instances are enabled
	default 3 if $(dt_nodelabel_enabled,usart3) && $(dt_nodelabel_enabled,usart4) && $(dt_nodelabel_enabled,usart5)
	default 3 if $(dt_nodelabel_enabled,usart3) && $(dt_nodelabel_enabled,usart4) && $(dt_nodelabel_enabled,usart6)
	default 3 if $(dt_nodelabel_enabled,usart3) && $(dt_nodelabel_enabled,usart5) && $(dt_nodelabel_enabled,usart6)
	default 3 if $(dt_nodelabel_enabled,usart3) && $(dt_nodelabel_enabled,usart4) && $(dt_nodelabel_enabled,lpuart1)
	default 3 if $(dt_nodelabel_enabled,usart3) && $(dt_nodelabel_enabled,usart5) && $(dt_nodelabel_enabled,lpuart1)
	default 3 if $(dt_nodelabel_enabled,usart3) && $(dt_nodelabel_enabled,usart6) && $(dt_nodelabel_enabled,lpuart1)
	default 3 if $(dt_nodelabel_enabled,usart4) && $(dt_nodelabel_enabled,usart5) && $(dt_nodelabel_enabled,usart6)
	default 3 if $(dt_nodelabel_enabled,usart4) && $(dt_nodelabel_enabled,usart5) && $(dt_nodelabel_enabled,lpuart1)
	default 3 if $(dt_nodelabel_enabled,usart4) && $(dt_nodelabel_enabled,usart6) && $(dt_nodelabel_enabled,lpuart1)
	default 3 if $(dt_nodelabel_enabled,usart5) && $(dt_nodelabel_enabled,usart6) && $(dt_nodelabel_enabled,lpuart1)

config SHARED_INTERRUPTS
	# LPUART1 - USART3/4/5/6 : irq 29
	default y if $(dt_nodelabel_enabled,usart3) && $(dt_nodelabel_enabled,usart4)
	default y if $(dt_nodelabel_enabled,usart3) && $(dt_nodelabel_enabled,usart5)
	default y if $(dt_nodelabel_enabled,usart3) && $(dt_nodelabel_enabled,usart6)
	default y if $(dt_nodelabel_enabled,usart3) && $(dt_nodelabel_enabled,lpuart1)
	default y if $(dt_nodelabel_enabled,usart4) && $(dt_nodelabel_enabled,usart5)
	default y if $(dt_nodelabel_enabled,usart4) && $(dt_nodelabel_enabled,usart6)
	default y if $(dt_nodelabel_enabled,usart4) && $(dt_nodelabel_enabled,lpuart1)
	default y if $(dt_nodelabel_enabled,usart5) && $(dt_nodelabel_enabled,usart6)
	default y if $(dt_nodelabel_enabled,usart5) && $(dt_nodelabel_enabled,lpuart1)
	default y if $(dt_nodelabel_enabled,usart6) && $(dt_nodelabel_enabled,lpuart1)
	# USART2 - LPUART2 : irq 28
	default y if $(dt_nodelabel_enabled,lpuart2) && $(dt_nodelabel_enabled,usart2)

endif # UART_STM32

# Default disable flash prefetch for G0Bx and G0Cx since ErrataSheet ES0548/ES0549,
# section "Prefetch failure when branching across flash memory banks
# which causes code execution corruption and may lead to HardFault interrupt"
# Project may override this configuration if sure no cross-bank prefetch access is
# awaited.
config STM32_FLASH_PREFETCH
	default n if SOC_STM32G0B0XX || SOC_STM32G0B1XX || SOC_STM32G0C1XX

endif # SOC_SERIES_STM32G0X
```

## soc/st/stm32/stm32g0x/Kconfig.defconfig.stm32g031xx
```kconfig
# STMicroelectronics STM32G031xx MCU

# Copyright (c) 2019 SEAL AG
# SPDX-License-Identifier: Apache-2.0

if SOC_STM32G031XX

config NUM_IRQS
	default 30

# Reduce kernel stack sizes to fit in 2 KiB RAM
config MAIN_STACK_SIZE
	default 640

config IDLE_STACK_SIZE
	default 200

config ISR_STACK_SIZE
	default 512

endif # SOC_STM32G031XX
```

## soc/st/stm32/stm32g0x/Kconfig.defconfig.stm32g051xx
```kconfig
# STMicroelectronics STM32G051xx MCU

# Copyright (c) 2020 Thomas Stranger
# SPDX-License-Identifier: Apache-2.0

if SOC_STM32G051XX

config NUM_IRQS
	default 30

endif # SOC_STM32G051XX
```

## soc/st/stm32/stm32g0x/Kconfig.defconfig.stm32g061xx
```kconfig
# STMicroelectronics STM32G061xx MCU

# Copyright (c) 2021 Thomas Stranger
# SPDX-License-Identifier: Apache-2.0

if SOC_STM32G061XX

config NUM_IRQS
	default 32

endif # SOC_STM32G061XX
```

## soc/st/stm32/stm32g0x/Kconfig.defconfig.stm32g070xx
```kconfig
# STMicroelectronics STM32G070xx MCU

# Copyright (c) 2019 Sierra Wireless
# SPDX-License-Identifier: Apache-2.0

if SOC_STM32G070XX

config NUM_IRQS
	default 30

endif # SOC_STM32G070XX
```

## soc/st/stm32/stm32g0x/Kconfig.defconfig.stm32g071xx
```kconfig
# STMicroelectronics STM32G071xx MCU

# Copyright (c) 2019 Philippe Retornaz <philippe@shapescale.com>
# Copyright (c) 2019 STMicroelectronics
# SPDX-License-Identifier: Apache-2.0

if SOC_STM32G071XX

config NUM_IRQS
	default 31

endif # SOC_STM32G071XX
```

## soc/st/stm32/stm32g0x/Kconfig.defconfig.stm32g081xx
```kconfig
# STMicroelectronics STM32G081xx MCU

# Copyright (c) 2019 STMicroelectronics
# Copyright (c) 2021 Thomas Stranger
# SPDX-License-Identifier: Apache-2.0

if SOC_STM32G081XX

config NUM_IRQS
	default 32

endif # SOC_STM32G081XX
```

## soc/st/stm32/stm32g0x/Kconfig.defconfig.stm32g0b0xx
```kconfig
# STMicroelectronics STM32G0B0xx MCU

# Copyright (c) 2020 Thomas Stranger
# SPDX-License-Identifier: Apache-2.0

if SOC_STM32G0B0XX

config NUM_IRQS
	default 30

endif # SOC_STM32G0B0XX
```

## soc/st/stm32/stm32g0x/Kconfig.defconfig.stm32g0b1xx
```kconfig
# STMicroelectronics STM32G0B1xx MCU

# Copyright (c) 2020 Thomas Stranger
# SPDX-License-Identifier: Apache-2.0

if SOC_STM32G0B1XX

config NUM_IRQS
	default 36

config MAX_IRQ_PER_AGGREGATOR
	default 2

config NUM_2ND_LEVEL_AGGREGATORS
	default 2

config 2ND_LVL_ISR_TBL_OFFSET
	default 32

config 2ND_LVL_INTR_00_OFFSET
	default 24

config 2ND_LVL_INTR_01_OFFSET
	default 26

if CAN_STM32_FDCAN

config SHARED_INTERRUPTS
	default y if $(dt_nodelabel_enabled,fdcan1) && $(dt_nodelabel_enabled,fdcan2)

endif # CAN_STM32_FDCAN

endif # SOC_STM32G0B1XX
```

## soc/st/stm32/stm32g0x/Kconfig.defconfig.stm32g0c1xx
```kconfig
# STMicroelectronics STM32G0C1xx MCU

# Copyright (c) 2021 Thomas Stranger
# SPDX-License-Identifier: Apache-2.0

if SOC_STM32G0C1XX

config NUM_IRQS
	default 32

endif # SOC_STM32G0C1XX
```

## soc/st/stm32/stm32g0x/Kconfig.soc
```kconfig
# STMicroelectronics STM32G0 MCU line

# Copyright (c) 2019 Philippe Retornaz <philippe@shapescale.com>
# Copyright (c) 2019 STMicroelectronics
# Copyright (c) 2020 Thomas Stranger
# SPDX-License-Identifier: Apache-2.0

config SOC_SERIES_STM32G0X
	bool
	select SOC_FAMILY_STM32

config SOC_SERIES
	default "stm32g0x" if SOC_SERIES_STM32G0X

config SOC_STM32G030XX
	bool
	select SOC_SERIES_STM32G0X

config SOC_STM32G031XX
	bool
	select SOC_SERIES_STM32G0X

config SOC_STM32G041XX
	bool
	select SOC_SERIES_STM32G0X

config SOC_STM32G050XX
	bool
	select SOC_SERIES_STM32G0X

config SOC_STM32G051XX
	bool
	select SOC_SERIES_STM32G0X

config SOC_STM32G061XX
	bool
	select SOC_SERIES_STM32G0X

config SOC_STM32G070XX
	bool
	select SOC_SERIES_STM32G0X

config SOC_STM32G071XX
	bool
	select SOC_SERIES_STM32G0X

config SOC_STM32G081XX
	bool
	select SOC_SERIES_STM32G0X

config SOC_STM32G0B0XX
	bool
	select SOC_SERIES_STM32G0X

config SOC_STM32G0B1XX
	bool
	select SOC_SERIES_STM32G0X

config SOC_STM32G0C1XX
	bool
	select SOC_SERIES_STM32G0X

config SOC
	default "stm32g030xx" if SOC_STM32G030XX
	default "stm32g031xx" if SOC_STM32G031XX
	default "stm32g041xx" if SOC_STM32G041XX
	default "stm32g050xx" if SOC_STM32G050XX
	default "stm32g051xx" if SOC_STM32G051XX
	default "stm32g061xx" if SOC_STM32G061XX
	default "stm32g070xx" if SOC_STM32G070XX
	default "stm32g071xx" if SOC_STM32G071XX
	default "stm32g081xx" if SOC_STM32G081XX
	default "stm32g0b0xx" if SOC_STM32G0B0XX
	default "stm32g0b1xx" if SOC_STM32G0B1XX
	default "stm32g0c1xx" if SOC_STM32G0C1XX
```

## soc/st/stm32/stm32g4/Kconfig.defconfig.stm32g474xx
```kconfig
# STMicroelectronics STM32G474XX MCU

# Copyright (c) 2019 STMicroelectronics.
# SPDX-License-Identifier: Apache-2.0

if SOC_STM32G474XX

config NUM_IRQS
	default 102

endif # SOC_STM32G474XX
```

## soc/st/stm32/stm32g4x/Kconfig
```kconfig
# STMicroelectronics STM32G4 MCU series

# Copyright (c) 2019 Richard Osterloh <richard.osterloh@gmail.com>
# SPDX-License-Identifier: Apache-2.0

config SOC_SERIES_STM32G4X
	select ARM
	select CPU_CORTEX_M4
	select CPU_CORTEX_M_HAS_DWT
	select CPU_HAS_FPU
	select HAS_STM32CUBE
	select CPU_HAS_ARM_MPU
	select CLOCK_CONTROL_STM32_CUBE if CLOCK_CONTROL
	select HAS_PM
	select HAS_SWO
```

## soc/st/stm32/stm32g4x/Kconfig.defconfig
```kconfig
# STMicroelectronics STM32G4 MCU line

# Copyright (c) 2019 Richard Osterloh <richard.osterloh@gmail.com>
# SPDX-License-Identifier: Apache-2.0

if SOC_SERIES_STM32G4X

configdefault SHARED_IRQ_MAX_NUM_CLIENTS
	# COMP1/2/3 or COMP4/5/6 instances are all enabled
	default 3 if $(dt_nodelabel_enabled,comp1) && $(dt_nodelabel_enabled,comp2) && $(dt_nodelabel_enabled,comp3)
	default 3 if $(dt_nodelabel_enabled,comp4) && $(dt_nodelabel_enabled,comp5) && $(dt_nodelabel_enabled,comp6)

configdefault SHARED_INTERRUPTS
	default y if $(dt_nodelabel_enabled,timers1) && $(dt_nodelabel_enabled,timers15)
	default y if $(dt_nodelabel_enabled,timers1) && $(dt_nodelabel_enabled,timers16)
	default y if $(dt_nodelabel_enabled,timers1) && $(dt_nodelabel_enabled,timers17)
	# COMP1 - COMP2 - COMP3 : irq 64
	default y if $(dt_nodelabel_enabled,comp1) && $(dt_nodelabel_enabled,comp2)
	default y if $(dt_nodelabel_enabled,comp1) && $(dt_nodelabel_enabled,comp3)
	default y if $(dt_nodelabel_enabled,comp2) && $(dt_nodelabel_enabled,comp3)
	# COMP4 - COMP5 - COMP6 : irq 65
	default y if $(dt_nodelabel_enabled,comp4) && $(dt_nodelabel_enabled,comp5)
	default y if $(dt_nodelabel_enabled,comp4) && $(dt_nodelabel_enabled,comp6)
	default y if $(dt_nodelabel_enabled,comp5) && $(dt_nodelabel_enabled,comp6)

if PM
config PM_DEVICE
	default y

config STM32_LPTIM_TIMER
	default y
endif # PM

endif # SOC_SERIES_STM32G4X
```

## soc/st/stm32/stm32g4x/Kconfig.defconfig.stm32g431xx
```kconfig
# STMicroelectronics STM32G431XX MCU

# Copyright (c) 2019 Richard Osterloh <richard.osterloh@gmail.com>
# SPDX-License-Identifier: Apache-2.0

if SOC_STM32G431XX

config NUM_IRQS
	default 102

endif # SOC_STM32G431XX
```

## soc/st/stm32/stm32g4x/Kconfig.defconfig.stm32g441xx
```kconfig
# STMicroelectronics STM32G441XX MCU

# Copyright (c) 2021 Guðni Már Gilbert
# SPDX-License-Identifier: Apache-2.0

if SOC_STM32G441XX

config NUM_IRQS
	default 102

endif # SOC_STM32G441XX
```

## soc/st/stm32/stm32g4x/Kconfig.defconfig.stm32g483xx
```kconfig
# STMicroelectronics STM32G483XX MCU

# Copyright (c) 2021 Guðni Már Gilbert
# SPDX-License-Identifier: Apache-2.0

if SOC_STM32G483XX

config NUM_IRQS
	default 102

endif # SOC_STM32G483XX
```

## soc/st/stm32/stm32g4x/Kconfig.defconfig.stm32g484xx
```kconfig
# STMicroelectronics STM32G484XX MCU

# Copyright (c) 2021 Guðni Már Gilbert
# SPDX-License-Identifier: Apache-2.0

if SOC_STM32G484XX

config NUM_IRQS
	default 102

endif # SOC_STM32G484XX
```
