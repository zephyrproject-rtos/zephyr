## soc/st/stm32/stm32mp2x/Kconfig.defconfig.stm32mp215fxx
```kconfig
# STMicroelectronics STM32MP2 MPU series
#
# Copyright (C) 2026 STMicroelectronics
# SPDX-License-Identifier: Apache-2.0

if SOC_STM32MP215FXX_M33

config NUM_IRQS
	default 311

endif # SOC_STM32MP215FXX_M33
```

## soc/st/stm32/stm32mp2x/Kconfig.defconfig.stm32mp257fxx
```kconfig
# STMicroelectronics STM32MP2 MPU series
#
# Copyright (C) 2025 Savoir-faire Linux, Inc.
# SPDX-License-Identifier: Apache-2.0

if SOC_STM32MP2X_M33

config NUM_IRQS
	default 320

endif # SOC_STM32MP2X_M33
```

## soc/st/stm32/stm32mp2x/Kconfig.soc
```kconfig
# STMicroelectronics STM32MP2 MPU series
#
# Copyright (C) 2025 Savoir-faire Linux, Inc.
# SPDX-License-Identifier: Apache-2.0

config SOC_SERIES_STM32MP2X
	bool
	select SOC_FAMILY_STM32

config SOC_SERIES
	default "stm32mp2x" if SOC_SERIES_STM32MP2X

config SOC_STM32MP2X_M33
	bool
	select SOC_SERIES_STM32MP2X

config SOC
	default "stm32mp257fxx" if SOC_STM32MP2X_M33
```

## soc/st/stm32/stm32n6x/Kconfig
```kconfig
# ST Microelectronics STM32N6 MCU series

# Copyright (c) 2024 STMicroelectronics
# SPDX-License-Identifier: Apache-2.0

config SOC_SERIES_STM32N6X
	select ARM
	select CPU_CORTEX_M55
	select ARM_TRUSTZONE_M
	select CPU_HAS_ARM_SAU
	select CPU_HAS_ARM_MPU
	select CPU_HAS_FPU
	select ARMV8_M_DSP
	select ARMV8_1_M_MVEI
	select ARMV8_1_M_MVEF
	select CPU_CORTEX_M_HAS_DWT
	select HAS_STM32CUBE
	select INIT_ARCH_HW_AT_BOOT
	select SOC_RESET_HOOK
	select SOC_EARLY_INIT_HOOK
	select TRUSTED_EXECUTION_SECURE
	select BUILD_OUTPUT_BIN
	# MPU_GAP_FILLING is default when !USERSPACE, select it in the other case as well.
	select MPU_GAP_FILLING if USERSPACE
	select CPU_HAS_CUSTOM_FIXED_SOC_MPU_REGIONS if USERSPACE && !XIP
	select USE_STM32_HAL_RIF if STM32N6_RIF_OPEN

if SOC_SERIES_STM32N6X

config STM32N6_BOOT_SERIAL
	bool "Serial boot target (USB)"

config STM32N6_RIF_OPEN
	bool "Configure the RIF with all OPEN access"
	default y
	depends on TRUSTED_EXECUTION_SECURE
	help
	  When this option is enabled, the RIMC of all masters and the RISC of all slaves are
	  configured during SoC initialization. Zephyr running with Secure privileges has full
	  access to all SoC resources.

source "soc/st/stm32/stm32n6x/npu/Kconfig"

endif # SOC_SERIES_STM32N6X
```

## soc/st/stm32/stm32n6x/Kconfig.defconfig.stm32n657xx
```kconfig
# ST Microelectronics STM32N6 MCU series

# Copyright (c) 2024 STMicroelectronics
# SPDX-License-Identifier: Apache-2.0

if SOC_STM32N657XX

config NUM_IRQS
	default 194

endif # SOC_STM32N657XX
```

## soc/st/stm32/stm32n6x/Kconfig.soc
```kconfig
# ST Microelectronics STM32N6 MCU series

# Copyright (c) 2024 STMicroelectronics
# SPDX-License-Identifier: Apache-2.0

config SOC_SERIES_STM32N6X
	bool
	select SOC_FAMILY_STM32

config SOC_SERIES
	default "stm32n6x" if SOC_SERIES_STM32N6X

config SOC_STM32N657XX
	bool
	select SOC_SERIES_STM32N6X

config SOC
	default "stm32n657xx" if SOC_STM32N657XX
```

## soc/st/stm32/stm32n6x/npu/Kconfig
```kconfig
# STMicroelectronics STM32N6 MCU series

# Copyright (c) 2026 STMicroelectronics
# SPDX-License-Identifier: Apache-2.0

config STM32N6_NPU
	bool "Neural-ART accelerator (NPU)"
	select RESET
	default y
	depends on DT_HAS_ST_STM32_NPU_ENABLED

config STM32N6_NPU_INIT_PRIORITY
	int "STM32N6 NPU init priority"
	default KERNEL_INIT_PRIORITY_DEFAULT
	depends on STM32N6_NPU
	help
	  STM32N6 NPU initialization priority.

	  Note: This value must have a higher priority (i.e., lower numerical value)
	  than `STM32N6_NPU_CACHE_INIT_PRIORITY`!

config STM32N6_NPU_CACHE_INIT_PRIORITY
	int "STM32N6 NPU cache (aka CACHEAXI) init priority"
	default APPLICATION_INIT_PRIORITY
	depends on STM32N6_NPU
	help
	  STM32N6 NPU cache (aka CACHEAXI) initialization priority.

	  Note: This value must have a lower priority (i.e., higher numerical value)
	  than `STM32N6_NPU_INIT_PRIORITY`!
```

## soc/st/stm32/stm32u0x/Kconfig.defconfig
```kconfig
# ST Microelectronics STM32U0 MCU line

# Copyright (c) 2024 STMicroelectronics
# SPDX-License-Identifier: Apache-2.0

if SOC_SERIES_STM32U0X

configdefault SHARED_INTERRUPTS
	# USART2 - LPUART2 : IRQn 28
	default y if $(dt_nodelabel_enabled,usart2) && $(dt_nodelabel_enabled,lpuart2)
	# USART3 - LPUART1 : IRQn 29
	default y if $(dt_nodelabel_enabled,usart3) && $(dt_nodelabel_enabled,lpuart1)
	# USART4 - LPUART3 : IRQn 30
	default y if $(dt_nodelabel_enabled,usart4) && $(dt_nodelabel_enabled,lpuart3)

if I2C_STM32

configdefault SHARED_INTERRUPTS
	# I2C2 - I2C3 - I2C4 : IRQn 24
	default y if $(dt_nodelabel_enabled,i2c2) && $(dt_nodelabel_enabled,i2c3)
	default y if $(dt_nodelabel_enabled,i2c2) && $(dt_nodelabel_enabled,i2c4)
	default y if $(dt_nodelabel_enabled,i2c3) && $(dt_nodelabel_enabled,i2c4)

endif # I2C_STM32

endif # SOC_SERIES_STM32U0X
```

## soc/st/stm32/stm32u0x/Kconfig.defconfig.stm32u031xx
```kconfig
# STMicroelectronics STM32U031XX MCU

# Copyright (c) 2024 STMicroelectronics
# SPDX-License-Identifier: Apache-2.0

if SOC_STM32U031XX

config NUM_IRQS
	default 32

endif # SOC_STM32U031XX
```

## soc/st/stm32/stm32u0x/Kconfig.defconfig.stm32u073xx
```kconfig
# STMicroelectronics STM32U073XX MCU

# Copyright (c) 2024 STMicroelectronics
# SPDX-License-Identifier: Apache-2.0

if SOC_STM32U073XX

config NUM_IRQS
	default 32

endif # SOC_STM32U073XX
```

## soc/st/stm32/stm32u0x/Kconfig.soc
```kconfig
# ST Microelectronics STM32U0 MCU line

# Copyright (c) 2024 STMicroelectronics
# SPDX-License-Identifier: Apache-2.0

config SOC_SERIES_STM32U0X
	bool
	select SOC_FAMILY_STM32

config SOC_SERIES
	default "stm32u0x" if SOC_SERIES_STM32U0X

config SOC_STM32U031XX
	bool
	select SOC_SERIES_STM32U0X

config SOC_STM32U073XX
	bool
	select SOC_SERIES_STM32U0X

config SOC_STM32U083XX
	bool
	select SOC_SERIES_STM32U0X

config SOC
	default "stm32u031xx" if SOC_STM32U031XX
	default "stm32u073xx" if SOC_STM32U073XX
	default "stm32u083xx" if SOC_STM32U083XX
```

## soc/st/stm32/stm32u3x/Kconfig
```kconfig
# STMicroelectronics STM32U3 MCU series

# Copyright (c) 2025 STMicroelectronics
# SPDX-License-Identifier: Apache-2.0

config SOC_SERIES_STM32U3X
	select ARM
	select CPU_CORTEX_M33
	select ARM_TRUSTZONE_M
	select CPU_HAS_ARM_SAU
	select CPU_HAS_ARM_MPU
	select CPU_HAS_FPU
	select CPU_HAS_ICACHE
	select ARMV8_M_DSP
	select CPU_CORTEX_M_HAS_DWT
	select HAS_STM32CUBE
	select HAS_PM
	select HAS_STM32_FLASH_PREFETCH
	select SOC_EARLY_INIT_HOOK

config STM32_STOP3_LP_MODE
	bool
	default $(dt_path_enabled,/cpus/power-states/state3) && $(dt_chosen_enabled,$(DT_CHOSEN_STDBY_TIMER))
	help
	  Enable support for STM32 STOP3 low-power mode.
	  Based on the Cortex-M33 Deepsleep mode combined with peripheral clock gating.
	  All clocks in the core domain are stopped.
	  The PLL, MSIS, MSIK, HSI16, and HSE oscillators are disabled.
	  All SRAMs and register contents are preserved.
	  SRAMs can be totally or partially switched off to further reduce consumption.
	  GPIOs are left floating and additional pull-up or pull-down can be applied
	  via PWR registers.
```

## soc/st/stm32/stm32u3x/Kconfig.defconfig.stm32u385xx
```kconfig
# STMicroelectronics STM32U385XX MCU

# Copyright (c) 2025 STMicroelectronics
# SPDX-License-Identifier: Apache-2.0

if SOC_STM32U385XX

config NUM_IRQS
	default 125

endif # SOC_STM32U385XX
```

## soc/st/stm32/stm32u3x/Kconfig.soc
```kconfig
# STMicroelectronics STM32U3 MCU series

# Copyright (c) 2025 STMicroelectronics
# SPDX-License-Identifier: Apache-2.0

config SOC_SERIES_STM32U3X
	bool
	select SOC_FAMILY_STM32

config SOC_SERIES
	default "stm32u3x" if SOC_SERIES_STM32U3X

config SOC_STM32U385XX
	bool
	select SOC_SERIES_STM32U3X

config SOC
	default "stm32u385xx" if SOC_STM32U385XX
```

## soc/st/stm32/stm32u5x/Kconfig
```kconfig
# ST Microelectronics STM32U5 MCU series

# Copyright (c) 2021 Linaro Limited
# SPDX-License-Identifier: Apache-2.0

DT_CHOSEN_STDBY_TIMER := st,lptim-stdby-timer

config SOC_SERIES_STM32U5X
	select ARM
	select ARM_TRUSTZONE_M
	select ARMV8_M_DSP
	select CPU_CORTEX_M33

	select CPU_CORTEX_M_HAS_DWT
	select CPU_HAS_ARM_MPU
	select CPU_HAS_ARM_SAU
	select CPU_HAS_DCACHE
	select CPU_HAS_FPU
	select CPU_HAS_ICACHE
	select HAS_SWO

	select HAS_PM
	select HAS_POWEROFF
	select PM_STATE_SET_IRQ_UNLOCKED
	select SOC_EARLY_INIT_HOOK

	select HAS_STM32CUBE

config STM32_STOP3_LP_MODE
	bool
	default $(dt_path_enabled,/cpus/power-states/state3) && $(dt_chosen_enabled,$(DT_CHOSEN_STDBY_TIMER))
	help
	  Enable support for STM32 STOP3 low-power mode.
	  Based on the Cortex-M33 Deepsleep mode combined with peripheral clock gating.
	  All clocks in the core domain are stopped.
	  The PLL, MSIS, MSIK, HSI16, and HSE oscillators are disabled.
	  All SRAMs and register contents are preserved.
	  SRAMs can be totally or partially switched off to further reduce consumption.
	  GPIOs are left floating and additional pull-up or pull-down can be applied
	  via PWR registers.
```

## soc/st/stm32/stm32u5x/Kconfig.defconfig
```kconfig
# ST Microelectronics STM32U5 MCU line

# Copyright (c) 2021 Linaro Limited
# SPDX-License-Identifier: Apache-2.0

if SOC_SERIES_STM32U5X

rsource "Kconfig.defconfig.stm32u5*"

config ROM_START_OFFSET
	default 0x400 if BOOTLOADER_MCUBOOT

config ICACHE
	default y

config ICACHE_LINE_SIZE
	default 16

config DCACHE
	default y

config DCACHE_LINE_SIZE
	default 32 if (SOC_STM32U595XX || SOC_STM32U599XX || \
		SOC_STM32U5A5XX || SOC_STM32U5A9XX || \
		SOC_STM32U5F9XX || SOC_STM32U5G9XX)
	default 16

config CACHE_MANAGEMENT
	default y

choice CACHE_TYPE
	default EXTERNAL_CACHE
endchoice

if STM32_STOP3_LP_MODE

config COUNTER
	default y

config COUNTER_RTC_STM32_SUBSECONDS
	default y

config STM32_LPTIM_STDBY_TIMER
	default y

config TICKLESS_KERNEL
	default y

config COUNTER_RTC_STM32_SAVE_VALUE_BETWEEN_RESETS
	default y

config IDLE_STACK_SIZE
	default 512

endif #STM32_USE_STOP3

endif # SOC_SERIES_STM32U5X
```

## soc/st/stm32/stm32u5x/Kconfig.defconfig.stm32u535xx
```kconfig
# ST Microelectronics STM32U535XX MCU

# Copyright (c) 2025 Harris Tomy
# SPDX-License-Identifier: Apache-2.0

if SOC_STM32U535XX

config NUM_IRQS
	default 126

endif # SOC_STM32U535XX
```

## soc/st/stm32/stm32u5x/Kconfig.defconfig.stm32u545xx
```kconfig
# ST Microelectronics STM32U545XX MCU

# Copyright (c) 2024 Opito
# SPDX-License-Identifier: Apache-2.0

if SOC_STM32U545XX

config NUM_IRQS
	default 126

endif # SOC_STM32U545XX
```

## soc/st/stm32/stm32u5x/Kconfig.defconfig.stm32u585xx
```kconfig
# STMicroelectronics STM32U585XX MCU

# Copyright (c) 2021 Linaro Limited
# SPDX-License-Identifier: Apache-2.0

if SOC_STM32U585XX

config NUM_IRQS
	default 125

endif # SOC_STM32U585XX
```

## soc/st/stm32/stm32u5x/Kconfig.defconfig.stm32u595xx
```kconfig
# STMicroelectronics STM32U595XX MCU

# Copyright (c) 2023 PSICONTROL nv
# SPDX-License-Identifier: Apache-2.0

if SOC_STM32U595XX

config NUM_IRQS
	default 132

endif # SOC_STM32U595XX
```

## soc/st/stm32/stm32u5x/Kconfig.defconfig.stm32u599xx
```kconfig
# STMicroelectronics STM32U599XX MCU

# Copyright (c) 2023 PSICONTROL nv
# SPDX-License-Identifier: Apache-2.0

if SOC_STM32U599XX

config NUM_IRQS
	default 139

endif # SOC_STM32U599XX
```

## soc/st/stm32/stm32u5x/Kconfig.defconfig.stm32u5a9xx
```kconfig
# STMicroelectronics STM32U5A9XX MCU

# Copyright (c) 2023 STMicroelectronics
# SPDX-License-Identifier: Apache-2.0

if SOC_STM32U5A9XX

config NUM_IRQS
	default 139

endif # SOC_STM32U5A9XX
```

## soc/st/stm32/stm32u5x/Kconfig.defconfig.stm32u5f9xx
```kconfig
# STMicroelectronics STM32U5GFXX MCU

# Copyright (c) 2025 Harris Tomy
# SPDX-License-Identifier: Apache-2.0

if SOC_STM32U5F9XX

config NUM_IRQS
	default 141

endif # SOC_STM32U5F9XX
```

## soc/st/stm32/stm32u5x/Kconfig.defconfig.stm32u5g9xx
```kconfig
# STMicroelectronics STM32U5G9XX MCU

# Copyright (c) 2025 Charles Dias
# SPDX-License-Identifier: Apache-2.0

if SOC_STM32U5G9XX

config NUM_IRQS
	default 141

endif # SOC_STM32U5G9XX
```

## soc/st/stm32/stm32u5x/Kconfig.soc
```kconfig
# ST Microelectronics STM32U5 MCU line

# Copyright (c) 2021 Linaro Limited
# Copyright (c) 2023 PSICONTROL nv
# Copyright (c) 2023 STMicroelectronics
# SPDX-License-Identifier: Apache-2.0

config SOC_SERIES_STM32U5X
	bool
	select SOC_FAMILY_STM32

config SOC_SERIES
	default "stm32u5x" if SOC_SERIES_STM32U5X

config SOC_STM32U545XX
	bool
	select SOC_SERIES_STM32U5X

config SOC_STM32U575XX
	bool
	select SOC_SERIES_STM32U5X

config SOC_STM32U585XX
	bool
	select SOC_SERIES_STM32U5X

config SOC_STM32U595XX
	bool
	select SOC_SERIES_STM32U5X

config SOC_STM32U599XX
	bool
	select SOC_SERIES_STM32U5X

config SOC_STM32U5A5XX
	bool
	select SOC_SERIES_STM32U5X

config SOC_STM32U5A9XX
	bool
	select SOC_SERIES_STM32U5X

config SOC
	default "stm32u5a5xx" if SOC_STM32U5A5XX
	default "stm32u5a9xx" if SOC_STM32U5A9XX
	default "stm32u545xx" if SOC_STM32U545XX
	default "stm32u575xx" if SOC_STM32U575XX
	default "stm32u585xx" if SOC_STM32U585XX
	default "stm32u595xx" if SOC_STM32U595XX
	default "stm32u599xx" if SOC_STM32U599XX
```
