## soc/st/stm32/stm32g4x/Kconfig.soc
```kconfig
# STMicroelectronics STM32G4 MCU line

# Copyright (c) 2019 Richard Osterloh <richard.osterloh@gmail.com>
# SPDX-License-Identifier: Apache-2.0

config SOC_SERIES_STM32G4X
	bool
	select SOC_FAMILY_STM32

config SOC_SERIES
	default "stm32g4x" if SOC_SERIES_STM32G4X

config SOC_STM32G431XX
	bool
	select SOC_SERIES_STM32G4X

config SOC_STM32G441XX
	bool
	select SOC_SERIES_STM32G4X

config SOC_STM32G473XX
	bool
	select SOC_SERIES_STM32G4X

config SOC_STM32G474XX
	bool
	select SOC_SERIES_STM32G4X

config SOC_STM32G483XX
	bool
	select SOC_SERIES_STM32G4X

config SOC_STM32G484XX
	bool
	select SOC_SERIES_STM32G4X

config SOC_STM32G491XX
	bool
	select SOC_SERIES_STM32G4X

config SOC_STM32G4A1XX
	bool
	select SOC_SERIES_STM32G4X

config SOC
	default "stm32g431xx" if SOC_STM32G431XX
	default "stm32g441xx" if SOC_STM32G441XX
	default "stm32g473xx" if SOC_STM32G473XX
	default "stm32g474xx" if SOC_STM32G474XX
	default "stm32g483xx" if SOC_STM32G483XX
	default "stm32g484xx" if SOC_STM32G484XX
	default "stm32g491xx" if SOC_STM32G491XX
	default "stm32g4a1xx" if SOC_STM32G4A1XX
```

## soc/st/stm32/stm32h5x/Kconfig.defconfig
```kconfig
# ST Microelectronics STM32H5 MCU line

# Copyright (c) 2023 STMicroelectronics
# SPDX-License-Identifier: Apache-2.0

if SOC_SERIES_STM32H5X

configdefault CACHE_MANAGEMENT
	default y

choice CACHE_TYPE
	default EXTERNAL_CACHE
endchoice

config ROM_START_OFFSET
	default 0x400 if BOOTLOADER_MCUBOOT

config STM32_INT_FLASH_SECURE_BASE_ADDRESS
	default 0x0c000000

endif # SOC_SERIES_STM32H5X
```

## soc/st/stm32/stm32h5x/Kconfig.defconfig.stm32h503xx
```kconfig
# STMicroelectronics STM32H503XX MCU

# Copyright (c) 2023 STMicroelectronics
# SPDX-License-Identifier: Apache-2.0

if SOC_STM32H503XX

config NUM_IRQS
	default 134

endif # SOC_STM32H503XX
```

## soc/st/stm32/stm32h5x/Kconfig.defconfig.stm32h523xx
```kconfig
# STMicroelectronics STM32H523XX MCU

# Copyright (c) Filip Stojanovic
# SPDX-License-Identifier: Apache-2.0

if SOC_STM32H523XX

config NUM_IRQS
	default 133

endif # SOC_STM32H523XX
```

## soc/st/stm32/stm32h5x/Kconfig.defconfig.stm32h533xx
```kconfig
# STMicroelectronics STM32H503XX MCU

# Copyright (c) 2024 STMicroelectronics
# SPDX-License-Identifier: Apache-2.0

if SOC_STM32H533XX

config NUM_IRQS
	default 133

endif # SOC_STM32H533XX
```

## soc/st/stm32/stm32h5x/Kconfig.defconfig.stm32h562xx
```kconfig
# STMicroelectronics STM32H562XX MCU

# Copyright (c) 2023 STMicroelectronics
# SPDX-License-Identifier: Apache-2.0

if SOC_STM32H562XX

config NUM_IRQS
	default 131

endif # SOC_STM32H562XX
```

## soc/st/stm32/stm32h5x/Kconfig.defconfig.stm32h563xx
```kconfig
# STMicroelectronics STM32H563XX MCU

# Copyright (c) 2023 STMicroelectronics
# SPDX-License-Identifier: Apache-2.0

if SOC_STM32H563XX

config NUM_IRQS
	default 131

endif # SOC_STM32H563XX
```

## soc/st/stm32/stm32h5x/Kconfig.defconfig.stm32h5f4xx
```kconfig
# STMicroelectronics STM32H5F4XX MCU

# Copyright (c) 2026 STMicroelectronics
# SPDX-License-Identifier: Apache-2.0

if SOC_STM32H5F4XX

configdefault NUM_IRQS
	default 162

endif # SOC_STM32H5F4XX
```

## soc/st/stm32/stm32h5x/Kconfig.defconfig.stm32h5f5xx
```kconfig
# STMicroelectronics STM32H5F5XX MCU

# Copyright (c) 2026 STMicroelectronics
# SPDX-License-Identifier: Apache-2.0

if SOC_STM32H5F5XX

configdefault NUM_IRQS
	default 162

endif # SOC_STM32H5F5XX
```

## soc/st/stm32/stm32h5x/Kconfig.soc
```kconfig
# ST Microelectronics STM32H5 MCU line

# Copyright (c) 2023 STMicroelectronics
# SPDX-License-Identifier: Apache-2.0

config SOC_SERIES_STM32H5X
	bool
	select SOC_FAMILY_STM32

config SOC_SERIES
	default "stm32h5x" if SOC_SERIES_STM32H5X

config SOC_STM32H503XX
	bool
	select SOC_SERIES_STM32H5X

config SOC_STM32H523XX
	bool
	select SOC_SERIES_STM32H5X

config SOC_STM32H533XX
	bool
	select SOC_SERIES_STM32H5X

config SOC_STM32H562XX
	bool
	select SOC_SERIES_STM32H5X

config SOC_STM32H563XX
	bool
	select SOC_SERIES_STM32H5X

config SOC_STM32H573XX
	bool
	select SOC_SERIES_STM32H5X

config SOC_STM32H5E4XX
	bool
	select SOC_SERIES_STM32H5X

config SOC_STM32H5E5XX
	bool
	select SOC_SERIES_STM32H5X

config SOC_STM32H5F4XX
	bool
	select SOC_SERIES_STM32H5X

config SOC_STM32H5F5XX
	bool
	select SOC_SERIES_STM32H5X

config SOC
	default "stm32h503xx" if SOC_STM32H503XX
	default "stm32h523xx" if SOC_STM32H523XX
	default "stm32h533xx" if SOC_STM32H533XX
	default "stm32h562xx" if SOC_STM32H562XX
	default "stm32h563xx" if SOC_STM32H563XX
	default "stm32h573xx" if SOC_STM32H573XX
	default "stm32h5e4xx" if SOC_STM32H5E4XX
	default "stm32h5e5xx" if SOC_STM32H5E5XX
	default "stm32h5f4xx" if SOC_STM32H5F4XX
	default "stm32h5f5xx" if SOC_STM32H5F5XX
```

## soc/st/stm32/stm32h7/Kconfig.defconfig.stm32h7b0xx
```kconfig
# ST STM32H7B0XX MCU configuration options

# Copyright (c) 2023 Charles Dias <charlesdias.cd@outlook.com>
# SPDX-License-Identifier: Apache-2.0

if SOC_STM32H7B0XX || SOC_STM32H7B0XXQ

config NUM_IRQS
	default 155

endif # SOC_STM32H7B0XX || SOC_STM32H7B0XXQ
```

## soc/st/stm32/stm32h7rsx/Kconfig.defconfig.stm32h7s3xx
```kconfig
# ST STM32H7S3X MCU configuration options

# Copyright (c) 2024 STMicroelectronics
# SPDX-License-Identifier: Apache-2.0

if SOC_STM32H7S3XX

config NUM_IRQS
	default 156

endif # SOC_STM32H7S3XX
```

## soc/st/stm32/stm32h7rsx/Kconfig.defconfig.stm32h7s7xx
```kconfig
# ST STM32H7S7X MCU configuration options

# Copyright (c) 2024 STMicroelectronics
# SPDX-License-Identifier: Apache-2.0

if SOC_STM32H7S7XX

config NUM_IRQS
	default 156

endif # SOC_STM32H7S7XX
```

## soc/st/stm32/stm32h7rsx/Kconfig.soc
```kconfig
# ST Microelectronics STM32H7RS MCU line

# Copyright (c) 2024 STMicroelectronics
# SPDX-License-Identifier: Apache-2.0

config SOC_SERIES_STM32H7RSX
	bool
	select SOC_FAMILY_STM32

config SOC_SERIES
	default "stm32h7rsx" if SOC_SERIES_STM32H7RSX

config SOC_STM32H7R3XX
	bool
	select SOC_SERIES_STM32H7RSX

config SOC_STM32H7R7XX
	bool
	select SOC_SERIES_STM32H7RSX

config SOC_STM32H7S3XX
	bool
	select SOC_SERIES_STM32H7RSX

config SOC_STM32H7S7XX
	bool
	select SOC_SERIES_STM32H7RSX

config SOC
	default "stm32h7r3xx" if SOC_STM32H7R3XX
	default "stm32h7r7xx" if SOC_STM32H7R7XX
	default "stm32h7s3xx" if SOC_STM32H7S3XX
	default "stm32h7s7xx" if SOC_STM32H7S7XX
```

## soc/st/stm32/stm32h7x/Kconfig
```kconfig
# ST Microelectronics STM32H7 MCU series

# Copyright (c) 2019 Linaro Limited
# SPDX-License-Identifier: Apache-2.0

config SOC_SERIES_STM32H7X
	select ARM
	select CPU_CORTEX_M_HAS_DWT
	select CPU_HAS_FPU
	select HAS_STM32CUBE
	select CPU_HAS_ARM_MPU
	select HAS_SWO
	select USE_STM32_HAL_CORTEX
	select CPU_HAS_CUSTOM_FIXED_SOC_MPU_REGIONS
	select CPU_HAS_FPU_DOUBLE_PRECISION if CPU_CORTEX_M7
	select CPU_HAS_ICACHE if CPU_CORTEX_M7
	select CPU_HAS_DCACHE if CPU_CORTEX_M7
	select SOC_EARLY_INIT_HOOK

config SOC_STM32H723XX
	select CPU_CORTEX_M7

config SOC_STM32H725XX
	select CPU_CORTEX_M7

config SOC_STM32H730XX
	select CPU_CORTEX_M7

config SOC_STM32H730XXQ
	select CPU_CORTEX_M7

config SOC_STM32H735XX
	select CPU_CORTEX_M7

config SOC_STM32H743XX
	select CPU_CORTEX_M7

config SOC_STM32H745XX_M7
	select CPU_CORTEX_M7

config SOC_STM32H745XX_M4
	select CPU_CORTEX_M4

config SOC_STM32H747XX_M7
	select CPU_CORTEX_M7

config SOC_STM32H747XX_M4
	select CPU_CORTEX_M4

config SOC_STM32H750XX
	select CPU_CORTEX_M7

config SOC_STM32H753XX
	select CPU_CORTEX_M7

config SOC_STM32H755XX_M7
	select CPU_CORTEX_M7

config SOC_STM32H755XX_M4
	select CPU_CORTEX_M4

config SOC_STM32H757XX_M7
	select CPU_CORTEX_M7

config SOC_STM32H757XX_M4
	select CPU_CORTEX_M4

config SOC_STM32H7A3XX
	select CPU_CORTEX_M7

config SOC_STM32H7A3XXQ
	select CPU_CORTEX_M7

config SOC_STM32H7B0XX
	select CPU_CORTEX_M7

config SOC_STM32H7B0XXQ
	select CPU_CORTEX_M7

config SOC_STM32H7B3XX
	select CPU_CORTEX_M7

config SOC_STM32H7B3XXQ
	select CPU_CORTEX_M7

if SOC_SERIES_STM32H7X

config STM32H7_DUAL_CORE
	bool "Dual Core"

config STM32H7_BOOT_M4_AT_INIT
	bool "Boot M4 core during M7 init independent of option byte BCM4."
	default y

endif # SOC_SERIES_STM32H7X
```

## soc/st/stm32/stm32h7x/Kconfig.defconfig
```kconfig
# ST Microelectronics STM32H7 MCU line

# Copyright (c) 2019 Linaro  Limited
# Copyright (c) 2022 SILA Embedded Solutions GmbH <office@embedded-solutions.at>
# SPDX-License-Identifier: Apache-2.0

# Kconfig symbols common to STM32H7 series

if SOC_SERIES_STM32H7X

rsource "Kconfig.defconfig.stm32h7*"

# NUM_IRQS must be set here (before the DT-computed configdefault in
# soc/st/stm32/Kconfig.defconfig) because NUM_IRQS has no prompt and
# cannot be overridden from prj.conf. Values derived from CMSIS headers.
configdefault NUM_IRQS
	default 163 if SOC_STM32H723XX || SOC_STM32H725XX || SOC_STM32H730XX || \
	               SOC_STM32H730XXQ || SOC_STM32H735XX
	default 155 if SOC_STM32H7A3XX || SOC_STM32H7A3XXQ || SOC_STM32H7B0XX || \
	               SOC_STM32H7B0XXQ || SOC_STM32H7B3XX || SOC_STM32H7B3XXQ
	default 150

configdefault SHARED_INTERRUPTS
	default y if $(dt_nodelabel_enabled,timers8) && $(dt_nodelabel_enabled,timers12)
	default y if $(dt_nodelabel_enabled,timers8) && $(dt_nodelabel_enabled,timers13)
	default y if $(dt_nodelabel_enabled,timers8) && $(dt_nodelabel_enabled,timers14)

config ROM_START_OFFSET
	default 0x400 if BOOTLOADER_MCUBOOT
	default 0x0   if !BOOTLOADER_MCUBOOT

config CACHE_MANAGEMENT
	default y if CPU_CORTEX_M7

if LVGL

config LV_DRAW_DMA2D_HAL_INCLUDE
	default "stm32h7xx.h"

endif # LVGL

endif # SOC_SERIES_STM32H7X
```

## soc/st/stm32/stm32h7x/Kconfig.defconfig.stm32h723xx
```kconfig
# ST STM32H723X MCU configuration options

# Copyright (c) 2020 Alexander Kozhinov <ak.alexander.kozhinov@gmail.com>
# SPDX-License-Identifier: Apache-2.0

if SOC_STM32H723XX

config NUM_IRQS
	default 163

endif # SOC_STM32H723XX
```

## soc/st/stm32/stm32h7x/Kconfig.defconfig.stm32h730xx
```kconfig
# ST STM32H730X MCU configuration options

# Copyright (c) 2022 Georgij Cernysiov <geo.cgv@gmail.com>
# Copyright (c) 2023 Chen Xingyu <hi@xingrz.me>
# SPDX-License-Identifier: Apache-2.0

if SOC_STM32H730XX || SOC_STM32H730XXQ

config NUM_IRQS
	default 163

endif # SOC_STM32H730XX || SOC_STM32H730XXQ
```

## soc/st/stm32/stm32h7x/Kconfig.defconfig.stm32h735xx
```kconfig
# ST STM32H723X MCU configuration options

# Copyright (c) 2021 SILA Embedded Solutions GmbH
# SPDX-License-Identifier: Apache-2.0

if SOC_STM32H735XX

config NUM_IRQS
	default 163

endif # SOC_STM32H735XX
```

## soc/st/stm32/stm32h7x/Kconfig.defconfig.stm32h742xx
```kconfig
# ST STM32H742X MCU configuration options

# Copyright (c) 2025 Brill Power
# SPDX-License-Identifier: Apache-2.0

if SOC_STM32H742XX

config NUM_IRQS
	default 150

endif # SOC_STM32H742XX
```

## soc/st/stm32/stm32h7x/Kconfig.defconfig.stm32h743xx
```kconfig
# ST STM32H743X MCU configuration options

# Copyright (c) 2020 Teslabs Engineering S.L.
# SPDX-License-Identifier: Apache-2.0

if SOC_STM32H743XX

config NUM_IRQS
	default 150

endif # SOC_STM32H743XX
```

## soc/st/stm32/stm32h7x/Kconfig.defconfig.stm32h745xx
```kconfig
# ST STM32H745X MCU configuration options

# Copyright (c) 2020 Alexander Kozhinov <AlexanderKozhinov@yandex.com>
# SPDX-License-Identifier: Apache-2.0

if SOC_STM32H745XX_M7 || SOC_STM32H745XX_M4

config STM32H7_DUAL_CORE
	default y

config NUM_IRQS
	default 150

endif # SOC_STM32H745XX_M7 || SOC_STM32H745XX_M4
```

## soc/st/stm32/stm32h7x/Kconfig.defconfig.stm32h747xx
```kconfig
# ST STM32H747X MCU configuration options

# Copyright (c) 2019 Linaro Limited
# SPDX-License-Identifier: Apache-2.0

if SOC_STM32H747XX_M7 || SOC_STM32H747XX_M4

config STM32H7_DUAL_CORE
	default y

config NUM_IRQS
	default 150

endif # SOC_STM32H747XX_M7 || SOC_STM32H747XX_M7
```

## soc/st/stm32/stm32h7x/Kconfig.defconfig.stm32h750xx
```kconfig
# ST STM32H750XX MCU configuration options

# Copyright (c) 2020 Teslabs Engineering S.L.
# SPDX-License-Identifier: Apache-2.0

if SOC_STM32H750XX

config NUM_IRQS
	default 150

endif # SOC_STM32H750XX
```

## soc/st/stm32/stm32h7x/Kconfig.defconfig.stm32h755xx
```kconfig
# ST STM32H755X MCU configuration options

# Copyright (c) 2024 S&C Electric Company
# SPDX-License-Identifier: Apache-2.0

if SOC_STM32H755XX_M7 || SOC_STM32H755XX_M4

config STM32H7_DUAL_CORE
	default y

endif # SOC_STM32H755XX_M7 || SOC_STM32H755XX_M4
```
