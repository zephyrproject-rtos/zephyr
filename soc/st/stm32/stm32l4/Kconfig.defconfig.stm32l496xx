## soc/st/stm32/stm32l4/Kconfig.defconfig.stm32l496xx
```kconfig
# ST Microelectronics STM32L496xx MCU

# Copyright (c) 2016 Open-RnD Sp. z o.o.
# Copyright (c) 2016 BayLibre, SAS
# Copyright (c) 2019 Centaur Analytics, Inc
# SPDX-License-Identifier: Apache-2.0

if SOC_STM32L496XX

config NUM_IRQS
	default 91

endif # SOC_STM32L496XX
```

## soc/st/stm32/stm32l4/Kconfig.defconfig.stm32l4q5xx
```kconfig
# ST Microelectronics STM32L4Q5xx MCU

# Copyright (c) 2023 Marcin Zapolski
# SPDX-License-Identifier: Apache-2.0

if SOC_STM32L4Q5XX

config NUM_IRQS
	default 95

endif # SOC_STM32L4Q5XX
```

## soc/st/stm32/stm32l4x/Kconfig.defconfig
```kconfig
# ST Microelectronics STM32L4 MCU line

# Copyright (c) 2016 Open-RnD Sp. z o.o.
# Copyright (c) 2016 BayLibre, SAS
# SPDX-License-Identifier: Apache-2.0

# Kconfig symbols common to STM32L4 series

if SOC_SERIES_STM32L4X

configdefault SHARED_INTERRUPTS
	default y if $(dt_nodelabel_enabled,timers1) && $(dt_nodelabel_enabled,timers15)
	default y if $(dt_nodelabel_enabled,timers1) && $(dt_nodelabel_enabled,timers16)
	default y if $(dt_nodelabel_enabled,timers1) && $(dt_nodelabel_enabled,timers17)

# Add LVGL HAL include file for SOC supporting DMA2D
if LVGL && DT_HAS_ST_STM32_DMA2D_ENABLED

config LV_DRAW_DMA2D_HAL_INCLUDE
	default "stm32l4xx.h"

endif # LVGL

endif # SOC_SERIES_STM32L4X
```

## soc/st/stm32/stm32l4x/Kconfig.defconfig.stm32l412xx
```kconfig
# ST Microelectronics STM32L412XX MCU

# Copyright (c) 2021 Guðni Már Gilbert
# SPDX-License-Identifier: Apache-2.0

if SOC_STM32L412XX

config NUM_IRQS
	default 83

endif # SOC_STM32L412XX
```

## soc/st/stm32/stm32l4x/Kconfig.defconfig.stm32l422xx
```kconfig
# ST Microelectronics STM32L422XX MCU

# Copyright (c) 2020 Aurelien Jarno
# SPDX-License-Identifier: Apache-2.0

if SOC_STM32L422XX

config NUM_IRQS
	default 83

endif # SOC_STM32L422XX
```

## soc/st/stm32/stm32l4x/Kconfig.defconfig.stm32l431xx
```kconfig
# ST Microelectronics STM32L432XX MCU

# Copyright (c) 2022 Liam Clark
# SPDX-License-Identifier: Apache-2.0

if SOC_STM32L431XX

config NUM_IRQS
	default 83

endif # SOC_STM32L431XX
```

## soc/st/stm32/stm32l4x/Kconfig.defconfig.stm32l432xx
```kconfig
# ST Microelectronics STM32L432XX MCU

# Copyright (c) 2016 Open-RnD Sp. z o.o.
# Copyright (c) 2016 BayLibre, SAS
# SPDX-License-Identifier: Apache-2.0

if SOC_STM32L432XX

config NUM_IRQS
	default 83

endif # SOC_STM32L432XX
```

## soc/st/stm32/stm32l4x/Kconfig.defconfig.stm32l433xx
```kconfig
# ST Microelectronics STM32L433XX MCU

# Copyright (c) 2018 David Lamparter
# SPDX-License-Identifier: Apache-2.0

if SOC_STM32L433XX

config NUM_IRQS
	default 83

endif # SOC_STM32L433XX
```

## soc/st/stm32/stm32l4x/Kconfig.defconfig.stm32l451xx
```kconfig
# ST Microelectronics STM32L451XX MCU

# Copyright (c) 2023 SILA Embedded Solutions GmbH
# SPDX-License-Identifier: Apache-2.0

if SOC_STM32L451XX

config NUM_IRQS
	default 85

endif # SOC_STM32L451XX
```

## soc/st/stm32/stm32l4x/Kconfig.defconfig.stm32l462xx
```kconfig
# ST Microelectronics STM32L462XX MCU

# Copyright (c) 2020 Giancarlo Stasi
# SPDX-License-Identifier: Apache-2.0

if SOC_STM32L462XX

config NUM_IRQS
	default 85

endif # SOC_STM32L462XX
```

## soc/st/stm32/stm32l4x/Kconfig.defconfig.stm32l471xx
```kconfig
# ST Microelectronics STM32L476RG MCU

# Copyright (c) 2018 Allterco Robotics
# SPDX-License-Identifier: Apache-2.0

if SOC_STM32L471XX

config NUM_IRQS
	default 82

endif # SOC_STM32L471XX
```

## soc/st/stm32/stm32l4x/Kconfig.defconfig.stm32l476xx
```kconfig
# ST Microelectronics STM32L476RG MCU

# Copyright (c) 2016 Open-RnD Sp. z o.o.
# Copyright (c) 2016 BayLibre, SAS
# SPDX-License-Identifier: Apache-2.0

if SOC_STM32L476XX

config NUM_IRQS
	default 82

endif # SOC_STM32L476XX
```

## soc/st/stm32/stm32l4x/Kconfig.defconfig.stm32l4a6xx
```kconfig
# ST Microelectronics STM32L4A6xx MCU

# Copyright (c) 2016 Open-RnD Sp. z o.o.
# Copyright (c) 2016 BayLibre, SAS
# Copyright (c) 2019 Centaur Analytics, Inc
# Copyright (c) 2022 Tomislav Milkovic
# SPDX-License-Identifier: Apache-2.0

if SOC_STM32L4A6XX

config NUM_IRQS
	default 91

endif # SOC_STM32L4A6XX
```

## soc/st/stm32/stm32l4x/Kconfig.soc
```kconfig
# ST Microelectronics STM32L4 MCU line

# Copyright (c) 2016 Open-RnD Sp. z o.o.
# Copyright (c) 2016 BayLibre, SAS
# Copyright (c) 2019 Centaur Analytics, Inc
# Copyright (c) 2019 STMicroelectronics
# SPDX-License-Identifier: Apache-2.0

config SOC_SERIES_STM32L4X
	bool
	select SOC_FAMILY_STM32

config SOC_SERIES
	default "stm32l4x" if SOC_SERIES_STM32L4X

config SOC_STM32L412XX
	bool
	select SOC_SERIES_STM32L4X

config SOC_STM32L422XX
	bool
	select SOC_SERIES_STM32L4X

config SOC_STM32L431XX
	bool
	select SOC_SERIES_STM32L4X

config SOC_STM32L432XX
	bool
	select SOC_SERIES_STM32L4X

config SOC_STM32L433XX
	bool
	select SOC_SERIES_STM32L4X

config SOC_STM32L451XX
	bool
	select SOC_SERIES_STM32L4X

config SOC_STM32L452XX
	bool
	select SOC_SERIES_STM32L4X

config SOC_STM32L462XX
	bool
	select SOC_SERIES_STM32L4X

config SOC_STM32L471XX
	bool
	select SOC_SERIES_STM32L4X

config SOC_STM32L475XX
	bool
	select SOC_SERIES_STM32L4X

config SOC_STM32L476XX
	bool
	select SOC_SERIES_STM32L4X

config SOC_STM32L486XX
	bool
	select SOC_SERIES_STM32L4X

config SOC_STM32L496XX
	bool
	select SOC_SERIES_STM32L4X

config SOC_STM32L4A6XX
	bool
	select SOC_SERIES_STM32L4X

config SOC_STM32L4P5XX
	bool
	select SOC_SERIES_STM32L4X

config SOC_STM32L4Q5XX
	bool
	select SOC_SERIES_STM32L4X

config SOC_STM32L4S5XX
	bool
	select SOC_SERIES_STM32L4X

config SOC_STM32L4R5XX
	bool
	select SOC_SERIES_STM32L4X

config SOC_STM32L4R9XX
	bool
	select SOC_SERIES_STM32L4X

config SOC
	default "stm32l412xx" if SOC_STM32L412XX
	default "stm32l422xx" if SOC_STM32L422XX
	default "stm32l431xx" if SOC_STM32L431XX
	default "stm32l432xx" if SOC_STM32L432XX
	default "stm32l433xx" if SOC_STM32L433XX
	default "stm32l451xx" if SOC_STM32L451XX
	default "stm32l452xx" if SOC_STM32L452XX
	default "stm32l462xx" if SOC_STM32L462XX
	default "stm32l471xx" if SOC_STM32L471XX
	default "stm32l475xx" if SOC_STM32L475XX
	default "stm32l476xx" if SOC_STM32L476XX
	default "stm32l486xx" if SOC_STM32L486XX
	default "stm32l496xx" if SOC_STM32L496XX
	default "stm32l4a6xx" if SOC_STM32L4A6XX
	default "stm32l4p5xx" if SOC_STM32L4P5XX
	default "stm32l4q5xx" if SOC_STM32L4Q5XX
	default "stm32l4s5xx" if SOC_STM32L4S5XX
	default "stm32l4r5xx" if SOC_STM32L4R5XX
	default "stm32l4r9xx" if SOC_STM32L4R9XX
```

## soc/st/stm32/stm32l5/Kconfig.defconfig.stm32l552xx
```kconfig
# ST Microelectronics STM32L552XX MCU

# Copyright (c) 2020 Linaro Limited
# SPDX-License-Identifier: Apache-2.0

if SOC_STM32L552XX

config NUM_IRQS
	default 108

endif # SOC_STM32L552XX
```

## soc/st/stm32/stm32l5x/Kconfig
```kconfig
# ST Microelectronics STM32L5 MCU series

# Copyright (c) 2020 Linaro Limited
# SPDX-License-Identifier: Apache-2.0

config SOC_SERIES_STM32L5X
	select ARM
	select ARM_TRUSTZONE_M
	select ARMV8_M_DSP
	select CPU_CORTEX_M33

	select CPU_CORTEX_M_HAS_DWT
	select CPU_HAS_ARM_MPU
	select CPU_HAS_ARM_SAU
	select CPU_HAS_FPU
	select CPU_HAS_ICACHE
	select HAS_SWO

	select HAS_PM
	select PM_STATE_SET_IRQ_UNLOCKED
	select SOC_EARLY_INIT_HOOK

	select HAS_STM32CUBE
```

## soc/st/stm32/stm32l5x/Kconfig.defconfig
```kconfig
# ST Microelectronics STM32L5 MCU line

# Copyright (c) 2020 Linaro Limited
# SPDX-License-Identifier: Apache-2.0

if SOC_SERIES_STM32L5X

configdefault CACHE_MANAGEMENT
	default y

choice CACHE_TYPE
	default EXTERNAL_CACHE
endchoice

config ROM_START_OFFSET
	default 0x400 if BOOTLOADER_MCUBOOT

config STM32_INT_FLASH_SECURE_BASE_ADDRESS
	default 0x0c000000

config BUILD_OUTPUT_UF2_FAMILY_ID
	default "0x04240bdf"

endif # SOC_SERIES_STM32L5X
```

## soc/st/stm32/stm32l5x/Kconfig.soc
```kconfig
# ST Microelectronics STM32L5 MCU line

# Copyright (c) 2020 Linaro Limited
# SPDX-License-Identifier: Apache-2.0

config SOC_SERIES_STM32L5X
	bool
	select SOC_FAMILY_STM32

config SOC_SERIES
	default "stm32l5x" if SOC_SERIES_STM32L5X

config SOC_STM32L552XX
	bool
	select SOC_SERIES_STM32L5X

config SOC_STM32L562XX
	bool
	select SOC_SERIES_STM32L5X

config SOC
	default "stm32l552xx" if SOC_STM32L552XX
	default "stm32l562xx" if SOC_STM32L562XX
```

## soc/st/stm32/stm32mp13x/Kconfig.defconfig
```kconfig
# STMicroelectronics STM32MP13 MPU series

# Copyright (c) 2025 STMicroelectronics
# SPDX-License-Identifier: Apache-2.0

if SOC_SERIES_STM32MP13X

rsource "Kconfig.defconfig.stm32mp13_a7"

config CACHE_MANAGEMENT
	default y

DT_STM32_CPU_CLOCK_PATH := $(dt_nodelabel_path,cpusw)
DT_STM32_CPU_CLOCK_FREQ := $(dt_node_int_prop_int,$(DT_STM32_CPU_CLOCK_PATH),clock-frequency)

# For STM32MP13, override the default value defined in STM32 Kconfig
config SYS_CLOCK_HW_CYCLES_PER_SEC
	default $(DT_STM32_CPU_CLOCK_FREQ) if $(dt_nodelabel_enabled,cpusw)

endif # SOC_SERIES_STM32MP13X
```

## soc/st/stm32/stm32mp13x/Kconfig.defconfig.stm32mp13_a7
```kconfig
# STMicroelectronics STM32MP13_A7 MPU

# Copyright (c) 2025 STMicroelectronics
# SPDX-License-Identifier: Apache-2.0

if SOC_SERIES_STM32MP13X

configdefault NUM_IRQS
	default 181

endif # SOC_SERIES_STM32MP13X
```

## soc/st/stm32/stm32mp1x/Kconfig.defconfig
```kconfig
# STMicroelectronics STM32MP1 MCU/MPU line

# Copyright (c) 2019 STMicroelectronics
# SPDX-License-Identifier: Apache-2.0

if SOC_SERIES_STM32MP1X

rsource "Kconfig.defconfig.stm32mp15_m4"

endif # SOC_SERIES_STM32MP1X
```

## soc/st/stm32/stm32mp1x/Kconfig.defconfig.stm32mp15_m4
```kconfig
# STMicroelectronics STM32MP157C_M4 MCU

# Copyright (c) 2019 STMicroelectronics
# SPDX-License-Identifier: Apache-2.0

if SOC_STM32MP15_M4

config NUM_IRQS
	default 150

endif # SOC_STM32MP15_M4
```

## soc/st/stm32/stm32mp1x/Kconfig.soc
```kconfig
# STMicroelectronics STM32MP1 MPU line

# Copyright (c) 2019 STMicroelectronics
# SPDX-License-Identifier: Apache-2.0

config SOC_SERIES_STM32MP1X
	bool
	select SOC_FAMILY_STM32

config SOC_SERIES
	default "stm32mp1x" if SOC_SERIES_STM32MP1X

config SOC_STM32MP15_M4
	bool
	select SOC_SERIES_STM32MP1X

config SOC
	default "stm32mp157cxx" if SOC_STM32MP15_M4
```

## soc/st/stm32/stm32mp2x/Kconfig
```kconfig
# STMicroelectronics STM32MP2 MPU series
#
# Copyright (C) 2025 Savoir-faire Linux, Inc.
# SPDX-License-Identifier: Apache-2.0

config SOC_SERIES_STM32MP2X
	select HAS_STM32CUBE

config SOC_STM32MP2X_M33
	select ARM
	select ARMV8_M_DSP
	select ARM_TRUSTZONE_M
	select CPU_CORTEX_M33

	select CPU_CORTEX_M_HAS_DWT
	select CPU_HAS_ARM_MPU
	select CPU_HAS_ARM_SAU
	select CPU_HAS_FPU

	select SOC_EARLY_INIT_HOOK

config SOC_STM32MP215FXX_M33
	select SOC_STM32MP2X_M33

config SOC_STM32MP257FXX_M33
	select SOC_STM32MP2X_M33
```

## soc/st/stm32/stm32mp2x/Kconfig.defconfig
```kconfig
# STMicroelectronics STM32MP2 MPU series
#
# Copyright (C) 2025 Savoir-faire Linux, Inc.
# SPDX-License-Identifier: Apache-2.0

if SOC_SERIES_STM32MP2X

rsource "Kconfig.defconfig.stm32mp2*"

endif # SOC_SERIES_STM32MP2X
```
