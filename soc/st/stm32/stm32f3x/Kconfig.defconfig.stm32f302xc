## soc/st/stm32/stm32f3x/Kconfig.defconfig.stm32f302xc
```kconfig
# STMicroelectronics STM32F302XC MCU

# Copyright (c) 2022, SECO Spa
# SPDX-License-Identifier: Apache-2.0

if SOC_STM32F302XC

config NUM_IRQS
	default 82

config CPU_HAS_ARM_MPU
	default y

endif # SOC_STM32F302XC
```

## soc/st/stm32/stm32f3x/Kconfig.defconfig.stm32f303xe
```kconfig
# STMicroelectronics STM32F303XC MCU

# Copyright (c) 2020 Paul M. Bendixen
# SPDX-License-Identifier: Apache-2.0

if SOC_STM32F303XE

config NUM_IRQS
	default 85

config CPU_HAS_ARM_MPU
	default y

endif # SOC_STM32F303XE
```

## soc/st/stm32/stm32f3x/Kconfig.defconfig.stm32f334x8
```kconfig
# STMicroelectronics STM32F334X8 MCU

# Copyright (c) 2016 RnDity Sp. z o.o.
# SPDX-License-Identifier: Apache-2.0

if SOC_STM32F334X8

config NUM_IRQS
	default 82

endif # SOC_STM32F334X8
```

## soc/st/stm32/stm32f3x/Kconfig.defconfig.stm32f373xc
```kconfig
# STMicroelectronics STM32F373XC MCU

# Copyright (c) 2016 RnDity Sp. z o.o.
# SPDX-License-Identifier: Apache-2.0

if SOC_STM32F373XC

config NUM_IRQS
	default 82

config CPU_HAS_ARM_MPU
	default y

endif # SOC_STM32F373XC
```

## soc/st/stm32/stm32f3x/Kconfig.soc
```kconfig
# STMicroelectronics STM32F3 MCU line

# Copyright (c) 2016 RnDity Sp. z o.o.
# SPDX-License-Identifier: Apache-2.0

config SOC_SERIES_STM32F3X
	bool
	select SOC_FAMILY_STM32

config SOC_SERIES
	default "stm32f3x" if SOC_SERIES_STM32F3X

config SOC_STM32F302X8
	bool
	select SOC_SERIES_STM32F3X

config SOC_STM32F302XC
	bool
	select SOC_SERIES_STM32F3X

config SOC_STM32F303X8
	bool
	select SOC_SERIES_STM32F3X

config SOC_STM32F303XB
	bool
	select SOC_SERIES_STM32F3X

config SOC_STM32F303XC
	bool
	select SOC_SERIES_STM32F3X

config SOC_STM32F303XE
	bool
	select SOC_SERIES_STM32F3X

config SOC_STM32F334X8
	bool
	select SOC_SERIES_STM32F3X

config SOC_STM32F373XC
	bool
	select SOC_SERIES_STM32F3X

config SOC
	default "stm32f302x8" if SOC_STM32F302X8
	default "stm32f302xc" if SOC_STM32F302XC
	default "stm32f303x8" if SOC_STM32F303X8
	default "stm32f303xb" if SOC_STM32F303XB
	default "stm32f303xc" if SOC_STM32F303XC
	default "stm32f303xe" if SOC_STM32F303XE
	default "stm32f334x8" if SOC_STM32F334X8
	default "stm32f373xc" if SOC_STM32F373XC
```

## soc/st/stm32/stm32f4/Kconfig.defconfig.stm32f412xx
```kconfig
# ST STM32F412XX MCU configuration options

# Copyright (c) 2024 STMicroelectronics.
# SPDX-License-Identifier: Apache-2.0

if SOC_STM32F412CX || SOC_STM32F412VX || SOC_STM32F412ZX

config NUM_IRQS
	default 97

endif
```

## soc/st/stm32/stm32f4x/Kconfig
```kconfig
# STMicroelectronics STM32F4 MCU series

# Copyright (c) 2016 Linaro Limited
# SPDX-License-Identifier: Apache-2.0

config SOC_SERIES_STM32F4X
	select ARM
	select CPU_CORTEX_M4
	select CPU_CORTEX_M_HAS_DWT
	select CPU_HAS_FPU
	select HAS_STM32CUBE
	select CPU_HAS_ARM_MPU
	select HAS_SWO
	select HAS_PM
	select HAS_POWEROFF
	select SOC_EARLY_INIT_HOOK
```

## soc/st/stm32/stm32f4x/Kconfig.defconfig
```kconfig
# STMicroelectronics STM32F4 MCU line

# Copyright (c) 2016 Linaro Limited
# SPDX-License-Identifier: Apache-2.0

# Kconfig symbols common to STM32F4 series

if SOC_SERIES_STM32F4X

rsource "Kconfig.defconfig.stm32f4*"

configdefault SHARED_INTERRUPTS
	default y if $(dt_nodelabel_enabled,timers1) && $(dt_nodelabel_enabled,timers9)
	default y if $(dt_nodelabel_enabled,timers1) && $(dt_nodelabel_enabled,timers10)
	default y if $(dt_nodelabel_enabled,timers1) && $(dt_nodelabel_enabled,timers11)
	default y if $(dt_nodelabel_enabled,timers8) && $(dt_nodelabel_enabled,timers12)
	default y if $(dt_nodelabel_enabled,timers8) && $(dt_nodelabel_enabled,timers13)
	default y if $(dt_nodelabel_enabled,timers8) && $(dt_nodelabel_enabled,timers14)

# adjust the fallback because of the LSI oscaillator characteristics
config TASK_WDT_HW_FALLBACK_DELAY
	depends on TASK_WDT_HW_FALLBACK
	default 200

if PM

config COUNTER
	default y

config COUNTER_RTC_STM32_SUBSECONDS
	default y if DT_HAS_ST_STM32_RTC_ENABLED

config IDLE_STACK_SIZE
	default 512

endif # PM

if LVGL

config LV_DRAW_DMA2D_HAL_INCLUDE
	default "stm32f4xx.h"

endif # LVGL

endif # SOC_SERIES_STM32F4X
```

## soc/st/stm32/stm32f4x/Kconfig.defconfig.stm32f401xd
```kconfig
# ST STM32F401xD MCU configuration options

# Copyright (c) 2025 Cirrus Logic, Inc.
# SPDX-License-Identifier: Apache-2.0

if SOC_STM32F401XD

config NUM_IRQS
	default 85

endif # SOC_STM32F401XD
```

## soc/st/stm32/stm32f4x/Kconfig.defconfig.stm32f401xe
```kconfig
# ST STM32F401RE MCU configuration options

# Copyright (c) 2016 Linaro Limited.
# SPDX-License-Identifier: Apache-2.0

if SOC_STM32F401XE

config NUM_IRQS
	default 85

endif # SOC_STM32F401XE
```

## soc/st/stm32/stm32f4x/Kconfig.defconfig.stm32f407xx
```kconfig
# ST STM32F407XX MCU configuration options

# Copyright (c) 2016 Linaro Limited.
# SPDX-License-Identifier: Apache-2.0

if SOC_STM32F407XE || SOC_STM32F407XG

config NUM_IRQS
	default 82

endif
```

## soc/st/stm32/stm32f4x/Kconfig.defconfig.stm32f410xx
```kconfig
# ST STM32F410XB MCU configuration options

# Copyright (c) 2020 Hans Unzner
# SPDX-License-Identifier: Apache-2.0

if SOC_STM32F410RX

config NUM_IRQS
	default 97

endif # SOC_STM32F410RX
```

## soc/st/stm32/stm32f4x/Kconfig.defconfig.stm32f411xe
```kconfig
# ST STM32F411CE MCU configuration options

# Copyright (c) 2016 Linaro Limited.
# SPDX-License-Identifier: Apache-2.0

if SOC_STM32F411XE

config NUM_IRQS
	default 86

endif # SOC_STM32F411XE
```

## soc/st/stm32/stm32f4x/Kconfig.defconfig.stm32f415xx
```kconfig
# ST STM32F415RG MCU configuration options

# Copyright (c) 2019, Kwon Tae-young <tykwon@m2i.co.kr>
# SPDX-License-Identifier: Apache-2.0

if SOC_STM32F415XX

config NUM_IRQS
	default 82

endif # SOC_STM32F415XX
```

## soc/st/stm32/stm32f4x/Kconfig.defconfig.stm32f417xx
```kconfig
# ST STM32F417XX MCU configuration options

# Copyright (c) 2016 Linaro Limited.
# SPDX-License-Identifier: Apache-2.0

if SOC_STM32F417XX

config NUM_IRQS
	default 82

endif # SOC_STM32F417XX
```

## soc/st/stm32/stm32f4x/Kconfig.defconfig.stm32f427xx
```kconfig
# ST STM32F427XX MCU configuration options

# Copyright (c) 2020 Linaro Limited.
# SPDX-License-Identifier: Apache-2.0

if SOC_STM32F427XX

config NUM_IRQS
	default 91

endif # SOC_STM32F427XX
```

## soc/st/stm32/stm32f4x/Kconfig.defconfig.stm32f439xx
```kconfig
# ST STM32F439XX MCU configuration options

# Copyright (c) 2025 Mathieu Anquetin <mathieu.anquetin@groupe-cahors.com>.
# SPDX-License-Identifier: Apache-2.0

if SOC_STM32F439XX

config NUM_IRQS
	default 91

endif # SOC_STM32F439XX
```

## soc/st/stm32/stm32f4x/Kconfig.defconfig.stm32f479xx
```kconfig
# ST STM32F479XI MCU configuration options

# Copyright (c) 2025 Christopher Cichiwskyj
# SPDX-License-Identifier: Apache-2.0

if SOC_STM32F479XX

config NUM_IRQS
	default 93

endif # SOC_STM32F479XX
```

## soc/st/stm32/stm32f4x/Kconfig.soc
```kconfig
# STMicroelectronics STM32F4 MCU line

# Copyright (c) 2016 Linaro Limited.
# SPDX-License-Identifier: Apache-2.0

config SOC_SERIES_STM32F4X
	bool
	select SOC_FAMILY_STM32

config SOC_SERIES
	default "stm32f4x" if SOC_SERIES_STM32F4X

config SOC_STM32F401XC
	bool
	select SOC_SERIES_STM32F4X

config SOC_STM32F401XD
	bool
	select SOC_SERIES_STM32F4X

config SOC_STM32F401XE
	bool
	select SOC_SERIES_STM32F4X

config SOC_STM32F405XX
	bool
	select SOC_SERIES_STM32F4X

config SOC_STM32F407XE
	bool
	select SOC_SERIES_STM32F4X

config SOC_STM32F407XG
	bool
	select SOC_SERIES_STM32F4X

config SOC_STM32F410RX
	bool
	select SOC_SERIES_STM32F4X

config SOC_STM32F411XE
	bool
	select SOC_SERIES_STM32F4X

config SOC_STM32F412CX
	bool
	select SOC_SERIES_STM32F4X

config SOC_STM32F412RX
	bool
	select SOC_SERIES_STM32F4X

config SOC_STM32F412VX
	bool
	select SOC_SERIES_STM32F4X

config SOC_STM32F412ZX
	bool
	select SOC_SERIES_STM32F4X

config SOC_STM32F413XX
	bool
	select SOC_SERIES_STM32F4X

config SOC_STM32F415XX
	bool
	select SOC_SERIES_STM32F4X

config SOC_STM32F417XX
	bool
	select SOC_SERIES_STM32F4X

config SOC_STM32F423XX
	bool
	select SOC_SERIES_STM32F4X

config SOC_STM32F427XX
	bool
	select SOC_SERIES_STM32F4X

config SOC_STM32F429XX
	bool
	select SOC_SERIES_STM32F4X

config SOC_STM32F437XX
	bool
	select SOC_SERIES_STM32F4X

config SOC_STM32F439XX
	bool
	select SOC_SERIES_STM32F4X

config SOC_STM32F446XX
	bool
	select SOC_SERIES_STM32F4X

config SOC_STM32F469XX
	bool
	select SOC_SERIES_STM32F4X

config SOC_STM32F479XX
	bool
	select SOC_SERIES_STM32F4X

config SOC
	default "stm32f401xc" if SOC_STM32F401XC
	default "stm32f401xd" if SOC_STM32F401XD
	default "stm32f401xe" if SOC_STM32F401XE
	default "stm32f405xx" if SOC_STM32F405XX
	default "stm32f407xx" if SOC_STM32F407XE
	default "stm32f407xx" if SOC_STM32F407XG
	default "stm32f410rx" if SOC_STM32F410RX
	default "stm32f411xe" if SOC_STM32F411XE
	default "stm32f412cx" if SOC_STM32F412CX
	default "stm32f412rx" if SOC_STM32F412RX
	default "stm32f412vx" if SOC_STM32F412VX
	default "stm32f412zx" if SOC_STM32F412ZX
	default "stm32f413xx" if SOC_STM32F413XX
	default "stm32f415xx" if SOC_STM32F415XX
	default "stm32f417xx" if SOC_STM32F417XX
	default "stm32f423xx" if SOC_STM32F423XX
	default "stm32f427xx" if SOC_STM32F427XX
	default "stm32f429xx" if SOC_STM32F429XX
	default "stm32f437xx" if SOC_STM32F437XX
	default "stm32f439xx" if SOC_STM32F439XX
	default "stm32f446xx" if SOC_STM32F446XX
	default "stm32f469xx" if SOC_STM32F469XX
	default "stm32f479xx" if SOC_STM32F479XX
```

## soc/st/stm32/stm32f7/Kconfig.defconfig
```kconfig
# ST Microelectronics STM32F7 MCU line

# Copyright (c) 2018 Yurii Hamann
# SPDX-License-Identifier: Apache-2.0

# Kconfig symbols common to STM32F7 series

if SOC_SERIES_STM32F7X

rsource "Kconfig.defconfig.stm32f7*"

endif # SOC_SERIES_STM32F7X
```

## soc/st/stm32/stm32f7/Kconfig.defconfig.stm32f722xx
```kconfig
# ST STM32F722XE Configuration options
#
# Copyright (c) 2023 Evan Perry Grove
#
# SPDX-License-Identifier: Apache-2.0

if SOC_STM32F722XX

config NUM_IRQS
	default 104

endif # SOC_STM32F722XX
```

## soc/st/stm32/stm32f7/Kconfig.defconfig.stm32f756xx
```kconfig
# ST STM32F756XX MCU configuration options

# Copyright (c) 2018 AJ Palmer
# SPDX-License-Identifier: Apache-2.0

if SOC_STM32F756XX

config NUM_IRQS
	default 98

endif # SOC_STM32F756XX
```

## soc/st/stm32/stm32f7x/Kconfig.defconfig.stm32f723xx
```kconfig
# ST STM32F723XE MCU configuration options

# Copyright (c) 2018 Aurelien Jarno
# SPDX-License-Identifier: Apache-2.0

if SOC_STM32F723XX

config NUM_IRQS
	default 104

endif # SOC_STM32F723XX
```

## soc/st/stm32/stm32f7x/Kconfig.defconfig.stm32f746xx
```kconfig
# ST STM32F746XG MCU configuration options

# Copyright (c) 2018 Yurii Hamann
# SPDX-License-Identifier: Apache-2.0

if SOC_STM32F746XX

config NUM_IRQS
	default 98

endif # SOC_STM32F746XX
```

## soc/st/stm32/stm32f7x/Kconfig.defconfig.stm32f765xx
```kconfig
# ST STM32F765XX MCU configuration options

# Copyright (c) 2023 Rahul Arasikere
# SPDX-License-Identifier: Apache-2.0

if SOC_STM32F765XX

config NUM_IRQS
	default 110

config CPU_HAS_FPU_DOUBLE_PRECISION
	default y

endif # SOC_STM32F765XX
```
