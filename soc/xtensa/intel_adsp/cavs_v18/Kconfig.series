## soc/xtensa/intel_adsp/cavs_v18/Kconfig.series
```kconfig
# Copyright (c) 2020 Intel Corporation
# SPDX-License-Identifier: Apache-2.0

config SOC_SERIES_INTEL_CAVS_V18
	bool "Intel CAVS v1.8"
	select SOC_FAMILY_INTEL_ADSP
	select XTENSA
	select INTEL_ADSP_CAVS
	select XTENSA_HAL if "$(ZEPHYR_TOOLCHAIN_VARIANT)" != "xcc"
	select XTENSA_RESET_VECTOR
	select XTENSA_USE_CORE_CRT1
	select XTENSA_WAITI_BUG
	select ATOMIC_OPERATIONS_BUILTIN if "$(ZEPHYR_TOOLCHAIN_VARIANT)" != "xcc"
	select ARCH_HAS_COHERENCE
	help
	  Intel CAVS v1.8
```

## soc/xtensa/intel_adsp/cavs_v18/Kconfig.soc
```kconfig
# Copyright (c) 2020 Intel Corporation
# SPDX-License-Identifier: Apache-2.0

choice
	prompt "Intel CAVS SoC Selection"

	config SOC_INTEL_CAVS_V18
		bool "CAVS v1.8 SoC"
		depends on SOC_SERIES_INTEL_CAVS_V18

endchoice
```

## soc/xtensa/intel_adsp/cavs_v20/Kconfig.defconfig.series
```kconfig
# Copyright (c) 2020 Intel Corporation
# SPDX-License-Identifier: Apache-2.0

if SOC_SERIES_INTEL_CAVS_V20

config SOC_SERIES
	string
	default "cavs_v20"

config SOC_TOOLCHAIN_NAME
	string
	default "intel_s1000"

config SOC
	string
	default "intel_cavs_20"

config SMP
       default y

# FIXME: these DSPs can have more cores, but Zephyr only supports up to 2 cores on them
config MP_NUM_CPUS
	default 2

config SCHED_IPI_SUPPORTED
	default y

config XTENSA_TIMER
	default n

config INTEL_ADSP_TIMER
	default y

config SYS_CLOCK_HW_CYCLES_PER_SEC
	default 400000000 if XTENSA_TIMER
	default 38400000 if INTEL_ADSP_TIMER

config SYS_CLOCK_TICKS_PER_SEC
	default 50000

config KERNEL_ENTRY
	default "_MainEntry"

config MULTI_LEVEL_INTERRUPTS
	default y

config 2ND_LEVEL_INTERRUPTS
	default y

config DYNAMIC_INTERRUPTS
	default y

if LOG

config LOG_BACKEND_ADSP
	default y

endif # LOG

endif # SOC_SERIES_INTEL_CAVS_V20
```

## soc/xtensa/intel_adsp/cavs_v20/Kconfig.soc
```kconfig
# Copyright (c) 2020 Intel Corporation
# SPDX-License-Identifier: Apache-2.0

choice
	prompt "Intel CAVS SoC Selection"

	config SOC_INTEL_CAVS_V20
		bool "CAVS v2.0 SoC"
		depends on SOC_SERIES_INTEL_CAVS_V20

endchoice
```

## soc/xtensa/intel_adsp/cavs_v25/Kconfig.defconfig.series
```kconfig
# Copyright (c) 2020 Intel Corporation
# SPDX-License-Identifier: Apache-2.0

if SOC_SERIES_INTEL_CAVS_V25

config SOC_SERIES
	string
	default "cavs_v25"

config SOC_TOOLCHAIN_NAME
	string
	default "intel_s1000"

config SOC
	string
	default "intel_cavs_25"

# Hardware has four cores, limited to two pending test fixes
config MP_NUM_CPUS
	default 2

config SMP
       default y

config XTENSA_TIMER
	default n

config CAVS_TIMER
	default y

config SYS_CLOCK_HW_CYCLES_PER_SEC
	default 400000000 if XTENSA_TIMER
	default 38400000 if CAVS_TIMER

config SYS_CLOCK_TICKS_PER_SEC
	default 50000

config KERNEL_ENTRY
	default "_MainEntry"

config MULTI_LEVEL_INTERRUPTS
	default y

config 2ND_LEVEL_INTERRUPTS
	default y

config DYNAMIC_INTERRUPTS
	default y

config CAVS_ICTL_0_OFFSET
	default 6
config CAVS_ICTL_1_OFFSET
	default 10
config CAVS_ICTL_2_OFFSET
	default 13
config CAVS_ICTL_3_OFFSET
	default 16

config 2ND_LVL_INTR_00_OFFSET
	default CAVS_ICTL_0_OFFSET
config 2ND_LVL_INTR_01_OFFSET
	default CAVS_ICTL_1_OFFSET
config 2ND_LVL_INTR_02_OFFSET
	default CAVS_ICTL_2_OFFSET
config 2ND_LVL_INTR_03_OFFSET
	default CAVS_ICTL_3_OFFSET

config MAX_IRQ_PER_AGGREGATOR
	default 32
config NUM_2ND_LEVEL_AGGREGATORS
	default 4
config 2ND_LVL_ISR_TBL_OFFSET
	default 21

config CAVS_ISR_TBL_OFFSET
	default 2ND_LVL_ISR_TBL_OFFSET

if LOG
config LOG_BACKEND_ADSP
	default y

endif # LOG

if KERNEL_VM_SUPPORT

config KERNEL_VM_SIZE
	default 0x800000

endif

endif # SOC_SERIES_INTEL_CAVS_V25
```

## soc/xtensa/intel_adsp/cavs_v25/Kconfig.series
```kconfig
# Copyright (c) 2020 Intel Corporation
# SPDX-License-Identifier: Apache-2.0

config SOC_SERIES_INTEL_CAVS_V25
	bool "Intel CAVS v2.5"
	select SOC_FAMILY_INTEL_ADSP
	select XTENSA
	select INTEL_ADSP_CAVS
	select XTENSA_HAL if "$(ZEPHYR_TOOLCHAIN_VARIANT)" != "xcc"
	select XTENSA_RESET_VECTOR
	select XTENSA_USE_CORE_CRT1
	select XTENSA_WAITI_BUG
	select ATOMIC_OPERATIONS_BUILTIN if "$(ZEPHYR_TOOLCHAIN_VARIANT)" != "xcc"
	select ARCH_HAS_COHERENCE
	select SCHED_IPI_SUPPORTED
	help
	  Intel CAVS v2.5
```

## soc/xtensa/intel_adsp/cavs_v25/Kconfig.soc
```kconfig
# Copyright (c) 2020 Intel Corporation
# SPDX-License-Identifier: Apache-2.0

choice
	prompt "Intel CAVS SoC Selection"

	config SOC_INTEL_CAVS_V25
		bool "CAVS v2.5 SoC"
		depends on SOC_SERIES_INTEL_CAVS_V25

endchoice
```

## soc/xtensa/intel_adsp/common/drivers/Kconfig
```kconfig
# drivers configuration options

# Copyright (c) 2023 Intel Corporation
# SPDX-License-Identifier: Apache-2.0

menu "SOC Device Drivers"

source "soc/xtensa/intel_adsp/common/drivers/memory_window/Kconfig"

source "soc/xtensa/intel_adsp/common/drivers/telemetry/Kconfig"

endmenu
```

## soc/xtensa/intel_adsp/common/drivers/memory_window/Kconfig
```kconfig
# Debug memory window driver configuration options

# Copyright (c) 2022 Intel Corporation
# SPDX-License-Identifier: Apache-2.0

config DYNAMIC_SLOTS
	bool "Support for dynamic slots allocation for memory windows"
	depends on SOC_FAMILY_INTEL_ADSP
	default y

config DEBUG_MEMORY_WINDOW
	bool "Debug memory window"
	depends on SOC_FAMILY_INTEL_ADSP && DYNAMIC_SLOTS
	default y
```

## soc/xtensa/intel_adsp/common/drivers/telemetry/Kconfig
```kconfig
# Debug memory window driver configuration options

# Copyright (c) 2022 Intel Corporation
# SPDX-License-Identifier: Apache-2.0

config TELEMETRY_INTEL
	bool "Support for Intel telemetry"
	depends on SOC_FAMILY_INTEL_ADSP
	default y
```

## soc/xtensa/intel_apl_adsp/Kconfig.defconfig
```kconfig
# Xtensa board configuration

# Copyright (c) 2017 Intel Corporation
# SPDX-License-Identifier: Apache-2.0

if SOC_INTEL_APL_ADSP

config SOC
	string
	default "intel_apl_adsp"

config SYS_CLOCK_HW_CYCLES_PER_SEC
	default 400000000 if XTENSA_TIMER
	default 19200000 if CAVS_TIMER

config IRQ_OFFLOAD_INTNUM
	default 0

# S1000 does not have MISC0.
# Since EXCSAVE2 is unused by Zephyr, use it instead.
config XTENSA_KERNEL_CPU_PTR_SR
	default "EXCSAVE2"

config KERNEL_ENTRY
	default "_MainEntry"

config MULTI_LEVEL_INTERRUPTS
	default y

config 2ND_LEVEL_INTERRUPTS
	default y

config DYNAMIC_INTERRUPTS
	default y

config LOG
	default y

# To prevent test uses TEST_LOGGING_MINIMAL
config TEST_LOGGING_DEFAULTS
	default n
	depends on TEST

if LOG

# When console is enabled printk should go through it
config LOG_PRINTK
	default y if !CONSOLE

config LOG_BACKEND_RB
	default y

config LOG_BACKEND_RB_MEM_BASE
	default 0xBE008000

config LOG_BACKEND_RB_MEM_SIZE
	default 8192

endif # LOG

if SMP

config MP_NUM_CPUS
	default 2

config XTENSA_TIMER
	default n

config CAVS_TIMER
	default y

config IPM
	default y

config IPM_CAVS_IDC
	default y if IPM

config SCHED_IPI_SUPPORTED
	default y if IPM_CAVS_IDC

endif

config IPM_INTEL_ADSP
	default y
	depends on IPM

config IPM_CONSOLE
	default y
	depends on CONSOLE
	depends on IPM

endif
```

## soc/xtensa/intel_apl_adsp/Kconfig.soc
```kconfig
# Copyright (c) 2017 Intel Corporation
# SPDX-License-Identifier: Apache-2.0

config SOC_INTEL_APL_ADSP
	bool "intel_apl_adsp"
	select XTENSA
	select XTENSA_HAL if "$(ZEPHYR_TOOLCHAIN_VARIANT)" != "xcc"
	select XTENSA_RESET_VECTOR
	select XTENSA_USE_CORE_CRT1
	select ATOMIC_OPERATIONS_BUILTIN
```

## soc/xtensa/intel_s1000/Kconfig.defconfig
```kconfig
# XTENSA board configuration

# Copyright (c) 2017 Intel Corporation
# SPDX-License-Identifier: Apache-2.0

if SOC_INTEL_S1000

config SOC
	default "intel_s1000"

config SOC_SERIES
	string
	default "intel_s1000"

config SOC_TOOLCHAIN_NAME
	string
	default "intel_s1000"

config IRQ_OFFLOAD_INTNUM
	default 0

# S1000 does not have MISC0.
# Since EXCSAVE7 is unused by Zephyr, use it instead.
config XTENSA_KERNEL_CPU_PTR_SR
	default "EXCSAVE7"

config SPI_DW_FIFO_DEPTH
	default 32

config SYS_CLOCK_HW_CYCLES_PER_SEC
	default 400000000 if XTENSA_TIMER
	default 38400000 if CAVS_TIMER

if SMP

config MP_NUM_CPUS
	default 2

config XTENSA_TIMER
	default n

config CAVS_TIMER
	default y

config IPM
	default y

config IPM_CAVS_IDC
	default y if IPM

config SCHED_IPI_SUPPORTED
	default y if IPM_CAVS_IDC

endif

endif
```

## soc/xtensa/intel_s1000/Kconfig.soc
```kconfig
# Copyright (c) 2017 Intel Corporation
# SPDX-License-Identifier: Apache-2.0

config SOC_INTEL_S1000
	bool "intel_s1000"
	select XTENSA
	select XTENSA_HAL if "$(ZEPHYR_TOOLCHAIN_VARIANT)" != "xcc"
	select HAS_I2C_DW if I2C
	select HAS_SPI_DW if SPI
	select ARCH_HAS_THREAD_LOCAL_STORAGE
```

## soc/xtensa/mtk_adsp/Kconfig
```kconfig
# Copyright 2023 The ChromiumOS Authors
# SPDX-License-Identifier: Apache-2.0

config SOC_FAMILY_MTK_ADSP
	bool "Mediatek MT8xxx Series Audio DSPs"
	select XTENSA
```

## soc/xtensa/mtk_adsp/Kconfig.soc
```kconfig
# Copyright 2023 The ChromiumOS Authors
# SPDX-License-Identifier: Apache-2.0

rsource "*/Kconfig.series"
```

## soc/xtensa/mtk_adsp/mt8195_adsp/Kconfig.series
```kconfig
# Copyright 2023 The ChromiumOS Authors
# SPDX-License-Identifier: Apache-2.0

config SOC_SERIES_MT8195_ADSP
	bool "Mediatek 8195 Audio DSP"
	select SOC_FAMILY_MTK_ADSP
```

## soc/xtensa/nxp_adsp/Kconfig
```kconfig
# NXP i.MX8 SoC family configuration options
#
# Copyright (c) 2021 NXP
# SPDX-License-Identifier: Apache-2.0

config SOC_FAMILY_NXP_ADSP
	bool
	select ARCH_HAS_COHERENCE
	select CPU_HAS_DCACHE

if SOC_FAMILY_NXP_ADSP

config SOC_FAMILY
	string
	default "nxp_adsp"

# Select SoC Part No. and configuration options
source "soc/xtensa/nxp_adsp/*/Kconfig.soc"

endif # SOC_FAMILY_NXP_ADSP
```

## soc/xtensa/nxp_adsp/Kconfig.defconfig
```kconfig
# NXP i.MX8/RT SoC family default configuration options
#
# Copyright (c) 2021 NXP
# SPDX-License-Identifier: Apache-2.0

if SOC_FAMILY_NXP_ADSP

source "soc/xtensa/nxp_adsp/*/Kconfig.defconfig.series"

config CACHE_MANAGEMENT
	default y

config SMP
	default n

config XTENSA_TIMER
	default y

config KERNEL_ENTRY
	default "__start"

config MULTI_LEVEL_INTERRUPTS
	default n

config 2ND_LEVEL_INTERRUPTS
	default n

# To prevent test uses TEST_LOGGING_MINIMAL
config TEST_LOGGING_DEFAULTS
	default n
	depends on TEST

endif
```

## soc/xtensa/nxp_adsp/Kconfig.soc
```kconfig
# NXP i.MX8 SoC series selection
#
# Copyright (c) 2021 NXP
# SPDX-License-Identifier: Apache-2.0

source "soc/xtensa/nxp_adsp/*/Kconfig.series"
```

## soc/xtensa/nxp_adsp/imx8/Kconfig.defconfig.imx8qm
```kconfig
# Copyright 2023 NXP
# SPDX-License-Identifier: Apache-2.0

if SOC_MIMX8QM_ADSP

config SOC
	default "mimx8qm6"

config SYS_CLOCK_HW_CYCLES_PER_SEC
	default 666000000 if XTENSA_TIMER

endif # SOC_MIMX8QM_ADSP
```

## soc/xtensa/nxp_adsp/imx8/Kconfig.defconfig.imx8qxp
```kconfig
# Copyright 2023 NXP
# SPDX-License-Identifier: Apache-2.0

if SOC_MIMX8QXP_ADSP

config SOC
	default "mimx8qx6"

config SYS_CLOCK_HW_CYCLES_PER_SEC
	default 640000000 if XTENSA_TIMER

endif # SOC_MIMX8QXP_ADSP
```

## soc/xtensa/nxp_adsp/imx8/Kconfig.defconfig.series
```kconfig
# Copyright (c) 2021 NXP
# SPDX-License-Identifier: Apache-2.0

if SOC_SERIES_NXP_IMX8

config SOC_SERIES
	string
	default "imx8"

config SOC_TOOLCHAIN_NAME
	string
	default "nxp_imx_adsp"

config SYS_CLOCK_HW_CYCLES_PER_SEC
	default 666000000 if XTENSA_TIMER

config SYS_CLOCK_TICKS_PER_SEC
	default 50000

config DCACHE_LINE_SIZE
	default 128

config GEN_IRQ_VECTOR_TABLE
	default n

source "soc/xtensa/nxp_adsp/imx8/Kconfig.defconfig.imx8q*"

endif # SOC_SERIES_NXP_IMX8
```

## soc/xtensa/nxp_adsp/imx8/Kconfig.series
```kconfig
# Copyright (c) 2021 NXP
# SPDX-License-Identifier: Apache-2.0

config SOC_SERIES_NXP_IMX8
	bool "NXP i.MX8"
	select SOC_FAMILY_NXP_ADSP
	select XTENSA
	select XTENSA_HAL if "$(ZEPHYR_TOOLCHAIN_VARIANT)" != "xcc"
	select XTENSA_RESET_VECTOR
	select XTENSA_USE_CORE_CRT1
	select ATOMIC_OPERATIONS_BUILTIN
	help
	  NXP i.MX8
```

## soc/xtensa/nxp_adsp/imx8/Kconfig.soc
```kconfig
# Copyright (c) 2021 NXP
# SPDX-License-Identifier: Apache-2.0

choice
	prompt "NXP i.MX SoC Selection"
	depends on SOC_SERIES_NXP_IMX8

	config SOC_MIMX8QM_ADSP
		bool "NXP i.MX8QM Audio DSP"
		depends on SOC_SERIES_NXP_IMX8
		select HAS_MCUX

	config SOC_MIMX8QXP_ADSP
		bool "NXP i.MX8QXP Audio DSP"
		depends on SOC_SERIES_NXP_IMX8
		select HAS_MCUX
endchoice

if SOC_SERIES_NXP_IMX8

config SOC_PART_NUMBER
	string
	default SOC_PART_NUMBER_MIMX8QM_DSP if SOC_MIMX8QM_ADSP
	default SOC_PART_NUMBER_MIMX8QXP_DSP if SOC_MIMX8QXP_ADSP

source "soc/xtensa/nxp_adsp/imx8/Kconfig.soc.imx8q*"

endif # SOC_SERIES_NXP_IMX8
```
