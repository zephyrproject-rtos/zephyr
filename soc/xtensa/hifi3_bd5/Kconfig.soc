## soc/xtensa/hifi3_bd5/Kconfig.soc
```kconfig
# Copyright (c) 2017 Intel Corporation
# SPDX-License-Identifier: Apache-2.0

config SOC_HIFI3_BD5
	bool "hifi3_bd5 core"
```

## soc/xtensa/hifi3_bd5_call0/Kconfig.defconfig
```kconfig
# Kconfig - XTENSA board configuration
#
# Copyright (c) 2016 Open-RnD Sp. z o.o.
# Copyright (c) 2016 Cadence Design Systems, Inc.
# SPDX-License-Identifier: Apache-2.0

if SOC_HIFI3_BD5_CALL0

config SOC
	string
	default "hifi3_bd5_call0"

config IRQ_OFFLOAD_INTNUM
	default 13

endif
```

## soc/xtensa/hifi3_bd5_call0/Kconfig.soc
```kconfig
# Copyright (c) 2017 Intel Corporation
# SPDX-License-Identifier: Apache-2.0

config SOC_HIFI3_BD5_CALL0
	bool "hifi3_bd5_call0 (hifi3_bd5 core with call0 ABI and 3 additional SW IRQs)"
```

## soc/xtensa/hifi4_bd7/Kconfig.soc
```kconfig
# Copyright (c) 2017 Intel Corporation
# SPDX-License-Identifier: Apache-2.0

config SOC_HIFI4_BD7
	bool "hifi4_bd7 core"
```

## soc/xtensa/intel_adsp/Kconfig
```kconfig
# Intel CAVS SoC family configuration options
#
# Copyright (c) 2020 Intel Corporation
# SPDX-License-Identifier: Apache-2.0

config SOC_FAMILY_INTEL_ADSP
	select WINSTREAM
	select ARCH_SUPPORTS_COREDUMP
	select CPU_HAS_DCACHE
	bool

if SOC_FAMILY_INTEL_ADSP

config SOC_FAMILY
	string
	default "intel_adsp"

# Select SoC Part No. and configuration options
source "soc/xtensa/intel_adsp/*/Kconfig.soc"

DT_COMPAT_INTEL_ADSP_HOST_IPC := intel,adsp-host-ipc
DT_COMPAT_INTEL_ADSP_IDC := intel,adsp-idc

config INTEL_ADSP_IPC
	bool "Driver for the host IPC interrupt delivery"
	default $(dt_compat_enabled,$(DT_COMPAT_INTEL_ADSP_HOST_IPC)) if !SOF
	default $(dt_compat_enabled,$(DT_COMPAT_INTEL_ADSP_IDC)) if !SOF
	help
	  Driver for the host IPC interrupt delivery mechanism.
	  Currently SOF has its own driver for this hardware.

config MEMORY_WIN_0_SIZE
	int "Size of memory window 0"
	default 8192
	help
	  Size of memory window 0.

	  This window is used for firmware status & outbox/uplink mbox.

config MEMORY_WIN_1_SIZE
	int "Size of memory window 1"
	default 8192
	help
	  Size of memory window 1.

	  This window is used for inbox/downlink mbox.

config MEMORY_WIN_2_SIZE
	int "Size of memory window 2"
	default 8192
	help
	  Size of memory window 2.

	  This window is used for debug.

config MEMORY_WIN_3_SIZE
	int "Size of memory window 3"
	default 8192
	help
	  Size of memory window 3.

	  This window is used for trace.

config ADSP_CLOCK
	bool
	help
	  Driver for the CAVS clocks. Allow type of clock (and
	  thus frequency) to be chosen.

config HP_SRAM_RESERVE
	int "Bytes to reserve at start of HP-SRAM"
	default 65536
	help
	  Bytes to reserve at the start of HP-SRAM.  Zephyr will not
	  place any symbols here, though the host windows have
	  addresses here.  The SOF application also makes direct use
	  of this region, so be very careful changing this value.

config ADSP_TRACE_SIMCALL
	bool "Emit SIMCALL output in addition to window tracing"
	help
	  When true, the trace_out layer will also use a SIMCALL
	  instruction to emit the passed data to the standard output
	  of an enclosing simulator process.  All window contents will
	  remain identical.

config ADSP_NEED_POWER_ON_CACHE
	bool
	help
	  Need to power cache SRAM banks on.

config ADSP_INIT_HPSRAM
	bool
	default y
	help
	  Need to init HP SRAM.

config ADSP_DISABLE_L2CACHE_AT_BOOT
	bool

config ADSP_IMR_CONTEXT_SAVE
	bool "Saves FW context into IMR before core is shut down"
	default n
	help
	  When true, FW will store its entire context into IMR before
	  entering D3 state. Later this context can be used to FW restore
	  when Host power up DSP again.

endif # SOC_FAMILY_INTEL_ADSP
```

## soc/xtensa/intel_adsp/Kconfig.defconfig
```kconfig
# Intel CAVS SoC family default configuration options
#
# Copyright (c) 2020 Intel Corporation
# SPDX-License-Identifier: Apache-2.0

if SOC_FAMILY_INTEL_ADSP
source "soc/xtensa/intel_adsp/*/Kconfig.defconfig.series"


config XTENSA_RPO_CACHE
	def_bool y

# console can't handle the amount of data coming from many tests, so introduce
# a delay beween testcases.
if ZTEST
config ZTEST_TEST_DELAY_MS
	default 100
endif

if XTENSA_RPO_CACHE
config XTENSA_CACHED_REGION
	default 5

config XTENSA_UNCACHED_REGION
	default 4

endif # XTENSA_RPO_CACHE

config CONSOLE
	def_bool y

if CONSOLE
config WINSTREAM_CONSOLE
	def_bool y
endif

config CACHE_MANAGEMENT
	def_bool y

choice CACHE_TYPE
	default ARCH_CACHE
endchoice

endif # SOC_FAMILY_INTEL_ADSP
```

## soc/xtensa/intel_adsp/Kconfig.soc
```kconfig
# Intel CAVS SoC series selection
#
# Copyright (c) 2020 Intel Corporation
# SPDX-License-Identifier: Apache-2.0

source "soc/xtensa/intel_adsp/*/Kconfig.series"
```

## soc/xtensa/intel_adsp/ace/Kconfig.defconfig.ace15_mtpm
```kconfig
# Copyright (c) 2022 Intel Corporation
# SPDX-License-Identifier: Apache-2.0


if SOC_INTEL_ACE15_MTPM

config SOC
	string
	default "intel_ace15_mtpm"

config MP_NUM_CPUS
	default 3

endif
```

## soc/xtensa/intel_adsp/ace/Kconfig.defconfig.series
```kconfig
# Copyright (c) 2022 Intel Corporation
# SPDX-License-Identifier: Apache-2.0

if SOC_SERIES_INTEL_ACE

config SOC_SERIES
	string
	default "ace"

config SOC_TOOLCHAIN_NAME
	string
	default "intel_ace15_mtpm"

config SMP
	default y

# MTL leaves the upper mapping in the same spot as cAVS, but moves the
# lower one inexplicably.
config XTENSA_UNCACHED_REGION
	default 2

# Parameters for gen_isr_tables.py:

config LVL_2_INTR_00_OFFSET
	default 4

config MULTI_LEVEL_INTERRUPTS
	default y

config MAX_IRQ_PER_AGGREGATOR
	default 29

config NUM_LEVEL_2_AGGREGATORS
	default 1

config LVL_2_ISR_TBL_OFFSET
	default 9

config LEVEL_2_INTERRUPTS
	default y

config XTENSA_TIMER
	default n

config XTENSA_TIMER_ID
	default 0

config SYS_CLOCK_HW_CYCLES_PER_SEC
	default 393216000 if XTENSA_TIMER
	default 38400000 if INTEL_ADSP_TIMER

config SYS_CLOCK_TICKS_PER_SEC
	default 12000

config XTENSA_CCOUNT_HZ
	default 393216000

config DYNAMIC_INTERRUPTS
	default y

if LOG

config LOG_BACKEND_ADSP
	default y

endif # LOG

source "soc/xtensa/intel_adsp/ace/Kconfig.defconfig.ace*"

endif # SOC_SERIES_INTEL_ACE
```

## soc/xtensa/intel_adsp/ace/Kconfig.series
```kconfig
# Copyright (c) 2022 Intel Corporation
# SPDX-License-Identifier: Apache-2.0

config SOC_SERIES_INTEL_ACE
	bool "Intel ACE"
	select SOC_FAMILY_INTEL_ADSP
	select XTENSA
	select XTENSA_HAL if ! XTENSA_TOOLCHAIN_HAS_HIFI
	select XTENSA_ARCH_HAS_HIFI3 if XTENSA_TOOLCHAIN_HAS_HIFI
	select XTENSA_ARCH_HAS_HIFI4 if XTENSA_TOOLCHAIN_HAS_HIFI
	select ATOMIC_OPERATIONS_BUILTIN if "$(ZEPHYR_TOOLCHAIN_VARIANT)" != "xcc"
	select ARCH_HAS_COHERENCE
	select SCHED_IPI_SUPPORTED
	select DW_ICTL_ACE
	select SOC_HAS_RUNTIME_NUM_CPUS
	select HAS_PM
	help
	  Intel ADSP ACE
```

## soc/xtensa/intel_adsp/ace/Kconfig.soc
```kconfig
# Copyright (c) 2022 Intel Corporation
# SPDX-License-Identifier: Apache-2.0

choice
	prompt "Intel ADSP SoC Selection"

	config SOC_INTEL_ACE15_MTPM
		bool "ACE 1.5 Meteor PCH M"
		depends on SOC_SERIES_INTEL_ACE

endchoice

config SOC_INTEL_COMM_WIDGET
	bool "Intel Communication Widget driver"
	default y
	depends on DT_HAS_INTEL_ADSP_COMMUNICATION_WIDGET_ENABLED
	help
	  Select this to enable Intel Communication Widget driver.
	  DSP Communication Widget is a device for generic sideband message transmit/receive.
```

## soc/xtensa/intel_adsp/ace_v1x/Kconfig.series
```kconfig
# Copyright (c) 2022 Intel Corporation
# SPDX-License-Identifier: Apache-2.0

config SOC_SERIES_INTEL_ACE1X
	bool "Intel ACE 1.x"
	select SOC_FAMILY_INTEL_ADSP
	select XTENSA
	select XTENSA_HAL if "$(ZEPHYR_TOOLCHAIN_VARIANT)" != "xcc"
	select ATOMIC_OPERATIONS_BUILTIN if "$(ZEPHYR_TOOLCHAIN_VARIANT)" != "xcc"
	select ARCH_HAS_COHERENCE
	select SCHED_IPI_SUPPORTED
	select DW_ICTL_ACE_V1X
	help
	  Intel ACE 1.x
```

## soc/xtensa/intel_adsp/ace_v1x/Kconfig.soc
```kconfig
# Copyright (c) 2022 Intel Corporation
# SPDX-License-Identifier: Apache-2.0

choice
	prompt "Intel ADSP SoC Selection"

	config SOC_INTEL_ACE15_MTPM
		bool "ACE 1.5 Meteor PCH M"
		depends on SOC_SERIES_INTEL_ACE1X

endchoice
```

## soc/xtensa/intel_adsp/baytrail_adsp/Kconfig.defconfig.series
```kconfig
# Copyright (c) 2020 Intel Corporation
# SPDX-License-Identifier: Apache-2.0

if SOC_SERIES_INTEL_ADSP_BAYTRAIL

config SOC_SERIES
	string
	default "baytrail_adsp"

config SOC
	string
	default "intel_byt_adsp"

config SYS_CLOCK_TICKS_PER_SEC
	default 50000

config IRQ_OFFLOAD_INTNUM
	default 0

# This series does not have MISC0.
# Since EXCSAVE7 is unused by Zephyr, use it instead.
config XTENSA_KERNEL_CPU_PTR_SR
	default "EXCSAVE7"

config KERNEL_ENTRY
	default "_MainEntry"

config MULTI_LEVEL_INTERRUPTS
	default y

config 2ND_LEVEL_INTERRUPTS
	default y

config DYNAMIC_INTERRUPTS
	default y

endif # SOC_SERIES_INTEL_ADSP_BAYTRAIL
```

## soc/xtensa/intel_adsp/baytrail_adsp/Kconfig.series
```kconfig
# Copyright (c) 2020 Intel Corporation
# SPDX-License-Identifier: Apache-2.0

config SOC_SERIES_INTEL_ADSP_BAYTRAIL
	bool "Intel Baytrail ADSP"
	select SOC_FAMILY_INTEL_ADSP
	select XTENSA
	select XTENSA_HAL if "$(ZEPHYR_TOOLCHAIN_VARIANT)" != "xcc"
	select XTENSA_RESET_VECTOR
	select XTENSA_USE_CORE_CRT1
	help
	  Intel Baytrail Audio DSP
```

## soc/xtensa/intel_adsp/baytrail_adsp/Kconfig.soc
```kconfig
# Copyright (c) 2020 Intel Corporation
# SPDX-License-Identifier: Apache-2.0

config SOC_INTEL_BAYTRAIL_ADSP
	bool "Intel Baytrail Audio DSP"
	depends on SOC_SERIES_INTEL_ADSP_BAYTRAIL
	default y if SOC_SERIES_INTEL_ADSP_BAYTRAIL
```

## soc/xtensa/intel_adsp/broadwell_adsp/Kconfig.soc
```kconfig
# Copyright (c) 2020 Intel Corporation
# SPDX-License-Identifier: Apache-2.0

config SOC_INTEL_BROADWELL_ADSP
	bool "Intel Broadwell Audio DSP"
	depends on SOC_SERIES_INTEL_ADSP_BROADWELL
	default y if SOC_SERIES_INTEL_ADSP_BROADWELL
```

## soc/xtensa/intel_adsp/cavs/Kconfig.defconfig.cavs_v15
```kconfig
# Copyright (c) 2020 Intel Corporation
# SPDX-License-Identifier: Apache-2.0

if SOC_INTEL_CAVS_V15

config SOC_TOOLCHAIN_NAME
	string
	default "intel_apl_adsp"

config SOC
	default "intel_apl_adsp"

# For backward compatibility, to be removed
config SOC_SERIES_INTEL_CAVS_V15
	def_bool y

config HP_SRAM_RESERVE
	default 32768

config MP_MAX_NUM_CPUS
	default 2

config SCHED_IPI_SUPPORTED
	default y

config SYS_CLOCK_HW_CYCLES_PER_SEC
	default 400000000 if XTENSA_TIMER
	default 19200000 if INTEL_ADSP_TIMER

if DAI_INTEL_SSP

config DAI_SSP_CLK_FORCE_DYNAMIC_CLOCK_GATING
	default y

config DAI_INTEL_SSP_NUM_BASE
	default 4

config DAI_INTEL_SSP_NUM_EXT
	default 2

endif # DAI_INTEL_SSP

config ADSP_INIT_HPSRAM
	default n

config ADSP_DISABLE_L2CACHE_AT_BOOT
	default y
endif
```

## soc/xtensa/intel_adsp/cavs/Kconfig.defconfig.cavs_v18
```kconfig
# Copyright (c) 2020 Intel Corporation
# SPDX-License-Identifier: Apache-2.0

if SOC_INTEL_CAVS_V18


config SOC_TOOLCHAIN_NAME
	string
	default "intel_s1000"

config SOC
	string
	default "intel_cnl_adsp"

# For backward compatibility, to be removed
config SOC_SERIES_INTEL_CAVS_V18
	def_bool y

# FIXME: these DSPs can have more cores, but Zephyr only supports up to 2 cores on them
config MP_NUM_CPUS
	default 2

config SCHED_IPI_SUPPORTED
	default y

config SYS_CLOCK_HW_CYCLES_PER_SEC
	default 400000000 if XTENSA_TIMER
	default 24000000 if INTEL_ADSP_TIMER

endif # SOC_INTEL_CAVS_V18
```

## soc/xtensa/intel_adsp/cavs/Kconfig.defconfig.cavs_v20
```kconfig
# Copyright (c) 2020,2022 Intel Corporation
# SPDX-License-Identifier: Apache-2.0

if SOC_INTEL_CAVS_V20

config SOC_TOOLCHAIN_NAME
	string
	default "intel_s1000"

config SOC
	string
	default "intel_icl_adsp"

# For backward compatibility, to be removed
config SOC_SERIES_INTEL_CAVS_V20
	def_bool y

# FIXME: these DSPs can have more cores, but Zephyr only supports up to 2 cores on them
config MP_MAX_NUM_CPUS
	default 2

config SCHED_IPI_SUPPORTED
	default y

config SYS_CLOCK_HW_CYCLES_PER_SEC
	default 400000000 if XTENSA_TIMER
	default 38400000 if INTEL_ADSP_TIMER

endif # SOC_INTEL_CAVS_V20
```

## soc/xtensa/intel_adsp/cavs/Kconfig.defconfig.series
```kconfig
# Copyright (c) 2020 Intel Corporation
# SPDX-License-Identifier: Apache-2.0

if SOC_SERIES_INTEL_ADSP_CAVS

config SOC_SERIES
	string
	default "cavs"

config INTEL_ADSP_CAVS
	def_bool y

source "soc/xtensa/intel_adsp/cavs/Kconfig.defconfig.cavs*"

config DMA_INTEL_ADSP_GPDMA
	default y
	depends on DMA

config XTENSA_CCOUNT_HZ
	default 400000000 if SOC_INTEL_CAVS_V25
	default 200000000

endif # SOC_SERIES_INTEL_ADSP_CAVS
```

## soc/xtensa/intel_adsp/cavs/Kconfig.series
```kconfig
# Copyright (c) 2017,2022 Intel Corporation
# SPDX-License-Identifier: Apache-2.0

config SOC_SERIES_INTEL_ADSP_CAVS
	bool "Intel CAVS"
	select SOC_FAMILY_INTEL_ADSP
	select XTENSA
	select XTENSA_HAL if ("$(ZEPHYR_TOOLCHAIN_VARIANT)" != "xcc" && ("$(ZEPHYR_TOOLCHAIN_VARIANT)" != "xt-clang"))
	select XTENSA_RESET_VECTOR
	select XTENSA_USE_CORE_CRT1
	select ATOMIC_OPERATIONS_BUILTIN if "$(ZEPHYR_TOOLCHAIN_VARIANT)" != "xcc"
	select ARCH_HAS_COHERENCE
	help
	  Intel ADSP CAVS
```

## soc/xtensa/intel_adsp/cavs/Kconfig.soc
```kconfig
# Copyright (c) 2020 Intel Corporation
# SPDX-License-Identifier: Apache-2.0

config SOC_INTEL_CAVS_V15
	bool
	help
	  Intel Apollo Lake

config SOC_INTEL_CAVS_V18
	bool
	select XTENSA_WAITI_BUG
	help
	  Intel Cannon Lake

config SOC_INTEL_CAVS_V20
	bool
	select XTENSA_WAITI_BUG
	help
	  Intel Ice Lake

config SOC_INTEL_CAVS_V25
	bool
	select XTENSA_WAITI_BUG
	select SCHED_IPI_SUPPORTED
	help
	  Intel Tiger Lake
```

## soc/xtensa/intel_adsp/cavs_v15/Kconfig.defconfig.series
```kconfig
# Copyright (c) 2020 Intel Corporation
# SPDX-License-Identifier: Apache-2.0

if SOC_SERIES_INTEL_CAVS_V15

config SOC_SERIES
	string
	default "cavs_v15"

config SOC_TOOLCHAIN_NAME
	string
	default "intel_apl_adsp"

config SOC
	string
	default "intel_apl_adsp" if SOC_INTEL_CAVS_V15

config HP_SRAM_RESERVE
	default 32768

config ADSP_WIN0_OFFSET
	default 24576

config ADSP_WIN3_OFFSET
	default 0

config SMP
	default y

config MP_NUM_CPUS
	default 2

config SCHED_IPI_SUPPORTED
	default y

config XTENSA_TIMER
	default n

config INTEL_ADSP_TIMER
	default y

config SYS_CLOCK_HW_CYCLES_PER_SEC
	default 400000000 if XTENSA_TIMER
	default 19200000 if INTEL_ADSP_TIMER

config SYS_CLOCK_TICKS_PER_SEC
	default 50000

config KERNEL_ENTRY
	default "_MainEntry"

config MULTI_LEVEL_INTERRUPTS
	default y

config 2ND_LEVEL_INTERRUPTS
	default y

config DYNAMIC_INTERRUPTS
	default y

if LOG

config LOG_BACKEND_ADSP
	default y

endif # LOG

endif # SOC_SERIES_INTEL_CAVS_V15
```

## soc/xtensa/intel_adsp/cavs_v15/Kconfig.soc
```kconfig
# Copyright (c) 2020 Intel Corporation
# SPDX-License-Identifier: Apache-2.0

choice
	prompt "Intel CAVS SoC Selection"

	config SOC_INTEL_CAVS_V15
		bool "Apollo Lake"
		depends on SOC_SERIES_INTEL_CAVS_V15

endchoice
```
