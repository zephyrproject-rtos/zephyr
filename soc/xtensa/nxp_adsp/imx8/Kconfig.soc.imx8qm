## soc/xuantie/xiaohui/c9xx/Kconfig.soc
```kconfig
# Copyright (c) 2024 Antmicro <www.antmicro.com>
# SPDX-License-Identifier: Apache-2.0

config SOC_SERIES
	default "c9xx" if SOC_SERIES_XIAOHUI_C9XX

config SOC
	default "c906"      if CPU_XUANTIE_C906
	default "c906fd"    if CPU_XUANTIE_C906FD
	default "c906fdv"   if CPU_XUANTIE_C906FDV

	default "c907"      if CPU_XUANTIE_C907
	default "c907fd"    if CPU_XUANTIE_C907FD
	default "c907fdv"   if CPU_XUANTIE_C907FDV
	default "c907fdvm"  if CPU_XUANTIE_C907FDVM

	default "c907-rv32"     if CPU_XUANTIE_C907_RV32
	default "c907fd-rv32"   if CPU_XUANTIE_C907FD_RV32
	default "c907fdv-rv32"  if CPU_XUANTIE_C907FDV_RV32
	default "c907fdvm-rv32" if CPU_XUANTIE_C907FDVM_RV32

	default "c908"      if CPU_XUANTIE_C908
	default "c908i"     if CPU_XUANTIE_C908I
	default "c908v"     if CPU_XUANTIE_C908V

	default "c910"      if CPU_XUANTIE_C910
	default "c910v2"    if CPU_XUANTIE_C910V2
	default "c910v3"    if CPU_XUANTIE_C910V3
	default "c910v3_cp" if CPU_XUANTIE_C910V3_CP

	default "c920"      if CPU_XUANTIE_C920
	default "c920v2"    if CPU_XUANTIE_C920V2
	default "c920v3"    if CPU_XUANTIE_C920V3
	default "c920v3_cp" if CPU_XUANTIE_C920V3_CP



config SOC_SERIES_XIAOHUI_C9XX
	bool "xiaohui(FPGA) c9xx"

config CPU_XUANTIE_C906
	bool "xuantie CPU c906 (I,M,A,C)"

config CPU_XUANTIE_C906FD
	bool "xuantie CPU c906fdv (I,M,A,F,D,C)"

config CPU_XUANTIE_C906FDV
	bool "xuantie CPU c906fdv (I,M,A,F,D,C,V)"

config CPU_XUANTIE_C907
	bool "xuantie CPU c907 (I,M,A,C)"

config CPU_XUANTIE_C907FD
	bool "xuantie CPU c907fd (I,M,A,F,D,C)"

config CPU_XUANTIE_C907FDV
	bool "xuantie CPU c907fdv (I,M,A,F,D,C,V)"

config CPU_XUANTIE_C907FDVM
	bool "xuantie CPU c907fdvm (I,M,A,F,D,C,V)"

config CPU_XUANTIE_C907_RV32
	bool "xuantie CPU c907-rv32 (I,M,A,C)"

config CPU_XUANTIE_C907FD_RV32
	bool "xuantie CPU c907fd-rv32 (I,M,A,F,D,C)"

config CPU_XUANTIE_C907FDV_RV32
	bool "xuantie CPU c907fdv-rv32 (I,M,A,F,D,C,V)"

config CPU_XUANTIE_C907FDVM_RV32
	bool "xuantie CPU c907fdvm-rv32 (I,M,A,F,D,C,V)"

config CPU_XUANTIE_C908
	bool "xuantie CPU c908 (I,M,A,F,D,C)"

config CPU_XUANTIE_C908I
	bool "xuantie CPU c908i (I,M,A,C)"

config CPU_XUANTIE_C908V
	bool "xuantie CPU c908v (I,M,A,F,D,C,V)"

config CPU_XUANTIE_C910
	bool "xuantie CPU c910 (I,M,A,C,F,D)"

config CPU_XUANTIE_C910V2
	bool "xuantie CPU c910v2 (I,M,A,C,F,D)"

config CPU_XUANTIE_C910V3
	bool "xuantie CPU c910v3 (I,M,A,C,F,D)"

config CPU_XUANTIE_C910V3_CP
	bool "xuantie CPU c910v3cp (I,M,A,C,F,D)"

config CPU_XUANTIE_C920
	bool "xuantie CPU c920 (I,M,A,C,F,D)"

config CPU_XUANTIE_C920V2
	bool "xuantie CPU c920v2 (I,M,A,C,F,D)"

config CPU_XUANTIE_C920V3
	bool "xuantie CPU c920v3 (I,M,A,C,F,D)"

config CPU_XUANTIE_C920V3_CP
	bool "xuantie CPU c920v3_cp (I,M,A,C,F,D)"
```

## soc/xuantie/xiaohui/r9xx/Kconfig
```kconfig
# riscv SOC family supporting the riscv privileged architecture spec

# Copyright (c) 2017 Jean-Paul Etienne <fractalclone@gmail.com>
# Copyright (C) 2017-2024 Alibaba Group Holding Limited
# SPDX-License-Identifier: Apache-2.0


config CPU_XUANTIE_R908FDV
	bool "xuantie CPU r908fdv (I,M,A,C,F,D,V)"
	select 64BIT
	select RISCV_ISA_RV64I
	select RISCV_ISA_EXT_M
	select RISCV_ISA_EXT_A
	select RISCV_ISA_EXT_C
	select RISCV_ISA_EXT_F
	select RISCV_ISA_EXT_D
	select RISCV_ISA_EXT_V

config CPU_XUANTIE_R908FD
	bool "xuantie CPU r908fd (I,M,A,C,F,D)"
	select 64BIT
	select RISCV_ISA_RV64I
	select RISCV_ISA_EXT_M
	select RISCV_ISA_EXT_A
	select RISCV_ISA_EXT_C
	select RISCV_ISA_EXT_F
	select RISCV_ISA_EXT_D

config CPU_XUANTIE_R908
	bool "xuantie CPU r908 (I,M,A,C)"
	select 64BIT
	select RISCV_ISA_RV64I
	select RISCV_ISA_EXT_M
	select RISCV_ISA_EXT_A
	select RISCV_ISA_EXT_C

config CPU_XUANTIE_R908FDV_CP
	bool "xuantie CPU r908fdv_cp (I,M,A,C,F,D,V)"
	select 64BIT
	select RISCV_ISA_RV64I
	select RISCV_ISA_EXT_M
	select RISCV_ISA_EXT_A
	select RISCV_ISA_EXT_C
	select RISCV_ISA_EXT_F
	select RISCV_ISA_EXT_D
# 	select RISCV_ISA_EXT_V

config CPU_XUANTIE_R908FD_CP
	bool "xuantie CPU r908fd_cp (I,M,A,C,F,D)"
	select 64BIT
	select RISCV_ISA_RV64I
	select RISCV_ISA_EXT_M
	select RISCV_ISA_EXT_A
	select RISCV_ISA_EXT_C
	select RISCV_ISA_EXT_F
	select RISCV_ISA_EXT_D

config CPU_XUANTIE_R908_CP
	bool "xuantie CPU r908 (I,M,A,C)"
	select 64BIT
	select RISCV_ISA_RV64I
	select RISCV_ISA_EXT_M
	select RISCV_ISA_EXT_A
	select RISCV_ISA_EXT_C

config CPU_XUANTIE_R910
	bool "xuantie CPU r910 (I,M,A,C,F,D)"
	select 64BIT
	select RISCV_ISA_RV64I
	select RISCV_ISA_EXT_M
	select RISCV_ISA_EXT_A
	select RISCV_ISA_EXT_C
	select RISCV_ISA_EXT_F
	select RISCV_ISA_EXT_D

config CPU_XUANTIE_R920
	bool "xuantie CPU r920 (I,M,A,C,F,D)"
	select 64BIT
	select RISCV_ISA_RV64I
	select RISCV_ISA_EXT_M
	select RISCV_ISA_EXT_A
	select RISCV_ISA_EXT_C
	select RISCV_ISA_EXT_F
	select RISCV_ISA_EXT_D
```

## submanifests/bsim/west.yml
```yaml
# Copyright 2023 Nordic Semiconductor ASA
# SPDX-License-Identifier: Apache-2.0
#
# west manifest file for BabbleSim
#
# Check https://babblesim.github.io/fetching.html for more information
#

manifest:
  defaults:
    remote: upstream

  remotes:
    - name: upstream
      url-base: https://github.com/BabbleSim

  self:
    path: bsim

  projects:
    - name: babblesim_base
      repo-path: base.git
      path: bsim/components
      revision: 02838ca04c4562e68dc876196828d8121679e537
      groups:
        - babblesim
    - name: babblesim_ext_2G4_libPhyComv1
      repo-path: ext_2G4_libPhyComv1.git
      path: bsim/components/ext_2G4_libPhyComv1
      revision: 9018113a362fa6c9e8f4b9cab9e5a8f12cc46b94
      groups:
        - babblesim
    - name: babblesim_ext_2G4_phy_v1
      repo-path: ext_2G4_phy_v1.git
      path: bsim/components/ext_2G4_phy_v1
      revision: cf2d86e736efac4f12fad5093ed2da2c5b406156
      groups:
        - babblesim
    - name: babblesim_ext_2G4_channel_NtNcable
      repo-path: ext_2G4_channel_NtNcable.git
      path: bsim/components/ext_2G4_channel_NtNcable
      revision: 20a38c997f507b0aa53817aab3d73a462fff7af1
      groups:
        - babblesim
    - name: babblesim_ext_2G4_channel_multiatt
      repo-path: ext_2G4_channel_multiatt.git
      path: bsim/components/ext_2G4_channel_multiatt
      revision: e09bc2d14b1975f969ad19c6ed23eb20e5dc3d09
      groups:
        - babblesim
    - name: babblesim_ext_2G4_modem_magic
      repo-path: ext_2G4_modem_magic.git
      path: bsim/components/ext_2G4_modem_magic
      revision: cb70771794f0bf6f262aa474848611c68ae8f1ed
      groups:
        - babblesim
    - name: babblesim_ext_2G4_modem_BLE_simple
      repo-path: ext_2G4_modem_BLE_simple.git
      path: bsim/components/ext_2G4_modem_BLE_simple
      revision: ce975a3259fd0dd761d371b60435242d54794bad
      groups:
        - babblesim
    - name: babblesim_ext_2G4_device_burst_interferer
      repo-path: ext_2G4_device_burst_interferer.git
      path: bsim/components/ext_2G4_device_burst_interferer
      revision: 5b5339351d6e6a2368c686c734dc8b2fc65698fc
      groups:
        - babblesim
    - name: babblesim_ext_2G4_device_WLAN_actmod
      repo-path: ext_2G4_device_WLAN_actmod.git
      path: bsim/components/ext_2G4_device_WLAN_actmod
      revision: 9cb6d8e72695f6b785e57443f0629a18069d6ce4
      groups:
        - babblesim
    - name: babblesim_ext_2G4_device_playback
      repo-path: ext_2G4_device_playback.git
      path: bsim/components/ext_2G4_device_playback
      revision: 85c645929cf1ce995d8537107d9dcbd12ed64036
      groups:
        - babblesim
    - name: babblesim_ext_libCryptov1
      repo-path: ext_libCryptov1.git
      path: bsim/components/ext_libCryptov1
      revision: eed6d7038e839153e340bd333bc43541cb90ba64
      groups:
        - babblesim
```

## subsys/Kconfig
```kconfig
# Subsystem configuration options

# Copyright (c) 2016-2017 Intel Corporation
# Copyright (c) 2021 Nordic Semiconductor
# SPDX-License-Identifier: Apache-2.0

menu "Subsystems and OS Services"

# zephyr-keep-sorted-start
source "subsys/bindesc/Kconfig"
source "subsys/bluetooth/Kconfig"
source "subsys/canbus/Kconfig"
source "subsys/console/Kconfig"
source "subsys/dap/Kconfig"
source "subsys/debug/Kconfig"
source "subsys/demand_paging/Kconfig"
source "subsys/dfu/Kconfig"
source "subsys/disk/Kconfig"
source "subsys/dsp/Kconfig"
source "subsys/emul/Kconfig"
source "subsys/fb/Kconfig"
source "subsys/fs/Kconfig"
source "subsys/input/Kconfig"
source "subsys/ipc/Kconfig"
source "subsys/jwt/Kconfig"
source "subsys/llext/Kconfig"
source "subsys/logging/Kconfig"
source "subsys/lorawan/Kconfig"
source "subsys/mctp/Kconfig"
source "subsys/mem_mgmt/Kconfig"
source "subsys/mgmt/Kconfig"
source "subsys/modbus/Kconfig"
source "subsys/modem/Kconfig"
source "subsys/net/Kconfig"
source "subsys/pm/Kconfig"
source "subsys/portability/Kconfig"
source "subsys/profiling/Kconfig"
source "subsys/random/Kconfig"
source "subsys/retention/Kconfig"
source "subsys/rtio/Kconfig"
source "subsys/sd/Kconfig"
source "subsys/secure_storage/Kconfig"
source "subsys/sensing/Kconfig"
source "subsys/settings/Kconfig"
source "subsys/shell/Kconfig"
source "subsys/sip_svc/Kconfig"
source "subsys/stats/Kconfig"
source "subsys/storage/Kconfig"
source "subsys/task_wdt/Kconfig"
source "subsys/testsuite/Kconfig"
source "subsys/timing/Kconfig"
source "subsys/tracing/Kconfig"
source "subsys/usb/device/Kconfig"
source "subsys/usb/device_next/Kconfig"
source "subsys/usb/host/Kconfig"
source "subsys/usb/usb_c/Kconfig"
source "subsys/zbus/Kconfig"
# zephyr-keep-sorted-stop

config MODULES
	bool "Make tristate Kconfig options and an 'm' selection available"
	help
	  Zephyr supports dynamically loadable code, e.g. using llext. Code,
	  that can either be built as a part of the system image or as a
	  loadable extension, can use tristate Kconfig options. For this to work
	  the CONFIG_MODULES option must be enabled by the project. Enabling
	  this option alone doesn't change the build on its own, it only allows
	  using 'm' for tristate Kconfig options.

endmenu
```

## subsys/ap_pwrseq/Kconfig
```kconfig
# Copyright (c) 2020 Intel Corporation
# SPDX-License-Identifier: Apache-2.0

config AP_PWRSEQ
	bool "Support for Aplication Processor power sequence"
	select SMF
	select SMF_ANCESTOR_SUPPORT
	select EVENTS
	help
	  Support for AP power sequence subsystem

if AP_PWRSEQ

module = AP_PWRSEQ
module-str = AP power sequencing
source "subsys/logging/Kconfig.template.log_config"

config AP_PWRSEQ_STACK_SIZE
	int "Stack size for AP Power sequence thread"
	default 1024
	help
	  AP Power sequence stack size

config AP_PWRSEQ_THREAD_PRIORITY
	int "AP Power Sequence thread priority"
	default 12
	help
	  This option determines AP power sequence thread priority, this number
	  must be selected in such way thread priority is in the middle of all
	  the enabled threads.

config AP_PWRSEQ_AUTOSTART
	bool "Start thread"
	default y
	help
	  AP Power thread

endif # AP_PWRSEQ
```

## subsys/app_event_manager/Kconfig
```kconfig
#
# Copyright (c) 2021 Nordic Semiconductor
#
# SPDX-License-Identifier: Apache-2.0
#

menuconfig APP_EVENT_MANAGER
	bool
	prompt "Application Event Manager"
	help
	  Enable Application Event Manager.
	  Note that Application Event Manager uses orphan sections to handle its
	  data structures.

if APP_EVENT_MANAGER

config APP_EVENT_MANAGER_SHOW_EVENTS
	bool "Show events"
	depends on LOG
	default y
	help
	  This option controls if events are printed to console.

config APP_EVENT_MANAGER_SHOW_EVENT_HANDLERS
	bool "Show event handlers"
	depends on APP_EVENT_MANAGER_SHOW_EVENTS
	help
	  This option controls if event handlers are printed to console.

config APP_EVENT_MANAGER_TRACE_EVENT_DATA
	bool "Enables tracing information"
	help
	  This option allows to gather information about events for tracing purposes.

module = APP_EVENT_MANAGER
module-str = Application Event Manager
source "${ZEPHYR_BASE}/subsys/logging/Kconfig.template.log_config"

config APP_EVENT_MANAGER_EVENT_LOG_BUF_LEN
	int "Length of buffer for processing event message"
	depends on APP_EVENT_MANAGER_USE_DEPRECATED_LOG_FUN
	default 128
	range 2 1024
	help
	  This option is only needed for deprecated event logging approach.

config APP_EVENT_MANAGER_USE_DEPRECATED_LOG_FUN
	bool "Allow using both logging functions current and deprecated one."
	help
	  This option is only needed for deprecated event logging approach.

config APP_EVENT_MANAGER_LOG_EVENT_TYPE
	bool "Include event type in the event log output"
	default y

config APP_EVENT_MANAGER_MAX_EVENT_CNT
	int "Maximum number of event types"
	default 32
	help
	  Maximum number of declared event types in Application Event Manager.

config APP_EVENT_MANAGER_PROVIDE_EVENT_SIZE
	bool "Provide information about the event size"
	help
	  This option enables the information about event size.
	  This would require to store more information with event type
	  and should be enabled only if such an information is required.

config APP_EVENT_MANAGER_POSTINIT_HOOK
	bool "Enable postinit hook"
	help
	  Enable postinit hooks support.
	  This option is here for optimisation purposes.
	  When postinit hook is not in use the related code may be removed.

config APP_EVENT_MANAGER_SUBMIT_HOOKS
	bool "Enable event submit hooks"
	help
	  Enable event submit hooks support.
	  This option is here for optimisation purposes.
	  When submit hook is not in use the related code may be removed.

config APP_EVENT_MANAGER_PREPROCESS_HOOKS
	bool "Enable event preprocess hooks"
	help
	  Enable event preprocess hooks support.
	  This option is here for optimisation purposes.
	  When preprocess hook is not in use the related code may be removed.

config APP_EVENT_MANAGER_POSTPROCESS_HOOKS
	bool "Enable event postprocess hooks"
	help
	  Enable event postprocess hooks support.
	  This option is here for optimisation purposes.
	  When postprocess hook is not in use the related code may be removed.

endif # APP_EVENT_MANAGER
```

## subsys/app_memory/Kconfig
```kconfig
menu "General Kernel Options"

config APP_SHARED_MEM
	bool "Application shared memory with app_memory"
	help
	  This is a wrapper around app_memory to simplify usage.

endmenu
```

## subsys/authentication/Kconfig
```kconfig
# Copyright (c) 2026 Siratul Islam <email@sirat.me>
# SPDX-License-Identifier: Apache-2.0

menu "Authentication"

source "subsys/authentication/fido2/Kconfig"

endmenu
```
