## soc/xtensa/nxp_adsp/imx8/Kconfig.soc.imx8qm
```kconfig
# Copyright 2023 NXP
# SPDX-License-Identifier: Apache-2.0

if SOC_MIMX8QM_ADSP

config SOC_PART_NUMBER_MIMX8QM6AVUFF
	bool

config SOC_PART_NUMBER_MIMX8QM_DSP
	string
	default "MIMX8QM6AVUFF_dsp" if SOC_PART_NUMBER_MIMX8QM6AVUFF
	help
		This string holds the full part number of the SoC. It is a hidden
		option that you should not set directly. The part number selection
		choice defines the default value for this string.

endif # SOC_MIMX8QM_ADSP
```

## soc/xtensa/nxp_adsp/imx8/Kconfig.soc.imx8qxp
```kconfig
# Copyright 2023 NXP
# SPDX-License-Identifier: Apache-2.0

if SOC_MIMX8QXP_ADSP

config SOC_PART_NUMBER_MIMX8QX6AVLFZ
	bool

config SOC_PART_NUMBER_MIMX8QX6CVLDZ
	bool

config SOC_PART_NUMBER_MIMX8QXP_DSP
	string
	default "MIMX8QX6AVLFZ_dsp" if SOC_PART_NUMBER_MIMX8QX6AVLFZ
	default "MIMX8QX6CVLDZ_dsp" if SOC_PART_NUMBER_MIMX8QX6CVLDZ
	help
		This string holds the full part number of the SoC. It is a hidden
		option that you should not set directly. The part number selection
		choice defines the default value for this string.

endif # SOC_MIMX8QXP_ADSP
```

## soc/xtensa/nxp_adsp/imx8m/Kconfig.defconfig.series
```kconfig
# Copyright (c) 2021 NXP
# SPDX-License-Identifier: Apache-2.0

if SOC_SERIES_NXP_IMX8M

config SOC_SERIES
	string
	default "imx8m"

config SOC_TOOLCHAIN_NAME
	string
	default "nxp_imx8m_adsp"

config SOC
	string
	default "nxp_imx8m"

config SMP
	default n

config XTENSA_TIMER
	default y

config SYS_CLOCK_HW_CYCLES_PER_SEC
	default 800000000 if XTENSA_TIMER

config SYS_CLOCK_TICKS_PER_SEC
	default 50000

config KERNEL_ENTRY
	default "__start"

config MULTI_LEVEL_INTERRUPTS
	default n

config 2ND_LEVEL_INTERRUPTS
	default n

config DYNAMIC_INTERRUPTS
	default y

config LOG
	default y

# To prevent test uses TEST_LOGGING_MINIMAL
config TEST_LOGGING_DEFAULTS
	default n
	depends on TEST

endif # SOC_SERIES_NXP_IMX8M
```

## soc/xtensa/nxp_adsp/imx8m/Kconfig.series
```kconfig
# Copyright (c) 2021 NXP
# SPDX-License-Identifier: Apache-2.0

config SOC_SERIES_NXP_IMX8M
	bool "NXP i.MX8M Audio DSP Series"
	select SOC_FAMILY_NXP_ADSP
	select XTENSA
	select XTENSA_HAL if ("$(ZEPHYR_TOOLCHAIN_VARIANT)" != "xcc" && "$(ZEPHYR_TOOLCHAIN_VARIANT)" != "xt-clang")
	select XTENSA_RESET_VECTOR
	select XTENSA_USE_CORE_CRT1
	select ATOMIC_OPERATIONS_BUILTIN
	help
	  Enable support for NXP i.MX8M Audio DSP
```

## soc/xtensa/nxp_adsp/imx8m/Kconfig.soc
```kconfig
# Copyright (c) 2021 NXP
# SPDX-License-Identifier: Apache-2.0

choice
	prompt "NXP i.MX8M Audio DSP Selection"
	depends on SOC_SERIES_NXP_IMX8M

	config SOC_MIMX8M_ADSP
		bool "NXP i.MX8MP Audio DSP"

endchoice

if SOC_SERIES_NXP_IMX8M

config SOC_PART_NUMBER_MIMX8ML8DVNLZ
	bool

config SOC_PART_NUMBER_MIMX8ML8CVNKZ
	bool

config SOC_PART_NUMBER_MIMX8MP_DSP
	string
	default "MIMX8ML8DVNLZ_dsp" if  SOC_PART_NUMBER_MIMX8ML8DVNLZ
	default "MIMX8ML8CVNKZ_dsp" if  SOC_PART_NUMBER_MIMX8ML8CVNKZ
	help
	  This string holds the full part number of the SoC. It is a hidden option
	  that you should not set directly. The part number selection choice defines
	  the default value for this string.

config SOC_PART_NUMBER
	string
	default SOC_PART_NUMBER_MIMX8MP_DSP if SOC_MIMX8M_ADSP

endif # SOC_SERIES_NXP_IMX8M
```

## soc/xtensa/nxp_adsp/imx8ulp/Kconfig.soc
```kconfig
# Copyright (c) 2023 NXP
# SPDX-License-Identifier: Apache-2.0

choice
	prompt "NXP i.MX8ULP Audio DSP Selection"
	depends on SOC_SERIES_NXP_IMX8ULP

	config SOC_NXP_IMX8ULP
		bool "NXP i.MX8ULP Audio DSP"

endchoice
```

## soc/xtensa/nxp_adsp/rt5xx/Kconfig.series
```kconfig
# Copyright (c) 2023 Google LLC.
# SPDX-License-Identifier: Apache-2.0

config SOC_SERIES_NXP_RT5XX
	bool "NXP RT5xx Series"
	select SOC_FAMILY_NXP_ADSP
	select XTENSA
	select XTENSA_HAL if ("$(ZEPHYR_TOOLCHAIN_VARIANT)" != "xcc" && "$(ZEPHYR_TOOLCHAIN_VARIANT)" != "xt-clang")
	select XTENSA_RESET_VECTOR
	select XTENSA_USE_CORE_CRT1
	help
	  NXP RT5xx ADSP Series
```

## soc/xtensa/nxp_adsp/rt6xx/Kconfig.defconfig.series
```kconfig
# Copyright (c) 2023 Google LLC.
# Copyright (c) 2023 NXP
# SPDX-License-Identifier: Apache-2.0

if SOC_SERIES_NXP_RT6XX

config SOC_SERIES
	string
	default "rt6xx"

config SOC_TOOLCHAIN_NAME
	string
	default "nxp_rt600_adsp"

config SOC
	string
	default "mimxrt685s"

config SOC_PART_NUMBER
	string
	default "MIMXRT685SFVKB_dsp" if SOC_NXP_RT685

config SYS_CLOCK_HW_CYCLES_PER_SEC
	default 198000000

config SYS_CLOCK_TICKS_PER_SEC
	default 1000

config CACHE
	default n

config DCACHE
	default n

config CACHE_MANAGEMENT
	default n

config LOG
	default n

endif # SOC_SERIES_NXP_RT6XX
```

## soc/xtensa/nxp_adsp/rt6xx/Kconfig.series
```kconfig
# Copyright (c) 2023 Google LLC.
# Copyright (c) 2023 NXP
# SPDX-License-Identifier: Apache-2.0

config SOC_SERIES_NXP_RT6XX
	bool "NXP RT6xx Series"
	select SOC_FAMILY_NXP_ADSP
	select XTENSA
	select XTENSA_HAL if ("$(ZEPHYR_TOOLCHAIN_VARIANT)" != "xcc" && "$(ZEPHYR_TOOLCHAIN_VARIANT)" != "xt-clang")
	select XTENSA_RESET_VECTOR
	select XTENSA_USE_CORE_CRT1
	select CLOCK_CONTROL
	help
	  NXP RT6xx ADSP Series
```

## soc/xtensa/nxp_adsp/rt6xx/Kconfig.soc
```kconfig
# Copyright (c) 2023 Google LLC.
# Copyright (c) 2023 NXP
# SPDX-License-Identifier: Apache-2.0

choice
	prompt "NXP RT6xx ADSP SoC Selection"
	depends on SOC_SERIES_NXP_RT6XX

	config SOC_NXP_RT685
		bool "NXP RT685"
		select HAS_MCUX
endchoice
```

## soc/xtensa/sample_controller/Kconfig.defconfig
```kconfig
# XTENSA board configuration

# Copyright (c) 2016 Open-RnD Sp. z o.o.
# Copyright (c) 2016 Cadence Design Systems, Inc.
# SPDX-License-Identifier: Apache-2.0

if SOC_XTENSA_SAMPLE_CONTROLLER

config SOC
	default "sample_controller"

config SOC_TOOLCHAIN_NAME
	string
	default "sample_controller"

config IRQ_OFFLOAD_INTNUM
	default 7

config LOG_BACKEND_XTENSA_SIM
	default LOG

endif
```

## soc/xtensa/sample_controller/Kconfig.soc
```kconfig
# Copyright (c) 2017 Intel Corporation
# SPDX-License-Identifier: Apache-2.0

config SOC_XTENSA_SAMPLE_CONTROLLER
	bool "Xtensa sample_controller core"
	select XTENSA
	select XTENSA_HAL
	select ARCH_SUPPORTS_COREDUMP
```

## soc/xuantie/xiaohui/Kconfig
```kconfig
# riscv SOC family supporting the riscv privileged architecture spec

# Copyright (c) 2017 Jean-Paul Etienne <fractalclone@gmail.com>
# Copyright (C) 2017-2024 Alibaba Group Holding Limited
# SPDX-License-Identifier: Apache-2.0

config SOC_FAMILY_XIAOHUI
	bool
	select ATOMIC_OPERATIONS_BUILTIN
	select INCLUDE_RESET_VECTOR
	select RISCV
	select RISCV_PRIVILEGED
	select RISCV_MACHINE_TIMER

# if SOC_FAMILY_XIAOHUI

config KERNEL_ENTRY
	default "__xuantie_start"

config SOC_FAMILY
	default "xiaohui" if SOC_FAMILY_XIAOHUI

config XUANTIE_CPU_NAME
	string "the cpu name of xuantie"
	default "unknown"

config RISCV_HAS_PLIC
	bool "Does the SOC provide support for a Platform Level Interrupt Controller (PLIC)"
	depends on SOC_FAMILY_XIAOHUI
	help
	  Does the SOC provide support for a Platform Level Interrupt Controller (PLIC).

config RISCV_HAS_CLIC
	bool "Does the SOC provide support for a Core-Local Interrupt Controller (CLIC)"
	depends on SOC_FAMILY_XIAOHUI
	help
	  Does the SOC provide support for a Core-Local Interrupt Controller (CLIC).

config PLIC_BASE
	hex "the base addr of Platform Level Interrupt Controller (PLIC) for csi components in yocopen"
	default $(dt_nodelabel_reg_addr_hex,plic)

config RISCV_VECTORED_MODE
	bool "Should the SOC use mtvec in vectored mode"
	depends on SOC_FAMILY_XIAOHUI
	help
	  Should the SOC use mtvec in vectored mode

config XUANTIE_RISCV_VLENB_LEN
	int "Size(bits) of vector register."
	default 256
	depends on RISCV_SOC_CONTEXT_SAVE
	help
	  This option sets the vlen size that vector extension will be used

config XUANTIE_RISCV_RLENB_LEN
	int "Row Size(bits, actually means xmlenb) of matrix register."
	default 256
	depends on RISCV_SOC_CONTEXT_SAVE
	help
	  This option sets the mlenb size that matrix extension will be used


config CPU_XUANTIE_FPU
	bool "CPU FPU support"
	select FPU
	select FPU_SHARING
	select CPU_HAS_FPU

config CPU_XUANTIE_DOUBLE_FPU
	bool "CPU double FPU support"
	select FPU
	select FPU_SHARING
	select CPU_HAS_FPU_DOUBLE_PRECISION

rsource "*/Kconfig"

# endif # SOC_FAMILY_XIAOHUI
```

## soc/xuantie/xiaohui/Kconfig.defconfig
```kconfig
# riscv SOC family supporting the riscv privileged architecture spec

# Copyright (c) 2017 Jean-Paul Etienne <fractalclone@gmail.com>
# Copyright (C) 2017-2024 Alibaba Group Holding Limited
# SPDX-License-Identifier: Apache-2.0

if SOC_FAMILY_XIAOHUI

rsource "*/Kconfig.defconfig"

endif # SOC_FAMILY_XIAOHUI
```

## soc/xuantie/xiaohui/Kconfig.soc
```kconfig
# riscv SOC family supporting the riscv privileged architecture spec

# Copyright (c) 2017 Jean-Paul Etienne <fractalclone@gmail.com>
# Copyright (C) 2017-2024 Alibaba Group Holding Limited
# SPDX-License-Identifier: Apache-2.0

config CPU_XUANTIE_FPU
	bool "CPU FPU support"

config CPU_XUANTIE_DOUBLE_FPU
	bool "CPU double FPU support"

rsource "*/Kconfig.soc"
```

## soc/xuantie/xiaohui/c9xx/Kconfig
```kconfig
# riscv SOC family supporting the riscv privileged architecture spec

# Copyright (c) 2017 Jean-Paul Etienne <fractalclone@gmail.com>
# Copyright (C) 2017-2024 Alibaba Group Holding Limited
# SPDX-License-Identifier: Apache-2.0


config SOC_SERIES_XIAOHUI_C9XX
	bool "xiaohui(FPGA) c9xx"

	select RISCV_SOC_HAS_GP_RELATIVE_ADDRESSING

	select RISCV_HAS_PLIC
	select RISCV_ISA_EXT_ZICSR
	select RISCV_ISA_EXT_ZIFENCEI
	select RISCV_ALWAYS_SWITCH_THROUGH_ECALL

	select RISCV_SOC_CONTEXT_SAVE if RISCV_ISA_EXT_V
	select CPU_XUANTIE_DOUBLE_FPU if (RISCV_ISA_EXT_F && RISCV_ISA_EXT_D)

	select SOC_FAMILY_XIAOHUI

config CPU_XUANTIE_C906
	bool "xuantie CPU c906 (I,M,A,C)"
	select 64BIT
	select RISCV_ISA_RV64I
	select RISCV_ISA_EXT_M
	select RISCV_ISA_EXT_A
	select RISCV_ISA_EXT_C

config CPU_XUANTIE_C906FD
	bool "xuantie CPU c906fdv (I,M,A,F,D,C)"
	select 64BIT
	select RISCV_ISA_RV64I
	select RISCV_ISA_EXT_M
	select RISCV_ISA_EXT_A
	select RISCV_ISA_EXT_F
	select RISCV_ISA_EXT_D
	select RISCV_ISA_EXT_C

config CPU_XUANTIE_C906FDV
	bool "xuantie CPU c906fdv (I,M,A,F,D,C,V)"
	select 64BIT
	select RISCV_ISA_RV64I
	select RISCV_ISA_EXT_M
	select RISCV_ISA_EXT_A
	select RISCV_ISA_EXT_F
	select RISCV_ISA_EXT_D
	select RISCV_ISA_EXT_C
#     select RISCV_ISA_EXT_V

config CPU_XUANTIE_C907
	bool "xuantie CPU c907 (I,M,A,C)"
	select RISCV_ISA_EXT_M
	select RISCV_ISA_EXT_A
	select RISCV_ISA_EXT_C

config CPU_XUANTIE_C907FD
	bool "xuantie CPU c907fd (I,M,A,F,D,C)"
	select 64BIT
	select RISCV_ISA_RV64I
	select RISCV_ISA_EXT_M
	select RISCV_ISA_EXT_A
	select RISCV_ISA_EXT_F
	select RISCV_ISA_EXT_D
	select RISCV_ISA_EXT_C

config CPU_XUANTIE_C907FDV
	bool "xuantie CPU c907fdv (I,M,A,F,D,C,V)"
	select 64BIT
	select RISCV_ISA_RV64I
	select RISCV_ISA_EXT_M
	select RISCV_ISA_EXT_A
	select RISCV_ISA_EXT_F
	select RISCV_ISA_EXT_D
	select RISCV_ISA_EXT_C
#     select RISCV_ISA_EXT_V

config CPU_XUANTIE_C907FDVM
	bool "xuantie CPU c907fdvm (I,M,A,F,D,C,V)"
	select 64BIT
	select RISCV_ISA_RV64I
	select RISCV_ISA_EXT_M
	select RISCV_ISA_EXT_A
	select RISCV_ISA_EXT_F
	select RISCV_ISA_EXT_D
	select RISCV_ISA_EXT_C
#     select RISCV_ISA_EXT_V


config CPU_XUANTIE_C907_RV32
	bool "xuantie CPU c907-rv32 (I,M,A,C)"
	select 32BIT
	select RISCV_ISA_RV32I
	select RISCV_ISA_EXT_M
	select RISCV_ISA_EXT_A
	select RISCV_ISA_EXT_C

config CPU_XUANTIE_C907FD_RV32
	bool "xuantie CPU c907fd-rv32 (I,M,A,F,D,C)"
	select 32BIT
	select RISCV_ISA_RV32I
	select RISCV_ISA_EXT_M
	select RISCV_ISA_EXT_A
	select RISCV_ISA_EXT_C
	select RISCV_ISA_EXT_F
	select RISCV_ISA_EXT_D

config CPU_XUANTIE_C907FDV_RV32
	bool "xuantie CPU c907fdv-rv32 (I,M,A,F,D,C,V)"
	select 32BIT
	select RISCV_ISA_RV32I
	select RISCV_ISA_EXT_M
	select RISCV_ISA_EXT_A
	select RISCV_ISA_EXT_C
	select RISCV_ISA_EXT_F
	select RISCV_ISA_EXT_D
# 	select RISCV_ISA_EXT_V

config CPU_XUANTIE_C907FDVM_RV32
	bool "xuantie CPU c907fdvm-rv32 (I,M,A,F,D,C,V)"
	select 32BIT
	select RISCV_ISA_RV32I
	select RISCV_ISA_EXT_M
	select RISCV_ISA_EXT_A
	select RISCV_ISA_EXT_C
	select RISCV_ISA_EXT_F
	select RISCV_ISA_EXT_D
# 	select RISCV_ISA_EXT_V



config CPU_XUANTIE_C908
	bool "xuantie CPU c908 (I,M,A,F,D,C)"
	select 64BIT
	select RISCV_ISA_RV64I
	select RISCV_ISA_EXT_M
	select RISCV_ISA_EXT_A
	select RISCV_ISA_EXT_F
	select RISCV_ISA_EXT_D
	select RISCV_ISA_EXT_C

config CPU_XUANTIE_C908I
	bool "xuantie CPU c908i (I,M,A,C)"
	select 64BIT
	select RISCV_ISA_RV64I
	select RISCV_ISA_EXT_M
	select RISCV_ISA_EXT_A
	select RISCV_ISA_EXT_C

config CPU_XUANTIE_C908V
	bool "xuantie CPU c908v (I,M,A,F,D,C,V)"
	select 64BIT
	select RISCV_ISA_RV64I
	select RISCV_ISA_EXT_M
	select RISCV_ISA_EXT_A
	select RISCV_ISA_EXT_F
	select RISCV_ISA_EXT_D
	select RISCV_ISA_EXT_C
#     select RISCV_ISA_EXT_V

config CPU_XUANTIE_C910
	bool "xuantie CPU c910 (I,M,A,C,F,D)"
	select 64BIT
	select RISCV_ISA_RV64I
	select RISCV_ISA_EXT_M
	select RISCV_ISA_EXT_A
	select RISCV_ISA_EXT_C
	select RISCV_ISA_EXT_F
	select RISCV_ISA_EXT_D

config CPU_XUANTIE_C910V2
	bool "xuantie CPU c910v2 (I,M,A,C,F,D)"
	select 64BIT
	select RISCV_ISA_RV64I
	select RISCV_ISA_EXT_M
	select RISCV_ISA_EXT_A
	select RISCV_ISA_EXT_C
	select RISCV_ISA_EXT_F
	select RISCV_ISA_EXT_D

config CPU_XUANTIE_C910V3
	bool "xuantie CPU c910v3 (I,M,A,C,F,D)"
	select 64BIT
	select RISCV_ISA_RV64I
	select RISCV_ISA_EXT_M
	select RISCV_ISA_EXT_A
	select RISCV_ISA_EXT_C
	select RISCV_ISA_EXT_F
	select RISCV_ISA_EXT_D

config CPU_XUANTIE_C910V3_CP
	bool "xuantie CPU c910v3cp (I,M,A,C,F,D)"
	select 64BIT
	select RISCV_ISA_RV64I
	select RISCV_ISA_EXT_M
	select RISCV_ISA_EXT_A
	select RISCV_ISA_EXT_C
	select RISCV_ISA_EXT_F
	select RISCV_ISA_EXT_D

config CPU_XUANTIE_C920
	bool "xuantie CPU c920 (I,M,A,C,F,D)"
	select 64BIT
	select RISCV_ISA_RV64I
	select RISCV_ISA_EXT_M
	select RISCV_ISA_EXT_A
	select RISCV_ISA_EXT_C
	select RISCV_ISA_EXT_F
	select RISCV_ISA_EXT_D

config CPU_XUANTIE_C920V2
	bool "xuantie CPU c920v2 (I,M,A,C,F,D)"
	select 64BIT
	select RISCV_ISA_RV64I
	select RISCV_ISA_EXT_M
	select RISCV_ISA_EXT_A
	select RISCV_ISA_EXT_C
	select RISCV_ISA_EXT_F
	select RISCV_ISA_EXT_D

config CPU_XUANTIE_C920V3
	bool "xuantie CPU c920v3 (I,M,A,C,F,D)"
	select 64BIT
	select RISCV_ISA_RV64I
	select RISCV_ISA_EXT_M
	select RISCV_ISA_EXT_A
	select RISCV_ISA_EXT_C
	select RISCV_ISA_EXT_F
	select RISCV_ISA_EXT_D

config CPU_XUANTIE_C920V3_CP
	bool "xuantie CPU c920v3_cp (I,M,A,C,F,D)"
	select 64BIT
	select RISCV_ISA_RV64I
	select RISCV_ISA_EXT_M
	select RISCV_ISA_EXT_A
	select RISCV_ISA_EXT_C
	select RISCV_ISA_EXT_F
	select RISCV_ISA_EXT_D
```

## soc/xuantie/xiaohui/c9xx/Kconfig.defconfig
```kconfig
# riscv SOC family supporting the riscv privileged architecture spec

# Copyright (c) 2017 Jean-Paul Etienne <fractalclone@gmail.com>
# Copyright (C) 2017-2024 Alibaba Group Holding Limited
# SPDX-License-Identifier: Apache-2.0

if SOC_SERIES_XIAOHUI_C9XX

config RISCV_MACHINE_TIMER_SYSTEM_CLOCK_DIVIDER
	default 1

config RISCV_MCAUSE_EXCEPTION_MASK
	default 0xFFF

config RISCV_SOC_INTERRUPT_INIT
	default y

config 2ND_LVL_ISR_TBL_OFFSET
	default 12

config 2ND_LVL_INTR_00_OFFSET
	default 11

config MAX_IRQ_PER_AGGREGATOR
	default 52

config NUM_IRQS
	default 64

config PMP_SLOTS
	default 16

endif # SOC_SERIES_XIAOHUI_C9XX
```
