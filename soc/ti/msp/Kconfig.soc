## soc/ti/msp/Kconfig.soc
```kconfig
# Texas Instruments MSP SoC Family (MSPM0 + MSPM33)

# Copyright (c) 2025 Texas Instruments
# Copyright (c) 2025 Linumiz
# SPDX-License-Identifier: Apache-2.0

config SOC_FAMILY_TI_MSP
	bool

config SOC_FAMILY
	default "ti_msp" if SOC_FAMILY_TI_MSP

rsource "*/Kconfig.soc"
```

## soc/ti/mspm/Kconfig.device_family
```kconfig
# SPDX-FileCopyrightText: Copyright (c) 2026 Texas Instruments Incorporated
# SPDX-License-Identifier: Apache-2.0

config SOC_MSPM0_DEVICE_FAMILY_L11XX_L13XX
	bool
	default y if (SOC_MSPM0L1105 || \
		      SOC_MSPM0L1106 || \
		      SOC_MSPM0L1303 || \
		      SOC_MSPM0L1304 || \
		      SOC_MSPM0L1305 || \
		      SOC_MSPM0L1306 || \
		      SOC_MSPM0L1343 || \
		      SOC_MSPM0L1344 || \
		      SOC_MSPM0L1345 || \
		      SOC_MSPM0L1346)

config SOC_MSPM0_DEVICE_FAMILY_L122X_L222X
	bool
	default y if (SOC_MSPM0L1227 || \
		      SOC_MSPM0L1228 || \
		      SOC_MSPM0L2227 || \
		      SOC_MSPM0L2228)

config SOC_MSPM0_DEVICE_FAMILY_L111X
	bool
	default y if SOC_MSPM0L1117

config SOC_MSPM0_DEVICE_FAMILY_G1X0X_G3X0X
	bool
	default y if (SOC_MSPM0G1105 || \
		      SOC_MSPM0G1106 || \
		      SOC_MSPM0G1107 || \
		      SOC_MSPM0G1505 || \
		      SOC_MSPM0G1506 || \
		      SOC_MSPM0G1507 || \
		      SOC_MSPM0G3105 || \
		      SOC_MSPM0G3106 || \
		      SOC_MSPM0G3107 || \
		      SOC_MSPM0G3505 || \
		      SOC_MSPM0G3506 || \
		      SOC_MSPM0G3507)

config SOC_MSPM0_DEVICE_FAMILY_GX51X
	bool
	default y if (SOC_MSPM0G1518 || \
		      SOC_MSPM0G1519 || \
		      SOC_MSPM0G3518 || \
		      SOC_MSPM0G3519)

config SOC_MSPM33_DEVICE_FAMILY_C321X
	bool
	default y if SOC_MSPM33C321A

config SOC_MSPM_DEVICE_FAMILY_TYPE
	string
	default "MSPM0_L11XX_L13XX" if SOC_MSPM0_DEVICE_FAMILY_L11XX_L13XX
	default "MSPM0_L122X_L222X" if SOC_MSPM0_DEVICE_FAMILY_L122X_L222X
	default "MSPM0_L111X"       if SOC_MSPM0_DEVICE_FAMILY_L111X
	default "MSPM0_G1X0X_G3X0X" if SOC_MSPM0_DEVICE_FAMILY_G1X0X_G3X0X
	default "MSPM0_GX51X"       if SOC_MSPM0_DEVICE_FAMILY_GX51X
	default "MSPM33_C321X"      if SOC_MSPM33_DEVICE_FAMILY_C321X
```

## soc/ti/mspm/mspm33c/Kconfig
```kconfig
# TI MSPM33C

# Copyright (c) 2026 Texas Instruments
# SPDX-License-Identifier: Apache-2.0

config SOC_SERIES_MSPM33C
	select ARM
	select CPU_CORTEX_M33
	select CPU_HAS_FPU
	select CPU_HAS_ARM_MPU
	select ARMV8_M_DSP
	select BUILD_OUTPUT_BIN
	select BUILD_OUTPUT_HEX
```

## soc/ti/mspm/mspm33c/Kconfig.defconfig
```kconfig
# TI MSPM33C series

# Copyright (c) 2026 Texas Instruments
# SPDX-License-Identifier: Apache-2.0

if SOC_SERIES_MSPM33C

config SYS_CLOCK_HW_CYCLES_PER_SEC
	default $(dt_node_int_prop_int,/cpus/cpu@0,clock-frequency)

config NUM_IRQS
	default 58

endif # SOC_SERIES_MSPM33C
```

## soc/ti/mspm/mspm33c/Kconfig.soc
```kconfig
# Copyright (c) 2026 Texas Instruments
# SPDX-License-Identifier: Apache-2.0

config SOC_SERIES_MSPM33C
	bool
	select SOC_FAMILY_TI_MSPM
	help
	  Enable support for TI MSPM33C series SoCs

config SOC_MSPM33C321A
	bool
	select SOC_SERIES_MSPM33C

config SOC_SERIES
	default "mspm33c" if SOC_SERIES_MSPM33C

config SOC
	default "mspm33c321a" if SOC_MSPM33C321A
```

## soc/ti/mspm0/Kconfig
```kconfig
# Texas Instruments MSPM0 Family
# Copyright (c) 2025 Texas Instruments
# Copyright (c) 2025 Linumiz
# SPDX-License-Identifier: Apache-2.0

if SOC_FAMILY_TI_MSPM0

rsource "*/Kconfig"

# Per TRM Section 2.2.7 Peripheral Power Enable Control: wait at least 4 ULPCLK
# clock cycles before accessing the peripheral's memory-mapped registers.
# ULPCLK will either be equivalent or half of the main MCLK and CPUCLK,
# yielding the delay time of 8 cycles
config MSPM0_PERIPH_STARTUP_DELAY
	int
	default 8

# MSPM0 shares the NVIC interrupt 0 and 1 up to 8 IP blocks each,
# called interrupt groups 0 and 1 respectively.
# These IP blocks are not either/or but always in such group
# so up to these blocks to select the right group they are in.
config SOC_TI_MSPM0_INT_GROUP_0
	bool

config SOC_TI_MSPM0_INT_GROUP_1
	bool

config HWINFO
	bool
	default y if POWEROFF

endif # SOC_FAMILY_TI_MSPM0
```

## soc/ti/mspm0/Kconfig.defconfig
```kconfig
# SPDX-License-Identifier: Apache-2.0
# Copyright (c) 2025 Texas Instruments
# Copyright (c) 2025 Linumiz

if SOC_FAMILY_TI_MSPM0

rsource "*/Kconfig.defconfig"

DT_MSPM0_MCLK_PATH := $(dt_nodelabel_path,mclk)
DT_MSPM0_MCLK_CPU_FREQ := $(dt_node_int_prop_int,$(DT_MSPM0_MCLK_PATH),clock-frequency)

config SYS_CLOCK_HW_CYCLES_PER_SEC
	default "$(DT_MSPM0_MCLK_CPU_FREQ)" if "$(dt_nodelabel_enabled,mclk)"

endif # SOC_FAMILY_TI_MSPM0
```

## soc/ti/mspm0/Kconfig.soc
```kconfig
# Texas Instruments MSPM0 Family

# Copyright (c) 2025 Texas Instruments
# Copyright (c) 2025 Linumiz
# SPDX-License-Identifier: Apache-2.0

config SOC_FAMILY_TI_MSPM0
	bool

config SOC_FAMILY
	default "ti_mspm0" if SOC_FAMILY_TI_MSPM0

rsource "*/Kconfig.soc"
```

## soc/ti/mspm0/mspm0g/Kconfig
```kconfig
# TI MSPM0G

# Copyright (c) 2025 Texas Instruments
# Copyright (c) 2025 Linumiz
# SPDX-License-Identifier: Apache-2.0

config SOC_SERIES_MSPM0G
	select ARM
	select CPU_CORTEX_M0PLUS
	select CPU_CORTEX_M_HAS_VTOR
	select CPU_HAS_ARM_MPU
	select CPU_CORTEX_M_HAS_SYSTICK
	select BUILD_OUTPUT_BIN
	select BUILD_OUTPUT_HEX
	select HAS_MSPM0_SDK
	select HAS_PM
	select HAS_POWEROFF
	select CLOCK_CONTROL
	select SOC_EARLY_INIT_HOOK
```

## soc/ti/mspm0/mspm0g/Kconfig.defconfig
```kconfig
# TI MSPM0G series

# Copyright (c) 2025 Texas Instruments
# Copyright (c) 2025 Linumiz
# SPDX-License-Identifier: Apache-2.0

DT_CHOSEN_Z_FLASH := zephyr,flash

config FLASH_SIZE
	default $(dt_chosen_reg_size_int,$(DT_CHOSEN_Z_FLASH),0,K)

config FLASH_BASE_ADDRESS
	default $(dt_chosen_reg_addr_hex,$(DT_CHOSEN_Z_FLASH))

if SOC_SERIES_MSPM0G

config NUM_IRQS
	default 32

endif # SOC_SERIES_MSPM0G
```

## soc/ti/mspm0/mspm0g/Kconfig.soc
```kconfig
# Copyright (c) 2024 Texas Instruments
# Copyright (c) 2025 Linumiz
# SPDX-License-Identifier: Apache-2.0

config SOC_SERIES_MSPM0G
	bool
	select SOC_FAMILY_TI_MSPM0
	help
	  Enable support for TI MSPM0G series SoCs

config SOC_MSPM0G1105
	bool
	select SOC_SERIES_MSPM0G

config SOC_MSPM0G1106
	bool
	select SOC_SERIES_MSPM0G

config SOC_MSPM0G1107
	bool
	select SOC_SERIES_MSPM0G

config SOC_MSPM0G1505
	bool
	select SOC_SERIES_MSPM0G

config SOC_MSPM0G1506
	bool
	select SOC_SERIES_MSPM0G

config SOC_MSPM0G1507
	bool
	select SOC_SERIES_MSPM0G

config SOC_MSPM0G1519
	bool
	select SOC_SERIES_MSPM0G

config SOC_MSPM0G3105
	bool
	select SOC_SERIES_MSPM0G

config SOC_MSPM0G3106
	bool
	select SOC_SERIES_MSPM0G

config SOC_MSPM0G3107
	bool
	select SOC_SERIES_MSPM0G

config SOC_MSPM0G3505
	bool
	select SOC_SERIES_MSPM0G

config SOC_MSPM0G3506
	bool
	select SOC_SERIES_MSPM0G

config SOC_MSPM0G3507
	bool
	select SOC_SERIES_MSPM0G

config SOC_MSPM0G3519
	bool
	select SOC_SERIES_MSPM0G

config SOC_SERIES
	default "mspm0g" if SOC_SERIES_MSPM0G

config SOC
	default "mspm0g1105" if SOC_MSPM0G1105
	default "mspm0g1106" if SOC_MSPM0G1106
	default "mspm0g1107" if SOC_MSPM0G1107
	default "mspm0g1505" if SOC_MSPM0G1505
	default "mspm0g1506" if SOC_MSPM0G1506
	default "mspm0g1507" if SOC_MSPM0G1507
	default "mspm0g1519" if SOC_MSPM0G1519
	default "mspm0g3105" if SOC_MSPM0G3105
	default "mspm0g3106" if SOC_MSPM0G3106
	default "mspm0g3107" if SOC_MSPM0G3107
	default "mspm0g3505" if SOC_MSPM0G3505
	default "mspm0g3506" if SOC_MSPM0G3506
	default "mspm0g3507" if SOC_MSPM0G3507
	default "mspm0g3519" if SOC_MSPM0G3519
```

## soc/ti/mspm0/mspm0g1x0x_g3x0x/Kconfig
```kconfig
# TI MSPM0G1X0X_G3X0X

# Copyright (c) 2024 Texas Instruments
# SPDX-License-Identifier: Apache-2.0

config SOC_SERIES_MSPM0G1X0X_G3X0X
	select ARM
	select CPU_CORTEX_M0PLUS
	select CPU_CORTEX_M_HAS_VTOR
	select CPU_HAS_ARM_MPU
	select CPU_CORTEX_M_HAS_SYSTICK
	select BUILD_OUTPUT_BIN
	select BUILD_OUTPUT_HEX
	select HAS_MSPM0_SDK
	help
	  Enable support for TI MSPM0GXXXX.
```

## soc/ti/mspm0/mspm0g1x0x_g3x0x/Kconfig.defconfig
```kconfig
# TI MSPM0G1X0X_G3X0X

# Copyright (c) 2024 Texas Instruments
# SPDX-License-Identifier: Apache-2.0

if SOC_SERIES_MSPM0G1X0X_G3X0X

DT_MSPM0_CLKMUX_PATH := $(dt_nodelabel_path,clkmux)
DT_MSPM0_CLKMUX_CPU_FREQ := $(dt_node_int_prop_int,$(DT_MSPM0_CLKMUX_PATH),clock-frequency)

config NUM_IRQS
	default 32

config SYS_CLOCK_HW_CYCLES_PER_SEC
	default "$(DT_MSPM0_CLKMUX_CPU_FREQ)" if "$(dt_nodelabel_enabled,clkmux)"

endif # SOC_SERIES_MSPM0G1X0X_G3X0X
```

## soc/ti/mspm0/mspm0g1x0x_g3x0x/Kconfig.defconfig.mspm0g1106
```kconfig
# TI MSPM0G1106 SoC

# Copyright (c) 2024 Texas Instruments
# SPDX-License-Identifier: Apache-2.0

if SOC_MSPM0G1106

config SOC
	default "mspm0g1106"

config NUM_IRQS
	default 32

endif # SOC_MSPM0G1106
```

## soc/ti/mspm0/mspm0g1x0x_g3x0x/Kconfig.defconfig.mspm0g1107
```kconfig
# TI MSPM0G1107 SoC

# Copyright (c) 2024 Texas Instruments
# SPDX-License-Identifier: Apache-2.0

if SOC_MSPM0G1107

config SOC
	default "mspm0g1107"

config NUM_IRQS
	default 32

endif # SOC_MSPM0G1107
```

## soc/ti/mspm0/mspm0g1x0x_g3x0x/Kconfig.defconfig.mspm0g1506
```kconfig
# TI MSPM0G1506 SoC

# Copyright (c) 2024 Texas Instruments
# SPDX-License-Identifier: Apache-2.0

if SOC_MSPM0G1506

config SOC
	default "mspm0g1506"

config NUM_IRQS
	default 32

endif # SOC_MSPM0G1506
```

## soc/ti/mspm0/mspm0g1x0x_g3x0x/Kconfig.defconfig.mspm0g1507
```kconfig
# TI MSPM0G1507 SoC

# Copyright (c) 2024 Texas Instruments
# SPDX-License-Identifier: Apache-2.0

if SOC_MSPM0G1507

config SOC
	default "mspm0g1507"

config NUM_IRQS
	default 32

endif # SOC_MSPM0G1507
```

## soc/ti/mspm0/mspm0g1x0x_g3x0x/Kconfig.defconfig.mspm0g3106
```kconfig
# TI MSPM0G3106 SoC

# Copyright (c) 2024 Texas Instruments
# SPDX-License-Identifier: Apache-2.0

if SOC_MSPM0G3106

config SOC
	default "mspm0g3106"

config NUM_IRQS
	default 32

endif # SOC_MSPM0G3106
```

## soc/ti/mspm0/mspm0g1x0x_g3x0x/Kconfig.defconfig.mspm0g3506
```kconfig
# TI MSPM0G3506 SoC

# Copyright (c) 2024 Texas Instruments
# SPDX-License-Identifier: Apache-2.0

if SOC_MSPM0G3506

config SOC
	default "mspm0g3506"

config NUM_IRQS
	default 32

endif # SOC_MSPM0G3506
```

## soc/ti/mspm0/mspm0g1x0x_g3x0x/Kconfig.defconfig.mspm0g350x
```kconfig
# TI MSPM0G3507 SoC

# Copyright (c) 2024 Texas Instruments
# SPDX-License-Identifier: Apache-2.0

if SOC_MSPM0G350X

config SOC
	default "mspm0g350X"

config SYS_CLOCK_HW_CYCLES_PER_SEC
	default 32000000

config NUM_IRQS
	default 32

endif # SOC_MSPM0G350X
```

## soc/ti/mspm0/mspm0g1x0x_g3x0x/Kconfig.soc
```kconfig
# Copyright (c) 2024 Texas Instruments
# SPDX-License-Identifier: Apache-2.0

config SOC_SERIES_MSPM0G1X0X_G3X0X
	bool
	select SOC_FAMILY_TI_MSPM0
	help
	  Enable support for TI MSPM0G1X0X_G3X0X SoCs

config SOC_MSPM0G1106
	bool
	select SOC_SERIES_MSPM0G1X0X_G3X0X

config SOC_MSPM0G1107
	bool
	select SOC_SERIES_MSPM0G1X0X_G3X0X

config SOC_MSPM0G1506
	bool
	select SOC_SERIES_MSPM0G1X0X_G3X0X

config SOC_MSPM0G1507
	bool
	select SOC_SERIES_MSPM0G1X0X_G3X0X

config SOC_MSPM0G3106
	bool
	select SOC_SERIES_MSPM0G1X0X_G3X0X

config SOC_MSPM0G3107
	bool
	select SOC_SERIES_MSPM0G1X0X_G3X0X

config SOC_MSPM0G3506
	bool
	select SOC_SERIES_MSPM0G1X0X_G3X0X

config SOC_MSPM0G3507
	bool
	select SOC_SERIES_MSPM0G1X0X_G3X0X

config SOC_SERIES
	default "mspm0g1x0x_g3x0x" if SOC_SERIES_MSPM0G1X0X_G3X0X

config SOC
	default "mspm0g1106" if SOC_MSPM0G1106
	default "mspm0g1107" if SOC_MSPM0G1107
	default "mspm0g1506" if SOC_MSPM0G1506
	default "mspm0g1507" if SOC_MSPM0G1507
	default "mspm0g3106" if SOC_MSPM0G3106
	default "mspm0g3107" if SOC_MSPM0G3107
	default "mspm0g3506" if SOC_MSPM0G3506
	default "mspm0g3507" if SOC_MSPM0G3507
```

## soc/ti/mspm0/mspm0g3xxx/Kconfig.defconfig
```kconfig
# TI MSPM0G3XXX

# Copyright (c) 2024 Texas Instruments
# SPDX-License-Identifier: Apache-2.0

if SOC_SERIES_MSPM0G3XXX

rsource "Kconfig.defconfig.mspm0g3*"

endif # SOC_SERIES_MSPM0G3XXX
```

## soc/ti/mspm0/mspm0g3xxx/Kconfig.soc
```kconfig
# Texas Instruments MSPM0G3507

# Copyright (c) 2024 Texas Instruments
# SPDX-License-Identifier: Apache-2.0

config SOC_SERIES_MSPM0G3XXX
	bool
	select SOC_FAMILY_TI_MSPM0
	help
		Enable support for TI MSPM0G3XXX SoCs

config SOC_MSPM0G3507
	bool
	select SOC_SERIES_MSPM0G3XXX

config SOC_SERIES
	default "mspm0g3xxx" if SOC_SERIES_MSPM0G3XXX

config SOC
	default "mspm0g3507" if SOC_MSPM0G3507
```

## soc/ti/mspm0/mspm0l/Kconfig
```kconfig
# TI MSPM0L

# Copyright (c) 2025 Texas Instruments
# Copyright (c) 2025 Linumiz GmbH
# SPDX-License-Identifier: Apache-2.0

config SOC_SERIES_MSPM0L
	select ARM
	select CPU_CORTEX_M0PLUS
	select CPU_CORTEX_M_HAS_VTOR
	select CPU_CORTEX_M_HAS_SYSTICK
	select BUILD_OUTPUT_BIN
	select BUILD_OUTPUT_HEX
	select HAS_MSPM0_SDK
	select CLOCK_CONTROL
	select SOC_EARLY_INIT_HOOK

config SOC_MSPM0L2227
	select CPU_HAS_ARM_MPU

config SOC_MSPM0L2228
	select CPU_HAS_ARM_MPU
```

## soc/ti/mspm0/mspm0l/Kconfig.defconfig
```kconfig
# TI MSPM0L series

# Copyright (c) 2025 Texas Instruments
# Copyright (c) 2025 Linumiz GmbH
# SPDX-License-Identifier: Apache-2.0

if SOC_SERIES_MSPM0L

config NUM_IRQS
	default 32

endif # SOC_SERIES_MSPM0L
```
