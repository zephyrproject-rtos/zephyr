## soc/ti/hercules/ti_tms570lc43x/Kconfig.soc
```kconfig
# Copyright (c) 2024 ispace, inc.
# SPDX-License-Identifier: Apache-2.0

config SOC_SERIES_TI_TMS570
	bool
	select SOC_FAMILY_TI_HERCULES
	help
	  TI Hercules family

config SOC_TI_TMS570LC43X
	bool
	select SOC_SERIES_TI_TMS570
	help
	  TI TMS570LC43X

config HAS_TMS570_HALCOGEN_CODE
	bool

config SOC_SERIES
	default "ti_tms570" if SOC_SERIES_TI_TMS570

config SOC
	default "ti_tms570lc43x" if SOC_TI_TMS570LC43X
```

## soc/ti/hercules/tms570lc43x/Kconfig
```kconfig
# Copyright (c) 2025 ispace, inc.
# SPDX-License-Identifier: Apache-2.0

config SOC_TI_TMS570LC43X
	bool
	select ARM
	select CPU_CORTEX_R5
	select BIG_ENDIAN
	select CPU_HAS_DCLS
	select CPU_HAS_ARM_MPU
	select CPU_HAS_DCACHE
	select CPU_HAS_ICACHE
	select PLATFORM_SPECIFIC_INIT
	select PLATFORM_SPECIFIC_PRE_STACK_INIT
	# select CPU_HAS_FPU
	select ARM_CUSTOM_INTERRUPT_CONTROLLER
	imply XIP

if SOC_TI_TMS570LC43X

endif # SOC_TI_TMS570LC43X
```

## soc/ti/hercules/tms570lc43x/Kconfig.defconfig
```kconfig
# Copyright (c) Copyright (c) 2025 ispace, inc.
# SPDX-License-Identifier: Apache-2.0

if SOC_TI_TMS570LC43X

config SYS_CLOCK_EXISTS
	default n

config MULTITHREADING
	default n

config GEN_SW_ISR_TABLE
	default n

config GEN_ISR_TABLES
	default n

# launchpad is 16MHz
config SYS_CLOCK_HW_CYCLES_PER_SEC
	default 16000000

config FLASH_BASE_ADDRESS
	default 1000000

config FLASH_SIZE
	default 4096

config NUM_IRQS
	int
	# must be >= the highest interrupt number used
	default 127

endif # SOC_TI_TMS570LC43X
```

## soc/ti/hercules/tms570lc43x/Kconfig.soc
```kconfig
# Copyright (c) 2024 ispace, inc.
# SPDX-License-Identifier: Apache-2.0

config SOC_SERIES_TI_HERCULES
	bool
	select SOC_FAMILY_HERCULES
	help
	  TI Hercules family

config SOC_TI_TMS570LC43X
	bool
	select SOC_SERIES_TI_HERCULES
	help
	  TI TMS570LC43X

config SOC_SERIES
	default "ti_hercules" if SOC_SERIES_TI_HERCULES

config SOC
	default "tms570lc43x" if SOC_TI_TMS570LC43X
```

## soc/ti/k3/Kconfig
```kconfig
# Copyright (c) 2023 Enphase Energy
# Copyright (c) 2024 Nordic Semiconductor ASA
# Copyright (c) 2026 Siemens Mobility GmbH
# SPDX-License-Identifier: Apache-2.0

if SOC_FAMILY_TI_K3

rsource "*/Kconfig"

config SOC_PART_NUMBER
	default "AM2434" if SOC_AM2434_M4 || SOC_AM2434_R5F0_0
	default "AM6232" if SOC_AM6232_A53 || SOC_AM6232_M4
	default "AM6234" if SOC_AM6234_A53 || SOC_AM6234_M4
	default "AM6254" if SOC_AM6254_A53 || SOC_AM6254_M4
	default "AM62L3" if SOC_AM62L3_A53
	default "AM6442" if SOC_AM6442_M4 || SOC_AM6442_R5F0_0 || SOC_AM6442_R5F0_1 || SOC_AM6442_R5F1_0 || SOC_AM6442_R5F1_1
	default "J721e" if SOC_J721E_MAIN_R5F0_0

endif # SOC_FAMILY_TI_K3
```

## soc/ti/k3/Kconfig.defconfig
```kconfig
# Copyright (c) 2024 Nordic Semiconductor ASA
# SPDX-License-Identifier: Apache-2.0

if SOC_FAMILY_TI_K3

rsource "*/Kconfig.defconfig"

endif # SOC_FAMILY_TI_K3
```

## soc/ti/k3/Kconfig.soc
```kconfig
# Copyright (c) 2023 Enphase Energy
# Copyright (c) 2024 Nordic Semiconductor ASA
# Copyright (c) 2026 Siemens Mobility GmbH
# SPDX-License-Identifier: Apache-2.0

config SOC_FAMILY_TI_K3
	bool

config SOC_FAMILY
	default "ti_k3" if SOC_FAMILY_TI_K3

rsource "*/Kconfig.soc"

config SOC_SERIES
	default "am62x" if SOC_SERIES_AM62X
	default "am62lx" if SOC_SERIES_AM62LX
	default "am64x" if SOC_SERIES_AM64X
	default "j721e" if SOC_SERIES_J721E
	default "j722s" if SOC_SERIES_J722S

config SOC
	default "am2434" if SOC_AM2434_M4 || SOC_AM2434_R5F0_0
	default "am6232" if SOC_AM6232_M4 || SOC_AM6232_A53
	default "am6234" if SOC_AM6234_M4 || SOC_AM6234_A53
	default "am6254" if SOC_AM6254_M4 || SOC_AM6254_A53
	default "am62l3" if SOC_AM62L3_A53
	default "am6442" if SOC_AM6442_M4 || SOC_AM6442_R5F0_0 || SOC_AM6442_R5F0_1 || SOC_AM6442_R5F1_0 || SOC_AM6442_R5F1_1
	default "j721e" if SOC_J721E_MAIN_R5F0_0
	default "j722s" if SOC_J722S_MAIN_R5F0_0 || SOC_J722S_MCU_R5F0_0
```

## soc/ti/k3/am62lx/Kconfig
```kconfig
# Copyright (c) 2023 Enphase Energy
# Copyright (c) 2026 Siemens Mobility GmbH
# SPDX-License-Identifier: Apache-2.0

config SOC_SERIES_AM62LX_A53
	select ARM64
	select CPU_CORTEX_A53
	select ARM_ARCH_TIMER if SYS_CLOCK_EXISTS
	select SOC_EARLY_INIT_HOOK
```

## soc/ti/k3/am62lx/Kconfig.defconfig
```kconfig
# Copyright (c) 2023 Enphase Energy
# Copyright (c) 2026 Siemens Mobility GmbH
# SPDX-License-Identifier: Apache-2.0

if SOC_SERIES_AM62LX

config NUM_IRQS
	default 992 if SOC_SERIES_AM62LX_A53

config SYS_CLOCK_HW_CYCLES_PER_SEC
	default 200000000 if SOC_SERIES_AM62LX_A53

if SERIAL

config UART_NS16550
	default y

config UART_NS16550_TI_K3
	default y if SOC_SERIES_AM62LX_A53

choice UART_NS16550_VARIANT
	default UART_NS16550_VARIANT_NS16750
endchoice

endif # SERIAL

endif # SOC_SERIES_AM62LX
```

## soc/ti/k3/am62lx/Kconfig.soc
```kconfig
# Copyright (c) 2023 Enphase Energy
# Copyright (c) 2026 Siemens Mobility GmbH
# SPDX-License-Identifier: Apache-2.0

config SOC_SERIES_AM62LX
	bool
	select SOC_FAMILY_TI_K3

config SOC_SERIES_AM62LX_A53
	bool
	select SOC_SERIES_AM62LX
	help
	  Enable support for AM62LX A53 Series.

config SOC_AM62L3_A53
	bool
	select SOC_SERIES_AM62LX_A53
```

## soc/ti/k3/am62x/Kconfig
```kconfig
# Copyright (c) 2023 Enphase Energy
# Copyright (c) 2026 Siemens Mobility GmbH
# SPDX-License-Identifier: Apache-2.0

config SOC_SERIES_AM62X_A53
	select ARM64
	select CPU_CORTEX_A53
	select ARM_ARCH_TIMER if SYS_CLOCK_EXISTS
	select SOC_EARLY_INIT_HOOK

config SOC_SERIES_AM62X_M4
	select ARM
	select CPU_CORTEX_M4
	select CPU_HAS_FPU
	select CPU_CORTEX_M_HAS_SYSTICK
	select DYNAMIC_INTERRUPTS
	select CPU_CORTEX_M_HAS_DWT
	select UART_NS16550_ACCESS_WORD_ONLY
	select EXTERNAL_ADDRESS_TRANSLATION
	select MM_DRV
	select MM_TI_RAT
	select SOC_EARLY_INIT_HOOK
```

## soc/ti/k3/am62x/Kconfig.defconfig
```kconfig
# Copyright (c) 2023 Enphase Energy
# Copyright (c) 2026 Siemens Mobility GmbH
# SPDX-License-Identifier: Apache-2.0

if SOC_SERIES_AM62X

config NUM_IRQS
	default 64 if SOC_SERIES_AM62X_M4
	default 992 if SOC_SERIES_AM62X_A53

config SYS_CLOCK_HW_CYCLES_PER_SEC
	default 400000000 if SOC_SERIES_AM62X_M4
	default 200000000 if SOC_SERIES_AM62X_A53

if SERIAL

config UART_NS16550
	default y

config UART_NS16550_TI_K3
	default y if SOC_SERIES_AM62X_M4
	default y if SOC_SERIES_AM62X_A53

choice UART_NS16550_VARIANT
	default UART_NS16550_VARIANT_NS16750
endchoice

endif # SERIAL

config BUILD_OUTPUT_BIN
	default n if SOC_SERIES_AM62X_M4

endif # SOC_SERIES_AM62X
```

## soc/ti/k3/am62x/Kconfig.soc
```kconfig
# Copyright (c) 2023 Enphase Energy
# Copyright (c) 2026 Siemens Mobility GmbH
# SPDX-License-Identifier: Apache-2.0

config SOC_SERIES_AM62X
	bool
	select SOC_FAMILY_TI_K3

config SOC_SERIES_AM62X_A53
	bool
	select SOC_SERIES_AM62X
	help
	  Enable support for AM62X A53 Series.

config SOC_SERIES_AM62X_M4
	bool
	select SOC_SERIES_AM62X
	help
	  Enable support for AM62X M4 Series.

config SOC_AM6234_A53
	bool
	select SOC_SERIES_AM62X_A53

config SOC_AM6234_M4
	bool
	select SOC_SERIES_AM62X_M4

config SOC_AM6254_A53
	bool
	select SOC_SERIES_AM62X_A53

config SOC_AM6254_M4
	bool
	select SOC_SERIES_AM62X_M4

config SOC_AM6232_A53
	bool
	select SOC_SERIES_AM62X_A53

config SOC_AM6232_M4
	bool
	select SOC_SERIES_AM62X_M4
```

## soc/ti/k3/am64x/Kconfig
```kconfig
# Copyright (c) 2023 Enphase Energy
# Copyright (c) 2026 Siemens Mobility GmbH
# SPDX-License-Identifier: Apache-2.0

config SOC_SERIES_AM64X_M4
	select ARM
	select CPU_CORTEX_M4
	select CPU_HAS_FPU
	select CPU_CORTEX_M_HAS_SYSTICK
	select DYNAMIC_INTERRUPTS
	select CPU_CORTEX_M_HAS_DWT
	select UART_NS16550_ACCESS_WORD_ONLY
	select EXTERNAL_ADDRESS_TRANSLATION
	select MM_DRV
	select MM_TI_RAT
	select SOC_EARLY_INIT_HOOK

# There are multiple reasons why the MPU needs to be always enabled for this SoC
# series. This includes that a lot of peripherals are in memory regions that are
# cached by default and have no ordering guarantees and that firmware memory is
# either in a shared memory region while needing a non-shared region for atomic
# instructions to work or being in external DRAM, which is marked as XN by
# default.
config SOC_SERIES_AM64X_R5
	select ARM
	select ARM_MPU
	select CPU_CORTEX_R5
	select CPU_HAS_ARM_MPU
	select VFP_SP_D16
	select ARM_CUSTOM_INTERRUPT_CONTROLLER
	select TI_VIM
	select TI_DM_TIMER
	select UART_NS16550_ACCESS_WORD_ONLY if UART_NS16550
	select SOC_EARLY_INIT_HOOK
```

## soc/ti/k3/am64x/Kconfig.soc
```kconfig
# Copyright (c) 2023 Enphase Energy
# Copyright (c) 2026 Siemens Mobility GmbH
# SPDX-License-Identifier: Apache-2.0

config SOC_SERIES_AM64X
	bool
	select SOC_FAMILY_TI_K3

config SOC_SERIES_AM64X_M4
	bool
	select SOC_SERIES_AM64X
	help
	  Enable support for AM64X M4 Series.

config SOC_SERIES_AM64X_R5
	bool
	select SOC_SERIES_AM64X
	help
	  Enable support for AM64X R5 Series.

config SOC_AM6442_M4
	bool
	select SOC_SERIES_AM64X_M4

config SOC_AM2434_M4
	bool
	select SOC_SERIES_AM64X_M4

config SOC_AM2434_R5F0_0
	bool
	select SOC_SERIES_AM64X_R5

config SOC_AM6442_R5F0_0
	bool
	select SOC_SERIES_AM64X_R5

config SOC_AM6442_R5F0_1
	bool
	select SOC_SERIES_AM64X_R5

config SOC_AM6442_R5F1_0
	bool
	select SOC_SERIES_AM64X_R5

config SOC_AM6442_R5F1_1
	bool
	select SOC_SERIES_AM64X_R5
```

## soc/ti/k3/am6x/Kconfig
```kconfig
# Copyright (c) 2023 Enphase Energy
# SPDX-License-Identifier: Apache-2.0

config SOC_SERIES_AM6X_A53
	select ARM64
	select CPU_CORTEX_A53
	select ARM_ARCH_TIMER if SYS_CLOCK_EXISTS

config SOC_SERIES_AM6X_M4
	select ARM
	select CPU_CORTEX_M4
	select CPU_CORTEX_M_HAS_SYSTICK
	select DYNAMIC_INTERRUPTS
	select CPU_CORTEX_M_HAS_DWT
	select OPENAMP_RSC_TABLE
	select UART_NS16550_ACCESS_WORD_ONLY
	select EXTERNAL_ADDRESS_TRANSLATION
	select MM_DRV
	select MM_TI_RAT
	select SOC_EARLY_INIT_HOOK

config SOC_SERIES_AM6X_R5
	select ARM
	select CPU_CORTEX_R5
	select CPU_HAS_ARM_MPU
	select ARM_CUSTOM_INTERRUPT_CONTROLLER
	select VIM
	select TI_DM_TIMER
	select OPENAMP_RSC_TABLE
	select UART_NS16550_ACCESS_WORD_ONLY if UART_NS16550

config SOC_PART_NUMBER
	default "AM6234" if SOC_AM6234_A53
	default "AM6234" if SOC_AM6234_M4
	default "AM6442" if SOC_AM6442_M4
	default "J721e" if SOC_J721E_MAIN_R5F0_0
```

## soc/ti/k3/am6x/Kconfig.defconfig
```kconfig
# Copyright (c) 2023 Enphase Energy
# SPDX-License-Identifier: Apache-2.0

if SOC_SERIES_AM6X

rsource "Kconfig.defconfig.*"

config KERNEL_ENTRY
	default "_vector_table" if SOC_SERIES_AM6X_R5

# Workaround for not being able to have commas in macro arguments
DT_CHOSEN_Z_FLASH := zephyr,flash

config FLASH_SIZE
	default $(dt_chosen_reg_size_int,$(DT_CHOSEN_Z_FLASH),0,K)

config FLASH_BASE_ADDRESS
	default $(dt_chosen_reg_addr_hex,$(DT_CHOSEN_Z_FLASH))

if SERIAL

config UART_NS16550
	default y

config UART_NS16550_TI_K3
	default y if SOC_SERIES_AM6X_M4
	default y if SOC_SERIES_AM6X_R5

choice UART_NS16550_VARIANT
	default UART_NS16550_VARIANT_NS16750
endchoice

endif # SERIAL

config BUILD_OUTPUT_BIN
	default n if SOC_SERIES_AM6X_M4
	default n if SOC_SERIES_AM6X_R5

endif # SOC_SERIES_AM6X
```

## soc/ti/k3/am6x/Kconfig.defconfig.am2434_r5
```kconfig
# Copyright (c) 2025 Texas Instruments
# SPDX-License-Identifier: Apache-2.0

if SOC_AM2434_R5F0_0

config SYS_CLOCK_HW_CYCLES_PER_SEC
	default 25000000

config NUM_IRQS
	default 256

endif # SOC_AM2434_R5F0_0
```

## soc/ti/k3/am6x/Kconfig.defconfig.am6232_a53
```kconfig
# Copyright (c) 2025 Texas Instruments
# SPDX-License-Identifier: Apache-2.0

if SOC_AM6232_A53

config SYS_CLOCK_HW_CYCLES_PER_SEC
	default 200000000

config NUM_IRQS
	default 280

endif # SOC_AM6232_A53
```

## soc/ti/k3/am6x/Kconfig.defconfig.am6232_m4
```kconfig
# Copyright (c) 2025 Texas Instruments
# SPDX-License-Identifier: Apache-2.0

if SOC_AM6232_M4

config SYS_CLOCK_HW_CYCLES_PER_SEC
	default 400000000

config NUM_IRQS
	default 64

endif # SOC_AM6232_M4
```

## soc/ti/k3/am6x/Kconfig.defconfig.j722s_main_r5
```kconfig
# Copyright (c) 2025 Texas Instruments
# SPDX-License-Identifier: Apache-2.0

if SOC_J722S_MAIN_R5F0_0

config SYS_CLOCK_HW_CYCLES_PER_SEC
	default 19200000

config NUM_IRQS
	default 512

endif # SOC_J722S_MAIN_R5F0_0
```

## soc/ti/k3/am6x/Kconfig.soc
```kconfig
# Copyright (c) 2023 Enphase Energy
# SPDX-License-Identifier: Apache-2.0

config SOC_SERIES_AM6X
	bool
	select SOC_FAMILY_TI_K3

config SOC_SERIES_AM6X_A53
	bool
	select SOC_SERIES_AM6X
	help
	  Enable support for AM6X A53 Series.

config SOC_SERIES_AM6X_M4
	bool
	select SOC_SERIES_AM6X
	help
	  Enable support for AM62X M4 Series.

config SOC_SERIES_AM6X_R5
	bool
	select SOC_SERIES_AM6X
	help
	  Enable support for AM6X R5 Series.

config SOC_AM6234_A53
	bool
	select SOC_SERIES_AM6X_A53

config SOC_AM6234_M4
	bool
	select SOC_SERIES_AM6X_M4

config SOC_AM6442_M4
	bool
	select SOC_SERIES_AM6X_M4

config SOC_J721E_MAIN_R5F0_0
	bool
	select SOC_SERIES_AM6X_R5

config SOC_J722S_MAIN_R5F0_0
	bool
	select SOC_SERIES_AM6X_R5

config SOC_J722S_MCU_R5F0_0
	bool
	select SOC_SERIES_AM6X_R5

config SOC_SERIES
	default "am6x" if SOC_SERIES_AM6X

config SOC
	default "am6234" if SOC_AM6234_M4 || SOC_AM6234_A53
	default "am6442" if SOC_AM6442_M4
	default "j721e" if SOC_J721E_MAIN_R5F0_0
	default "j722s" if SOC_J722S_MAIN_R5F0_0 || SOC_J722S_MCU_R5F0_0
```

## soc/ti/k3/j721e/Kconfig.soc
```kconfig
# Copyright (c) 2023 Enphase Energy
# Copyright (c) 2026 Siemens Mobility GmbH
# SPDX-License-Identifier: Apache-2.0

config SOC_SERIES_J721E
	bool
	select SOC_FAMILY_TI_K3

config SOC_SERIES_J721E_R5
	bool
	select SOC_SERIES_J721E
	help
	  Enable support for J721E R5 Series.

config SOC_J721E_MAIN_R5F0_0
	bool
	select SOC_SERIES_J721E_R5

config SOC_J722S_MAIN_R5F0_0
	bool
	select SOC_SERIES_J721E_R5

config SOC_J722S_MCU_R5F0_0
	bool
	select SOC_SERIES_J721E_R5
```

## soc/ti/k3/j722s/Kconfig
```kconfig
# Copyright (c) 2023 Enphase Energy
# Copyright (c) 2026 Siemens Mobility GmbH
# SPDX-License-Identifier: Apache-2.0

config SOC_SERIES_J722S_R5
	select ARM
	select CPU_CORTEX_R5
	select CPU_HAS_ARM_MPU
	select VFP_SP_D16
	select ARM_CUSTOM_INTERRUPT_CONTROLLER
	select TI_VIM
	select TI_DM_TIMER
	select UART_NS16550_ACCESS_WORD_ONLY if UART_NS16550
	select SOC_EARLY_INIT_HOOK
```

## soc/ti/k3/j722s/Kconfig.soc
```kconfig
# Copyright (c) 2023 Enphase Energy
# Copyright (c) 2026 Siemens Mobility GmbH
# SPDX-License-Identifier: Apache-2.0

config SOC_SERIES_J722S
	bool
	select SOC_FAMILY_TI_K3

config SOC_SERIES_J722S_R5
	bool
	select SOC_SERIES_J722S
	help
	  Enable support for J722S R5 Series.

config SOC_J721E_MAIN_R5F0_0
	bool
	select SOC_SERIES_J722S_R5

config SOC_J722S_MAIN_R5F0_0
	bool
	select SOC_SERIES_J722S_R5

config SOC_J722S_MCU_R5F0_0
	bool
	select SOC_SERIES_J722S_R5
```
