## soc/ti/mspm0/mspm0l/Kconfig.soc
```kconfig
# Copyright (c) 2024 Texas Instruments
# Copyright (c) 2025 Linumiz GmbH
# SPDX-License-Identifier: Apache-2.0

config SOC_SERIES_MSPM0L
	bool
	select SOC_FAMILY_TI_MSPM0
	help
	  Enable support for TI MSPM0L series SoCs

config SOC_MSPM0L1105
	bool
	select SOC_SERIES_MSPM0L

config SOC_MSPM0L1106
	bool
	select SOC_SERIES_MSPM0L

config SOC_MSPM0L1117
	bool
	select SOC_SERIES_MSPM0L

config SOC_MSPM0L1227
	bool
	select SOC_SERIES_MSPM0L

config SOC_MSPM0L1228
	bool
	select SOC_SERIES_MSPM0L

config SOC_MSPM0L1303
	bool
	select SOC_SERIES_MSPM0L

config SOC_MSPM0L1304
	bool
	select SOC_SERIES_MSPM0L

config SOC_MSPM0L1305
	bool
	select SOC_SERIES_MSPM0L

config SOC_MSPM0L1306
	bool
	select SOC_SERIES_MSPM0L

config SOC_MSPM0L1343
	bool
	select SOC_SERIES_MSPM0L

config SOC_MSPM0L1344
	bool
	select SOC_SERIES_MSPM0L

config SOC_MSPM0L1345
	bool
	select SOC_SERIES_MSPM0L

config SOC_MSPM0L1346
	bool
	select SOC_SERIES_MSPM0L

config SOC_MSPM0L2227
	bool
	select SOC_SERIES_MSPM0L

config SOC_MSPM0L2228
	bool
	select SOC_SERIES_MSPM0L

config SOC_SERIES
	default "mspm0l" if SOC_SERIES_MSPM0L

config SOC
	default "mspm0l1105" if SOC_MSPM0L1105
	default "mspm0l1106" if SOC_MSPM0L1106
	default "mspm0l1117" if SOC_MSPM0L1117
	default "mspm0l1227" if SOC_MSPM0L1227
	default "mspm0l1228" if SOC_MSPM0L1228
	default "mspm0l1303" if SOC_MSPM0L1303
	default "mspm0l1304" if SOC_MSPM0L1304
	default "mspm0l1305" if SOC_MSPM0L1305
	default "mspm0l1306" if SOC_MSPM0L1306
	default "mspm0l1343" if SOC_MSPM0L1343
	default "mspm0l1344" if SOC_MSPM0L1344
	default "mspm0l1345" if SOC_MSPM0L1345
	default "mspm0l1346" if SOC_MSPM0L1346
	default "mspm0l2227" if SOC_MSPM0L2227
	default "mspm0l2228" if SOC_MSPM0L2228
```

## soc/ti/mspm0/mspm0l122x_l222x/Kconfig
```kconfig
# TI MSPM0L122X_L222X

# Copyright (c) 2024 Texas Instruments
# SPDX-License-Identifier: Apache-2.0

config SOC_SERIES_MSPM0L122X_L222X
	select ARM
	select CPU_CORTEX_M0PLUS
	select CPU_CORTEX_M_HAS_VTOR
	select CPU_HAS_ARM_MPU
	select CPU_CORTEX_M_HAS_SYSTICK
	select BUILD_OUTPUT_BIN
	select BUILD_OUTPUT_HEX
	select HAS_MSPM0_SDK
	select HAS_PM
	select HAS_POWEROFF
	select HAS_SEGGER_RTT if ZEPHYR_SEGGER_MODULE
	help
	  Enable support for TI MSPM0L122X_L222X.
```

## soc/ti/mspm0/mspm0l122x_l222x/Kconfig.defconfig
```kconfig
# TI MSPM0L122X_L222X

# Copyright (c) 2024 Texas Instruments
# SPDX-License-Identifier: Apache-2.0

if SOC_SERIES_MSPM0L122X_L222X

config SYS_CLOCK_HW_CYCLES_PER_SEC
	default "$(DT_MSPM0_CLKMUX_CPU_FREQ)" if "$(dt_nodelabel_enabled,clkmux)"

rsource "Kconfig.defconfig.mspm0l*"

endif # SOC_SERIES_MSPM0L122X_L222X
```

## soc/ti/mspm0/mspm0l122x_l222x/Kconfig.defconfig.mspm0l1227
```kconfig
# TI MSPM0L1227 SoC

# Copyright (c) 2024 Texas Instruments
# SPDX-License-Identifier: Apache-2.0

if SOC_MSPM0L1227

config SOC
	default "mspm0l1227"

config NUM_IRQS
	default 32

endif # SOC_MSPM0L1227
```

## soc/ti/mspm0/mspm0l122x_l222x/Kconfig.defconfig.mspm0l2228
```kconfig
# TI MSPM0L2228 SoC

# Copyright (c) 2024 Texas Instruments
# SPDX-License-Identifier: Apache-2.0

if SOC_MSPM0L222X

config SOC
	default "mspm0l2228"

config NUM_IRQS
	default 32

endif # SOC_MSPM0L2228
```

## soc/ti/mspm0/mspm0l122x_l222x/Kconfig.soc
```kconfig
# Copyright (c) 2024 Texas Instruments
# SPDX-License-Identifier: Apache-2.0

config SOC_SERIES_MSPM0L122X_L222X
	bool 
	select SOC_FAMILY_TI_MSPM0
	help 
		Enable support for TI MSPM0L122X_L222X SoCs

config SOC_MSPM0L222X
	bool
	select SOC_SERIES_MSPM0L122X_L222X

config SOC_MSPM0L122X
	bool
	select SOC_SERIES_MSPM0L122X_L222X

config SOC_SERIES
	default "mspm0l122x_l222x" if SOC_SERIES_MSPM0L122X_L222X

config SOC
	default "mspm0l222x" if SOC_MSPM0L222X
	default "mspm0l122x" if SOC_MSPM0L122X
```

## soc/ti/simplelink/Kconfig.defconfig
```kconfig
# SPDX-License-Identifier: Apache-2.0
# Copyright (c) 2017 Zephyr Contributors

if SOC_FAMILY_TI_SIMPLELINK

rsource "*/Kconfig.defconfig"

endif # SOC_FAMILY_TI_SIMPLELINK
```

## soc/ti/simplelink/Kconfig.soc
```kconfig
# Texas Instruments SimpleLink Family
# SPDX-License-Identifier: Apache-2.0
# Copyright (c) 2017 Zephyr Contributors

config SOC_FAMILY_TI_SIMPLELINK
	bool

config SOC_FAMILY
	default "ti_simplelink" if SOC_FAMILY_TI_SIMPLELINK

rsource "*/Kconfig.soc"
```

## soc/ti/simplelink/cc13x2_cc26x2/Kconfig.soc
```kconfig
# Texas Instruments SimpleLink CC13x2 / CC26x2

# Copyright (c) 2019 Brett Witherspoon
# SPDX-License-Identifier: Apache-2.0

config SOC_SERIES_CC13X2_CC26X2
	bool
	select SOC_FAMILY_TI_SIMPLELINK
	help
	  Enable support for TI SimpleLink CC13x2 / CC26x2 SoCs

config SOC_CC1352P
	bool
	select SOC_SERIES_CC13X2_CC26X2
	help
	  CC1352P

config SOC_CC1352R
	bool
	select SOC_SERIES_CC13X2_CC26X2
	help
	  CC1352R

config SOC_CC2652P
	bool
	select SOC_SERIES_CC13X2_CC26X2
	help
	  CC2652P

config SOC_CC2652R
	bool
	select SOC_SERIES_CC13X2_CC26X2
	help
	  CC2652R

config SOC_SERIES
	default "cc13x2_cc26x2" if SOC_SERIES_CC13X2_CC26X2

config SOC
	default "cc1352p" if SOC_CC1352P
	default "cc1352r" if SOC_CC1352R
	default "cc2652p" if SOC_CC2652P
	default "cc2652r" if SOC_CC2652R
```

## soc/ti/simplelink/cc13x2x7_cc26x2x7/Kconfig
```kconfig
# Texas Instruments SimpleLink CC13x2 / CC26x2
# Copyright (c) 2022 Vaishnav Achath
# SPDX-License-Identifier: Apache-2.0

config SOC_SERIES_CC13X2X7_CC26X2X7
	bool
	select ARM
	select CPU_CORTEX_M4
	select CPU_HAS_ARM_MPU
	select DYNAMIC_INTERRUPTS
	select CPU_CORTEX_M_HAS_DWT
	select CPU_HAS_FPU
	select HAS_CC13X2X7_CC26X2X7_SDK
	select HAS_TI_CCFG if !BOOTLOADER_MCUBOOT
	select HAS_SEGGER_RTT if ZEPHYR_SEGGER_MODULE
	select HAS_PM
	select SOC_EARLY_INIT_HOOK
	select PINCTRL

menu "Customer Configuration (CCFG)"
depends on SOC_SERIES_CC13X2X7_CC26X2X7

config CC13X2_CC26X2_BOOST_MODE
	bool "Radio boost mode (VDDR_HH)"
	help
	  Enable the radio boost mode +14dBm (sets CCFG_FORCE_VDDR_HH to 1).

config CC13X2_CC26X2_HAS_CUSTOM_RF_HWATTRS
	bool "Board defines custom RFCC26XX hwAttrs structure"
	help
	  The board defines its own RFCC26XX_hwAttrs structure (e.g., for
	  custom antenna switching callback).

config CC13X2_CC26X2_BOOTLOADER_ENABLE
	bool "ROM bootloader"
	help
	  Enable the serial bootloader which resides in ROM on CC13xx / CC26xx
	  devices.

config CC13X2_CC26X2_BOOTLOADER_BACKDOOR_ENABLE
	bool "ROM bootloader backdoor"
	depends on CC13X2_CC26X2_BOOTLOADER_ENABLE
	help
	  Enable the ROM bootloader backdoor which starts the bootloader if the
	  associated pin is at the correct logic level on reset.

config CC13X2_CC26X2_BOOTLOADER_BACKDOOR_PIN
	int "ROM bootloader backdoor pin"
	depends on CC13X2_CC26X2_BOOTLOADER_BACKDOOR_ENABLE
	range 0 $(UINT8_MAX)
	default $(UINT8_MAX)
	help
	  Set the pin that is level checked if the bootloader backdoor is
	  enabled.

config CC13X2_CC26X2_BOOTLOADER_BACKDOOR_LEVEL
	int "ROM bootloader backdoor level"
	depends on CC13X2_CC26X2_BOOTLOADER_BACKDOOR_ENABLE
	range 0 1
	default 0
	help
	  Set the active level of the pin selected for the bootloader backdoor.

config CC13X2_CC26X2_XOSC_CAPARRAY_DELTA
	hex "Cap array tuning delta"
	range 0 0xFF
	default 0xD5
	help
	  Enable a specific cap array tunning delta.

endmenu
```

## soc/ti/simplelink/cc13x2x7_cc26x2x7/Kconfig.soc
```kconfig
# Texas Instruments SimpleLink CC13x2 / CC26x2
# Copyright (c) 2022 Vaishnav Achath
# SPDX-License-Identifier: Apache-2.0

config SOC_SERIES_CC13X2X7_CC26X2X7
	bool
	select SOC_FAMILY_TI_SIMPLELINK
	help
	  Enable support for TI SimpleLink CC13x2x7 / CC26x2x7 SoCs

config SOC_CC1352P7
	bool
	select SOC_SERIES_CC13X2X7_CC26X2X7
	help
	  CC1352P7

config SOC_CC1352R7
	bool
	select SOC_SERIES_CC13X2X7_CC26X2X7
	help
	  CC1352R7

config SOC_CC2652P7
	bool
	select SOC_SERIES_CC13X2X7_CC26X2X7
	help
	  CC2652P7

config SOC_CC2652R7
	bool
	select SOC_SERIES_CC13X2X7_CC26X2X7
	help
	  CC2652R7

config SOC_SERIES
	default "cc13x2x7_cc26x2x7" if SOC_SERIES_CC13X2X7_CC26X2X7

config SOC
	default "cc1352p7" if SOC_CC1352P7
	default "cc1352r7" if SOC_CC1352R7
	default "cc2652p7" if SOC_CC2652P7
	default "cc2652r7" if SOC_CC2652R7
```

## soc/ti/simplelink/cc23x0/Kconfig.defconfig
```kconfig
# Texas Instruments SimpleLink CC23X0

# Copyright (c) 2024 Texas Instruments Incorporated
# Copyright (c) 2024 BayLibre, SAS
#
# SPDX-License-Identifier: Apache-2.0

if SOC_SERIES_CC23X0

config SYS_CLOCK_HW_CYCLES_PER_SEC
	default $(dt_node_int_prop_int,/cpus/cpu@0,clock-frequency)

if CC23X0_RTC_TIMER
	config SYS_CLOCK_HW_CYCLES_PER_SEC
		default 32768

	config SYS_CLOCK_TICKS_PER_SEC
		default 125375
endif
if CC23X0_SYSTIM_TIMER
	config SYS_CLOCK_HW_CYCLES_PER_SEC
		default 48000000

	config SYS_CLOCK_TICKS_PER_SEC
		default 1000
endif

config NUM_IRQS
	default 19

config BUILD_OUTPUT_BIN
	default n

endif
```

## soc/ti/simplelink/cc23x0/Kconfig.soc
```kconfig
# Copyright (c) 2024 Texas Instruments Incorporated
# Copyright (c) 2024 BayLibre, SAS
#
# SPDX-License-Identifier: Apache-2.0

config SOC_SERIES_CC23X0
	bool
	select SOC_FAMILY_TI_SIMPLELINK
	help
	  Enable support for TI SimpleLink CC23X0 series SOCs.

config SOC_CC2340R5
	bool
	select SOC_SERIES_CC23X0
	help
	  CC2340R5

config SOC_SERIES
	default "cc23x0" if SOC_SERIES_CC23X0

config SOC
	default "cc2340r5" if SOC_CC2340R5
```

## soc/ti/simplelink/cc32xx/Kconfig
```kconfig
# Texas Instruments CC32XX
# SPDX-License-Identifier: Apache-2.0
# Copyright (c) 2016-2017, Texas Instruments Incorporated

config SOC_SERIES_CC32XX
	select ARM
	select CPU_CORTEX_M4
	select CPU_CORTEX_M_HAS_DWT
	select DYNAMIC_INTERRUPTS

config SOC_CC3220SF
	select HAS_CC3220SDK

config SOC_CC3235SF
	select HAS_CC3220SDK

config CC3220SF_DEBUG
	bool "Prepend debug header, disabling flash verification" if XIP
	default XIP
	depends on SOC_CC3220SF

config CC3235SF_DEBUG
	bool "Prepend debug header, disabling flash verification" if XIP
	default XIP
	depends on SOC_CC3235SF
```

## soc/ti/simplelink/cc32xx/Kconfig.defconfig
```kconfig
# TI SimpleLink Family
# SPDX-License-Identifier: Apache-2.0
# Copyright (c) 2016-2017, Texas Instruments Incorporated

if SOC_SERIES_CC32XX

rsource "Kconfig.defconfig.cc32*"

endif # SOC_SERIES_CC32XX
```

## soc/ti/simplelink/cc32xx/Kconfig.soc
```kconfig
# TI SimpleLink CC32xx
# SPDX-License-Identifier: Apache-2.0
# Copyright (c) 2016-2017, Texas Instruments Incorporated

config SOC_SERIES_CC32XX
	bool
	select SOC_FAMILY_TI_SIMPLELINK
	help
	  Enable support for TI SimpleLink CC32xx

config SOC_CC3220SF
	bool
	select SOC_SERIES_CC32XX
	help
	  CC3220SF

config SOC_CC3235SF
	bool
	select SOC_SERIES_CC32XX
	help
	  CC3235SF

config SOC_SERIES
	default "cc32xx" if SOC_SERIES_CC32XX

config SOC
	default "cc3220sf" if SOC_CC3220SF
	default "cc3235sf" if SOC_CC3235SF
```

## soc/ti/simplelink/msp432p4xx/Kconfig
```kconfig
# Texas Instruments MSP432P401R
# Copyright (c) 2017, Linaro Ltd
# SPDX-License-Identifier: Apache-2.0

config SOC_SERIES_MSP432P4XX
	select ARM
	select CPU_CORTEX_M4
	select CPU_CORTEX_M_HAS_DWT
	select DYNAMIC_INTERRUPTS
	select CPU_HAS_FPU
	select CPU_HAS_ARM_MPU

config SOC_MSP432P401R
	select HAS_MSP432P4XXSDK
```

## soc/ti/simplelink/msp432p4xx/Kconfig.defconfig
```kconfig
# TI SimpleLink MSP432P4XX
# Copyright (c) 2017, Linaro Ltd
# SPDX-License-Identifier: Apache-2.0

if SOC_SERIES_MSP432P4XX

rsource "Kconfig.defconfig.msp432p4*"

endif # SOC_SERIES_MSP432P4XX
```

## soc/ti/simplelink/msp432p4xx/Kconfig.soc
```kconfig
# Texas Instruments MSP432P401R
# Copyright (c) 2017, Linaro Ltd
# SPDX-License-Identifier: Apache-2.0

config SOC_SERIES_MSP432P4XX
	bool
	select SOC_FAMILY_TI_SIMPLELINK
	help
	  Enable support for TI SimpleLink MSP432P4XX.

config SOC_MSP432P401R
	bool
	select SOC_SERIES_MSP432P4XX
	help
	  MSP432P401R

config SOC_SERIES
	default "msp432p4xx" if SOC_SERIES_MSP432P4XX

config SOC
	default "msp432p401r" if SOC_MSP432P401R
```

## soc/ti/tiva_c/Kconfig
```kconfig
# SPDX-License-Identifier: Apache-2.0
#
# Copyright (c) 2026 Linumiz
# Author: Sri Surya <srisurya@linumiz.com>


if SOC_FAMILY_TI_TIVA_C

rsource "*/Kconfig"

endif # SOC_FAMILY_TI_TIVA_C
```

## soc/ti/tiva_c/Kconfig.defconfig
```kconfig
# SPDX-License-Identifier: Apache-2.0
#
# Copyright (c) 2026 Linumiz
# Author: Sri Surya <srisurya@linumiz.com>

# TI Tiva C Series platform configuration defaults

if SOC_FAMILY_TI_TIVA_C

rsource "*/Kconfig.defconfig"

endif # SOC_FAMILY_TI_TIVA_C
```

## soc/ti/tiva_c/Kconfig.soc
```kconfig
# SPDX-License-Identifier: Apache-2.0
#
# Copyright (c) 2026 Linumiz
# Author: Sri Surya <srisurya@linumiz.com>

config SOC_FAMILY_TI_TIVA_C
	bool

config SOC_FAMILY
	default "ti_tiva_c" if SOC_FAMILY_TI_TIVA_C

rsource "*/Kconfig.soc"
```

## soc/ti/tiva_c/tm4c123x/Kconfig
```kconfig
# SPDX-License-Identifier: Apache-2.0
#
# Copyright (c) 2026 Linumiz
# Author: Sri Surya <srisurya@linumiz.com>

# TI Tiva C TM4C123x Series

config SOC_SERIES_TM4C123X
	select ARM
	select CPU_CORTEX_M4
	select CPU_CORTEX_M_HAS_DWT
	select CPU_HAS_ARM_MPU
	select CPU_HAS_FPU
	select PINCTRL
	select HAS_TIVAWARE
	select BUILD_OUTPUT_HEX
	select SOC_EARLY_INIT_HOOK
```

## soc/ti/tiva_c/tm4c123x/Kconfig.defconfig
```kconfig
# SPDX-License-Identifier: Apache-2.0
#
# Copyright (c) 2026 Linumiz
# Author: Sri Surya <srisurya@linumiz.com>

# TI Tiva C TM4C123x Series defaults

if SOC_SERIES_TM4C123X

config NUM_IRQS
	default 139

config SYS_CLOCK_HW_CYCLES_PER_SEC
	default $(dt_node_int_prop_int,$(dt_nodelabel_path,sysclk),clock-frequency)

endif # SOC_SERIES_TM4C123X
```

## soc/ti/tiva_c/tm4c123x/Kconfig.soc
```kconfig
# SPDX-License-Identifier: Apache-2.0
#
# Copyright (c) 2026 Linumiz
# Author: Sri Surya <srisurya@linumiz.com>

# TI Tiva C TM4C123x Series

config SOC_SERIES_TM4C123X
	bool
	select SOC_FAMILY_TI_TIVA_C

config SOC_SERIES
	default "tm4c123x" if SOC_SERIES_TM4C123X

config SOC_TI_TM4C123GH6PM
	bool
	select SOC_SERIES_TM4C123X
	help
	  TI Tiva C Series TM4C123GH6PM (ARM Cortex-M4F, 80 MHz,
	  256 KB Flash, 32 KB SRAM)

config SOC
	default "ti_tm4c123gh6pm" if SOC_TI_TM4C123GH6PM
```
