## soc/ti/simplelink/cc32xx/Kconfig.defconfig.cc3235sf
```kconfig
# TI SimpleLink CC3235SF SoC
# Copyright (c) 2019, Texas Instruments Incorporated
# SPDX-License-Identifier: Apache-2.0

if SOC_CC3235SF

config NUM_IRQS
	# must be >= the highest interrupt number used
	# This includes the NWP interrupt
	default 179

config ROM_START_OFFSET
	default 0x800 if XIP
	default 0x0   if !XIP

endif # SOC_CC3235SF
```

## soc/ti/simplelink/cc35xxe/Kconfig
```kconfig
# Copyright (c) 2025 Conclusive Engineering Sp. z o.o.
# Texas Instruments CC35XXE
# SPDX-License-Identifier: Apache-2.0

config SOC_SERIES_CC35XXE
	select ARM
	select CPU_CORTEX_M33
	select CPU_HAS_ARM_SAU
	select CPU_HAS_ARM_MPU
	select CPU_HAS_FPU
	select HAS_CC35XX_SDK
	select ARMV8_M_DSP
	select DYNAMIC_INTERRUPTS
```

## soc/ti/simplelink/cc35xxe/Kconfig.defconfig
```kconfig
# Copyright (c) 2025 Conclusive Engineering Sp. z o.o.
# Texas Instruments SimpleLink Family
# SPDX-License-Identifier: Apache-2.0

if SOC_SERIES_CC35XXE

rsource "Kconfig.defconfig.cc35*e"

endif # SOC_SERIES_CC35XXE
```

## soc/ti/simplelink/cc35xxe/Kconfig.defconfig.cc3551e
```kconfig
# Copyright (c) 2025 Conclusive Engineering Sp. z o.o.
# Texas Instruments SimpleLink CC3551E SoC
# SPDX-License-Identifier: Apache-2.0

if SOC_SERIES_CC35XXE

config SYS_CLOCK_HW_CYCLES_PER_SEC
	int
	default 1000000 if CC35XX_RTC_TIMER
	default 160000000 if !CC35XX_RTC_TIMER

config SYS_CLOCK_TICKS_PER_SEC
	int
	default 1000

config NUM_IRQS
	int
	default 53

config CORTEX_M_SYSTICK
	default y if !CC35XX_RTC_TIMER
	default n if CC35XX_RTC_TIMER

config XIP
	bool
	default n

config FLASH_LOAD_OFFSET
	hex
	default 0x2000 if XIP
	default 0x0 if !XIP

config ROM_START_OFFSET
	hex
	default 0x0

config SYSTEM_WORKQUEUE_STACK_SIZE
	default 2048

endif # SOC_SERIES_CC35XXE
```

## soc/ti/simplelink/cc35xxe/Kconfig.soc
```kconfig
# Copyright (c) 2025 Conclusive Engineering Sp. z o.o.
#
# SPDX-License-Identifier: Apache-2.0

config SOC_SERIES_CC35XXE
	bool
	select SOC_FAMILY_TI_SIMPLELINK
	help
	  Enable support for TI SimpleLink CC35xxE SoCs

config SOC_CC3500E
	bool
	select SOC_SERIES_CC35XXE
	select SOC_CC35XXE_HAS_WIFI

config SOC_CC3501E
	bool
	select SOC_SERIES_CC35XXE
	select SOC_CC35XXE_HAS_WIFI
	select SOC_CC35XXE_HAS_BT

config SOC_CC3550E
	bool
	select SOC_SERIES_CC35XXE
	select SOC_CC35XXE_HAS_WIFI
	select SOC_CC35XXE_HAS_WIFI_5GHZ

config SOC_CC3551E
	bool
	select SOC_SERIES_CC35XXE
	select SOC_CC35XXE_HAS_WIFI
	select SOC_CC35XXE_HAS_WIFI_5GHZ
	select SOC_CC35XXE_HAS_BT

config SOC_CC35XXE_HAS_WIFI
	bool

config SOC_CC35XXE_HAS_WIFI_5GHZ
	bool

config SOC_CC35XXE_HAS_BT
	bool

config SOC_SERIES
	string
	default "cc35xxe" if SOC_SERIES_CC35XXE

config SOC
	string
	default "cc3500e" if SOC_CC3500E
	default "cc3501e" if SOC_CC3501E
	default "cc3550e" if SOC_CC3550E
	default "cc3551e" if SOC_CC3551E

config CC35XXE_SIGN_PRIVATE_KEY_FILE
	string "Path to the private key used to sign the image"

config CC35XXE_SIGN_PUBLIC_KEY_FILE
	string "Path to the public key used to sign the image"

config CC35XXE_FLASH_DISCOVERY_CONFIG_OTFDE
	string "Path to the OTFDE configuration file"

config CC35XXE_FLASH_DISCOVERY_CONFIG_EXT_MEM
	string "Path to the external memory configuration file"

config CC35XXE_FLASH_DISCOVERY_CONFIG_XSPI
	string "Path to the xSPI configuration file"

choice CC35XXE_FLASH_PROFILE_SELECT
	prompt "External flash configuration profile"
	default CC35XXE_FLASH_PROFILE_IS25WJ032F
	help
	  Select the board flash profile used by the SimpleLink toolbox image
	  builder. The profile name maps to a directory under the board
	  config/flash directory. Explicit CC35XXE_FLASH_DISCOVERY_CONFIG_*
	  paths override this profile.

config CC35XXE_FLASH_PROFILE_GD25LF32E
	bool "gd25lf32e"

config CC35XXE_FLASH_PROFILE_GD25LF64E
	bool "gd25lf64e"

config CC35XXE_FLASH_PROFILE_IS25WJ032F
	bool "is25wj032f"

config CC35XXE_FLASH_PROFILE_IS25WJ064F
	bool "is25wj064f"

config CC35XXE_FLASH_PROFILE_IS25WJ128F
	bool "is25wj128f"

config CC35XXE_FLASH_PROFILE_MX25U12843G
	bool "mx25u12843g"

config CC35XXE_FLASH_PROFILE_MX25U3235F
	bool "mx25u3235f"

config CC35XXE_FLASH_PROFILE_MX25U6435F
	bool "mx25u6435f"

config CC35XXE_FLASH_PROFILE_PY25Q128LA
	bool "py25q128la"

config CC35XXE_FLASH_PROFILE_PY25Q256LC
	bool "py25q256lc"

config CC35XXE_FLASH_PROFILE_PY25Q32LB
	bool "py25q32lb"

config CC35XXE_FLASH_PROFILE_PY25Q64LB
	bool "py25q64lb"

config CC35XXE_FLASH_PROFILE_W25Q12PW
	bool "w25q12pw"

config CC35XXE_FLASH_PROFILE_W25Q32JW
	bool "w25q32jw"

config CC35XXE_FLASH_PROFILE_W25Q33PW
	bool "w25q33pw"

config CC35XXE_FLASH_PROFILE_W25Q64JW
	bool "w25q64jw"

config CC35XXE_FLASH_PROFILE_W25Q64PW
	bool "w25q64pw"

endchoice

config CC35XXE_FLASH_PROFILE
	string
	default "gd25lf32e" if CC35XXE_FLASH_PROFILE_GD25LF32E
	default "gd25lf64e" if CC35XXE_FLASH_PROFILE_GD25LF64E
	default "is25wj032f" if CC35XXE_FLASH_PROFILE_IS25WJ032F
	default "is25wj064f" if CC35XXE_FLASH_PROFILE_IS25WJ064F
	default "is25wj128f" if CC35XXE_FLASH_PROFILE_IS25WJ128F
	default "mx25u12843g" if CC35XXE_FLASH_PROFILE_MX25U12843G
	default "mx25u3235f" if CC35XXE_FLASH_PROFILE_MX25U3235F
	default "mx25u6435f" if CC35XXE_FLASH_PROFILE_MX25U6435F
	default "py25q128la" if CC35XXE_FLASH_PROFILE_PY25Q128LA
	default "py25q256lc" if CC35XXE_FLASH_PROFILE_PY25Q256LC
	default "py25q32lb" if CC35XXE_FLASH_PROFILE_PY25Q32LB
	default "py25q64lb" if CC35XXE_FLASH_PROFILE_PY25Q64LB
	default "w25q12pw" if CC35XXE_FLASH_PROFILE_W25Q12PW
	default "w25q32jw" if CC35XXE_FLASH_PROFILE_W25Q32JW
	default "w25q33pw" if CC35XXE_FLASH_PROFILE_W25Q33PW
	default "w25q64jw" if CC35XXE_FLASH_PROFILE_W25Q64JW
	default "w25q64pw" if CC35XXE_FLASH_PROFILE_W25Q64PW

config CC35XXE_FUSE_CONFIG
	string "Path to the fuse configuration file"

config CC35XXE_ACTION_PARAMS_FILE
	string "Path to the action parameters file"

config CC35XXE_TOOL_SETTINGS_FILE
	string "Path to the SimpleLink toolbox settings file"

config CC35XXE_CONF_INI_FILE
	string "Path to the cc35xx-conf.ini file"
	help
	  Override the default cc35xx-conf.ini file used to generate
	  cc35xx-conf.bin during the build. If left empty, the in-tree
	  default at soc/ti/simplelink/cc35xxe/conf/cc35xx-conf.ini is
	  used.

config CC35XXE_VENDOR_IMAGE_VERSION
	string "TI CC35xx vendor image version"
	default "0.0.1.0"
	help
	  Version passed to the SimpleLink Wi-Fi Toolbox when generating
	  vendor_image.sign.bin. The format is major.minor.patch.other.

config CC35XXE_GENERATE_FLASH_MAP_CONFIG
	bool "Generate TI flash map config from MemoryConfigurator JSON"
	help
	  Generate ti_flash_map_config.c during the build from a SimpleLink
	  Wi-Fi Toolbox MemoryConfigurator JSON file.

config CC35XXE_MEMORY_CONFIG_JSON
	string "Path to the MemoryConfigurator JSON file"
	depends on CC35XXE_GENERATE_FLASH_MAP_CONFIG
	help
	  Override the default MemoryConfigurator JSON file used to generate
	  ti_flash_map_config.c. If left empty, the board flash profile's
	  external_memory_configurator.json is used.

config CC35XXE_FWU
	bool "TI CC35xx PSA firmware update support"
	help
	  Build the TI CC35xx PSA Firmware Update implementation from the
	  SimpleLink SDK. This provides psa_fwu_* APIs for inspecting and
	  managing TI bootloader OTA slots.
```

## soc/ti/simplelink/msp432p4xx/Kconfig.defconfig.msp432p401r
```kconfig
# TI SimpleLink MSP432P401R SoC
# Copyright (c) 2017, Linaro Ltd
# SPDX-License-Identifier: Apache-2.0

if SOC_MSP432P401R

config NUM_IRQS
	default 64

endif # SOC_MSP432P401R
```

## soc/ti/tiva_c/tm4c129x/Kconfig.defconfig
```kconfig
# SPDX-License-Identifier: Apache-2.0
#
# Copyright (c) 2026 Linumiz
# Author: Sri Surya <srisurya@linumiz.com>

# TI Tiva C TM4C129x Series defaults

if SOC_SERIES_TM4C129X

config NUM_IRQS
	default 114

config SYS_CLOCK_HW_CYCLES_PER_SEC
	default $(dt_node_int_prop_int,$(dt_nodelabel_path,sysclk),clock-frequency)

endif # SOC_SERIES_TM4C129X
```

## soc/ti/tiva_c/tm4c129x/Kconfig.soc
```kconfig
# SPDX-License-Identifier: Apache-2.0
#
# Copyright (c) 2026 Linumiz
# Author: Sri Surya <srisurya@linumiz.com>

# TI Tiva C TM4C129x Series

config SOC_SERIES_TM4C129X
	bool
	select SOC_FAMILY_TI_TIVA_C

config SOC_SERIES
	default "tm4c129x" if SOC_SERIES_TM4C129X

config SOC_TI_TM4C129ENCPDT
	bool
	select SOC_SERIES_TM4C129X
	help
	  TI Tiva C Series TM4C129ENCPDT (ARM Cortex-M4F, 120 MHz,
	  1 MB Flash, 256 KB SRAM)

config SOC
	default "ti_tm4c129encpdt" if SOC_TI_TM4C129ENCPDT
```

## soc/wch/ch32v/Kconfig.defconfig
```kconfig
# Copyright (c) 2024 Michael Hope
# Copyright (c) 2024 Jianxiong Gu
# SPDX-License-Identifier: Apache-2.0

if SOC_FAMILY_CH32V

rsource "*/Kconfig.defconfig"

configdefault FLASH_FILL_BUFFER_SIZE
	default 256 if FLASH

endif # SOC_FAMILY_CH32V
```

## soc/wch/ch32v/qingke_v3c/Kconfig.defconfig
```kconfig
# SPDX-FileCopyrightText: 2026 SMILE (smile.eu)
# SPDX-License-Identifier: Apache-2.0

if SOC_SERIES_QINGKE_V3C

config TIMER_READS_ITS_FREQUENCY_AT_RUNTIME
	default y

config CLOCK_CONTROL
	default y

rsource "Kconfig.defconfig.*"

endif # SOC_SERIES_QINGKE_V3C
```

## soc/xlnx/mbv32/Kconfig
```kconfig
#
# Copyright (c) 2026 Advanced Micro Devices, Inc.
#
# SPDX-License-Identifier: Apache-2.0
#

config SOC_MBV32
	select RISCV
	select INCLUDE_RESET_VECTOR
```

## soc/xlnx/mbv32/Kconfig.defconfig
```kconfig
#
# Copyright (c) 2026 Advanced Micro Devices, Inc.
#
# SPDX-License-Identifier: Apache-2.0
#

if SOC_MBV32

config NUM_IRQS
	default 44

endif # SOC_MBV32
```
