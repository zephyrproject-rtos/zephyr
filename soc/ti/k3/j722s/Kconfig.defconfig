## soc/ti/k3/j722s/Kconfig.defconfig
```kconfig
# Copyright (c) 2023 Enphase Energy
# Copyright (c) 2026 Siemens Mobility GmbH
# SPDX-License-Identifier: Apache-2.0

if SOC_SERIES_J722S

config KERNEL_ENTRY
	default "_vector_table" if SOC_SERIES_J722S_R5

config NUM_IRQS
	default 2048 if SOC_SERIES_J722S_R5 && TI_SCI_INTR && DT_HAS_TI_SCI_INTR_OUT_ENABLED
	default 512 if SOC_SERIES_J722S_R5

if SOC_SERIES_J722S_R5 && TI_SCI_INTR && DT_HAS_TI_SCI_INTR_OUT_ENABLED

config MULTI_LEVEL_INTERRUPTS
	default y

config 2ND_LEVEL_INTERRUPTS
	default y

config 1ST_LEVEL_INTERRUPT_BITS
	default 8

config 2ND_LEVEL_INTERRUPT_BITS
	default 8

config MAX_IRQ_PER_AGGREGATOR
	default 192

config NUM_2ND_LEVEL_AGGREGATORS
	default 8

config 2ND_LVL_ISR_TBL_OFFSET
	default 512

# MAIN GPIOMUX IR outs 16..19,20..21,32..33 -> VIM 104..107,56..57,58..59
config 2ND_LVL_INTR_00_OFFSET
	default 104

config 2ND_LVL_INTR_01_OFFSET
	default 105

config 2ND_LVL_INTR_02_OFFSET
	default 106

config 2ND_LVL_INTR_03_OFFSET
	default 107

config 2ND_LVL_INTR_04_OFFSET
	default 56

config 2ND_LVL_INTR_05_OFFSET
	default 57

config 2ND_LVL_INTR_06_OFFSET
	default 58

config 2ND_LVL_INTR_07_OFFSET
	default 59

endif # SOC_SERIES_J722S_R5 && TI_SCI_INTR && DT_HAS_TI_SCI_INTR_OUT_ENABLED

configdefault UART_NS16550_TI_K3
	default y if SOC_SERIES_J722S_R5

if SERIAL

choice UART_NS16550_VARIANT
	default UART_NS16550_VARIANT_NS16750
endchoice

endif # SERIAL

config BUILD_OUTPUT_BIN
	default n if SOC_SERIES_J722S_R5

endif # SOC_SERIES_J722S
```

## soc/ti/mspm/mspm0g/Kconfig.defconfig
```kconfig
# TI MSPM0G series

# Copyright (c) 2025 Texas Instruments
# Copyright (c) 2025 Linumiz
# SPDX-License-Identifier: Apache-2.0

if SOC_SERIES_MSPM0G

config NUM_IRQS
	default 32

if SHARED_INTERRUPTS

configdefault SHARED_IRQ_MAX_NUM_CLIENTS
	default 7

endif # SHARED_INTERRUPTS

endif # SOC_SERIES_MSPM0G
```

## soc/ti/mspm/mspm0l/Kconfig.defconfig
```kconfig
# TI MSPM0L series

# Copyright (c) 2025 Texas Instruments
# Copyright (c) 2025 Linumiz GmbH
# SPDX-License-Identifier: Apache-2.0

if SOC_SERIES_MSPM0L

config NUM_IRQS
	default 32

if SHARED_INTERRUPTS

configdefault SHARED_IRQ_MAX_NUM_CLIENTS
	default 6

endif # SHARED_INTERRUPTS

endif # SOC_SERIES_MSPM0L
```

## soc/ti/simplelink/Kconfig
```kconfig
# Texas Instruments SimpleLink Family
# SPDX-License-Identifier: Apache-2.0
# Copyright (c) 2017 Zephyr Contributors

if SOC_FAMILY_TI_SIMPLELINK

rsource "*/Kconfig"

config HAS_TI_CCFG
	bool
	help
	  Selected when CCFG (Customer Configuration) registers
	  appear at the end of flash

config TI_SIMPLELINK_DYNAMIC_DPL_OBJECTS
	bool
	help
	  Turn on dynamic memory allocation for DPL objects. Reserves
	  extra memory for this.

config TI_DPL_TASK_POOL_SIZE
	int "Number of pre-allocated TaskP thread stacks"
	depends on TI_SIMPLELINK_DYNAMIC_DPL_OBJECTS
	default 2
	help
	  Number of thread stacks in the TaskP-private pool. This is
	  independent of CONFIG_DYNAMIC_THREAD_POOL_SIZE, which governs
	  the generic Zephyr dynamic thread pool.

config TI_DPL_TASK_STACK_SIZE
	int "Stack size for dynamically created TaskP threads"
	depends on TI_SIMPLELINK_DYNAMIC_DPL_OBJECTS
	default 1500
	help
	  Stack size used by TaskP_create() for each dynamically allocated
	  thread. This is independent of CONFIG_DYNAMIC_THREAD_STACK_SIZE,
	  which governs the generic Zephyr dynamic thread pool and is used
	  by e.g. pthread_create() with a NULL attr argument.

endif # SOC_FAMILY_TI_SIMPLELINK
```

## soc/ti/simplelink/cc13x4_cc26x4/Kconfig
```kconfig
# Copyright (c) 2026 Texas Instruments
# SPDX-License-Identifier: Apache-2.0

if SOC_SERIES_CC13X4_CC26X4

config SOC_SERIES_CC13X4_CC26X4
	select ARM
	select CPU_CORTEX_M33
	select CPU_HAS_FPU
	select ARMV8_M_DSP
	select CPU_HAS_ARM_MPU
	select CPU_HAS_DSP
	select DYNAMIC_INTERRUPTS
	select CPU_CORTEX_M_HAS_DWT
	select HAS_CC13X4_CC26X4_SDK
	select HAS_TI_CCFG if !BOOTLOADER_MCUBOOT
	select HAS_SEGGER_RTT if ZEPHYR_SEGGER_MODULE
	select HAS_PM
	select HAS_POWEROFF

menu "Customer Configuration (CCFG)"

config SOC_SERIES_CC13X4_CC26X4_BOOTLOADER_ENABLE
	bool "ROM bootloader"
	help
	Enable the serial bootloader in ROM on CC13x4/CC26x4 devices.
	Default disabled per TI production recommendation.

config SOC_SERIES_CC13X4_CC26X4_BOOTLOADER_BACKDOOR_ENABLE
	bool "ROM bootloader backdoor"
	depends on SOC_SERIES_CC13X4_CC26X4_BOOTLOADER_ENABLE

config SOC_SERIES_CC13X4_CC26X4_XOSC_CAPARRAY_DELTA
	hex "Cap array tuning delta"
	range 0 0xFF
	default 0xFF

config SOC_SERIES_CC13X4_CC26X4_IDAU_CFG_ENABLE
	bool "custom TrustZone boundary configuration"
	help
	Enables user-defined NSADDR/NSCADDR watermarks for flash and SRAM.
	When disabled, TI factory boundaries apply.

config SOC_SERIES_CC13X4_CC26X4_TZ_FLASH_NS_BOUNDARY
	hex "Flash non-secure address boundary"
	depends on SOC_SERIES_CC13X4_CC26X4_IDAU_CFG_ENABLE
	range 0x0 0x3FF
	default 0x0
	help
	SET_CCFG_TRUSTZONE_FLASH_CFG_NSADDR_BOUNDARY.
	0x0 = all flash except lowest 8KB is non-secure.

config SOC_SERIES_CC13X4_CC26X4_TZ_SRAM_NS_BOUNDARY
	hex "SRAM non-secure address boundary"
	depends on SOC_SERIES_CC13X4_CC26X4_IDAU_CFG_ENABLE
	range 0x0 0x1FF
	default 0x0
	help
	SET_CCFG_TRUSTZONE_SRAM_CFG_NSADDR_BOUNDARY.
	0x0 = all SRAM is non-secure.

config SOC_SERIES_CC13X4_CC26X4_SRAM_PARITY_DISABLE
	bool "Disable SRAM parity"
	help
	Parity is enabled by default. TI recommends keeping it enabled
	for any application with run-time security requirements.

endmenu

endif # SOC_SERIES_CC13X4_CC26X4
```

## soc/ti/simplelink/cc13x4_cc26x4/Kconfig.defconfig
```kconfig
# Copyright (c) 2026 Texas Instruments
# SPDX-License-Identifier: Apache-2.0

if SOC_SERIES_CC13X4_CC26X4

config SYS_CLOCK_HW_CYCLES_PER_SEC
	default $(dt_node_int_prop_int,/rtc-clock,clock-frequency)

config SYS_CLOCK_TICKS_PER_SEC
	default $(dt_node_int_prop_int,/rtc-clock,clock-frequency)

config NUM_IRQS
	default 43

config CORTEX_M_SYSTICK
	default n

endif
```

## soc/ti/simplelink/cc13x4_cc26x4/Kconfig.soc
```kconfig
# Copyright (c) 2026 Texas Instruments
# SPDX-License-Identifier: Apache-2.0

config SOC_SERIES_CC13X4_CC26X4
	bool
	select SOC_FAMILY_TI_SIMPLELINK
	help
	  Enable support for TI SimpleLink CC13x4/cc26x4 SoCs

config SOC_CC1354P10
	bool
	select SOC_SERIES_CC13X4_CC26X4
	help
	  CC1354P10

config SOC_SERIES
	default "cc13x4_cc26x4" if SOC_SERIES_CC13X4_CC26X4

config SOC
	default "cc1354p10" if SOC_CC1354P10
```

## soc/ti/simplelink/cc23x0/Kconfig
```kconfig
# Copyright (c) 2024-2026 Texas Instruments Incorporated
# Copyright (c) 2024 BayLibre, SAS
#
# SPDX-License-Identifier: Apache-2.0

config SOC_SERIES_CC23X0
	select ARM
	select CPU_CORTEX_M0PLUS
	select CPU_CORTEX_M_HAS_VTOR
	select SOC_RESET_HOOK
	select DYNAMIC_INTERRUPTS
	select HAS_CC23X0_SDK
	select HAS_TI_CCFG if !BOOTLOADER_MCUBOOT
	select TI_SIMPLELINK_DYNAMIC_DPL_OBJECTS
	select EVENTS
	select THREAD_STACK_INFO
	select HAS_PM
	select PM_DEVICE if PM
	select HAS_POWEROFF
	select HAS_SEGGER_RTT if ZEPHYR_SEGGER_MODULE

menu "Bootloader Configuration"
depends on SOC_SERIES_CC23X0

choice CC23X0_BLDR_VTOR_TYPE
	prompt "Pointer to user bootloader vector table"
	default CC23X0_BLDR_VTOR_TYPE_UNDEF

config CC23X0_BLDR_VTOR_TYPE_UNDEF
	bool "ROM serial bootloader"

config CC23X0_BLDR_VTOR_TYPE_FORBID
	bool "No bootloader invoked"

config CC23X0_BLDR_VTOR_TYPE_USE_FCFG
	bool "Use factory configuration"

config CC23X0_BLDR_VTOR_TYPE_FLASH
	bool "Use valid main flash address"

endchoice # CC23X0_BLDR_VTOR_TYPE

config CC23X0_BLDR_ENABLED
	bool "Bootloader commands"
	help
	  If n, bootloader ignores all commands.

endmenu # "Bootloader Configuration"
```
