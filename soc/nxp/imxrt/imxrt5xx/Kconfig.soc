## soc/nxp/imxrt/imxrt5xx/Kconfig.soc
```kconfig
# i.MX RT5XX Series

# Copyright 2022-2024, NXP
# SPDX-License-Identifier: Apache-2.0

config SOC_SERIES_IMXRT5XX
	bool
	select SOC_FAMILY_NXP_IMXRT

config SOC_MIMXRT595S
	bool
	select SOC_SERIES_IMXRT5XX

config SOC_MIMXRT595S_CM33
	bool
	select SOC_MIMXRT595S
	help
	  NXP RT5xx CM33 core

config SOC_MIMXRT595S_F1
	bool
	select SOC_MIMXRT595S
	help
	  NXP RT5xx ADSP Series

config SOC_SERIES
	default "imxrt5xx" if SOC_SERIES_IMXRT5XX

config SOC
	default "mimxrt595s" if SOC_MIMXRT595S

config SOC_TOOLCHAIN_NAME
	string
	default "nxp_rt500_adsp" if SOC_MIMXRT595S_F1

config SOC_PART_NUMBER_MIMXRT533SFFOC
	bool

config SOC_PART_NUMBER_MIMXRT555SFFOC
	bool

config SOC_PART_NUMBER_MIMXRT595SFFOC
	bool

config SOC_PART_NUMBER_MIMXRT533SFAWC
	bool

config SOC_PART_NUMBER_MIMXRT555SFAWC
	bool

config SOC_PART_NUMBER_MIMXRT595SFAWC
	bool

config SOC_PART_NUMBER
	default "MIMXRT533SFAWC" if SOC_PART_NUMBER_MIMXRT533SFAWC
	default "MIMXRT555SFAWC" if SOC_PART_NUMBER_MIMXRT555SFAWC
	default "MIMXRT595SFAWC" if SOC_PART_NUMBER_MIMXRT595SFAWC
	default "MIMXRT533SFFOC" if SOC_PART_NUMBER_MIMXRT533SFFOC
	default "MIMXRT555SFFOC" if SOC_PART_NUMBER_MIMXRT555SFFOC
	default "MIMXRT595SFFOC" if SOC_PART_NUMBER_MIMXRT595SFFOC
```

## soc/nxp/imxrt/imxrt6xx/Kconfig
```kconfig
# Copyright 2020, 2024 NXP
# SPDX-License-Identifier: Apache-2.0

config SOC_MIMXRT685S_CM33
	select ARM
	select CPU_CORTEX_M33
	select CPU_CORTEX_M_HAS_DWT
	select CLOCK_CONTROL
	select SOC_RESET_HOOK
	select HAS_PM
	select CPU_HAS_ARM_SAU
	select CPU_HAS_ARM_MPU
	select CPU_HAS_FPU
	select ARMV8_M_DSP
	select ARM_TRUSTZONE_M
	select CPU_CORTEX_M_HAS_SYSTICK
	select HAS_MCUX
	select HAS_MCUX_CACHE
	select INIT_SYS_PLL
	select SOC_EARLY_INIT_HOOK

config SOC_MIMXRT685S_HIFI4
	select XTENSA
	select XTENSA_HAL if ("$(ZEPHYR_TOOLCHAIN_VARIANT)" != "xcc" && "$(ZEPHYR_TOOLCHAIN_VARIANT)" != "xt-clang")
	select XTENSA_RESET_VECTOR
	select XTENSA_USE_CORE_CRT1
	select CLOCK_CONTROL
	select HAS_MCUX
	select SOC_EARLY_INIT_HOOK
	select NXP_INPUTMUX

if SOC_SERIES_IMXRT6XX

config MCUX_CORE_SUFFIX
	default "_cm33" if SOC_MIMXRT685S_CM33
	default "_dsp" if SOC_MIMXRT685S_HIFI4

if SOC_MIMXRT685S_CM33

config INIT_SYS_PLL
	bool "Initialize SYS PLL"

config INIT_AUDIO_PLL
	bool "Initialize Audio PLL"

config XTAL_SYS_CLK_HZ
	int "External oscillator frequency"
	help
	  Set the external oscillator frequency in Hz. This should be set by the
	  board's defconfig.

config SYSOSC_SETTLING_US
	int "System oscillator settling time"
	help
	  Set the board system oscillator settling time in us. This should be set by the
	  board's defconfig.

config IMXRT6XX_CODE_CACHE
	bool "Code cache"
	default y
	help
	  Enable code cache for FlexSPI region at boot. If this Kconfig is
	  cleared, the CACHE64 controller will be disabled during SOC init

endif # SOC_MIMXRT685S_CM33

if SOC_MIMXRT685S_HIFI4

DT_ADSP_RESET_MEM := $(dt_nodelabel_path,adsp_reset)
DT_ADSP_DATA_MEM := $(dt_nodelabel_path,adsp_data)
DT_ADSP_TEXT_MEM := $(dt_nodelabel_path,adsp_text)

config RT685_ADSP_STACK_SIZE
	hex "Boot time stack size"
	default 0x1000
	help
	  Stack space is reserved at the end of the RT685_ADSP_DATA_MEM
	  region, starting at RT685_ADSP_DATA_MEM_ADDR - RT685_ADSP_STACK_SIZE

config RT685_ADSP_RESET_MEM_ADDR
	hex
	default $(dt_node_reg_addr_hex,$(DT_ADSP_RESET_MEM))

config RT685_ADSP_RESET_MEM_SIZE
	hex
	default $(dt_node_reg_size_hex,$(DT_ADSP_RESET_MEM))

config RT685_ADSP_DATA_MEM_ADDR
	hex
	default $(dt_node_reg_addr_hex,$(DT_ADSP_DATA_MEM))

config RT685_ADSP_DATA_MEM_SIZE
	hex
	default $(dt_node_reg_size_hex,$(DT_ADSP_DATA_MEM))

config RT685_ADSP_TEXT_MEM_ADDR
	hex
	default $(dt_node_reg_addr_hex,$(DT_ADSP_TEXT_MEM))

config RT685_ADSP_TEXT_MEM_SIZE
	hex
	default $(dt_node_reg_size_hex,$(DT_ADSP_TEXT_MEM))

endif # SOC_MIMXRT685S_HIFI4

endif # SOC_SERIES_IMXRT6XX
```

## soc/nxp/imxrt/imxrt6xx/Kconfig.defconfig
```kconfig
# i.MX RT6XX series configuration options

# Copyright 2020, 2024 NXP
# SPDX-License-Identifier: Apache-2.0

if SOC_SERIES_IMXRT6XX

# alias for hal
config SOC_SERIES_IMX_RT6XX
	bool
	default y

# another alias for hal
config SOC_SERIES_IMXRT_6XX
	bool
	default y

endif # SOC_SERIES_MIMXRT6XX

if SOC_MIMXRT685S_CM33

config ROM_START_OFFSET
	default 0x1200 if NXP_IMXRT_BOOT_HEADER

config NUM_IRQS
	default 60

config ZTEST_NO_YIELD
	default y if (ZTEST && PM)

# Setup LMA adjustment if using the RAMLOADER feature of ROM
FLASH_CHOSEN := zephyr,flash
FLASH_BASE := $(dt_chosen_reg_addr_hex,$(FLASH_CHOSEN))
FLEXSPI_BASE := $(dt_node_reg_addr_hex,/soc/spi@134000,1)
config BUILD_OUTPUT_ADJUST_LMA
	default "$(FLEXSPI_BASE) - $(FLASH_BASE)" if NXP_IMX_RT_ROM_RAMLOADER

# The base address is determined from the zephyr,flash node with the following
# precedence:
# FlexSPI base address (if flash node is on a FlexSPI bus)
# node reg property (used for memory regions such as SRAM)

# Workaround for not being able to have commas in macro arguments

DT_CHOSEN_Z_FLASH := zephyr,flash
DT_COMPAT_FLEXSPI := nxp,imx-flexspi

# Macros to shorten Kconfig definitions
DT_CHOSEN_FLASH_NODE := $(dt_chosen_path,$(DT_CHOSEN_Z_FLASH))
DT_CHOSEN_FLASH_PARENT := $(dt_node_parent,$(DT_CHOSEN_FLASH_NODE))

config FLASH_BASE_ADDRESS
	default $(dt_node_reg_addr_hex,$(DT_CHOSEN_FLASH_PARENT),1) \
		if $(dt_node_has_compat,$(DT_CHOSEN_FLASH_PARENT),$(DT_COMPAT_FLEXSPI))
	default $(dt_chosen_reg_addr_hex,$(DT_CHOSEN_Z_FLASH))

# The RT6xx has no internal flash. If the flash node has a size property,
# use that over the reg property. This is used for the external flash
# present on the board. Otherwise, fallback to the reg property
config FLASH_SIZE
	default $(dt_node_int_prop_int,$(DT_CHOSEN_FLASH_NODE),size,Kb) \
		if $(dt_node_has_prop,$(DT_CHOSEN_FLASH_NODE),size)
	default $(dt_chosen_reg_size_int,$(DT_CHOSEN_Z_FLASH),0,K)

if FLASH_MCUX_FLEXSPI_XIP

# Avoid RWW hazards by defaulting logging to disabled
choice FLASH_LOG_LEVEL_CHOICE
	default FLASH_LOG_LEVEL_OFF
endchoice

choice MEMC_LOG_LEVEL_CHOICE
	default MEMC_LOG_LEVEL_OFF
endchoice

endif

#
# MBEDTLS is larger but much faster than TinyCrypt so choose wisely
#
config MBEDTLS
#config TINYCRYPT
	default y if CSPRNG_ENABLED
	depends on ENTROPY_GENERATOR

if MBEDTLS
#
# MBEDTLS CTR_DRBG code path needs extra stack space for initialization than
# what the ztest_thread_stack defaults to.
#
config TEST_EXTRA_STACK_SIZE
	int
	default 1024
endif # MBEDTLS

config I2S_MCUX_FLEXCOMM
	select INIT_AUDIO_PLL

if MCUX_OS_TIMER

config SYS_CLOCK_HW_CYCLES_PER_SEC
	default 1000000

endif # MCUX_OS_TIMER

if CORTEX_M_SYSTICK

config SYS_CLOCK_HW_CYCLES_PER_SEC
	default 250105263

endif # CORTEX_M_SYSTICK

choice USB_MCUX_CONTROLLER_TYPE
	default USB_DC_NXP_LPCIP3511
endchoice

endif # SOC_MIMXRT685S_CM33
```

## soc/nxp/imxrt/imxrt6xx/Kconfig.soc
```kconfig
# Copyright 2024 NXP
# SPDX-License-Identifier: Apache-2.0

config SOC_SERIES_IMXRT6XX
	bool
	select SOC_FAMILY_NXP_IMXRT

config SOC_SERIES
	default "imxrt6xx" if SOC_SERIES_IMXRT6XX

config SOC_MIMXRT685S
	bool
	select SOC_SERIES_IMXRT6XX

config SOC
	default "mimxrt685s" if SOC_MIMXRT685S

config SOC_MIMXRT685S_CM33
	bool
	select SOC_MIMXRT685S

config SOC_MIMXRT685S_HIFI4
	bool
	select SOC_MIMXRT685S

config SOC_PART_NUMBER_MIMXRT685SFVKB
	select SOC_MIMXRT685S
	bool

config SOC_PART_NUMBER_MIMXRT685SFFOB
	select SOC_MIMXRT685S
	bool

config SOC_PART_NUMBER_MIMXRT685SFAWBR
	select SOC_MIMXRT685S
	bool

config SOC_PART_NUMBER
	default "MIMXRT685SFVKB" if SOC_PART_NUMBER_MIMXRT685SFVKB
	default "MIMXRT685SFFOB" if SOC_PART_NUMBER_MIMXRT685SFFOB
	default "MIMXRT685SFAWBR" if SOC_PART_NUMBER_MIMXRT685SFAWBR

config SOC_TOOLCHAIN_NAME
	string
	default "nxp_rt600_adsp" if SOC_MIMXRT685S_HIFI4
```

## soc/nxp/imxrt/imxrt7xx/Kconfig
```kconfig
# Copyright 2024-2025 NXP
# SPDX-License-Identifier: Apache-2.0

if SOC_SERIES_IMXRT7XX

rsource "*/Kconfig"

config IMAGE_VECTOR_TABLE_OFFSET
	default 0x4000 if NXP_IMXRT_BOOT_HEADER

config GLIKEY_MCUX_GLIKEY
	default y
	bool "Use glikey MCUX Driver"

endif # SOC_SERIES_IMXRT7XX
```

## soc/nxp/imxrt/imxrt7xx/Kconfig.defconfig
```kconfig
# Copyright 2024-2025 NXP
# SPDX-License-Identifier: Apache-2.0

rsource "*/Kconfig.defconfig"

config MFD
	default y if DT_HAS_NXP_LP_FLEXCOMM_ENABLED

# Default offset 0x200 is not enough with higher ISR count
config ROM_START_OFFSET
	default 0x400 if BOOTLOADER_MCUBOOT
```

## soc/nxp/imxrt/imxrt7xx/Kconfig.soc
```kconfig
# Copyright 2024-2025 NXP
# SPDX-License-Identifier: Apache-2.0

config SOC_SERIES_IMXRT7XX
	bool
	select SOC_FAMILY_NXP_IMXRT

config SOC_MIMXRT798S
	bool
	select SOC_SERIES_IMXRT7XX

config SOC_SERIES
	default "imxrt7xx" if SOC_SERIES_IMXRT7XX

config SOC
	default "mimxrt798s" if SOC_MIMXRT798S

config SOC_MIMXRT798S_CM33_CPU0
	bool
	select SOC_MIMXRT798S

config SOC_MIMXRT798S_CM33_CPU1
	bool
	select SOC_MIMXRT798S

config SOC_MIMXRT798S_HIFI4
	bool
	select SOC_MIMXRT798S
	help
	  NXP i.MXRT7xx HiFi4 DSP Core

config SOC_MIMXRT798S_HIFI1
	bool
	select SOC_MIMXRT798S
	help
	  NXP i.MXRT7xx HiFi1 DSP Core

config SOC_TOOLCHAIN_NAME
	string
	default "nxp_rt700_hifi4" if SOC_MIMXRT798S_HIFI4
	default "nxp_rt700_hifi1" if SOC_MIMXRT798S_HIFI1

config SOC_PART_NUMBER_MIMXRT798SGAWBR
	bool

config SOC_PART_NUMBER_MIMXRT798SGFOB
	bool

config SOC_PART_NUMBER_MIMXRT758SGAWBR
	bool

config SOC_PART_NUMBER_MIMXRT758SGFOB
	bool

config SOC_PART_NUMBER_MIMXRT735SGAWBR
	bool

config SOC_PART_NUMBER_MIMXRT735SGFOB
	bool

config SOC_PART_NUMBER
	default "MIMXRT798SGFOB" if SOC_PART_NUMBER_MIMXRT798SGFOB
	default "MIMXRT798SGAWBR" if SOC_PART_NUMBER_MIMXRT798SGAWBR
	default "MIMXRT758SGFOB" if SOC_PART_NUMBER_MIMXRT758SGFOB
	default "MIMXRT758SGAWBR" if SOC_PART_NUMBER_MIMXRT758SGAWBR
	default "MIMXRT735SGFOB" if SOC_PART_NUMBER_MIMXRT735SGFOB
	default "MIMXRT735SGAWBR" if SOC_PART_NUMBER_MIMXRT735SGAWBR
```

## soc/nxp/imxrt/imxrt7xx/cm33/Kconfig
```kconfig
# Copyright 2024-2025 NXP
# SPDX-License-Identifier: Apache-2.0

config SOC_MIMXRT798S_CM33_CPU0
	select CPU_CORTEX_M33
	select CLOCK_CONTROL
	select CPU_CORTEX_M_HAS_DWT
	select ARM
	select CPU_HAS_ARM_SAU
	select CPU_HAS_ARM_MPU
	select CPU_HAS_FPU
	select ARMV8_M_DSP
	select ARM_TRUSTZONE_M
	select CPU_CORTEX_M_HAS_SYSTICK
	select HAS_MCUX
	select HAS_MCUX_XCACHE
	select CACHE_MANAGEMENT
	select CPU_HAS_ICACHE
	select CPU_HAS_DCACHE
	select INIT_ARCH_HW_AT_BOOT
	select SOC_RESET_HOOK
	select SOC_EARLY_INIT_HOOK
	select WUC if PM
	select HAS_PM
	select SOC_IMXRT7XX_POWER_DOMAIN_COMPUTE

config SOC_MIMXRT798S_CM33_CPU1
	select CPU_CORTEX_M33
	select CLOCK_CONTROL
	select CPU_CORTEX_M_HAS_DWT
	select ARM
	select CPU_HAS_ARM_SAU
	select CPU_HAS_ARM_MPU
	select CPU_HAS_FPU
	select ARMV8_M_DSP
	select ARM_TRUSTZONE_M
	select CPU_CORTEX_M_HAS_SYSTICK
	select HAS_MCUX
	select HAS_PM
	select SOC_IMXRT7XX_POWER_DOMAIN_SENSE

config SOC_IMXRT7XX_POWER_DOMAIN_COMPUTE
	bool
	help
	  Selected when building for a core residing in the RT7xx Compute
	  power domain. This domain is controlled by PMC0/SLEEPCON0 and
	  covers the Common, Compute and Media rails.

config SOC_IMXRT7XX_POWER_DOMAIN_SENSE
	bool
	help
	  Selected when building for a core residing in the RT7xx Sense
	  power domain. This domain is controlled by PMC1/SLEEPCON1.

config SOC_MIMXRT7XX_PM_XIP_HANDOVER
	bool
	default y if FLASH_MCUX_XSPI_XIP
	depends on PM
	help
	  Internal (not a user option): compile in the XIP suspend/resume
	  helpers and invoke them from the low-power entry path. When entering
	  deep sleep / DSR while executing XIP, the XSPI controller and its
	  caches must be quiesced before the relevant power domain is removed
	  and brought back up afterwards. Auto-enabled for XIP
	  (FLASH_MCUX_XSPI_XIP) builds with PM.

config MCUX_CORE_SUFFIX
	default "_cm33_core0" if SOC_MIMXRT798S_CM33_CPU0
	default "_cm33_core1" if SOC_MIMXRT798S_CM33_CPU1
```

## soc/nxp/imxrt/imxrt7xx/cm33/Kconfig.defconfig
```kconfig
# Copyright 2024-2025 NXP
# SPDX-License-Identifier: Apache-2.0

config NUM_IRQS
	default 158 if SOC_MIMXRT798S_CM33_CPU0
	default 93 if SOC_MIMXRT798S_CM33_CPU1

if SOC_MIMXRT798S_CM33_CPU0

config ROM_START_OFFSET
	default 0x4000 if NXP_IMXRT_BOOT_HEADER

config SYS_CLOCK_HW_CYCLES_PER_SEC
	default 237500000 if CORTEX_M_SYSTICK
	default 1000000 if MCUX_OS_TIMER

choice CACHE_TYPE
	default EXTERNAL_CACHE
endchoice

# The existing SAI diver cannot initialize the PLL on the board,
# so the PLL settings will not be performed in the driver.
config I2S_HAS_PLL_SETTING
	default n

endif # SOC_MIMXRT798S_CM33_CPU0


if SOC_MIMXRT798S_CM33_CPU1

config SYS_CLOCK_HW_CYCLES_PER_SEC
	default 100000000 if CORTEX_M_SYSTICK
	default 1000000 if MCUX_OS_TIMER

endif # SOC_MIMXRT798S_CM33_CPU1
```

## soc/nxp/imxrt/imxrt7xx/hifi1/Kconfig
```kconfig
# Copyright 2024-2025 NXP
# SPDX-License-Identifier: Apache-2.0

config SOC_MIMXRT798S_HIFI1
	select XTENSA
	select XTENSA_HAL if ("$(ZEPHYR_TOOLCHAIN_VARIANT)" != "xcc" && "$(ZEPHYR_TOOLCHAIN_VARIANT)" != "xt-clang")
	select XTENSA_RESET_VECTOR
	select XTENSA_USE_CORE_CRT1
	select XTENSA_SMALL_VECTOR_TABLE_ENTRY
	select GEN_ISR_TABLES
	select HAS_MCUX

config MCUX_CORE_SUFFIX
	default "_hifi1" if SOC_MIMXRT798S_HIFI1
```

## soc/nxp/imxrt/imxrt7xx/hifi1/Kconfig.defconfig
```kconfig
# Copyright 2024-2025 NXP
# SPDX-License-Identifier: Apache-2.0

if SOC_MIMXRT798S_HIFI1

config SYS_CLOCK_HW_CYCLES_PER_SEC
	default $(dt_node_int_prop_int,/cpus/cpu@0,clock-frequency)

config XTENSA_TIMER
	default y

config GEN_IRQ_VECTOR_TABLE
	default n

config NXP_IMXRT_BOOT_HEADER
	default n

config XTENSA_CCOUNT_HZ
	default SYS_CLOCK_HW_CYCLES_PER_SEC

config SYS_CLOCK_TICKS_PER_SEC
	default 1000

endif # SOC_MIMXRT798S_HIFI1
```

## soc/nxp/imxrt/imxrt7xx/hifi4/Kconfig
```kconfig
# Copyright 2024-2025 NXP
# SPDX-License-Identifier: Apache-2.0

config SOC_MIMXRT798S_HIFI4
	select XTENSA
	select XTENSA_HAL if ("$(ZEPHYR_TOOLCHAIN_VARIANT)" != "xcc" && "$(ZEPHYR_TOOLCHAIN_VARIANT)" != "xt-clang")
	select XTENSA_RESET_VECTOR
	select XTENSA_USE_CORE_CRT1
	select XTENSA_GEN_HANDLERS
	select XTENSA_SMALL_VECTOR_TABLE_ENTRY
	select GEN_ISR_TABLES
	select CLOCK_CONTROL
	select SOC_EARLY_INIT_HOOK
	select NXP_INPUTMUX
	select HAS_MCUX

config MCUX_CORE_SUFFIX
	default "_hifi4"

config RT798_HIFI4_STACK_SIZE
	hex "Boot time stack size"
	default 0x1000
	depends on SOC_MIMXRT798S_HIFI4
	help
	  Stack space is reserved at the end of the data region, starting at
	  (data base - RT798_HIFI4_STACK_SIZE).
```

## soc/nxp/k32/Kconfig
```kconfig
# NXP K32 family

#
# Copyright (c) 2023 Sendrato
#
# SPDX-License-Identifier: Apache-2.0
#

config SOC_FAMILY_K32
	bool
	select HAS_SEGGER_RTT if ZEPHYR_SEGGER_MODULE
	select ARM

if SOC_FAMILY_K32

config MCUX_MIDDLEWARE_MEMMANAGER_HEAP_SIZE
	int "MemManager Heap-size"
	default 1024
	help
		Maximum number of bytes available for MemManager in the mcux middleware.

rsource "*/Kconfig"

endif # SOC_FAMILY_K32
```

## soc/nxp/k32/Kconfig.defconfig
```kconfig
# NXP K32 family

#
# Copyright (c) 2023 Sendrato
#
# SPDX-License-Identifier: Apache-2.0
#

if SOC_FAMILY_K32

config I2C_MCUX_FLEXCOMM
	default y if HAS_MCUX_FLEXCOMM
	depends on I2C

config SPI_MCUX_FLEXCOMM
	default y if HAS_MCUX_FLEXCOMM
	depends on SPI

config CLOCK_CONTROL_MCUX_SYSCON
	default y if HAS_MCUX_SYSCON
	depends on CLOCK_CONTROL

config BUILD_OUTPUT_HEX
	default y

config HW_STACK_PROTECTION
	default ARCH_HAS_STACK_PROTECTION

rsource "*/Kconfig.defconfig"

endif # SOC_FAMILY_K32
```

## soc/nxp/k32/Kconfig.soc
```kconfig
# NXP K32 family

#
# Copyright (c) 2023 Sendrato
#
# SPDX-License-Identifier: Apache-2.0
#

config SOC_FAMILY_K32
	bool

config SOC_FAMILY
	default "k32" if SOC_FAMILY_K32

rsource "*/Kconfig.soc"
```
