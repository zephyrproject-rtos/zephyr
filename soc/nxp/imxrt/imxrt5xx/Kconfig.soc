## soc/nxp/k32/k32/Kconfig
```kconfig
# NXP K32 series

#
# Copyright (c) 2023 Sendrato
#
# SPDX-License-Identifier: Apache-2.0
#

config SOC_SERIES_K32
	select ARM
	select HAS_MCUX
	select HAS_MCUX_RNG
	select HAS_MCUX_FLEXCOMM
	select HAS_MCUX_SYSCON
	select CPU_CORTEX_M_HAS_SYSTICK

config SOC_QN9090
	select CPU_CORTEX_M4
	select CPU_CORTEX_M_HAS_DWT
	select CPU_HAS_ARM_MPU
	select CLOCK_CONTROL
	select HAS_MCUX_IAP_K32
	select BUILD_OUTPUT_HEX
```

## soc/nxp/k32/k32/Kconfig.defconfig
```kconfig
# NXP K32 series

#
# Copyright (c) 2023 Sendrato
#
# SPDX-License-Identifier: Apache-2.0
#

if SOC_SERIES_K32

config NUM_IRQS
	# must be >= the highest interrupt number used
	default 56

rsource "Kconfig.defconfig.qn*"

endif # SOC_SERIES_K32
```

## soc/nxp/k32/k32/Kconfig.defconfig.qn9090
```kconfig
# NXP QN9090 SoC

#
# Copyright (c) 2023 Sendrato
#
# SPDX-License-Identifier: Apache-2.0
#

if SOC_QN9090

config SOC
	default "qn9090"

config NFC_NT3H2X11
	default n

config GPIO_MCUX_LPC
	default y
	depends on GPIO

config UART_MCUX_FLEXCOMM
	default y
	depends on SERIAL

config SOC_FLASH_MCUX
	default y
	depends on FLASH

config ENTROPY_MCUX_RNG
	default y if HAS_MCUX_RNG

choice BT_HCI_BUS_TYPE
	default BT_NXP_IPM
	depends on BT
endchoice

config CODE_DATA_RELOCATION
	default y
	depends on BT

endif # SOC_QN9090
```

## soc/nxp/k32/k32/Kconfig.soc
```kconfig
# K32 MCU line

#
# Copyright (c) 2023 Sendrato
#
# SPDX-License-Identifier: Apache-2.0
#

config SOC_SERIES_K32
	bool
	select SOC_FAMILY_K32

config SOC_SERIES
	default "k32" if SOC_SERIES_K32

config SOC_QN9090
	bool
	select SOC_SERIES_K32

config SOC
	default "qn9090" if SOC_QN9090

config SOC_PART_NUMBER_QN9090THN
	bool

config SOC_PART_NUMBER_QN9090HN
	bool

config SOC_PART_NUMBER
	default "QN9090HN" if SOC_PART_NUMBER_QN9090HN
	default "QN9090THN" if SOC_PART_NUMBER_QN9090THN
```

## soc/nxp/kinetis/Kconfig
```kconfig
# Copyright (c) 2016 Intel Corporation
# Copyright (c) 2016, Freescale Semiconductor, Inc.
# Copyright 2024 NXP
# SPDX-License-Identifier: Apache-2.0

config SOC_FAMILY_KINETIS
	select HAS_SEGGER_RTT if ZEPHYR_SEGGER_MODULE

if SOC_FAMILY_KINETIS

config HAS_OSC
	bool
	help
	  Set if the oscillator (OSC) module is present in the SoC.

config HAS_MCG
	bool
	help
	  Set if the multipurpose clock generator (MCG) module is present in the SoC.

if HAS_OSC

choice
	prompt "Oscillator Mode Selection"
	default OSC_EXTERNAL

config OSC_EXTERNAL
	bool "External reference clock"
	help
	  Set this option to use the oscillator in external reference clock mode.

config OSC_LOW_POWER
	bool "Low power oscillator"
	help
	  Set this option to use the oscillator in low-power mode.

config OSC_HIGH_GAIN
	bool "High gain oscillator"
	help
	  Set this option to use the oscillator in high-gain mode.

endchoice

config OSC_XTAL0_FREQ
	int "External oscillator frequency"
	help
	  Set the external oscillator frequency in Hz. This should be set by the
	  board's defconfig.

endif # HAS_OSC

if HAS_MCG

config MCG_PRDIV0
	hex "PLL external reference divider"
	range 0 0x18
	default 0
	help
	  Selects the amount to divide down the external reference clock for the PLL.
	  The resulting frequency must be in the range of 2 MHz to 4 MHz.

config MCG_VDIV0
	hex "VCO 0 divider"
	range 0 0x1F
	default 0
	help
	  Selects the amount to divide the VCO output of the PLL. The VDIV 0 bits
	  establish the multiplication factor (M) applied to the reference clock
	  frequency.

config MCG_FCRDIV
	int "Fast internal reference clock divider"
	range 0 7
	default 1
	help
	  Selects the amount to divide down the fast internal reference clock. The
	  resulting frequency must be in the range 31.25 kHz to 4 MHz.

config MCG_FRDIV
	int "FLL external reference divider"
	range 0 7
	default 0
	help
	  Selects the amount to divide down the external reference clock for the
	  FLL. The resulting frequency must be in the range 31.25 kHz to 39.0625
	  kHz.

endif # HAS_MCG

config KINETIS_FLASH_CONFIG
	bool "Kinetis flash configuration field"
	default y if XIP && !BOOTLOADER_MCUBOOT
	help
	  Include the 16-byte flash configuration field that stores default
	  protection settings (loaded on reset) and security information that
	  allows the MCU to restrict access to the FTFx module.

if KINETIS_FLASH_CONFIG

config KINETIS_FLASH_CONFIG_OFFSET
	hex "Kinetis flash configuration field offset"
	default 0x400

config KINETIS_FLASH_CONFIG_FSEC
	hex "Flash security byte (FSEC)"
	range 0 0xff
	default 0xfe
	help
	  Configures the reset value of the FSEC register, which includes
	  backdoor key access, mass erase, factory access, and flash security
	  options.

config KINETIS_FLASH_CONFIG_FOPT
	hex "Flash nonvolatile option byte (FOPT)"
	range 0 0xff
	default 0xff
	help
	  Configures the reset value of the FOPT register, which includes boot,
	  NMI, and EzPort options.

config KINETIS_FLASH_CONFIG_FEPROT
	hex "EEPROM protection byte (FEPROT)"
	range 0 0xff
	default 0xff
	help
	  Configures the reset value of the FEPROT register for FlexNVM
	  devices. For program flash only devices, this byte is reserved.

config KINETIS_FLASH_CONFIG_FDPROT
	hex "Data flash protection byte (FDPROT)"
	range 0 0xff
	default 0xff
	help
	  Configures the reset value of the FDPROT register for FlexNVM
	  devices. For program flash only devices, this byte is reserved.

endif # KINETIS_FLASH_CONFIG

rsource "*/Kconfig"

endif # SOC_FAMILY_KINETIS
```

## soc/nxp/kinetis/Kconfig.defconfig
```kconfig
# Copyright 2024 NXP
# SPDX-License-Identifier: Apache-2.0

if SOC_FAMILY_KINETIS

rsource "*/Kconfig.defconfig"

config WDT_DISABLE_AT_BOOT
	default y

endif # SOC_FAMILY_KINETIS
```

## soc/nxp/kinetis/Kconfig.soc
```kconfig
# Copyright 2024 NXP
# SPDX-License-Identifier: Apache-2.0

config SOC_FAMILY_KINETIS
	bool

config SOC_FAMILY
	default "nxp_kinetis" if SOC_FAMILY_KINETIS

rsource "*/Kconfig.soc"
```

## soc/nxp/kinetis/k2x/Kconfig
```kconfig
# Kinetis K2X MCU line

# Copyright (c) 2018 Prevas A/S
# Copyright (c) 2019 Thomas Burdick <thomas.burdick@gmail.com>
# Copyright 2024 NXP

#
# SPDX-License-Identifier: Apache-2.0
#

config SOC_SERIES_KINETIS_K2X
	select ARM
	select CPU_CORTEX_M4
	select CPU_CORTEX_M_HAS_DWT
	select CLOCK_CONTROL
	select SOC_RESET_HOOK

config SOC_MK22F51212
	select HAS_MCUX
	select HAS_MCUX_SMC
	select HAS_MCUX_ADC16
	select HAS_MCUX_FTFX
	select HAS_MCUX_FTM
	select HAS_MCUX_RNGA
	select HAS_MCUX_SIM
	select HAS_OSC
	select HAS_MCG
	select CPU_HAS_FPU
	select HAS_MCUX_DAC
	select HAS_MCUX_RCM

# Note- the MK22F12 SKU is a legacy SOC, no longer officially supported by
# NXP's MCUX SDK, and not recommended for new designs.
config SOC_MK22F12
	select HAS_MCUX
	select HAS_MCUX_SMC
	select HAS_MCUX_ADC16
	select HAS_MCUX_FTFX
	select HAS_MCUX_FTM
	select HAS_MCUX_RNGA
	select HAS_MCUX_SIM
	select HAS_OSC
	select HAS_MCG
	select CPU_HAS_FPU
	select HAS_MCUX_DAC
	select HAS_MCUX_RCM
	select CPU_HAS_NXP_MPU
```

## soc/nxp/kinetis/k2x/Kconfig.defconfig
```kconfig
# Kinetis K2x series configuration options

# Copyright (c) 2018 Prevas A/S
# Copyright (c) 2019 Thomas Burdick <thomas.burdick@gmail.com>
# Copyright 2024 NXP

#
# SPDX-License-Identifier: Apache-2.0
#

if SOC_SERIES_KINETIS_K2X

config GPIO
	default y if SOC_MK22F51212

config NUM_IRQS
	default 74

config NUM_IRQS
	default 81 if SOC_MK22F12
	default 74 if SOC_MK22F51212

config CPU_HAS_CUSTOM_FIXED_SOC_MPU_REGIONS
	default y if SOC_MK22F12

# The flash option register (FOPT) boot options
# 1111 1001 - Set NMI pin/interrupts and EzPort reset default to disabled
config KINETIS_FLASH_CONFIG_FOPT
	default 0xF9
	depends on KINETIS_FLASH_CONFIG

endif # SOC_SERIES_KINETIS_K2X
```

## soc/nxp/kinetis/k2x/Kconfig.soc
```kconfig
# Kinetis K2X MCU line

# Copyright (c) 2018 Prevas A/S
# Copyright (c) 2019 Thomas Burdick <thomas.burdick@gmail.com>
# Copyright 2024 NXP

#
# SPDX-License-Identifier: Apache-2.0
#

config SOC_SERIES_KINETIS_K2X
	bool
	select SOC_FAMILY_KINETIS

config SOC_SERIES
	default "k2x" if SOC_SERIES_KINETIS_K2X

config SOC_MK22F51212
	bool
	select SOC_SERIES_KINETIS_K2X

# Note- the MK22F12 SKU is a legacy SOC, no longer officially supported by
# NXP's MCUX SDK, and not recommended for new designs.
config SOC_MK22F12
	bool
	select SOC_SERIES_KINETIS_K2X

config SOC
	default "mk22f51212" if SOC_MK22F51212
	default "mk22f12" if SOC_MK22F12

config SOC_PART_NUMBER_MK22FN512VLH12
	bool

config SOC_PART_NUMBER_MK22FX512VLQ12
	bool

config SOC_PART_NUMBER
	default "MK22FN512VLH12" if SOC_PART_NUMBER_MK22FN512VLH12
	default "MK22FX512VLQ12" if SOC_PART_NUMBER_MK22FX512VLQ12
```
