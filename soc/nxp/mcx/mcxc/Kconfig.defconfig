## soc/nxp/mcx/mcxc/Kconfig.defconfig
```kconfig
# Copyright 2024-2026 NXP
# SPDX-License-Identifier: Apache-2.0

DT_CHOSEN_ZEPHYR_SYSTEM_TIMER := zephyr,system-timer
DT_CHOSEN_ZEPHYR_SYSTEM_TIMER_PATH := $(dt_chosen_path,$(DT_CHOSEN_ZEPHYR_SYSTEM_TIMER))

if SOC_FAMILY_MCXC

configdefault MCUX_LPTMR_TIMER
	default y if PM && $(dt_chosen_enabled,$(DT_CHOSEN_ZEPHYR_SYSTEM_TIMER))

configdefault CORTEX_M_SYSTICK
	default n if MCUX_LPTMR_TIMER

configdefault WUC
	default y if PM && DT_HAS_NXP_LLWU_ENABLED

if PM && MCUX_LPTMR_TIMER

choice PM_PREWAKEUP_CONV_MODE
	default PM_PREWAKEUP_CONV_MODE_CEIL
endchoice # PM_PREWAKEUP_CONV_MODE

endif # PM && MCUX_LPTMR_TIMER

configdefault NUM_IRQS
	default 32

configdefault SYS_CLOCK_TICKS_PER_SEC
	default 1024 if MCUX_LPTMR_TIMER

configdefault SYS_CLOCK_HW_CYCLES_PER_SEC
	default $(dt_node_int_prop_int,/cpus/cpu@0,clock-frequency) if CORTEX_M_SYSTICK
	default $(dt_node_int_prop_int,$(DT_CHOSEN_ZEPHYR_SYSTEM_TIMER_PATH),clock-frequency) if MCUX_LPTMR_TIMER

configdefault WDT_DISABLE_AT_BOOT
	default y

endif # SOC_FAMILY_MCXC
```

## soc/nxp/mcx/mcxc/Kconfig.soc
```kconfig
# Copyright 2024 NXP
# SPDX-License-Identifier: Apache-2.0

config SOC_SERIES_MCXC
	bool
	select SOC_FAMILY_NXP_MCX

config SOC_SERIES
	default "mcxc" if SOC_SERIES_MCXC

config SOC_MCXC141
	bool
	select SOC_SERIES_MCXC

config SOC_MCXC142
	bool
	select SOC_SERIES_MCXC

config SOC_MCXC242
	bool
	select SOC_SERIES_MCXC

config SOC_MCXC444
	bool
	select SOC_SERIES_MCXC

config SOC
	default "mcxc141" if SOC_MCXC141
	default "mcxc142" if SOC_MCXC142
	default "mcxc242" if SOC_MCXC242
	default "mcxc444" if SOC_MCXC444

config SOC_PART_NUMBER_MCXC141VLH
	bool

config SOC_PART_NUMBER_MCXC141VFM
	bool

config SOC_PART_NUMBER_MCXC142VFM
	bool

config SOC_PART_NUMBER_MCXC242VLH
	bool

config SOC_PART_NUMBER_MCXC242VFM
	bool

config SOC_PART_NUMBER_MCXC444VLH
	bool

config SOC_PART_NUMBER_MCXC444VMP
	bool

config SOC_PART_NUMBER
	default "MCXC141VFM" if SOC_PART_NUMBER_MCXC141VLH
	default "MCXC141VFM" if SOC_PART_NUMBER_MCXC141VFM
	default "MCXC141VFM" if SOC_PART_NUMBER_MCXC142VFM
	default "MCXC242VLH" if SOC_PART_NUMBER_MCXC242VLH
	default "MCXC242VFM" if SOC_PART_NUMBER_MCXC242VFM
	default "MCXC444VLH" if SOC_PART_NUMBER_MCXC444VLH
	default "MCXC444VMP" if SOC_PART_NUMBER_MCXC444VMP
```

## soc/nxp/mcx/mcxe/Kconfig.defconfig
```kconfig
# Copyright 2025 NXP
# SPDX-License-Identifier: Apache-2.0

if SOC_FAMILY_MCXE

rsource "*/Kconfig.defconfig"

endif # SOC_FAMILY_MCXE
```

## soc/nxp/mcx/mcxe/Kconfig.soc
```kconfig
# Copyright 2025 NXP
# SPDX-License-Identifier: Apache-2.0

config SOC_FAMILY_MCXE
	bool

config SOC_FAMILY
	default "mcxe" if SOC_FAMILY_MCXE

rsource "*/Kconfig.soc"
```

## soc/nxp/mcx/mcxe/mcxe24x/Kconfig
```kconfig
# Copyright 2025 NXP
# SPDX-License-Identifier: Apache-2.0

config SOC_SERIES_MCXE24X
	select ARM
	select CPU_CORTEX_M4
	select CPU_CORTEX_M_HAS_DWT
	select CPU_HAS_FPU
	select HAS_MCUX
	select CLOCK_CONTROL
	select SOC_RESET_HOOK
	select CPU_HAS_ICACHE
	select HAS_MCUX_LMEM_CACHE

if SOC_SERIES_MCXE24X

config MCXE_FLASH_CONFIG
	bool "MCXE flash configuration field"
	default y if XIP && !BOOTLOADER_MCUBOOT
	help
	  Include the 16-byte flash configuration field that stores default
	  protection settings (loaded on reset) and security information that
	  allows the MCU to restrict access to the FTFC module.

config WDOG_ENABLE_AT_BOOT
	bool "Keep watchdog timer enabled at boot"
	help
	  Leave SOC watchdog timer enabled at boot. The specific timeout
	  and clock configuration of the watchdog at boot is SOC dependent.
	  Note: if the watchdog timer is enabled at boot, the user will
	  need to configure the watchdog using z_arm_watchdog_init, as
	  the SOC requires watchdog configuration before initial expiration

# Enable watchdog configuration function if watchdog is left enabled at boot
config WDOG_INIT
	bool
	default WDOG_ENABLE_AT_BOOT

endif # SOC_SERIES_MCXE24X
```

## soc/nxp/mcx/mcxe/mcxe24x/Kconfig.defconfig
```kconfig
# Copyright 2025-2026 NXP
# SPDX-License-Identifier: Apache-2.0

if SOC_SERIES_MCXE24X

DT_CHOSEN_ZEPHYR_SYSTEM_TIMER := zephyr,system-timer
DT_CHOSEN_ZEPHYR_SYSTEM_TIMER_PATH := $(dt_chosen_path,$(DT_CHOSEN_ZEPHYR_SYSTEM_TIMER))
DT_CHOSEN_ZEPHYR_SYSTEM_TIMER_IS_NXP_LPTMR := \
	$(dt_node_has_compat,$(DT_CHOSEN_ZEPHYR_SYSTEM_TIMER_PATH),$(DT_COMPAT_NXP_LPTMR))

configdefault MCUX_LPTMR_TIMER
	default y if PM && $(dt_chosen_enabled,$(DT_CHOSEN_ZEPHYR_SYSTEM_TIMER)) && \
		$(DT_CHOSEN_ZEPHYR_SYSTEM_TIMER_IS_NXP_LPTMR)

configdefault CORTEX_M_SYSTICK
	default n if MCUX_LPTMR_TIMER

configdefault SYS_CLOCK_HW_CYCLES_PER_SEC
	default $(dt_node_int_prop_int,/cpus/cpu@0,clock-frequency) if CORTEX_M_SYSTICK
	default $(dt_node_int_prop_int,$(DT_CHOSEN_ZEPHYR_SYSTEM_TIMER_PATH),clock-frequency) if MCUX_LPTMR_TIMER

configdefault SYS_CLOCK_TICKS_PER_SEC
	default 1000 if MCUX_LPTMR_TIMER

configdefault NUM_IRQS
	default 146

configdefault CPU_HAS_CUSTOM_FIXED_SOC_MPU_REGIONS
	default y

configdefault GPIO
	default y

# Enable cache management features
configdefault CACHE_MANAGEMENT
	default y

choice CACHE_TYPE
	default EXTERNAL_CACHE
endchoice

configdefault WDT_DISABLE_AT_BOOT
	default y

endif # SOC_SERIES_MCXE24X
```

## soc/nxp/mcx/mcxe/mcxe24x/Kconfig.soc
```kconfig
# Copyright 2025 NXP
# SPDX-License-Identifier: Apache-2.0

config SOC_SERIES_MCXE24X
	bool
	select SOC_FAMILY_MCXE

config SOC_SERIES
	default "mcxe24x" if SOC_SERIES_MCXE24X

config SOC_MCXE245
	bool
	select SOC_SERIES_MCXE24X

config SOC_MCXE246
	bool
	select SOC_SERIES_MCXE24X

config SOC_MCXE247
	bool
	select SOC_SERIES_MCXE24X

config SOC
	default "mcxe245" if SOC_MCXE245
	default "mcxe246" if SOC_MCXE246
	default "mcxe247" if SOC_MCXE247

config SOC_PART_NUMBER_MCXE245VLF
	bool

config SOC_PART_NUMBER_MCXE245VLH
	bool

config SOC_PART_NUMBER_MCXE245VLL
	bool

config SOC_PART_NUMBER_MCXE246VLH
	bool

config SOC_PART_NUMBER_MCXE246VLL
	bool

config SOC_PART_NUMBER_MCXE246VLQ
	bool

config SOC_PART_NUMBER_MCXE247VLL
	bool

config SOC_PART_NUMBER_MCXE247VLQ
	bool

config SOC_PART_NUMBER
	default "MCXE245VLF" if SOC_PART_NUMBER_MCXE245VLF
	default "MCXE245VLH" if SOC_PART_NUMBER_MCXE245VLH
	default "MCXE245VLL" if SOC_PART_NUMBER_MCXE245VLL
	default "MCXE246VLH" if SOC_PART_NUMBER_MCXE246VLH
	default "MCXE246VLL" if SOC_PART_NUMBER_MCXE246VLL
	default "MCXE246VLQ" if SOC_PART_NUMBER_MCXE246VLQ
	default "MCXE247VLL" if SOC_PART_NUMBER_MCXE247VLL
	default "MCXE247VLQ" if SOC_PART_NUMBER_MCXE247VLQ
```

## soc/nxp/mcx/mcxe/mcxe31x/Kconfig
```kconfig
# Copyright 2025 NXP
# SPDX-License-Identifier: Apache-2.0

config SOC_SERIES_MCXE31X
	select CPU_CORTEX_M7
	select CPU_CORTEX_M_HAS_DWT
	select CPU_HAS_FPU
	select CPU_HAS_ARM_MPU
	select ARM
	select CLOCK_CONTROL
	select HAS_MCUX
	select CPU_HAS_ICACHE
	select CPU_HAS_DCACHE
	select SOC_RESET_HOOK
	select SOC_EARLY_INIT_HOOK
	select CODE_DATA_RELOCATION

if SOC_SERIES_MCXE31X

if CODE_DATA_RELOCATION

config SRAM_CONFIG_RELOCATE_MEM
	string
	default "ITCM"
	help
	  Select memory to relocate sram_config.c code

endif # CODE_DATA_RELOCATION

config SOC_NXP_MCXE31X_BOOT_HEADER
	bool
	help
	  Enable boot header configuration for NXP MCXE31X SoC.
	  This should be selected by boards that need boot header support.

if SOC_NXP_MCXE31X_BOOT_HEADER

config BOOT_HEADER_OFFSET
	hex "Flash config data offset"
	default 0x0
	help
	  The flash config offset provides the boot ROM with the on-board
	  flash type and parameters. The boot ROM requires a fixed flash config
	  offset for FlexSPI device.

config IMAGE_VECTOR_TABLE_OFFSET
	hex "Image vector table offset"
	default 0x1000
	help
	  The Image Vector Table (IVT) provides the boot ROM with pointers to
	  the application entry point and device configuration data. The boot
	  ROM requires a fixed IVT offset for each type of boot device.

endif # SOC_NXP_MCXE31X_BOOT_HEADER

endif # SOC_SERIES_MCXE31X
```

## soc/nxp/mcx/mcxe/mcxe31x/Kconfig.soc
```kconfig
# Copyright 2025 NXP
# SPDX-License-Identifier: Apache-2.0

config SOC_SERIES_MCXE31X
	bool
	select SOC_FAMILY_MCXE

config SOC_SERIES
	default "mcxe31x" if SOC_SERIES_MCXE31X

config SOC_MCXE315
	bool
	select SOC_SERIES_MCXE31X

config SOC_MCXE316
	bool
	select SOC_SERIES_MCXE31X

config SOC_MCXE317
	bool
	select SOC_SERIES_MCXE31X

config SOC_MCXE31B
	bool
	select SOC_SERIES_MCXE31X

config SOC
	default "mcxe315" if SOC_MCXE315
	default "mcxe316" if SOC_MCXE316
	default "mcxe317" if SOC_MCXE317
	default "mcxe31b" if SOC_MCXE31B

config SOC_PART_NUMBER_MCXE315MLF
	bool
	select SOC_MCXE315

config SOC_PART_NUMBER_MCXE315MPA
	bool
	select SOC_MCXE315

config SOC_PART_NUMBER_MCXE316MLF
	bool
	select SOC_MCXE316

config SOC_PART_NUMBER_MCXE316MPA
	bool
	select SOC_MCXE316

config SOC_PART_NUMBER_MCXE317MPA
	bool
	select SOC_MCXE317

config SOC_PART_NUMBER_MCXE317MPB
	bool
	select SOC_MCXE317

config SOC_PART_NUMBER_MCXE31BMPB
	bool
	select SOC_MCXE31B

config SOC_PART_NUMBER
	default "MCXE315MLF" if SOC_PART_NUMBER_MCXE315MLF
	default "MCXE315MPA" if SOC_PART_NUMBER_MCXE315MPA
	default "MCXE316MLF" if SOC_PART_NUMBER_MCXE316MLF
	default "MCXE316MPA" if SOC_PART_NUMBER_MCXE316MPA
	default "MCXE317MPA" if SOC_PART_NUMBER_MCXE317MPA
	default "MCXE317MPB" if SOC_PART_NUMBER_MCXE317MPB
	default "MCXE31BMPB" if SOC_PART_NUMBER_MCXE31BMPB
```

## soc/nxp/mcx/mcxl/Kconfig.soc
```kconfig
# Copyright 2025 NXP
# SPDX-License-Identifier: Apache-2.0

config SOC_FAMILY_MCXL
	bool

config SOC_FAMILY
	default "mcxl" if SOC_FAMILY_MCXL

config SOC_MCXL255
	bool
	select SOC_FAMILY_MCXL

config SOC_MCXL255_CPU0
	bool
	select SOC_MCXL255

config SOC_MCXL255_CPU1
	bool
	select SOC_MCXL255

config SOC_MCXL254
	bool
	select SOC_FAMILY_MCXL

config SOC_MCXL254_CPU0
	bool
	select SOC_MCXL254

config SOC_MCXL254_CPU1
	bool
	select SOC_MCXL254

config SOC_MCXL253
	bool
	select SOC_FAMILY_MCXL

config SOC_MCXL253_CPU0
	bool
	select SOC_MCXL253

config SOC_MCXL253_CPU1
	bool
	select SOC_MCXL253

config SOC
	default "mcxl255" if SOC_MCXL255
	default "mcxl254" if SOC_MCXL254
	default "mcxl253" if SOC_MCXL253

config SOC_PART_NUMBER_MCXL255VLL
	bool

config SOC_PART_NUMBER_MCXL255VDF
	bool

config SOC_PART_NUMBER_MCXL254VLL
	bool

config SOC_PART_NUMBER_MCXL254VDF
	bool

config SOC_PART_NUMBER_MCXL253VLL
	bool

config SOC_PART_NUMBER_MCXL253VDF
	bool

config SOC_PART_NUMBER
	default "MCXL255VLL" if SOC_PART_NUMBER_MCXL255VLL
	default "MCXL255VDF" if SOC_PART_NUMBER_MCXL255VDF
	default "MCXL254VLL" if SOC_PART_NUMBER_MCXL254VLL
	default "MCXL254VDF" if SOC_PART_NUMBER_MCXL254VDF
	default "MCXL253VLL" if SOC_PART_NUMBER_MCXL253VLL
	default "MCXL253VDF" if SOC_PART_NUMBER_MCXL253VDF
```

## soc/nxp/mcx/mcxn/Kconfig
```kconfig
# Copyright 2024-2025 NXP
# SPDX-License-Identifier: Apache-2.0

config SOC_FAMILY_MCXN
	select HAS_SEGGER_RTT if ZEPHYR_SEGGER_MODULE
	select CLOCK_CONTROL
	select ARM
	select HAS_MCUX
	select CPU_CORTEX_M_HAS_SYSTICK
	select CPU_CORTEX_M_HAS_DWT

config SOC_MCXN947_CPU0
	select CPU_CORTEX_M33
	select CPU_HAS_ARM_SAU
	select CPU_HAS_ARM_MPU
	select CPU_HAS_FPU
	select ARMV8_M_DSP
	select SOC_RESET_HOOK
	select ARM_TRUSTZONE_M
	select HAS_MCUX_CACHE

config SOC_MCXN947_CPU1
	select CPU_CORTEX_M33

config SOC_MCXN547
	select CPU_CORTEX_M33
	select CPU_HAS_ARM_SAU
	select CPU_HAS_ARM_MPU
	select CPU_HAS_FPU
	select ARMV8_M_DSP
	select SOC_RESET_HOOK
	select ARM_TRUSTZONE_M
	select HAS_MCUX_CACHE

config SOC_MCXN547_CPU1
	select CPU_CORTEX_M33

config SOC_MCXN236
	select CPU_CORTEX_M33
	select CPU_HAS_ARM_SAU
	select CPU_HAS_ARM_MPU
	select CPU_HAS_FPU
	select ARMV8_M_DSP
	select SOC_RESET_HOOK
	select ARM_TRUSTZONE_M

if SOC_FAMILY_MCXN

if SOC_MCXN947 || SOC_MCXN547

config SECOND_CORE_MCUX
	bool "MCXNX4X's second core"
	depends on HAS_MCUX
	help
	  Indicates the second core will be enabled, and the part will run
	  in dual core mode.

config FLASH_DISABLE_CACHE64
	bool "Disable the CACHE64 cache for FlexSPI flash accesses"
	help
	  Disable cache64 cache.

config MCUX_CORE_SUFFIX
	default "_cm33_core0" if SOC_MCXN947_CPU0 || SOC_MCXN547_CPU0
	default "_cm33_core1" if SOC_MCXN947_CPU1 || SOC_MCXN547_CPU1
endif

if SECOND_CORE_MCUX

config SECOND_CORE_MCUX_ACCESS_LEVEL
	int "default TrustZone access level for secondary core"
	default 3
	help
	  Configures AHBSC MASTER_SEC_LEVEL register for the cpu1 before cpu1 is
	  enabled.
endif

config NXP_FLEXSPI_BOOT_HEADER
	bool "Boot header"
	default y if FLASH_MCUX_FLEXSPI_XIP && !BOOTLOADER_MCUBOOT

	help
	  Enable data structures required by the boot ROM to boot the
	  application from an external flash device.

if NXP_FLEXSPI_BOOT_HEADER

config FLEXSPI_CONFIG_BLOCK_OFFSET
	hex "FlexSPI config block offset"
	default 0x400
	help
	  FlexSPI configuration block consists of parameters regarding specific
	  flash devices including read command sequence, quad mode enablement
	  sequence (optional), etc. The boot ROM expects FlexSPI configuration
	  parameter to be presented in serial nor flash.

endif # NXP_FLEXSPI_BOOT_HEADER

rsource "../../common/Kconfig.flexspi_xip"

endif # SOC_FAMILY_MCXN
```

## soc/nxp/mcx/mcxn/Kconfig.defconfig
```kconfig
# Copyright 2024-2025 NXP
# SPDX-License-Identifier: Apache-2.0

if SOC_FAMILY_MCXN

# Ensure SysTick is not enabled by default if another system timer is selected.
configdefault CORTEX_M_SYSTICK
	default n if (MCUX_LPTMR_TIMER || MCUX_OS_TIMER)

# We override it here so CPU_FREQ controls whether OSTIMER is selected by default.
configdefault MCUX_OS_TIMER
	default y if CPU_FREQ
	default n

config MFD
	default y if DT_HAS_NXP_LP_FLEXCOMM_ENABLED

config NUM_IRQS
	default 156

config ROM_START_OFFSET
	default 0x400 if BOOTLOADER_MCUBOOT
	default 0x1000 if !BOOTLOADER_MCUBOOT && FLASH_MCUX_FLEXSPI_XIP

config SYS_CLOCK_HW_CYCLES_PER_SEC
	default 1000000 if MCUX_OS_TIMER
	default 16000 if MCUX_LPTMR_TIMER
	default 150000000 if CORTEX_M_SYSTICK

config MCUX_FLASH_K4_API
	default y if (SOC_MCXN947 || SOC_MCXN547) # Initially, only Nx4x uses the k4 driver

# Set to the minimal size of data which can be written.
config FLASH_FILL_BUFFER_SIZE
	default 16 if (SOC_MCXN947 || SOC_MCXN547) # Initially, only Nx4x uses the k4 driver
	default 128

# The existing SAI diver cannot initialize the PLL on the board,
# so the PLL settings will not be performed in the driver.
config I2S_HAS_PLL_SETTING
	default n

if PM

configdefault CORTEX_M_SYSTICK_RESET_BY_LPM
	default y

endif # PM

endif # SOC_FAMILY_MCXN
```

## soc/nxp/mcx/mcxn/Kconfig.soc
```kconfig
# Copyright 2024 NXP
# SPDX-License-Identifier: Apache-2.0

config SOC_FAMILY_MCXN
	bool

config SOC_FAMILY
	default "mcxn" if SOC_FAMILY_MCXN

config SOC_MCXN947
	bool
	select SOC_FAMILY_MCXN

config SOC_MCXN947_CPU0
	bool
	select SOC_MCXN947

config SOC_MCXN947_CPU1
	bool
	select SOC_MCXN947

config SOC_MCXN547
	bool
	select SOC_FAMILY_MCXN

config SOC_MCXN547_CPU0
	bool
	select SOC_MCXN547

config SOC_MCXN547_CPU1
	bool
	select SOC_MCXN547

config SOC_MCXN236
	bool
	select SOC_FAMILY_MCXN

config SOC
	default "mcxn947" if SOC_MCXN947
	default "mcxn547" if SOC_MCXN547
	default "mcxn236" if SOC_MCXN236

config SOC_PART_NUMBER_MCXN947VDF
	bool

config SOC_PART_NUMBER_MCXN947VNL
	bool

config SOC_PART_NUMBER_MCXN547VDF
	bool

config SOC_PART_NUMBER_MCXN547VNL
	bool

config SOC_PART_NUMBER_MCXN236VDF
	bool

config SOC_PART_NUMBER_MCXN236VNL
	bool

config SOC_PART_NUMBER
	default "MCXN947VDF" if SOC_PART_NUMBER_MCXN947VDF
	default "MCXN947VNL" if SOC_PART_NUMBER_MCXN947VNL
	default "MCXN547VDF" if SOC_PART_NUMBER_MCXN547VDF
	default "MCXN547VNL" if SOC_PART_NUMBER_MCXN547VNL
	default "MCXN236VDF" if SOC_PART_NUMBER_MCXN236VDF
	default "MCXN236VNL" if SOC_PART_NUMBER_MCXN236VNL
```
