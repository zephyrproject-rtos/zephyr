## soc/nxp/mcx/mcxnx4x/Kconfig
```kconfig
# Copyright 2024 NXP
# SPDX-License-Identifier: Apache-2.0

config SOC_SERIES_MCXNX4X
	select HAS_MCUX
	select HAS_MCUX_FLEXCOMM
	select CPU_CORTEX_M_HAS_SYSTICK
	select CPU_CORTEX_M_HAS_DWT
	select PLATFORM_SPECIFIC_INIT

config SOC_MCXN947_CPU0
	select CPU_CORTEX_M33
	select CPU_HAS_ARM_SAU
	select CPU_HAS_ARM_MPU
	select CPU_HAS_FPU
	select ARMV8_M_DSP
	select ARM_TRUSTZONE_M
	select HAS_MCUX_CACHE

if SOC_SERIES_MCXNX4X

config SECOND_CORE_MCUX
	bool "MCXN94X's second core"
	depends on HAS_MCUX
	help
	  Indicates the second core will be enabled, and the part will run
	  in dual core mode.

config FLASH_DISABLE_CACHE64
	bool "Disable the CACHE64 cache for FlexSPI flash accesses"
	help
	  Disable cache64 cache.

config MCUX_CORE_SUFFIX
	default "_cm33_core0" if SOC_MCXN947_CPU0
	default "_cm33_core1" if SOC_MCXN947_CPU1

DT_CHOSEN_Z_FLASH := zephyr,flash
DT_COMPAT_FLEXSPI := nxp,imx-flexspi

DT_CHOSEN_FLASH_NODE := $(dt_chosen_path,$(DT_CHOSEN_Z_FLASH))
DT_CHOSEN_FLASH_PARENT := $(dt_node_parent,$(DT_CHOSEN_FLASH_NODE))

DT_FLASH_PARENT_IS_FLEXSPI := $(dt_node_has_compat,$(DT_CHOSEN_FLASH_PARENT),$(DT_COMPAT_FLEXSPI))
DT_FLASH_HAS_SIZE_PROP := $(dt_node_has_prop,$(DT_CHOSEN_FLASH_NODE),size)

config FLASH_BASE_ADDRESS
	default $(dt_node_reg_addr_hex,$(DT_CHOSEN_FLASH_PARENT),1) \
		if $(DT_FLASH_PARENT_IS_FLEXSPI)

config FLASH_SIZE
	default $(dt_node_int_prop_int,$(DT_CHOSEN_FLASH_NODE),size,Kb) \
		if $(DT_FLASH_HAS_SIZE_PROP)

config FLASH_MCUX_FLEXSPI_XIP
	bool
	default $(DT_FLASH_PARENT_IS_FLEXSPI)
	select XIP
	help
	  Allows for the soc to safely initialize the clocks for the
	  FlexSpi when planning to execute code in FlexSpi Memory.

endif # SOC_SERIES_MCXNX4X
```

## soc/nxp/mcx/mcxnx4x/Kconfig.defconfig
```kconfig
# Copyright 2024 NXP
# SPDX-License-Identifier: Apache-2.0

if SOC_SERIES_MCXNX4X

config NUM_IRQS
	default 155

config ROM_START_OFFSET
	default 0x400 if BOOTLOADER_MCUBOOT

config ZTEST_NO_YIELD
	default y if (PM && ZTEST)

if MCUX_OS_TIMER

config SYS_CLOCK_HW_CYCLES_PER_SEC
	default 1000000

endif # MCUX_OS_TIMER

if CORTEX_M_SYSTICK

config SYS_CLOCK_HW_CYCLES_PER_SEC
	default 150000000

endif # CORTEX_M_SYSTICK

endif # SOC_SERIES_MCXNX4X
```

## soc/nxp/mcx/mcxnx4x/Kconfig.soc
```kconfig
# Copyright 2024 NXP
# SPDX-License-Identifier: Apache-2.0

config SOC_SERIES_MCXNX4X
	bool
	select SOC_FAMILY_NXP_MCX

config SOC_SERIES
	default "mcxnx4x" if SOC_SERIES_MCXNX4X

config SOC_MCXN947
	bool
	select SOC_SERIES_MCXNX4X

config SOC_MCXN947_CPU0
	bool
	select SOC_MCXN947

config SOC_MCXN947_CPU1
	bool
	select SOC_MCXN947

config SOC
	default "mcxn947" if SOC_MCXN947

config SOC_PART_NUMBER_MCXN947VDF
	bool

config SOC_PART_NUMBER_MCXN947VNL
	bool

config SOC_PART_NUMBER
	default "MCXN947VDF" if SOC_PART_NUMBER_MCXN947VDF
	default "MCXN947VNL" if SOC_PART_NUMBER_MCXN947VNL
```

## soc/nxp/mcx/mcxw/Kconfig
```kconfig
# Copyright 2024-2026 NXP
# SPDX-License-Identifier: Apache-2.0

config SOC_FAMILY_MCXW
	select ARM
	select CPU_CORTEX_M33
	select CPU_CORTEX_M_HAS_DWT
	select CPU_CORTEX_M_HAS_SYSTICK
	select HAS_MCUX
	select SOC_RESET_HOOK
	select SOC_EARLY_INIT_HOOK
	select CLOCK_CONTROL
	select HAS_SEGGER_RTT if ZEPHYR_SEGGER_MODULE
	select HAS_PM
	select HAS_POWEROFF

# NOTE:
# CPU feature selects (FPU/MPU/SAU/DSP/TrustZone) are SoC and core dependent.
# In particular, some secondary cores (e.g. MCXW727C CPU1) do not expose these
# extensions in their MCUX CMSIS headers. Selecting them unconditionally here
# breaks the build due to CMSIS consistency checks.
#
# These selects are therefore done in the per-SoC (and per-core) Kconfig files.
if SOC_FAMILY_MCXW

rsource "*/Kconfig"

endif # SOC_FAMILY_MCXW
```

## soc/nxp/mcx/mcxw/Kconfig.defconfig
```kconfig
# Copyright 2023-2025 NXP
# SPDX-License-Identifier: Apache-2.0

rsource "*/Kconfig.defconfig"

if SOC_FAMILY_MCXW

# Ensure SysTick is not enabled by default if another system timer is selected.
# OS timer stays off by default on MCXW (reserved as a low-power companion),
# but this lets it be selected as the system timer without a SysTick conflict.
config CORTEX_M_SYSTICK
	default n if (MCUX_LPTMR_TIMER || MCUX_OS_TIMER)

config OPENTHREAD_PLATFORM_CSL_UNCERT
	default 20 if OPENTHREAD

endif # SOC_FAMILY_MCXW
```

## soc/nxp/mcx/mcxw/Kconfig.soc
```kconfig
# Copyright 2024-2025 NXP
# SPDX-License-Identifier: Apache-2.0

config SOC_FAMILY_MCXW
	bool

config SOC_FAMILY
	default "mcxw" if SOC_FAMILY_MCXW

rsource "*/Kconfig.soc"
```

## soc/nxp/mcx/mcxw/mcxw2xx/Kconfig
```kconfig
# Copyright 2025-2026 NXP
#
# SPDX-License-Identifier: Apache-2.0

config SOC_SERIES_MCXW2XX
	select HAS_POWEROFF
	select NXP_SNPS_BLE_CTRL if BT
	select CPU_HAS_ARM_SAU
	select CPU_HAS_ARM_MPU
	select CPU_HAS_FPU
	select ARMV8_M_DSP
```

## soc/nxp/mcx/mcxw/mcxw2xx/Kconfig.defconfig
```kconfig
# Copyright 2025-2026 NXP
#
# SPDX-License-Identifier: Apache-2.0

if SOC_SERIES_MCXW2XX

# MCXW23 uses SYSTICK timer as the kernel timer by default.
# OS timer is reserved to replace SYSTICK during low power events for system wakeup.
# This dual-timer approach maintains accurate connectivity timing while enabling
# efficient low power operation.
configdefault MCUX_OS_TIMER
	default n

choice SYSTEM_TIMER_LPM_COMPANION
	default SYSTEM_TIMER_LPM_COMPANION_HOOKS
endchoice

config NUM_IRQS
	default 61

DT_SYSCLK_PATH := $(dt_nodelabel_path,sysclk)
DT_OSTIMER_CLK_PATH := $(dt_nodelabel_path,clk_32k)

configdefault SYS_CLOCK_HW_CYCLES_PER_SEC
	# MCXW23 clocks the OS event timer from the 32.768 kHz RTC oscillator (PMC
	# OSTIMERCLKSEL resets to 32.768 kHz and the HAL never reselects it; MCXW23
	# RM 45.4.11.2.24), unlike other NXP parts where OSTIMER is 1 MHz. The rate
	# is taken from the clk_32k fixed-clock node rather than hardcoded. Note:
	# selecting OSTIMER trades timing precision (~1 ms tick, ~30 us resolution)
	# for low-power always-on operation, so SysTick stays the default where
	# fine-grained timing is needed.
	default $(dt_node_int_prop_int,$(DT_OSTIMER_CLK_PATH),clock-frequency) if MCUX_OS_TIMER
	default $(dt_node_int_prop_int,$(DT_SYSCLK_PATH),clock-frequency) if CORTEX_M_SYSTICK

configdefault SYS_CLOCK_TICKS_PER_SEC
	# 32.768 kHz / 1024 = 32 cycles per tick exactly when OSTIMER is the timer.
	default 1024 if MCUX_OS_TIMER
	default 1000 if PM

# Set to the minimal size of data which can be written.
config FLASH_FILL_BUFFER_SIZE
	default 512

if BT

config FPU
	default y

config BT_BUF_ACL_TX_COUNT
	default 8

config BT_LONG_WQ_STACK_SIZE
	default 2048

config MAIN_STACK_SIZE
	default 2048

config SYSTEM_WORKQUEUE_STACK_SIZE
	default 2048

endif # BT

if PM

# Enable PM_DEVICE for Suspend mode and Standby mode,
# because some devices can't work in these modes.
configdefault PM_DEVICE
	default y if "$(dt_nodelabel_enabled,standby)" || "$(dt_nodelabel_enabled,suspend)"

configdefault PM_POLICY_DEVICE_CONSTRAINTS
	default y if PM_DEVICE

configdefault IDLE_STACK_SIZE
	default 640

configdefault TICKLESS_KERNEL
	default y

choice PM_PREWAKEUP_CONV_MODE
	default PM_PREWAKEUP_CONV_MODE_CEIL
endchoice # PM_PREWAKEUP_CONV_MODE

configdefault MCUX_OS_TIMER_MIN_DELAY
	default 100

if BT
choice PM_POLICY
	default PM_POLICY_CUSTOM
endchoice
endif # BT

endif # PM

if PM_DEVICE

configdefault POWER_DOMAIN
	default y

endif # PM_DEVICE

endif # SOC_SERIES_MCXW2XX
```

## soc/nxp/mcx/mcxw2x/Kconfig
```kconfig
# Copyright 2025 NXP
#
# SPDX-License-Identifier: Apache-2.0

config SOC_FAMILY_MCXW2X
	select ARM
	select CPU_CORTEX_M33
	select CPU_HAS_ARM_SAU
	select CPU_HAS_ARM_MPU
	select CPU_HAS_FPU
	select CLOCK_CONTROL
	select HAS_MCUX
	select CPU_CORTEX_M_HAS_SYSTICK
	select CPU_CORTEX_M_HAS_DWT
	select SOC_RESET_HOOK
	select ARM_TRUSTZONE_M
	select ARMV8_M_DSP

if SOC_FAMILY_MCXW2X

config MCXW23X_SRAM_CLOCKS
	bool "Clock MCXW23 SRAM banks"

endif # SOC_FAMILY_MCXW2X
```

## soc/nxp/mcx/mcxw2x/Kconfig.defconfig
```kconfig
# Copyright 2024 NXP
# SPDX-License-Identifier: Apache-2.0

if SOC_FAMILY_MCXW2X

config NUM_IRQS
	# must be >= the highest interrupt number used
	default 60

DT_SYSCLK_PATH := $(dt_nodelabel_path,sysclk)

config SYS_CLOCK_HW_CYCLES_PER_SEC
	default $(dt_node_int_prop_int,$(DT_SYSCLK_PATH),clock-frequency) if CORTEX_M_SYSTICK

# Indicates the second core will be enabled, and the part will run
# in dual core mode.
config SECOND_CORE_MCUX
	depends on HAS_MCUX

# Workaround for not being able to have commas in macro arguments
DT_CHOSEN_Z_CODE_CPU1_PARTITION := zephyr,code-cpu1-partition

# SRAM controllers 1,2,3, and 4 are disabled at reset.
# By default, CMSIS SystemInit will enable the clock to these RAM banks.
# Disable this Kconfig to leave the ram banks untouched out of reset.
config MCXW23X_SRAM_CLOCKS
	default y

# Set to the minimal size of data which can be written.
config FLASH_FILL_BUFFER_SIZE
	default 512

endif # SOC_FAMILY_MCXW2X
```

## soc/nxp/mcx/mcxw2x/Kconfig.soc
```kconfig
# Copyright 2025 NXP
# SPDX-License-Identifier: Apache-2.0

config SOC_FAMILY_MCXW2X
	bool

config SOC_FAMILY
	default "mcxw2x" if SOC_FAMILY_MCXW2X

config SOC_MCXW236
	bool
	select SOC_FAMILY_MCXW2X

config SOC_MCXW235
	bool
	select SOC_FAMILY_MCXW2X

config SOC
	default "mcxw236" if SOC_MCXW236
	default "mcxw235" if SOC_MCXW235

config SOC_PART_NUMBER_MCXW236BIHNAR
	bool

config SOC_PART_NUMBER
	default "MCXW236BIHNAR" if SOC_PART_NUMBER_MCXW236BIHNAR
```

## soc/nxp/rw/Kconfig.defconfig
```kconfig
# Copyright 2022-2024 NXP
# SPDX-License-Identifier: Apache-2.0

if SOC_SERIES_RW6XX

config ROM_START_OFFSET
	default 0x400 if BOOTLOADER_MCUBOOT
	default 0x1300 if NXP_RW6XX_BOOT_HEADER

config NUM_IRQS
	default 129

config SYS_CLOCK_HW_CYCLES_PER_SEC
	default 1000000 if MCUX_OS_TIMER
	default 260000000 if CORTEX_M_SYSTICK

config NXP_MONOLITHIC_NBU
	default y if (BT || IEEE802154)

if BT

config HCI_NXP_ENABLE_AUTO_SLEEP
	default y

config HCI_NXP_SET_CAL_DATA
	default y

config MAIN_STACK_SIZE
	default 2560

config BT_LONG_WQ_STACK_SIZE
	default 5120 if (WIFI || IEEE802154)
	default 2560

config SYSTEM_WORKQUEUE_STACK_SIZE
	default 2048

if SHELL

config SHELL_STACK_SIZE
	default 4096

endif # SHELL

endif # BT

config NXP_MONOLITHIC_WIFI
	default y if WIFI

config NXP_FW_LOADER
	default y if (BT || WIFI || IEEE802154)

config NXP_RF_IMU
	default y if (BT || WIFI || IEEE802154)

if PM
# For PM mode 3 we change this config to get better accuracy
# when using the iKHz RTC clock as system clock.
config SYS_CLOCK_TICKS_PER_SEC
	default 1000
	depends on $(dt_nodelabel_enabled,standby)
endif

if WIFI
orsource "Kconfig.defconfig.wifi"
endif # WIFI

endif # SOC_SERIES_RW6XX
```
