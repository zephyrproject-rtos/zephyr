## soc/nxp/imx/imx6sx/Kconfig.defconfig
```kconfig
# i.MX 6SoloX core series

# Copyright 2018,2024 NXP
# SPDX-License-Identifier: Apache-2.0

if SOC_SERIES_IMX6SX

config NUM_IRQS
	# must be >= the highest interrupt number used
	default 128

config PINCTRL_IMX
	default y if HAS_IMX_IOMUXC
	depends on PINCTRL

rsource "Kconfig.defconfig.*"

endif # SOC_SERIES_IMX6SX
```

## soc/nxp/imx/imx6sx/Kconfig.defconfig.mcimx6x_m4
```kconfig
# i.MX 6SoloX

# Copyright 2018,2024 NXP
# SPDX-License-Identifier: Apache-2.0

if SOC_MCIMX6X_M4

config FPU
	default y

endif # SOC_MCIMX6X_M4
```

## soc/nxp/imx/imx6sx/Kconfig.soc
```kconfig
# i.MX 6SoloX core series

# Copyright 2018,2024 NXP
# SPDX-License-Identifier: Apache-2.0


config SOC_SERIES_IMX6SX
	bool
	select SOC_FAMILY_NXP_IMX

config SOC_MCIMX6X
	bool
	select SOC_SERIES_IMX6SX

config SOC_MCIMX6X_M4
	select SOC_MCIMX6X
	bool
	help
	  NXP iMX6 SoloX M4 core

config SOC_SERIES
	default "imx6sx" if SOC_SERIES_IMX6SX

config SOC
	default "mcimx6x" if SOC_MCIMX6X

config SOC_PART_NUMBER_MCIMX6X1EVK10AB
	bool

config SOC_PART_NUMBER_MCIMX6X1EVK10AC
	bool

config SOC_PART_NUMBER_MCIMX6X3EVK10AB
	bool

config SOC_PART_NUMBER_MCIMX6X3EVK10AC
	bool

config SOC_PART_NUMBER_MCIMX6X1EVO10AB
	bool

config SOC_PART_NUMBER_MCIMX6X1EVO10AC
	bool

config SOC_PART_NUMBER_MCIMX6X3EVO10AB
	bool

config SOC_PART_NUMBER_MCIMX6X3EVO10AC
	bool

config SOC_PART_NUMBER_MCIMX6X2EVN10AB
	bool

config SOC_PART_NUMBER_MCIMX6X2EVN10AC
	bool

config SOC_PART_NUMBER_MCIMX6X3EVN10AB
	bool

config SOC_PART_NUMBER_MCIMX6X3EVN10AC
	bool

config SOC_PART_NUMBER_MCIMX6X4EVM10AB
	bool

config SOC_PART_NUMBER_MCIMX6X4EVM10AC
	bool

config SOC_PART_NUMBER
	default "MCIMX6X1EVK10AB" if SOC_PART_NUMBER_MCIMX6X1EVK10AB
	default "MCIMX6X1EVK10AC" if SOC_PART_NUMBER_MCIMX6X1EVK10AC
	default "MCIMX6X3EVK10AB" if SOC_PART_NUMBER_MCIMX6X3EVK10AB
	default "MCIMX6X3EVK10AC" if SOC_PART_NUMBER_MCIMX6X3EVK10AC
	default "MCIMX6X1EVO10AB" if SOC_PART_NUMBER_MCIMX6X1EVO10AB
	default "MCIMX6X1EVO10AC" if SOC_PART_NUMBER_MCIMX6X1EVO10AC
	default "MCIMX6X3EVO10AB" if SOC_PART_NUMBER_MCIMX6X3EVO10AB
	default "MCIMX6X3EVO10AC" if SOC_PART_NUMBER_MCIMX6X3EVO10AC
	default "MCIMX6X2EVN10AB" if SOC_PART_NUMBER_MCIMX6X2EVN10AB
	default "MCIMX6X2EVN10AC" if SOC_PART_NUMBER_MCIMX6X2EVN10AC
	default "MCIMX6X3EVN10AB" if SOC_PART_NUMBER_MCIMX6X3EVN10AB
	default "MCIMX6X3EVN10AC" if SOC_PART_NUMBER_MCIMX6X3EVN10AC
	default "MCIMX6X4EVM10AB" if SOC_PART_NUMBER_MCIMX6X4EVM10AB
	default "MCIMX6X4EVM10AC" if SOC_PART_NUMBER_MCIMX6X4EVM10AC
```

## soc/nxp/imx/imx7d/Kconfig
```kconfig
# Copyright 2024 NXP
# SPDX-License-Identifier: Apache-2.0

config SOC_SERIES_IMX7D
	select ARM
	select CPU_CORTEX_M4
	select CPU_CORTEX_M_HAS_DWT
	select CLOCK_CONTROL
	select CPU_HAS_FPU
	select CPU_HAS_ARM_MPU
	select SOC_EARLY_INIT_HOOK

config SOC_MCIMX7D_M4
	select HAS_IMX_HAL
```

## soc/nxp/imx/imx7d/Kconfig.defconfig
```kconfig
# iMX7 core series

# Copyright 2017,2024 NXP
# SPDX-License-Identifier: Apache-2.0

if SOC_SERIES_IMX7D

config NUM_IRQS
	# must be >= the highest interrupt number used
	default 127

rsource "Kconfig.defconfig.*"

endif # SOC_SERIES_IMX7D
```

## soc/nxp/imx/imx7d/Kconfig.soc
```kconfig
# iMX7D core series

# Copyright 2017,2024 NXP
# SPDX-License-Identifier: Apache-2.0

config SOC_SERIES_IMX7D
	bool
	select SOC_FAMILY_NXP_IMX
	help
	  Enable support for iMX7D MCU series

config SOC_MCIMX7D
	bool
	select SOC_SERIES_IMX7D

config SOC_MCIMX7D_M4
	bool
	select SOC_MCIMX7D
	help
	  NXP iMX7 Dual M4 Core

config SOC_SERIES
	default "imx7d" if SOC_SERIES_IMX7D

config SOC
	default "mcimx7d" if SOC_MCIMX7D

config SOC_PART_NUMBER_MCIMX7D7DVM10SC
	bool

config SOC_PART_NUMBER_MCIMX7D5EVM10SC
	bool

config SOC_PART_NUMBER_MCIMX7S3DVK08SA
	bool

config SOC_PART_NUMBER
	default	"MCIMX7D7DVM10SC" if SOC_PART_NUMBER_MCIMX7D7DVM10SC
	default "MCIMX7D5EVM10SC" if SOC_PART_NUMBER_MCIMX7D5EVM10SC
	default "MCIMX7S3DVK08SA" if SOC_PART_NUMBER_MCIMX7S3DVK08SA
```

## soc/nxp/imx/imx8/Kconfig
```kconfig
# Copyright 2024 NXP
# SPDX-License-Identifier: Apache-2.0

config SOC_MIMX8QM6_ADSP
	select XTENSA
	select XTENSA_HAL if ("$(ZEPHYR_TOOLCHAIN_VARIANT)" != "xcc" && "$(ZEPHYR_TOOLCHAIN_VARIANT)" != "xt-clang")
	select XTENSA_RESET_VECTOR
	select XTENSA_USE_CORE_CRT1
	select ATOMIC_OPERATIONS_BUILTIN
	select GEN_ISR_TABLES
	select XTENSA_SMALL_VECTOR_TABLE_ENTRY
	select HAS_MCUX
	select CPU_HAS_DCACHE

config MCUX_CORE_SUFFIX
	default "_dsp" if SOC_MIMX8QM6_ADSP
```

## soc/nxp/imx/imx8/Kconfig.defconfig
```kconfig
# Copyright 2024 NXP
# SPDX-License-Identifier: Apache-2.0

if SOC_SERIES_IMX8

if SOC_MIMX8QM6_ADSP

config SYS_CLOCK_HW_CYCLES_PER_SEC
	default 666000000

config SYS_CLOCK_TICKS_PER_SEC
	default 50000

config DCACHE_LINE_SIZE
	default 128

config GEN_IRQ_VECTOR_TABLE
	default n

config CACHE_MANAGEMENT
	default y

config SMP
	default n

config XTENSA_TIMER
	default y

config KERNEL_ENTRY
	default "__start"

config MULTI_LEVEL_INTERRUPTS
	default n

config 2ND_LEVEL_INTERRUPTS
	default n

# To prevent test uses TEST_LOGGING_MINIMAL
config TEST_LOGGING_DEFAULTS
	default n
	depends on TEST

endif # SOC_MIMX8QM6_ADSP

endif # SOC_SERIES_IMX8
```

## soc/nxp/imx/imx8/Kconfig.soc
```kconfig
# Copyright 2024 NXP
# SPDX-License-Identifier: Apache-2.0

config SOC_SERIES_IMX8
	bool
	select SOC_FAMILY_NXP_IMX

config SOC_SERIES
	default "imx8" if SOC_SERIES_IMX8

config SOC_MIMX8QM6
	bool
	select SOC_SERIES_IMX8

config SOC
	default "mimx8qm6" if SOC_MIMX8QM6

config SOC_MIMX8QM6_ADSP
	bool
	select SOC_MIMX8QM6
	help
	  Enable support for NXP i.MX 8QM Audio DSP

config SOC_TOOLCHAIN_NAME
	string
	default "nxp_imx_adsp" if SOC_MIMX8QM6_ADSP

config SOC_PART_NUMBER_MIMX8QM6AVUFF
	bool

config SOC_PART_NUMBER
	default "MIMX8QM6AVUFF" if SOC_PART_NUMBER_MIMX8QM6AVUFF
```

## soc/nxp/imx/imx8m/Kconfig.defconfig
```kconfig
# Copyright 2024 NXP
# SPDX-License-Identifier: Apache-2.0

if SOC_SERIES_IMX8M

rsource "Kconfig.defconfig.*"

endif # SOC_SERIES_IMX8M
```

## soc/nxp/imx/imx8m/Kconfig.defconfig.mimx8ml8.m7
```kconfig
# MIMX8ML8 SoC defconfig

# Copyright (c) 2021, Laird Connectivity
# Copyright 2024 NXP
# SPDX-License-Identifier: Apache-2.0

if SOC_MIMX8MP_M7

config SOC
	string
	default "mimx8ml8"

config SYS_CLOCK_HW_CYCLES_PER_SEC
	int
	default 800000000

config GPIO
	default y

config IPM_IMX
	default y
	depends on IPM

if CODE_ITCM

config FLASH_SIZE
	default $(dt_node_reg_size_int,/soc/itcm@0,0,K)

config FLASH_BASE_ADDRESS
	default $(dt_node_reg_addr_hex,/soc/itcm@0)

endif # CODE_ITCM

if CODE_DDR

config FLASH_SIZE
	default $(dt_node_reg_size_int,/soc/code@80000000,0,K)

config FLASH_BASE_ADDRESS
	default $(dt_node_reg_addr_hex,/soc/code@80000000)

endif # CODE_DDR

config NUM_IRQS
	int
	# must be >= the highest interrupt number used
	default 159

config PINCTRL_IMX
	default y if HAS_MCUX_IOMUXC
	depends on PINCTRL

endif # SOC_MIMX8MP_M7
```

## soc/nxp/imx/imx8m/Kconfig.defconfig.mimx8mm6_a53
```kconfig
# Copyright 2020-2025 NXP
# SPDX-License-Identifier: Apache-2.0

if SOC_MIMX8MM6_A53

# Enable GIC Safe Configuration to run multiple OSes on Cortex-A Cores
config GIC_SAFE_CONFIG
	default y

# Disable data cache until MMU is enabled when booting from EL2
config ARM64_DCACHE_ALL_OPS
	default y
config ARM64_BOOT_DISABLE_DCACHE
	default y

config NUM_IRQS
	default 240

config SYS_CLOCK_HW_CYCLES_PER_SEC
	default 8000000

endif
```

## soc/nxp/imx/imx8m/Kconfig.defconfig.mimx8mn6_a53
```kconfig
# Copyright 2022-2024 NXP
# SPDX-License-Identifier: Apache-2.0

if SOC_MIMX8MN6_A53

# Workaround for not being able to have commas in macro arguments
DT_CHOSEN_Z_FLASH := zephyr,flash

config FLASH_SIZE
	default $(dt_chosen_reg_size_int,$(DT_CHOSEN_Z_FLASH),0,K)

config FLASH_BASE_ADDRESS
	default $(dt_chosen_reg_addr_hex,$(DT_CHOSEN_Z_FLASH))

config NUM_IRQS
	default 240

config SYS_CLOCK_HW_CYCLES_PER_SEC
	default 8000000

endif
```

## soc/nxp/imx/imx8m/Kconfig.soc
```kconfig
# Copyright 2024 NXP
# SPDX-License-Identifier: Apache-2.0

config SOC_SERIES_IMX8M
	bool
	select SOC_FAMILY_NXP_IMX

config SOC_SERIES
	default "imx8m" if SOC_SERIES_IMX8M

config SOC_MIMX8MM6
	bool
	select SOC_SERIES_IMX8M

config SOC_MIMX8MM6_A53
	bool
	select SOC_MIMX8MM6
	help
	  NXP i.MX8MM A53

config SOC_MIMX8MM6_M4
	bool
	select SOC_MIMX8MM6
	help
	  NXP i.MX8MM M4

config SOC_MIMX8ML8
	bool
	select SOC_SERIES_IMX8M

config SOC_MIMX8ML8_A53
	bool
	select SOC_MIMX8ML8
	help
	  NXP i.MX8MP A53

config SOC_MIMX8ML8_ADSP
	bool
	select SOC_MIMX8ML8
	help
	  Enable support for NXP i.MX 8MPLUS Audio DSP

config SOC_MIMX8ML8_M7
	bool
	select SOC_MIMX8ML8
	help
	  Enable support for NXP i.MX 8MPLUS M7 MCU

config SOC_MIMX8MQ6
	bool
	select SOC_SERIES_IMX8M

config SOC_MIMX8MQ6_M4
	bool
	select SOC_MIMX8MQ6
	help
	  Enable support for NXP i.MX 8M Quad M4 MCU

config SOC_TOOLCHAIN_NAME
	string
	default "nxp_imx8m_adsp" if SOC_MIMX8ML8_ADSP

config SOC_MIMX8MN6
	bool
	select SOC_SERIES_IMX8M

config SOC_MIMX8MN6_A53
	bool
	select SOC_MIMX8MN6
	help
	  NXP i.MX8MN A53

config SOC
	default "mimx8mm6" if SOC_MIMX8MM6
	default "mimx8mn6" if SOC_MIMX8MN6
	default "mimx8ml8" if SOC_MIMX8ML8
	default "mimx8mq6" if SOC_MIMX8MQ6

config SOC_PART_NUMBER_MIMX8ML8DVNLZ
	bool

config SOC_PART_NUMBER_MIMX8MM6DVTLZ
	bool

config SOC_PART_NUMBER_MIMX8MM6CVTKZ
	bool

config SOC_PART_NUMBER_MIMX8MN6DVTJZ
	bool

config SOC_PART_NUMBER_MIMX8MN6DUCJZ
	bool

config SOC_PART_NUMBER_MIMX8MN6CVTIZ
	bool

config SOC_PART_NUMBER_MIMX8MN6CUCIZ
	bool

config SOC_PART_NUMBER_MIMX8MQ6DVAJZ
	bool

config SOC_PART_NUMBER
	default "MIMX8ML8DVNLZ" if SOC_PART_NUMBER_MIMX8ML8DVNLZ
	default "MIMX8MM6DVTLZ" if SOC_PART_NUMBER_MIMX8MM6DVTLZ
	default "MIMX8MM6CVTKZ" if SOC_PART_NUMBER_MIMX8MM6CVTKZ
	default "MIMX8MN6DVTJZ" if SOC_PART_NUMBER_MIMX8MN6DVTJZ
	default "MIMX8MN6DUCJZ" if SOC_PART_NUMBER_MIMX8MN6DUCJZ
	default "MIMX8MN6CVTIZ" if SOC_PART_NUMBER_MIMX8MN6CVTIZ
	default "MIMX8MN6CUCIZ" if SOC_PART_NUMBER_MIMX8MN6CUCIZ
	default "MIMX8MQ6DVAJZ" if SOC_PART_NUMBER_MIMX8MQ6DVAJZ
```

## soc/nxp/imx/imx8ulp/Kconfig.soc
```kconfig
# Copyright 2024 NXP
# SPDX-License-Identifier: Apache-2.0

config SOC_SERIES_IMX8ULP
	bool
	select SOC_FAMILY_NXP_IMX

config SOC_SERIES
	default "imx8ulp" if SOC_SERIES_IMX8ULP

config SOC_MIMX8UD7
	bool
	select SOC_SERIES_IMX8ULP

config SOC
	default "mimx8ud7" if SOC_MIMX8UD7

config SOC_MIMX8UD7_ADSP
	bool
	select SOC_MIMX8UD7
	help
	  Enable support for NXP i.MX 8ULP Audio DSP

config SOC_TOOLCHAIN_NAME
	string
	default "nxp_imx8ulp_adsp" if SOC_MIMX8UD7_ADSP

config SOC_PART_NUMBER_MIMX8UD7DVK08
	bool

config SOC_PART_NUMBER
	default "MIMX8UD7DVK08" if SOC_PART_NUMBER_MIMX8UD7DVK08
```

## soc/nxp/imx/imx8x/Kconfig.soc
```kconfig
# Copyright 2024 NXP
# SPDX-License-Identifier: Apache-2.0

config SOC_SERIES_IMX8X
	bool
	select SOC_FAMILY_NXP_IMX

config SOC_SERIES
	default "imx8x" if SOC_SERIES_IMX8X

config SOC_MIMX8QX6
	bool
	select SOC_SERIES_IMX8X

config SOC
	default "mimx8qx6" if SOC_MIMX8QX6

config SOC_MIMX8QX6_ADSP
	bool
	select SOC_MIMX8QX6
	help
	  Enable support for NXP i.MX 8QXP Audio DSP

config SOC_TOOLCHAIN_NAME
	string
	default "nxp_imx_adsp" if SOC_MIMX8QX6_ADSP

config SOC_PART_NUMBER_MIMX8QX6AVLFZ
	bool

config SOC_PART_NUMBER_MIMX8QX6CVLDZ
	bool

config SOC_PART_NUMBER
	default "MIMX8QX6AVLFZ" if SOC_PART_NUMBER_MIMX8QX6AVLFZ
	default "MIMX8QX6CVLDZ" if SOC_PART_NUMBER_MIMX8QX6CVLDZ
```

## soc/nxp/imx/imx9/Kconfig
```kconfig
# Copyright 2024 NXP
# SPDX-License-Identifier: Apache-2.0

config SOC_MIMX9352_A55
	select ARM64
	select CPU_CORTEX_A55
	select ARM_ARCH_TIMER if SYS_CLOCK_EXISTS
	select HAS_MCUX if CLOCK_CONTROL
	select HAS_MCUX_CCM_REV2 if CLOCK_CONTROL
	select HAS_MCUX_IOMUXC if PINCTRL

config MCUX_CORE_SUFFIX
	default "_ca55" if SOC_MIMX9352_A55
```

## soc/nxp/imx/imx9/Kconfig.defconfig.mimx95.m7
```kconfig
# Copyright 2024 NXP
# SPDX-License-Identifier: Apache-2.0

if SOC_MIMX9596_M7

config FLASH_SIZE
	default $(dt_node_reg_size_int,/soc/itcm@0,0,K)

config FLASH_BASE_ADDRESS
	default $(dt_node_reg_addr_hex,/soc/itcm@0)

config NUM_IRQS
	int
	default 230

config SYS_CLOCK_HW_CYCLES_PER_SEC
	int
	default 800000000

endif # SOC_MIMX9596_M7
```

## soc/nxp/imx/imx9/Kconfig.soc
```kconfig
# Copyright 2024 NXP
# SPDX-License-Identifier: Apache-2.0

config SOC_SERIES_IMX9
	bool
	select SOC_FAMILY_NXP_IMX
	imply COMPILER_LARGE_TU_DIAGNOSTICS_DEFAULT_SUPPRESS_MISLEADING_INDENTATION

config SOC_SERIES
	default "imx9" if SOC_SERIES_IMX9

rsource "*/Kconfig.soc"
```

## soc/nxp/imx/imx9/imx91/Kconfig
```kconfig
# Copyright 2025 NXP
# SPDX-License-Identifier: Apache-2.0

config SOC_MIMX9131
	select ARM64
	select CPU_CORTEX_A55
	select ARM_ARCH_TIMER if SYS_CLOCK_EXISTS
	select HAS_MCUX if CLOCK_CONTROL
	select HAS_MCUX_CACHE
	select KERNEL_DIRECT_MAP if HAS_MCUX
```

## soc/nxp/imx/imx9/imx91/Kconfig.soc
```kconfig
# Copyright 2025 NXP
# SPDX-License-Identifier: Apache-2.0

config SOC_MIMX9111
	bool
	select SOC_SERIES_IMX9
	help
	  NXP i.MX91

config SOC_MIMX9131
	bool
	select SOC_SERIES_IMX9
	help
	  NXP i.MX91

config SOC_PART_NUMBER_MIMX9111CVXXJ
	bool

config SOC_PART_NUMBER_MIMX9111DVXXJ
	bool

config SOC_PART_NUMBER_MIMX9131CVVXJ
	bool

config SOC_PART_NUMBER_MIMX9131DVVXJ
	bool

config SOC_PART_NUMBER
	default "MIMX9111CVXXJ" if SOC_PART_NUMBER_MIMX9111CVXXJ
	default "MIMX9111DVXXJ" if SOC_PART_NUMBER_MIMX9111DVXXJ
	default "MIMX9131CVVXJ" if SOC_PART_NUMBER_MIMX9131CVVXJ
	default "MIMX9131DVVXJ" if SOC_PART_NUMBER_MIMX9131DVVXJ

config SOC
	default "mimx9111" if SOC_MIMX9111
	default "mimx9131" if SOC_MIMX9131
```

## soc/nxp/imx/imx9/imx93/Kconfig
```kconfig
# Copyright 2024-2025 NXP
# SPDX-License-Identifier: Apache-2.0

config SOC_MIMX9352_A55
	select ARM64
	select CPU_CORTEX_A55
	select ARM_ARCH_TIMER if SYS_CLOCK_EXISTS
	select HAS_MCUX if CLOCK_CONTROL
	select HAS_MCUX_CACHE

config SOC_MIMX9352_M33
	select ARM
	select CPU_CORTEX_M33
	select CPU_CORTEX_M_HAS_DWT
	select CPU_HAS_FPU
	select CPU_HAS_ARM_MPU
	select CPU_HAS_ARM_SAU
	select ARM_MPU
	select ARMV8_M_DSP
	select HAS_MCUX
	select HAS_MCUX_CACHE
	select SOC_EARLY_INIT_HOOK
	select SOC_RESET_HOOK

config MCUX_CORE_SUFFIX
	default "_ca55" if SOC_MIMX9352_A55
	default "_cm33" if SOC_MIMX9352_M33

if SOC_MIMX9352_M33

config TRDC_MCUX_TRDC_1
	default y
	bool "Use TRDC_1 MCUX Driver"
endif # SOC_MIMX9352_M33
```

## soc/nxp/imx/imx9/imx93/Kconfig.defconfig.mimx93.m33
```kconfig
# Copyright 2024 NXP
# SPDX-License-Identifier: Apache-2.0

if SOC_MIMX9352_M33

config NUM_IRQS
	default 268

config SYS_CLOCK_HW_CYCLES_PER_SEC
	default 200000000

endif
```

## soc/nxp/imx/imx9/imx93/Kconfig.soc
```kconfig
# Copyright 2022,2024 NXP
# SPDX-License-Identifier: Apache-2.0

config SOC_MIMX9352
	bool
	select SOC_SERIES_IMX9

config SOC_MIMX9352_A55
	bool
	select SOC_MIMX9352
	help
	  NXP i.MX93 A55

config SOC_MIMX9352_M33
	bool
	select SOC_MIMX9352
	help
	  NXP i.MX93 M33

config SOC_PART_NUMBER_MIMX9352CVVXM
	bool

config SOC_PART_NUMBER_MIMX9352DVVXM
	bool

config SOC_PART_NUMBER_MIMX9352AVTXM
	bool

config SOC_PART_NUMBER_MIMX9352XVVXM
	bool

config SOC_PART_NUMBER
	default "MIMX9352CVVXM" if SOC_PART_NUMBER_MIMX9352CVVXM
	default "MIMX9352DVVXM" if SOC_PART_NUMBER_MIMX9352DVVXM
	default "MIMX9352AVTXM" if SOC_PART_NUMBER_MIMX9352AVTXM
	default "MIMX9352XVVXM" if SOC_PART_NUMBER_MIMX9352XVVXM

config SOC
	default "mimx9352" if SOC_MIMX9352
```
