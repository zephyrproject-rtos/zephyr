## soc/nxp/imx/imx9/imx943/Kconfig.defconfig
```kconfig
# Copyright 2025 NXP
# SPDX-License-Identifier: Apache-2.0

if SOC_SERIES_IMX9

rsource "Kconfig.defconfig.*"

endif # SOC_SERIES_IMX9
```

## soc/nxp/imx/imx9/imx943/Kconfig.defconfig.mimx94398.a55
```kconfig
# Copyright 2025 NXP
# SPDX-License-Identifier: Apache-2.0

if SOC_MIMX94398_A55

# Workaround for not being able to have commas in macro arguments
DT_CHOSEN_Z_FLASH := zephyr,flash

config FLASH_SIZE
	default $(dt_chosen_reg_size_int,$(DT_CHOSEN_Z_FLASH),0,K)

config FLASH_BASE_ADDRESS
	default $(dt_chosen_reg_addr_hex,$(DT_CHOSEN_Z_FLASH))

# Enable GIC Safe Configuration to run multiple OSes on Cortex-A Cores
config GIC_SAFE_CONFIG
	default y

config GIC_V3_RDIST_DMA_NONCOHERENT
	default y

config GIC_V3_ITS_DMA_NONCOHERENT
	default y

# Disable data cache until MMU is enabled when booting from EL2
config ARM64_DCACHE_ALL_OPS
	default y

config ARM64_BOOT_DISABLE_DCACHE
	default y

config MCUX_CORE_SUFFIX
	default "_ca55" if SOC_MIMX94398_A55

# Reserve 8192 LPI interrupt ID starts from 8192 when ITS is enabled
config NUM_IRQS
	default 16384 if GIC_V3_ITS
	default 437 if !GIC_V3_ITS

config SYS_CLOCK_HW_CYCLES_PER_SEC
	default 24000000

endif
```

## soc/nxp/imx/imx9/imx943/Kconfig.defconfig.mimx94398.m33
```kconfig
# Copyright 2025 NXP
# SPDX-License-Identifier: Apache-2.0

if SOC_MIMX94398_M33

DT_CHOSEN_Z_FLASH := zephyr,flash

configdefault FLASH_SIZE
	default $(dt_chosen_reg_size_int,$(DT_CHOSEN_Z_FLASH),0,K)

configdefault FLASH_BASE_ADDRESS
	default $(dt_chosen_reg_addr_hex,$(DT_CHOSEN_Z_FLASH))

configdefault MCUX_CORE_SUFFIX
	default "_cm33_core1" if SOC_MIMX94398_M33

# Multi-level interrupts
# Some interrupts(e.g. dma interrupts) depend on irqsteer.
# So enable Multi-level interrupts
config MULTI_LEVEL_INTERRUPTS
	default y
	depends on GEN_ISR_TABLES

configdefault 1ST_LEVEL_INTERRUPT_BITS
	default 9

configdefault MAX_IRQ_PER_AGGREGATOR
	default 64

configdefault 2ND_LEVEL_INTERRUPTS
	default y

configdefault 2ND_LVL_ISR_TBL_OFFSET
	default 407

configdefault NUM_2ND_LEVEL_AGGREGATORS
	default 6

configdefault 2ND_LEVEL_INTERRUPT_BITS
	default 9

configdefault 2ND_LVL_INTR_00_OFFSET
	default 224

configdefault 2ND_LVL_INTR_01_OFFSET
	default 225

configdefault 2ND_LVL_INTR_02_OFFSET
	default 226

configdefault 2ND_LVL_INTR_03_OFFSET
	default 227

configdefault 2ND_LVL_INTR_04_OFFSET
	default 228

configdefault 2ND_LVL_INTR_05_OFFSET
	default 229

configdefault 3RD_LEVEL_INTERRUPTS
	default n

configdefault NUM_IRQS
	default 791

configdefault CORTEX_M_SYSTICK
	default n if MCUX_GPT_TIMER

configdefault SYS_CLOCK_HW_CYCLES_PER_SEC
	default $(dt_node_int_prop_int,/cpus/cpu@0,clock-frequency) if CORTEX_M_SYSTICK
	default 32768 if MCUX_GPT_TIMER

choice CACHE_TYPE
	default EXTERNAL_CACHE
endchoice

configdefault ETH_NXP_IMX_MSGINTR
	default 2

configdefault CACHE_MANAGEMENT
	default y

if PM

configdefault IDLE_STACK_SIZE
	default 640

configdefault MCUX_GPT_TIMER
	default y

configdefault SYS_CLOCK_TICKS_PER_SEC
	default 1024

endif

configdefault DMA_TCD_QUEUE_SIZE
	default 4

endif # SOC_MIMX94398_M33
```

## soc/nxp/imx/imx9/imx943/Kconfig.defconfig.mimx94398.m7_0
```kconfig
# Copyright 2025 NXP
# SPDX-License-Identifier: Apache-2.0

if SOC_MIMX94398_M7_0

DT_CHOSEN_Z_FLASH := zephyr,flash

configdefault FLASH_SIZE
	default $(dt_chosen_reg_size_int,$(DT_CHOSEN_Z_FLASH),0,K)

configdefault FLASH_BASE_ADDRESS
	default $(dt_chosen_reg_addr_hex,$(DT_CHOSEN_Z_FLASH))

configdefault MCUX_CORE_SUFFIX
	default "_cm7_core0" if SOC_MIMX94398_M7_0

configdefault NUM_IRQS
	default 238

configdefault SYS_CLOCK_HW_CYCLES_PER_SEC
	default $(dt_node_int_prop_int,/cpus/cpu@0,clock-frequency)

configdefault ETH_NXP_IMX_MSGINTR
	default 2

configdefault CACHE_MANAGEMENT
	default n

if PM

configdefault IDLE_STACK_SIZE
	default 640

config PM_S2RAM
	default y

config HAS_PM_S2RAM_CUSTOM_MARKING
	default y

endif

configdefault DMA_TCD_QUEUE_SIZE
	default 4

endif # SOC_MIMX94398_M7_0
```

## soc/nxp/imx/imx9/imx943/Kconfig.defconfig.mimx94398.m7_1
```kconfig
# Copyright 2025 NXP
# SPDX-License-Identifier: Apache-2.0

if SOC_MIMX94398_M7_1

DT_CHOSEN_Z_FLASH := zephyr,flash

configdefault FLASH_SIZE
	default $(dt_chosen_reg_size_int,$(DT_CHOSEN_Z_FLASH),0,K)

configdefault FLASH_BASE_ADDRESS
	default $(dt_chosen_reg_addr_hex,$(DT_CHOSEN_Z_FLASH))

configdefault MCUX_CORE_SUFFIX
	default "_cm7_core1" if SOC_MIMX94398_M7_1

configdefault NUM_IRQS
	default 238

configdefault CORTEX_M_SYSTICK
	default n if MCUX_GPT_TIMER

configdefault SYS_CLOCK_HW_CYCLES_PER_SEC
	default $(dt_node_int_prop_int,/cpus/cpu@0,clock-frequency) if CORTEX_M_SYSTICK
	default 32768 if MCUX_GPT_TIMER

configdefault ETH_NXP_IMX_MSGINTR
	default 2

configdefault CACHE_MANAGEMENT
	default n

if PM

configdefault IDLE_STACK_SIZE
	default 640

configdefault PM_S2RAM
	default y

configdefault HAS_PM_S2RAM_CUSTOM_MARKING
	default y

configdefault MCUX_GPT_TIMER
	default y

configdefault SYS_CLOCK_TICKS_PER_SEC
	default 1024

endif

configdefault DMA_TCD_QUEUE_SIZE
	default 4

endif # SOC_MIMX94398_M7_1
```

## soc/nxp/imx/imx9/imx943/Kconfig.soc
```kconfig
# Copyright 2025 NXP
# SPDX-License-Identifier: Apache-2.0

config SOC_MIMX94398
	bool
	select SOC_SERIES_IMX9

config SOC_MIMX94398_A55
	bool
	select SOC_MIMX94398
	help
	  NXP i.MX943 A55

config SOC_MIMX94398_M33
	bool
	select SOC_MIMX94398
	help
	  NXP i.MX943 Cortex-M33 Core1 in NETC MIX

config SOC_MIMX94398_M7_0
	bool
	select SOC_MIMX94398
	help
	  NXP i.MX943 Cortex-M7 Core0 in M7MIX0

config SOC_MIMX94398_M7_1
	bool
	select SOC_MIMX94398
	help
	  NXP i.MX943 Cortex-M7 Core1 in M7MIX1

config SOC
	default "mimx94398" if SOC_MIMX94398

config SOC_PART_NUMBER_MIMX94398AVKM
	bool

config SOC_PART_NUMBER
	default "MIMX94398AVKM" if SOC_PART_NUMBER_MIMX94398AVKM
```

## soc/nxp/imx/imx9/imx95/Kconfig
```kconfig
# Copyright 2024 NXP
# SPDX-License-Identifier: Apache-2.0

config SOC_MIMX9596_M7
	select ARM
	select CPU_CORTEX_M7
	select CPU_HAS_FPU
	select CPU_HAS_FPU_DOUBLE_PRECISION
	select CPU_HAS_ICACHE
	select CPU_HAS_DCACHE
	select CPU_HAS_ARM_MPU
	select ARM_MPU
	select SOC_LATE_INIT_HOOK
	select HAS_MCUX

config SOC_MIMX9596_A55
	select ARM64
	select CPU_CORTEX_A55
	select ARM_ARCH_TIMER if SYS_CLOCK_EXISTS
	select HAS_MCUX
	select HAS_MCUX_CACHE

config MCUX_CORE_SUFFIX
	default "_cm7" if SOC_MIMX9596_M7
	default "_ca55" if SOC_MIMX9596_A55
```

## soc/nxp/imx/imx9/imx95/Kconfig.defconfig.mimx95.m7
```kconfig
# Copyright 2024 NXP
# SPDX-License-Identifier: Apache-2.0

if SOC_MIMX9596_M7

DT_CHOSEN_Z_FLASH := zephyr,flash

config FLASH_SIZE
	default $(dt_chosen_reg_size_int,$(DT_CHOSEN_Z_FLASH),0,K)

config FLASH_BASE_ADDRESS
	default $(dt_chosen_reg_addr_hex,$(DT_CHOSEN_Z_FLASH))

# multi-level interrupts
config MULTI_LEVEL_INTERRUPTS
	default y

config 1ST_LEVEL_INTERRUPT_BITS
	default 8

config MAX_IRQ_PER_AGGREGATOR
	default 16

config 2ND_LEVEL_INTERRUPTS
	default y

config 2ND_LVL_ISR_TBL_OFFSET
	default 234

# 8 aggregators are from display irqsteer
#   max interrupts: 8 * 64 = 512
# 10 aggregators are from cortex-m7 irqsteer
#   max interrupts: 10 * 64 = 640
config NUM_2ND_LEVEL_AGGREGATORS
	default 18

config 2ND_LEVEL_INTERRUPT_BITS
	default 8

# 214 - 219 for display irqsteer interrupt controller(first instance)
config 2ND_LVL_INTR_00_OFFSET
	default 214

config 2ND_LVL_INTR_01_OFFSET
	default 215

config 2ND_LVL_INTR_02_OFFSET
	default 216

config 2ND_LVL_INTR_03_OFFSET
	default 217

config 2ND_LVL_INTR_04_OFFSET
	default 218

config 2ND_LVL_INTR_07_OFFSET
	default 219

# 224 - 233 for irqsteer interrupt controller(second instance)
config 2ND_LVL_INTR_010_OFFSET
	default 224

config 2ND_LVL_INTR_011_OFFSET
	default 225

config 2ND_LVL_INTR_012_OFFSET
	default 226

config 2ND_LVL_INTR_013_OFFSET
	default 227

config 2ND_LVL_INTR_014_OFFSET
	default 228

config 2ND_LVL_INTR_015_OFFSET
	default 229

config 2ND_LVL_INTR_016_OFFSET
	default 230

config 2ND_LVL_INTR_017_OFFSET
	default 231

config 2ND_LVL_INTR_018_OFFSET
	default 232

config 2ND_LVL_INTR_019_OFFSET
	default 233

config 3RD_LEVEL_INTERRUPTS
	default n

config NUM_IRQS
	default 1514 # 2ND_LVL_ISR_TBL_OFFSET + MAX_IRQ_PER_AGGREGATOR * NUM_2ND_LEVEL_AGGREGATORS

config SYS_CLOCK_HW_CYCLES_PER_SEC
	default 800000000

config CACHE_MANAGEMENT
	default y

config ETH_NXP_IMX_MSGINTR
	default 2
if PM
# PM code that runs from the idle loop has a large
# footprint. Hence increase the size when PM is enabled.
config IDLE_STACK_SIZE
	default 640
endif

if PM_DEVICE

config POWER_DOMAIN
	default y

endif # PM_DEVICE

config ROM_START_OFFSET
	default 0x800 if BOOTLOADER_MCUBOOT

endif # SOC_MIMX9596_M7
```

## soc/nxp/imx/imx9/imx95/Kconfig.soc
```kconfig
# Copyright 2024 NXP
# SPDX-License-Identifier: Apache-2.0

config SOC_MIMX9596
	bool
	select SOC_SERIES_IMX9

config SOC_MIMX9596_M7
	bool
	select SOC_MIMX9596
	help
	  NXP i.MX95 M7

config SOC_MIMX9596_A55
	bool
	select SOC_MIMX9596
	help
	  NXP i.MX95 A55

config SOC
	default "mimx9596" if SOC_MIMX9596

config SOC_PART_NUMBER_MIMX9596AVZXN
	bool

config SOC_PART_NUMBER
	default "MIMX9596AVZXN" if SOC_PART_NUMBER_MIMX9596AVZXN
```

## soc/nxp/imx/imx9/imx952/Kconfig
```kconfig
# Copyright 2026 NXP
# SPDX-License-Identifier: Apache-2.0

config SOC_MIMX9529_M7
	select ARM
	select CPU_CORTEX_M7
	select CPU_CORTEX_M_HAS_DWT
	select CPU_HAS_FPU
	select CPU_HAS_FPU_DOUBLE_PRECISION
	select CPU_HAS_ICACHE
	select CPU_HAS_DCACHE
	select CPU_HAS_ARM_MPU
	select ARM_MPU
	select SOC_EARLY_INIT_HOOK
	select HAS_MCUX
	select HAS_MCUX_CACHE
	select HAS_PM
	select PM_STATE_SET_IRQ_UNLOCKED
```

## soc/nxp/imx/imx9/imx952/Kconfig.defconfig.mimx952.a55
```kconfig
# SPDX-FileCopyrightText: Copyright 2026 NXP
# SPDX-License-Identifier: Apache-2.0

if SOC_MIMX9529_A55

# Enable GIC Safe Configuration to run multiple OSes on Cortex-A Cores
config GIC_SAFE_CONFIG
	default y

config GIC_V3_RDIST_DMA_NONCOHERENT
	default y

config GIC_V3_ITS_DMA_NONCOHERENT
	default y

# Disable data cache until MMU is enabled when booting from EL2
config ARM64_DCACHE_ALL_OPS
	default y

config ARM64_BOOT_DISABLE_DCACHE
	default y

config MCUX_CORE_SUFFIX
	default "_ca55" if SOC_MIMX9529_A55

# Reserve 8192 LPI interrupt ID starts from 8192 when ITS is enabled
config NUM_IRQS
	default 16384 if GIC_V3_ITS
	default 437 if !GIC_V3_ITS

config SYS_CLOCK_HW_CYCLES_PER_SEC
	default $(dt_node_int_prop_int,/cpus/cpu@0,clock-frequency) \
		if $(dt_path_enabled,/cpus/cpu@0)
	default $(dt_node_int_prop_int,/cpus/cpu@100,clock-frequency) \
		if $(dt_path_enabled,/cpus/cpu@100)
	default $(dt_node_int_prop_int,/cpus/cpu@200,clock-frequency) \
		if $(dt_path_enabled,/cpus/cpu@200)
	default $(dt_node_int_prop_int,/cpus/cpu@300,clock-frequency) \
		if $(dt_path_enabled,/cpus/cpu@300)

endif
```

## soc/nxp/imx/imx9/imx952/Kconfig.soc
```kconfig
# Copyright 2026 NXP
# SPDX-License-Identifier: Apache-2.0

config SOC_MIMX9529
	bool
	select SOC_SERIES_IMX9

config SOC_MIMX9529_M7
	bool
	select SOC_MIMX9529
	help
	  NXP i.MX952 M7

config SOC
	default "mimx9529" if SOC_MIMX9529

config SOC_PART_NUMBER_MIMX95294AVTM
	bool

config SOC_PART_NUMBER_MIMX95294AVZM
	bool

config SOC_PART_NUMBER_MIMX9529xxVZx
	bool

config SOC_PART_NUMBER
	default "MIMX9529xxVZx" if SOC_PART_NUMBER_MIMX9529xxVZx
	default "MIMX95294AVZM" if SOC_PART_NUMBER_MIMX95294AVZM
```
