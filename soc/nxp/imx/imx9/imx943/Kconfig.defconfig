## soc/nxp/imxrt/imxrt10xx/Kconfig.soc
```kconfig
# Copyright 2024 NXP
# SPDX-License-Identifier: Apache-2.0

config SOC_SERIES_IMXRT10XX
	bool
	select SOC_FAMILY_NXP_IMXRT

config SOC_SERIES
	default "imxrt10xx" if SOC_SERIES_IMXRT10XX

config SOC_MIMXRT1011
	bool
	select SOC_SERIES_IMXRT10XX

config SOC_MIMXRT1015
	bool
	select SOC_SERIES_IMXRT10XX

config SOC_MIMXRT1021
	bool
	select SOC_SERIES_IMXRT10XX

config SOC_MIMXRT1024
	bool
	select SOC_SERIES_IMXRT10XX

config SOC_MIMXRT1042
	bool
	select SOC_SERIES_IMXRT10XX

config SOC_MIMXRT1052
	bool
	select SOC_SERIES_IMXRT10XX

config SOC_MIMXRT1062
	bool
	select SOC_SERIES_IMXRT10XX

config SOC_MIMXRT1064
	bool
	select SOC_SERIES_IMXRT10XX

config SOC
	default "mimxrt1011" if SOC_MIMXRT1011
	default "mimxrt1015" if SOC_MIMXRT1015
	default "mimxrt1021" if SOC_MIMXRT1021
	default "mimxrt1024" if SOC_MIMXRT1024
	default "mimxrt1042" if SOC_MIMXRT1042
	default "mimxrt1052" if SOC_MIMXRT1052
	default "mimxrt1062" if SOC_MIMXRT1062
	default "mimxrt1064" if SOC_MIMXRT1064

config SOC_PART_NUMBER_MIMXRT1011CAE4A
	bool
	select SOC_MIMXRT1011

config SOC_PART_NUMBER_MIMXRT1011DAE5A
	bool
	select SOC_MIMXRT1011

config SOC_PART_NUMBER_MIMXRT1015CAF4A
	bool
	select SOC_MIMXRT1015

config SOC_PART_NUMBER_MIMXRT1015DAF5A
	bool
	select SOC_MIMXRT1015

config SOC_PART_NUMBER_MIMXRT1021CAF4A
	bool
	select SOC_MIMXRT1021

config SOC_PART_NUMBER_MIMXRT1021CAG4A
	bool
	select SOC_MIMXRT1021

config SOC_PART_NUMBER_MIMXRT1021DAF5A
	bool
	select SOC_MIMXRT1021

config SOC_PART_NUMBER_MIMXRT1021DAG5A
	bool
	select SOC_MIMXRT1021

config SOC_PART_NUMBER_MIMXRT1024CAG4A
	bool
	select SOC_MIMXRT1024

config SOC_PART_NUMBER_MIMXRT1024DAG5A
	bool
	select SOC_MIMXRT1024

config SOC_PART_NUMBER_MIMXRT1042DFP6B
	bool
	select SOC_MIMXRT1042

config SOC_PART_NUMBER_MIMXRT1042DJM6B
	bool
	select SOC_MIMXRT1042

config SOC_PART_NUMBER_MIMXRT1042XFP5B
	bool
	select SOC_MIMXRT1042

config SOC_PART_NUMBER_MIMXRT1042XJM5B
	bool
	select SOC_MIMXRT1042

config SOC_PART_NUMBER_MIMXRT1052CVJ5B
	bool
	select SOC_MIMXRT1052

config SOC_PART_NUMBER_MIMXRT1052CVL5A
	bool
	select SOC_MIMXRT1052

config SOC_PART_NUMBER_MIMXRT1052CVL5B
	bool
	select SOC_MIMXRT1052

config SOC_PART_NUMBER_MIMXRT1052DVJ6B
	bool
	select SOC_MIMXRT1052

config SOC_PART_NUMBER_MIMXRT1052DVL6A
	bool
	select SOC_MIMXRT1052

config SOC_PART_NUMBER_MIMXRT1052DVL6B
	bool
	select SOC_MIMXRT1052

config SOC_PART_NUMBER_MIMXRT1062CVJ5A
	bool
	select SOC_MIMXRT1062

config SOC_PART_NUMBER_MIMXRT1062CVJ5B
	bool
	select SOC_MIMXRT1062

config SOC_PART_NUMBER_MIMXRT1062CVL5A
	bool
	select SOC_MIMXRT1062

config SOC_PART_NUMBER_MIMXRT1062DVJ6A
	bool
	select SOC_MIMXRT1062

config SOC_PART_NUMBER_MIMXRT1062DVL6A
	bool
	select SOC_MIMXRT1062

config SOC_PART_NUMBER_MIMXRT1064CVL5A
	bool
	select SOC_MIMXRT1064

config SOC_PART_NUMBER_MIMXRT1064DVL6A
	bool
	select SOC_MIMXRT1064

config SOC_PART_NUMBER
	default "MIMXRT1011CAE4A" if SOC_PART_NUMBER_MIMXRT1011CAE4A
	default "MIMXRT1011DAE5A" if SOC_PART_NUMBER_MIMXRT1011DAE5A
	default "MIMXRT1015CAF4A" if SOC_PART_NUMBER_MIMXRT1015CAF4A
	default "MIMXRT1015DAF5A" if SOC_PART_NUMBER_MIMXRT1015DAF5A
	default "MIMXRT1021CAF4A" if SOC_PART_NUMBER_MIMXRT1021CAF4A
	default "MIMXRT1021CAG4A" if SOC_PART_NUMBER_MIMXRT1021CAG4A
	default "MIMXRT1021DAF5A" if SOC_PART_NUMBER_MIMXRT1021DAF5A
	default "MIMXRT1021DAG5A" if SOC_PART_NUMBER_MIMXRT1021DAG5A
	default "MIMXRT1024CAG4A" if SOC_PART_NUMBER_MIMXRT1024CAG4A
	default "MIMXRT1024DAG5A" if SOC_PART_NUMBER_MIMXRT1024DAG5A
	default "MIMXRT1042DFP6B" if SOC_PART_NUMBER_MIMXRT1042DFP6B
	default "MIMXRT1042DJM6B" if SOC_PART_NUMBER_MIMXRT1042DJM6B
	default "MIMXRT1042XFP5B" if SOC_PART_NUMBER_MIMXRT1042XFP5B
	default "MIMXRT1042XJM5B" if SOC_PART_NUMBER_MIMXRT1042XJM5B
	default "MIMXRT1052CVJ5B" if SOC_PART_NUMBER_MIMXRT1052CVJ5B
	default "MIMXRT1052CVL5A" if SOC_PART_NUMBER_MIMXRT1052CVL5A
	default "MIMXRT1052CVL5B" if SOC_PART_NUMBER_MIMXRT1052CVL5B
	default "MIMXRT1052DVJ6B" if SOC_PART_NUMBER_MIMXRT1052DVJ6B
	default "MIMXRT1052DVL6A" if SOC_PART_NUMBER_MIMXRT1052DVL6A
	default "MIMXRT1052DVL6B" if SOC_PART_NUMBER_MIMXRT1052DVL6B
	default "MIMXRT1062CVJ5A" if SOC_PART_NUMBER_MIMXRT1062CVJ5A
	default "MIMXRT1062CVJ5B" if SOC_PART_NUMBER_MIMXRT1062CVJ5B
	default "MIMXRT1062CVL5A" if SOC_PART_NUMBER_MIMXRT1062CVL5A
	default "MIMXRT1062DVJ6A" if SOC_PART_NUMBER_MIMXRT1062DVJ6A
	default "MIMXRT1062DVL6A" if SOC_PART_NUMBER_MIMXRT1062DVL6A
	default "MIMXRT1064CVL5A" if SOC_PART_NUMBER_MIMXRT1064CVL5A
	default "MIMXRT1064DVL6A" if SOC_PART_NUMBER_MIMXRT1064DVL6A
```

## soc/nxp/imxrt/imxrt118x/Kconfig
```kconfig
# Copyright 2024 NXP
# SPDX-License-Identifier: Apache-2.0

config SOC_SERIES_IMXRT118X
	select CPU_CORTEX_M_HAS_DWT
	select SOC_RESET_HOOK
	select INIT_ARCH_HW_AT_BOOT if SOC_MIMXRT1189_CM33
	select ARM
	select CLOCK_CONTROL
	select HAS_MCUX_CACHE
	select ARMV8_M_DSP if SOC_MIMXRT1189_CM33
	select CPU_HAS_ARM_SAU if SOC_MIMXRT1189_CM33
	select HAS_MCUX
	select CPU_HAS_ARM_MPU
	select CPU_HAS_CUSTOM_FIXED_SOC_MPU_REGIONS
	select ARM_MPU
	select ARM_TRUSTZONE_M if SOC_MIMXRT1189_CM33
	select CPU_HAS_ICACHE
	select CPU_HAS_DCACHE
	select CPU_HAS_FPU
	select CPU_HAS_FPU_DOUBLE_PRECISION if SOC_MIMXRT1189_CM7
	select HAS_SWO
	select SOC_EARLY_INIT_HOOK

config SOC_MIMXRT1189_CM33
	select CPU_CORTEX_M33
	select HAS_MCUX_XCACHE
	select CACHE_MANAGEMENT

config SOC_MIMXRT1189_CM7
	select CPU_CORTEX_M7

if SOC_SERIES_IMXRT118X

config IMAGE_CONTAINER_OFFSET
	hex "Image container"
	default 0x1000
	help
	  Image container is a boot image format that is used by ROM. Container
	  format consists of container header, image array entry, signature block
	  and user program images and data. The boot ROM expects container data
	  to be saved in external memory.

# Note- This config presents the offset between container header and user
# image. If ROM_START_OFFSET changed, you also need to change CONTAINER_USER_IMAGE_OFFSET
# value. CONTAINER_USER_IMAGE_OFFSET = ROM_START_OFFSET - IMAGE_CONTAINER_OFFSET.
config CONTAINER_USER_IMAGE_OFFSET
	hex "The offset between container header and user image"
	default 0xA000
	help
	  The offset between container and user image. IF change the user image
	  start address, please don't forget to modify CONTAINER_USER_IMAGE_OFFSET
	  value, this will make ROM could get the user image start address.

config MCUX_CORE_SUFFIX
	default "_cm7" if SOC_MIMXRT1189_CM7
	default "_cm33" if SOC_MIMXRT1189_CM33

config TRDC_MCUX_TRDC
	default y
	bool "Use TRDC MCUX Driver"

config S3MU_MCUX_S3MU
	default y
	bool "Use S3MU MCUX Driver"

endif # SOC_SERIES_IMXRT118X
```

## soc/nxp/imxrt/imxrt118x/Kconfig.defconfig
```kconfig
# Copyright 2024-2025 NXP
# SPDX-License-Identifier: Apache-2.0

if SOC_SERIES_IMXRT118X

config CORTEX_M_SYSTICK
	default n if MCUX_LPTMR_TIMER

config NUM_IRQS
	default 239

config GPIO
	default y

if CORTEX_M_SYSTICK

config SYS_CLOCK_HW_CYCLES_PER_SEC
	default 240000000 if SOC_MIMXRT1189_CM33
	default 792000000 if SOC_MIMXRT1189_CM7

endif # CORTEX_M_SYSTICK

config DCDC_VALUE
	default 0x13

config FLEXSPI_CONFIG_BLOCK_OFFSET
	default 0x400 if BOOT_FLEXSPI_NOR

config ROM_START_OFFSET
	default 0xb000 if BOOT_FLEXSPI_NOR

if SECOND_CORE_MCUX

# RT Boot header is only needed on primary core
config NXP_IMXRT_BOOT_HEADER
	default y
	depends on !(CPU_CORTEX_M7 || BOOTLOADER_MCUBOOT)

endif # SECOND_CORE_MCUX

choice CACHE_TYPE
	default EXTERNAL_CACHE if SOC_MIMXRT1189_CM33
endchoice

endif # SOC_SERIES_IMXRT118X
```

## soc/nxp/imxrt/imxrt118x/Kconfig.soc
```kconfig
# Copyright 2024-2025 NXP
# SPDX-License-Identifier: Apache-2.0

config SOC_SERIES_IMXRT118X
	bool
	select SOC_FAMILY_NXP_IMXRT

config SOC_SERIES
	default "imxrt118x" if SOC_SERIES_IMXRT118X

config SOC_MIMXRT1189
	bool
	select SOC_SERIES_IMXRT118X

config SOC_MIMXRT1189_CM33
	bool
	select SOC_MIMXRT1189

config SOC_MIMXRT1189_CM7
	bool
	select SOC_MIMXRT1189

config SOC
	default "mimxrt1189" if SOC_MIMXRT1189

config SOC_PART_NUMBER_MIMXRT1189CVM8B
	bool

config SOC_PART_NUMBER_MIMXRT1189XVM8B
	bool

config SOC_PART_NUMBER_MIMXRT1187AVM8B
	bool

config SOC_PART_NUMBER_MIMXRT1187CVM8B
	bool

config SOC_PART_NUMBER_MIMXRT1187XVM8B
	bool

config SOC_PART_NUMBER_MIMXRT1182CVP2B
	bool

config SOC_PART_NUMBER_MIMXRT1182XVP2B
	bool

config SOC_PART_NUMBER_MIMXRT1181CVP2B
	bool

config SOC_PART_NUMBER_MIMXRT1181XVP2B
	bool

config SOC_PART_NUMBER_MIMXRT1189CVM8C
	bool

config SOC_PART_NUMBER_MIMXRT1189XVM8C
	bool

config SOC_PART_NUMBER_MIMXRT1187AVM8C
	bool

config SOC_PART_NUMBER_MIMXRT1187CVM8C
	bool

config SOC_PART_NUMBER_MIMXRT1187XVM8C
	bool

config SOC_PART_NUMBER_MIMXRT1182CVP2C
	bool

config SOC_PART_NUMBER_MIMXRT1182XVP2C
	bool

config SOC_PART_NUMBER_MIMXRT1181CVP2C
	bool

config SOC_PART_NUMBER_MIMXRT1181XVP2C
	bool

config SOC_PART_NUMBER
	default "MIMXRT1189CVM8B" if SOC_PART_NUMBER_MIMXRT1189CVM8B
	default "MIMXRT1189XVM8B" if SOC_PART_NUMBER_MIMXRT1189XVM8B
	default "MIMXRT1187AVM8B" if SOC_PART_NUMBER_MIMXRT1187AVM8B
	default "MIMXRT1187CVM8B" if SOC_PART_NUMBER_MIMXRT1187CVM8B
	default "MIMXRT1187XVM8B" if SOC_PART_NUMBER_MIMXRT1187XVM8B
	default "MIMXRT1182CVP2B" if SOC_PART_NUMBER_MIMXRT1182CVP2B
	default "MIMXRT1182XVP2B" if SOC_PART_NUMBER_MIMXRT1182XVP2B
	default "MIMXRT1181CVP2B" if SOC_PART_NUMBER_MIMXRT1181CVP2B
	default "MIMXRT1181XVP2B" if SOC_PART_NUMBER_MIMXRT1181XVP2B
	default "MIMXRT1189CVM8C" if SOC_PART_NUMBER_MIMXRT1189CVM8C
	default "MIMXRT1189XVM8C" if SOC_PART_NUMBER_MIMXRT1189XVM8C
	default "MIMXRT1187AVM8C" if SOC_PART_NUMBER_MIMXRT1187AVM8C
	default "MIMXRT1187CVM8C" if SOC_PART_NUMBER_MIMXRT1187CVM8C
	default "MIMXRT1187XVM8C" if SOC_PART_NUMBER_MIMXRT1187XVM8C
	default "MIMXRT1182CVP2C" if SOC_PART_NUMBER_MIMXRT1182CVP2C
	default "MIMXRT1182XVP2C" if SOC_PART_NUMBER_MIMXRT1182XVP2C
	default "MIMXRT1181CVP2C" if SOC_PART_NUMBER_MIMXRT1181CVP2C
	default "MIMXRT1181XVP2C" if SOC_PART_NUMBER_MIMXRT1181XVP2C
```

## soc/nxp/imxrt/imxrt11xx/Kconfig
```kconfig
# Copyright 2024 NXP
# SPDX-License-Identifier: Apache-2.0

config SOC_SERIES_IMXRT11XX
	select CPU_HAS_CUSTOM_FIXED_SOC_MPU_REGIONS
	select CPU_CORTEX_M_HAS_DWT
	select SOC_RESET_HOOK
	select ARM
	select CLOCK_CONTROL
	select HAS_MCUX_CACHE
	select HAS_MCUX
	select CPU_HAS_ARM_MPU
	select CPU_HAS_ICACHE if CPU_CORTEX_M7
	select CPU_HAS_DCACHE if CPU_CORTEX_M7
	select CPU_HAS_FPU
	select CPU_HAS_FPU_DOUBLE_PRECISION if CPU_CORTEX_M7
	select HAS_MCUX_SRC_V2
	select HAS_SWO
	select HAS_PM

config SOC_MIMXRT1176_CM4
	select CPU_CORTEX_M4

config SOC_MIMXRT1176_CM7
	select CPU_CORTEX_M7

config SOC_MIMXRT1166_CM4
	select CPU_CORTEX_M4

config SOC_MIMXRT1166_CM7
	select CPU_CORTEX_M7

if SOC_SERIES_IMXRT11XX

config MCUX_CORE_SUFFIX
	default "_cm7" if SOC_MIMXRT1176_CM7 || SOC_MIMXRT1166_CM7
	default "_cm4" if SOC_MIMXRT1176_CM4 || SOC_MIMXRT1166_CM4

config BYPASS_LDO_LPSR
	default y
	bool "Bypass LDO lpsr"

config ADJUST_LDO
	default y
	bool "Adjust LDO setting"

config INIT_VIDEO_PLL
	default y

config SYS_PLL2_PFD0_DIV
	int "System PLL2 PFD0 divider"
	default 27
	range 13 35

config SYS_PLL2_PFD1_DIV
	int "System PLL2 PFD1 divider"
	default 16
	range 13 35

config SYS_PLL2_PFD2_DIV
	int "System PLL2 PFD2 divider"
	default 24
	range 13 35

config SYS_PLL2_PFD3_DIV
	int "System PLL2 PFD3 divider"
	default 32
	range 13 35

config SYS_PLL3_PFD0_DIV
	int "System PLL3 PFD0 divider"
	default 13
	range 13 35

config SYS_PLL3_PFD1_DIV
	int "System PLL3 PFD1 divider"
	default 17
	range 13 35

config SYS_PLL3_PFD2_DIV
	int "System PLL3 PFD2 divider"
	default 32
	range 13 35

config SYS_PLL3_PFD3_DIV
	int "System PLL3 PFD3 divider"
	default 22
	range 13 35

endif # SOC_SERIES_IMXRT11XX
```

## soc/nxp/imxrt/imxrt11xx/Kconfig.defconfig
```kconfig
# Copyright 2024 NXP
# SPDX-License-Identifier: Apache-2.0

if SOC_SERIES_IMXRT11XX

config NUM_IRQS
	default 218

config GPIO
	default y

if CORTEX_M_SYSTICK

config SYS_CLOCK_HW_CYCLES_PER_SEC
	default 996000000 if SOC_MIMXRT1176_CM7
	default 600000000 if SOC_MIMXRT1166_CM7
	default 400000000 if SOC_MIMXRT1176_CM4
	default 240000000 if SOC_MIMXRT1166_CM4

endif # CORTEX_M_SYSTICK

config DCDC_VALUE
	default 0x13

config FLEXSPI_CONFIG_BLOCK_OFFSET
	default 0x400 if BOOT_FLEXSPI_NOR

if SECOND_CORE_MCUX

# RT Boot header is only needed on primary core
config NXP_IMXRT_BOOT_HEADER
	default y
	depends on !(CPU_CORTEX_M4 || BOOTLOADER_MCUBOOT)

endif
endif
```

## soc/nxp/imxrt/imxrt5xx/Kconfig
```kconfig
# Copyright 2024 NXP
# Copyright (c) 2023 Google LLC.
# SPDX-License-Identifier: Apache-2.0

config SOC_MIMXRT595S_CM33
	select CPU_CORTEX_M33
	select CLOCK_CONTROL
	select CPU_CORTEX_M_HAS_DWT
	select ARM
	select HAS_PM
	select HAS_POWEROFF
	select CPU_HAS_ARM_SAU
	select CPU_HAS_ARM_MPU
	select CPU_HAS_FPU
	select SOC_RESET_HOOK
	select ARMV8_M_DSP
	select ARM_TRUSTZONE_M
	select CPU_CORTEX_M_HAS_SYSTICK
	select HAS_MCUX
	select HAS_MCUX_SYSCON
	select HAS_MCUX_FLEXCOMM
	select HAS_MCUX_FLEXSPI
	select HAS_MCUX_CACHE
	select HAS_MCUX_LPC_DMA
	select HAS_MCUX_LPADC
	select HAS_MCUX_OS_TIMER
	select HAS_MCUX_LPC_RTC
	select HAS_MCUX_TRNG
	select HAS_MCUX_SCTIMER
	select HAS_MCUX_USDHC1
	select HAS_MCUX_USDHC2
	select HAS_MCUX_USB_LPCIP3511
	select HAS_MCUX_CTIMER

config SOC_MIMXRT595S_F1
	select XTENSA
	select XTENSA_HAL if ("$(ZEPHYR_TOOLCHAIN_VARIANT)" != "xcc" && "$(ZEPHYR_TOOLCHAIN_VARIANT)" != "xt-clang")
	select XTENSA_RESET_VECTOR
	select XTENSA_USE_CORE_CRT1

if SOC_SERIES_IMXRT5XX

if NXP_IMXRT_BOOT_HEADER

config IMAGE_VECTOR_TABLE_OFFSET
	default 0x1000

endif # NXP_IMXRT_BOOT_HEADER

config IMXRT5XX_CODE_CACHE
	bool "Code cache"
	default y
	help
	  Enable code cache for FlexSPI region at boot. If this Kconfig is
	  cleared, the CACHE64 controller will be disabled during SOC init

choice FLEXCOMM0_CLK_SRC
	prompt "Clock source for Flexcomm0"
	default FLEXCOMM0_CLK_SRC_FRG

config FLEXCOMM0_CLK_SRC_FRG
	bool "FRG is source of Flexcomm0 clock"

config FLEXCOMM0_CLK_SRC_FRO
	bool "FRO_DIV4 is source of Flexcomm0 clock"

endchoice

choice MIPI_DPHY_CLK_SRC
	prompt "Clock source for MIPI DPHY"
	default MIPI_DPHY_CLK_SRC_AUX1_PLL

config MIPI_DPHY_CLK_SRC_AUX1_PLL
	bool "AUX1_PLL is source of MIPI_DPHY clock"

config MIPI_DPHY_CLK_SRC_FRO
	bool "FRO 192/96M is source of MIPI_DPHY clock"

endchoice

config MCUX_CORE_SUFFIX
	default "_cm33" if SOC_MIMXRT595S_CM33
	default "_dsp" if SOC_MIMXRT595S_F1

endif # SOC_SERIES_IMXRT5XX
```
