## soc/nxp/imxrt/Kconfig
```kconfig
# Copyright 2024-2025 NXP
# SPDX-License-Identifier: Apache-2.0

config SOC_FAMILY_NXP_IMXRT
	select HAS_SEGGER_RTT if ZEPHYR_SEGGER_MODULE

if SOC_FAMILY_NXP_IMXRT

# Source series Kconfig files first, so SOCs
# can override the defaults given here
rsource "*/Kconfig"

if DT_HAS_NXP_IMX_FLEXSPI_ENABLED
rsource "../common/Kconfig.flexspi_xip"
endif

if DT_HAS_NXP_XSPI_ENABLED
rsource "../common/Kconfig.xspi_xip"
endif

# Note- When SECOND_CORE_MCUX is set, the dependencies for this Kconfig
# should be set elsewhere, since the determination of which SOC core
# requires the boot header is SOC specific.
config NXP_IMXRT_BOOT_HEADER
	bool "Boot header"
	default y
	depends on !(BOOTLOADER_MCUBOOT || SECOND_CORE_MCUX)
	help
	  Enable data structures required by the boot ROM to boot the
	  application from an external flash device.

if NXP_IMXRT_BOOT_HEADER

rsource "../common/Kconfig.rom_loader"

choice BOOT_DEVICE
	prompt "Boot device"
	default BOOT_XSPI_NOR if DT_HAS_NXP_XSPI_ENABLED
	default BOOT_FLEXSPI_NOR

config BOOT_XSPI_NOR
	bool "XPI serial NOR"
	depends on DT_HAS_NXP_XSPI_ENABLED

FLEXSPI_COMPAT := nxp,imx-flexspi

config BOOT_FLEXSPI_NOR
	bool "FlexSPI serial NOR"
	depends on $(dt_has_compat,$(FLEXSPI_COMPAT))

config BOOT_FLEXSPI_NAND
	bool "FlexSPI serial NAND"
	depends on $(dt_has_compat,$(FLEXSPI_COMPAT))

SEMC_COMPAT := nxp,imx-semc

config BOOT_SEMC_NOR
	bool "SEMC parallel NOR"
	depends on $(dt_has_compat, $(SEMC_COMPAT))

config BOOT_SEMC_NAND
	bool "SEMC parallel NAND"
	depends on $(dt_has_compat, $(SEMC_COMPAT))

endchoice # BOOT_DEVICE

if BOOT_FLEXSPI_NOR

config FLEXSPI_CONFIG_BLOCK_OFFSET
	hex "FlexSPI config block offset"
	default 0x0 if BOOT_FLEXSPI_NOR
	default 0x400
	help
	  FlexSPI configuration block consists of parameters regarding specific
	  flash devices including read command sequence, quad mode enablement
	  sequence (optional), etc. The boot ROM expects FlexSPI configuration
	  parameter to be presented in serial nor flash.

endif # BOOT_FLEXSPI_NOR

if BOOT_XSPI_NOR

config XSPI_CONFIG_BLOCK_OFFSET
	hex "XSPI config block offset"
	default 0x0
	help
	  XSPI configuration block consists of parameters regarding specific
	  flash devices including read command sequence, quad mode enablement
	  sequence (optional), etc. The boot ROM expects XSPI configuration
	  parameter to be presented in serial nor flash.

endif # BOOT_XSPI_NOR

config IMAGE_VECTOR_TABLE_OFFSET
	hex "Image vector table offset"
	default 0x1000 if BOOT_FLEXSPI_NOR || BOOT_SEMC_NOR
	default 0x400 if BOOT_FLEXSPI_NAND || BOOT_SEMC_NAND
	help
	  The Image Vector Table (IVT) provides the boot ROM with pointers to
	  the application entry point and device configuration data. The boot
	  ROM requires a fixed IVT offset for each type of boot device.

config DEVICE_CONFIGURATION_DATA
	bool "Device configuration data"
	help
	  Device configuration data (DCD) provides a sequence of commands to
	  the boot ROM to initialize components such as an SDRAM. This is
	  useful if your application expects components like SDRAM to be
	  initialized at boot time.

config EXTERNAL_MEM_CONFIG_DATA
	bool "External Memory Configuration Data"
	depends on !DEVICE_CONFIGURATION_DATA
	help
	  External memory configuration data (XMDC) provides an alternative
	  configuration sequences which allows to intilialize the external memory
	  at the boot time. This sequence allows to configure
	  external memories (such as SDRAM) with more advanced option.
	  This is a new alternative boot header compared to DCD, and DCD must be disabled
	  in order to select this option.

config EXTERNAL_MEM_CONFIG_OFFSET
	hex "External memory configuration offset"
	depends on EXTERNAL_MEM_CONFIG_DATA
	default 0x800 if SOC_SERIES_IMXRT118X
	default 0x1040 if BOOT_FLEXSPI_NOR || BOOT_SEMC_NOR
	help
	  As specified by the boot ROM, the External Memory configuration data must be
	  placed in a specific address location to be pointed by the boot ROM.

endif # NXP_IMXRT_BOOT_HEADER

config NXP_IMX_EXTERNAL_SDRAM
	bool "Allow access to external SDRAM region"
	help
	  Enable access to external SDRAM region managed by the SEMC. This
	  setting should be enabled when the application uses SDRAM, or
	  an MPU region will be defined to disable cached access to the
	  SDRAM memory space.

config NXP_IMX_EXTERNAL_HYPERRAM
	bool "Allow access to external HYPERRAM region"
	help
	  Enable access to external HYPERRAM region managed by the FLEXSPI.
	  This setting should be enabled when the application uses HYPERRAM,
	  or an MPU region will be defined to disable cached access to the
	  HYPERRAM memory space.

config SECOND_CORE_MCUX
	bool "Dual core operation on the RT11xx series"
	depends on SOC_SERIES_IMXRT11XX || SOC_SERIES_IMXRT118X
	help
	  Indicates the second core will be enabled, and the part will run
	  in dual core mode. Enables dual core operation on the RT11xx series,
	  by booting an image targeting the Cortex-M4 from the Cortex-M7 CPU.
	  The M4 image will be loaded from flash into RAM based off a
	  generated header specifying the VMA and LMA of each memory section
	  to load

config SECOND_CORE_MCUX_REMOTE_DIR
	string "Directory to with output image header from second core"
	depends on SECOND_CORE_MCUX
	help
	  Sets the remote directory to include the output image header data
	  from when launching a second core image

if SOC_SERIES_IMXRT10XX || SOC_SERIES_IMXRT11XX || SOC_SERIES_IMXRT118X

config PM_MCUX_GPC
	bool "MCUX general power controller driver"

config PM_MCUX_DCDC
	bool "MCUX dcdc converter module driver"

config PM_MCUX_PMU
	bool "MCUX power management unit driver"

config ADJUST_DCDC
	default y
	bool "Adjust internal DCDC output"

config DCDC_VALUE
	hex "DCDC value for VDD_SOC"

config INIT_ARM_PLL
	default y
	depends on !SOC_MIMXRT1011 && !SOC_MIMXRT1015 && \
		   !SOC_MIMXRT1021 && !SOC_MIMXRT1024
	bool "Initialize ARM PLL"

config INIT_VIDEO_PLL
	bool "Initialize Video PLL"

config INIT_SYS_PLL
	bool "Initialize System PLL"

endif # SOC_SERIES_IMXRT10XX || SOC_SERIES_IMXRT11XX || SOC_SERIES_IMXRT118X

endif # SOC_FAMILY_NXP_IMXRT
```

## soc/nxp/imxrt/Kconfig.defconfig
```kconfig
# Copyright 2017-2024 NXP
# SPDX-License-Identifier: Apache-2.0

if SOC_FAMILY_NXP_IMXRT

# Source series Kconfig files first, so SOCs
# can override the defaults given here
rsource "*/Kconfig.defconfig"

if SOC_SERIES_IMXRT10XX || SOC_SERIES_IMXRT11XX || SOC_SERIES_IMXRT118X

config ROM_START_OFFSET
	default 0x400 if BOOTLOADER_MCUBOOT
	default 0x2000 if BOOT_FLEXSPI_NOR || BOOT_SEMC_NOR

config PINCTRL_IMX
	default y if HAS_MCUX_IOMUXC
	depends on PINCTRL

config ADC_MCUX_12B1MSPS_SAR
	default y if HAS_MCUX_12B1MSPS_SAR
	depends on ADC

config LOG_BACKEND_SWO_FREQ_HZ
	default 7500000
	depends on LOG_BACKEND_SWO

# set the tick per sec as a divider of the GPT clock source
config SYS_CLOCK_TICKS_PER_SEC
	default 4096 if MCUX_GPT_TIMER

DT_SYSCLK_PATH := $(dt_nodelabel_path,sysclk)

config SYS_CLOCK_HW_CYCLES_PER_SEC
	default $(dt_node_int_prop_int,$(DT_SYSCLK_PATH),clock-frequency) if SOC_SERIES_IMXRT10XX && CORTEX_M_SYSTICK
	default 32768 if MCUX_GPT_TIMER

# Disable systick if using MCUX_GPT_TIMER, as they will conflict
config CORTEX_M_SYSTICK
	default n if MCUX_GPT_TIMER

config PM_MCUX_GPC
	default y if HAS_MCUX_GPC
	depends on SOC_SERIES_IMXRT11XX && PM

# Don't allow SOC to sleep after tests complete when PM is enabled
config ZTEST_NO_YIELD
	default y if (ZTEST && PM)

if SOC_SERIES_IMXRT10XX && PM

config CODE_DATA_RELOCATION
	default y

config PM_MCUX_GPC
	default y if HAS_MCUX_GPC

config PM_MCUX_DCDC
	default y if HAS_MCUX_DCDC

config PM_MCUX_PMU
	default y if HAS_MCUX_PMU

endif # SOC_SERIES_IMXRT10XX && PM

if ETH_NXP_ENET || ETH_NXP_IMX_NETC

config SYSTEM_WORKQUEUE_STACK_SIZE
	default 1560

endif # ETH_NXP_ENET

config MEMC
	default y if !SOC_SERIES_IMXRT118X # RT118X lacks FLEXRAM

DT_CHOSEN_Z_DTCM := zephyr,dtcm

choice SEGGER_RTT_SECTION
	default SEGGER_RTT_SECTION_DTCM if $(dt_chosen_enabled,$(DT_CHOSEN_Z_DTCM))
	depends on USE_SEGGER_RTT
endchoice

choice SEGGER_SYSVIEW_SECTION
	default SEGGER_SYSVIEW_SECTION_DTCM if $(dt_chosen_enabled,$(DT_CHOSEN_Z_DTCM))
	depends on SEGGER_SYSTEMVIEW
endchoice

config MBEDTLS
	default y if CSPRNG_ENABLED
	depends on ENTROPY_GENERATOR

if MBEDTLS
#
# MBEDTLS CTR_DRBG code path needs extra stack space for initialization than
# what the ztest_thread_stack defaults to.
#
config TEST_EXTRA_STACK_SIZE
	default 1024
endif # MBEDTLS

if CPU_CORTEX_M7
# defaults specific for the M7 core

# Enable cache management features when using M7 core, since these parts
# have L1 instruction and data caches that should be enabled at boot
config CACHE_MANAGEMENT
	default y

config FLASH_MCUX_FLEXSPI_XIP_MEM
	default "ITCM"

endif # CPU_CORTEX_M7

endif # SOC_SERIES_IMXRT10XX || SOC_SERIES_IMXRT11XX || SOC_SERIES_IMXRT118X

endif # SOC_FAMILY_NXP_IMXRT
```

## soc/nxp/imxrt/Kconfig.soc
```kconfig
# Copyright 2024 NXP
# SPDX-License-Identifier: Apache-2.0

config SOC_FAMILY_NXP_IMXRT
	bool

config SOC_FAMILY
	default "nxp_imxrt" if SOC_FAMILY_NXP_IMXRT

rsource "*/Kconfig.soc"
```

## soc/nxp/imxrt/imxrt10xx/Kconfig
```kconfig
# Copyright 2024 NXP
# SPDX-License-Identifier: Apache-2.0

config SOC_SERIES_IMXRT10XX
	select CPU_CORTEX_M7
	select CPU_CORTEX_M_HAS_DWT
	select CPU_HAS_ICACHE
	select CPU_HAS_DCACHE
	select CPU_HAS_CUSTOM_FIXED_SOC_MPU_REGIONS
	select ARM
	select CLOCK_CONTROL
	select HAS_MCUX
	select HAS_MCUX_CACHE
	select HAS_SWO
	select HAS_PM
	select SOC_RESET_HOOK
	select SOC_EARLY_INIT_HOOK

config SOC_MIMXRT1011
	select CPU_HAS_FPU
	select CPU_HAS_ARM_MPU
	select CPU_HAS_ICACHE
	select CPU_HAS_DCACHE

config SOC_MIMXRT1015
	select CPU_HAS_FPU
	select CPU_HAS_FPU_DOUBLE_PRECISION
	select CPU_HAS_ARM_MPU

config SOC_MIMXRT1021
	select CPU_HAS_FPU_DOUBLE_PRECISION
	select CPU_HAS_ARM_MPU

config SOC_MIMXRT1024
	select CPU_HAS_FPU_DOUBLE_PRECISION
	select CPU_HAS_ARM_MPU
	select HAS_MCUX_SRC

config SOC_MIMXRT1042
	select CPU_HAS_FPU_DOUBLE_PRECISION
	select CPU_HAS_ARM_MPU

config SOC_MIMXRT1052
	select CPU_HAS_FPU_DOUBLE_PRECISION
	select CPU_HAS_ARM_MPU
	select HAS_MCUX_SRC

config SOC_MIMXRT1062
	select CPU_HAS_FPU_DOUBLE_PRECISION
	select CPU_HAS_ARM_MPU
	select HAS_MCUX_SRC

config SOC_MIMXRT1064
	select HAS_MCUX_SRC
	select CPU_HAS_FPU_DOUBLE_PRECISION
	select CPU_HAS_ARM_MPU
	select HAS_SWO

if SOC_SERIES_IMXRT10XX

config INIT_ENET_PLL
	bool "Initialize ENET PLL"
	default y if ETH_NXP_ENET
	help
	  When enabled, will call the SDK function to initialize the enet pll.
	  The exact meaning of what the "enet pll" is in the hardware according
	  to the SDK changes per platform, and so does the API signature.
	  This configuration also assumes a certain default clocking scheme for each SOC.
	  See soc.c code and HAL fsl_clock.c for the platform for better understanding.

config INIT_PLL6_500M
	bool "PLL6 500M output enable"
	default y
	depends on SOC_MIMXRT1011 || SOC_MIMXRT1015 || \
		   SOC_MIMXRT1021 || SOC_MIMXRT1024
	select INIT_ENET_PLL

config INIT_SYS_PLL
	bool "Initialize System PLL"
	default y if SOC_MIMXRT1042

config INIT_VIDEO_PLL
	default y if DISPLAY_MCUX_ELCDIF
	depends on !SOC_MIMXRT1011 && !SOC_MIMXRT1015 && \
		   !SOC_MIMXRT1021 && !SOC_MIMXRT1024

if PM

config DCDC_TARGET_LOW_POWER_VOLTAGE
	int "Target DCDC voltage in mV for low power mode"
	default 1075
	range 800 1575
	help
	  When entering suspend-to-idle drops to this target SOC voltage.
	  If you are experiencing issues with low power mode stability,
	  try raising this voltage value. Increment or decrement in steps of 25 mV.

config DCDC_TARGET_NORMAL_VOLTAGE
	int "Target DCDC voltage in mV for normal mode"
	default 1275
	range 800 1575
	help
	  When exiting suspend-to-idle raises to this SOC voltage.
	  Increment or decrement in steps of 25 mV.

endif # PM

endif # SOC_SERIES_IMXRT10XX
```

## soc/nxp/imxrt/imxrt10xx/Kconfig.defconfig
```kconfig
# Copyright 2024 NXP
# SPDX-License-Identifier: Apache-2.0


if SOC_SERIES_IMXRT10XX

rsource "../../common/Kconfig.defconfig.nvic"

config DCDC_VALUE
	default 0x12 if SOC_MIMXRT1011 ||	\
			SOC_MIMXRT1015 ||	\
			SOC_MIMXRT1021 ||	\
			SOC_MIMXRT1024
	default 0x13

config GPIO
	default y

config FLEXSPI_CONFIG_BLOCK_OFFSET
	default 0x400 if SOC_MIMXRT1011

endif # SOC_SERIES_IMXRT10XX
```
