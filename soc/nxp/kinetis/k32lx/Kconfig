## soc/nxp/kinetis/ke1xz/Kconfig.soc
```kconfig
# Kinetis KE1xZ MCU line

# Copyright (c) 2019 Vestas Wind Systems A/S
# Copyright 2024 NXP
# SPDX-License-Identifier: Apache-2.0

config SOC_SERIES_KE1XZ
	bool
	select SOC_FAMILY_KINETIS

config SOC_SERIES
	default "ke1xz" if SOC_SERIES_KE1XZ

config SOC_MKE15Z4
	bool
	select SOC_SERIES_KE1XZ

config SOC_MKE16Z4
	bool
	select SOC_SERIES_KE1XZ

config SOC_MKE15Z7
	bool
	select SOC_SERIES_KE1XZ

config SOC_MKE17Z7
	bool
	select SOC_SERIES_KE1XZ

config SOC_MKE17Z9
	bool
	select SOC_SERIES_KE1XZ

config SOC
	default "mke15z4" if SOC_MKE15Z4
	default "mke16z4" if SOC_MKE16Z4
	default "mke15z7" if SOC_MKE15Z7
	default "mke17z7" if SOC_MKE17Z7
	default "mke17z9" if SOC_MKE17Z9

config SOC_PART_NUMBER_MKE15Z64VFP4
	bool

config SOC_PART_NUMBER_MKE15Z64VLD4
	bool

config SOC_PART_NUMBER_MKE15Z64VLF4
	bool

config SOC_PART_NUMBER_MKE16Z64VFP4
	bool

config SOC_PART_NUMBER_MKE16Z64VLD4
	bool

config SOC_PART_NUMBER_MKE16Z64VLF4
	bool

config SOC_PART_NUMBER_MKE15Z128VLL7
	bool

config SOC_PART_NUMBER_MKE15Z128VLH7
	bool

config SOC_PART_NUMBER_MKE15Z256VLL7
	bool

config SOC_PART_NUMBER_MKE15Z256VLH7
	bool

config SOC_PART_NUMBER_MKE17Z128VLF7
	bool

config SOC_PART_NUMBER_MKE17Z128VLH7
	bool

config SOC_PART_NUMBER_MKE17Z128VLL7
	bool

config SOC_PART_NUMBER_MKE17Z256VLF7
	bool

config SOC_PART_NUMBER_MKE17Z256VLH7
	bool

config SOC_PART_NUMBER_MKE17Z256VLL7
	bool

config SOC_PART_NUMBER_MKE17Z512VLH9
	bool

config SOC_PART_NUMBER_MKE17Z512VLL9
	bool

config SOC_PART_NUMBER
	default "MKE15Z64VFP4" if SOC_PART_NUMBER_MKE15Z64VFP4
	default "MKE15Z64VLD4" if SOC_PART_NUMBER_MKE15Z64VLD4
	default "MKE15Z64VLF4" if SOC_PART_NUMBER_MKE15Z64VLF4
	default "MKE16Z64VFP4" if SOC_PART_NUMBER_MKE16Z64VFP4
	default "MKE16Z64VLD4" if SOC_PART_NUMBER_MKE16Z64VLD4
	default "MKE16Z64VLF4" if SOC_PART_NUMBER_MKE16Z64VLF4
	default "MKE15Z128VLL7" if SOC_PART_NUMBER_MKE15Z128VLL7
	default "MKE15Z128VLH7" if SOC_PART_NUMBER_MKE15Z128VLH7
	default "MKE15Z256VLL7" if SOC_PART_NUMBER_MKE15Z256VLL7
	default "MKE15Z256VLH7" if SOC_PART_NUMBER_MKE15Z256VLH7
	default "MKE17Z128VLF7" if SOC_PART_NUMBER_MKE17Z128VLF7
	default "MKE17Z128VLH7" if SOC_PART_NUMBER_MKE17Z128VLH7
	default "MKE17Z128VLL7" if SOC_PART_NUMBER_MKE17Z128VLL7
	default "MKE17Z256VLF7" if SOC_PART_NUMBER_MKE17Z256VLF7
	default "MKE17Z256VLH7" if SOC_PART_NUMBER_MKE17Z256VLH7
	default "MKE17Z256VLL7" if SOC_PART_NUMBER_MKE17Z256VLL7
	default "MKE17Z512VLH9" if SOC_PART_NUMBER_MKE17Z512VLH9
	default "MKE17Z512VLL9" if SOC_PART_NUMBER_MKE17Z512VLL9
```

## soc/nxp/kinetis/kl2x/Kconfig
```kconfig
# Kinetis KL2x MCU series

# Copyright (c) 2017, 2024 NXP
# SPDX-License-Identifier: Apache-2.0

config SOC_SERIES_KINETIS_KL2X
	select ARM
	select CPU_CORTEX_M0PLUS
	select CPU_CORTEX_M_HAS_SYSTICK
	select CPU_CORTEX_M_HAS_VTOR
	select CLOCK_CONTROL
	select PLATFORM_SPECIFIC_INIT

config SOC_MKL25Z4
	select CPU_CORTEX_M0PLUS
	select HAS_MCUX
	select HAS_MCUX_ADC16
	select HAS_MCUX_FTFX
	select HAS_MCUX_LPSCI
	select HAS_MCUX_SIM
	select HAS_OSC
	select HAS_MCG
	select HAS_MCUX_RCM
```

## soc/nxp/kinetis/kl2x/Kconfig.defconfig
```kconfig
# Kinetis KL2x series configuration options

# Copyright 2017, 2024 NXP
# SPDX-License-Identifier: Apache-2.0

if SOC_SERIES_KINETIS_KL2X

config NUM_IRQS
	default 32 if SOC_MKL25Z4

# The flash option register (FOPT) boot options
# 0011 1011 - Boot from Internal Flash.
#             Set NMI pin/interrupts to disabled.
config KINETIS_FLASH_CONFIG_FOPT
	default 0x3B
	depends on KINETIS_FLASH_CONFIG

endif # SOC_SERIES_KINETIS_KL2X
```

## soc/nxp/kinetis/kl2x/Kconfig.soc
```kconfig
# Kinetis KL2x MCU series

# Copyright 2017,2024 NXP
# SPDX-License-Identifier: Apache-2.0

config SOC_SERIES_KINETIS_KL2X
	bool
	select SOC_FAMILY_KINETIS

config SOC_SERIES
	default "kl2x" if SOC_SERIES_KINETIS_KL2X

config SOC_MKL25Z4
	bool
	select SOC_SERIES_KINETIS_KL2X

config SOC
	default "mkl25z4" if SOC_MKL25Z4

config SOC_PART_NUMBER_MKL25Z32VFM4
	bool

config SOC_PART_NUMBER_MKL25Z64VFM4
	bool

config SOC_PART_NUMBER_MKL25Z128VFM4
	bool

config SOC_PART_NUMBER_MKL25Z32VFT4
	bool

config SOC_PART_NUMBER_MKL25Z64VFT4
	bool

config SOC_PART_NUMBER_MKL25Z128VFT4
	bool

config SOC_PART_NUMBER_MKL25Z32VLH4
	bool

config SOC_PART_NUMBER_MKL25Z64VLH4
	bool

config SOC_PART_NUMBER_MKL25Z128VLH4
	bool

config SOC_PART_NUMBER_MKL25Z32VLK4
	bool

config SOC_PART_NUMBER_MKL25Z64VLK4
	bool

config SOC_PART_NUMBER_MKL25Z128VLK4
	bool

config SOC_PART_NUMBER
	default "MKL25Z32VFM4" if SOC_PART_NUMBER_MKL25Z32VFM4
	default "MKL25Z64VFM4" if SOC_PART_NUMBER_MKL25Z64VFM4
	default "MKL25Z128VFM4" if SOC_PART_NUMBER_MKL25Z128VFM4
	default "MKL25Z32VFT4" if SOC_PART_NUMBER_MKL25Z32VFT4
	default "MKL25Z64VFT4" if SOC_PART_NUMBER_MKL25Z64VFT4
	default "MKL25Z128VFT4" if SOC_PART_NUMBER_MKL25Z128VFT4
	default "MKL25Z32VLH4" if SOC_PART_NUMBER_MKL25Z32VLH4
	default "MKL25Z64VLH4" if SOC_PART_NUMBER_MKL25Z64VLH4
	default "MKL25Z128VLH4" if SOC_PART_NUMBER_MKL25Z128VLH4
	default "MKL25Z32VLK4" if SOC_PART_NUMBER_MKL25Z32VLK4
	default "MKL25Z64VLK4" if SOC_PART_NUMBER_MKL25Z64VLK4
	default "MKL25Z128VLK4" if SOC_PART_NUMBER_MKL25Z128VLK4
```

## soc/nxp/kinetis/kv5x/Kconfig
```kconfig
# Kinetis KV5x series MCU

# Copyright (c) 2019 SEAL AG
# Copyright 2024 NXP
# SPDX-License-Identifier: Apache-2.0

config SOC_SERIES_KINETIS_KV5X
	select ARM
	select CPU_CORTEX_M7
	select CPU_CORTEX_M_HAS_DWT
	select CPU_HAS_ARM_MPU
	select CPU_HAS_FPU
	select CPU_HAS_ICACHE
	select CPU_HAS_DCACHE
	select CLOCK_CONTROL
	select HAS_MCUX
	select HAS_MCUX_ADC16
	select HAS_MCUX_FTFX
	select HAS_MCUX_FTM
	select HAS_MCUX_SIM
	select HAS_OSC
	select HAS_MCG
	select HAS_MCUX_RCM
	select SOC_RESET_HOOK
	select SOC_EARLY_INIT_HOOK
```

## soc/nxp/kinetis/kv5x/Kconfig.defconfig
```kconfig
# Kinetis KV5x series configuration options

# Copyright (c) 2019 SEAL AG
# Copyright 2024 NXP
# SPDX-License-Identifier: Apache-2.0

if SOC_SERIES_KINETIS_KV5X

config NUM_IRQS
	# must be >= the highest interrupt number used
	default 121

config GPIO
	default y

# The flash option register (FOPT) boot options
# 1111 1011 - Set NMI pin/interrupts to disabled.
config KINETIS_FLASH_CONFIG_FOPT
	default 0xFB
	depends on KINETIS_FLASH_CONFIG

endif # SOC_SERIES_KINETIS_KV5X
```

## soc/nxp/kinetis/kv5x/Kconfig.soc
```kconfig
# Kinetis KV5x series MCU

# Copyright (c) 2019 SEAL AG
# Copyright 2024 NXP
# SPDX-License-Identifier: Apache-2.0

config SOC_SERIES_KINETIS_KV5X
	bool
	select SOC_FAMILY_KINETIS

config SOC_SERIES
	default "kv5x" if SOC_SERIES_KINETIS_KV5X

config SOC_MKV56F24
	bool
	select SOC_SERIES_KINETIS_KV5X

config SOC_MKV58F24
	bool
	select SOC_SERIES_KINETIS_KV5X

config SOC
	default "mkv56f24" if SOC_MKV56F24
	default "mkv58f24" if SOC_MKV58F24

config SOC_PART_NUMBER_MKV56F512VLL24
	bool

config SOC_PART_NUMBER_MKV56F512VLQ24
	bool

config SOC_PART_NUMBER_MKV56F1M0VLL24
	bool

config SOC_PART_NUMBER_MKV56F1M0VLQ24
	bool

config SOC_PART_NUMBER_MKV58F512VLL24
	bool

config SOC_PART_NUMBER_MKV58F512VLQ24
	bool

config SOC_PART_NUMBER_MKV58F1M0VLL24
	bool

config SOC_PART_NUMBER_MKV58F1M0VLQ24
	bool

config SOC_PART_NUMBER
	default "MKV56F512VLL24" if SOC_PART_NUMBER_MKV56F512VLL24
	default "MKV56F512VLQ24" if SOC_PART_NUMBER_MKV56F512VLQ24
	default "MKV56F1M0VLL24" if SOC_PART_NUMBER_MKV56F1M0VLL24
	default "MKV56F1M0VLQ24" if SOC_PART_NUMBER_MKV56F1M0VLQ24
	default "MKV58F512VLL24" if SOC_PART_NUMBER_MKV58F512VLL24
	default "MKV58F512VLQ24" if SOC_PART_NUMBER_MKV58F512VLQ24
	default "MKV58F1M0VLL24" if SOC_PART_NUMBER_MKV58F1M0VLL24
	default "MKV58F1M0VLQ24" if SOC_PART_NUMBER_MKV58F1M0VLQ24
```

## soc/nxp/kinetis/kw45/Kconfig
```kconfig
# KW45 Series

# Copyright 2025 NXP
# SPDX-License-Identifier: Apache-2.0

config SOC_SERIES_KINETIS_KW45
	select ARM
	select CPU_CORTEX_M33
	select CPU_CORTEX_M_HAS_DWT
	select HAS_MCUX
	select CLOCK_CONTROL
	select SOC_RESET_HOOK
	select SOC_EARLY_INIT_HOOK

config SOC_KW45B41Z83
	select ARM_TRUSTZONE_M
	select CPU_CORTEX_M_HAS_SYSTICK
	select CPU_HAS_FPU
	select CPU_HAS_ARM_SAU
	select CPU_HAS_ARM_MPU
	select ARMV8_M_DSP

	rsource "../../common/Kconfig.nbu"
```

## soc/nxp/kinetis/kw45/Kconfig.defconfig
```kconfig
# KW45 series configuration options

# Copyright 2025 NXP
# SPDX-License-Identifier: Apache-2.0

if SOC_SERIES_KINETIS_KW45

config SYS_CLOCK_HW_CYCLES_PER_SEC
	default 96000000 if CORTEX_M_SYSTICK

config MCUX_FLASH_K4_API
	default y

config WDOG_INIT
	default n

config SOC_SERIES
	default "kw45"

config NUM_IRQS
	default 74

if BT

# Include intercore messaging component
config NXP_RF_IMU
	default y

#  Set the controller's public identity using NXP vendor command
config BT_HCI_SET_PUBLIC_ADDR
	default y

# HCI RX buffers are received in ISR context. RX messages
# need to be queued and processed by a dedicated thread
config HCI_NXP_RX_THREAD
	default y

endif # BT

config PM
	select COUNTER

config FLASH
	default y if BT

config BT_BUF_EVT_DISCARDABLE_SIZE
	default 84 if BT

choice LIBC_IMPLEMENTATION
	default NEWLIB_LIBC if PM
endchoice

endif # SOC_SERIES_KINETIS_KW45
```

## soc/nxp/kinetis/kw45/Kconfig.soc
```kconfig
# KW45 Series

# Copyright 2025 NXP
# SPDX-License-Identifier: Apache-2.0

config SOC_SERIES_KINETIS_KW45
	bool
	select SOC_FAMILY_KINETIS

config SOC_SERIES
	default "kw45" if SOC_SERIES_KINETIS_KW45

config SOC_KW45B41Z83
	bool
	select SOC_SERIES_KINETIS_KW45

config SOC
	default "kw45b41z83" if SOC_KW45B41Z83

config SOC_PART_NUMBER_KW45B41Z83AFTA
	bool

config SOC_PART_NUMBER
	default "KW45B41Z83AFTA" if SOC_PART_NUMBER_KW45B41Z83AFTA
```

## soc/nxp/kinetis/kwx/Kconfig
```kconfig
# Kinetis KWx MCU series

# Copyright (c) 2017, 2024 NXP
# SPDX-License-Identifier: Apache-2.0

config SOC_SERIES_KWX
	select ARM
	select CPU_CORTEX_M_HAS_SYSTICK
	select CPU_CORTEX_M_HAS_VTOR
	select CLOCK_CONTROL
	select SOC_RESET_HOOK
	select SOC_EARLY_INIT_HOOK

config SOC_MKW22D5
	select CPU_CORTEX_M4
	select CPU_CORTEX_M_HAS_DWT
	select HAS_MCUX
	select HAS_OSC
	select HAS_MCG

config SOC_MKW24D5
	select CPU_CORTEX_M4
	select CPU_CORTEX_M_HAS_DWT
	select HAS_MCUX
	select HAS_OSC
	select HAS_MCG

config SOC_MKW40Z4
	select CPU_CORTEX_M0PLUS
	select HAS_MCUX
	select HAS_OSC
	select HAS_MCG

config SOC_MKW41Z4
	select CPU_CORTEX_M0PLUS
	select HAS_MCUX
	select HAS_OSC
	select HAS_MCG
```
