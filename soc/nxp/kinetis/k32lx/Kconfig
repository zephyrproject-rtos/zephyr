## soc/nxp/kinetis/k32lx/Kconfig
```kconfig
# Copyright (c) 2025 Ishraq Ibne Ashraf <ishraq.i.ashraf@gmail.com>
#
# SPDX-License-Identifier: Apache-2.0

# Kinetis K32Lx MCU series

config SOC_SERIES_K32LX
	select ARM
	select CPU_CORTEX_M0PLUS
	select CPU_CORTEX_M_HAS_VTOR
	select CPU_CORTEX_M_HAS_SYSTICK
	select HAS_MCUX
	select HAS_MCUX_ADC16
	select HAS_MCUX_SIM
	select HAS_MCUX_RCM
	select HAS_MCUX_FTFX
	select HAS_MCUX_LPUART
	select HAS_MCUX_LPI2C
	select HAS_MCUX_TPM
	select CLOCK_CONTROL
	select SOC_RESET_HOOK
	select SOC_EARLY_INIT_HOOK
```

## soc/nxp/kinetis/k32lx/Kconfig.defconfig
```kconfig
# Copyright (c) 2025 Ishraq Ibne Ashraf <ishraq.i.ashraf@gmail.com>
#
# SPDX-License-Identifier: Apache-2.0

if SOC_SERIES_K32LX

config NUM_IRQS
	default 32

config SYS_CLOCK_HW_CYCLES_PER_SEC
	default $(dt_node_int_prop_int,/cpus/cpu@0,clock-frequency) if CORTEX_M_SYSTICK

endif # SOC_SERIES_K32LX
```

## soc/nxp/kinetis/k32lx/Kconfig.soc
```kconfig
# Copyright (c) 2025 Ishraq Ibne Ashraf <ishraq.i.ashraf@gmail.com>
#
# SPDX-License-Identifier: Apache-2.0

config SOC_SERIES_K32LX
	bool
	select SOC_FAMILY_KINETIS

config SOC_SERIES
	default "k32lx" if SOC_SERIES_K32LX

config SOC_K32L2B31A
	bool
	select SOC_SERIES_K32LX

config SOC
	default "k32l2b31a" if SOC_K32L2B31A

config SOC_PART_NUMBER_K32L2B31VLH0A
	bool

config SOC_PART_NUMBER
	default "K32L2B31VLH0A" if SOC_PART_NUMBER_K32L2B31VLH0A
```

## soc/nxp/kinetis/k6x/Kconfig
```kconfig
# Kinetis K6x series configuration

# Copyright 2024 NXP
# SPDX-License-Identifier: Apache-2.0

config SOC_SERIES_KINETIS_K6X
	select ARM
	select CPU_CORTEX_M4
	select CPU_CORTEX_M_HAS_DWT
	select CPU_HAS_NXP_MPU
	select HAS_MCUX_PIT
	select CLOCK_CONTROL
	select PLATFORM_SPECIFIC_INIT

config SOC_MK64F12
	select HAS_MCUX
	select HAS_MCUX_ADC16
	select HAS_MCUX_ENET
	select HAS_MCUX_FLEXCAN
	select HAS_MCUX_FTFX
	select HAS_MCUX_FTM
	select HAS_MCUX_RNGA
	select HAS_MCUX_SIM
	select HAS_OSC
	select HAS_MCG
	select CPU_HAS_FPU
	select HAS_MCUX_RTC
	select HAS_MCUX_DAC
	select HAS_MCUX_EDMA
	select HAS_MCUX_RCM

config SOC_MK66F18
	select HAS_MCUX
	select HAS_MCUX_ADC16
	select HAS_MCUX_ENET
	select HAS_MCUX_FLEXCAN
	select HAS_MCUX_FTFX
	select HAS_MCUX_FTM
	select HAS_MCUX_RNGA
	select HAS_MCUX_SIM
	select HAS_OSC
	select HAS_MCG
	select CPU_HAS_FPU
	select HAS_MCUX_RTC
	select HAS_MCUX_DAC
	select HAS_MCUX_EDMA
	select HAS_MCUX_RCM
	select HAS_MCUX_LPUART


if SOC_MK66F18

config K6X_HSRUN
	bool "High Speed RUN mode"
	default y
	help
	  This options enables support for High Speed RUN mode on K66F SoC.

endif # SOC_MK66F18
```

## soc/nxp/kinetis/k6x/Kconfig.defconfig
```kconfig
# Kinetis K6x series default configurations

# Copyright (c) 2014-2016 Wind River Systems, Inc.
# Copyright 2024 NXP
# SPDX-License-Identifier: Apache-2.0

if SOC_SERIES_KINETIS_K6X

config CPU_HAS_CUSTOM_FIXED_SOC_MPU_REGIONS
	default y

config NUM_IRQS
	default 100 if SOC_MK66F18
	default 86 if SOC_MK64F12

config GPIO
	default y

config SPI
	default n if SOC_MK64F12

# The flash option register (FOPT) boot options
# 1111 1001 - Set NMI pin/interrupts and EzPort reset default to disabled
config KINETIS_FLASH_CONFIG_FOPT
	default 0xF9
	depends on KINETIS_FLASH_CONFIG

endif # SOC_SERIES_KINETIS_K6X
```

## soc/nxp/kinetis/k6x/Kconfig.soc
```kconfig
# Kinetis K6X MCU line

# Copyright (c) 2016 Open-RnD Sp. z o.o.
# Copyright 2024 NXP
# SPDX-License-Identifier: Apache-2.0

config SOC_SERIES_KINETIS_K6X
	bool
	select SOC_FAMILY_KINETIS

config SOC_SERIES
	default "k6x" if SOC_SERIES_KINETIS_K6X

config SOC_MK64F12
	bool
	select SOC_SERIES_KINETIS_K6X

config SOC_MK66F18
	bool
	select SOC_SERIES_KINETIS_K6X

config SOC
	default "mk64f12" if SOC_MK64F12
	default "mk66f18" if SOC_MK66F18

config SOC_PART_NUMBER_MK64FN1M0CAJ12
	bool

config SOC_PART_NUMBER_MK64FN1M0VDC12
	bool

config SOC_PART_NUMBER_MK64FN1M0VLL12
	bool

config SOC_PART_NUMBER_MK64FN1M0VLQ12
	bool

config SOC_PART_NUMBER_MK64FN1M0VMD12
	bool

config SOC_PART_NUMBER_MK64FX512VDC12
	bool

config SOC_PART_NUMBER_MK64FX512VLL12
	bool

config SOC_PART_NUMBER_MK64FX512VLQ12
	bool

config SOC_PART_NUMBER_MK64FX512VMD12
	bool

config SOC_PART_NUMBER_MK66FN2M0VMD18
	bool

config SOC_PART_NUMBER_MK66FN2M0VLQ18
	bool

config SOC_PART_NUMBER
	default "MK64FN1M0CAJ12" if SOC_PART_NUMBER_MK64FN1M0CAJ12
	default "MK64FN1M0VDC12" if SOC_PART_NUMBER_MK64FN1M0VDC12
	default "MK64FN1M0VLL12" if SOC_PART_NUMBER_MK64FN1M0VLL12
	default "MK64FN1M0VLQ12" if SOC_PART_NUMBER_MK64FN1M0VLQ12
	default "MK64FN1M0VMD12" if SOC_PART_NUMBER_MK64FN1M0VMD12
	default "MK64FX512VDC12" if SOC_PART_NUMBER_MK64FX512VDC12
	default "MK64FX512VLL12" if SOC_PART_NUMBER_MK64FX512VLL12
	default "MK64FX512VLQ12" if SOC_PART_NUMBER_MK64FX512VLQ12
	default "MK64FX512VMD12" if SOC_PART_NUMBER_MK64FX512VMD12
	default "MK66FN2M0VMD18" if SOC_PART_NUMBER_MK66FN2M0VMD18
	default "MK66FN2M0VLQ18" if SOC_PART_NUMBER_MK66FN2M0VLQ18
```

## soc/nxp/kinetis/k8x/Kconfig
```kconfig
# Kinetis K8x series MCU

# Copyright (c) 2019 SEAL AG
# Copyright 2024 NXP
# SPDX-License-Identifier: Apache-2.0

config SOC_SERIES_KINETIS_K8X
	select ARM
	select CPU_CORTEX_M4
	select CPU_CORTEX_M_HAS_DWT
	select CPU_HAS_NXP_MPU
	select CPU_HAS_FPU
	select CLOCK_CONTROL
	select HAS_MCUX
	select HAS_MCUX_ADC16
	select HAS_MCUX_FTFX
	select HAS_MCUX_FTM
	select HAS_MCUX_LPUART
	select HAS_MCUX_PIT
	select HAS_MCUX_RTC
	select HAS_MCUX_SIM
	select HAS_MCUX_TRNG
	select HAS_OSC
	select HAS_MCG
	select HAS_MCUX_EDMA
	select HAS_MCUX_PIT
	select HAS_MCUX_RCM
	select HAS_MCUX_CACHE
	select SOC_RESET_HOOK

if SOC_SERIES_KINETIS_K8X

config K8X_CORE_CLOCK_DIVIDER
	int "Freescale K8x core clock divider"
	default 1
	help
	  This option specifies the divide value for the K8x processor core clock
	  from the system clock.

config K8X_BUS_CLOCK_DIVIDER
	int "Freescale K8x bus clock divider"
	default 2
	help
	  This option specifies the divide value for the K8x bus clock from the
	  system clock.

config K8X_FLEXBUS_CLOCK_DIVIDER
	int "Freescale K8x FlexBus clock divider"
	default 2
	help
	  This option specifies the divide value for the K8x FlexBus clock from the
	  system clock.

config K8X_FLASH_CLOCK_DIVIDER
	int "Freescale K8x flash clock divider"
	default 5
	help
	  This option specifies the divide value for the K8x flash clock from the
	  system clock.

endif # SOC_SERIES_KINETIS_K8X
```

## soc/nxp/kinetis/k8x/Kconfig.defconfig
```kconfig
# Kinetis K8x series configuration options

# Copyright (c) 2019 SEAL AG
# Copyright 2024 NXP
# SPDX-License-Identifier: Apache-2.0

if SOC_SERIES_KINETIS_K8X

config NUM_IRQS
	# must be >= the highest interrupt number used
	default 106

config CPU_HAS_CUSTOM_FIXED_SOC_MPU_REGIONS
	default y

# The flash option register (FOPT) boot options
# 0011 1001 - Boot from Internal Flash.
#             Set NMI pin/interrupts to disabled.
config KINETIS_FLASH_CONFIG_FOPT
	default 0x3B
	depends on KINETIS_FLASH_CONFIG

config GPIO
	default y

endif # SOC_SERIES_KINETIS_K8X
```

## soc/nxp/kinetis/k8x/Kconfig.soc
```kconfig
# Kinetis K8x series MCU

# Copyright (c) 2019 SEAL AG
# Copyright 2024 NXP
# SPDX-License-Identifier: Apache-2.0

config SOC_SERIES_KINETIS_K8X
	bool
	select SOC_FAMILY_KINETIS

config SOC_SERIES
	default "k8x" if SOC_SERIES_KINETIS_K8X

config SOC_MK80F25615
	bool
	select SOC_SERIES_KINETIS_K8X

config SOC_MK82F25615
	bool
	select SOC_SERIES_KINETIS_K8X

config SOC
	default "mk80f25615" if SOC_MK80F25615
	default "mk82f25615" if SOC_MK82F25615

config SOC_PART_NUMBER_MK80FN256VDC15
	bool

config SOC_PART_NUMBER_MK80FN256VLL15
	bool

config SOC_PART_NUMBER_MK82FN256VDC15
	bool

config SOC_PART_NUMBER_MK82FN256VLL15
	bool

config SOC_PART_NUMBER
	default "MK80FN256VDC15" if SOC_PART_NUMBER_MK80FN256VDC15
	default "MK80FN256VLL15" if SOC_PART_NUMBER_MK80FN256VLL15
	default "MK82FN256VDC15" if SOC_PART_NUMBER_MK82FN256VDC15
	default "MK82FN256VLL15" if SOC_PART_NUMBER_MK82FN256VLL15
```

## soc/nxp/kinetis/ke1xf/Kconfig
```kconfig
# Kinetis KE1xF series MCU

# Copyright (c) 2019 Vestas Wind Systems A/S
# Copyright 2024 NXP
# SPDX-License-Identifier: Apache-2.0

config SOC_SERIES_KINETIS_KE1XF
	select ARM
	select CPU_CORTEX_M4
	select CPU_CORTEX_M_HAS_DWT
	select CPU_HAS_NXP_MPU
	select CPU_HAS_FPU
	select CLOCK_CONTROL
	select HAS_MCUX
	select HAS_MCUX_CACHE
	select HAS_MCUX_FTFX
	select HAS_MCUX_LPI2C
	select HAS_MCUX_LPSPI
	select HAS_MCUX_LPUART
	select HAS_MCUX_PCC
	select HAS_MCUX_RTC
	select HAS_MCUX_SIM
	select HAS_MCUX_ADC12
	select HAS_MCUX_SCG
	select HAS_MCUX_WDOG32
	select HAS_MCUX_FTM
	select HAS_MCUX_LPTMR
	select HAS_MCUX_DAC32
	select HAS_MCUX_EDMA
	select HAS_MCUX_PWT
	select HAS_MCUX_RCM
	select SOC_RESET_HOOK
	select SOC_EARLY_INIT_HOOK
	select HAS_PM

config SOC_MKE16F16
	select HAS_MCUX
	select HAS_MCUX_FLEXCAN

config SOC_MKE18F16
	select HAS_MCUX
	select HAS_MCUX_FLEXCAN

if SOC_SERIES_KINETIS_KE1XF

config WDOG_ENABLE_AT_BOOT
	bool "Keep watchdog timer enabled at boot"
	help
	  Keep the watchdog timer enabled at boot with the internal
	  128kHz LPO clock (and a prescaler of 256) as clock
	  source. The application can take over control of the
	  watchdog timer after boot and install a different timeout,
	  if needed.

config WDOG_INITIAL_TIMEOUT
	int "Initial timeout for the watchdog timer in milliseconds"
	depends on WDOG_ENABLE_AT_BOOT && WDOG_INIT
	range 2 131070
	default 2048
	help
	  Initial timeout value for the watchdog timer in
	  milliseconds.

config KINETIS_KE1XF_ENABLE_CODE_CACHE
	bool "Code cache"
	default y

endif # SOC_SERIES_KINETIS_KE1XF
```

## soc/nxp/kinetis/ke1xf/Kconfig.defconfig
```kconfig
# Kinetis KE1xF series configuration options

# Copyright (c) 2019-2021 Vestas Wind Systems A/S
# Copyright 2024 NXP
# SPDX-License-Identifier: Apache-2.0

if SOC_SERIES_KINETIS_KE1XF

config MCUX_LPTMR_TIMER
	default y if PM

config CORTEX_M_SYSTICK
	default n if MCUX_LPTMR_TIMER

config SYS_CLOCK_HW_CYCLES_PER_SEC
	default $(dt_node_int_prop_int,/cpus/cpu@0,clock-frequency) if CORTEX_M_SYSTICK
	default $(dt_node_int_prop_int,/soc/lptmr@40040000,clock-frequency) if MCUX_LPTMR_TIMER

config NUM_IRQS
	# must be >= the highest interrupt number used
	default 91

config CPU_HAS_CUSTOM_FIXED_SOC_MPU_REGIONS
	default y

config KINETIS_FLASH_CONFIG_FOPT
	default 0x7d
	depends on KINETIS_FLASH_CONFIG

config PWM_MCUX_PWT
	default y
	depends on PWM_CAPTURE

config GPIO
	default y

endif # SOC_SERIES_KINETIS_KE1XF
```

## soc/nxp/kinetis/ke1xf/Kconfig.soc
```kconfig
# Kinetis KE1xF MCU line

# Copyright (c) 2019 Vestas Wind Systems A/S
# Copyright 2024 NXP
# SPDX-License-Identifier: Apache-2.0

config SOC_SERIES_KINETIS_KE1XF
	bool
	select SOC_FAMILY_KINETIS

config SOC_SERIES
	default "ke1xf" if SOC_SERIES_KINETIS_KE1XF

config SOC_MKE14F16
	bool
	select SOC_SERIES_KINETIS_KE1XF

config SOC_MKE16F16
	bool
	select SOC_SERIES_KINETIS_KE1XF

config SOC_MKE18F16
	bool
	select SOC_SERIES_KINETIS_KE1XF

config SOC
	default "mke14f16" if SOC_MKE14F16
	default "mke16f16" if SOC_MKE16F16
	default "mke18f16" if SOC_MKE18F16

config SOC_PART_NUMBER_MKE14F256VLH16
	bool

config SOC_PART_NUMBER_MKE14F256VLL16
	bool

config SOC_PART_NUMBER_MKE14F512VLH16
	bool

config SOC_PART_NUMBER_MKE14F512VLL16
	bool

config SOC_PART_NUMBER_MKE16F256VLH16
	bool

config SOC_PART_NUMBER_MKE16F256VLL16
	bool

config SOC_PART_NUMBER_MKE16F512VLH16
	bool

config SOC_PART_NUMBER_MKE16F512VLL16
	bool

config SOC_PART_NUMBER_MKE18F256VLH16
	bool

config SOC_PART_NUMBER_MKE18F256VLL16
	bool

config SOC_PART_NUMBER_MKE18F512VLH16
	bool

config SOC_PART_NUMBER_MKE18F512VLL16
	bool

config SOC_PART_NUMBER
	default "MKE14F256VLH16" if SOC_PART_NUMBER_MKE14F256VLH16
	default "MKE14F256VLL16" if SOC_PART_NUMBER_MKE14F256VLL16
	default "MKE14F512VLH16" if SOC_PART_NUMBER_MKE14F512VLH16
	default "MKE14F512VLL16" if SOC_PART_NUMBER_MKE14F512VLL16
	default "MKE16F256VLH16" if SOC_PART_NUMBER_MKE16F256VLH16
	default "MKE16F256VLL16" if SOC_PART_NUMBER_MKE16F256VLL16
	default "MKE16F512VLH16" if SOC_PART_NUMBER_MKE16F512VLH16
	default "MKE16F512VLL16" if SOC_PART_NUMBER_MKE16F512VLL16
	default "MKE18F256VLH16" if SOC_PART_NUMBER_MKE18F256VLH16
	default "MKE18F256VLL16" if SOC_PART_NUMBER_MKE18F256VLL16
	default "MKE18F512VLH16" if SOC_PART_NUMBER_MKE18F512VLH16
	default "MKE18F512VLL16" if SOC_PART_NUMBER_MKE18F512VLL16
```

## soc/nxp/kinetis/ke1xz/Kconfig
```kconfig
# Kinetis KE1xZ series MCU

# Copyright (c) 2019 Vestas Wind Systems A/S
# Copyright 2024 NXP
# SPDX-License-Identifier: Apache-2.0

config SOC_SERIES_KE1XZ
	select ARM
	select CPU_CORTEX_M0PLUS
	select CPU_CORTEX_M_HAS_SYSTICK
	select CPU_CORTEX_M_HAS_VTOR
	select CLOCK_CONTROL
	select HAS_MCUX
	select HAS_PM
	select SOC_RESET_HOOK
```

## soc/nxp/kinetis/ke1xz/Kconfig.defconfig
```kconfig
# Kinetis KE1xZ series configuration options

# Copyright (c) 2019-2021 Vestas Wind Systems A/S
# Copyright 2024 NXP
# SPDX-License-Identifier: Apache-2.0

if SOC_SERIES_KE1XZ

config MCUX_LPTMR_TIMER
	default y if PM

config CORTEX_M_SYSTICK
	default n if MCUX_LPTMR_TIMER

config SYS_CLOCK_HW_CYCLES_PER_SEC
	default $(dt_node_int_prop_int,/cpus/cpu@0,clock-frequency) if CORTEX_M_SYSTICK
	default $(dt_node_int_prop_int,/soc/lptmr@40040000,clock-frequency) if MCUX_LPTMR_TIMER

config NUM_IRQS
	default 32

config CPU_HAS_CUSTOM_FIXED_SOC_MPU_REGIONS
	default y

# The flash option register (FOPT) boot options:
# 0000 0001 - Normal Boot
# 0000 0000 - Set NMI pin/interrupts to disabled
# 0000 1000 - Allow Reset detection from RESET_Pin
# 1111 0010 - Reserved for Future Expansion
config KINETIS_FLASH_CONFIG_FOPT
	default 0xFB
	depends on KINETIS_FLASH_CONFIG

endif # SOC_SERIES_KE1XZ
```
