## soc/nxp/mcx/mcxc/Kconfig
```kconfig
# Copyright 2024 NXP
# SPDX-License-Identifier: Apache-2.0

config SOC_FAMILY_MCXC
	select ARM
	select CPU_CORTEX_M0PLUS
	select CPU_CORTEX_M_HAS_SYSTICK
	select CPU_CORTEX_M_HAS_VTOR
	select CLOCK_CONTROL
	select SOC_RESET_HOOK
	select HAS_MCUX
	select HAS_MCUX_SIM
	select HAS_MCUX_RCM
	select SOC_EARLY_INIT_HOOK
	select HAS_SEGGER_RTT if ZEPHYR_SEGGER_MODULE

if SOC_FAMILY_MCXC

config MCXC_FLASH_CONFIG
	bool "MCXC flash configuration field"
	default y if XIP && !BOOTLOADER_MCUBOOT
	help
	  Include the 16-byte flash configuration field that stores default
	  protection settings (loaded on reset) and security information that
	  allows the MCU to restrict access to the FTFx module.

if MCXC_FLASH_CONFIG

config MCXC_FLASH_CONFIG_OFFSET
	hex
	default $(dt_node_int_prop_hex,/soc/flash-controller@40020000,config-field-offset)

endif # MCXC_FLASH_CONFIG

endif # SOC_FAMILY_MCXC
```
