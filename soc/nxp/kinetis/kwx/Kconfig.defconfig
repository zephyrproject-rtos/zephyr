## soc/nxp/kinetis/kwx/Kconfig.defconfig
```kconfig
# Kinetis KWx series configuration options

# Copyright 2024 NXP
# SPDX-License-Identifier: Apache-2.0

if SOC_SERIES_KINETIS_KWX

config NUM_IRQS
	default 65 if SOC_MKW22D5 || SOC_MKW24D5
	default 32 if SOC_MKW40Z4 || SOC_MKW41Z4

config SPI
	default y if SOC_MKW22D5 || SOC_MKW24D5

config NET_L2_IEEE802154
	default y if !NET_L2_OPENTHREAD && SOC_MKW41Z4

if SOC_MKW40Z4 || SOC_MKW41Z4

choice CSPRNG_GENERATOR_CHOICE
	default CTR_DRBG_CSPRNG_GENERATOR
endchoice

choice RNG_GENERATOR_CHOICE
	default XOSHIRO_RANDOM_GENERATOR
endchoice

# The flash option register (FOPT) boot options
# 1111 1011 - Set NMI pin/interrupts to disabled.
config KINETIS_FLASH_CONFIG_FOPT
	default 0xFB
	depends on KINETIS_FLASH_CONFIG

endif # SOC_MKW40Z4 || SOC_MKW41Z4

if SOC_MKW22D5 || SOC_MKW24D5

# The flash option register (FOPT) boot options
# 1111 1001 - Set NMI pin/interrupts and EzPort reset default to disabled
config KINETIS_FLASH_CONFIG_FOPT
	default 0xF9
	depends on KINETIS_FLASH_CONFIG

endif # SOC_MKW22D5 || SOC_MKW24D5

endif # SOC_SERIES_KINETIS_KWX
```

## soc/nxp/kinetis/kwx/Kconfig.soc
```kconfig
# Kinetis KWx MCU series

# Copyright 2017,2024 NXP
# SPDX-License-Identifier: Apache-2.0

config SOC_SERIES_KINETIS_KWX
	bool
	select SOC_FAMILY_KINETIS

config SOC_SERIES
	default "kwx" if SOC_SERIES_KINETIS_KWX

config SOC_MKW22D5
	bool
	select SOC_SERIES_KINETIS_KWX

config SOC_MKW24D5
	bool
	select SOC_SERIES_KINETIS_KWX

config SOC_MKW40Z4
	bool
	select SOC_SERIES_KINETIS_KWX

config SOC_MKW41Z4
	bool
	select SOC_SERIES_KINETIS_KWX

config SOC
	default "mkw22d5" if SOC_MKW22D5
	default "mkw24d5" if SOC_MKW24D5
	default "mkw40z4" if SOC_MKW40Z4
	default "mkw41z4" if SOC_MKW41Z4

config SOC_PART_NUMBER_MKW22D512VHA5
	bool

config SOC_PART_NUMBER_MKW24D512VHA5
	bool

config SOC_PART_NUMBER_MKW40Z160VHT4
	bool

config SOC_PART_NUMBER_MKW41Z256VHT4
	bool

config SOC_PART_NUMBER_MKW41Z512VHT4
	bool

config SOC_PART_NUMBER
	default "MKW22D512VHA5" if SOC_PART_NUMBER_MKW22D512VHA5
	default "MKW24D512VHA5" if SOC_PART_NUMBER_MKW24D512VHA5
	default "MKW40Z160VHT4" if SOC_PART_NUMBER_MKW40Z160VHT4
	default "MKW41Z256VHT4" if SOC_PART_NUMBER_MKW41Z256VHT4
	default "MKW41Z512VHT4" if SOC_PART_NUMBER_MKW41Z512VHT4
```

## soc/nxp/layerscape/Kconfig
```kconfig
#
# Copyright 2024 NXP
#
# SPDX-License-Identifier: Apache-2.0
#
#
if SOC_FAMILY_NXP_LAYERSCAPE

rsource "*/Kconfig"

endif # SOC_FAMILY_NXP_LAYERSCAPE
```

## soc/nxp/layerscape/Kconfig.soc
```kconfig
#
# Copyright 2024 NXP
#
# SPDX-License-Identifier: Apache-2.0
#

config SOC_FAMILY_NXP_LAYERSCAPE
	bool

config SOC_FAMILY
	default "nxp_layerscape" if SOC_FAMILY_NXP_LAYERSCAPE

rsource "*/Kconfig.soc"
```

## soc/nxp/layerscape/ls1046a/Kconfig
```kconfig
#
# Copyright 2021,2024 NXP
#
# SPDX-License-Identifier: Apache-2.0
#

config SOC_LS1046A
	select ARM64
	select CPU_CORTEX_A72
	select ARM_ARCH_TIMER if SYS_CLOCK_EXISTS
```

## soc/nxp/layerscape/ls1046a/Kconfig.defconfig
```kconfig
#
# Copyright 2021,2024 NXP
#
# SPDX-License-Identifier: Apache-2.0
#

if SOC_LS1046A

config NUM_IRQS
	default 240

config FLASH_SIZE
	default 0

config FLASH_BASE_ADDRESS
	default 0

endif
```

## soc/nxp/layerscape/ls1046a/Kconfig.soc
```kconfig
#
# Copyright 2024 NXP
#
# SPDX-License-Identifier: Apache-2.0
#

config SOC_SERIES_LS1046A
	bool
	select SOC_FAMILY_NXP_LAYERSCAPE

config SOC_LS1046A
	bool
	select SOC_SERIES_LS1046A
	help
	  NXP Layerscape ls1046a

config SOC
	default "ls1046a" if SOC_LS1046A

config SOC_SERIES
	default "ls1046a" if SOC_SERIES_LS1046A

config SOC_PART_NUMBER_LS1046A
	bool

config SOC_PART_NUMBER_LS1026A
	bool

config SOC_PART_NUMBER
	default "LS1046A" if SOC_PART_NUMBER_LS1046A
	default "LS1026A" if SOC_PART_NUMBER_LS1026A
```

## soc/nxp/lpc/Kconfig
```kconfig
# Copyright 2017,2024 NXP
# SPDX-License-Identifier: Apache-2.0

config SOC_FAMILY_LPC
	select HAS_SEGGER_RTT if ZEPHYR_SEGGER_MODULE
	select CLOCK_CONTROL
	select ARM

if SOC_FAMILY_LPC
rsource "*/Kconfig"

endif # SOC_FAMILY_LPC
```

## soc/nxp/lpc/Kconfig.defconfig
```kconfig
# Copyright 2017,2024 NXP
# SPDX-License-Identifier: Apache-2.0

if SOC_FAMILY_LPC

config SERIAL_INIT_PRIORITY
	default 55 if SERIAL

config BUILD_WITH_TFM
	default y if TRUSTED_EXECUTION_NONSECURE

rsource "*/Kconfig.defconfig"

endif # SOC_FAMILY_LPC
```

## soc/nxp/lpc/Kconfig.soc
```kconfig
# Copyright 2017,2024 NXP
# SPDX-License-Identifier: Apache-2.0

config SOC_FAMILY_LPC
	bool

config SOC_FAMILY
	default "lpc" if SOC_FAMILY_LPC

rsource "*/Kconfig.soc"
```

## soc/nxp/lpc/lpc11u6x/Kconfig
```kconfig
# LPC LPC11U6X MCU line
#
# Copyright (c) 2020, Seagate
# Copyright 2024 NXP
#
# SPDX-License-Identifier: Apache-2.0
#

config SOC_SERIES_LPC11U6X
	select ARM
	select CPU_CORTEX_M0PLUS
	select CPU_CORTEX_M_HAS_SYSTICK
	select PINCTRL
	select CLOCK_CONTROL
```

## soc/nxp/lpc/lpc11u6x/Kconfig.defconfig
```kconfig
# LPC LPC11U6X MCU line
#
# Copyright (c) 2020, Seagate
# Copyright 2024 NXP
#
# SPDX-License-Identifier: Apache-2.0
#

if SOC_SERIES_LPC11U6X

rsource "../../common/Kconfig.defconfig.nvic"

endif # SOC_SERIES_LPC11U6X
```

## soc/nxp/lpc/lpc11u6x/Kconfig.soc
```kconfig
# NXP LPC11U6x series

# Copyright 2024 NXP

#
# SPDX-License-Identifier: Apache-2.0
#

config SOC_SERIES_LPC11U6X
	bool
	select SOC_FAMILY_LPC

config SOC_SERIES
	default "lpc11u6x" if SOC_SERIES_LPC11U6X

config SOC_LPC11U68
	bool
	select SOC_SERIES_LPC11U6X

config SOC_LPC11U67
	bool
	select SOC_SERIES_LPC11U6X

config SOC_LPC11U66
	bool
	select SOC_SERIES_LPC11U6X

config SOC
	default "lpc11u66" if SOC_LPC11U66
	default "lpc11u67" if SOC_LPC11U67
	default "lpc11u68" if SOC_LPC11U68

config SOC_PART_NUMBER_LPC11U66JBD48
	bool
config SOC_PART_NUMBER_LPC11U67JBD48
	bool
config SOC_PART_NUMBER_LPC11U67JBD64
	bool
config SOC_PART_NUMBER_LPC11U67JBD100
	bool
config SOC_PART_NUMBER_LPC11U68JBD48
	bool
config SOC_PART_NUMBER_LPC11U68JBD64
	bool
config SOC_PART_NUMBER_LPC11U68JBD100
	bool

config SOC_PART_NUMBER
	default "LPC11U66JBD48" if SOC_PART_NUMBER_LPC11U66JBD48
	default "LPC11U67JBD48" if SOC_PART_NUMBER_LPC11U67JBD48
	default "LPC11U67JBD64" if SOC_PART_NUMBER_LPC11U67JBD64
	default "LPC11U67JBD100" if SOC_PART_NUMBER_LPC11U67JBD100
	default "LPC11U68JBD48" if SOC_PART_NUMBER_LPC11U68JBD48
	default "LPC11U68JBD64" if SOC_PART_NUMBER_LPC11U68JBD64
	default "LPC11U68JBD100" if SOC_PART_NUMBER_LPC11U68JBD100
```

## soc/nxp/lpc/lpc51u68/Kconfig
```kconfig
# LPC51U68 series configuration options
#
# Copyright (c) 2021 metraTec GmbH
# Copyright 2024 NXP
#
# SPDX-License-Identifier: Apache-2.0
#

config SOC_SERIES_LPC51U68
	select ARM
	select CPU_CORTEX_M0PLUS
	select HAS_MCUX
	select HAS_MCUX_FLEXCOMM
	select HAS_MCUX_SYSCON
	select HAS_MCUX_SCTIMER
	select CPU_CORTEX_M_HAS_SYSTICK
	select CPU_CORTEX_M_HAS_VTOR
	select SOC_RESET_HOOK

config SOC_LPC51U68
	select CLOCK_CONTROL
```

## soc/nxp/lpc/lpc51u68/Kconfig.defconfig
```kconfig
# LPC51U68 series configuration options

# Copyright (c) 2021 metraTec GmbH
# Copyright 2024 NXP
# SPDX-License-Identifier: Apache-2.0

if SOC_SERIES_LPC51U68

config NUM_IRQS
	# must be >= the highest interrupt number used.
	default 32

config SOC_FLASH_LPC
	default y
	depends on FLASH

endif # SOC_SERIES_LPC51U86
```

## soc/nxp/lpc/lpc51u68/Kconfig.soc
```kconfig
# LPC LPC51U68 MCU line

# Copyright (c) 2021 metraTec GmbH
# Copyright 2024 NXP
# SPDX-License Identifier: Apache-2.0

config SOC_SERIES_LPC51U68
	bool
	select SOC_FAMILY_LPC

config SOC_SERIES
	default "lpc51u68" if SOC_SERIES_LPC51U68

config SOC_LPC51U68
	bool
	select SOC_SERIES_LPC51U68

config SOC
	default "lpc51u68" if SOC_LPC51U68

config SOC_PART_NUMBER_LPC51U68JBD48
	bool

config SOC_PART_NUMBER_LPC51U68JBD64
	bool

config SOC_PART_NUMBER
	default "LPC51U68JBD48" if SOC_PART_NUMBER_LPC51U68JBD48
	default "LPC51U68JBD64" if SOC_PART_NUMBER_LPC51U68JBD64
```

## soc/nxp/lpc/lpc54xxx/lpc54s018/Kconfig.defconfig
```kconfig
# Copyright (c) 2024, VCI Development - LPC54S018J4MET180E single-core M4
# SPDX-License-Identifier: Apache-2.0

if SOC_LPC54S018

config SOC
	default "lpc54s018"

config SOC_PART_NUMBER
	default "LPC54S018J4MET180E"

# External SPIFI flash base address
config FLASH_BASE_ADDRESS
	default 0x10000000

# LPC54S018 uses external flash only
config FLASH_SIZE
	default 4096

# SRAM configuration
config SRAM_SIZE
	default 360

config SRAM_BASE_ADDRESS
	default 0x20000000

config NUM_IRQS
	default 64

config SYS_CLOCK_HW_CYCLES_PER_SEC
	default 180000000

endif # SOC_LPC54S018
```

## soc/nxp/lpc/lpc55xxx/Kconfig
```kconfig
# Copyright 2019,2024 NXP
# SPDX-License-Identifier: Apache-2.0

config SOC_SERIES_LPC55XXX
	select HAS_MCUX
	select CPU_CORTEX_M_HAS_SYSTICK
	select CPU_CORTEX_M_HAS_DWT
	select SOC_RESET_HOOK

config SOC_LPC55S06
	select CPU_CORTEX_M33
	select CPU_HAS_ARM_SAU
	select CPU_HAS_ARM_MPU
	select CPU_HAS_FPU
	select ARMV8_M_DSP
	select ARM_TRUSTZONE_M

config SOC_LPC55S16
	select CPU_CORTEX_M33
	select CPU_HAS_ARM_SAU
	select CPU_HAS_ARM_MPU
	select CPU_HAS_FPU
	select ARMV8_M_DSP
	select ARM_TRUSTZONE_M

config SOC_LPC55S26
	select CPU_CORTEX_M33
	select CPU_HAS_ARM_SAU
	select CPU_HAS_ARM_MPU
	select CPU_HAS_FPU
	select ARMV8_M_DSP

config SOC_LPC55S28
	select CPU_CORTEX_M33
	select CPU_HAS_ARM_SAU
	select CPU_HAS_ARM_MPU
	select CPU_HAS_FPU
	select ARMV8_M_DSP

config SOC_LPC55S36
	select CPU_CORTEX_M33
	select CPU_HAS_ARM_SAU
	select CPU_HAS_ARM_MPU
	select CPU_HAS_FPU
	select ARMV8_M_DSP
	select ARM_TRUSTZONE_M

config SOC_LPC55S69
	select CPU_CORTEX_M33

config SOC_LPC55S69_CPU0
	select CPU_HAS_ARM_SAU
	select CPU_HAS_ARM_MPU
	select CPU_HAS_FPU
	select ARMV8_M_DSP
	select ARM_TRUSTZONE_M
	select HAS_PM

if SOC_SERIES_LPC55XXX

config INIT_PLL0
	bool "Initialize PLL0"

config INIT_PLL1
	bool "Initialize PLL1"
	default "y"
	depends on !(SOC_LPC55S06 || FLASH || BUILD_WITH_TFM)
	help
	  In the LPC55XXX Family, this is currently being used to set the
	  core clock value at it's highest frequency which clocks at 150MHz.
	  Note that flash programming operations are limited to 100MHz, and
	  this PLL should not be used as the core clock in those cases.

config SECOND_CORE_MCUX
	bool "LPC55xxx's second core"

config SECOND_CORE_BOOT_ADDRESS_MCUX
	depends on SECOND_CORE_MCUX
	hex "Address the second core will boot at"
	default $(dt_chosen_reg_addr_hex,$(DT_CHOSEN_Z_CODE_CPU1_PARTITION))
	help
	  This is the address the second core will boot from.

config LPC55XXX_SRAM_CLOCKS
	bool "CLock LPC SRAM banks"

config LPC55XXX_USB_RAM
	bool

if SOC_LPC55S69

config SOC_FLASH_MCUX
	bool

endif # SOC_LPC55S69

config MCUX_CORE_SUFFIX
	default "_cm33_core0" if SOC_LPC55S69_CPU0
	default "_cm33_core1" if SOC_LPC55S69_CPU1

endif # SOC_SERIES_LPC55XXX
```

## soc/nxp/lpc/lpc55xxx/Kconfig.defconfig
```kconfig
# Copyright 2019,2024 NXP
# SPDX-License-Identifier: Apache-2.0

if SOC_SERIES_LPC55XXX

config NUM_IRQS
	# must be >= the highest interrupt number used
	default 60

config SYS_CLOCK_HW_CYCLES_PER_SEC
	default 144000000 if INIT_PLL1
	default 96000000

# Indicates the second core will be enabled, and the part will run
# in dual core mode.
config SECOND_CORE_MCUX
	depends on HAS_MCUX

# Workaround for not being able to have commas in macro arguments
DT_CHOSEN_Z_CODE_CPU1_PARTITION := zephyr,code-cpu1-partition

# Move the LMA for the second core image to be in the flash region of primary
# core, so that JLink flash will load it correctly.
config BUILD_OUTPUT_ADJUST_LMA
	depends on SECOND_CORE_MCUX && SOC_LPC55S69_CPU1
	default "0x10000000"

# SRAM controllers 1,2,3, and 4 are disabled at reset.
# By default, CMSIS SystemInit will enable the clock to these RAM banks.
# Disable this Kconfig to leave the ram banks untouched out of reset.
config LPC55XXX_SRAM_CLOCKS
	default y

# Some SoC's in the LPC5500 Series do have a dedicated USB RAM.
# By default, USB RAM is assumed to be present.
# Disable this Kconfig in case there is no dedicated USB RAM.
config LPC55XXX_USB_RAM
	default y if (!SOC_LPC55S06 && !SOC_LPC55S36)

# Set to the minimal size of data which can be written.
config FLASH_FILL_BUFFER_SIZE
	default 512

if SOC_LPC55S06

endif # SOC_LPC55S06

if SOC_LPC55S16

config CAN_MCUX_MCAN
	default y
	depends on CAN

endif # SOC_LPC55S16

if SOC_LPC55S69

config SOC_FLASH_MCUX
	default y
	depends on FLASH
	depends on !TRUSTED_EXECUTION_NONSECURE

config I2S_MCUX_FLEXCOMM
	select INIT_PLL0

endif # SOC_LPC55S69

if SOC_LPC55S69_CPU1

config GPIO
	default y

config SERIAL
	default n

endif # SOC_LPC55S69_CPU1

endif # SOC_SERIES_LPC55XXX
```

## soc/nxp/lpc/lpc55xxx/Kconfig.soc
```kconfig
# Copyright 2019, 2023-2024 NXP
# SPDX-License-Identifier: Apache-2.0

config SOC_SERIES_LPC55XXX
	bool
	select SOC_FAMILY_LPC

config SOC_SERIES
	default "lpc55xxx" if SOC_SERIES_LPC55XXX

config SOC_LPC55S06
	bool
	select SOC_SERIES_LPC55XXX

config SOC_LPC55S16
	bool
	select SOC_SERIES_LPC55XXX

config SOC_LPC55S26
	bool
	select SOC_SERIES_LPC55XXX

config SOC_LPC55S28
	bool
	select SOC_SERIES_LPC55XXX

config SOC_LPC55S36
	bool
	select SOC_SERIES_LPC55XXX

config SOC_LPC55S69
	bool
	select SOC_SERIES_LPC55XXX

config SOC_LPC55S69_CPU0
	bool
	select SOC_LPC55S69

config SOC_LPC55S69_CPU1
	bool
	select SOC_LPC55S69

config SOC
	default "lpc55s69" if SOC_LPC55S69_CPU0 || SOC_LPC55S69_CPU1
	default "lpc55s06" if SOC_LPC55S06
	default "lpc55s16" if SOC_LPC55S16
	default "lpc55s26" if SOC_LPC55S26
	default "lpc55s28" if SOC_LPC55S28
	default "lpc55s36" if SOC_LPC55S36

config SOC_PART_NUMBER_LPC55S06JBD64
	bool

config SOC_PART_NUMBER_LPC55S16JBD64
	bool

config SOC_PART_NUMBER_LPC55S16JBD100
	bool

config SOC_PART_NUMBER_LPC55S26JBD64
	bool

config SOC_PART_NUMBER_LPC55S26JBD100
	bool

config SOC_PART_NUMBER_LPC55S28JBD100
	bool

config SOC_PART_NUMBER_LPC55S36JBD100
	bool

config SOC_PART_NUMBER_LPC55S69JBD100
	bool

config SOC_PART_NUMBER_LPC55S69JEV98
	bool

config SOC_PART_NUMBER
	default "LPC55S06JBD64"  if SOC_PART_NUMBER_LPC55S06JBD64
	default "LPC55S16JBD64" if SOC_PART_NUMBER_LPC55S16JBD64
	default "LPC55S16JBD100" if SOC_PART_NUMBER_LPC55S16JBD100
	default "LPC55S26JBD64" if SOC_PART_NUMBER_LPC55S26JBD64
	default "LPC55S26JBD100" if SOC_PART_NUMBER_LPC55S26JBD100
	default "LPC55S28JBD100" if SOC_PART_NUMBER_LPC55S28JBD100
	default "LPC55S36JBD100" if SOC_PART_NUMBER_LPC55S36JBD100
	default "LPC55S69JBD100" if SOC_PART_NUMBER_LPC55S69JBD100
	default "LPC55S69JEV98"  if SOC_PART_NUMBER_LPC55S69JEV98
```

## soc/nxp/lpc/lpc84x/Kconfig.defconfig
```kconfig
# Copyright (c) 2026 Aerlync Labs Inc.
# SPDX-License-Identifier: Apache-2.0

if SOC_SERIES_LPC84X

config NUM_IRQS
	default 32

config SYS_CLOCK_HW_CYCLES_PER_SEC
	default $(dt_node_int_prop_int,/cpus/cpu@0,clock-frequency)

endif # SOC_SERIES_LPC84X
```

## soc/nxp/mcx/Kconfig
```kconfig
# Copyright 2024 NXP
# SPDX-License-Identifier: Apache-2.0

config SOC_FAMILY_NXP_MCX
	select HAS_SEGGER_RTT
	select CLOCK_CONTROL
	select ARM

if SOC_FAMILY_NXP_MCX

rsource "*/Kconfig"

endif # SOC_FAMILY_NXP_MCX
```

## soc/nxp/mcx/Kconfig.defconfig
```kconfig
# Copyright 2024 NXP
# SPDX-License-Identifier: Apache-2.0
#
# Do NOT select anything from the MCX family kconfig,
# and do not make it a dependency of anything else.
# If there is some similarity between series,
# use if SERIES_A || SERIES_B or something of that
# effect rather than the family config.
# This is because MCX series is expected to be very diverse.

if SOC_FAMILY_NXP_MCX

rsource "*/Kconfig.defconfig"

if BT

config MAIN_STACK_SIZE
	default 2560

if SHELL

config SHELL_STACK_SIZE
	default 4096

endif # SHELL

endif # BT

endif # SOC_FAMILY_NXP_MCX
```

## soc/nxp/mcx/Kconfig.soc
```kconfig
# Copyright 2024 NXP
# SPDX-License-Identifier: Apache-2.0

config SOC_FAMILY_NXP_MCX
	bool

config SOC_FAMILY
	default "nxp_mcx" if SOC_FAMILY_NXP_MCX

rsource "*/Kconfig.soc"
```
