## soc/nxp/s32/s32k3/Kconfig
```kconfig
# NXP S32K3XX MCU series

# Copyright 2023-2024 NXP
# SPDX-License-Identifier: Apache-2.0

config SOC_SERIES_S32K3
	select ARM
	select CPU_CORTEX_M7
	select HAS_NXP_S32_HAL
	select CPU_HAS_FPU
	select CPU_HAS_ARM_MPU
	select CPU_HAS_ICACHE
	select CPU_HAS_DCACHE
	select CPU_HAS_CUSTOM_FIXED_SOC_MPU_REGIONS
	select SOC_RESET_HOOK if XIP
	select USE_DT_CODE_PARTITION if XIP
	select CLOCK_CONTROL
	select HAS_MCUX
	select HAS_MCUX_LPUART
	select HAS_MCUX_FLEXCAN
	select HAS_MCUX_LPI2C
	select HAS_MCUX_LPSPI
	select HAS_MCUX_CACHE
	select HAS_MCUX_EDMA
	select SOC_EARLY_INIT_HOOK
	select HAS_SEGGER_RTT if ZEPHYR_SEGGER_MODULE

if SOC_SERIES_S32K3

config IVT_HEADER_OFFSET
	hex
	depends on XIP
	default $(dt_node_reg_addr_hex,$(dt_nodelabel_path,ivt_header))
	help
	  The offset address from flash base address for ivt header

config IVT_HEADER_SIZE
	hex
	depends on XIP
	default $(dt_node_reg_size_hex,$(dt_nodelabel_path,ivt_header))
	help
	  Size of ivt header region

endif # SOC_SERIES_S32K3
```

## soc/nxp/s32/s32k3/Kconfig.defconfig
```kconfig
# NXP S32K3XX MCU series

# Copyright 2023-2025 NXP
# SPDX-License-Identifier: Apache-2.0

if SOC_SERIES_S32K3

config SYS_CLOCK_HW_CYCLES_PER_SEC
	default $(dt_node_int_prop_int,/cpus/cpu@0,clock-frequency) if CORTEX_M_SYSTICK

config NUM_IRQS
	# must be >= the highest interrupt number used
	default 239

config FPU
	default y

if ETH_DRIVER && NET_L2_ETHERNET

config NET_TCP_CHECKSUM
	default n

config NET_UDP_CHECKSUM
	default n

endif # ETH_DRIVER && NET_L2_ETHERNET

config CACHE_MANAGEMENT
	default y

# S32K3 places the vector table at +0x400
# This makes the bootloader and the sign tool compatible with that.
config ROM_START_OFFSET
	default 0x400 if BOOTLOADER_MCUBOOT

endif # SOC_SERIES_S32K3
```

## soc/nxp/s32/s32k3/Kconfig.soc
```kconfig
# NXP S32K3XX MCU series

# Copyright 2023-2024 NXP
# SPDX-License-Identifier: Apache-2.0

config SOC_SERIES_S32K3
	bool
	select SOC_FAMILY_NXP_S32

config SOC_SERIES
	default "s32k3" if SOC_SERIES_S32K3

config SOC_S32K344
	bool
	select SOC_SERIES_S32K3

config SOC
	default "s32k344" if SOC_S32K344

config SOC_PART_NUMBER_PS32K344EHVPBS
	bool

config SOC_PART_NUMBER
	default "PS32K344EHVPBS" if SOC_PART_NUMBER_PS32K344EHVPBS
```

## soc/nxp/s32/s32k5/Kconfig
```kconfig
# NXP S32K5XX MCUs series

# Copyright 2025 NXP
# SPDX-License-Identifier: Apache-2.0

config SOC_SERIES_S32K5
	select ARM
	select HAS_NXP_S32_HAL
	select HAS_MCUX
	select CPU_HAS_FPU
	select CPU_HAS_ARM_MPU
	select CPU_HAS_ICACHE
	select CPU_HAS_DCACHE
	select SOC_EARLY_INIT_HOOK

config SOC_S32K566_M7
	select CPU_CORTEX_M7
	select CPU_HAS_CUSTOM_FIXED_SOC_MPU_REGIONS
	select SOC_EARLY_RESET_HOOK if XIP

config SOC_S32K566_R52
	select ARM_ARCH_TIMER if SYS_CLOCK_EXISTS
	select CPU_CORTEX_R52
	select GIC_SINGLE_SECURITY_STATE
	select VFP_DP_D16
	select SOC_RESET_HOOK
```

## soc/nxp/s32/s32k5/Kconfig.defconfig
```kconfig
# Copyright 2025 NXP
# SPDX-License-Identifier: Apache-2.0

if SOC_SERIES_S32K5

config SYS_CLOCK_HW_CYCLES_PER_SEC
	default $(dt_node_int_prop_int,/cpus/cpu@0,clock-frequency) if CORTEX_M_SYSTICK
	default $(dt_node_int_prop_int,/timer,clock-frequency) if ARM_ARCH_TIMER

configdefault FPU
	default y

config CACHE_MANAGEMENT
	default y

rsource "Kconfig.defconfig.*"

endif # SOC_SERIES_S32K5
```

## soc/nxp/s32/s32k5/Kconfig.defconfig.s32k566.m7
```kconfig
# NXP S32K5XX MCU series

# Copyright 2025 NXP
# SPDX-License-Identifier: Apache-2.0

if SOC_S32K566_M7

rsource "../../common/Kconfig.defconfig.nvic"

endif # SOC_S32K566_M7
```

## soc/nxp/s32/s32k5/Kconfig.defconfig.s32k566.r52
```kconfig
# NXP S32K5XX MCU series

# Copyright 2025 NXP
# SPDX-License-Identifier: Apache-2.0

if SOC_S32K566_R52

config NUM_IRQS
	# must be >= the highest interrupt number used
	default 328

config MAIN_STACK_SIZE
	default 1024

endif # SOC_S32K566_R52
```

## soc/nxp/s32/s32k5/Kconfig.soc
```kconfig
# Copyright 2025 NXP
# SPDX-License-Identifier: Apache-2.0

config SOC_SERIES_S32K5
	bool
	select SOC_FAMILY_NXP_S32

config SOC_SERIES
	default "s32k5" if SOC_SERIES_S32K5

config SOC_S32K566
	bool
	select SOC_SERIES_S32K5

config SOC_S32K566_M7
	bool
	select SOC_S32K566

config SOC_S32K566_R52
	bool
	select SOC_S32K566

config SOC
	default "s32k566" if SOC_S32K566

config SOC_PART_NUMBER_S32K566JAMJGS
	bool

config SOC_PART_NUMBER
	default "S32K566JAMJGS" if SOC_PART_NUMBER_S32K566JAMJGS
```

## soc/nxp/s32/s32ze/Kconfig
```kconfig
# NXP S32ZE MCUs series

# Copyright 2022-2024 NXP
# SPDX-License-Identifier: Apache-2.0

config SOC_SERIES_S32ZE
	select ARM
	select ARM_ARCH_TIMER if SYS_CLOCK_EXISTS
	select CPU_CORTEX_R52
	select CPU_HAS_DCLS
	select CPU_HAS_ARM_MPU
	select GIC_SINGLE_SECURITY_STATE
	select VFP_DP_D16
	select PLATFORM_SPECIFIC_INIT
	select CLOCK_CONTROL
	select HAS_NXP_S32_HAL
	select HAS_MCUX
	select HAS_MCUX_PIT

if SOC_SERIES_S32ZE

config NXP_S32_RTU_INDEX
	int
	range 0 1
	default 0 if SOC_S32Z270_RTU0
	default 1 if SOC_S32Z270_RTU1
	help
	  This option indicates the index of the target RTU (Real-Time Unit) subsystem.

endif # SOC_SERIES_S32ZE
```

## soc/nxp/s32/s32ze/Kconfig.defconfig
```kconfig
# NXP S32ZE MCUs series

# Copyright 2022,2024 NXP
# SPDX-License-Identifier: Apache-2.0

if SOC_SERIES_S32ZE

config NUM_IRQS
	# must be >= the highest interrupt number used
	default 991

config FPU
	default y

config SYS_CLOCK_HW_CYCLES_PER_SEC
	default 2000000

config MAIN_STACK_SIZE
	default 1024

config CACHE_MANAGEMENT
	default y

if ETH_DRIVER && NET_L2_ETHERNET

# NETC drops TCP/UDP packets with invalid checksum
config NET_TCP_CHECKSUM
	default n

config NET_UDP_CHECKSUM
	default n

endif # ETH_DRIVER && NET_L2_ETHERNET

endif # SOC_SERIES_S32ZE
```

## soc/nxp/s32/s32ze/Kconfig.soc
```kconfig
# NXP S32ZE MCUs series

# Copyright 2022-2024 NXP
# SPDX-License-Identifier: Apache-2.0

config SOC_SERIES_S32ZE
	bool
	select SOC_FAMILY_NXP_S32

config SOC_SERIES
	default "s32ze" if SOC_SERIES_S32ZE

config SOC_S32Z270
	bool
	select SOC_SERIES_S32ZE

config SOC_S32Z270_RTU0
	bool
	select SOC_S32Z270

config SOC_S32Z270_RTU1
	bool
	select SOC_S32Z270

config SOC
	default "s32z270" if SOC_S32Z270

config SOC_PART_NUMBER_P32Z270ADCK0MJFT
	bool

config SOC_PART_NUMBER
	default "P32Z270ADCK0MJFT" if SOC_PART_NUMBER_P32Z270ADCK0MJFT
```

## soc/oct/osd32mp15x/Kconfig
```kconfig
# Copyright (c) 2024 Antmicro <www.antmicro.com>
# SPDX-License-Identifier: Apache-2.0

config SOC_OSD32MP15X
	select SOC_STM32MP15_M4
```

## soc/oct/osd32mp15x/Kconfig.soc
```kconfig
# Copyright (c) 2024 Antmicro <www.antmicro.com>
# SPDX-License-Identifier: Apache-2.0

# The OSD32MP15X is technically a SiP (System-in-Package) that consists of
# the STM32MP15 MCU and additional components like EEPROM. So for
# OSD32MP1-BRK platform the STM32MP15_M4 SoC is to be indicated as
# the build target, but since the OSD32MP15x SiP is what a user can actually
# see on a board, using only STM32MP15_M4 in the Zephyr build
# infrastructure might be confusing. That's why in the top level of SoC
# definitions (for user-configurable options in Kconfig, for example)
# the OSD32MP15X term is used and STM32MP15_M4 underneath.

config SOC_OSD32MP15X
	bool
	help
	  Octavo Systems OSD32MP15X SiP

config SOC
	default "osd32mp15x" if SOC_OSD32MP15X
```

## soc/openhwgroup/cv64a6/Kconfig.defconfig
```kconfig
# Copyright (c) 2024 CISPA Helmholtz Center for Information Security gGmbH
# SPDX-License-Identifier: Apache-2.0

if SOC_FAMILY_OPENHWGROUP_CV64A6

rsource "*/Kconfig.defconfig"

if SOC_SERIES_CV64A6

config SYS_CLOCK_HW_CYCLES_PER_SEC
	default 25000000

config RISCV_SOC_INTERRUPT_INIT
	default y

config RISCV_GP
	default y

config 2ND_LVL_ISR_TBL_OFFSET
	default 13

config 2ND_LVL_INTR_00_OFFSET
	default 11

config MAX_IRQ_PER_AGGREGATOR
	default 186

config NUM_IRQS
	default 186

endif # SOC_SERIES_CV64A6


endif # SOC_FAMILY_OPENHWGROUP_CV64A6
```

## soc/openhwgroup/cv64a6/Kconfig.soc
```kconfig
#Copyright 2024 CISPA Helmholtz Center for Information Security gGmbH
#SPDX-License-Identifier: Apache-2.0

config SOC_FAMILY_OPENHWGROUP_CV64A6
	bool

config SOC_FAMILY
	default "ariane_cv64a6" if SOC_FAMILY_OPENHWGROUP_CV64A6

rsource "*/Kconfig.soc"
```

## soc/openhwgroup/cv64a6/cv64a6/Kconfig
```kconfig
# Copyright 2024 CISPA Helmholtz Center for Information Security gGmbH
# SPDX-License-Identifier: Apache-2.0
# RISCV64 OpenHW Group cva6 configuration options

config SOC_SERIES_CV64A6
	select RISCV
	select RISCV_HAS_PLIC

config SOC_CV64A6
	select RISCV_PRIVILEGED
	select ATOMIC_OPERATIONS_BUILTIN
	select RISCV_GP
	select USE_SWITCH_SUPPORTED
	select USE_SWITCH
	select CPU_HAS_FPU
	select CPU_HAS_FPU_DOUBLE_PRECISION
	select SCHED_IPI_SUPPORTED
	select 64BIT
	select RISCV_ISA_RV64I
	select RISCV_ISA_EXT_M
	select RISCV_ISA_EXT_A
	select RISCV_ISA_EXT_C
	select RISCV_ISA_EXT_ZICSR
	select RISCV_ISA_EXT_ZIFENCEI
	select HAS_POWEROFF
	select CPU_HAS_DCACHE
	select CPU_HAS_ICACHE

config SOC_SERIES_CV64A6_PROVIDE_NONSTANDARD_CACHE_OPTIONS
	bool "Include non-standard cache management operations (currently global cache disable)"
	depends on SOC_CV64A6
	default n

config SOC_SERIES_CV64A6_PROVIDE_TEST_POWEROFF
	bool "Include methods for terminating a test in the CV64a6 test harness (hardware simulation)"
	depends on SOC_CV64A6
	default n

config SOC_SERIES_CV64A6_PROVIDE_FPGA_POWEROFF
	bool "Include methods for terminating a test on the FPGA"
	depends on SOC_CV64A6
	default n
```

## soc/openhwgroup/cva6/Kconfig
```kconfig
# Copyright (c) 2024 CISPA Helmholtz Center for Information Security gGmbH
# SPDX-License-Identifier: Apache-2.0

if SOC_FAMILY_OPENHWGROUP_CVA6

rsource "*/Kconfig"

endif # SOC_FAMILY_OPENHWGROUP_CVA6
```

## soc/openhwgroup/cva6/Kconfig.defconfig
```kconfig
# Copyright (c) 2024 CISPA Helmholtz Center for Information Security gGmbH
# SPDX-License-Identifier: Apache-2.0

if SOC_FAMILY_OPENHWGROUP_CVA6

config SYS_CLOCK_HW_CYCLES_PER_SEC
	int
	default $(dt_node_int_prop_int,/cpus/cpu@0,timebase-frequency)

config RISCV_SOC_INTERRUPT_INIT
	default y

# highest implemented first-level interrupt is machine external, 11
config 2ND_LVL_ISR_TBL_OFFSET
	default 12

config 2ND_LVL_INTR_00_OFFSET
	default 11

# 12 first level, 30 second level
config MAX_IRQ_PER_AGGREGATOR
	default 30

# one 2nd level aggregator (PLIC) with 30 interrupts
# offset of 12
config NUM_IRQS
	default 42

config MULTI_LEVEL_INTERRUPTS
	default y

config 2ND_LEVEL_INTERRUPTS
	default y

# 1 PLIC
config NUM_2ND_LEVEL_AGGREGATORS
	default 1

config PLIC
	default y

config 3RD_LEVEL_INTERRUPTS
	default n

endif # SOC_FAMILY_OPENHWGROUP_CVA6
```
