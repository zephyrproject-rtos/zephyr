## soc/nxp/mcx/mcxl/Kconfig
```kconfig
# Copyright 2025-2026 NXP
# SPDX-License-Identifier: Apache-2.0

config SOC_FAMILY_MCXL
	select CLOCK_CONTROL
	select ARM
	select HAS_MCUX
	select CPU_CORTEX_M_HAS_SYSTICK
	select CPU_CORTEX_M_HAS_VTOR
	select CLOCK_CONTROL_FIXED_RATE_CLOCK

config NXP_MCXL_FLASH_ACCESS_UNRESTRICTED
	bool "Unlock TRDC MBC flash access (unrestricted RWX)"
	depends on SOC_FAMILY_MCXL
	default y
	help
	  When enabled, soc_reset_hook() programs the TRDC Memory Block
	  Controller (MBC0) to grant full read/write/execute access to all
	  flash blocks for all security levels before any application code
	  runs.  This overrides the restrictive flash access control policy
	  that the ROM bootloader sets up on boot.

config SOC_MCXL255_CPU0
	select CPU_CORTEX_M33
	select CPU_HAS_ARM_SAU
	select CPU_HAS_ARM_MPU
	select CPU_HAS_FPU
	select CPU_CORTEX_M_HAS_DWT
	select ARMV8_M_DSP
	select SOC_RESET_HOOK
	select ARM_TRUSTZONE_M
	select HAS_MCUX_CACHE

config SOC_MCXL255_CPU1
	select CPU_CORTEX_M0PLUS

config ADVC_DRIVER_USED
	bool "NXP ADVC (Adaptive Voltage Control) driver support"
	depends on SOC_MCXL255_CPU0 || SOC_MCXL255_CPU1
	help
	  Link the precompiled NXP ADVC library (fetched via west blobs)
	  and enable the ADVC-aware code paths in the NXP power/clock
	  drivers. When disabled, those drivers fall back to fixed
	  voltage selection based on target frequency.

config SOC_MCXL254_CPU0
	select CPU_CORTEX_M33
	select CPU_HAS_ARM_SAU
	select CPU_HAS_ARM_MPU
	select CPU_HAS_FPU
	select CPU_CORTEX_M_HAS_DWT
	select ARMV8_M_DSP
	select SOC_RESET_HOOK
	select ARM_TRUSTZONE_M
	select HAS_MCUX_CACHE

config SOC_MCXL254_CPU1
	select CPU_CORTEX_M0PLUS

config SOC_MCXL253_CPU0
	select CPU_CORTEX_M33
	select CPU_HAS_ARM_SAU
	select CPU_HAS_ARM_MPU
	select CPU_HAS_FPU
	select CPU_CORTEX_M_HAS_DWT
	select ARMV8_M_DSP
	select SOC_RESET_HOOK
	select ARM_TRUSTZONE_M
	select HAS_MCUX_CACHE

config SOC_MCXL253_CPU1
	select CPU_CORTEX_M0PLUS
```

## soc/nxp/mcx/mcxl/Kconfig.defconfig
```kconfig
# Copyright 2025-2026 NXP
# SPDX-License-Identifier: Apache-2.0

if SOC_FAMILY_MCXL

config MCUX_CORE_SUFFIX
	default "_cm33" if SOC_MCXL255_CPU0 || SOC_MCXL254_CPU0 || \
		SOC_MCXL253_CPU0
	default "_cm0plus" if SOC_MCXL255_CPU1 || SOC_MCXL254_CPU1 || \
		SOC_MCXL253_CPU1

config CORTEX_M_SYSTICK
	default n if MCUX_OS_TIMER
	default y

config NUM_IRQS
	default 32 if SOC_MCXL255_CPU1 || SOC_MCXL254_CPU1 || SOC_MCXL253_CPU1
	default 161 if SOC_MCXL255_CPU0 || SOC_MCXL254_CPU0 || SOC_MCXL253_CPU0

config SYS_CLOCK_HW_CYCLES_PER_SEC
	default $(dt_node_int_prop_int,$(dt_nodelabel_path,ostimer0_clk),clock-frequency) if \
		MCUX_OS_TIMER
	default $(dt_node_int_prop_int,/cpus/cpu@0,clock-frequency) if \
		SOC_MCXL255_CPU0 || SOC_MCXL254_CPU0 || SOC_MCXL253_CPU0
	default $(dt_node_int_prop_int,/cpus/cpu@1,clock-frequency) if \
		SOC_MCXL255_CPU1 || SOC_MCXL254_CPU1 || SOC_MCXL253_CPU1

# Set to the minimal size of data which can be written.
config FLASH_FILL_BUFFER_SIZE
	default 512

config RESET
	default y if DT_HAS_NXP_MRCC_RESET_ENABLED

# Shift the cpu1 image LMA from VMA (0x00000000 in CM0+ / AON SRAM view)
# to the reserved slot in CM33 flash (0x10078000 = last 32 KB of 512 KB).
configdefault BUILD_OUTPUT_ADJUST_LMA
	default "0x10078000" if SOC_MCXL255_SECOND_CORE && SOC_MCXL255_CPU1

configdefault BUILD_OUTPUT_INFO_HEADER
	default y if SOC_MCXL255_SECOND_CORE && SOC_MCXL255_CPU1

endif # SOC_FAMILY_MCXL
```

## soc/nxp/mcx/mcxw/mcxw2xx/Kconfig.soc
```kconfig
# Copyright 2025 NXP
#
# SPDX-License-Identifier: Apache-2.0

config SOC_SERIES_MCXW2XX
	bool
	select SOC_FAMILY_MCXW

config SOC_SERIES
	default "mcxw2xx" if SOC_SERIES_MCXW2XX

config SOC_MCXW236
	bool
	select SOC_SERIES_MCXW2XX

config SOC_MCXW235
	bool
	select SOC_SERIES_MCXW2XX

config SOC
	default "mcxw236" if SOC_MCXW236
	default "mcxw235" if SOC_MCXW235

config SOC_PART_NUMBER_MCXW236BIHNAR
	bool

config SOC_PART_NUMBER_MCXW236AIHNAR
	bool

config SOC_PART_NUMBER_MCXW236AIUKAR
	bool

config SOC_PART_NUMBER_MCXW236BIUKAR
	bool

config SOC_PART_NUMBER_MCXW235BIHNAR
	bool

config SOC_PART_NUMBER_MCXW235AIHNAR
	bool

config SOC_PART_NUMBER_MCXW235AIUKAR
	bool

config SOC_PART_NUMBER_MCXW235BIUKAR
	bool

config SOC_PART_NUMBER
	default "MCXW236BIHNAR" if SOC_PART_NUMBER_MCXW236BIHNAR
	default "MCXW236AIHNAR" if SOC_PART_NUMBER_MCXW236AIHNAR
	default "MCXW236AIUKAR" if SOC_PART_NUMBER_MCXW236AIUKAR
	default "MCXW236BIUKAR" if SOC_PART_NUMBER_MCXW236BIUKAR
	default "MCXW235BIHNAR" if SOC_PART_NUMBER_MCXW235BIHNAR
	default "MCXW235AIHNAR" if SOC_PART_NUMBER_MCXW235AIHNAR
	default "MCXW235AIUKAR" if SOC_PART_NUMBER_MCXW235AIUKAR
	default "MCXW235BIUKAR" if SOC_PART_NUMBER_MCXW235BIUKAR
```

## soc/nxp/mcx/mcxw/mcxw7xx/Kconfig
```kconfig
# Copyright 2025-2026 NXP
#
# SPDX-License-Identifier: Apache-2.0

rsource "../../../common/Kconfig.nbu"

config MCUX_CORE_SUFFIX
	default "_cm33_core0" if SOC_MCXW727C

config SOC_MCXW716C
	select NXP_MULTICORE if NXP_NBU
	select NXP_MCXW7X_BLE_CTRL if NXP_NBU
	select HAS_PM
	select CPU_HAS_ICACHE
	select HAS_MCUX_MCM_LPCAC

config SOC_MCXW727C
	select NXP_MULTICORE if NXP_NBU
	select NXP_MCXW7X_BLE_CTRL if NXP_NBU
	select HAS_PM
	select CPU_HAS_ICACHE
	select HAS_MCUX_MCM_LPCAC

config SOC_MCXW70AC
	bool
	select NXP_MCXW7XX_BOOT_HEADER if !BOOTLOADER_MCUBOOT && !BUILD_WITH_TFM
	select NXP_MCXW7X_BLE_CTRL if NXP_NBU
	select NXP_MULTICORE if NXP_NBU
	select CPU_HAS_ICACHE
	select HAS_MCUX_MCM_LPCAC

config NXP_MCXW7XX_BOOT_HEADER
	bool "Create boot header"
	depends on !BOOTLOADER_MCUBOOT && !BUILD_WITH_TFM
	help
	  Create data structures required by the boot ROM to boot the
	  application from flash.

config SOC_SERIES_MCXW7XX_SHUTDOWN_UNUSED_RAM
	bool "Power off unused SRAM banks at init"
	depends on PM
	depends on $(dt_nodelabel_has_prop,cmc,sram-banks)
	help
	  At SoC power init, permanently power off (in all modes, via the CMC
	  SRAMDIS register) every CMC-controllable SRAM bank that no memory
	  region the linked image relies on overlaps. This lowers both active
	  and low-power leakage on images that do not use all of SRAM.

	  Bank geometry (start address, size and CMC disable bit for each bank)
	  comes from the sram-banks property on the cmc device tree node. A bank
	  is kept powered when it overlaps any of: the chosen zephyr,sram node,
	  the chosen zephyr,flash node when it is linked on-chip, or any enabled
	  zephyr,memory-region node. So an application keeps a bank alive simply
	  by declaring the region that uses it (for example an ECC region holding
	  critical data declared as a zephyr,memory-region). No linker symbol is
	  used, so the decision is not tied to any single linker region.

	  By default zephyr,sram spans the whole system SRAM, so only banks
	  outside it (for example the Code-TCM banks in the common flash-execution
	  configuration) are powered off. To free system-SRAM banks, shrink
	  zephyr,sram in a board overlay so the unused high banks fall outside it.
	  When this option is disabled, no SRAMDIS programming occurs and behavior
	  is unchanged.
```

## soc/nxp/mcx/mcxw/mcxw7xx/Kconfig.soc
```kconfig
# Copyright 2025-2026 NXP
#
# SPDX-License-Identifier: Apache-2.0

config SOC_SERIES_MCXW7XX
	bool
	select SOC_FAMILY_MCXW

config SOC_SERIES
	default "mcxw7xx" if SOC_SERIES_MCXW7XX

config SOC_MCXW70AC
	bool
	select SOC_SERIES_MCXW7XX

config SOC_MCXW716C
	bool
	select SOC_SERIES_MCXW7XX

config SOC_MCXW727C
	bool
	select SOC_SERIES_MCXW7XX

config SOC
	default "mcxw70ac" if SOC_MCXW70AC
	default "mcxw716c" if SOC_MCXW716C
	default "mcxw727c" if SOC_MCXW727C

config SOC_PART_NUMBER_MCXW70ACMFT
	bool

config SOC_PART_NUMBER_MCXW70AAMFT
	bool

config SOC_PART_NUMBER_MCXW70ADMFT
	bool

config SOC_PART_NUMBER_MCXW716CMFTA
	bool

config SOC_PART_NUMBER_MCXW716CMFPA
	bool

config SOC_PART_NUMBER_MCXW716AMFTA
	bool

config SOC_PART_NUMBER_MCXW716AMFPA
	bool

config SOC_PART_NUMBER_MCXW727CMFTA
	bool

config SOC_PART_NUMBER
	default "MCXW70ACMFT"  if SOC_PART_NUMBER_MCXW70ACMFT
	default "MCXW70AAMFT"  if SOC_PART_NUMBER_MCXW70AAMFT
	default "MCXW70ADMFT"  if SOC_PART_NUMBER_MCXW70ADMFT
	default "MCXW716CMFTA" if SOC_PART_NUMBER_MCXW716CMFTA
	default "MCXW716CMFPA" if SOC_PART_NUMBER_MCXW716CMFPA
	default "MCXW716AMFTA" if SOC_PART_NUMBER_MCXW716AMFTA
	default "MCXW716AMFPA" if SOC_PART_NUMBER_MCXW716AMFPA
	default "MCXW727CMFTA" if SOC_PART_NUMBER_MCXW727CMFTA
```

## soc/nxp/rw/Kconfig
```kconfig
# Copyright 2022-2024, 2026 NXP
# SPDX-License-Identifier: Apache-2.0

config SOC_SERIES_RW6XX
	select ARM
	select CPU_CORTEX_M33
	select CPU_CORTEX_M_HAS_DWT
	select CLOCK_CONTROL
	select SOC_RESET_HOOK
	select CPU_HAS_ARM_SAU
	select CPU_HAS_ARM_MPU
	select CPU_HAS_FPU
	select ARM_TRUSTZONE_M
	select CPU_CORTEX_M_HAS_SYSTICK
	select HAS_MCUX
	select HAS_MCUX_CACHE
	select HAS_MCUX_ELS_PKC
	select HAS_PM
	select PM_STATE_SET_IRQ_UNLOCKED if !MULTITHREADING
	select HAS_NXP_MONOLITHIC_NBU
	select SOC_EARLY_INIT_HOOK
	select HAS_SEGGER_RTT if ZEPHYR_SEGGER_MODULE
	select DSP_POWERQUAD_ADDR_REMAP if DSP_BACKEND_POWERQUAD

if SOC_SERIES_RW6XX

config SOC_SERIES_RW6XX_T3_CAU_POWER_SAVE
	bool "T3 clock shutdown and CAU sleep power saving"
	depends on PM && !ADC_MCUX_GAU && !DAC_MCUX_GAU && !COMPARATOR_NXP_ACOMP && \
		!ENTROPY_NXP_ELS_TRNG && !MCUX_ELS_PKC && \
		!I2C_MCUX_FLEXCOMM && !SPI_MCUX_FLEXCOMM && \
		!COUNTER_MCUX_CTIMER && !PWM_MCUX_CTIMER && !CLOCK_MONITOR_NXP_FMEAS
	help
	  Disable T3 clocks at the end of SoC clock initialization on boot and
	  PM3 wakeup. DTRNG, GDET and peripherals requiring T3 clocks cannot be used with this
	  option. Flexcomm I2C/SPI, CTIMER, ELS/PKC and clock monitoring must be
	  disabled because their clock paths can use T3. Power down CAU in
	  sleep when CLK32K uses RC32K or XTAL32K;
	  retain CAU when CLK32K uses its NCO. This option is disabled by default.

menuconfig NXP_RW6XX_BOOT_HEADER
	bool "Create boot header"
	default y if !BOOTLOADER_MCUBOOT
	help
	  Create data structures required by the boot ROM to boot the
	  application from an external flash device.

if NXP_RW6XX_BOOT_HEADER

rsource "../common/Kconfig.rom_loader"

config FLASH_CONFIG_OFFSET
	hex "Flash config data offset"
	default 0x400
	help
	  The flash config offset provides the boot ROM with the on-board
	  flash type and parameters. The boot ROM requires a fixed flash config
	  offset for FlexSPI device.

config IMAGE_VECTOR_TABLE_OFFSET
	hex "Image vector table offset"
	default 0x1000
	help
	  The Image Vector Table (IVT) provides the boot ROM with pointers to
	  the application entry point and device configuration data. The boot
	  ROM requires a fixed IVT offset for each type of boot device.

endif # NXP_RW6XX_BOOT_HEADER

rsource "../common/Kconfig.flexspi_xip"
rsource "../common/Kconfig.nbu"

endif # SOC_SERIES_RW6XX
```

## soc/openhwgroup/erbium/Kconfig.defconfig
```kconfig
# Copyright (c) 2026 AIFoundry
# SPDX-License-Identifier: Apache-2.0

if SOC_ERBIUM

configdefault 2ND_LVL_ISR_TBL_OFFSET
	default 12

configdefault 2ND_LVL_INTR_00_OFFSET
	default 11

configdefault MAX_IRQ_PER_AGGREGATOR
	default 32

configdefault NUM_IRQS
	default 44

# Erbium requires mtvec/stvec to be 4KB aligned.
configdefault RISCV_TRAP_HANDLER_ALIGNMENT
	default 4096

endif
```

## soc/puya/py32/Kconfig
```kconfig
# SPDX-FileCopyrightText: Copyright The Zephyr Project Contributors
# SPDX-License-Identifier: Apache-2.0

config SOC_FAMILY_PY32
	select BUILD_OUTPUT_HEX
	select HAS_CMSIS_CORE

if SOC_FAMILY_PY32

rsource "*/Kconfig"

endif # SOC_FAMILY_PY32
```

## soc/puya/py32/Kconfig.defconfig
```kconfig
# Copyright (c) 2017, I-SENSE group of ICCS
# SPDX-License-Identifier: Apache-2.0

if SOC_FAMILY_PY32

configdefault CLOCK_CONTROL
	default y

configdefault NUM_IRQS
	default 32

configdefault SYS_CLOCK_HW_CYCLES_PER_SEC
	default $(dt_nodelabel_int_prop,rcc,clock-frequency)

configdefault SYS_CLOCK_TICKS_PER_SEC
	default 8000

configdefault CLOCK_CONTROL_INIT_PRIORITY
	default 1 if CLOCK_CONTROL

endif # SOC_FAMILY_PY32
```

## soc/puya/py32/Kconfig.soc
```kconfig
# Puya PY32 MCU family

# Copyright (c) 2016 Open-RnD Sp. z o.o.
# SPDX-License-Identifier: Apache-2.0

config SOC_FAMILY_PY32
	bool

config SOC_FAMILY
	default "py32" if SOC_FAMILY_PY32

rsource "*/Kconfig.soc"
```

## soc/puya/py32/py32f0x/Kconfig
```kconfig
# Puya PY32F0 MCU series

# Copyright (c) 2017 RnDity Sp. z o.o.
# SPDX-License-Identifier: Apache-2.0

config SOC_SERIES_PY32F0X
	select ARM
	select CPU_CORTEX_M0PLUS
	select CPU_CORTEX_M_HAS_VTOR
	select CPU_CORTEX_M_HAS_SYSTICK
	select HAS_STM32CUBE_PUYA
	select SOC_EARLY_INIT_HOOK
```

## soc/puya/py32/py32f0x/Kconfig.soc
```kconfig
# Puya PY32F0 MCU series

# Copyright (c) 2017 RnDity Sp. z o.o.
# SPDX-License-Identifier: Apache-2.0

config SOC_SERIES_PY32F0X
	bool
	select SOC_FAMILY_PY32

config SOC_SERIES
	default "py32f0x" if SOC_SERIES_PY32F0X

config SOC_PY32F003X6
	bool
	select SOC_SERIES_PY32F0X

config SOC_PY32F030X4
	bool
	select SOC_SERIES_PY32F0X

config SOC_PY32F030X6
	bool
	select SOC_SERIES_PY32F0X

config SOC_PY32F030X8
	bool
	select SOC_SERIES_PY32F0X

config SOC
	default "py32f003x6" if SOC_PY32F003X6
	default "py32f030x4" if SOC_PY32F030X4
	default "py32f030x6" if SOC_PY32F030X6
	default "py32f030x8" if SOC_PY32F030X8
```

## soc/qemu/tricore/Kconfig
```kconfig
# SPDX-FileCopyrightText: Copyright (c) 2026 Infineon Technologies AG,
# SPDX-FileCopyrightText: or an affiliate of Infineon Technologies AG. All rights reserved.
# SPDX-FileCopyrightText: Copyright (c) 2026 Linumiz
#
# SPDX-License-Identifier: Apache-2.0

config SOC_SERIES_TC3X
	select TRICORE
	select CPU_TC162
	select AURIX_IR

config SOC_SERIES_TC4X
	select TRICORE
	select CPU_TC18
	select AURIX_IR
	select CPU_HAS_FPU
	select CPU_HAS_FPU_DOUBLE_PRECISION
	select CPU_HAS_TRICORE_VIRTUALIZATION
	imply FPU

config SOC_QEMU_TC3X
	select SOC_SERIES_TC3X

config SOC_QEMU_TC4X
	select SOC_SERIES_TC4X
```

## soc/qemu/tricore/Kconfig.defconfig
```kconfig
# SPDX-FileCopyrightText: Copyright (c) 2026 Infineon Technologies AG,
# SPDX-FileCopyrightText: or an affiliate of Infineon Technologies AG. All rights reserved.
# SPDX-FileCopyrightText: Copyright (c) 2026 Linumiz
#
# SPDX-License-Identifier: Apache-2.0

if SOC_SERIES_TC3X

config NUM_IRQS
	default 256

endif

if SOC_SERIES_TC4X

config NUM_IRQS
	default 16

endif

if SOC_QEMU_TC3X || SOC_QEMU_TC4X

config SYS_CLOCK_HW_CYCLES_PER_SEC
	default $(dt_node_int_prop_int,/clocks/fstm,clock-frequency)

config BUILD_OUTPUT_HEX
	default y

config TRICORE_CSA_COUNT
	default 384

endif
```

## soc/qemu/tricore/Kconfig.soc
```kconfig
# SPDX-FileCopyrightText: Copyright (c) 2026 Infineon Technologies AG,
# SPDX-FileCopyrightText: or an affiliate of Infineon Technologies AG. All rights reserved.
# SPDX-FileCopyrightText: Copyright (c) 2026 Linumiz
#
# SPDX-License-Identifier: Apache-2.0

config SOC_FAMILY_AURIX
	bool

config SOC_FAMILY
	default "aurix" if SOC_FAMILY_AURIX

config SOC_SERIES_TC3X
	bool
	select SOC_FAMILY_AURIX

config SOC_SERIES_TC4X
	bool
	select SOC_FAMILY_AURIX

config SOC_SERIES
	default "tc3x" if SOC_SERIES_TC3X
	default "tc4x" if SOC_SERIES_TC4X

config SOC_QEMU_TC3X
	bool

config SOC_QEMU_TC4X
	bool

config SOC
	default "qemu_tc3x" if SOC_QEMU_TC3X
	default "qemu_tc4x" if SOC_QEMU_TC4X
```
