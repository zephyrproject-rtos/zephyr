## soc/nxp/lpc/lpc84x/Kconfig.soc
```kconfig
# Copyright (c) 2026 Aerlync Labs Inc.
# SPDX-License-Identifier: Apache-2.0

config SOC_SERIES_LPC84X
	bool
	select SOC_FAMILY_LPC

config SOC_SERIES
	default "lpc84x" if SOC_SERIES_LPC84X

config SOC_LPC845
	bool
	select SOC_SERIES_LPC84X

config SOC_PART_NUMBER_LPC845M301JBD48
	bool

config SOC_PART_NUMBER_LPC845M301JBD64
	bool

config SOC_PART_NUMBER_LPC845M301JHI33
	bool

config SOC_PART_NUMBER_LPC845M301JHI48
	bool

config SOC_PART_NUMBER
	default "LPC845M301JBD48" if SOC_PART_NUMBER_LPC845M301JBD48
	default "LPC845M301JBD64" if SOC_PART_NUMBER_LPC845M301JBD64
	default "LPC845M301JHI33" if SOC_PART_NUMBER_LPC845M301JHI33
	default "LPC845M301JHI48" if SOC_PART_NUMBER_LPC845M301JHI48

config SOC
	default "lpc845" if SOC_LPC845
```

## soc/nxp/mcx/mcxa/Kconfig
```kconfig
# Copyright 2024-2026 NXP
# SPDX-License-Identifier: Apache-2.0

config SOC_FAMILY_MCXA
	select HAS_SEGGER_RTT if ZEPHYR_SEGGER_MODULE
	select CLOCK_CONTROL
	select ARM
	select HAS_MCUX
	select CPU_CORTEX_M_HAS_SYSTICK
	select CPU_CORTEX_M_HAS_DWT
	select SOC_RESET_HOOK
	select CPU_HAS_ICACHE
	select HAS_MCUX_SYSCON_LPCAC

config SOC_SERIES_MCXA1X3
	select CPU_CORTEX_M33
	select SOC_MCXA_EARLY_SRAM_ECC_INIT
	select HAS_PM
	select WUC if PM
	select HAS_POWEROFF

config SOC_SERIES_MCXA1X6
	select CPU_CORTEX_M33
	select SOC_MCXA_EARLY_SRAM_ECC_INIT
	select CPU_HAS_FPU
	select ARMV8_M_DSP
	select HAS_PM
	select WUC if PM
	select HAS_POWEROFF

config SOC_SERIES_MCXAXX6
	select CPU_CORTEX_M33
	select SOC_MCXA_EARLY_SRAM_ECC_INIT
	select CPU_HAS_ARM_MPU
	select CPU_HAS_FPU
	select ARMV8_M_DSP
	select HAS_PM
	select WUC if PM
	select HAS_POWEROFF

config SOC_SERIES_MCXAXX4
	select CPU_CORTEX_M33
	select SOC_MCXA_EARLY_SRAM_ECC_INIT
	select CPU_HAS_ARM_MPU
	select CPU_HAS_FPU
	select ARMV8_M_DSP
	select HAS_PM
	select WUC if PM
	select HAS_POWEROFF

config SOC_SERIES_MCXAXX7
	select CPU_CORTEX_M33
	select CPU_HAS_ARM_SAU
	select CPU_HAS_ARM_MPU
	select CPU_HAS_FPU
	select ARMV8_M_DSP
	select ARM_TRUSTZONE_M
	select HAS_PM
	select WUC if PM
	select HAS_POWEROFF

config SOC_MCXA_EARLY_SRAM_ECC_INIT
	bool
	select SOC_EARLY_RESET_HOOK

# Parts within the MCXA family that integrate the SGI PKC crypto accelerator.
config SOC_MCXA266
	select HAS_MCUX_SGI_PKC

config SOC_MCXA366
	select HAS_MCUX_SGI_PKC

config SOC_MCXA577
	select HAS_MCUX_SGI_PKC

if SOC_FAMILY_MCXA

config SOC_FAMILY_MCXA_DEBUG_IN_LOW_POWER
	bool "Keep the debug logic enabled in low power modes"
	depends on PM
	help
	  Leave the debug logic operational while the core is in a low power
	  mode (CMC DBGCTL[SOD] cleared) so that a debug probe keeps its
	  connection across suspend and resume, at the cost of a higher low
	  power current.

	  Say n to shut the debug logic off on low power entry. A suspended
	  target can then no longer be halted, inspected or reflashed without
	  a reset.

	  Power modes that gate the whole core power domain, such as Deep Power
	  Down, lose the debug logic regardless of this option.

endif # SOC_FAMILY_MCXA
```

## soc/nxp/mcx/mcxa/Kconfig.soc
```kconfig
# Copyright 2024-2026 NXP
# SPDX-License-Identifier: Apache-2.0

config SOC_FAMILY_MCXA
	bool

config SOC_FAMILY
	default "mcxa" if SOC_FAMILY_MCXA

config SOC_SERIES_MCXA1X3
	bool
	select SOC_FAMILY_MCXA

config SOC_SERIES_MCXA1X6
	bool
	select SOC_FAMILY_MCXA

config SOC_SERIES_MCXAXX6
	bool
	select SOC_FAMILY_MCXA

config SOC_SERIES_MCXAXX4
	bool
	select SOC_FAMILY_MCXA

config SOC_SERIES_MCXAXX7
	bool
	select SOC_FAMILY_MCXA

config SOC_SERIES
	default "mcxa1x3" if SOC_SERIES_MCXA1X3
	default "mcxa1x6" if SOC_SERIES_MCXA1X6
	default "mcxaxx6" if SOC_SERIES_MCXAXX6
	default "mcxaxx4" if SOC_SERIES_MCXAXX4
	default "mcxaxx7" if SOC_SERIES_MCXAXX7

config SOC_MCXA153
	bool
	select SOC_SERIES_MCXA1X3

config SOC_MCXA156
	bool
	select SOC_SERIES_MCXA1X6

config SOC_MCXA346
	bool
	select SOC_SERIES_MCXAXX6

config SOC_MCXA266
	bool
	select SOC_SERIES_MCXAXX6

config SOC_MCXA366
	bool
	select SOC_SERIES_MCXAXX6

config SOC_MCXA537
	bool
	select SOC_SERIES_MCXAXX7

config SOC_MCXA536
	bool
	select SOC_SERIES_MCXAXX7

config SOC_MCXA557
	bool
	select SOC_SERIES_MCXAXX7

config SOC_MCXA556
	bool
	select SOC_SERIES_MCXAXX7

config SOC_MCXA567
	bool
	select SOC_SERIES_MCXAXX7

config SOC_MCXA566
	bool
	select SOC_SERIES_MCXAXX7

config SOC_MCXA577
	bool
	select SOC_SERIES_MCXAXX7

config SOC_MCXA457
	bool
	select SOC_SERIES_MCXAXX7

config SOC_MCXA456
	bool
	select SOC_SERIES_MCXAXX7

config SOC_MCXA287
	bool
	select SOC_SERIES_MCXAXX7

config SOC_MCXA286
	bool
	select SOC_SERIES_MCXAXX7

config SOC_MCXA344
	bool
	select SOC_SERIES_MCXAXX4

config SOC
	default "mcxa153" if SOC_MCXA153
	default "mcxa156" if SOC_MCXA156
	default "mcxa346" if SOC_MCXA346
	default "mcxa266" if SOC_MCXA266
	default "mcxa366" if SOC_MCXA366
	default "mcxa344" if SOC_MCXA344
	default "mcxa537" if SOC_MCXA537
	default "mcxa536" if SOC_MCXA536
	default "mcxa557" if SOC_MCXA557
	default "mcxa556" if SOC_MCXA556
	default "mcxa567" if SOC_MCXA567
	default "mcxa566" if SOC_MCXA566
	default "mcxa577" if SOC_MCXA577
	default "mcxa457" if SOC_MCXA457
	default "mcxa456" if SOC_MCXA456
	default "mcxa287" if SOC_MCXA287
	default "mcxa286" if SOC_MCXA286

config SOC_PART_NUMBER_MCXA153VFM
	bool

config SOC_PART_NUMBER_MCXA153VFT
	bool

config SOC_PART_NUMBER_MCXA153VLF
	bool

config SOC_PART_NUMBER_MCXA153VLH
	bool

config SOC_PART_NUMBER_MCXA156VPJ
	bool

config SOC_PART_NUMBER_MCXA156VLL
	bool

config SOC_PART_NUMBER_MCXA156VMP
	bool

config SOC_PART_NUMBER_MCXA156VFT
	bool

config SOC_PART_NUMBER_MCXA156VLH
	bool

config SOC_PART_NUMBER_MCXA346VLQ
	bool

config SOC_PART_NUMBER_MCXA346VLL
	bool

config SOC_PART_NUMBER_MCXA346VLH
	bool

config SOC_PART_NUMBER_MCXA346VPN
	bool

config SOC_PART_NUMBER_MCXA266VLQ
	bool

config SOC_PART_NUMBER_MCXA266VLL
	bool

config SOC_PART_NUMBER_MCXA266VLH
	bool

config SOC_PART_NUMBER_MCXA266VPN
	bool

config SOC_PART_NUMBER_MCXA366VLQ
	bool

config SOC_PART_NUMBER_MCXA366VLL
	bool

config SOC_PART_NUMBER_MCXA366VLH
	bool

config SOC_PART_NUMBER_MCXA366VPN
	bool

config SOC_PART_NUMBER_MCXA344VFM
	bool

config SOC_PART_NUMBER_MCXA344VLF
	bool

config SOC_PART_NUMBER_MCXA344VLH
	bool

config SOC_PART_NUMBER_MCXA344VLL
	bool

config SOC_PART_NUMBER_MCXA577VLQ
	bool

config SOC_PART_NUMBER_MCXA537VLQ
	bool

config SOC_PART_NUMBER_MCXA537VLL
	bool

config SOC_PART_NUMBER_MCXA537VPN
	bool

config SOC_PART_NUMBER_MCXA536VLQ
	bool

config SOC_PART_NUMBER_MCXA536VLL
	bool

config SOC_PART_NUMBER_MCXA536VPN
	bool

config SOC_PART_NUMBER_MCXA567VLQ
	bool

config SOC_PART_NUMBER_MCXA567VLL
	bool

config SOC_PART_NUMBER_MCXA567VPN
	bool

config SOC_PART_NUMBER_MCXA567VASR
	bool

config SOC_PART_NUMBER_MCXA567VAPR
	bool

config SOC_PART_NUMBER_MCXA566VLQ
	bool

config SOC_PART_NUMBER_MCXA566VLL
	bool

config SOC_PART_NUMBER_MCXA566VPN
	bool

config SOC_PART_NUMBER_MCXA557VPN
	bool

config SOC_PART_NUMBER_MCXA557BVPN
	bool

config SOC_PART_NUMBER_MCXA556VPN
	bool

config SOC_PART_NUMBER_MCXA556BVPN
	bool

config SOC_PART_NUMBER_MCXA577VLL
	bool

config SOC_PART_NUMBER_MCXA577VPN
	bool

config SOC_PART_NUMBER_MCXA577VASR
	bool

config SOC_PART_NUMBER_MCXA577VAPR
	bool

config SOC_PART_NUMBER_MCXA457VLQ
	bool

config SOC_PART_NUMBER_MCXA457VLL
	bool

config SOC_PART_NUMBER_MCXA457VPN
	bool

config SOC_PART_NUMBER_MCXA457VASR
	bool

config SOC_PART_NUMBER_MCXA456VLQ
	bool

config SOC_PART_NUMBER_MCXA456VLL
	bool

config SOC_PART_NUMBER_MCXA456VPN
	bool

config SOC_PART_NUMBER_MCXA287VLQ
	bool

config SOC_PART_NUMBER_MCXA287VLL
	bool

config SOC_PART_NUMBER_MCXA287VPN
	bool

config SOC_PART_NUMBER_MCXA287VASR
	bool

config SOC_PART_NUMBER_MCXA287VAPR
	bool

config SOC_PART_NUMBER_MCXA286VLQ
	bool

config SOC_PART_NUMBER_MCXA286VLL
	bool

config SOC_PART_NUMBER_MCXA286VPN
	bool

config SOC_PART_NUMBER_MCXA286VASR
	bool

config SOC_PART_NUMBER_MCXA286VAPR
	bool

config SOC_PART_NUMBER
	default "MCXA153VFM" if SOC_PART_NUMBER_MCXA153VFM
	default "MCXA153VFT" if SOC_PART_NUMBER_MCXA153VFT
	default "MCXA153VLF" if SOC_PART_NUMBER_MCXA153VLF
	default "MCXA153VLH" if SOC_PART_NUMBER_MCXA153VLH
	default "MCXA156VPJ" if SOC_PART_NUMBER_MCXA156VPJ
	default "MCXA156VLL" if SOC_PART_NUMBER_MCXA156VLL
	default "MCXA156VMP" if SOC_PART_NUMBER_MCXA156VMP
	default "MCXA156VFT" if SOC_PART_NUMBER_MCXA156VFT
	default "MCXA156VLH" if SOC_PART_NUMBER_MCXA156VLH
	default "MCXA346VLQ" if SOC_PART_NUMBER_MCXA346VLQ
	default "MCXA346VLL" if SOC_PART_NUMBER_MCXA346VLL
	default "MCXA346VLH" if SOC_PART_NUMBER_MCXA346VLH
	default "MCXA346VPN" if SOC_PART_NUMBER_MCXA346VPN
	default "MCXA266VLQ" if SOC_PART_NUMBER_MCXA266VLQ
	default "MCXA266VLL" if SOC_PART_NUMBER_MCXA266VLL
	default "MCXA266VLH" if SOC_PART_NUMBER_MCXA266VLH
	default "MCXA266VPN" if SOC_PART_NUMBER_MCXA266VPN
	default "MCXA366VLQ" if SOC_PART_NUMBER_MCXA366VLQ
	default "MCXA366VLL" if SOC_PART_NUMBER_MCXA366VLL
	default "MCXA366VLH" if SOC_PART_NUMBER_MCXA366VLH
	default "MCXA366VPN" if SOC_PART_NUMBER_MCXA366VPN
	default "MCXA537VLQ" if SOC_PART_NUMBER_MCXA537VLQ
	default "MCXA537VLL" if SOC_PART_NUMBER_MCXA537VLL
	default "MCXA537VPN" if SOC_PART_NUMBER_MCXA537VPN
	default "MCXA536VLQ" if SOC_PART_NUMBER_MCXA536VLQ
	default "MCXA536VLL" if SOC_PART_NUMBER_MCXA536VLL
	default "MCXA536VPN" if SOC_PART_NUMBER_MCXA536VPN
	default "MCXA567VLQ" if SOC_PART_NUMBER_MCXA567VLQ
	default "MCXA567VLL" if SOC_PART_NUMBER_MCXA567VLL
	default "MCXA567VPN" if SOC_PART_NUMBER_MCXA567VPN
	default "MCXA567VASR" if SOC_PART_NUMBER_MCXA567VASR
	default "MCXA567VAPR" if SOC_PART_NUMBER_MCXA567VAPR
	default "MCXA566VLQ" if SOC_PART_NUMBER_MCXA566VLQ
	default "MCXA566VLL" if SOC_PART_NUMBER_MCXA566VLL
	default "MCXA566VPN" if SOC_PART_NUMBER_MCXA566VPN
	default "MCXA557VPN" if SOC_PART_NUMBER_MCXA557VPN
	default "MCXA557BVPN" if SOC_PART_NUMBER_MCXA557BVPN
	default "MCXA556VPN" if SOC_PART_NUMBER_MCXA556VPN
	default "MCXA556BVPN" if SOC_PART_NUMBER_MCXA556BVPN
	default "MCXA577VLL" if SOC_PART_NUMBER_MCXA577VLL
	default "MCXA577VLQ" if SOC_PART_NUMBER_MCXA577VLQ
	default "MCXA577VPN" if SOC_PART_NUMBER_MCXA577VPN
	default "MCXA577VASR" if SOC_PART_NUMBER_MCXA577VASR
	default "MCXA577VAPR" if SOC_PART_NUMBER_MCXA577VAPR
	default "MCXA457VLQ" if SOC_PART_NUMBER_MCXA457VLQ
	default "MCXA457VLL" if SOC_PART_NUMBER_MCXA457VLL
	default "MCXA457VPN" if SOC_PART_NUMBER_MCXA457VPN
	default "MCXA457VASR" if SOC_PART_NUMBER_MCXA457VASR
	default "MCXA456VLQ" if SOC_PART_NUMBER_MCXA456VLQ
	default "MCXA456VLL" if SOC_PART_NUMBER_MCXA456VLL
	default "MCXA456VPN" if SOC_PART_NUMBER_MCXA456VPN
	default "MCXA287VLQ" if SOC_PART_NUMBER_MCXA287VLQ
	default "MCXA287VLL" if SOC_PART_NUMBER_MCXA287VLL
	default "MCXA287VPN" if SOC_PART_NUMBER_MCXA287VPN
	default "MCXA287VASR" if SOC_PART_NUMBER_MCXA287VASR
	default "MCXA287VAPR" if SOC_PART_NUMBER_MCXA287VAPR
	default "MCXA286VLQ" if SOC_PART_NUMBER_MCXA286VLQ
	default "MCXA286VLL" if SOC_PART_NUMBER_MCXA286VLL
	default "MCXA286VPN" if SOC_PART_NUMBER_MCXA286VPN
	default "MCXA286VASR" if SOC_PART_NUMBER_MCXA286VASR
	default "MCXA286VAPR" if SOC_PART_NUMBER_MCXA286VAPR
	default "MCXA344VFM" if SOC_PART_NUMBER_MCXA344VFM
	default "MCXA344VLF" if SOC_PART_NUMBER_MCXA344VLF
	default "MCXA344VLH" if SOC_PART_NUMBER_MCXA344VLH
	default "MCXA344VLL" if SOC_PART_NUMBER_MCXA344VLL
```

## soc/nxp/mcx/mcxe/Kconfig
```kconfig
# Copyright 2025-2026 NXP
# SPDX-License-Identifier: Apache-2.0

config SOC_FAMILY_MCXE
	select HAS_SEGGER_RTT if ZEPHYR_SEGGER_MODULE

if SOC_FAMILY_MCXE

rsource "*/Kconfig"

endif # SOC_FAMILY_MCXE
```

## soc/nxp/mcx/mcxe/mcxe32x/Kconfig
```kconfig
# Copyright 2026 NXP
# SPDX-License-Identifier: Apache-2.0

config SOC_SERIES_MCXE32X
	select CPU_CORTEX_M7
	select CPU_CORTEX_M_HAS_DWT
	select CPU_HAS_FPU
	select CPU_HAS_ARM_MPU
	select ARM
	select HAS_MCUX
	select CPU_HAS_ICACHE
	select CPU_HAS_DCACHE
	select SOC_EARLY_RESET_HOOK
	select CODE_DATA_RELOCATION
	select SPI_NXP_LPSPI_ERR050456 if SPI_NXP_LPSPI

config SOC_MCXE32B_CPU0
	select CLOCK_CONTROL
	select SOC_EARLY_INIT_HOOK
	select SOC_LATE_INIT_HOOK
	select HAS_POWEROFF

if SOC_SERIES_MCXE32X

config MCUX_CORE_SUFFIX
	default "_core0" if SOC_MCXE32B_CPU0
	default "_core1" if SOC_MCXE32B_CPU1

if CODE_DATA_RELOCATION

config SRAM_CONFIG_RELOCATE_MEM
	string
	default "ITCM"
	help
	  Select memory to relocate sram_config.c code

endif # CODE_DATA_RELOCATION

config SOC_NXP_MCXE32X_BOOT_HEADER
	bool
	help
	  Enable boot header configuration for NXP MCXE32X SoC.
	  This should be selected by boards that need boot header support.

if SOC_NXP_MCXE32X_BOOT_HEADER

config BOOT_HEADER_OFFSET
	hex "Flash config data offset"
	default 0x0

config IMAGE_VECTOR_TABLE_OFFSET
	hex "Image vector table offset"
	default 0x1000

endif # SOC_NXP_MCXE32X_BOOT_HEADER

endif # SOC_SERIES_MCXE32X
```

## soc/nxp/mcx/mcxe/mcxe32x/Kconfig.defconfig
```kconfig
# Copyright 2026 NXP
# SPDX-License-Identifier: Apache-2.0

if SOC_SERIES_MCXE32X

config NUM_IRQS
	default 240

config SYS_CLOCK_HW_CYCLES_PER_SEC
	default $(dt_node_int_prop_int,/cpus/cpu@0,clock-frequency) if CORTEX_M_SYSTICK && SOC_MCXE32B_CPU0
	default $(dt_node_int_prop_int,/cpus/cpu@1,clock-frequency) if CORTEX_M_SYSTICK && SOC_MCXE32B_CPU1

config SYS_CLOCK_TICKS_PER_SEC
	default 1000 if MCUX_RTC_JDP_TIMER

config CORTEX_M_SYSTICK
	default n if (MCUX_LPTMR_TIMER || MCUX_OS_TIMER || MCUX_STM_TIMER || MCUX_RTC_JDP_TIMER)

config ROM_START_OFFSET
	default 0x1000

config I2S_HAS_PLL_SETTING
	default n

endif # SOC_SERIES_MCXE32X
```

## soc/nxp/mcx/mcxe/mcxe32x/Kconfig.soc
```kconfig
# Copyright 2026 NXP
# SPDX-License-Identifier: Apache-2.0

config SOC_SERIES_MCXE32X
	bool
	select SOC_FAMILY_MCXE

config SOC_SERIES
	default "mcxe32x" if SOC_SERIES_MCXE32X

config SOC_MCXE32B_CPU0
	bool
	select SOC_SERIES_MCXE32X

config SOC_MCXE32B_CPU1
	bool
	select SOC_SERIES_MCXE32X

config SOC
	default "mcxe32b" if SOC_MCXE32B_CPU0 || SOC_MCXE32B_CPU1

config SOC_PART_NUMBER_MCXE32BMPB
	bool
	select SOC_MCXE32B_CPU0 if BOARD_FRDM_MCXE32B_MCXE32B_CPU0
	select SOC_MCXE32B_CPU1 if BOARD_FRDM_MCXE32B_MCXE32B_CPU1

config SOC_PART_NUMBER
	default "MCXE32BMPB" if SOC_PART_NUMBER_MCXE32BMPB
```
