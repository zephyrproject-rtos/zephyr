## soc/espressif/esp32s31/Kconfig.mac
```kconfig
# Copyright (c) 2026 Espressif Systems (Shanghai) Co., Ltd.
# SPDX-License-Identifier: Apache-2.0

if SOC_SERIES_ESP32S31

choice ESP32S31_UNIVERSAL_MAC_ADDRESSES
	bool "Number of universally administered (by IEEE) MAC address"
	default ESP32S31_UNIVERSAL_MAC_ADDRESSES_TWO
	help
	  Configure the number of universally administered (by IEEE) MAC addresses.
	  During initialization, MAC addresses for each network interface are generated or
	  derived from a single base MAC address.
	  If the number of universal MAC addresses is four, all four interfaces (Wi-Fi station,
	  Wi-Fi softap, Bluetooth and Ethernet) receive a universally administered MAC address.
	  These are generated sequentially by adding 0, 1, 2 and 3 (respectively) to the final
	  octet of the base MAC address.
	  If the number of universal MAC addresses is two, only two interfaces (Wi-Fi station
	  and Bluetooth) receive a universally administered MAC address. These are generated
	  sequentially by adding 0 and 1 (respectively) to the base MAC address. The remaining
	  interfaces receive local MAC addresses derived from the universal ones.
	  The ESP32-S31 eFuse provides two universally administered MAC addresses, so two is
	  the default. Four is only for a custom universal MAC address range that allocates
	  four addresses per device.

config ESP32S31_UNIVERSAL_MAC_ADDRESSES_TWO
	bool "Two"
	select ESP_MAC_UNIVERSAL_MAC_ADDRESSES_TWO
	select ESP_MAC_ADDR_UNIVERSE_WIFI_STA
	select ESP_MAC_ADDR_UNIVERSE_BT

config ESP32S31_UNIVERSAL_MAC_ADDRESSES_FOUR
	bool "Four"
	select ESP_MAC_UNIVERSAL_MAC_ADDRESSES_FOUR
	select ESP_MAC_ADDR_UNIVERSE_WIFI_STA
	select ESP_MAC_ADDR_UNIVERSE_WIFI_AP
	select ESP_MAC_ADDR_UNIVERSE_BT
	select ESP_MAC_ADDR_UNIVERSE_ETH

endchoice # ESP32S31_UNIVERSAL_MAC_ADDRESSES

config ESP32S31_UNIVERSAL_MAC_ADDRESSES
	int
	default 2 if ESP32S31_UNIVERSAL_MAC_ADDRESSES_TWO
	default 4 if ESP32S31_UNIVERSAL_MAC_ADDRESSES_FOUR

endif # SOC_SERIES_ESP32S31
```

## soc/gd/gd32/gd32f527/Kconfig
```kconfig
# Copyright (c) 2026 GigaDevice Semiconductor Inc.
# SPDX-License-Identifier: Apache-2.0

config SOC_SERIES_GD32F527
	select ARM
	select CPU_HAS_ARM_MPU
	select CPU_HAS_FPU
	select ARMV8_M_DSP
	select CPU_CORTEX_M33
	select CPU_CORTEX_M_HAS_SYSTICK
	select CPU_CORTEX_M_HAS_VTOR
	select GD32_HAS_AF_PINMUX
	select GD32_HAS_IRC_32K
	select SOC_RESET_HOOK
	select SOC_EARLY_INIT_HOOK
```

## soc/gd/gd32/gd32f527/Kconfig.defconfig.gd32f527
```kconfig
# Copyright (c) 2026 GigaDevice Semiconductor Inc.
# SPDX-License-Identifier: Apache-2.0

if SOC_GD32F527

configdefault SYS_CLOCK_HW_CYCLES_PER_SEC
	default $(dt_nodelabel_int_prop,rcu,clock-frequency)

configdefault NUM_IRQS
	default 104

endif # SOC_GD32F527
```

## soc/gd/gd32/gd32f527/Kconfig.defconfig.series
```kconfig
# Copyright (c) 2026 GigaDevice Semiconductor Inc.
# SPDX-License-Identifier: Apache-2.0

if SOC_SERIES_GD32F527

rsource "Kconfig.defconfig.gd32f527"

endif
```

## soc/gd/gd32/gd32f527/Kconfig.soc
```kconfig
# Copyright (c) 2026 GigaDevice Semiconductor Inc.
# SPDX-License-Identifier: Apache-2.0

config SOC_SERIES_GD32F527
	bool
	select SOC_FAMILY_GD_GD32
	help
	  Enable support for GigaDevice GD32F527 MCU series

config SOC_SERIES
	default "gd32f527" if SOC_SERIES_GD32F527

config SOC_GD32F527
	bool
	select SOC_SERIES_GD32F527

config SOC
	default "gd32f527" if SOC_GD32F527
```

## soc/gd/gd32/gd32vf103/Kconfig.defconfig.gd32vf103
```kconfig
# Copyright (c) 2021 Tokita, Hiroshi <tokita.hiroshi@gmail.com>
# SPDX-License-Identifier: Apache-2.0

if SOC_GD32VF103

config KERNEL_ENTRY
	default "__nuclei_start"

config RISCV_MCAUSE_EXCEPTION_MASK
	default 0xFFF

config RISCV_SOC_INTERRUPT_INIT
	default y

config NUM_IRQS
	default 87 if  NUCLEI_ECLIC
	default 16 if !NUCLEI_ECLIC

config ARCH_IRQ_VECTOR_TABLE_ALIGN
	default 512 if NUCLEI_ECLIC

config RISCV_TRAP_HANDLER_ALIGNMENT
	default 64 if NUCLEI_ECLIC && !RISCV_VECTORED_MODE

endif # GD32VF103
```

## soc/hisilicon/Kconfig
```kconfig
# SPDX-FileCopyrightText: Copyright The Zephyr Project Contributors
# SPDX-License-Identifier: Apache-2.0

rsource "hi3861/Kconfig"
```
