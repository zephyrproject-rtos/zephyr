## soc/espressif/esp32c6/Kconfig
```kconfig
# Copyright (c) 2024 Espressif Systems (Shanghai) Co., Ltd.
# SPDX-License-Identifier: Apache-2.0

config SOC_SERIES_ESP32C6
	select RISCV
	select RISCV_SOC_HAS_GP_RELATIVE_ADDRESSING
	select RISCV_PMP if SOC_ESP32C6_HPCORE && !MCUBOOT
	select DYNAMIC_INTERRUPTS if SOC_ESP32C6_HPCORE
	select CLOCK_CONTROL if SOC_ESP32C6_HPCORE
	select PINCTRL if SOC_ESP32C6_HPCORE
	select HAS_ESPRESSIF_HAL
	select HAS_PM
	select HAS_POWEROFF

if SOC_SERIES_ESP32C6

rsource "Kconfig.caps"

endif # SOC_SERIES_ESP32C6
```

## soc/espressif/esp32c6/Kconfig.caps
```kconfig
# Copyright (c) 2026 Espressif Systems (Shanghai) Co., Ltd.
# SPDX-License-Identifier: Apache-2.0

config SOC_FAMILY_ESPRESSIF_PM_SUPPORT_CPU_PD
	bool
	default y

config SOC_FAMILY_ESPRESSIF_PM_SUPPORT_BEACON_WAKEUP
	bool
	default y

config SOC_FAMILY_ESPRESSIF_WIFI_HE_SUPPORT
	bool
	default y

config SOC_FAMILY_ESPRESSIF_PM_SUPPORT_TOP_PD
	bool
	default y

config SOC_FAMILY_ESPRESSIF_PAU_SUPPORTED
	bool
	default y

config SOC_FAMILY_ESPRESSIF_PM_CPU_RETENTION_BY_SW
	bool
	default y

config SOC_FAMILY_ESPRESSIF_ETM_SUPPORTED
	bool
	default y
```

## soc/espressif/esp32c61/Kconfig
```kconfig
# Copyright (c) 2026 Espressif Systems (Shanghai) Co., Ltd.
# SPDX-License-Identifier: Apache-2.0

config SOC_SERIES_ESP32C61
	select RISCV
	select RISCV_SOC_HAS_GP_RELATIVE_ADDRESSING
	select RISCV_PMP if !MCUBOOT
	select DYNAMIC_INTERRUPTS
	select CLOCK_CONTROL
	select PINCTRL
	select HAS_ESPRESSIF_HAL
	select CPU_HAS_DCACHE
	select HAS_PM
	select HAS_POWEROFF

if SOC_SERIES_ESP32C61

rsource "Kconfig.caps"

config SOC_ESP32C61_REV_MIN_FULL
	int
	default 100 if SOC_ESP32C61_REV_1_0
	default 101 if SOC_ESP32C61_REV_1_1
	default 100
	help
	  Minimum supported ESP32-C61 chip revision in major * 100 + minor
	  format, matching what efuse_hal_chip_revision() returns at runtime.
	  Derived from the SOC_ESP32C61_REV_* symbol the board selects;
	  defaults to v1.0 (100), the floor of the family.

endif # SOC_SERIES_ESP32C61
```

## soc/espressif/esp32c61/Kconfig.mac
```kconfig
# Copyright (c) 2026 Espressif Systems (Shanghai) Co., Ltd.
# SPDX-License-Identifier: Apache-2.0

if SOC_SERIES_ESP32C61

choice ESP32C61_UNIVERSAL_MAC_ADDRESSES
	bool "Number of universally administered (by IEEE) MAC address"
	default ESP32C61_UNIVERSAL_MAC_ADDRESSES_FOUR
	help
	  Configure the number of universally administered (by IEEE) MAC addresses.
	  During initialization, MAC addresses for each network interface are generated or
	  derived from a single base MAC address.
	  If the number of universal MAC addresses is four, all four interfaces (Wi-Fi station,
	  Wi-Fi softap, Bluetooth and Ethernet) receive a universally administered MAC address.
	  These are generated sequentially by adding 0, 1, 2 and 3 (respectively) to the final
	  octet of the base MAC address.
	  If the number of universal MAC addresses is two, only two interfaces (Wi-Fi station
	  and Bluetooth) receive a universally administered MAC address. These are generated
	  sequentially by adding 0 and 1 (respectively) to the base MAC address. The remaining
	  interfaces receive local MAC addresses derived from the universal ones.
	  When using the default (Espressif-assigned) base MAC address, either setting can be
	  used. When using a custom universal MAC address range, the correct setting will depend
	  on the allocation of MAC addresses in this range (either 2 or 4 per device.)
	  Note that ESP32-C61 has no integrated Ethernet MAC.

config ESP32C61_UNIVERSAL_MAC_ADDRESSES_TWO
	bool "Two"
	select ESP_MAC_UNIVERSAL_MAC_ADDRESSES_TWO
	select ESP_MAC_ADDR_UNIVERSE_WIFI_STA
	select ESP_MAC_ADDR_UNIVERSE_BT

config ESP32C61_UNIVERSAL_MAC_ADDRESSES_FOUR
	bool "Four"
	select ESP_MAC_UNIVERSAL_MAC_ADDRESSES_FOUR
	select ESP_MAC_ADDR_UNIVERSE_WIFI_STA
	select ESP_MAC_ADDR_UNIVERSE_WIFI_AP
	select ESP_MAC_ADDR_UNIVERSE_BT
	select ESP_MAC_ADDR_UNIVERSE_ETH

endchoice # ESP32C61_UNIVERSAL_MAC_ADDRESSES

config ESP32C61_UNIVERSAL_MAC_ADDRESSES
	int
	default 2 if ESP32C61_UNIVERSAL_MAC_ADDRESSES_TWO
	default 4 if ESP32C61_UNIVERSAL_MAC_ADDRESSES_FOUR

endif # SOC_SERIES_ESP32C61
```

## soc/espressif/esp32h2/Kconfig.caps
```kconfig
# Copyright (c) 2026 Espressif Systems (Shanghai) Co., Ltd.
# SPDX-License-Identifier: Apache-2.0

config SOC_ESP32_PM_SUPPORT_CPU_PD
	bool
	default y

config SOC_ESP32_PM_SUPPORT_TOP_PD
	bool
	default y

config SOC_ESP32_PAU_SUPPORTED
	bool
	default y

config SOC_ESP32_PM_CPU_RETENTION_BY_SW
	bool
	default y

config SOC_ESP32_FLASH_SUPPORTED
	bool
	default y

config SOC_ESP32_PM_SUPPORT_VDDSDIO_PD
	bool
	default y

config SOC_ESP32_ETM_SUPPORTED
	bool
	default y

config SOC_ESP32_FLASH_ENCRYPTION_XTS_AES
	bool
	default y

config SOC_ESP32_FLASH_ENCRYPTION_XTS_AES_128
	bool
	default y

config SOC_ESP32_EFUSE_XTS_AES_KEY_128
	bool
	default y

config SOC_ESP32_SUPPORTS_SECURE_DL_MODE
	bool
	default y

config SOC_ESP32_EFUSE_DIS_ICACHE
	bool
	default y

config SOC_ESP32_FLASH_ENCRYPTION_XTS_AES_SUPPORT_PSEUDO_ROUND
	bool
	default y
```

## soc/espressif/esp32h2/Kconfig.mac
```kconfig
# Copyright (c) 2025 Espressif Systems (Shanghai) Co., Ltd.
# SPDX-License-Identifier: Apache-2.0

if SOC_SERIES_ESP32H2

choice SOC_ESP32H2_UNIVERSAL_MAC_ADDRESSES
	bool "Number of universally administered (by IEEE) MAC address"
	default SOC_ESP32H2_UNIVERSAL_MAC_ADDRESSES_TWO
	help
	  Configure the number of universally administered (by IEEE) MAC addresses.
	  During initialization, MAC addresses for each network interface are generated
	  or derived from a single base MAC address.

config SOC_ESP32H2_UNIVERSAL_MAC_ADDRESSES_TWO
	bool "Two"
	select SOC_FAMILY_ESP32_MAC_ADDRESSES_TWO
	select SOC_FAMILY_ESP32_MAC_ADDR_UNIVERSE_IEEE802154
	select SOC_FAMILY_ESP32_MAC_ADDR_UNIVERSE_BT

endchoice # SOC_ESP32H2_UNIVERSAL_MAC_ADDRESSES

config SOC_ESP32H2_UNIVERSAL_MAC_ADDRESSES
	int
	default 2 if SOC_ESP32H2_UNIVERSAL_MAC_ADDRESSES_TWO

endif # SOC_SERIES_ESP32H2
```

## soc/espressif/esp32p4/Kconfig.caps
```kconfig
# Copyright (c) 2026 Espressif Systems (Shanghai) Co., Ltd.
# SPDX-License-Identifier: Apache-2.0

config SOC_FAMILY_ESPRESSIF_PM_SUPPORT_CPU_PD
	bool
	default y

config SOC_FAMILY_ESPRESSIF_PM_SUPPORT_TOP_PD
	bool
	default y

config SOC_FAMILY_ESPRESSIF_PAU_SUPPORTED
	bool
	default y

config SOC_FAMILY_ESPRESSIF_PM_CPU_RETENTION_BY_SW
	bool
	default y

config SOC_FAMILY_ESPRESSIF_PM_FLASH_KEEP_POWER_IN_LSLP
	bool
	default y if SOC_ESP32P4_REV_1_3

config SOC_FAMILY_ESPRESSIF_ETM_SUPPORTED
	bool
	default y

config SOC_FAMILY_ESPRESSIF_SPI_MEM_SUPPORT_TIMING_TUNING
	bool
	default y
```

## soc/espressif/esp32p4/Kconfig.mac
```kconfig
# Copyright (c) 2026 Espressif Systems (Shanghai) Co., Ltd.
# SPDX-License-Identifier: Apache-2.0

if SOC_SERIES_ESP32P4

choice SOC_ESP32P4_UNIVERSAL_MAC_ADDRESSES
	bool "Number of universally administered (by IEEE) MAC address"
	default SOC_ESP32P4_UNIVERSAL_MAC_ADDRESSES_TWO
	help
	  Configure the number of universally administered (by IEEE) MAC addresses.
	  During initialization, MAC addresses for each network interface are generated or derived from a
	  single base MAC address.
	  If the number of universal MAC addresses is two, only two interfaces (Ethernet and reserved)
	  receive a universally administered MAC address. These are generated sequentially by adding 0
	  and 1 (respectively) to the base MAC address.
	  Note that ESP32-P4 has an integrated Ethernet MAC but no Wi-Fi or Bluetooth.

config SOC_ESP32P4_UNIVERSAL_MAC_ADDRESSES_TWO
	bool "Two"
	select SOC_FAMILY_ESP32_MAC_ADDRESSES_TWO
	select SOC_FAMILY_ESP32_MAC_ADDR_UNIVERSE_ETH

endchoice # SOC_ESP32P4_UNIVERSAL_MAC_ADDRESSES

config SOC_ESP32P4_UNIVERSAL_MAC_ADDRESSES
	int
	default 2 if SOC_ESP32P4_UNIVERSAL_MAC_ADDRESSES_TWO

endif # SOC_SERIES_ESP32P4
```

## soc/espressif/esp32s3/Kconfig
```kconfig
# Copyright (c) 2023 Espressif Systems (Shanghai) Co., Ltd.
# SPDX-License-Identifier: Apache-2.0

config SOC_SERIES_ESP32S3
	select XTENSA
	select DYNAMIC_INTERRUPTS
	select ATOMIC_OPERATIONS_BUILTIN
	select ARCH_SUPPORTS_COREDUMP
	select ARCH_HAS_WORD_GRANULAR_ACCESS_INSTR_MEM
	select CLOCK_CONTROL
	select PINCTRL
	select HAS_ESPRESSIF_HAL
	select CPU_HAS_FPU
	select CPU_HAS_DCACHE
	select HAS_PM
	select HAS_POWEROFF
	imply XTENSA_ENABLE_BACKTRACE

if SOC_SERIES_ESP32S3

menu "Cache config"

choice ESP32S3_INSTRUCTION_CACHE_SIZE
	prompt "Instruction cache size"
	default ESP32S3_INSTRUCTION_CACHE_16KB
	help
	  Instruction cache size to be set on application startup.
	  If you use 16KB instruction cache rather than 32KB instruction cache,
	  then the other 16KB will be managed by heap allocator.

config ESP32S3_INSTRUCTION_CACHE_16KB
	bool "16KB"

config ESP32S3_INSTRUCTION_CACHE_32KB
	bool "32KB"

endchoice

config ESP32S3_INSTRUCTION_CACHE_SIZE
	hex
	default 0x4000 if ESP32S3_INSTRUCTION_CACHE_16KB
	default 0x8000 if ESP32S3_INSTRUCTION_CACHE_32KB

choice ESP32S3_ICACHE_ASSOCIATED_WAYS
	prompt "Instruction cache associated ways"
	default ESP32S3_INSTRUCTION_CACHE_8WAYS
	help
	  Instruction cache associated ways to be set on application startup.

config ESP32S3_INSTRUCTION_CACHE_4WAYS
	bool "4 ways"

config ESP32S3_INSTRUCTION_CACHE_8WAYS
	bool "8 ways"

endchoice

config ESP32S3_ICACHE_ASSOCIATED_WAYS
	int
	default 4 if ESP32S3_INSTRUCTION_CACHE_4WAYS
	default 8 if ESP32S3_INSTRUCTION_CACHE_8WAYS

choice ESP32S3_INSTRUCTION_CACHE_LINE_SIZE
	prompt "Instruction cache line size"
	default ESP32S3_INSTRUCTION_CACHE_LINE_32B
	help
	  Instruction cache line size to be set on application startup.

config ESP32S3_INSTRUCTION_CACHE_LINE_16B
	bool "16 Bytes"
	depends on ESP32S3_INSTRUCTION_CACHE_16KB

config ESP32S3_INSTRUCTION_CACHE_LINE_32B
	bool "32 Bytes"

endchoice

config ESP32S3_INSTRUCTION_CACHE_LINE_SIZE
	int
	default 16 if ESP32S3_INSTRUCTION_CACHE_LINE_16B
	default 32 if ESP32S3_INSTRUCTION_CACHE_LINE_32B

config ESP32S3_INSTRUCTION_CACHE_WRAP
	bool "Define instruction cache wrap mode"
	help
	  If enabled, instruction cache will use wrap mode to read spi flash or spi ram.
	  The wrap length equals to ESP32S3_INSTRUCTION_CACHE_LINE_SIZE.
	  However, it depends on complex conditions.

choice ESP32S3_DATA_CACHE_SIZE
	prompt "Data cache size"
	default ESP32S3_DATA_CACHE_32KB
	help
	  Data cache size to be set on application startup.
	  If you use 32KB data cache rather than 64KB data cache,
	  the other 32KB will be added to the heap.

config ESP32S3_DATA_CACHE_16KB
	bool "16KB"

config ESP32S3_DATA_CACHE_32KB
	bool "32KB"

config ESP32S3_DATA_CACHE_64KB
	bool "64KB"

endchoice

config ESP32S3_DATA_CACHE_SIZE
	hex
	# For 16KB the actual configuration is 32kb cache, but 16kb will be reserved for heap at startup
	default 0x8000 if ESP32S3_DATA_CACHE_16KB
	default 0x8000 if ESP32S3_DATA_CACHE_32KB
	default 0x10000 if ESP32S3_DATA_CACHE_64KB

choice ESP32S3_DCACHE_ASSOCIATED_WAYS
	prompt "Data cache associated ways"
	default ESP32S3_DATA_CACHE_8WAYS
	help
	  Data cache associated ways to be set on application startup.

config ESP32S3_DATA_CACHE_4WAYS
	bool "4 ways"

config ESP32S3_DATA_CACHE_8WAYS
	bool "8 ways"

endchoice

config ESP32S3_DCACHE_ASSOCIATED_WAYS
	int
	default 4 if ESP32S3_DATA_CACHE_4WAYS
	default 8 if ESP32S3_DATA_CACHE_8WAYS

choice ESP32S3_DATA_CACHE_LINE_SIZE
	prompt "Data cache line size"
	default ESP32S3_DATA_CACHE_LINE_32B
	help
	  Data cache line size to be set on application startup.

config ESP32S3_DATA_CACHE_LINE_16B
	bool "16 Bytes"
	depends on ESP32S3_DATA_CACHE_16KB || ESP32S3_DATA_CACHE_32KB

config ESP32S3_DATA_CACHE_LINE_32B
	bool "32 Bytes"

config ESP32S3_DATA_CACHE_LINE_64B
	bool "64 Bytes"

endchoice

config ESP32S3_DATA_CACHE_LINE_SIZE
	int
	default 16 if ESP32S3_DATA_CACHE_LINE_16B
	default 32 if ESP32S3_DATA_CACHE_LINE_32B
	default 64 if ESP32S3_DATA_CACHE_LINE_64B

config ESP32S3_DATA_CACHE_WRAP
	bool "Define data cache wrap mode"
	help
	  If enabled, data cache will use wrap mode to read spi flash or spi ram.
	  The wrap length equals to ESP32S3_DATA_CACHE_LINE_SIZE.
	  However, it depends on complex conditions.

config MAC_BB_PD
	bool "Power down MAC and baseband of Wi-Fi and Bluetooth when PHY is disabled"
	depends on SOC_SERIES_ESP32S3 && TICKLESS_KERNEL && PM
	help
	  If enabled, the MAC and baseband of Wi-Fi and Bluetooth will be powered
	  down when PHY is disabled. Enabling this setting reduces power consumption
	  by a small amount but increases RAM use by approximately 4KB (Wi-Fi only),
	  2KB (Bluetooth only) or 5.3KB (Wi-Fi + Bluetooth).

endmenu  # Cache config

config ESP32S3_PIE_SHARING
	bool "PIE register sharing"
	help
	  Preserve the registers of the Processor Instruction Extensions (PIE),
	  the 128-bit SIMD extension of the ESP32-S3, across context switches,
	  allowing multiple threads to use PIE instructions. Interrupt service
	  routines must not use PIE instructions.

if ESP32S3_PIE_SHARING

choice ESP32S3_PIE_SHARING_MODEL
	prompt "PIE sharing model"
	default ESP32S3_LAZY_PIE_SHARING

config ESP32S3_EAGER_PIE_SHARING
	bool "Eager PIE sharing"
	select XTENSA_EAGER_CP_SHARING
	help
	  Save and restore the PIE registers on every context switch and
	  interrupt, which adds about 100 instructions to each of them.
	  Every interrupt and context switch frame grows by 224 bytes.

	  Suited to applications where several threads using PIE alternate
	  often.

config ESP32S3_LAZY_PIE_SHARING
	bool "Lazy PIE sharing"
	depends on (SCHED_IPI_SUPPORTED && ARCH_HAS_DIRECTED_IPIS) || (MP_MAX_NUM_CPUS = 1)
	select XTENSA_LAZY_CP_SHARING
	help
	  Keep PIE disabled for all threads but the last one that used it, and
	  save and restore the PIE registers only when another thread executes
	  a PIE instruction: that instruction traps, and moving the registers
	  takes about 320 instructions. Other context switches take 4 more
	  instructions. Every thread structure grows by 208 bytes.

	  Suited to applications where PIE rarely changes hands between
	  threads.

endchoice

config XTENSA_CP_SHARING_ID
	default 3

endif # ESP32S3_PIE_SHARING

rsource "Kconfig.caps"

endif # SOC_SERIES_ESP32S3
```

## soc/espressif/esp32s31/Kconfig
```kconfig
# Copyright (c) 2026 Espressif Systems (Shanghai) Co., Ltd.
# SPDX-License-Identifier: Apache-2.0

config SOC_SERIES_ESP32S31
	select RISCV
	select RISCV_SOC_HAS_GP_RELATIVE_ADDRESSING
	select RISCV_PMP if SOC_ESP32S31_HPCORE && !MCUBOOT
	select DYNAMIC_INTERRUPTS if SOC_ESP32S31_HPCORE
	select CLOCK_CONTROL if SOC_ESP32S31_HPCORE
	select PINCTRL if SOC_ESP32S31_HPCORE
	select HAS_ESPRESSIF_HAL
	select CPU_HAS_DCACHE if SOC_ESP32S31_HPCORE
	select HAS_POWEROFF
	select SOC_HAS_TIMING_FUNCTIONS if SOC_ESP32S31_HPCORE

if SOC_SERIES_ESP32S31

rsource "Kconfig.caps"

config ESP32S31_EMAC
	bool
	default y if ETH_ESP32
	default y if ETH_ESP32_DWC_ETHER_1000
	default y if MDIO_ESP32
	help
	  Hidden option to build the ESP32-S31 Ethernet MAC HAL. Both the
	  Ethernet and the MDIO drivers depend on it.

config SOC_ESP32S31_REV_MIN_FULL
	int
	default 0 if SOC_ESP32S31_REV_0_0
	default 0
	help
	  Minimum supported ESP32-S31 chip revision in major * 100 + minor
	  format, matching what efuse_hal_chip_revision() returns at runtime.
	  Derived from the SOC_ESP32S31_REV_* symbol the board selects.
	  Defaults to v0.0 (0), the first revision of the family.

endif # SOC_SERIES_ESP32S31
```

## soc/espressif/esp32s31/Kconfig.caps
```kconfig
# Copyright (c) 2026 Espressif Systems (Shanghai) Co., Ltd.
# SPDX-License-Identifier: Apache-2.0

config SOC_ESP32_SPI_MEM_SUPPORT_TIMING_TUNING
	bool
	default y

config SOC_ESP32_WIFI_HE_SUPPORT
	bool
	default y

config SOC_ESP32_FLASH_SUPPORTED
	bool
	default y

config SOC_ESP32_ETM_SUPPORTED
	bool
	default y
```
