## soc/espressif/esp32s2/Kconfig.soc
```kconfig
# Copyright (c) 2023 Espressif Systems (Shanghai) Co., Ltd.
# SPDX-License-Identifier: Apache-2.0

config SOC_SERIES_ESP32S2
	bool
	select SOC_FAMILY_ESPRESSIF_ESP32
	help
	  ESP32-S2 Series

config SOC_ESP32S2
	bool
	select SOC_SERIES_ESP32S2
	help
	  ESP32S2

config SOC_SERIES
	default "esp32s2" if SOC_SERIES_ESP32S2

config SOC
	default "esp32s2" if SOC_SERIES_ESP32S2

config SOC_TOOLCHAIN_NAME
	string
	default "espressif_esp32s2" if SOC_SERIES_ESP32S2
```

## soc/espressif/esp32s3/Kconfig.amp
```kconfig
# Copyright (c) 2023 Espressif Systems (Shanghai) Co., Ltd.
# SPDX-License-Identifier: Apache-2.0

if SOC_SERIES_ESP32S3

menu "AMP config"

config ESP32S3_APPCPU_IRAM_SIZE
	hex "ESP32S3 APPCPU IRAM size"
	depends on SOC_ESP32S3_PROCPU || SOC_ESP32S3_APPCPU
	default 0x10000
	help
	  Defines APPCPU IRAM area size in bytes.

config ESP32S3_APPCPU_DRAM_SIZE
	hex "ESP32S3 APPCPU DRAM size"
	depends on SOC_ESP32S3_PROCPU || SOC_ESP32S3_APPCPU
	default 0x10000
	help
	  Defines APPCPU DRAM area size in bytes.

config SOC_ENABLE_APPCPU
	bool
	default y
	depends on (IPM || MBOX) && SOC_ESP32S3_PROCPU
	help
	  This hidden configuration lets PROCPU core to map and start APPCPU whenever IPM is enabled.

endmenu # AMP config

endif # SOC_SERIES_ESP32S3
```

## soc/espressif/esp32s3/Kconfig.caps
```kconfig
# Copyright (c) 2026 Espressif Systems (Shanghai) Co., Ltd.
# SPDX-License-Identifier: Apache-2.0

config ESP32_SOC_PM_SUPPORT_CPU_PD
	bool
	default y
```

## soc/espressif/esp32s3/Kconfig.soc
```kconfig
# Copyright (c) 2023 Espressif Systems (Shanghai) Co., Ltd.
# SPDX-License-Identifier: Apache-2.0

config SOC_SERIES_ESP32S3
	bool
	select SOC_FAMILY_ESPRESSIF_ESP32
	help
	  ESP32-S3 Series

config SOC_ESP32S3
	bool
	select SOC_SERIES_ESP32S3
	help
	  ESP32S3

config SOC_ESP32S3_PROCPU
	bool
	help
	  This hidden configuration defines that build is targeted for PROCPU (core 0).

config SOC_ESP32S3_APPCPU
	bool
	help
	  This hidden configuration defines that build is targeted for APPCPU (core 1).

config SOC_SERIES
	default "esp32s3" if SOC_SERIES_ESP32S3

config SOC
	default "esp32s3" if SOC_SERIES_ESP32S3

config SOC_TOOLCHAIN_NAME
	string
	default "espressif_esp32s3" if SOC_SERIES_ESP32S3
```

## soc/focaltech/Kconfig
```kconfig
# Copyright (c) 2025, FocalTech Systems CO.,Ltd
# SPDX-License-Identifier: Apache-2.0

rsource "*/Kconfig"
```

## soc/focaltech/ft9001/Kconfig
```kconfig
# Copyright (c) 2025, FocalTech Systems CO.,Ltd
# SPDX-License-Identifier: Apache-2.0

config SOC_FT9001
	select ARM
	select CPU_CORTEX_M4
	select CPU_HAS_FPU
	select CPU_HAS_ARM_MPU
	select CPU_CORTEX_M_HAS_SYSTICK
	select CPU_CORTEX_M_HAS_VTOR
	select SOC_EARLY_INIT_HOOK
	select BUILD_OUTPUT_HEX
	select HAS_SEGGER_RTT if ZEPHYR_SEGGER_MODULE
```

## soc/focaltech/ft9001/Kconfig.defconfig
```kconfig
# Copyright (c) 2025, FocalTech Systems CO.,Ltd
# SPDX-License-Identifier: Apache-2.0

if SOC_FT9001

config SYS_CLOCK_HW_CYCLES_PER_SEC
	default $(dt_node_int_prop_int,/cpus/cpu@0,clock-frequency)

config NUM_IRQS
	default 140

endif # SOC_FT9001
```

## soc/focaltech/ft9001/Kconfig.soc
```kconfig
# Copyright (c) 2025, FocalTech Systems Co., Ltd.
# SPDX-License-Identifier: Apache-2.0

config SOC_FT9001
	bool
	help
	  Build for the FocalTech FT9001 MCU (ARM Cortex-M4F).

config SOC
	default "ft9001" if SOC_FT9001
```

## soc/gaisler/Kconfig
```kconfig
# Copyright (c) 2019-2020 Cobham Gaisler AB
# SPDX-License-Identifier: Apache-2.0

config SPARC_CASA
	bool
	default y if SPARC
```

## soc/gaisler/gr716a/Kconfig
```kconfig
# Copyright (c) 2019-2020 Cobham Gaisler AB
# SPDX-License-Identifier: Apache-2.0

config SOC_GR716A
	select SPARC
	select SOC_SPARC_LEON
	select CPU_HAS_FPU

rsource "../Kconfig"
```

## soc/gaisler/gr716a/Kconfig.defconfig
```kconfig
# Copyright (c) 2019-2020 Cobham Gaisler AB
# SPDX-License-Identifier: Apache-2.0

if SOC_GR716A

config SPARC_NWIN
	default 31

config SYS_CLOCK_HW_CYCLES_PER_SEC
	int
	default 50000000

if FLASH

config SPI
	default y

config SPI_NOR
	default y

config SPI_GRLIB_SPIMCTRL
	default y

endif

endif
```

## soc/gaisler/gr716a/Kconfig.soc
```kconfig
# Copyright (c) 2019-2020 Cobham Gaisler AB
# SPDX-License-Identifier: Apache-2.0

config SOC_GR716A
	bool

config SOC
	default "gr716a" if SOC_GR716A

rsource "../Kconfig.soc"
```

## soc/gaisler/leon3/Kconfig.soc
```kconfig
# Copyright (c) 2019-2020 Cobham Gaisler AB
# SPDX-License-Identifier: Apache-2.0

config SOC_LEON3
	bool

config SOC
	default "leon3" if SOC_LEON3

rsource "../Kconfig.soc"
```

## soc/gd/gd32/Kconfig
```kconfig
# Copyright (c) 2021, ATL Electronics
# SPDX-License-Identifier: Apache-2.0

config SOC_FAMILY_GD_GD32
	select HAS_GD32_HAL
	select BUILD_OUTPUT_HEX
	select HAS_SEGGER_RTT if ZEPHYR_SEGGER_MODULE

if SOC_FAMILY_GD_GD32

rsource "*/Kconfig"

endif # SOC_FAMILY_GD_GD32
```

## soc/gd/gd32/Kconfig.defconfig
```kconfig
# Copyright (c) 2021, ATL Electronics
# SPDX-License-Identifier: Apache-2.0

if SOC_FAMILY_GD_GD32

rsource "*/Kconfig.defconfig.series"

config RESET
	default y

config CLOCK_CONTROL
	default y

config GD32_BACKUP_PROTECTION
	default y if SOC_SERIES_GD32F4XX

endif # SOC_FAMILY_GD_GD32
```

## soc/gd/gd32/Kconfig.soc
```kconfig
# Copyright (c) 2021, ATL Electronics
# SPDX-License-Identifier: Apache-2.0

config SOC_FAMILY_GD_GD32
	bool

config SOC_FAMILY
	default "gd_gd32" if SOC_FAMILY_GD_GD32

rsource "*/Kconfig.soc"
```

## soc/gd/gd32/common/Kconfig
```kconfig
# Copyright (c) 2025 STMicroelectronics
# SPDX-License-Identifier: Apache-2.0

config SOC_FAMILY_GD_GD32_HAS_BACKUP_DOMAIN_PROTECTION
	bool
	help
	  Selected for SoCs that need to explicitly enable access to
	  backup domain resources.
```

## soc/gd/gd32/gd32a50x/Kconfig
```kconfig
# Copyright (c) 2022 YuLong Yao <feilongphone@gmail.com>
# SPDX-License-Identifier: Apache-2.0

config SOC_SERIES_GD32A50X
	select ARM
	select CPU_HAS_ARM_MPU
	select CPU_HAS_FPU
	select ARMV8_M_DSP
	select CPU_CORTEX_M33
	select GD32_HAS_AF_PINMUX
	select GD32_HAS_IRC_40K
	select PLATFORM_SPECIFIC_INIT
```

## soc/gd/gd32/gd32a50x/Kconfig.defconfig.series
```kconfig
# Copyright (c) 2022 YuLong Yao <feilongphone@gmail.com>
# SPDX-License-Identifier: Apache-2.0

if SOC_SERIES_GD32A50X

rsource "Kconfig.defconfig.gd32*"

endif # SOC_SERIES_GD32A50X
```

## soc/gd/gd32/gd32a50x/Kconfig.soc
```kconfig
# Copyright (c) 2022 YuLong Yao <feilongphone@gmail.com>
# SPDX-License-Identifier: Apache-2.0

config SOC_SERIES_GD32A50X
	bool
	select SOC_FAMILY_GD_GD32
	help
	  Enable support for GigaDevice GD32A50X MCU series

config SOC_SERIES
	default "gd32a50x" if SOC_SERIES_GD32A50X

config SOC_GD32A503
	bool
	select SOC_SERIES_GD32A50X

config SOC
	default "gd32a503" if SOC_GD32A503
```

## soc/gd/gd32/gd32c2x1/Kconfig
```kconfig
# Copyright (c) 2026 GigaDevice Semiconductor Inc.
# SPDX-License-Identifier: Apache-2.0

config SOC_SERIES_GD32C2X1
	select ARM
	select CPU_CORTEX_M23
	select CPU_CORTEX_M_HAS_SYSTICK
	select CPU_CORTEX_M_HAS_VTOR
	select GD32_HAS_AF_PINMUX
	select GD32_HAS_IRC_32K
	select SOC_RESET_HOOK
	select SOC_EARLY_INIT_HOOK
```

## soc/gd/gd32/gd32c2x1/Kconfig.defconfig.gd32c231
```kconfig
# Copyright (c) 2026 GigaDevice Semiconductor Inc.
# SPDX-License-Identifier: Apache-2.0

if SOC_GD32C231

config SYS_CLOCK_HW_CYCLES_PER_SEC
	default $(dt_node_int_prop_int,/cpus/cpu@0,clock-frequency)

config NUM_IRQS
	default 55

endif # SOC_GD32C231
```

## soc/gd/gd32/gd32c2x1/Kconfig.defconfig.series
```kconfig
# Copyright (c) 2026 GigaDevice Semiconductor Inc.
# SPDX-License-Identifier: Apache-2.0

if SOC_SERIES_GD32C2X1

rsource "Kconfig.defconfig.gd32*"

endif # SOC_SERIES_GD32C2X1
```

## soc/gd/gd32/gd32c2x1/Kconfig.soc
```kconfig
# Copyright (c) 2026 GigaDevice Semiconductor Inc.
# SPDX-License-Identifier: Apache-2.0

config SOC_SERIES_GD32C2X1
	bool
	select SOC_FAMILY_GD_GD32
	help
	  Enable support for GigaDevice GD32C2X1 MCU series

config SOC_SERIES
	default "gd32c2x1" if SOC_SERIES_GD32C2X1

config SOC_GD32C231
	bool
	select SOC_SERIES_GD32C2X1

config SOC
	default "gd32c231" if SOC_GD32C231
```

## soc/gd/gd32/gd32e10x/Kconfig
```kconfig
# Copyright (c) 2021 YuLong Yao <feilongphone@gmail.com>
# SPDX-License-Identifier: Apache-2.0

config SOC_SERIES_GD32E10X
	select ARM
	select CPU_HAS_FPU
	select CPU_CORTEX_M4
	select CPU_CORTEX_M_HAS_SYSTICK
	select CPU_CORTEX_M_HAS_VTOR
	select GD32_HAS_AFIO_PINMUX
	select GD32_HAS_IRC_40K
	select SOC_EARLY_INIT_HOOK
```
