## soc/infineon/aurix/Kconfig
```kconfig
# Copyright (c) 2024 Infineon Technologies AG
# SPDX-License-Identifier: Apache-2.0

config SOC_FAMILY_AURIX
	bool

if SOC_FAMILY_AURIX

rsource "*/Kconfig"

config AURIX_STARTUP_CPU
	bool "AURIX Startup CPU"
	help
	  This option is used to select the startup CPU for the SoC.  The startup CPU is
	  responsible the initial setup of some of the shared resources like Safety Watchdog,
	  PLLs, etc.

endif # SOC_FAMILY_AURIX
```

## soc/infineon/aurix/tc3x/Kconfig
```kconfig
# Copyright (c) 2024 Infineon Technologies AG
# SPDX-License-Identifier: Apache-2.0

config SOC_SERIES_TC3X
	select TRICORE
	select CPU_TC162
	select AURIX_IR
	select HAS_INFINEON_TC3X_HAL

config SOC_TC375TP_CPU0
	imply AURIX_STARTUP_CPU

config SOC_TC397XA_CPU0
	imply AURIX_STARTUP_CPU
```

## soc/infineon/aurix/tc4x/Kconfig
```kconfig
# Copyright (c) 2024 Infineon Technologies AG
# SPDX-License-Identifier: Apache-2.0

config SOC_SERIES_TC4X
	select TRICORE
	select CPU_TC18
	select AURIX_IR
	select HAS_INFINEON_TC4X_HAL

config TC4X_CPU
	bool
	depends on SOC_SERIES_TC4X
	select CPU_HAS_FPU
	select CPU_HAS_FPU_DOUBLE_PRECISION
	select CPU_HAS_TRICORE_VIRTUALIZATION
	imply FPU
	default y if !SOC_TC4D7XP_CPUCS

config TC4X_CPUCS
	bool
	depends on SOC_SERIES_TC4X
	default y if SOC_TC4D7XP_CPUCS

config SOC_TC4D7XP_CPU0
	imply AURIX_STARTUP_CPU
```

## soc/infineon/aurix/tc4x/Kconfig.defconfig
```kconfig
# Copyright (c) 2024 Infineon Technologies AG
# SPDX-License-Identifier: Apache-2.0

if SOC_SERIES_TC4X

config NUM_IRQS
	default 2048

endif
```

## soc/infineon/cat1a/Kconfig
```kconfig
# Copyright (c) 2024 Cypress Semiconductor Corporation (an Infineon company) or
# an affiliate of Cypress Semiconductor Corporation
# SPDX-License-Identifier: Apache-2.0

# Infineon CAT1A devices

# Family definitions
config SOC_FAMILY_PSOC6
	select ARM
	select CPU_CORTEX_M4
	select CPU_HAS_ARM_MPU
	select DYNAMIC_INTERRUPTS
	select CPU_HAS_FPU
	select SOC_FAMILY_INFINEON_CAT1
	select BUILD_OUTPUT_HEX

config SOC_FAMILY_PSOC6_LEGACY
	select ARM
	select HAS_CYPRESS_DRIVERS
	select CPU_CORTEX_M_HAS_SYSTICK
	select BUILD_OUTPUT_HEX
	select CPU_HAS_ARM_MPU

config SOC_FAMILY_PSOC6_LEGACY_M4
	select CPU_CORTEX_M4
	select CPU_CORTEX_M_HAS_DWT
	select CPU_HAS_FPU

config SOC_FAMILY_PSOC6_LEGACY_M0
	select CPU_CORTEX_M0PLUS
	select CPU_CORTEX_M_HAS_VTOR

config SOC_PSOC6_M0_ENABLES_M4
	bool "Dual-core support [activate Cortex-M4]"
	depends on SOC_FAMILY_PSOC6_LEGACY_M0
	help
	  Cortex-M0 CPU should boot Cortex-M4

if SOC_FAMILY_PSOC6
## PSOC™ 6 Cortex M0+ prebuilt images
choice
	prompt "PSOC™ 6 Cortex M0+ prebuilt images"
	help
	  Choose the prebuilt application image to be executed on the Cortex-M0+ core of the PSOC™ 6
	  dual-core MCU. The image is responsible for booting the Cortex-M4 on the device.

config SOC_PSOC6_CM0P_IMAGE_SLEEP
	bool "DeepSleep"
	help
	  DeepSleep prebuilt application image is executed on the Cortex-M0+ core of the PSOC™ 6 BLE
	  dual-core MCU.The image is provided as C array ready to be compiled as part of the Cortex-M4
	  application. The Cortex-M0+ application code is placed to internal flash by the Cortex-M4
	  linker script.
endchoice

config SOC_PSOC6_CM0P_IMAGE_ROM_SIZE
	hex
	default 0x2000 if SOC_PSOC6_CM0P_IMAGE_SLEEP

config SOC_PSOC6_CM0P_IMAGE_RAM_SIZE
	hex
	default 0x2000 if SOC_PSOC6_CM0P_IMAGE_SLEEP

endif # SOC_FAMILY_PSOC6
```

## soc/infineon/cat1a/Kconfig.soc
```kconfig
# Copyright (c) 2024 Cypress Semiconductor Corporation (an Infineon company) or
# an affiliate of Cypress Semiconductor Corporation
# SPDX-License-Identifier: Apache-2.0

# MPNs definitions
rsource "*/Kconfig.soc"

# Infineon CAT1A devices

# Category definitions
config SOC_FAMILY_INFINEON_CAT1
	bool

config SOC_FAMILY_INFINEON_CAT1A
	bool

# Family definitions
config SOC_FAMILY_PSOC6
	bool

config SOC_FAMILY_PSOC6_LEGACY
	bool

config SOC_FAMILY_PSOC6_LEGACY_M4
	bool

config SOC_FAMILY_PSOC6_LEGACY_M0
	bool

# Cypress PSOC™ 6 MCU lines
config SOC_SERIES_PSOC6_60
	bool
	select SOC_FAMILY_PSOC6 if !SOC_FAMILY_PSOC6_LEGACY
	select SOC_FAMILY_INFINEON_CAT1A

config SOC_SERIES_PSOC6_61
	bool
	select SOC_FAMILY_PSOC6 if !SOC_FAMILY_PSOC6_LEGACY
	select SOC_FAMILY_INFINEON_CAT1A

config SOC_SERIES_PSOC6_62
	bool
	select SOC_FAMILY_PSOC6 if !SOC_FAMILY_PSOC6_LEGACY
	select SOC_FAMILY_INFINEON_CAT1A

config SOC_SERIES_PSOC6_63
	bool
	select SOC_FAMILY_PSOC6 if !SOC_FAMILY_PSOC6_LEGACY
	select SOC_FAMILY_INFINEON_CAT1A

config SOC_SERIES_PSOC6_64
	bool
	select SOC_FAMILY_PSOC6 if !SOC_FAMILY_PSOC6_LEGACY
	select SOC_FAMILY_INFINEON_CAT1A

config SOC_SERIES
	default "psoc6_60" if SOC_SERIES_PSOC6_60
	default "psoc6_61" if SOC_SERIES_PSOC6_61
	default "psoc6_62" if SOC_SERIES_PSOC6_62
	default "psoc6_63" if SOC_SERIES_PSOC6_63
	default "psoc6_64" if SOC_SERIES_PSOC6_64
```

## soc/infineon/cat1a/psoc6_01/Kconfig.defconfig
```kconfig
# Copyright (c) 2023 Cypress Semiconductor Corporation (an Infineon company) or
# an affiliate of Cypress Semiconductor Corporation
# SPDX-License-Identifier: Apache-2.0

# Infineon PSoC6_01 based MCU default configuration

if SOC_DIE_PSOC6_01

config NUM_IRQS
	default 32 if CPU_CORTEX_M0PLUS
	default 147 if CPU_CORTEX_M4

config SYS_CLOCK_HW_CYCLES_PER_SEC
	default 100000000

# add additional die specific params

endif # SOC_DIE_PSOC6_01
```
