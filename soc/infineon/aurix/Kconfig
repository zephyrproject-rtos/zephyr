## soc/infineon/cat1a/psoc6_04/Kconfig.soc
```kconfig
# Copyright (c) 2023 Cypress Semiconductor Corporation (an Infineon company) or
# an affiliate of Cypress Semiconductor Corporation
# SPDX-License-Identifier: Apache-2.0

# SOC die
config SOC_DIE_PSOC6_04
	bool

# SOC packages
config SOC_PACKAGE_PSOC6_04_64_TQFP
	bool

config SOC_PACKAGE_PSOC6_04_68_QFN
	bool

config SOC_PACKAGE_PSOC6_04_80_TQFP
	bool

config SOC_PACKAGE_PSOC6_04_80_M_CSP
	bool

# Infineon PSoC6_04 series MCUs
config SOC_CY8C6244AZI_S4D92
	bool
	select SOC_DIE_PSOC6_04
	select SOC_PACKAGE_PSOC6_04_64_TQFP
	select SOC_SERIES_PSOC6_62

config SOC_CY8C6244LQI_S4D92
	bool
	select SOC_DIE_PSOC6_04
	select SOC_PACKAGE_PSOC6_04_68_QFN
	select SOC_SERIES_PSOC6_62

config SOC_CY8C6244AZI_S4D93
	bool
	select SOC_DIE_PSOC6_04
	select SOC_PACKAGE_PSOC6_04_80_TQFP
	select SOC_SERIES_PSOC6_62

config SOC_CY8C6244AZI_S4D82
	bool
	select SOC_DIE_PSOC6_04
	select SOC_PACKAGE_PSOC6_04_64_TQFP
	select SOC_SERIES_PSOC6_62

config SOC_CY8C6244LQI_S4D82
	bool
	select SOC_DIE_PSOC6_04
	select SOC_PACKAGE_PSOC6_04_68_QFN
	select SOC_SERIES_PSOC6_62

config SOC_CY8C6244AZI_S4D83
	bool
	select SOC_DIE_PSOC6_04
	select SOC_PACKAGE_PSOC6_04_80_TQFP
	select SOC_SERIES_PSOC6_62

config SOC_CY8C6244AZI_S4D62
	bool
	select SOC_DIE_PSOC6_04
	select SOC_PACKAGE_PSOC6_04_64_TQFP
	select SOC_SERIES_PSOC6_62

config SOC_CY8C6244LQI_S4D62
	bool
	select SOC_DIE_PSOC6_04
	select SOC_PACKAGE_PSOC6_04_68_QFN
	select SOC_SERIES_PSOC6_62

config SOC_CY8C6244AZI_S4D12
	bool
	select SOC_DIE_PSOC6_04
	select SOC_PACKAGE_PSOC6_04_64_TQFP
	select SOC_SERIES_PSOC6_62

config SOC_CY8C6244LQI_S4D12
	bool
	select SOC_DIE_PSOC6_04
	select SOC_PACKAGE_PSOC6_04_68_QFN
	select SOC_SERIES_PSOC6_62

config SOC_CY8C6144AZI_S4F92
	bool
	select SOC_DIE_PSOC6_04
	select SOC_PACKAGE_PSOC6_04_64_TQFP
	select SOC_SERIES_PSOC6_61

config SOC_CY8C6144LQI_S4F92
	bool
	select SOC_DIE_PSOC6_04
	select SOC_PACKAGE_PSOC6_04_68_QFN
	select SOC_SERIES_PSOC6_61

config SOC_CY8C6144AZI_S4F93
	bool
	select SOC_DIE_PSOC6_04
	select SOC_PACKAGE_PSOC6_04_80_TQFP
	select SOC_SERIES_PSOC6_61

config SOC_CY8C6144AZI_S4F82
	bool
	select SOC_DIE_PSOC6_04
	select SOC_PACKAGE_PSOC6_04_64_TQFP
	select SOC_SERIES_PSOC6_61

config SOC_CY8C6144LQI_S4F82
	bool
	select SOC_DIE_PSOC6_04
	select SOC_PACKAGE_PSOC6_04_68_QFN
	select SOC_SERIES_PSOC6_61

config SOC_CY8C6144AZI_S4F83
	bool
	select SOC_DIE_PSOC6_04
	select SOC_PACKAGE_PSOC6_04_80_TQFP
	select SOC_SERIES_PSOC6_61

config SOC_CY8C6144AZI_S4F62
	bool
	select SOC_DIE_PSOC6_04
	select SOC_PACKAGE_PSOC6_04_64_TQFP
	select SOC_SERIES_PSOC6_61

config SOC_CY8C6144LQI_S4F62
	bool
	select SOC_DIE_PSOC6_04
	select SOC_PACKAGE_PSOC6_04_68_QFN
	select SOC_SERIES_PSOC6_61

config SOC_CY8C6144AZI_S4F12
	bool
	select SOC_DIE_PSOC6_04
	select SOC_PACKAGE_PSOC6_04_64_TQFP
	select SOC_SERIES_PSOC6_61

config SOC_CY8C6144LQI_S4F12
	bool
	select SOC_DIE_PSOC6_04
	select SOC_PACKAGE_PSOC6_04_68_QFN
	select SOC_SERIES_PSOC6_61

config SOC_CY8C6244AZQ_S4D92
	bool
	select SOC_DIE_PSOC6_04
	select SOC_PACKAGE_PSOC6_04_64_TQFP
	select SOC_SERIES_PSOC6_62

config SOC_CY8C6244LQQ_S4D92
	bool
	select SOC_DIE_PSOC6_04
	select SOC_PACKAGE_PSOC6_04_68_QFN
	select SOC_SERIES_PSOC6_62

config SOC_CY8C6244AZQ_S4D93
	bool
	select SOC_DIE_PSOC6_04
	select SOC_PACKAGE_PSOC6_04_80_TQFP
	select SOC_SERIES_PSOC6_62

config SOC_CY8C6144AZQ_S4F92
	bool
	select SOC_DIE_PSOC6_04
	select SOC_PACKAGE_PSOC6_04_64_TQFP
	select SOC_SERIES_PSOC6_61

config SOC_CY8C6144LQQ_S4F92
	bool
	select SOC_DIE_PSOC6_04
	select SOC_PACKAGE_PSOC6_04_68_QFN
	select SOC_SERIES_PSOC6_61

config SOC_CY8C6144AZQ_S4F93
	bool
	select SOC_DIE_PSOC6_04
	select SOC_PACKAGE_PSOC6_04_80_TQFP
	select SOC_SERIES_PSOC6_61

config SOC_CY8C6244FMI_S4D93
	bool
	select SOC_DIE_PSOC6_04
	select SOC_PACKAGE_PSOC6_04_80_M_CSP
	select SOC_SERIES_PSOC6_62

config SOC_CY8C6244FMI_S4D73
	bool
	select SOC_DIE_PSOC6_04
	select SOC_PACKAGE_PSOC6_04_80_M_CSP
	select SOC_SERIES_PSOC6_62

config SOC_CY8C6244FMI_S4D53
	bool
	select SOC_DIE_PSOC6_04
	select SOC_PACKAGE_PSOC6_04_80_M_CSP
	select SOC_SERIES_PSOC6_62

config SOC_CY8C6244FMI_S4D03
	bool
	select SOC_DIE_PSOC6_04
	select SOC_PACKAGE_PSOC6_04_80_M_CSP
	select SOC_SERIES_PSOC6_62

config SOC_CY8C6244FMQ_S4D93
	bool
	select SOC_DIE_PSOC6_04
	select SOC_PACKAGE_PSOC6_04_80_M_CSP
	select SOC_SERIES_PSOC6_62

config SOC_CY8C6144FMI_S4F93
	bool
	select SOC_DIE_PSOC6_04
	select SOC_PACKAGE_PSOC6_04_80_M_CSP
	select SOC_SERIES_PSOC6_61

config SOC_CY8C6144FMI_S4F73
	bool
	select SOC_DIE_PSOC6_04
	select SOC_PACKAGE_PSOC6_04_80_M_CSP
	select SOC_SERIES_PSOC6_61

config SOC_CY8C6144FMI_S4F53
	bool
	select SOC_DIE_PSOC6_04
	select SOC_PACKAGE_PSOC6_04_80_M_CSP
	select SOC_SERIES_PSOC6_61

config SOC_CY8C6144FMI_S4F03
	bool
	select SOC_DIE_PSOC6_04
	select SOC_PACKAGE_PSOC6_04_80_M_CSP
	select SOC_SERIES_PSOC6_61

config SOC_CY8C6144FMQ_S4F93
	bool
	select SOC_DIE_PSOC6_04
	select SOC_PACKAGE_PSOC6_04_80_M_CSP
	select SOC_SERIES_PSOC6_61

config SOC
	default "cy8c6244azi_s4d92" if SOC_CY8C6244AZI_S4D92
	default "cy8c6244lqi_s4d92" if SOC_CY8C6244LQI_S4D92
	default "cy8c6244azi_s4d93" if SOC_CY8C6244AZI_S4D93
	default "cy8c6244azi_s4d82" if SOC_CY8C6244AZI_S4D82
	default "cy8c6244lqi_s4d82" if SOC_CY8C6244LQI_S4D82
	default "cy8c6244azi_s4d83" if SOC_CY8C6244AZI_S4D83
	default "cy8c6244azi_s4d62" if SOC_CY8C6244AZI_S4D62
	default "cy8c6244lqi_s4d62" if SOC_CY8C6244LQI_S4D62
	default "cy8c6244azi_s4d12" if SOC_CY8C6244AZI_S4D12
	default "cy8c6244lqi_s4d12" if SOC_CY8C6244LQI_S4D12
	default "cy8c6144azi_s4f92" if SOC_CY8C6144AZI_S4F92
	default "cy8c6144lqi_s4f92" if SOC_CY8C6144LQI_S4F92
	default "cy8c6144azi_s4f93" if SOC_CY8C6144AZI_S4F93
	default "cy8c6144azi_s4f82" if SOC_CY8C6144AZI_S4F82
	default "cy8c6144lqi_s4f82" if SOC_CY8C6144LQI_S4F82
	default "cy8c6144azi_s4f83" if SOC_CY8C6144AZI_S4F83
	default "cy8c6144azi_s4f62" if SOC_CY8C6144AZI_S4F62
	default "cy8c6144lqi_s4f62" if SOC_CY8C6144LQI_S4F62
	default "cy8c6144azi_s4f12" if SOC_CY8C6144AZI_S4F12
	default "cy8c6144lqi_s4f12" if SOC_CY8C6144LQI_S4F12
	default "cy8c6244azq_s4d92" if SOC_CY8C6244AZQ_S4D92
	default "cy8c6244lqq_s4d92" if SOC_CY8C6244LQQ_S4D92
	default "cy8c6244azq_s4d93" if SOC_CY8C6244AZQ_S4D93
	default "cy8c6144azq_s4f92" if SOC_CY8C6144AZQ_S4F92
	default "cy8c6144lqq_s4f92" if SOC_CY8C6144LQQ_S4F92
	default "cy8c6144azq_s4f93" if SOC_CY8C6144AZQ_S4F93
	default "cy8c6244fmi_s4d93" if SOC_CY8C6244FMI_S4D93
	default "cy8c6244fmi_s4d73" if SOC_CY8C6244FMI_S4D73
	default "cy8c6244fmi_s4d53" if SOC_CY8C6244FMI_S4D53
	default "cy8c6244fmi_s4d03" if SOC_CY8C6244FMI_S4D03
	default "cy8c6244fmq_s4d93" if SOC_CY8C6244FMQ_S4D93
	default "cy8c6144fmi_s4f93" if SOC_CY8C6144FMI_S4F93
	default "cy8c6144fmi_s4f73" if SOC_CY8C6144FMI_S4F73
	default "cy8c6144fmi_s4f53" if SOC_CY8C6144FMI_S4F53
	default "cy8c6144fmi_s4f03" if SOC_CY8C6144FMI_S4F03
	default "cy8c6144fmq_s4f93" if SOC_CY8C6144FMQ_S4F93
```

## soc/infineon/cat1a/psoc6_legacy/Kconfig.defconfig
```kconfig
# Copyright (c) 2023 Cypress Semiconductor Corporation (an Infineon company) or
# an affiliate of Cypress Semiconductor Corporation
# SPDX-License-Identifier: Apache-2.0

# Infineon PSoC6 (Legacy) based MCU default configuration

if SOC_FAMILY_PSOC6_LEGACY

config NUM_IRQS
	default 32 if CPU_CORTEX_M0PLUS
	default 147 if CPU_CORTEX_M4

config SYS_CLOCK_HW_CYCLES_PER_SEC
	default 50000000

# add additional die specific params

endif # SOC_FAMILY_PSOC6_LEGACY
```

## soc/infineon/cat1a/psoc6_legacy/Kconfig.soc
```kconfig
# Copyright (c) 2023 Cypress Semiconductor Corporation (an Infineon company) or
# an affiliate of Cypress Semiconductor Corporation
# SPDX-License-Identifier: Apache-2.0

# Infineon PSoC6 (legacy) series MCUs
config SOC_CY8C6247_M0
	bool
	select SOC_SERIES_PSOC6_62
	select SOC_FAMILY_PSOC6_LEGACY
	select SOC_FAMILY_PSOC6_LEGACY_M0

config SOC_CY8C6247_M4
	bool
	select SOC_SERIES_PSOC6_62
	select SOC_FAMILY_PSOC6_LEGACY
	select SOC_FAMILY_PSOC6_LEGACY_M4

config SOC_CY8C6347_M0
	bool
	select SOC_SERIES_PSOC6_63
	select SOC_FAMILY_PSOC6_LEGACY
	select SOC_FAMILY_PSOC6_LEGACY_M0

config SOC_CY8C6347_M4
	bool
	select SOC_SERIES_PSOC6_63
	select SOC_FAMILY_PSOC6_LEGACY
	select SOC_FAMILY_PSOC6_LEGACY_M4

config SOC_PART_NUMBER_CY8C6247BZI_D54
	bool

config SOC_PART_NUMBER_CY8C6347BZI_BLD53
	bool

config SOC
	default "cy8c6247" if SOC_CY8C6247_M0 || SOC_CY8C6247_M4
	default "cy8c6347" if SOC_CY8C6347_M0 || SOC_CY8C6347_M4

config SOC_PART_NUMBER
	default "CY8C6247BZI_D54" if SOC_PART_NUMBER_CY8C6247BZI_D54
	default "CY8C6347BZI_BLD53" if SOC_PART_NUMBER_CY8C6347BZI_BLD53
```

## soc/infineon/cat1b/Kconfig
```kconfig
# Copyright (c) 2024 Cypress Semiconductor Corporation (an Infineon company) or
# an affiliate of Cypress Semiconductor Corporation
# SPDX-License-Identifier: Apache-2.0

if SOC_FAMILY_INFINEON_CAT1B

rsource "*/Kconfig"

endif # SOC_FAMILY_INFINEON_CAT1B
```

## soc/infineon/cat1b/Kconfig.soc
```kconfig
# Copyright (c) 2024 Cypress Semiconductor Corporation (an Infineon company) or
# an affiliate of Cypress Semiconductor Corporation
# SPDX-License-Identifier: Apache-2.0

# Family definitions
config SOC_FAMILY_INFINEON_CAT1
	bool

config SOC_FAMILY_INFINEON_CAT1B
	bool
	select SOC_FAMILY_INFINEON_CAT1

# MPNs definitions
rsource "*/Kconfig.soc"
```

## soc/infineon/cat1b/cyw20829/Kconfig
```kconfig
# Copyright (c) 2024 Cypress Semiconductor Corporation (an Infineon company) or
# an affiliate of Cypress Semiconductor Corporation
# SPDX-License-Identifier: Apache-2.0

# Infineon CAT1B devices

# Series definitions
config SOC_SERIES_CYW20829
	select ARM
	select CPU_HAS_ARM_MPU
	select CPU_HAS_CUSTOM_FIXED_SOC_MPU_REGIONS
	select CPU_CORTEX_M33
	select DYNAMIC_INTERRUPTS
	select HAS_SEGGER_RTT if ZEPHYR_SEGGER_MODULE
	select HAS_PM
	select BUILD_OUTPUT_HEX
	select BUILD_OUTPUT_BIN
	select SOC_EARLY_INIT_HOOK

config CYW20829_FLASH_SAHB_ADDR
	hex
	default $(dt_nodelabel_reg_addr_hex,flash_sahb)

config CYW20829_FLASH_CBUS_ADDR
	hex
	default $(dt_nodelabel_reg_addr_hex,flash_cbus)

config CYW20829_SRAM_SAHB_ADDR
	hex
	default $(dt_nodelabel_reg_addr_hex,sram_sahb)

config CYW20829_SRAM_CBUS_ADDR
	hex
	default $(dt_nodelabel_reg_addr_hex,sram_cbus)
```

## soc/infineon/cat1b/cyw20829/Kconfig.soc
```kconfig
# Copyright (c) 2025 Infineon Technologies AG,
# or an affiliate of Infineon Technologies AG.
#
# SPDX-License-Identifier: Apache-2.0

# Infineon CYW20829 series MCUs
config SOC_SERIES_CYW20829
	bool
	select SOC_FAMILY_INFINEON_CAT1B

config SOC_SERIES
	default "cyw20829" if SOC_SERIES_CYW20829

# Infineon CYW20829 series MPNs
config SOC_CYW20829B0LKML
	bool
	select SOC_SERIES_CYW20829

config SOC_CYW89829B0232
	bool
	select SOC_SERIES_CYW20829

config SOC_CYW20829B0000
	bool
	select SOC_SERIES_CYW20829

config SOC_CYW20829B0010
	bool
	select SOC_SERIES_CYW20829

config SOC_CYW20829B1240
	bool
	select SOC_SERIES_CYW20829

config SOC_CYW20829B1340
	bool
	select SOC_SERIES_CYW20829

config SOC_CYW89829B0062
	bool
	select SOC_SERIES_CYW20829

config SOC_CYW89829B1062
	bool
	select SOC_SERIES_CYW20829

config SOC_CYW20829B1000
	bool
	select SOC_SERIES_CYW20829

config SOC_CYW20829B1010
	bool
	select SOC_SERIES_CYW20829

config SOC_CYW89829B1232
	bool
	select SOC_SERIES_CYW20829

config SOC
	default "cyw20829b0lkml" if SOC_CYW20829B0LKML
	default "cyw89829b0232" if SOC_CYW89829B0232
	default "cyw20829b0000" if SOC_CYW20829B0000
	default "cyw20829b0010" if SOC_CYW20829B0010
	default "cyw20829b1240" if SOC_CYW20829B1240
	default "cyw20829b1340" if SOC_CYW20829B1340
	default "cyw89829b0062" if SOC_CYW89829B0062
	default "cyw89829b1062" if SOC_CYW89829B1062
	default "cyw20829b1000" if SOC_CYW20829B1000
	default "cyw20829b1010" if SOC_CYW20829B1010
	default "cyw89829b1232" if SOC_CYW89829B1232
```

## soc/infineon/cat1c/Kconfig
```kconfig
# Copyright (c) 2024 Cypress Semiconductor Corporation (an Infineon company) or
# an affiliate of Cypress Semiconductor Corporation
# SPDX-License-Identifier: Apache-2.0

if SOC_FAMILY_INFINEON_CAT1C

rsource "*/Kconfig"

endif # SOC_FAMILY_INFINEON_CAT1C
```

## soc/infineon/cat1c/Kconfig.defconfig
```kconfig
# PSOC CAT1B Configuration

# Copyright (c) 2024 Cypress Semiconductor Corporation.
# SPDX-License-Identifier: Apache-2.0

if SOC_FAMILY_INFINEON_CAT1C

rsource "*/Kconfig.defconfig"

endif # SOC_FAMILY_INFINEON_CAT1C
```

## soc/infineon/cat1c/cyt4dn/Kconfig.defconfig
```kconfig
# Copyright (c) 2026 Linumiz
# Copyright (c) 2026 Infineon Technologies AG
# SPDX-License-Identifier: Apache-2.0

# Infineon CAT1C CYT4DN based MCU default configuration

if SOC_SERIES_CYT4DN

# Multi-level interrupt bit allocation:
# L1: 5 bits (covers 16 L1 lines on M7 and M0+)
# L2: 10 bits (covers 794 system interrupts)
config 1ST_LEVEL_INTERRUPT_BITS
	default 5

config 2ND_LEVEL_INTERRUPT_BITS
	default 10

config MAX_IRQ_PER_AGGREGATOR
	default 794

config NUM_2ND_LEVEL_AGGREGATORS
	default 8

# Offset in _sw_isr_table for 2nd level system interrupts:
# M7 and M0P: 16 (NvicMux 0-7 + Internal 0-7)
config 2ND_LVL_ISR_TBL_OFFSET
	default 16

# Aggregator N maps to NvicMux line N
config 2ND_LVL_INTR_00_OFFSET
	default 0

config 2ND_LVL_INTR_01_OFFSET
	default 1

config 2ND_LVL_INTR_02_OFFSET
	default 2

config 2ND_LVL_INTR_03_OFFSET
	default 3

config 2ND_LVL_INTR_04_OFFSET
	default 4

config 2ND_LVL_INTR_05_OFFSET
	default 5

config 2ND_LVL_INTR_06_OFFSET
	default 6

config 2ND_LVL_INTR_07_OFFSET
	default 7

config NUM_IRQS
	default 6368

config SYS_CLOCK_HW_CYCLES_PER_SEC
	default $(dt_node_int_prop_int,/cpus/cpu@0,clock-frequency) if SOC_CYT4DN_CORE_M0PLUS
	default $(dt_node_int_prop_int,/cpus/cpu@1,clock-frequency) if SOC_CYT4DN_CORE_M7_0
	default $(dt_node_int_prop_int,/cpus/cpu@2,clock-frequency) if SOC_CYT4DN_CORE_M7_1

config INFINEON_INTC_CAT1
	default y

config GEN_IRQ_VECTOR_TABLE
	default n

config BUILD_OUTPUT_HEX
	default y

config CLOCK_CONTROL
	default y

config ARM_MPU
	default y

endif # SOC_SERIES_CYT4DN
```

## soc/infineon/cat1c/cyt4dn/Kconfig.soc
```kconfig
# Copyright (c) 2026 Linumiz
# Copyright (c) 2026 Infineon Technologies AG
# SPDX-License-Identifier: Apache-2.0

# SOC series
config SOC_SERIES_CYT4DN
	bool
	select SOC_FAMILY_INFINEON_CAT1C
	select SOC_FAMILY_INFINEON_TRAVEO

config SOC_SERIES
	default "cyt4dn" if SOC_SERIES_CYT4DN

config SOC_CYT4DNJBZS_M0PLUS
	bool
	select SOC_SERIES_CYT4DN

config SOC_CYT4DNJBZS_M7_0
	bool
	select SOC_SERIES_CYT4DN

config SOC_CYT4DNJBZS_M7_1
	bool
	select SOC_SERIES_CYT4DN

config SOC
	default "cyt4dnjbzs" if SOC_CYT4DNJBZS_M0PLUS || SOC_CYT4DNJBZS_M7_0 || SOC_CYT4DNJBZS_M7_1
```

## soc/infineon/cat1c/cyt4dn/m0p/Kconfig
```kconfig
# Copyright (c) 2026 Linumiz
# Copyright (c) 2026 Infineon Technologies AG
# SPDX-License-Identifier: Apache-2.0

if SOC_SERIES_CYT4DN

config SOC_CYT4DN_CORE_M0PLUS
	bool
	default y if SOC_CYT4DNJBZS_M0PLUS
	select ARM
	select CPU_CORTEX_M0PLUS
	select CPU_CORTEX_M_HAS_SYSTICK
	select CPU_HAS_ARM_MPU
	select CPU_CORTEX_M_HAS_VTOR
	select SOC_PREP_HOOK
	select SOC_LATE_INIT_HOOK

config SOC_CYT4DN_START_M7_0
	bool "CYT4DN M7 Core 0 during M0+ startup"
	help
	  Enable starting M7 core 0 from M0+ core.

config SOC_CYT4DN_START_M7_1
	bool "CYT4DN M7 Core 1 during M0+ startup"
	help
	  Enable starting M7 core 1 from M0+ core.

endif
```
