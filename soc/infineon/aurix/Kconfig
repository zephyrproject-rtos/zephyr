## soc/infineon/cat1a/psoc6_02/Kconfig.soc
```kconfig
# Copyright (c) 2023 Cypress Semiconductor Corporation (an Infineon company) or
# an affiliate of Cypress Semiconductor Corporation
# SPDX-License-Identifier: Apache-2.0

# SOC die
config SOC_DIE_PSOC6_02
	bool

# SOC packages
config SOC_PACKAGE_PSOC6_02_124_BGA
	bool

config SOC_PACKAGE_PSOC6_02_100_WLCSP
	bool

config SOC_PACKAGE_PSOC6_02_128_TQFP
	bool

config SOC_PACKAGE_PSOC6_02_68_QFN
	bool

# Infineon PSOC 6_02 series MCUs
config SOC_CYB0644ABZI_S2D44
	bool
	select SOC_DIE_PSOC6_02
	select SOC_PACKAGE_PSOC6_02_124_BGA
	select SOC_SERIES_PSOC6_64

config SOC_CYS0644ABZI_S2D44
	bool
	select SOC_DIE_PSOC6_02
	select SOC_PACKAGE_PSOC6_02_124_BGA
	select SOC_SERIES_PSOC6_64

config SOC_CYS0644AFNI_S2D43
	bool
	select SOC_DIE_PSOC6_02
	select SOC_PACKAGE_PSOC6_02_100_WLCSP
	select SOC_SERIES_PSOC6_64

config SOC_CY8C624ABZI_S2D44A0
	bool
	select SOC_DIE_PSOC6_02
	select SOC_PACKAGE_PSOC6_02_124_BGA
	select SOC_SERIES_PSOC6_62

config SOC_CY8C624ABZI_S2D44
	bool
	select SOC_DIE_PSOC6_02
	select SOC_PACKAGE_PSOC6_02_124_BGA
	select SOC_SERIES_PSOC6_62

config SOC_CY8C624AAZI_S2D44
	bool
	select SOC_DIE_PSOC6_02
	select SOC_PACKAGE_PSOC6_02_128_TQFP
	select SOC_SERIES_PSOC6_62

config SOC_CY8C624AFNI_S2D43
	bool
	select SOC_DIE_PSOC6_02
	select SOC_PACKAGE_PSOC6_02_100_WLCSP
	select SOC_SERIES_PSOC6_62

config SOC_CY8C624ABZI_S2D04
	bool
	select SOC_DIE_PSOC6_02
	select SOC_PACKAGE_PSOC6_02_124_BGA
	select SOC_SERIES_PSOC6_62

config SOC_CY8C624ABZI_S2D14
	bool
	select SOC_DIE_PSOC6_02
	select SOC_PACKAGE_PSOC6_02_124_BGA
	select SOC_SERIES_PSOC6_62

config SOC_CY8C624AAZI_S2D14
	bool
	select SOC_DIE_PSOC6_02
	select SOC_PACKAGE_PSOC6_02_128_TQFP
	select SOC_SERIES_PSOC6_62

config SOC_CY8C6248AZI_S2D14
	bool
	select SOC_DIE_PSOC6_02
	select SOC_PACKAGE_PSOC6_02_128_TQFP
	select SOC_SERIES_PSOC6_62

config SOC_CY8C6248BZI_S2D44
	bool
	select SOC_DIE_PSOC6_02
	select SOC_PACKAGE_PSOC6_02_124_BGA
	select SOC_SERIES_PSOC6_62

config SOC_CY8C6248AZI_S2D44
	bool
	select SOC_DIE_PSOC6_02
	select SOC_PACKAGE_PSOC6_02_128_TQFP
	select SOC_SERIES_PSOC6_62

config SOC_CY8C6248FNI_S2D43
	bool
	select SOC_DIE_PSOC6_02
	select SOC_PACKAGE_PSOC6_02_100_WLCSP
	select SOC_SERIES_PSOC6_62

config SOC_CY8C614ABZI_S2F04
	bool
	select SOC_DIE_PSOC6_02
	select SOC_PACKAGE_PSOC6_02_124_BGA
	select SOC_SERIES_PSOC6_61

config SOC_CY8C614AAZI_S2F04
	bool
	select SOC_DIE_PSOC6_02
	select SOC_PACKAGE_PSOC6_02_128_TQFP
	select SOC_SERIES_PSOC6_61

config SOC_CY8C614AFNI_S2F03
	bool
	select SOC_DIE_PSOC6_02
	select SOC_PACKAGE_PSOC6_02_100_WLCSP
	select SOC_SERIES_PSOC6_61

config SOC_CY8C614AAZI_S2F14
	bool
	select SOC_DIE_PSOC6_02
	select SOC_PACKAGE_PSOC6_02_128_TQFP
	select SOC_SERIES_PSOC6_61

config SOC_CY8C614ABZI_S2F44
	bool
	select SOC_DIE_PSOC6_02
	select SOC_PACKAGE_PSOC6_02_124_BGA
	select SOC_SERIES_PSOC6_61

config SOC_CY8C614AAZI_S2F44
	bool
	select SOC_DIE_PSOC6_02
	select SOC_PACKAGE_PSOC6_02_128_TQFP
	select SOC_SERIES_PSOC6_61

config SOC_CY8C614AFNI_S2F43
	bool
	select SOC_DIE_PSOC6_02
	select SOC_PACKAGE_PSOC6_02_100_WLCSP
	select SOC_SERIES_PSOC6_61

config SOC_CY8C6148BZI_S2F44
	bool
	select SOC_DIE_PSOC6_02
	select SOC_PACKAGE_PSOC6_02_124_BGA
	select SOC_SERIES_PSOC6_61

config SOC_CY8C6148AZI_S2F44
	bool
	select SOC_DIE_PSOC6_02
	select SOC_PACKAGE_PSOC6_02_128_TQFP
	select SOC_SERIES_PSOC6_61

config SOC_CY8C6148FNI_S2F43
	bool
	select SOC_DIE_PSOC6_02
	select SOC_PACKAGE_PSOC6_02_100_WLCSP
	select SOC_SERIES_PSOC6_61

config SOC_CY8C624ABZI_D44
	bool
	select SOC_DIE_PSOC6_02
	select SOC_PACKAGE_PSOC6_02_124_BGA
	select SOC_SERIES_PSOC6_62

config SOC_CY8C624ALQI_S2D42
	bool
	select SOC_DIE_PSOC6_02
	select SOC_PACKAGE_PSOC6_02_68_QFN
	select SOC_SERIES_PSOC6_62

config SOC_CY8C624ALQI_S2D02
	bool
	select SOC_DIE_PSOC6_02
	select SOC_PACKAGE_PSOC6_02_68_QFN
	select SOC_SERIES_PSOC6_62

config SOC_CY8C6248LQI_S2D42
	bool
	select SOC_DIE_PSOC6_02
	select SOC_PACKAGE_PSOC6_02_68_QFN
	select SOC_SERIES_PSOC6_62

config SOC_CY8C6248LQI_S2D02
	bool
	select SOC_DIE_PSOC6_02
	select SOC_PACKAGE_PSOC6_02_68_QFN
	select SOC_SERIES_PSOC6_62

config SOC_CY8C614ALQI_S2F42
	bool
	select SOC_DIE_PSOC6_02
	select SOC_PACKAGE_PSOC6_02_68_QFN
	select SOC_SERIES_PSOC6_61

config SOC_CY8C614ALQI_S2F02
	bool
	select SOC_DIE_PSOC6_02
	select SOC_PACKAGE_PSOC6_02_68_QFN
	select SOC_SERIES_PSOC6_61

config SOC_CY8C6148LQI_S2F42
	bool
	select SOC_DIE_PSOC6_02
	select SOC_PACKAGE_PSOC6_02_68_QFN
	select SOC_SERIES_PSOC6_61

config SOC_CY8C6148LQI_S2F02
	bool
	select SOC_DIE_PSOC6_02
	select SOC_PACKAGE_PSOC6_02_68_QFN
	select SOC_SERIES_PSOC6_61

config SOC
	default "cyb0644abzi_s2d44" if SOC_CYB0644ABZI_S2D44
	default "cys0644abzi_s2d44" if SOC_CYS0644ABZI_S2D44
	default "cys0644afni_s2d43" if SOC_CYS0644AFNI_S2D43
	default "cy8c624abzi_s2d44a0" if SOC_CY8C624ABZI_S2D44A0
	default "cy8c624abzi_s2d44" if SOC_CY8C624ABZI_S2D44
	default "cy8c624aazi_s2d44" if SOC_CY8C624AAZI_S2D44
	default "cy8c624afni_s2d43" if SOC_CY8C624AFNI_S2D43
	default "cy8c624abzi_s2d04" if SOC_CY8C624ABZI_S2D04
	default "cy8c624abzi_s2d14" if SOC_CY8C624ABZI_S2D14
	default "cy8c624aazi_s2d14" if SOC_CY8C624AAZI_S2D14
	default "cy8c6248azi_s2d14" if SOC_CY8C6248AZI_S2D14
	default "cy8c6248bzi_s2d44" if SOC_CY8C6248BZI_S2D44
	default "cy8c6248azi_s2d44" if SOC_CY8C6248AZI_S2D44
	default "cy8c6248fni_s2d43" if SOC_CY8C6248FNI_S2D43
	default "cy8c614abzi_s2f04" if SOC_CY8C614ABZI_S2F04
	default "cy8c614aazi_s2f04" if SOC_CY8C614AAZI_S2F04
	default "cy8c614afni_s2f03" if SOC_CY8C614AFNI_S2F03
	default "cy8c614aazi_s2f14" if SOC_CY8C614AAZI_S2F14
	default "cy8c614abzi_s2f44" if SOC_CY8C614ABZI_S2F44
	default "cy8c614aazi_s2f44" if SOC_CY8C614AAZI_S2F44
	default "cy8c614afni_s2f43" if SOC_CY8C614AFNI_S2F43
	default "cy8c6148bzi_s2f44" if SOC_CY8C6148BZI_S2F44
	default "cy8c6148azi_s2f44" if SOC_CY8C6148AZI_S2F44
	default "cy8c6148fni_s2f43" if SOC_CY8C6148FNI_S2F43
	default "cy8c624abzi_d44" if SOC_CY8C624ABZI_D44
	default "cy8c624alqi_s2d42" if SOC_CY8C624ALQI_S2D42
	default "cy8c624alqi_s2d02" if SOC_CY8C624ALQI_S2D02
	default "cy8c6248lqi_s2d42" if SOC_CY8C6248LQI_S2D42
	default "cy8c6248lqi_s2d02" if SOC_CY8C6248LQI_S2D02
	default "cy8c614alqi_s2f42" if SOC_CY8C614ALQI_S2F42
	default "cy8c614alqi_s2f02" if SOC_CY8C614ALQI_S2F02
	default "cy8c6148lqi_s2f42" if SOC_CY8C6148LQI_S2F42
	default "cy8c6148lqi_s2f02" if SOC_CY8C6148LQI_S2F02
```

## soc/infineon/cat1a/psoc6_03/Kconfig.defconfig
```kconfig
# Copyright (c) 2023 Cypress Semiconductor Corporation (an Infineon company) or
# an affiliate of Cypress Semiconductor Corporation
# SPDX-License-Identifier: Apache-2.0

# Infineon PSOC 6_03 based MCU default configuration

if SOC_DIE_PSOC6_03

config NUM_IRQS
	default 16 if CPU_CORTEX_M0PLUS
	default 174 if CPU_CORTEX_M4

config SYS_CLOCK_HW_CYCLES_PER_SEC
	default 100000000

config MAIN_STACK_SIZE
	default 2048

config IDLE_STACK_SIZE
	default 1024 if PM

# add additional die specific params

endif # SOC_DIE_PSOC6_03
```

## soc/infineon/cat1a/psoc6_03/Kconfig.soc
```kconfig
# Copyright (c) 2023 Cypress Semiconductor Corporation (an Infineon company) or
# an affiliate of Cypress Semiconductor Corporation
# SPDX-License-Identifier: Apache-2.0

# SOC die
config SOC_DIE_PSOC6_03
	bool

# SOC packages
config SOC_PACKAGE_PSOC6_03_100_TQFP
	bool

config SOC_PACKAGE_PSOC6_03_68_QFN
	bool

config SOC_PACKAGE_PSOC6_03_49_WLCSP
	bool

# Infineon PSOC 6_03 series MCUs
config SOC_CY8C6245AZI_S3D72
	bool
	select SOC_DIE_PSOC6_03
	select SOC_PACKAGE_PSOC6_03_100_TQFP
	select SOC_SERIES_PSOC6_62

config SOC_CY8C6245LQI_S3D72
	bool
	select SOC_DIE_PSOC6_03
	select SOC_PACKAGE_PSOC6_03_68_QFN
	select SOC_SERIES_PSOC6_62

config SOC_CY8C6245FNI_S3D71
	bool
	select SOC_DIE_PSOC6_03
	select SOC_PACKAGE_PSOC6_03_49_WLCSP
	select SOC_SERIES_PSOC6_62

config SOC_CY8C6245AZI_S3D62
	bool
	select SOC_DIE_PSOC6_03
	select SOC_PACKAGE_PSOC6_03_100_TQFP
	select SOC_SERIES_PSOC6_62

config SOC_CY8C6245LQI_S3D62
	bool
	select SOC_DIE_PSOC6_03
	select SOC_PACKAGE_PSOC6_03_68_QFN
	select SOC_SERIES_PSOC6_62

config SOC_CY8C6245AZI_S3D42
	bool
	select SOC_DIE_PSOC6_03
	select SOC_PACKAGE_PSOC6_03_100_TQFP
	select SOC_SERIES_PSOC6_62

config SOC_CY8C6245LQI_S3D42
	bool
	select SOC_DIE_PSOC6_03
	select SOC_PACKAGE_PSOC6_03_68_QFN
	select SOC_SERIES_PSOC6_62

config SOC_CYB06445LQI_S3D42
	bool
	select SOC_DIE_PSOC6_03
	select SOC_PACKAGE_PSOC6_03_68_QFN
	select SOC_SERIES_PSOC6_64

config SOC_CY8C6245FNI_S3D41
	bool
	select SOC_DIE_PSOC6_03
	select SOC_PACKAGE_PSOC6_03_49_WLCSP
	select SOC_SERIES_PSOC6_62

config SOC_CY8C6245AZI_S3D12
	bool
	select SOC_DIE_PSOC6_03
	select SOC_PACKAGE_PSOC6_03_100_TQFP
	select SOC_SERIES_PSOC6_62

config SOC_CY8C6245LQI_S3D12
	bool
	select SOC_DIE_PSOC6_03
	select SOC_PACKAGE_PSOC6_03_68_QFN
	select SOC_SERIES_PSOC6_62

config SOC_CY8C6245FNI_S3D11
	bool
	select SOC_DIE_PSOC6_03
	select SOC_PACKAGE_PSOC6_03_49_WLCSP
	select SOC_SERIES_PSOC6_62

config SOC_CY8C6245AZI_S3D02
	bool
	select SOC_DIE_PSOC6_03
	select SOC_PACKAGE_PSOC6_03_100_TQFP
	select SOC_SERIES_PSOC6_62

config SOC_CY8C6245LQI_S3D02
	bool
	select SOC_DIE_PSOC6_03
	select SOC_PACKAGE_PSOC6_03_68_QFN
	select SOC_SERIES_PSOC6_62

config SOC_CY8C6145AZI_S3F72
	bool
	select SOC_DIE_PSOC6_03
	select SOC_PACKAGE_PSOC6_03_100_TQFP
	select SOC_SERIES_PSOC6_61

config SOC_CY8C6145LQI_S3F72
	bool
	select SOC_DIE_PSOC6_03
	select SOC_PACKAGE_PSOC6_03_68_QFN
	select SOC_SERIES_PSOC6_61

config SOC_CY8C6145FNI_S3F71
	bool
	select SOC_DIE_PSOC6_03
	select SOC_PACKAGE_PSOC6_03_49_WLCSP
	select SOC_SERIES_PSOC6_61

config SOC_CY8C6145AZI_S3F62
	bool
	select SOC_DIE_PSOC6_03
	select SOC_PACKAGE_PSOC6_03_100_TQFP
	select SOC_SERIES_PSOC6_61

config SOC_CY8C6145LQI_S3F62
	bool
	select SOC_DIE_PSOC6_03
	select SOC_PACKAGE_PSOC6_03_68_QFN
	select SOC_SERIES_PSOC6_61

config SOC_CY8C6145AZI_S3F42
	bool
	select SOC_DIE_PSOC6_03
	select SOC_PACKAGE_PSOC6_03_100_TQFP
	select SOC_SERIES_PSOC6_61

config SOC_CY8C6145LQI_S3F42
	bool
	select SOC_DIE_PSOC6_03
	select SOC_PACKAGE_PSOC6_03_68_QFN
	select SOC_SERIES_PSOC6_61

config SOC_CY8C6145FNI_S3F41
	bool
	select SOC_DIE_PSOC6_03
	select SOC_PACKAGE_PSOC6_03_49_WLCSP
	select SOC_SERIES_PSOC6_61

config SOC_CY8C6145AZI_S3F12
	bool
	select SOC_DIE_PSOC6_03
	select SOC_PACKAGE_PSOC6_03_100_TQFP
	select SOC_SERIES_PSOC6_61

config SOC_CY8C6145LQI_S3F12
	bool
	select SOC_DIE_PSOC6_03
	select SOC_PACKAGE_PSOC6_03_68_QFN
	select SOC_SERIES_PSOC6_61

config SOC_CY8C6145FNI_S3F11
	bool
	select SOC_DIE_PSOC6_03
	select SOC_PACKAGE_PSOC6_03_49_WLCSP
	select SOC_SERIES_PSOC6_61

config SOC_CY8C6145AZI_S3F02
	bool
	select SOC_DIE_PSOC6_03
	select SOC_PACKAGE_PSOC6_03_100_TQFP
	select SOC_SERIES_PSOC6_61

config SOC_CY8C6145LQI_S3F02
	bool
	select SOC_DIE_PSOC6_03
	select SOC_PACKAGE_PSOC6_03_68_QFN
	select SOC_SERIES_PSOC6_61

config SOC
	default "cy8c6245azi_s3d72" if SOC_CY8C6245AZI_S3D72
	default "cy8c6245lqi_s3d72" if SOC_CY8C6245LQI_S3D72
	default "cy8c6245fni_s3d71" if SOC_CY8C6245FNI_S3D71
	default "cy8c6245azi_s3d62" if SOC_CY8C6245AZI_S3D62
	default "cy8c6245lqi_s3d62" if SOC_CY8C6245LQI_S3D62
	default "cy8c6245azi_s3d42" if SOC_CY8C6245AZI_S3D42
	default "cy8c6245lqi_s3d42" if SOC_CY8C6245LQI_S3D42
	default "cyb06445lqi_s3d42" if SOC_CYB06445LQI_S3D42
	default "cy8c6245fni_s3d41" if SOC_CY8C6245FNI_S3D41
	default "cy8c6245azi_s3d12" if SOC_CY8C6245AZI_S3D12
	default "cy8c6245lqi_s3d12" if SOC_CY8C6245LQI_S3D12
	default "cy8c6245fni_s3d11" if SOC_CY8C6245FNI_S3D11
	default "cy8c6245azi_s3d02" if SOC_CY8C6245AZI_S3D02
	default "cy8c6245lqi_s3d02" if SOC_CY8C6245LQI_S3D02
	default "cy8c6145azi_s3f72" if SOC_CY8C6145AZI_S3F72
	default "cy8c6145lqi_s3f72" if SOC_CY8C6145LQI_S3F72
	default "cy8c6145fni_s3f71" if SOC_CY8C6145FNI_S3F71
	default "cy8c6145azi_s3f62" if SOC_CY8C6145AZI_S3F62
	default "cy8c6145lqi_s3f62" if SOC_CY8C6145LQI_S3F62
	default "cy8c6145azi_s3f42" if SOC_CY8C6145AZI_S3F42
	default "cy8c6145lqi_s3f42" if SOC_CY8C6145LQI_S3F42
	default "cy8c6145fni_s3f41" if SOC_CY8C6145FNI_S3F41
	default "cy8c6145azi_s3f12" if SOC_CY8C6145AZI_S3F12
	default "cy8c6145lqi_s3f12" if SOC_CY8C6145LQI_S3F12
	default "cy8c6145fni_s3f11" if SOC_CY8C6145FNI_S3F11
	default "cy8c6145azi_s3f02" if SOC_CY8C6145AZI_S3F02
	default "cy8c6145lqi_s3f02" if SOC_CY8C6145LQI_S3F02
```
