## soc/infineon/cat1a/psoc6_01/Kconfig.soc
```kconfig
# Copyright (c) 2023 Cypress Semiconductor Corporation (an Infineon company) or
# an affiliate of Cypress Semiconductor Corporation
# SPDX-License-Identifier: Apache-2.0

# SOC die
config SOC_DIE_PSOC6_01
	bool

# SOC packages
config SOC_PACKAGE_PSOC6_01_124_BGA
	bool

config SOC_PACKAGE_PSOC6_01_116_BGA_BLE
	bool

config SOC_PACKAGE_PSOC6_01_104_M_CSP_BLE
	bool

config SOC_PACKAGE_PSOC6_01_80_WLCSP
	bool

config SOC_PACKAGE_PSOC6_01_116_BGA_USB
	bool

config SOC_PACKAGE_PSOC6_01_124_BGA_SIP
	bool

config SOC_PACKAGE_PSOC6_01_104_M_CSP_BLE_USB
	bool

config SOC_PACKAGE_PSOC6_01_68_QFN_BLE
	bool

# Infineon PSoC6_01 series MCUs
config SOC_CY8C6036BZI_F04
	bool
	select SOC_DIE_PSOC6_01
	select SOC_PACKAGE_PSOC6_01_124_BGA
	select SOC_SERIES_PSOC6_60

config SOC_CY8C6016BZI_F04
	bool
	select SOC_DIE_PSOC6_01
	select SOC_PACKAGE_PSOC6_01_124_BGA
	select SOC_SERIES_PSOC6_60

config SOC_CY8C6116BZI_F54
	bool
	select SOC_DIE_PSOC6_01
	select SOC_PACKAGE_PSOC6_01_124_BGA
	select SOC_SERIES_PSOC6_61

config SOC_CY8C6136BZI_F14
	bool
	select SOC_DIE_PSOC6_01
	select SOC_PACKAGE_PSOC6_01_124_BGA
	select SOC_SERIES_PSOC6_61

config SOC_CY8C6136BZI_F34
	bool
	select SOC_DIE_PSOC6_01
	select SOC_PACKAGE_PSOC6_01_124_BGA
	select SOC_SERIES_PSOC6_61

config SOC_CY8C6137BZI_F14
	bool
	select SOC_DIE_PSOC6_01
	select SOC_PACKAGE_PSOC6_01_124_BGA
	select SOC_SERIES_PSOC6_61

config SOC_CY8C6137BZI_F34
	bool
	select SOC_DIE_PSOC6_01
	select SOC_PACKAGE_PSOC6_01_124_BGA
	select SOC_SERIES_PSOC6_61

config SOC_CY8C6137BZI_F54
	bool
	select SOC_DIE_PSOC6_01
	select SOC_PACKAGE_PSOC6_01_124_BGA
	select SOC_SERIES_PSOC6_61

config SOC_CY8C6117BZI_F34
	bool
	select SOC_DIE_PSOC6_01
	select SOC_PACKAGE_PSOC6_01_124_BGA
	select SOC_SERIES_PSOC6_61

config SOC_CY8C6246BZI_D04
	bool
	select SOC_DIE_PSOC6_01
	select SOC_PACKAGE_PSOC6_01_124_BGA
	select SOC_SERIES_PSOC6_62

config SOC_CY8C6247BZI_D44
	bool
	select SOC_DIE_PSOC6_01
	select SOC_PACKAGE_PSOC6_01_124_BGA
	select SOC_SERIES_PSOC6_62

config SOC_CY8C6247BZI_D34
	bool
	select SOC_DIE_PSOC6_01
	select SOC_PACKAGE_PSOC6_01_124_BGA
	select SOC_SERIES_PSOC6_62

config SOC_CY8C6247BZI_D54
	bool
	select SOC_DIE_PSOC6_01
	select SOC_PACKAGE_PSOC6_01_124_BGA
	select SOC_SERIES_PSOC6_62

config SOC_CY8C6336BZI_BLF03
	bool
	select SOC_DIE_PSOC6_01
	select SOC_PACKAGE_PSOC6_01_116_BGA_BLE
	select SOC_SERIES_PSOC6_63

config SOC_CY8C6316BZI_BLF03
	bool
	select SOC_DIE_PSOC6_01
	select SOC_PACKAGE_PSOC6_01_116_BGA_BLE
	select SOC_SERIES_PSOC6_63

config SOC_CY8C6316BZI_BLF53
	bool
	select SOC_DIE_PSOC6_01
	select SOC_PACKAGE_PSOC6_01_116_BGA_BLE
	select SOC_SERIES_PSOC6_63

config SOC_CY8C6336BZI_BLD13
	bool
	select SOC_DIE_PSOC6_01
	select SOC_PACKAGE_PSOC6_01_116_BGA_BLE
	select SOC_SERIES_PSOC6_63

config SOC_CY8C6347BZI_BLD43
	bool
	select SOC_DIE_PSOC6_01
	select SOC_PACKAGE_PSOC6_01_116_BGA_BLE
	select SOC_SERIES_PSOC6_63

config SOC_CY8C6347BZI_BLD33
	bool
	select SOC_DIE_PSOC6_01
	select SOC_PACKAGE_PSOC6_01_116_BGA_BLE
	select SOC_SERIES_PSOC6_63

config SOC_CY8C6347BZI_BLD53
	bool
	select SOC_DIE_PSOC6_01
	select SOC_PACKAGE_PSOC6_01_116_BGA_BLE
	select SOC_SERIES_PSOC6_63

config SOC_CY8C6347FMI_BLD13
	bool
	select SOC_DIE_PSOC6_01
	select SOC_PACKAGE_PSOC6_01_104_M_CSP_BLE
	select SOC_SERIES_PSOC6_63

config SOC_CY8C6347FMI_BLD43
	bool
	select SOC_DIE_PSOC6_01
	select SOC_PACKAGE_PSOC6_01_104_M_CSP_BLE
	select SOC_SERIES_PSOC6_63

config SOC_CY8C6347FMI_BLD33
	bool
	select SOC_DIE_PSOC6_01
	select SOC_PACKAGE_PSOC6_01_104_M_CSP_BLE
	select SOC_SERIES_PSOC6_63

config SOC_CY8C6347FMI_BLD53
	bool
	select SOC_DIE_PSOC6_01
	select SOC_PACKAGE_PSOC6_01_104_M_CSP_BLE
	select SOC_SERIES_PSOC6_63

config SOC_CY8C6137FDI_F02
	bool
	select SOC_DIE_PSOC6_01
	select SOC_PACKAGE_PSOC6_01_80_WLCSP
	select SOC_SERIES_PSOC6_61

config SOC_CY8C6117FDI_F02
	bool
	select SOC_DIE_PSOC6_01
	select SOC_PACKAGE_PSOC6_01_80_WLCSP
	select SOC_SERIES_PSOC6_61

config SOC_CY8C6247FDI_D02
	bool
	select SOC_DIE_PSOC6_01
	select SOC_PACKAGE_PSOC6_01_80_WLCSP
	select SOC_SERIES_PSOC6_62

config SOC_CY8C6247FDI_D32
	bool
	select SOC_DIE_PSOC6_01
	select SOC_PACKAGE_PSOC6_01_80_WLCSP
	select SOC_SERIES_PSOC6_62

config SOC_CY8C6336BZI_BUD13
	bool
	select SOC_DIE_PSOC6_01
	select SOC_PACKAGE_PSOC6_01_116_BGA_USB
	select SOC_SERIES_PSOC6_63

config SOC_CY8C6347BZI_BUD43
	bool
	select SOC_DIE_PSOC6_01
	select SOC_PACKAGE_PSOC6_01_116_BGA_USB
	select SOC_SERIES_PSOC6_63

config SOC_CY8C6347BZI_BUD33
	bool
	select SOC_DIE_PSOC6_01
	select SOC_PACKAGE_PSOC6_01_116_BGA_USB
	select SOC_SERIES_PSOC6_63

config SOC_CY8C6347BZI_BUD53
	bool
	select SOC_DIE_PSOC6_01
	select SOC_PACKAGE_PSOC6_01_116_BGA_USB
	select SOC_SERIES_PSOC6_63

config SOC_CY8C6337BZI_BLF13
	bool
	select SOC_DIE_PSOC6_01
	select SOC_PACKAGE_PSOC6_01_116_BGA_BLE
	select SOC_SERIES_PSOC6_63

config SOC_CY8C6136FDI_F42
	bool
	select SOC_DIE_PSOC6_01
	select SOC_PACKAGE_PSOC6_01_80_WLCSP
	select SOC_SERIES_PSOC6_61

config SOC_CY8C6247FDI_D52
	bool
	select SOC_DIE_PSOC6_01
	select SOC_PACKAGE_PSOC6_01_80_WLCSP
	select SOC_SERIES_PSOC6_62

config SOC_CY8C6136FTI_F42
	bool
	select SOC_DIE_PSOC6_01
	select SOC_PACKAGE_PSOC6_01_80_WLCSP
	select SOC_SERIES_PSOC6_61

config SOC_CY8C6247FTI_D52
	bool
	select SOC_DIE_PSOC6_01
	select SOC_PACKAGE_PSOC6_01_80_WLCSP
	select SOC_SERIES_PSOC6_62

config SOC_CY8C6247BZI_AUD54
	bool
	select SOC_DIE_PSOC6_01
	select SOC_PACKAGE_PSOC6_01_124_BGA
	select SOC_SERIES_PSOC6_62

config SOC_CY8C6336BZI_BLF04
	bool
	select SOC_DIE_PSOC6_01
	select SOC_PACKAGE_PSOC6_01_124_BGA_SIP
	select SOC_SERIES_PSOC6_63

config SOC_CY8C6316BZI_BLF04
	bool
	select SOC_DIE_PSOC6_01
	select SOC_PACKAGE_PSOC6_01_124_BGA_SIP
	select SOC_SERIES_PSOC6_63

config SOC_CY8C6316BZI_BLF54
	bool
	select SOC_DIE_PSOC6_01
	select SOC_PACKAGE_PSOC6_01_124_BGA_SIP
	select SOC_SERIES_PSOC6_63

config SOC_CY8C6336BZI_BLD14
	bool
	select SOC_DIE_PSOC6_01
	select SOC_PACKAGE_PSOC6_01_124_BGA_SIP
	select SOC_SERIES_PSOC6_63

config SOC_CY8C6347BZI_BLD44
	bool
	select SOC_DIE_PSOC6_01
	select SOC_PACKAGE_PSOC6_01_124_BGA_SIP
	select SOC_SERIES_PSOC6_63

config SOC_CY8C6347BZI_BLD34
	bool
	select SOC_DIE_PSOC6_01
	select SOC_PACKAGE_PSOC6_01_124_BGA_SIP
	select SOC_SERIES_PSOC6_63

config SOC_CY8C6347BZI_BLD54
	bool
	select SOC_DIE_PSOC6_01
	select SOC_PACKAGE_PSOC6_01_124_BGA_SIP
	select SOC_SERIES_PSOC6_63

config SOC_CY8C6247BFI_D54
	bool
	select SOC_DIE_PSOC6_01
	select SOC_PACKAGE_PSOC6_01_124_BGA
	select SOC_SERIES_PSOC6_62

config SOC_CY8C6347FMI_BUD53
	bool
	select SOC_DIE_PSOC6_01
	select SOC_PACKAGE_PSOC6_01_104_M_CSP_BLE_USB
	select SOC_SERIES_PSOC6_63

config SOC_CY8C6347FMI_BUD13
	bool
	select SOC_DIE_PSOC6_01
	select SOC_PACKAGE_PSOC6_01_104_M_CSP_BLE_USB
	select SOC_SERIES_PSOC6_63

config SOC_CY8C6347FMI_BUD43
	bool
	select SOC_DIE_PSOC6_01
	select SOC_PACKAGE_PSOC6_01_104_M_CSP_BLE_USB
	select SOC_SERIES_PSOC6_63

config SOC_CY8C6347FMI_BUD33
	bool
	select SOC_DIE_PSOC6_01
	select SOC_PACKAGE_PSOC6_01_104_M_CSP_BLE_USB
	select SOC_SERIES_PSOC6_63

config SOC_CY8C6137WI_F54
	bool
	select SOC_DIE_PSOC6_01
	select SOC_PACKAGE_PSOC6_01_124_BGA
	select SOC_SERIES_PSOC6_61

config SOC_CY8C6117WI_F34
	bool
	select SOC_DIE_PSOC6_01
	select SOC_PACKAGE_PSOC6_01_124_BGA
	select SOC_SERIES_PSOC6_61

config SOC_CY8C6247WI_D54
	bool
	select SOC_DIE_PSOC6_01
	select SOC_PACKAGE_PSOC6_01_124_BGA
	select SOC_SERIES_PSOC6_62

config SOC_CY8C6336LQI_BLF02
	bool
	select SOC_DIE_PSOC6_01
	select SOC_PACKAGE_PSOC6_01_68_QFN_BLE
	select SOC_SERIES_PSOC6_63

config SOC_CY8C6336LQI_BLF42
	bool
	select SOC_DIE_PSOC6_01
	select SOC_PACKAGE_PSOC6_01_68_QFN_BLE
	select SOC_SERIES_PSOC6_63

config SOC_CY8C6347LQI_BLD52
	bool
	select SOC_DIE_PSOC6_01
	select SOC_PACKAGE_PSOC6_01_68_QFN_BLE
	select SOC_SERIES_PSOC6_63

config SOC_CY8C6247BTI_D54
	bool
	select SOC_DIE_PSOC6_01
	select SOC_PACKAGE_PSOC6_01_124_BGA
	select SOC_SERIES_PSOC6_62

config SOC_CY8C6246BTI_D54
	bool
	select SOC_DIE_PSOC6_01
	select SOC_PACKAGE_PSOC6_01_124_BGA
	select SOC_SERIES_PSOC6_62

config SOC_CY8C6147BTI_F54
	bool
	select SOC_DIE_PSOC6_01
	select SOC_PACKAGE_PSOC6_01_124_BGA
	select SOC_SERIES_PSOC6_61

config SOC_CY8C6146BTI_F54
	bool
	select SOC_DIE_PSOC6_01
	select SOC_PACKAGE_PSOC6_01_124_BGA
	select SOC_SERIES_PSOC6_61

config SOC_CYB06447BZI_BLD54
	bool
	select SOC_DIE_PSOC6_01
	select SOC_PACKAGE_PSOC6_01_124_BGA_SIP
	select SOC_SERIES_PSOC6_64

config SOC_CYB06447BZI_BLD53
	bool
	select SOC_DIE_PSOC6_01
	select SOC_PACKAGE_PSOC6_01_116_BGA_BLE
	select SOC_SERIES_PSOC6_64

config SOC_CYB06447BZI_D54
	bool
	select SOC_DIE_PSOC6_01
	select SOC_PACKAGE_PSOC6_01_124_BGA
	select SOC_SERIES_PSOC6_64

config SOC_CYBLE_416045_02
	bool
	select SOC_DIE_PSOC6_01
	select SOC_PACKAGE_PSOC6_01_116_BGA_BLE
	select SOC_SERIES_PSOC6_63

config SOC
	default "cy8c6036bzi_f04" if SOC_CY8C6036BZI_F04
	default "cy8c6016bzi_f04" if SOC_CY8C6016BZI_F04
	default "cy8c6116bzi_f54" if SOC_CY8C6116BZI_F54
	default "cy8c6136bzi_f14" if SOC_CY8C6136BZI_F14
	default "cy8c6136bzi_f34" if SOC_CY8C6136BZI_F34
	default "cy8c6137bzi_f14" if SOC_CY8C6137BZI_F14
	default "cy8c6137bzi_f34" if SOC_CY8C6137BZI_F34
	default "cy8c6137bzi_f54" if SOC_CY8C6137BZI_F54
	default "cy8c6117bzi_f34" if SOC_CY8C6117BZI_F34
	default "cy8c6246bzi_d04" if SOC_CY8C6246BZI_D04
	default "cy8c6247bzi_d44" if SOC_CY8C6247BZI_D44
	default "cy8c6247bzi_d34" if SOC_CY8C6247BZI_D34
	default "cy8c6247bzi_d54" if SOC_CY8C6247BZI_D54
	default "cy8c6336bzi_blf03" if SOC_CY8C6336BZI_BLF03
	default "cy8c6316bzi_blf03" if SOC_CY8C6316BZI_BLF03
	default "cy8c6316bzi_blf53" if SOC_CY8C6316BZI_BLF53
	default "cy8c6336bzi_bld13" if SOC_CY8C6336BZI_BLD13
	default "cy8c6347bzi_bld43" if SOC_CY8C6347BZI_BLD43
	default "cy8c6347bzi_bld33" if SOC_CY8C6347BZI_BLD33
	default "cy8c6347bzi_bld53" if SOC_CY8C6347BZI_BLD53
	default "cy8c6347fmi_bld13" if SOC_CY8C6347FMI_BLD13
	default "cy8c6347fmi_bld43" if SOC_CY8C6347FMI_BLD43
	default "cy8c6347fmi_bld33" if SOC_CY8C6347FMI_BLD33
	default "cy8c6347fmi_bld53" if SOC_CY8C6347FMI_BLD53
	default "cy8c6137fdi_f02" if SOC_CY8C6137FDI_F02
	default "cy8c6117fdi_f02" if SOC_CY8C6117FDI_F02
	default "cy8c6247fdi_d02" if SOC_CY8C6247FDI_D02
	default "cy8c6247fdi_d32" if SOC_CY8C6247FDI_D32
	default "cy8c6336bzi_bud13" if SOC_CY8C6336BZI_BUD13
	default "cy8c6347bzi_bud43" if SOC_CY8C6347BZI_BUD43
	default "cy8c6347bzi_bud33" if SOC_CY8C6347BZI_BUD33
	default "cy8c6347bzi_bud53" if SOC_CY8C6347BZI_BUD53
	default "cy8c6337bzi_blf13" if SOC_CY8C6337BZI_BLF13
	default "cy8c6136fdi_f42" if SOC_CY8C6136FDI_F42
	default "cy8c6247fdi_d52" if SOC_CY8C6247FDI_D52
	default "cy8c6136fti_f42" if SOC_CY8C6136FTI_F42
	default "cy8c6247fti_d52" if SOC_CY8C6247FTI_D52
	default "cy8c6247bzi_aud54" if SOC_CY8C6247BZI_AUD54
	default "cy8c6336bzi_blf04" if SOC_CY8C6336BZI_BLF04
	default "cy8c6316bzi_blf04" if SOC_CY8C6316BZI_BLF04
	default "cy8c6316bzi_blf54" if SOC_CY8C6316BZI_BLF54
	default "cy8c6336bzi_bld14" if SOC_CY8C6336BZI_BLD14
	default "cy8c6347bzi_bld44" if SOC_CY8C6347BZI_BLD44
	default "cy8c6347bzi_bld34" if SOC_CY8C6347BZI_BLD34
	default "cy8c6347bzi_bld54" if SOC_CY8C6347BZI_BLD54
	default "cy8c6247bfi_d54" if SOC_CY8C6247BFI_D54
	default "cy8c6347fmi_bud53" if SOC_CY8C6347FMI_BUD53
	default "cy8c6347fmi_bud13" if SOC_CY8C6347FMI_BUD13
	default "cy8c6347fmi_bud43" if SOC_CY8C6347FMI_BUD43
	default "cy8c6347fmi_bud33" if SOC_CY8C6347FMI_BUD33
	default "cy8c6137wi_f54" if SOC_CY8C6137WI_F54
	default "cy8c6117wi_f34" if SOC_CY8C6117WI_F34
	default "cy8c6247wi_d54" if SOC_CY8C6247WI_D54
	default "cy8c6336lqi_blf02" if SOC_CY8C6336LQI_BLF02
	default "cy8c6336lqi_blf42" if SOC_CY8C6336LQI_BLF42
	default "cy8c6347lqi_bld52" if SOC_CY8C6347LQI_BLD52
	default "cy8c6247bti_d54" if SOC_CY8C6247BTI_D54
	default "cy8c6246bti_d54" if SOC_CY8C6246BTI_D54
	default "cy8c6147bti_f54" if SOC_CY8C6147BTI_F54
	default "cy8c6146bti_f54" if SOC_CY8C6146BTI_F54
	default "cyb06447bzi_bld54" if SOC_CYB06447BZI_BLD54
	default "cyb06447bzi_bld53" if SOC_CYB06447BZI_BLD53
	default "cyb06447bzi_d54" if SOC_CYB06447BZI_D54
	default "cyble_416045_02" if SOC_CYBLE_416045_02
```

## soc/infineon/cat1a/psoc6_02/Kconfig.defconfig
```kconfig
# Copyright (c) 2023 Cypress Semiconductor Corporation (an Infineon company) or
# an affiliate of Cypress Semiconductor Corporation
# SPDX-License-Identifier: Apache-2.0

# Infineon PSOC 6_02 based MCU default configuration

if SOC_DIE_PSOC6_02

config NUM_IRQS
	default 16 if CPU_CORTEX_M0PLUS
	default 168 if CPU_CORTEX_M4

config SYS_CLOCK_HW_CYCLES_PER_SEC
	default 100000000

config BUILD_OUTPUT_HEX
	default y

# add additional die specific params

endif # SOC_DIE_PSOC6_02
```
