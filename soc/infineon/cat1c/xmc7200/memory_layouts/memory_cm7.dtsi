/ {
	cm7_code: cm7_code@28004000 {
		compatible = "mmio-sram";
		reg = <0x28004000  DT_SIZE_K(816)>;
	};

	cm7_data: cm7_data@10080000 {
		compatible = "soc-nv-flash";
		reg = <0x10080000 DT_SIZE_K(2048)>;
		write-block-size = <512>;
		erase-block-size = <512>;
	};
};
