## soc/infineon/edge/pse84/Kconfig.soc
```kconfig
# Copyright (c) 2025 Infineon Technologies AG,
# or an affiliate of Infineon Technologies AG.
#
# SPDX-License-Identifier: Apache-2.0

# Infineon PSE84 series MCUs
config SOC_SERIES_PSE84
	bool

config SOC_SERIES_PSE84_M33
	bool

config SOC_SERIES_PSE84_M55
	bool

config SOC_SERIES
	default "pse84" if SOC_SERIES_PSE84

config SOC_DIE_PSE8XXGP
	bool
	select SOC_FAMILY_INFINEON_EDGE

config SOC_DIE_PSE8XXGO
	bool
	select SOC_FAMILY_INFINEON_EDGE

config SOC_DIE_PSE8XXGM
	bool
	select SOC_FAMILY_INFINEON_EDGE

# SOC Packages for Infineon PSE84 series MCUs
config SOC_PACKAGE_PSE84_LQFP_144
	bool

config SOC_PACKAGE_PSE84_BGA_220
	bool

config SOC_PACKAGE_PSE84_EWLB_235
	bool

config SOC_PACKAGE_PSE84_WLB_154
	bool

# Infineon PSE84 series MPNs
config SOC_PSE846GPS4DBZC4B
	bool
	select SOC_PACKAGE_PSE84_BGA_220
	select SOC_SERIES_PSE84
	select SOC_DIE_PSE8XXGP

config SOC_PSE846GPS4DBZC4B_M33
	bool
	select SOC_SERIES_PSE84_M33
	select SOC_PSE846GPS4DBZC4B

config SOC_PSE846GPS4DBZC4B_M55
	bool
	select SOC_SERIES_PSE84_M55
	select SOC_PSE846GPS4DBZC4B

config SOC_PSE846GPS4DBZC4A
	bool
	select SOC_PACKAGE_PSE84_BGA_220
	select SOC_SERIES_PSE84
	select SOC_DIE_PSE8XXGP

config SOC_PSE846GPS4DBZC4A_M33
	bool
	select SOC_SERIES_PSE84_M33
	select SOC_PSE846GPS4DBZC4A

config SOC_PSE846GPS4DBZC4A_M55
	bool
	select SOC_SERIES_PSE84_M55
	select SOC_PSE846GPS4DBZC4A

config SOC_PSE846GPS2DBZC4A
	bool
	select SOC_PACKAGE_PSE84_BGA_220
	select SOC_SERIES_PSE84
	select SOC_DIE_PSE8XXGP

config SOC_PSE846GPS2DBZC4A_M33
	bool
	select SOC_SERIES_PSE84_M33
	select SOC_PSE846GPS2DBZC4A

config SOC_PSE846GPS2DBZC4A_M55
	bool
	select SOC_SERIES_PSE84_M55
	select SOC_PSE846GPS2DBZC4A

config SOC_PSE846GOS4DBZC4B
	bool
	select SOC_PACKAGE_PSE84_BGA_220
	select SOC_SERIES_PSE84
	select SOC_DIE_PSE8XXGO

config SOC_PSE846GOS4DBZC4B_M33
	bool
	select SOC_SERIES_PSE84_M33
	select SOC_PSE846GOS4DBZC4B

config SOC_PSE846GOS4DBZC4B_M55
	bool
	select SOC_SERIES_PSE84_M55
	select SOC_PSE846GOS4DBZC4B

config SOC_PSE846GOS2DBZC4B
	bool
	select SOC_PACKAGE_PSE84_BGA_220
	select SOC_SERIES_PSE84
	select SOC_DIE_PSE8XXGO

config SOC_PSE846GOS2DBZC4B_M33
	bool
	select SOC_SERIES_PSE84_M33
	select SOC_PSE846GOS2DBZC4B

config SOC_PSE846GOS2DBZC4B_M55
	bool
	select SOC_SERIES_PSE84_M55
	select SOC_PSE846GOS2DBZC4B

config SOC_PSE845GPS4DFNC4B
	bool
	select SOC_PACKAGE_PSE84_WLB_154
	select SOC_SERIES_PSE84
	select SOC_DIE_PSE8XXGP

config SOC_PSE845GPS4DFNC4B_M33
	bool
	select SOC_SERIES_PSE84_M33
	select SOC_PSE845GPS4DFNC4B

config SOC_PSE845GPS4DFNC4B_M55
	bool
	select SOC_SERIES_PSE84_M55
	select SOC_PSE845GPS4DFNC4B

config SOC_PSE845GPS4DFMC4B
	bool
	select SOC_PACKAGE_PSE84_EWLB_235
	select SOC_SERIES_PSE84
	select SOC_DIE_PSE8XXGP

config SOC_PSE845GPS4DFMC4B_M33
	bool
	select SOC_SERIES_PSE84_M33
	select SOC_PSE845GPS4DFMC4B

config SOC_PSE845GPS4DFMC4B_M55
	bool
	select SOC_SERIES_PSE84_M55
	select SOC_PSE845GPS4DFMC4B

config SOC_PSE845GPS2DFNC4A
	bool
	select SOC_PACKAGE_PSE84_WLB_154
	select SOC_SERIES_PSE84
	select SOC_DIE_PSE8XXGP

config SOC_PSE845GPS2DFNC4A_M33
	bool
	select SOC_SERIES_PSE84_M33
	select SOC_PSE845GPS2DFNC4A

config SOC_PSE845GPS2DFNC4A_M55
	bool
	select SOC_SERIES_PSE84_M55
	select SOC_PSE845GPS2DFNC4A

config SOC_PSE845GPS2DFMC4A
	bool
	select SOC_PACKAGE_PSE84_EWLB_235
	select SOC_SERIES_PSE84
	select SOC_DIE_PSE8XXGP

config SOC_PSE845GPS2DFMC4A_M33
	bool
	select SOC_SERIES_PSE84_M33
	select SOC_PSE845GPS2DFMC4A

config SOC_PSE845GPS2DFMC4A_M55
	bool
	select SOC_SERIES_PSE84_M55
	select SOC_PSE845GPS2DFMC4A

config SOC_PSE845GOS4DFNC4B
	bool
	select SOC_PACKAGE_PSE84_WLB_154
	select SOC_SERIES_PSE84
	select SOC_DIE_PSE8XXGO

config SOC_PSE845GOS4DFNC4B_M33
	bool
	select SOC_SERIES_PSE84_M33
	select SOC_PSE845GOS4DFNC4B

config SOC_PSE845GOS4DFNC4B_M55
	bool
	select SOC_SERIES_PSE84_M55
	select SOC_PSE845GOS4DFNC4B

config SOC_PSE845GOS4DFMC4B
	bool
	select SOC_PACKAGE_PSE84_EWLB_235
	select SOC_SERIES_PSE84
	select SOC_DIE_PSE8XXGO

config SOC_PSE845GOS4DFMC4B_M33
	bool
	select SOC_SERIES_PSE84_M33
	select SOC_PSE845GOS4DFMC4B

config SOC_PSE845GOS4DFMC4B_M55
	bool
	select SOC_SERIES_PSE84_M55
	select SOC_PSE845GOS4DFMC4B

config SOC_PSE845GOS2DFNC4B
	bool
	select SOC_PACKAGE_PSE84_WLB_154
	select SOC_SERIES_PSE84
	select SOC_DIE_PSE8XXGO

config SOC_PSE845GOS2DFNC4B_M33
	bool
	select SOC_SERIES_PSE84_M33
	select SOC_PSE845GOS2DFNC4B

config SOC_PSE845GOS2DFNC4B_M55
	bool
	select SOC_SERIES_PSE84_M55
	select SOC_PSE845GOS2DFNC4B

config SOC_PSE845GOS2DFMC4B
	bool
	select SOC_PACKAGE_PSE84_EWLB_235
	select SOC_SERIES_PSE84
	select SOC_DIE_PSE8XXGO

config SOC_PSE845GOS2DFMC4B_M33
	bool
	select SOC_SERIES_PSE84_M33
	select SOC_PSE845GOS2DFMC4B

config SOC_PSE845GOS2DFMC4B_M55
	bool
	select SOC_SERIES_PSE84_M55
	select SOC_PSE845GOS2DFMC4B

config SOC_PSE846GPS4DBZQ3B
	bool
	select SOC_PACKAGE_PSE84_BGA_220
	select SOC_SERIES_PSE84
	select SOC_DIE_PSE8XXGP

config SOC_PSE846GPS4DBZQ3B_M33
	bool
	select SOC_SERIES_PSE84_M33
	select SOC_PSE846GPS4DBZQ3B

config SOC_PSE846GPS4DBZQ3B_M55
	bool
	select SOC_SERIES_PSE84_M55
	select SOC_PSE846GPS4DBZQ3B

config SOC_PSE846GPS2DBZQ3A
	bool
	select SOC_PACKAGE_PSE84_BGA_220
	select SOC_SERIES_PSE84
	select SOC_DIE_PSE8XXGP

config SOC_PSE846GPS2DBZQ3A_M33
	bool
	select SOC_SERIES_PSE84_M33
	select SOC_PSE846GPS2DBZQ3A

config SOC_PSE846GPS2DBZQ3A_M55
	bool
	select SOC_SERIES_PSE84_M55
	select SOC_PSE846GPS2DBZQ3A

config SOC_PSE846GOS4DBZQ3B
	bool
	select SOC_PACKAGE_PSE84_BGA_220
	select SOC_SERIES_PSE84
	select SOC_DIE_PSE8XXGO

config SOC_PSE846GOS4DBZQ3B_M33
	bool
	select SOC_SERIES_PSE84_M33
	select SOC_PSE846GOS4DBZQ3B

config SOC_PSE846GOS4DBZQ3B_M55
	bool
	select SOC_SERIES_PSE84_M55
	select SOC_PSE846GOS4DBZQ3B

config SOC_PSE846GOS2DBZQ3B
	bool
	select SOC_PACKAGE_PSE84_BGA_220
	select SOC_SERIES_PSE84
	select SOC_DIE_PSE8XXGO

config SOC_PSE846GOS2DBZQ3B_M33
	bool
	select SOC_SERIES_PSE84_M33
	select SOC_PSE846GOS2DBZQ3B

config SOC_PSE846GOS2DBZQ3B_M55
	bool
	select SOC_SERIES_PSE84_M55
	select SOC_PSE846GOS2DBZQ3B

config SOC_PSE832GOS4DFNC4B
	bool
	select SOC_PACKAGE_PSE84_WLB_154
	select SOC_SERIES_PSE84
	select SOC_DIE_PSE8XXGO

config SOC_PSE832GOS4DFNC4B_M33
	bool
	select SOC_SERIES_PSE84_M33
	select SOC_PSE832GOS4DFNC4B

config SOC_PSE832GOS4DFNC4B_M55
	bool
	select SOC_SERIES_PSE84_M55
	select SOC_PSE832GOS4DFNC4B

config SOC_PSE833GOS4DBZC4B
	bool
	select SOC_PACKAGE_PSE84_BGA_220
	select SOC_SERIES_PSE84
	select SOC_DIE_PSE8XXGO

config SOC_PSE833GOS4DBZC4B_M33
	bool
	select SOC_SERIES_PSE84_M33
	select SOC_PSE833GOS4DBZC4B

config SOC_PSE833GOS4DBZC4B_M55
	bool
	select SOC_SERIES_PSE84_M55
	select SOC_PSE833GOS4DBZC4B

config SOC_PSE832GOS2DFNC4B
	bool
	select SOC_PACKAGE_PSE84_WLB_154
	select SOC_SERIES_PSE84
	select SOC_DIE_PSE8XXGO

config SOC_PSE832GOS2DFNC4B_M33
	bool
	select SOC_SERIES_PSE84_M33
	select SOC_PSE832GOS2DFNC4B

config SOC_PSE832GOS2DFNC4B_M55
	bool
	select SOC_SERIES_PSE84_M55
	select SOC_PSE832GOS2DFNC4B

config SOC_PSE833GOS2DBZC4A
	bool
	select SOC_PACKAGE_PSE84_BGA_220
	select SOC_SERIES_PSE84
	select SOC_DIE_PSE8XXGO

config SOC_PSE833GOS2DBZC4A_M33
	bool
	select SOC_SERIES_PSE84_M33
	select SOC_PSE833GOS2DBZC4A

config SOC_PSE833GOS2DBZC4A_M55
	bool
	select SOC_SERIES_PSE84_M55
	select SOC_PSE833GOS2DBZC4A

config SOC_PSE832GMS4DFNC4B
	bool
	select SOC_PACKAGE_PSE84_WLB_154
	select SOC_SERIES_PSE84
	select SOC_DIE_PSE8XXGM

config SOC_PSE832GMS4DFNC4B_M33
	bool
	select SOC_SERIES_PSE84_M33
	select SOC_PSE832GMS4DFNC4B

config SOC_PSE832GMS4DFNC4B_M55
	bool
	select SOC_SERIES_PSE84_M55
	select SOC_PSE832GMS4DFNC4B

config SOC_PSE833GMS4DBZC4B
	bool
	select SOC_PACKAGE_PSE84_BGA_220
	select SOC_SERIES_PSE84
	select SOC_DIE_PSE8XXGM

config SOC_PSE833GMS4DBZC4B_M33
	bool
	select SOC_SERIES_PSE84_M33
	select SOC_PSE833GMS4DBZC4B

config SOC_PSE833GMS4DBZC4B_M55
	bool
	select SOC_SERIES_PSE84_M55
	select SOC_PSE833GMS4DBZC4B

config SOC_PSE832GMS2DFNC4B
	bool
	select SOC_PACKAGE_PSE84_WLB_154
	select SOC_SERIES_PSE84
	select SOC_DIE_PSE8XXGM

config SOC_PSE832GMS2DFNC4B_M33
	bool
	select SOC_SERIES_PSE84_M33
	select SOC_PSE832GMS2DFNC4B

config SOC_PSE832GMS2DFNC4B_M55
	bool
	select SOC_SERIES_PSE84_M55
	select SOC_PSE832GMS2DFNC4B

config SOC_PSE833GMS2DBZC4B
	bool
	select SOC_PACKAGE_PSE84_BGA_220
	select SOC_SERIES_PSE84
	select SOC_DIE_PSE8XXGM

config SOC_PSE833GMS2DBZC4B_M33
	bool
	select SOC_SERIES_PSE84_M33
	select SOC_PSE833GMS2DBZC4B

config SOC_PSE833GMS2DBZC4B_M55
	bool
	select SOC_SERIES_PSE84_M55
	select SOC_PSE833GMS2DBZC4B

config SOC_PSE833GOS4DBZQ3B
	bool
	select SOC_PACKAGE_PSE84_BGA_220
	select SOC_SERIES_PSE84
	select SOC_DIE_PSE8XXGO

config SOC_PSE833GOS4DBZQ3B_M33
	bool
	select SOC_SERIES_PSE84_M33
	select SOC_PSE833GOS4DBZQ3B

config SOC_PSE833GOS4DBZQ3B_M55
	bool
	select SOC_SERIES_PSE84_M55
	select SOC_PSE833GOS4DBZQ3B

config SOC_PSE833GOS2DBZQ3B
	bool
	select SOC_PACKAGE_PSE84_BGA_220
	select SOC_SERIES_PSE84
	select SOC_DIE_PSE8XXGO

config SOC_PSE833GOS2DBZQ3B_M33
	bool
	select SOC_SERIES_PSE84_M33
	select SOC_PSE833GOS2DBZQ3B

config SOC_PSE833GOS2DBZQ3B_M55
	bool
	select SOC_SERIES_PSE84_M55
	select SOC_PSE833GOS2DBZQ3B

config SOC_PSE833GMS4DBZQ3B
	bool
	select SOC_PACKAGE_PSE84_BGA_220
	select SOC_SERIES_PSE84
	select SOC_DIE_PSE8XXGM

config SOC_PSE833GMS4DBZQ3B_M33
	bool
	select SOC_SERIES_PSE84_M33
	select SOC_PSE833GMS4DBZQ3B

config SOC_PSE833GMS4DBZQ3B_M55
	bool
	select SOC_SERIES_PSE84_M55
	select SOC_PSE833GMS4DBZQ3B

config SOC_PSE833GMS2DBZQ3B
	bool
	select SOC_PACKAGE_PSE84_BGA_220
	select SOC_SERIES_PSE84
	select SOC_DIE_PSE8XXGM

config SOC_PSE833GMS2DBZQ3B_M33
	bool
	select SOC_SERIES_PSE84_M33
	select SOC_PSE833GMS2DBZQ3B

config SOC_PSE833GMS2DBZQ3B_M55
	bool
	select SOC_SERIES_PSE84_M55
	select SOC_PSE833GMS2DBZQ3B

config SOC_PSE822GOS4DFNC4B
	bool
	select SOC_PACKAGE_PSE84_WLB_154
	select SOC_SERIES_PSE84
	select SOC_DIE_PSE8XXGO

config SOC_PSE822GOS4DFNC4B_M33
	bool
	select SOC_SERIES_PSE84_M33
	select SOC_PSE822GOS4DFNC4B

config SOC_PSE822GOS4DFNC4B_M55
	bool
	select SOC_SERIES_PSE84_M55
	select SOC_PSE822GOS4DFNC4B

config SOC_PSE823GOS4DBZC4B
	bool
	select SOC_PACKAGE_PSE84_BGA_220
	select SOC_SERIES_PSE84
	select SOC_DIE_PSE8XXGO

config SOC_PSE823GOS4DBZC4B_M33
	bool
	select SOC_SERIES_PSE84_M33
	select SOC_PSE823GOS4DBZC4B

config SOC_PSE823GOS4DBZC4B_M55
	bool
	select SOC_SERIES_PSE84_M55
	select SOC_PSE823GOS4DBZC4B

config SOC_PSE822GOS2DFNC4B
	bool
	select SOC_PACKAGE_PSE84_WLB_154
	select SOC_SERIES_PSE84
	select SOC_DIE_PSE8XXGO

config SOC_PSE822GOS2DFNC4B_M33
	bool
	select SOC_SERIES_PSE84_M33
	select SOC_PSE822GOS2DFNC4B

config SOC_PSE822GOS2DFNC4B_M55
	bool
	select SOC_SERIES_PSE84_M55
	select SOC_PSE822GOS2DFNC4B

config SOC_PSE823GOS2DBZC4B
	bool
	select SOC_PACKAGE_PSE84_BGA_220
	select SOC_SERIES_PSE84
	select SOC_DIE_PSE8XXGO

config SOC_PSE823GOS2DBZC4B_M33
	bool
	select SOC_SERIES_PSE84_M33
	select SOC_PSE823GOS2DBZC4B

config SOC_PSE823GOS2DBZC4B_M55
	bool
	select SOC_SERIES_PSE84_M55
	select SOC_PSE823GOS2DBZC4B

config SOC_PSE822GMS4DFNC4B
	bool
	select SOC_PACKAGE_PSE84_WLB_154
	select SOC_SERIES_PSE84
	select SOC_DIE_PSE8XXGM

config SOC_PSE822GMS4DFNC4B_M33
	bool
	select SOC_SERIES_PSE84_M33
	select SOC_PSE822GMS4DFNC4B

config SOC_PSE822GMS4DFNC4B_M55
	bool
	select SOC_SERIES_PSE84_M55
	select SOC_PSE822GMS4DFNC4B

config SOC_PSE823GMS4DBZC4B
	bool
	select SOC_PACKAGE_PSE84_BGA_220
	select SOC_SERIES_PSE84
	select SOC_DIE_PSE8XXGM

config SOC_PSE823GMS4DBZC4B_M33
	bool
	select SOC_SERIES_PSE84_M33
	select SOC_PSE823GMS4DBZC4B

config SOC_PSE823GMS4DBZC4B_M55
	bool
	select SOC_SERIES_PSE84_M55
	select SOC_PSE823GMS4DBZC4B

config SOC_PSE822GMS2DFNC4B
	bool
	select SOC_PACKAGE_PSE84_WLB_154
	select SOC_SERIES_PSE84
	select SOC_DIE_PSE8XXGM

config SOC_PSE822GMS2DFNC4B_M33
	bool
	select SOC_SERIES_PSE84_M33
	select SOC_PSE822GMS2DFNC4B

config SOC_PSE822GMS2DFNC4B_M55
	bool
	select SOC_SERIES_PSE84_M55
	select SOC_PSE822GMS2DFNC4B

config SOC_PSE823GMS2DBZC4B
	bool
	select SOC_PACKAGE_PSE84_BGA_220
	select SOC_SERIES_PSE84
	select SOC_DIE_PSE8XXGM

config SOC_PSE823GMS2DBZC4B_M33
	bool
	select SOC_SERIES_PSE84_M33
	select SOC_PSE823GMS2DBZC4B

config SOC_PSE823GMS2DBZC4B_M55
	bool
	select SOC_SERIES_PSE84_M55
	select SOC_PSE823GMS2DBZC4B

config SOC_PSE823GOS4DBZQ3B
	bool
	select SOC_PACKAGE_PSE84_BGA_220
	select SOC_SERIES_PSE84
	select SOC_DIE_PSE8XXGO

config SOC_PSE823GOS4DBZQ3B_M33
	bool
	select SOC_SERIES_PSE84_M33
	select SOC_PSE823GOS4DBZQ3B

config SOC_PSE823GOS4DBZQ3B_M55
	bool
	select SOC_SERIES_PSE84_M55
	select SOC_PSE823GOS4DBZQ3B

config SOC_PSE823GOS2DBZQ3B
	bool
	select SOC_PACKAGE_PSE84_BGA_220
	select SOC_SERIES_PSE84
	select SOC_DIE_PSE8XXGO

config SOC_PSE823GOS2DBZQ3B_M33
	bool
	select SOC_SERIES_PSE84_M33
	select SOC_PSE823GOS2DBZQ3B

config SOC_PSE823GOS2DBZQ3B_M55
	bool
	select SOC_SERIES_PSE84_M55
	select SOC_PSE823GOS2DBZQ3B

config SOC_PSE823GMS4DBZQ3B
	bool
	select SOC_PACKAGE_PSE84_BGA_220
	select SOC_SERIES_PSE84
	select SOC_DIE_PSE8XXGM

config SOC_PSE823GMS4DBZQ3B_M33
	bool
	select SOC_SERIES_PSE84_M33
	select SOC_PSE823GMS4DBZQ3B

config SOC_PSE823GMS4DBZQ3B_M55
	bool
	select SOC_SERIES_PSE84_M55
	select SOC_PSE823GMS4DBZQ3B

config SOC_PSE823GMS2DBZQ3B
	bool
	select SOC_PACKAGE_PSE84_BGA_220
	select SOC_SERIES_PSE84
	select SOC_DIE_PSE8XXGM

config SOC_PSE823GMS2DBZQ3B_M33
	bool
	select SOC_SERIES_PSE84_M33
	select SOC_PSE823GMS2DBZQ3B

config SOC_PSE823GMS2DBZQ3B_M55
	bool
	select SOC_SERIES_PSE84_M55
	select SOC_PSE823GMS2DBZQ3B

config SOC_PSE812GOS4DFNC4B
	bool
	select SOC_PACKAGE_PSE84_WLB_154
	select SOC_SERIES_PSE84
	select SOC_DIE_PSE8XXGO

config SOC_PSE812GOS4DFNC4B_M33
	bool
	select SOC_SERIES_PSE84_M33
	select SOC_PSE812GOS4DFNC4B

config SOC_PSE812GOS4DFNC4B_M55
	bool
	select SOC_SERIES_PSE84_M55
	select SOC_PSE812GOS4DFNC4B

config SOC_PSE813GOS4DBZC4A
	bool
	select SOC_PACKAGE_PSE84_BGA_220
	select SOC_SERIES_PSE84
	select SOC_DIE_PSE8XXGO

config SOC_PSE813GOS4DBZC4A_M33
	bool
	select SOC_SERIES_PSE84_M33
	select SOC_PSE813GOS4DBZC4A

config SOC_PSE813GOS4DBZC4A_M55
	bool
	select SOC_SERIES_PSE84_M55
	select SOC_PSE813GOS4DBZC4A

config SOC_PSE812GOS2DFNC4B
	bool
	select SOC_PACKAGE_PSE84_WLB_154
	select SOC_SERIES_PSE84
	select SOC_DIE_PSE8XXGO

config SOC_PSE812GOS2DFNC4B_M33
	bool
	select SOC_SERIES_PSE84_M33
	select SOC_PSE812GOS2DFNC4B

config SOC_PSE812GOS2DFNC4B_M55
	bool
	select SOC_SERIES_PSE84_M55
	select SOC_PSE812GOS2DFNC4B

config SOC_PSE813GOS2DBZC4B
	bool
	select SOC_PACKAGE_PSE84_BGA_220
	select SOC_SERIES_PSE84
	select SOC_DIE_PSE8XXGO

config SOC_PSE813GOS2DBZC4B_M33
	bool
	select SOC_SERIES_PSE84_M33
	select SOC_PSE813GOS2DBZC4B

config SOC_PSE813GOS2DBZC4B_M55
	bool
	select SOC_SERIES_PSE84_M55
	select SOC_PSE813GOS2DBZC4B

config SOC_PSE812GMS4DFNC4B
	bool
	select SOC_PACKAGE_PSE84_WLB_154
	select SOC_SERIES_PSE84
	select SOC_DIE_PSE8XXGM

config SOC_PSE812GMS4DFNC4B_M33
	bool
	select SOC_SERIES_PSE84_M33
	select SOC_PSE812GMS4DFNC4B

config SOC_PSE812GMS4DFNC4B_M55
	bool
	select SOC_SERIES_PSE84_M55
	select SOC_PSE812GMS4DFNC4B

config SOC_PSE813GMS4DBZC4B
	bool
	select SOC_PACKAGE_PSE84_BGA_220
	select SOC_SERIES_PSE84
	select SOC_DIE_PSE8XXGM

config SOC_PSE813GMS4DBZC4B_M33
	bool
	select SOC_SERIES_PSE84_M33
	select SOC_PSE813GMS4DBZC4B

config SOC_PSE813GMS4DBZC4B_M55
	bool
	select SOC_SERIES_PSE84_M55
	select SOC_PSE813GMS4DBZC4B

config SOC_PSE812GMS2DFNC4B
	bool
	select SOC_PACKAGE_PSE84_WLB_154
	select SOC_SERIES_PSE84
	select SOC_DIE_PSE8XXGM

config SOC_PSE812GMS2DFNC4B_M33
	bool
	select SOC_SERIES_PSE84_M33
	select SOC_PSE812GMS2DFNC4B

config SOC_PSE812GMS2DFNC4B_M55
	bool
	select SOC_SERIES_PSE84_M55
	select SOC_PSE812GMS2DFNC4B

config SOC_PSE813GMS2DBZC4B
	bool
	select SOC_PACKAGE_PSE84_BGA_220
	select SOC_SERIES_PSE84
	select SOC_DIE_PSE8XXGM

config SOC_PSE813GMS2DBZC4B_M33
	bool
	select SOC_SERIES_PSE84_M33
	select SOC_PSE813GMS2DBZC4B

config SOC_PSE813GMS2DBZC4B_M55
	bool
	select SOC_SERIES_PSE84_M55
	select SOC_PSE813GMS2DBZC4B

config SOC_PSE813GOS4DBZQ3B
	bool
	select SOC_PACKAGE_PSE84_BGA_220
	select SOC_SERIES_PSE84
	select SOC_DIE_PSE8XXGO

config SOC_PSE813GOS4DBZQ3B_M33
	bool
	select SOC_SERIES_PSE84_M33
	select SOC_PSE813GOS4DBZQ3B

config SOC_PSE813GOS4DBZQ3B_M55
	bool
	select SOC_SERIES_PSE84_M55
	select SOC_PSE813GOS4DBZQ3B

config SOC_PSE813GOS2DBZQ3B
	bool
	select SOC_PACKAGE_PSE84_BGA_220
	select SOC_SERIES_PSE84
	select SOC_DIE_PSE8XXGO

config SOC_PSE813GOS2DBZQ3B_M33
	bool
	select SOC_SERIES_PSE84_M33
	select SOC_PSE813GOS2DBZQ3B

config SOC_PSE813GOS2DBZQ3B_M55
	bool
	select SOC_SERIES_PSE84_M55
	select SOC_PSE813GOS2DBZQ3B

config SOC_PSE813GMS4DBZQ3B
	bool
	select SOC_PACKAGE_PSE84_BGA_220
	select SOC_SERIES_PSE84
	select SOC_DIE_PSE8XXGM

config SOC_PSE813GMS4DBZQ3B_M33
	bool
	select SOC_SERIES_PSE84_M33
	select SOC_PSE813GMS4DBZQ3B

config SOC_PSE813GMS4DBZQ3B_M55
	bool
	select SOC_SERIES_PSE84_M55
	select SOC_PSE813GMS4DBZQ3B

config SOC_PSE813GMS2DBZQ3B
	bool
	select SOC_PACKAGE_PSE84_BGA_220
	select SOC_SERIES_PSE84
	select SOC_DIE_PSE8XXGM

config SOC_PSE813GMS2DBZQ3B_M33
	bool
	select SOC_SERIES_PSE84_M33
	select SOC_PSE813GMS2DBZQ3B

config SOC_PSE813GMS2DBZQ3B_M55
	bool
	select SOC_SERIES_PSE84_M55
	select SOC_PSE813GMS2DBZQ3B

config SOC_PSE846GPS2DBZC4B
	bool
	select SOC_PACKAGE_PSE84_BGA_220
	select SOC_SERIES_PSE84
	select SOC_DIE_PSE8XXGP

config SOC_PSE846GPS2DBZC4B_M33
	bool
	select SOC_SERIES_PSE84_M33
	select SOC_PSE846GPS2DBZC4B

config SOC_PSE846GPS2DBZC4B_M55
	bool
	select SOC_SERIES_PSE84_M55
	select SOC_PSE846GPS2DBZC4B

config SOC_PSE845GPS2DFNC4B
	bool
	select SOC_PACKAGE_PSE84_WLB_154
	select SOC_SERIES_PSE84
	select SOC_DIE_PSE8XXGP

config SOC_PSE845GPS2DFNC4B_M33
	bool
	select SOC_SERIES_PSE84_M33
	select SOC_PSE845GPS2DFNC4B

config SOC_PSE845GPS2DFNC4B_M55
	bool
	select SOC_SERIES_PSE84_M55
	select SOC_PSE845GPS2DFNC4B

config SOC_PSE845GPS2DFMC4B
	bool
	select SOC_PACKAGE_PSE84_EWLB_235
	select SOC_SERIES_PSE84
	select SOC_DIE_PSE8XXGP

config SOC_PSE845GPS2DFMC4B_M33
	bool
	select SOC_SERIES_PSE84_M33
	select SOC_PSE845GPS2DFMC4B

config SOC_PSE845GPS2DFMC4B_M55
	bool
	select SOC_SERIES_PSE84_M55
	select SOC_PSE845GPS2DFMC4B

config SOC_PSE846GPS2DBZQ3B
	bool
	select SOC_PACKAGE_PSE84_BGA_220
	select SOC_SERIES_PSE84
	select SOC_DIE_PSE8XXGP

config SOC_PSE846GPS2DBZQ3B_M33
	bool
	select SOC_SERIES_PSE84_M33
	select SOC_PSE846GPS2DBZQ3B

config SOC_PSE846GPS2DBZQ3B_M55
	bool
	select SOC_SERIES_PSE84_M55
	select SOC_PSE846GPS2DBZQ3B

config SOC_PSE833GOS2DBZC4B
	bool
	select SOC_PACKAGE_PSE84_BGA_220
	select SOC_SERIES_PSE84
	select SOC_DIE_PSE8XXGO

config SOC_PSE833GOS2DBZC4B_M33
	bool
	select SOC_SERIES_PSE84_M33
	select SOC_PSE833GOS2DBZC4B

config SOC_PSE833GOS2DBZC4B_M55
	bool
	select SOC_SERIES_PSE84_M55
	select SOC_PSE833GOS2DBZC4B

config SOC_PSE813GOS4DBZC4B
	bool
	select SOC_PACKAGE_PSE84_BGA_220
	select SOC_SERIES_PSE84
	select SOC_DIE_PSE8XXGO

config SOC_PSE813GOS4DBZC4B_M33
	bool
	select SOC_SERIES_PSE84_M33
	select SOC_PSE813GOS4DBZC4B

config SOC_PSE813GOS4DBZC4B_M55
	bool
	select SOC_SERIES_PSE84_M55
	select SOC_PSE813GOS4DBZC4B

config SOC
	default "pse846gps4dbzc4b" if SOC_PSE846GPS4DBZC4B
	default "pse846gps4dbzc4a" if SOC_PSE846GPS4DBZC4A
	default "pse846gps2dbzc4a" if SOC_PSE846GPS2DBZC4A
	default "pse846gos4dbzc4b" if SOC_PSE846GOS4DBZC4B
	default "pse846gos2dbzc4b" if SOC_PSE846GOS2DBZC4B
	default "pse845gps4dfnc4b" if SOC_PSE845GPS4DFNC4B
	default "pse845gps4dfmc4b" if SOC_PSE845GPS4DFMC4B
	default "pse845gps2dfnc4a" if SOC_PSE845GPS2DFNC4A
	default "pse845gps2dfmc4a" if SOC_PSE845GPS2DFMC4A
	default "pse845gos4dfnc4b" if SOC_PSE845GOS4DFNC4B
	default "pse845gos4dfmc4b" if SOC_PSE845GOS4DFMC4B
	default "pse845gos2dfnc4b" if SOC_PSE845GOS2DFNC4B
	default "pse845gos2dfmc4b" if SOC_PSE845GOS2DFMC4B
	default "pse846gps4dbzq3b" if SOC_PSE846GPS4DBZQ3B
	default "pse846gps2dbzq3a" if SOC_PSE846GPS2DBZQ3A
	default "pse846gos4dbzq3b" if SOC_PSE846GOS4DBZQ3B
	default "pse846gos2dbzq3b" if SOC_PSE846GOS2DBZQ3B
	default "pse832gos4dfnc4b" if SOC_PSE832GOS4DFNC4B
	default "pse833gos4dbzc4b" if SOC_PSE833GOS4DBZC4B
	default "pse832gos2dfnc4b" if SOC_PSE832GOS2DFNC4B
	default "pse833gos2dbzc4a" if SOC_PSE833GOS2DBZC4A
	default "pse832gms4dfnc4b" if SOC_PSE832GMS4DFNC4B
	default "pse833gms4dbzc4b" if SOC_PSE833GMS4DBZC4B
	default "pse832gms2dfnc4b" if SOC_PSE832GMS2DFNC4B
	default "pse833gms2dbzc4b" if SOC_PSE833GMS2DBZC4B
	default "pse833gos4dbzq3b" if SOC_PSE833GOS4DBZQ3B
	default "pse833gos2dbzq3b" if SOC_PSE833GOS2DBZQ3B
	default "pse833gms4dbzq3b" if SOC_PSE833GMS4DBZQ3B
	default "pse833gms2dbzq3b" if SOC_PSE833GMS2DBZQ3B
	default "pse822gos4dfnc4b" if SOC_PSE822GOS4DFNC4B
	default "pse823gos4dbzc4b" if SOC_PSE823GOS4DBZC4B
	default "pse822gos2dfnc4b" if SOC_PSE822GOS2DFNC4B
	default "pse823gos2dbzc4b" if SOC_PSE823GOS2DBZC4B
	default "pse822gms4dfnc4b" if SOC_PSE822GMS4DFNC4B
	default "pse823gms4dbzc4b" if SOC_PSE823GMS4DBZC4B
	default "pse822gms2dfnc4b" if SOC_PSE822GMS2DFNC4B
	default "pse823gms2dbzc4b" if SOC_PSE823GMS2DBZC4B
	default "pse823gos4dbzq3b" if SOC_PSE823GOS4DBZQ3B
	default "pse823gos2dbzq3b" if SOC_PSE823GOS2DBZQ3B
	default "pse823gms4dbzq3b" if SOC_PSE823GMS4DBZQ3B
	default "pse823gms2dbzq3b" if SOC_PSE823GMS2DBZQ3B
	default "pse812gos4dfnc4b" if SOC_PSE812GOS4DFNC4B
	default "pse813gos4dbzc4a" if SOC_PSE813GOS4DBZC4A
	default "pse812gos2dfnc4b" if SOC_PSE812GOS2DFNC4B
	default "pse813gos2dbzc4b" if SOC_PSE813GOS2DBZC4B
	default "pse812gms4dfnc4b" if SOC_PSE812GMS4DFNC4B
	default "pse813gms4dbzc4b" if SOC_PSE813GMS4DBZC4B
	default "pse812gms2dfnc4b" if SOC_PSE812GMS2DFNC4B
	default "pse813gms2dbzc4b" if SOC_PSE813GMS2DBZC4B
	default "pse813gos4dbzq3b" if SOC_PSE813GOS4DBZQ3B
	default "pse813gos2dbzq3b" if SOC_PSE813GOS2DBZQ3B
	default "pse813gms4dbzq3b" if SOC_PSE813GMS4DBZQ3B
	default "pse813gms2dbzq3b" if SOC_PSE813GMS2DBZQ3B
	default "pse846gps2dbzc4b" if SOC_PSE846GPS2DBZC4B
	default "pse845gps2dfnc4b" if SOC_PSE845GPS2DFNC4B
	default "pse845gps2dfmc4b" if SOC_PSE845GPS2DFMC4B
	default "pse846gps2dbzq3b" if SOC_PSE846GPS2DBZQ3B
	default "pse833gos2dbzc4b" if SOC_PSE833GOS2DBZC4B
	default "pse813gos4dbzc4b" if SOC_PSE813GOS4DBZC4B
```
