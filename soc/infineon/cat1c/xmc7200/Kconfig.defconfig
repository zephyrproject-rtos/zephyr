## soc/infineon/cat1c/xmc7200/Kconfig.defconfig
```kconfig
# Copyright (c) 2023 Cypress Semiconductor Corporation (an Infineon company) or
# an affiliate of Cypress Semiconductor Corporation
# SPDX-License-Identifier: Apache-2.0

# Infineon XMC7200 based MCU default configuration

if SOC_DIE_XMC7200

config NUM_IRQS
	default 16

config SYS_CLOCK_HW_CYCLES_PER_SEC
	default $(dt_node_int_prop_int,/cpus/cpu@0,clock-frequency)

config BUILD_OUTPUT_HEX
	default y

# add additional die specific params

endif # SOC_DIE_XMC7200
```

## soc/infineon/cat1c/xmc7200/Kconfig.soc
```kconfig
# Copyright (c) 2023 Cypress Semiconductor Corporation (an Infineon company) or
# an affiliate of Cypress Semiconductor Corporation
# SPDX-License-Identifier: Apache-2.0

# SOC series
config SOC_SERIES_XMC7200
	bool

config SOC_SERIES
	default "xmc7200" if SOC_SERIES_XMC7200
# SOC die
config SOC_DIE_XMC7200
	bool
	select SOC_FAMILY_INFINEON_CAT1C

# SOC packages
config SOC_PACKAGE_XMC7200_176_TEQFP
	bool

config SOC_PACKAGE_XMC7200_272_BGA
	bool

config SOC_PACKAGE_XMC7200_320_BGA
	bool

# Infineon XMC7200 series MCUs
config SOC_XMC7200_F176K8384
	bool
	select SOC_DIE_XMC7200
	select SOC_PACKAGE_XMC7200_176_TEQFP
	select SOC_SERIES_XMC7200

config SOC_XMC7200D_F176K8384
	bool
	select SOC_DIE_XMC7200
	select SOC_PACKAGE_XMC7200_176_TEQFP
	select SOC_SERIES_XMC7200

config SOC_XMC7200_E272K8384
	bool
	select SOC_DIE_XMC7200
	select SOC_PACKAGE_XMC7200_272_BGA
	select SOC_SERIES_XMC7200

config SOC_XMC7200D_E272K8384_M0PLUS
	bool
	select SOC_DIE_XMC7200
	select SOC_PACKAGE_XMC7200_272_BGA
	select SOC_SERIES_XMC7200

config SOC_XMC7200D_E272K8384_M7_0
	bool
	select SOC_DIE_XMC7200
	select SOC_PACKAGE_XMC7200_272_BGA
	select SOC_SERIES_XMC7200

config SOC_XMC7200D_E272K8384_M7_1
	bool
	select SOC_DIE_XMC7200
	select SOC_PACKAGE_XMC7200_272_BGA
	select SOC_SERIES_XMC7200

# Infineon T2G Body High series MCUs: CYT4BF8CES
config SOC_CYT4BF8CES_M0PLUS
	bool
	select SOC_CYT4BF8CES

config SOC_CYT4BF8CES_M7_0
	bool
	select SOC_CYT4BF8CES

config SOC_CYT4BF8CES_M7_1
	bool
	select SOC_CYT4BF8CES

config SOC_CYT4BF8CES
	bool
	select SOC_DIE_XMC7200
	select SOC_SERIES_XMC7200
	select SOC_PACKAGE_XMC7200_176_TEQFP

# Infineon T2G Body High series MCUs: CYT4BF8CEE
config SOC_CYT4BF8CEE_M0PLUS
	bool
	select SOC_CYT4BF8CEE

config SOC_CYT4BF8CEE_M7_0
	bool
	select SOC_CYT4BF8CEE

config SOC_CYT4BF8CEE_M7_1
	bool
	select SOC_CYT4BF8CEE

config SOC_CYT4BF8CEE
	bool
	select SOC_DIE_XMC7200
	select SOC_SERIES_XMC7200
	select SOC_PACKAGE_XMC7200_176_TEQFP

# Infineon T2G Body High series MCUs: CYT4BF8CDS
config SOC_CYT4BF8CDS_M0PLUS
	bool
	select SOC_CYT4BF8CDS

config SOC_CYT4BF8CDS_M7_0
	bool
	select SOC_CYT4BF8CDS

config SOC_CYT4BF8CDS_M7_1
	bool
	select SOC_CYT4BF8CDS

config SOC_CYT4BF8CDS
	bool
	select SOC_DIE_XMC7200
	select SOC_SERIES_XMC7200
	select SOC_PACKAGE_XMC7200_176_TEQFP

# Infineon T2G Body High series MCUs: CYT4BF8CDE
config SOC_CYT4BF8CDE_M0PLUS
	bool
	select SOC_CYT4BF8CDE

config SOC_CYT4BF8CDE_M7_0
	bool
	select SOC_CYT4BF8CDE

config SOC_CYT4BF8CDE_M7_1
	bool
	select SOC_CYT4BF8CDE

config SOC_CYT4BF8CDE
	bool
	select SOC_DIE_XMC7200
	select SOC_SERIES_XMC7200
	select SOC_PACKAGE_XMC7200_176_TEQFP

# Infineon T2G Body High series MCUs: CYT4BFBCJS
config SOC_CYT4BFBCJS_M0PLUS
	bool
	select SOC_CYT4BFBCJS

config SOC_CYT4BFBCJS_M7_0
	bool
	select SOC_CYT4BFBCJS

config SOC_CYT4BFBCJS_M7_1
	bool
	select SOC_CYT4BFBCJS

config SOC_CYT4BFBCJS
	bool
	select SOC_DIE_XMC7200
	select SOC_SERIES_XMC7200
	select SOC_PACKAGE_XMC7200_272_BGA

# Infineon T2G Body High series MCUs: CYT4BFBCJE
config SOC_CYT4BFBCJE_M0PLUS
	bool
	select SOC_CYT4BFBCJE

config SOC_CYT4BFBCJE_M7_0
	bool
	select SOC_CYT4BFBCJE

config SOC_CYT4BFBCJE_M7_1
	bool
	select SOC_CYT4BFBCJE

config SOC_CYT4BFBCJE
	bool
	select SOC_DIE_XMC7200
	select SOC_SERIES_XMC7200
	select SOC_PACKAGE_XMC7200_272_BGA

# Infineon T2G Body High series MCUs: CYT4BFBCHS
config SOC_CYT4BFBCHS_M0PLUS
	bool
	select SOC_CYT4BFBCHS

config SOC_CYT4BFBCHS_M7_0
	bool
	select SOC_CYT4BFBCHS

config SOC_CYT4BFBCHS_M7_1
	bool
	select SOC_CYT4BFBCHS

config SOC_CYT4BFBCHS
	bool
	select SOC_DIE_XMC7200
	select SOC_SERIES_XMC7200
	select SOC_PACKAGE_XMC7200_272_BGA

# Infineon T2G Body High series MCUs: CYT4BFBCHE
config SOC_CYT4BFBCHE_M0PLUS
	bool
	select SOC_CYT4BFBCHE

config SOC_CYT4BFBCHE_M7_0
	bool
	select SOC_CYT4BFBCHE

config SOC_CYT4BFBCHE_M7_1
	bool
	select SOC_CYT4BFBCHE

config SOC_CYT4BFBCHE
	bool
	select SOC_DIE_XMC7200
	select SOC_SERIES_XMC7200
	select SOC_PACKAGE_XMC7200_272_BGA

# Infineon T2G Body High series MCUs: CYT4BFCCJS
config SOC_CYT4BFCCJS_M0PLUS
	bool
	select SOC_CYT4BFCCJS

config SOC_CYT4BFCCJS_M7_0
	bool
	select SOC_CYT4BFCCJS

config SOC_CYT4BFCCJS_M7_1
	bool
	select SOC_CYT4BFCCJS

config SOC_CYT4BFCCJS
	bool
	select SOC_DIE_XMC7200
	select SOC_SERIES_XMC7200
	select SOC_PACKAGE_XMC7200_320_BGA

# Infineon T2G Body High series MCUs: CYT4BFCCJE
config SOC_CYT4BFCCJE_M0PLUS
	bool
	select SOC_CYT4BFCCJE

config SOC_CYT4BFCCJE_M7_0
	bool
	select SOC_CYT4BFCCJE

config SOC_CYT4BFCCJE_M7_1
	bool
	select SOC_CYT4BFCCJE

config SOC_CYT4BFCCJE
	bool
	select SOC_DIE_XMC7200
	select SOC_SERIES_XMC7200
	select SOC_PACKAGE_XMC7200_320_BGA

# Infineon T2G Body High series MCUs: CYT4BFCCHS
config SOC_CYT4BFCCHS_M0PLUS
	bool
	select SOC_CYT4BFCCHS

config SOC_CYT4BFCCHS_M7_0
	bool
	select SOC_CYT4BFCCHS

config SOC_CYT4BFCCHS_M7_1
	bool
	select SOC_CYT4BFCCHS

config SOC_CYT4BFCCHS
	bool
	select SOC_DIE_XMC7200
	select SOC_SERIES_XMC7200
	select SOC_PACKAGE_XMC7200_320_BGA

# Infineon T2G Body High series MCUs: CYT4BFCCHE
config SOC_CYT4BFCCHE_M0PLUS
	bool
	select SOC_CYT4BFCCHE

config SOC_CYT4BFCCHE_M7_0
	bool
	select SOC_CYT4BFCCHE

config SOC_CYT4BFCCHE_M7_1
	bool
	select SOC_CYT4BFCCHE

config SOC_CYT4BFCCHE
	bool
	select SOC_DIE_XMC7200
	select SOC_SERIES_XMC7200
	select SOC_PACKAGE_XMC7200_320_BGA

config SOC
	default "xmc7200_f176k8384" if SOC_XMC7200_F176K8384
	default "xmc7200d_f176k8384" if SOC_XMC7200D_F176K8384
	default "xmc7200_e272k8384" if SOC_XMC7200_E272K8384
	default "xmc7200d_e272k8384" if SOC_XMC7200D_E272K8384_M0PLUS || SOC_XMC7200D_E272K8384_M7_0 || SOC_XMC7200D_E272K8384_M7_1
	default "cyt4bf8ces" if SOC_CYT4BF8CES
	default "cyt4bf8cee" if SOC_CYT4BF8CEE
	default "cyt4bf8cds" if SOC_CYT4BF8CDS
	default "cyt4bf8cde" if SOC_CYT4BF8CDE
	default "cyt4bfbcjs" if SOC_CYT4BFBCJS
	default "cyt4bfbcje" if SOC_CYT4BFBCJE
	default "cyt4bfbchs" if SOC_CYT4BFBCHS
	default "cyt4bfbche" if SOC_CYT4BFBCHE
	default "cyt4bfccjs" if SOC_CYT4BFCCJS
	default "cyt4bfccje" if SOC_CYT4BFCCJE
	default "cyt4bfcchs" if SOC_CYT4BFCCHS
	default "cyt4bfcche" if SOC_CYT4BFCCHE
```

## soc/infineon/cat2/Kconfig.soc
```kconfig
# Copyright (c) 2025 Infineon Technologies AG,
# or an affiliate of Infineon Technologies AG.
#
# SPDX-License-Identifier: Apache-2.0

# Family definitions
config SOC_FAMILY_INFINEON_CAT2
	bool

rsource "*/Kconfig.soc"
```

## soc/infineon/cat2/psoc4100tp/Kconfig
```kconfig
# Copyright (c) 2025 Infineon Technologies AG,
# or an affiliate of Infineon Technologies AG.
#
# SPDX-License-Identifier: Apache-2.0
#
# Licensed under the Apache License, Version 2.0 (the "License");
# you may not use this file except in compliance with the License.
# You may obtain a copy of the License at
#
#     http://www.apache.org/licenses/LICENSE-2.0
#
# Unless required by applicable law or agreed to in writing, software
# distributed under the License is distributed on an "AS IS" BASIS,
# WITHOUT WARRANTIES OR CONDITIONS OF ANY KIND, either express or implied.
# See the License for the specific language governing permissions and
# limitations under the License.

config SOC_SERIES_PSOC4100TP
	select ARM
	select CPU_CORTEX_M0PLUS
	select CPU_CORTEX_M_HAS_VTOR
	select BUILD_OUTPUT_HEX
	select BUILD_OUTPUT_BIN
	select DYNAMIC_INTERRUPTS
	select SOC_EARLY_INIT_HOOK
	select CPU_CORTEX_M_HAS_SYSTICK
```

## soc/infineon/cat2/psoc4100tp/Kconfig.defconfig
```kconfig
# Copyright (c) 2025 Infineon Technologies AG,
# or an affiliate of Infineon Technologies AG.
#
# SPDX-License-Identifier: Apache-2.0

if SOC_SERIES_PSOC4100TP

config NUM_IRQS
	default 23

config SYS_CLOCK_HW_CYCLES_PER_SEC
	default $(dt_node_int_prop_int,/cpus/cpu@0,clock-frequency)

# add additional die specific params

endif # SOC_SERIES_PSOC4100TP
```

## soc/infineon/cat3/Kconfig.defconfig
```kconfig
# SPDX-License-Identifier: Apache-2.0
#
# Copyright (c) 2020 Linumiz
# Author: Parthiban Nallathambi <parthiban@linumiz.com>

if SOC_FAMILY_INFINEON_XMC

rsource "*/Kconfig.defconfig"

endif # SOC_FAMILY_INFINEON_XMC
```

## soc/infineon/cat3/Kconfig.soc
```kconfig
# SPDX-License-Identifier: Apache-2.0
#
# Copyright (c) 2020 Linumiz
# Author: Parthiban Nallathambi <parthiban@linumiz.com>

config SOC_FAMILY_INFINEON_XMC
	bool

config SOC_FAMILY
	default "infineon_xmc" if SOC_FAMILY_INFINEON_XMC

rsource "*/Kconfig.soc"
```

## soc/infineon/cat3/xmc4xxx/Kconfig
```kconfig
# XMC 4xxx MCU line
#
# Copyright (c) 2020 Linumiz
# Author: Parthiban Nallathambi <parthiban@linumiz.com>
# SPDX-License-Identifier: Apache-2.0

config SOC_SERIES_XMC4XXX
	select ARM
	select CPU_CORTEX_M4
	select CPU_CORTEX_M_HAS_DWT
	select CPU_HAS_ARM_MPU
	select CPU_HAS_FPU
	select HAS_XMCLIB
	select HAS_XMCLIB_UART
	select HAS_XMCLIB_FLASH
	select HAS_XMCLIB_ERU
	select HAS_XMCLIB_VADC
	select HAS_XMCLIB_DMA
	select HAS_XMCLIB_SPI
	select HAS_XMCLIB_I2C
	select HAS_XMCLIB_CCU
	select HAS_XMCLIB_WDT
	select HAS_XMCLIB_ETH
	select HAS_XMCLIB_CAN
	select HAS_XMCLIB_RTC
```

## soc/infineon/cat3/xmc4xxx/Kconfig.defconfig
```kconfig
# SPDX-License-Identifier: Apache-2.0
#
# XMC 4xxx series configuration options
# Copyright (c) 2020 Linumiz
# Author: Parthiban Nallathambi <parthiban@linumiz.com>

if SOC_SERIES_XMC4XXX

config NUM_IRQS
	default 112

rsource "Kconfig.defconfig.xmc*"

endif # SOC_SERIES_XMC4XXX
```

## soc/infineon/cat3/xmc4xxx/Kconfig.defconfig.xmc4500
```kconfig
# Infineon XMC4500 relax kit platform configuration options
#
# Copyright (c) 2020 Linumiz
# Author: Parthiban Nallathambi <parthiban@linumiz.com>
# SPDX-License-Identifier: Apache-2.0

if SOC_XMC4500

config SYS_CLOCK_HW_CYCLES_PER_SEC
	default 120000000

config NUM_IRQS
	default 110

endif # SOC_XMC4500
```

## soc/infineon/cat3/xmc4xxx/Kconfig.defconfig.xmc4700
```kconfig
# Infineon XMC4700 relax kit platform configuration options
#
# Copyright (c) 2023 Schlumberger
# SPDX-License-Identifier: Apache-2.0

if SOC_XMC4700

config SYS_CLOCK_HW_CYCLES_PER_SEC
	default 144000000

config NUM_IRQS
	default 112

endif # SOC_XMC4700
```

## soc/infineon/cat3/xmc4xxx/Kconfig.defconfig.xmc4800
```kconfig
# Infineon XMC4800 platform configuration options
#
# SPDX-FileCopyrightText: Karl Palsson 2026 <karl.palsson@marel.com>
# SPDX-License-Identifier: Apache-2.0

if SOC_XMC4800

config SYS_CLOCK_HW_CYCLES_PER_SEC
	default $(dt_node_int_prop_int,/cpus/cpu@0,clock-frequency)

config NUM_IRQS
	default 112

endif # SOC_XMC4800
```

## soc/infineon/cat3/xmc4xxx/Kconfig.soc
```kconfig
# XMC 4xxx MCU line
#
# Copyright (c) 2020 Linumiz
# Author: Parthiban Nallathambi <parthiban@linumiz.com>
# SPDX-License-Identifier: Apache-2.0

config SOC_SERIES_XMC4XXX
	bool
	select SOC_FAMILY_INFINEON_XMC
	help
	  XMC 4xxx Series MCU

config SOC_XMC4500
	bool
	select SOC_SERIES_XMC4XXX
	help
	 SOC_XMC4500

config SOC_XMC4700
	bool
	select SOC_SERIES_XMC4XXX
	help
	  SOC_XMC4700

config SOC_PART_NUMBER_F100X1024
	bool

config SOC_PART_NUMBER_F144X2048
	bool

config SOC_SERIES
	default "xmc4xxx" if SOC_SERIES_XMC4XXX

config SOC
	default "xmc4500" if SOC_XMC4500
	default "xmc4700" if SOC_XMC4700

config SOC_PART_NUMBER
	default "F100x1024" if SOC_PART_NUMBER_F100X1024
	default "F144x2048" if SOC_PART_NUMBER_F144X2048
```

## soc/infineon/edge/Kconfig.soc
```kconfig
# SPDX-FileCopyrightText: <text>Copyright (c) 2026 Infineon Technologies AG,
# or an affiliate of Infineon Technologies AG. All rights reserved.</text>
#
# SPDX-License-Identifier: Apache-2.0

# Family definitions
config SOC_FAMILY_INFINEON_EDGE
	bool

config SOC_FAMILY
	default "infineon_edge" if SOC_FAMILY_INFINEON_EDGE

# MPNs definitions
rsource "*/Kconfig.soc"
```
