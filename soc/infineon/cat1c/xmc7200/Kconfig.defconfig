## soc/infineon/psoc4/Kconfig.defconfig
```kconfig
# Copyright (c) 2025 Infineon Technologies AG,
# or an affiliate of Infineon Technologies AG.
#
# SPDX-License-Identifier: Apache-2.0

if SOC_SERIES_PSOC4100TP

rsource "*/Kconfig.defconfig"

configdefault SHARED_IRQ_MAX_NUM_CLIENTS
	# All 3 GPIO ports enabled
	default 3 if $(dt_nodelabel_enabled,gpio_prt4) && \
		$(dt_nodelabel_enabled,gpio_prt5) && \
		$(dt_nodelabel_enabled,gpio_prt6)

	# Any 2 GPIO ports enabled
	default 2 if $(dt_nodelabel_enabled,gpio_prt4) && $(dt_nodelabel_enabled,gpio_prt5)
	default 2 if $(dt_nodelabel_enabled,gpio_prt4) && $(dt_nodelabel_enabled,gpio_prt6)
	default 2 if $(dt_nodelabel_enabled,gpio_prt5) && $(dt_nodelabel_enabled,gpio_prt6)

configdefault SHARED_INTERRUPTS
	default y if (($(dt_nodelabel_enabled,gpio_prt4) && \
		($(dt_nodelabel_enabled,gpio_prt5) || $(dt_nodelabel_enabled,gpio_prt6))) || \
		($(dt_nodelabel_enabled,gpio_prt5) && $(dt_nodelabel_enabled,gpio_prt6)))

endif # SOC_SERIES_PSOC4100TP

if SOC_SERIES_PSOC4100SMAX

rsource "*/Kconfig.defconfig"

configdefault SHARED_IRQ_MAX_NUM_CLIENTS
	default 9 if \
		$(dt_nodelabel_enabled,gpio_prt4) || \
		$(dt_nodelabel_enabled,gpio_prt5) || \
		$(dt_nodelabel_enabled,gpio_prt6) || \
		$(dt_nodelabel_enabled,gpio_prt7) || \
		$(dt_nodelabel_enabled,gpio_prt8) || \
		$(dt_nodelabel_enabled,gpio_prt9) || \
		$(dt_nodelabel_enabled,gpio_prt10) || \
		$(dt_nodelabel_enabled,gpio_prt11) || \
		$(dt_nodelabel_enabled,gpio_prt12)

configdefault SHARED_INTERRUPTS
	default y if \
		$(dt_nodelabel_enabled,gpio_prt4) || \
		$(dt_nodelabel_enabled,gpio_prt5) || \
		$(dt_nodelabel_enabled,gpio_prt6) || \
		$(dt_nodelabel_enabled,gpio_prt7) || \
		$(dt_nodelabel_enabled,gpio_prt8) || \
		$(dt_nodelabel_enabled,gpio_prt9) || \
		$(dt_nodelabel_enabled,gpio_prt10) || \
		$(dt_nodelabel_enabled,gpio_prt11) || \
		$(dt_nodelabel_enabled,gpio_prt12)

endif # SOC_SERIES_PSOC4100SMAX
```

## soc/infineon/psoc4/psoc4100smax/Kconfig
```kconfig
# Copyright (c) 2025 Infineon Technologies AG,
# or an affiliate of Infineon Technologies AG.
#
# SPDX-License-Identifier: Apache-2.0

# SOC Packages for Infineon PSOC4100Smax series MCUs
config SOC_PACKAGE_PSOC4100SMAX_100_TQFP
	bool
	help
	  100-pin TQFP package

# Hardware configuration for PSOC4100SMAX series
config SOC_SERIES_PSOC4100SMAX
	select ARM
	select CPU_CORTEX_M0PLUS
	select CPU_CORTEX_M_HAS_VTOR
	select CPU_HAS_ARM_MPU
	select BUILD_OUTPUT_HEX
	select BUILD_OUTPUT_BIN
	select DYNAMIC_INTERRUPTS
	select SOC_EARLY_INIT_HOOK
	select CPU_CORTEX_M_HAS_SYSTICK

config SOC_CY8C4149AZI_S598
	select SOC_PACKAGE_PSOC4100SMAX_100_TQFP
```

## soc/infineon/psoc4/psoc4100smax/Kconfig.defconfig
```kconfig
# Copyright (c) 2025 Infineon Technologies AG,
# or an affiliate of Infineon Technologies AG.
#
# SPDX-License-Identifier: Apache-2.0

if SOC_SERIES_PSOC4100SMAX

config NUM_IRQS
	default 32

config SYS_CLOCK_HW_CYCLES_PER_SEC
	default $(dt_node_int_prop_int,/cpus/cpu@0,clock-frequency)

endif # SOC_SERIES_PSOC4100SMAX
```

## soc/infineon/psoc4/psoc4100smax/Kconfig.soc
```kconfig
# Copyright (c) 2025 Infineon Technologies AG,
# or an affiliate of Infineon Technologies AG.
#
# SPDX-License-Identifier: Apache-2.0

# MCU series
config SOC_SERIES_PSOC4100SMAX
	bool
	select SOC_FAMILY_INFINEON_PSOC4
	help
	  PSOC4100Smax Series MCU

config SOC_SERIES
	default "psoc4100smax" if SOC_SERIES_PSOC4100SMAX

config SOC_CY8C4149AZI_S598
	bool
	select SOC_SERIES_PSOC4100SMAX

config SOC
	default "cy8c4149azi_s598" if SOC_CY8C4149AZI_S598
```

## soc/infineon/psoc4/psoc4100tp/Kconfig
```kconfig
# Copyright (c) 2025 Infineon Technologies AG,
# or an affiliate of Infineon Technologies AG.
#
# SPDX-License-Identifier: Apache-2.0
#
# Licensed under the Apache License, Version 2.0 (the "License");
# you may not use this file except in compliance with the License.
# You may obtain a copy of the License at
#
#     http://www.apache.org/licenses/LICENSE-2.0
#
# Unless required by applicable law or agreed to in writing, software
# distributed under the License is distributed on an "AS IS" BASIS,
# WITHOUT WARRANTIES OR CONDITIONS OF ANY KIND, either express or implied.
# See the License for the specific language governing permissions and
# limitations under the License.

# SOC Packages for Infineon PSOC4100Tp series MCUs
config SOC_PACKAGE_PSOC4100TP_64_TQFP
	bool
	help
	  64-pin TQFP package

config SOC_PACKAGE_PSOC4100TP_48_TQFP
	bool
	help
	  48-pin TQFP package

config SOC_PACKAGE_PSOC4100TP_48_QFN
	bool
	help
	  48-pin QFN package

config SOC_PACKAGE_PSOC4100TP_44_TQFP
	bool
	help
	  44-pin TQFP package

# Hardware configuration for PSOC4100TP series
config SOC_SERIES_PSOC4100TP
	select ARM
	select CPU_CORTEX_M0PLUS
	select CPU_CORTEX_M_HAS_VTOR
	select BUILD_OUTPUT_HEX
	select BUILD_OUTPUT_BIN
	select DYNAMIC_INTERRUPTS
	select SOC_EARLY_INIT_HOOK
	select CPU_CORTEX_M_HAS_SYSTICK

# Infineon PSOC4100Tp series MPNs
config SOC_CY8C4146LQI_T403
	select SOC_PACKAGE_PSOC4100TP_48_QFN

config SOC_CY8C4146AXI_T403
	select SOC_PACKAGE_PSOC4100TP_44_TQFP

config SOC_CY8C4146AZI_T403
	select SOC_PACKAGE_PSOC4100TP_48_TQFP

config SOC_CY8C4146AZI_T405
	select SOC_PACKAGE_PSOC4100TP_64_TQFP

config SOC_CY8C4146LQI_T413
	select SOC_PACKAGE_PSOC4100TP_48_QFN

config SOC_CY8C4146AXI_T413
	select SOC_PACKAGE_PSOC4100TP_44_TQFP

config SOC_CY8C4146AZI_T413
	select SOC_PACKAGE_PSOC4100TP_48_TQFP

config SOC_CY8C4146AZI_T415
	select SOC_PACKAGE_PSOC4100TP_64_TQFP

config SOC_CY8C4146LQI_T453
	select SOC_PACKAGE_PSOC4100TP_48_QFN

config SOC_CY8C4146AXI_T453
	select SOC_PACKAGE_PSOC4100TP_44_TQFP

config SOC_CY8C4146AZI_T453
	select SOC_PACKAGE_PSOC4100TP_48_TQFP

config SOC_CY8C4146AZI_T455
	select SOC_PACKAGE_PSOC4100TP_64_TQFP

config SOC_CY8C4147LQI_T403
	select SOC_PACKAGE_PSOC4100TP_48_QFN

config SOC_CY8C4147AXI_T403
	select SOC_PACKAGE_PSOC4100TP_44_TQFP

config SOC_CY8C4147AZI_T403
	select SOC_PACKAGE_PSOC4100TP_48_TQFP

config SOC_CY8C4147AZI_T405
	select SOC_PACKAGE_PSOC4100TP_64_TQFP

config SOC_CY8C4147LQI_T413
	select SOC_PACKAGE_PSOC4100TP_48_QFN

config SOC_CY8C4147AXI_T413
	select SOC_PACKAGE_PSOC4100TP_44_TQFP

config SOC_CY8C4147AZI_T413
	select SOC_PACKAGE_PSOC4100TP_48_TQFP

config SOC_CY8C4147AZI_T415
	select SOC_PACKAGE_PSOC4100TP_64_TQFP

config SOC_CY8C4147LQI_T453
	select SOC_PACKAGE_PSOC4100TP_48_QFN

config SOC_CY8C4147AXI_T453
	select SOC_PACKAGE_PSOC4100TP_44_TQFP

config SOC_CY8C4147AZI_T453
	select SOC_PACKAGE_PSOC4100TP_48_TQFP

config SOC_CY8C4147AZI_T455
	select SOC_PACKAGE_PSOC4100TP_64_TQFP

config SOC_CY8C4147LQI_T463
	select SOC_PACKAGE_PSOC4100TP_48_QFN

config SOC_CY8C4147AXI_T463
	select SOC_PACKAGE_PSOC4100TP_44_TQFP

config SOC_CY8C4147AZI_T463
	select SOC_PACKAGE_PSOC4100TP_48_TQFP

config SOC_CY8C4147AZI_T465
	select SOC_PACKAGE_PSOC4100TP_64_TQFP

config SOC_CY8C4147LQI_T473
	select SOC_PACKAGE_PSOC4100TP_48_QFN

config SOC_CY8C4147AXI_T473
	select SOC_PACKAGE_PSOC4100TP_44_TQFP

config SOC_CY8C4147AZI_T473
	select SOC_PACKAGE_PSOC4100TP_48_TQFP

config SOC_CY8C4147AZI_T475
	select SOC_PACKAGE_PSOC4100TP_64_TQFP

config SOC_CY8C4147LQQ_T493
	select SOC_PACKAGE_PSOC4100TP_48_QFN

config SOC_CY8C4147AXQ_T493
	select SOC_PACKAGE_PSOC4100TP_44_TQFP

config SOC_CY8C4147AZQ_T493
	select SOC_PACKAGE_PSOC4100TP_48_TQFP

config SOC_CY8C4147AZQ_T495
	select SOC_PACKAGE_PSOC4100TP_64_TQFP

config SOC_CY8C4146AZQ_T413
	select SOC_PACKAGE_PSOC4100TP_48_TQFP

config SOC_CY8C4146AZQ_T453
	select SOC_PACKAGE_PSOC4100TP_48_TQFP

config SOC_CY8C4147AZQ_T415
	select SOC_PACKAGE_PSOC4100TP_64_TQFP

config SOC_CY8C4147AZQ_T455
	select SOC_PACKAGE_PSOC4100TP_64_TQFP
```

## soc/infineon/psoc4/psoc4100tp/Kconfig.soc
```kconfig
# Copyright (c) 2025 Infineon Technologies AG,
# or an affiliate of Infineon Technologies AG.
#
# SPDX-License-Identifier: Apache-2.0

# MCU series
config SOC_SERIES_PSOC4100TP
	bool
	select SOC_FAMILY_INFINEON_PSOC4
	help
	  PSOC4100tp Series MCU

config SOC_SERIES
	default "psoc4100tp" if SOC_SERIES_PSOC4100TP

config SOC_CY8C4146LQI_T403
	bool
	select SOC_SERIES_PSOC4100TP

config SOC_CY8C4146AXI_T403
	bool
	select SOC_SERIES_PSOC4100TP

config SOC_CY8C4146AZI_T403
	bool
	select SOC_SERIES_PSOC4100TP

config SOC_CY8C4146AZI_T405
	bool
	select SOC_SERIES_PSOC4100TP

config SOC_CY8C4146LQI_T413
	bool
	select SOC_SERIES_PSOC4100TP

config SOC_CY8C4146AXI_T413
	bool
	select SOC_SERIES_PSOC4100TP

config SOC_CY8C4146AZI_T413
	bool
	select SOC_SERIES_PSOC4100TP

config SOC_CY8C4146AZI_T415
	bool
	select SOC_SERIES_PSOC4100TP

config SOC_CY8C4146LQI_T453
	bool
	select SOC_SERIES_PSOC4100TP

config SOC_CY8C4146AXI_T453
	bool
	select SOC_SERIES_PSOC4100TP

config SOC_CY8C4146AZI_T453
	bool
	select SOC_SERIES_PSOC4100TP

config SOC_CY8C4146AZI_T455
	bool
	select SOC_SERIES_PSOC4100TP

config SOC_CY8C4147LQI_T403
	bool
	select SOC_SERIES_PSOC4100TP

config SOC_CY8C4147AXI_T403
	bool
	select SOC_SERIES_PSOC4100TP

config SOC_CY8C4147AZI_T403
	bool
	select SOC_SERIES_PSOC4100TP

config SOC_CY8C4147AZI_T405
	bool
	select SOC_SERIES_PSOC4100TP

config SOC_CY8C4147LQI_T413
	bool
	select SOC_SERIES_PSOC4100TP

config SOC_CY8C4147AXI_T413
	bool
	select SOC_SERIES_PSOC4100TP

config SOC_CY8C4147AZI_T413
	bool
	select SOC_SERIES_PSOC4100TP

config SOC_CY8C4147AZI_T415
	bool
	select SOC_SERIES_PSOC4100TP

config SOC_CY8C4147LQI_T453
	bool
	select SOC_SERIES_PSOC4100TP

config SOC_CY8C4147AXI_T453
	bool
	select SOC_SERIES_PSOC4100TP

config SOC_CY8C4147AZI_T453
	bool
	select SOC_SERIES_PSOC4100TP

config SOC_CY8C4147AZI_T455
	bool
	select SOC_SERIES_PSOC4100TP

config SOC_CY8C4147LQI_T463
	bool
	select SOC_SERIES_PSOC4100TP

config SOC_CY8C4147AXI_T463
	bool
	select SOC_SERIES_PSOC4100TP

config SOC_CY8C4147AZI_T463
	bool
	select SOC_SERIES_PSOC4100TP

config SOC_CY8C4147AZI_T465
	bool
	select SOC_SERIES_PSOC4100TP

config SOC_CY8C4147LQI_T473
	bool
	select SOC_SERIES_PSOC4100TP

config SOC_CY8C4147AXI_T473
	bool
	select SOC_SERIES_PSOC4100TP

config SOC_CY8C4147AZI_T473
	bool
	select SOC_SERIES_PSOC4100TP

config SOC_CY8C4147AZI_T475
	bool
	select SOC_SERIES_PSOC4100TP

config SOC_CY8C4147LQQ_T493
	bool
	select SOC_SERIES_PSOC4100TP

config SOC_CY8C4147AXQ_T493
	bool
	select SOC_SERIES_PSOC4100TP

config SOC_CY8C4147AZQ_T493
	bool
	select SOC_SERIES_PSOC4100TP

config SOC_CY8C4147AZQ_T495
	bool
	select SOC_SERIES_PSOC4100TP

config SOC_CY8C4146AZQ_T413
	bool
	select SOC_SERIES_PSOC4100TP

config SOC_CY8C4146AZQ_T453
	bool
	select SOC_SERIES_PSOC4100TP

config SOC_CY8C4147AZQ_T415
	bool
	select SOC_SERIES_PSOC4100TP

config SOC_CY8C4147AZQ_T455
	bool
	select SOC_SERIES_PSOC4100TP

# Default SOC selection
config SOC
	default "cy8c4146lqi_t403" if SOC_CY8C4146LQI_T403
	default "cy8c4146axi_t403" if SOC_CY8C4146AXI_T403
	default "cy8c4146azi_t403" if SOC_CY8C4146AZI_T403
	default "cy8c4146azi_t405" if SOC_CY8C4146AZI_T405
	default "cy8c4146lqi_t413" if SOC_CY8C4146LQI_T413
	default "cy8c4146axi_t413" if SOC_CY8C4146AXI_T413
	default "cy8c4146azi_t413" if SOC_CY8C4146AZI_T413
	default "cy8c4146azi_t415" if SOC_CY8C4146AZI_T415
	default "cy8c4146lqi_t453" if SOC_CY8C4146LQI_T453
	default "cy8c4146axi_t453" if SOC_CY8C4146AXI_T453
	default "cy8c4146azi_t453" if SOC_CY8C4146AZI_T453
	default "cy8c4146azi_t455" if SOC_CY8C4146AZI_T455
	default "cy8c4147lqi_t403" if SOC_CY8C4147LQI_T403
	default "cy8c4147axi_t403" if SOC_CY8C4147AXI_T403
	default "cy8c4147azi_t403" if SOC_CY8C4147AZI_T403
	default "cy8c4147azi_t405" if SOC_CY8C4147AZI_T405
	default "cy8c4147lqi_t413" if SOC_CY8C4147LQI_T413
	default "cy8c4147axi_t413" if SOC_CY8C4147AXI_T413
	default "cy8c4147azi_t413" if SOC_CY8C4147AZI_T413
	default "cy8c4147azi_t415" if SOC_CY8C4147AZI_T415
	default "cy8c4147lqi_t453" if SOC_CY8C4147LQI_T453
	default "cy8c4147axi_t453" if SOC_CY8C4147AXI_T453
	default "cy8c4147azi_t453" if SOC_CY8C4147AZI_T453
	default "cy8c4147azi_t455" if SOC_CY8C4147AZI_T455
	default "cy8c4147lqi_t463" if SOC_CY8C4147LQI_T463
	default "cy8c4147axi_t463" if SOC_CY8C4147AXI_T463
	default "cy8c4147azi_t463" if SOC_CY8C4147AZI_T463
	default "cy8c4147azi_t465" if SOC_CY8C4147AZI_T465
	default "cy8c4147lqi_t473" if SOC_CY8C4147LQI_T473
	default "cy8c4147axi_t473" if SOC_CY8C4147AXI_T473
	default "cy8c4147azi_t473" if SOC_CY8C4147AZI_T473
	default "cy8c4147azi_t475" if SOC_CY8C4147AZI_T475
	default "cy8c4147lqq_t493" if SOC_CY8C4147LQQ_T493
	default "cy8c4147axq_t493" if SOC_CY8C4147AXQ_T493
	default "cy8c4147azq_t493" if SOC_CY8C4147AZQ_T493
	default "cy8c4147azq_t495" if SOC_CY8C4147AZQ_T495
	default "cy8c4146azq_t413" if SOC_CY8C4146AZQ_T413
	default "cy8c4146azq_t453" if SOC_CY8C4146AZQ_T453
	default "cy8c4147azq_t415" if SOC_CY8C4147AZQ_T415
	default "cy8c4147azq_t455" if SOC_CY8C4147AZQ_T455
```

## soc/infineon/xmc/Kconfig
```kconfig
# SPDX-License-Identifier: Apache-2.0
#
# Copyright (c) 2020 Linumiz
# Author: Parthiban Nallathambi <parthiban@linumiz.com>

config SOC_FAMILY_INFINEON_XMC
	select HAS_SEGGER_RTT if ZEPHYR_SEGGER_MODULE
	select PLATFORM_SPECIFIC_INIT

if SOC_FAMILY_INFINEON_XMC

rsource "*/Kconfig"

endif # SOC_FAMILY_INFINEON_XMC
```

## soc/infineon/xmc/Kconfig.defconfig
```kconfig
# SPDX-License-Identifier: Apache-2.0
#
# Copyright (c) 2020 Linumiz
# Author: Parthiban Nallathambi <parthiban@linumiz.com>

rsource "*/Kconfig.defconfig"

if SOC_FAMILY_INFINEON_XMC

config PINCTRL
	default y

endif # SOC_FAMILY_INFINEON_XMC
```

## soc/intel/alder_lake/Kconfig
```kconfig
# Copyright (c) 2018-2024 Intel Corporation Inc.
# SPDX-License-Identifier: Apache-2.0

config SOC_ALDER_LAKE
	select X86
	select X86_64
	select CPU_ATOM
	select PCIE
	select PCIE_MSI
	select DYNAMIC_INTERRUPTS
	select X86_MMU
	select HAS_POWEROFF if ACPI_POWEROFF
```

## soc/intel/alder_lake/Kconfig.soc
```kconfig
# Copyright (c) 2018-2024 Intel Corporation Inc.
# SPDX-License-Identifier: Apache-2.0

config SOC_ALDER_LAKE
	bool

config SOC
	default "alder_lake" if SOC_ALDER_LAKE
```
