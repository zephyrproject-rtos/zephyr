## soc/infineon/psoc4/psoc4hvms64k/Kconfig.soc
```kconfig
# SPDX-FileCopyrightText: Copyright (c) 2026 Infineon Technologies AG,
# SPDX-FileCopyrightText: or an affiliate of Infineon Technologies AG. All rights reserved.
#
# SPDX-License-Identifier: Apache-2.0

# MCU series
config SOC_SERIES_PSOC4HVMS64K
	bool
	select SOC_FAMILY_INFINEON_PSOC4
	help
	  PSOC4 HVMS 64K Series MCU

config SOC_SERIES
	default "psoc4hvms64k" if SOC_SERIES_PSOC4HVMS64K

config SOC_CY8C4125LCE_HVS003
	bool
	select SOC_SERIES_PSOC4HVMS64K

config SOC_CY8C4125LCE_HVS013
	bool
	select SOC_SERIES_PSOC4HVMS64K

config SOC_CY8C4126LCE_HVS003
	bool
	select SOC_SERIES_PSOC4HVMS64K

config SOC_CY8C4126LCE_HVS013
	bool
	select SOC_SERIES_PSOC4HVMS64K

config SOC_CY8C4146LCE_HVS003
	bool
	select SOC_SERIES_PSOC4HVMS64K

config SOC_CY8C4146LCE_HVS013
	bool
	select SOC_SERIES_PSOC4HVMS64K

config SOC_CY8C4146LCE_HVS003X
	bool
	select SOC_SERIES_PSOC4HVMS64K

config SOC_CY8C4146LCE_HVS013X
	bool
	select SOC_SERIES_PSOC4HVMS64K

config SOC_CY8C4125LCE_HVS103
	bool
	select SOC_SERIES_PSOC4HVMS64K

config SOC_CY8C4125LCE_HVS113
	bool
	select SOC_SERIES_PSOC4HVMS64K

config SOC_CY8C4126LCE_HVS103
	bool
	select SOC_SERIES_PSOC4HVMS64K

config SOC_CY8C4126LCE_HVS113
	bool
	select SOC_SERIES_PSOC4HVMS64K

config SOC_CY8C4146LCE_HVS103
	bool
	select SOC_SERIES_PSOC4HVMS64K

config SOC_CY8C4146LCE_HVS113
	bool
	select SOC_SERIES_PSOC4HVMS64K

config SOC_CY8C4146LCE_HVS103X
	bool
	select SOC_SERIES_PSOC4HVMS64K

config SOC_CY8C4146LCE_HVS113X
	bool
	select SOC_SERIES_PSOC4HVMS64K

config SOC_CY8C4125LDE_HVS004
	bool
	select SOC_SERIES_PSOC4HVMS64K

config SOC_CY8C4125LDE_HVS014
	bool
	select SOC_SERIES_PSOC4HVMS64K

config SOC_CY8C4126LDE_HVS004
	bool
	select SOC_SERIES_PSOC4HVMS64K

config SOC_CY8C4126LDE_HVS014
	bool
	select SOC_SERIES_PSOC4HVMS64K

config SOC_CY8C4146LDE_HVS004
	bool
	select SOC_SERIES_PSOC4HVMS64K

config SOC_CY8C4146LDE_HVS014
	bool
	select SOC_SERIES_PSOC4HVMS64K

config SOC_CY8C4146LDE_HVS004X
	bool
	select SOC_SERIES_PSOC4HVMS64K

config SOC_CY8C4146LDE_HVS014X
	bool
	select SOC_SERIES_PSOC4HVMS64K

config SOC_CY8C4125LDE_HVS104
	bool
	select SOC_SERIES_PSOC4HVMS64K

config SOC_CY8C4125LDE_HVS114
	bool
	select SOC_SERIES_PSOC4HVMS64K

config SOC_CY8C4126LDE_HVS104
	bool
	select SOC_SERIES_PSOC4HVMS64K

config SOC_CY8C4126LDE_HVS114
	bool
	select SOC_SERIES_PSOC4HVMS64K

config SOC_CY8C4146LDE_HVS104
	bool
	select SOC_SERIES_PSOC4HVMS64K

config SOC_CY8C4146LDE_HVS114
	bool
	select SOC_SERIES_PSOC4HVMS64K

config SOC_CY8C4146LDE_HVS104X
	bool
	select SOC_SERIES_PSOC4HVMS64K

config SOC_CY8C4146LDE_HVS114X
	bool
	select SOC_SERIES_PSOC4HVMS64K

config SOC_CY8C4125LWE_HVS005
	bool
	select SOC_SERIES_PSOC4HVMS64K

config SOC_CY8C4125LWE_HVS015
	bool
	select SOC_SERIES_PSOC4HVMS64K

config SOC_CY8C4126LWE_HVS005
	bool
	select SOC_SERIES_PSOC4HVMS64K

config SOC_CY8C4126LWE_HVS015
	bool
	select SOC_SERIES_PSOC4HVMS64K

config SOC_CY8C4146LWE_HVS005
	bool
	select SOC_SERIES_PSOC4HVMS64K

config SOC_CY8C4146LWE_HVS015
	bool
	select SOC_SERIES_PSOC4HVMS64K

config SOC_CY8C4146LWE_HVS005X
	bool
	select SOC_SERIES_PSOC4HVMS64K

config SOC_CY8C4146LWE_HVS015X
	bool
	select SOC_SERIES_PSOC4HVMS64K

config SOC_CY8C4125LWE_HVS105
	bool
	select SOC_SERIES_PSOC4HVMS64K

config SOC_CY8C4125LWE_HVS115
	bool
	select SOC_SERIES_PSOC4HVMS64K

config SOC_CY8C4126LWE_HVS105
	bool
	select SOC_SERIES_PSOC4HVMS64K

config SOC_CY8C4126LWE_HVS115
	bool
	select SOC_SERIES_PSOC4HVMS64K

config SOC_CY8C4146LWE_HVS105
	bool
	select SOC_SERIES_PSOC4HVMS64K

config SOC_CY8C4146LWE_HVS115
	bool
	select SOC_SERIES_PSOC4HVMS64K

config SOC_CY8C4146LWE_HVS105X
	bool
	select SOC_SERIES_PSOC4HVMS64K

config SOC_CY8C4146LWE_HVS115X
	bool
	select SOC_SERIES_PSOC4HVMS64K

config SOC
	default "cy8c4125lce_hvs003" if SOC_CY8C4125LCE_HVS003
	default "cy8c4125lce_hvs013" if SOC_CY8C4125LCE_HVS013
	default "cy8c4126lce_hvs003" if SOC_CY8C4126LCE_HVS003
	default "cy8c4126lce_hvs013" if SOC_CY8C4126LCE_HVS013
	default "cy8c4146lce_hvs003" if SOC_CY8C4146LCE_HVS003
	default "cy8c4146lce_hvs013" if SOC_CY8C4146LCE_HVS013
	default "cy8c4146lce_hvs003x" if SOC_CY8C4146LCE_HVS003X
	default "cy8c4146lce_hvs013x" if SOC_CY8C4146LCE_HVS013X
	default "cy8c4125lce_hvs103" if SOC_CY8C4125LCE_HVS103
	default "cy8c4125lce_hvs113" if SOC_CY8C4125LCE_HVS113
	default "cy8c4126lce_hvs103" if SOC_CY8C4126LCE_HVS103
	default "cy8c4126lce_hvs113" if SOC_CY8C4126LCE_HVS113
	default "cy8c4146lce_hvs103" if SOC_CY8C4146LCE_HVS103
	default "cy8c4146lce_hvs113" if SOC_CY8C4146LCE_HVS113
	default "cy8c4146lce_hvs103x" if SOC_CY8C4146LCE_HVS103X
	default "cy8c4146lce_hvs113x" if SOC_CY8C4146LCE_HVS113X
	default "cy8c4125lde_hvs004" if SOC_CY8C4125LDE_HVS004
	default "cy8c4125lde_hvs014" if SOC_CY8C4125LDE_HVS014
	default "cy8c4126lde_hvs004" if SOC_CY8C4126LDE_HVS004
	default "cy8c4126lde_hvs014" if SOC_CY8C4126LDE_HVS014
	default "cy8c4146lde_hvs004" if SOC_CY8C4146LDE_HVS004
	default "cy8c4146lde_hvs014" if SOC_CY8C4146LDE_HVS014
	default "cy8c4146lde_hvs004x" if SOC_CY8C4146LDE_HVS004X
	default "cy8c4146lde_hvs014x" if SOC_CY8C4146LDE_HVS014X
	default "cy8c4125lde_hvs104" if SOC_CY8C4125LDE_HVS104
	default "cy8c4125lde_hvs114" if SOC_CY8C4125LDE_HVS114
	default "cy8c4126lde_hvs104" if SOC_CY8C4126LDE_HVS104
	default "cy8c4126lde_hvs114" if SOC_CY8C4126LDE_HVS114
	default "cy8c4146lde_hvs104" if SOC_CY8C4146LDE_HVS104
	default "cy8c4146lde_hvs114" if SOC_CY8C4146LDE_HVS114
	default "cy8c4146lde_hvs104x" if SOC_CY8C4146LDE_HVS104X
	default "cy8c4146lde_hvs114x" if SOC_CY8C4146LDE_HVS114X
	default "cy8c4125lwe_hvs005" if SOC_CY8C4125LWE_HVS005
	default "cy8c4125lwe_hvs015" if SOC_CY8C4125LWE_HVS015
	default "cy8c4126lwe_hvs005" if SOC_CY8C4126LWE_HVS005
	default "cy8c4126lwe_hvs015" if SOC_CY8C4126LWE_HVS015
	default "cy8c4146lwe_hvs005" if SOC_CY8C4146LWE_HVS005
	default "cy8c4146lwe_hvs015" if SOC_CY8C4146LWE_HVS015
	default "cy8c4146lwe_hvs005x" if SOC_CY8C4146LWE_HVS005X
	default "cy8c4146lwe_hvs015x" if SOC_CY8C4146LWE_HVS015X
	default "cy8c4125lwe_hvs105" if SOC_CY8C4125LWE_HVS105
	default "cy8c4125lwe_hvs115" if SOC_CY8C4125LWE_HVS115
	default "cy8c4126lwe_hvs105" if SOC_CY8C4126LWE_HVS105
	default "cy8c4126lwe_hvs115" if SOC_CY8C4126LWE_HVS115
	default "cy8c4146lwe_hvs105" if SOC_CY8C4146LWE_HVS105
	default "cy8c4146lwe_hvs115" if SOC_CY8C4146LWE_HVS115
	default "cy8c4146lwe_hvs105x" if SOC_CY8C4146LWE_HVS105X
	default "cy8c4146lwe_hvs115x" if SOC_CY8C4146LWE_HVS115X
```

## soc/infineon/psoc4/psoc4hvpa144k/Kconfig
```kconfig
# SPDX-FileCopyrightText: Copyright (c) 2026 Infineon Technologies AG,
# SPDX-FileCopyrightText: or an affiliate of Infineon Technologies AG. All rights reserved.
#
# SPDX-License-Identifier: Apache-2.0

# SOC Packages for Infineon PSOC4HVPA144K series MCUs
config SOC_PACKAGE_PSOC4HVPA144K_32_QFN
	bool
	help
	  32-pin QFN package

# Hardware configuration for PSOC4HVPA144K series
config SOC_SERIES_PSOC4HVPA144K
	select ARM
	select CPU_CORTEX_M0PLUS
	select CPU_CORTEX_M_HAS_VTOR
	select CPU_HAS_ARM_MPU
	select BUILD_OUTPUT_HEX
	select BUILD_OUTPUT_BIN
	select DYNAMIC_INTERRUPTS
	select SOC_EARLY_INIT_HOOK
	select SOC_EARLY_RESET_HOOK
	select CPU_CORTEX_M_HAS_SYSTICK

config SOC_CY8C4126LCE_HV403
	select SOC_PACKAGE_PSOC4HVPA144K_32_QFN

config SOC_CY8C4126LCE_HV413
	select SOC_PACKAGE_PSOC4HVPA144K_32_QFN

config SOC_CY8C4126LCE_HV423
	select SOC_PACKAGE_PSOC4HVPA144K_32_QFN

config SOC_CY8C4127LCE_HV403
	select SOC_PACKAGE_PSOC4HVPA144K_32_QFN

config SOC_CY8C4127LCE_HV413
	select SOC_PACKAGE_PSOC4HVPA144K_32_QFN

config SOC_CY8C4127LCE_HV423
	select SOC_PACKAGE_PSOC4HVPA144K_32_QFN

config SOC_CY8C4147LCE_HV403
	select SOC_PACKAGE_PSOC4HVPA144K_32_QFN

config SOC_CY8C4147LCE_HV413
	select SOC_PACKAGE_PSOC4HVPA144K_32_QFN

config SOC_CY8C4147LCE_HV423
	select SOC_PACKAGE_PSOC4HVPA144K_32_QFN
```

## soc/infineon/psoc4/psoc4hvpa144k/Kconfig.soc
```kconfig
# SPDX-FileCopyrightText: Copyright (c) 2026 Infineon Technologies AG,
# SPDX-FileCopyrightText: or an affiliate of Infineon Technologies AG. All rights reserved.
#
# SPDX-License-Identifier: Apache-2.0

# MCU series
config SOC_SERIES_PSOC4HVPA144K
	bool
	select SOC_FAMILY_INFINEON_PSOC4
	help
	  PSOC4 HVPA 144K Series MCU

config SOC_SERIES
	default "psoc4hvpa144k" if SOC_SERIES_PSOC4HVPA144K

config SOC_CY8C4126LCE_HV403
	bool
	select SOC_SERIES_PSOC4HVPA144K

config SOC_CY8C4126LCE_HV413
	bool
	select SOC_SERIES_PSOC4HVPA144K

config SOC_CY8C4126LCE_HV423
	bool
	select SOC_SERIES_PSOC4HVPA144K

config SOC_CY8C4127LCE_HV403
	bool
	select SOC_SERIES_PSOC4HVPA144K

config SOC_CY8C4127LCE_HV413
	bool
	select SOC_SERIES_PSOC4HVPA144K

config SOC_CY8C4127LCE_HV423
	bool
	select SOC_SERIES_PSOC4HVPA144K

config SOC_CY8C4147LCE_HV403
	bool
	select SOC_SERIES_PSOC4HVPA144K

config SOC_CY8C4147LCE_HV413
	bool
	select SOC_SERIES_PSOC4HVPA144K

config SOC_CY8C4147LCE_HV423
	bool
	select SOC_SERIES_PSOC4HVPA144K

config SOC
	default "cy8c4126lce_hv403" if SOC_CY8C4126LCE_HV403
	default "cy8c4126lce_hv413" if SOC_CY8C4126LCE_HV413
	default "cy8c4126lce_hv423" if SOC_CY8C4126LCE_HV423
	default "cy8c4127lce_hv403" if SOC_CY8C4127LCE_HV403
	default "cy8c4127lce_hv413" if SOC_CY8C4127LCE_HV413
	default "cy8c4127lce_hv423" if SOC_CY8C4127LCE_HV423
	default "cy8c4147lce_hv403" if SOC_CY8C4147LCE_HV403
	default "cy8c4147lce_hv413" if SOC_CY8C4147LCE_HV413
	default "cy8c4147lce_hv423" if SOC_CY8C4147LCE_HV423
```

## soc/intel/intel_socfpga/agilex3/Kconfig
```kconfig
# Copyright (c) 2022-2024 Intel Corporation
# Copyright (c) 2026 Altera Corporation
# SPDX-License-Identifier: Apache-2.0

config SOC_SERIES_AGILEX3
	select ARM64
	select CPU_CORTEX_A55
	select ARM_ARCH_TIMER
	select SYS_CLOCK_EXISTS
```

## soc/intel/intel_socfpga/agilex3/Kconfig.defconfig.series
```kconfig
# Copyright (c) 2022-2024 Intel Corporation
# Copyright (c) 2026 Altera Corporation
# SPDX-License-Identifier: Apache-2.0

if SOC_SERIES_AGILEX3

rsource "Kconfig.defconfig.agilex3*"

endif # SOC_SERIES_AGILEX3
```
