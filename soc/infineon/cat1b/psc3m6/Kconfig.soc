## soc/infineon/psoc4/psoc4hvms128k/Kconfig.soc
```kconfig
# SPDX-FileCopyrightText: Copyright (c) 2026 Infineon Technologies AG,
# SPDX-FileCopyrightText: or an affiliate of Infineon Technologies AG. All rights reserved.
#
# SPDX-License-Identifier: Apache-2.0

# MCU series
config SOC_SERIES_PSOC4HVMS128K
	bool
	select SOC_FAMILY_INFINEON_PSOC4
	help
	  PSOC4 HVMS 128K Series MCU

config SOC_SERIES
	default "psoc4hvms128k" if SOC_SERIES_PSOC4HVMS128K

config SOC_CY8C4127LDE_HVS004
	bool
	select SOC_SERIES_PSOC4HVMS128K

config SOC_CY8C4127LDE_HVS014
	bool
	select SOC_SERIES_PSOC4HVMS128K

config SOC_CY8C4147LDE_HVS004
	bool
	select SOC_SERIES_PSOC4HVMS128K

config SOC_CY8C4147LDE_HVS014
	bool
	select SOC_SERIES_PSOC4HVMS128K

config SOC_CY8C4147LDE_HVS024
	bool
	select SOC_SERIES_PSOC4HVMS128K

config SOC_CY8C4147LDE_HVS034
	bool
	select SOC_SERIES_PSOC4HVMS128K

config SOC_CY8C4147LDE_HVS024X
	bool
	select SOC_SERIES_PSOC4HVMS128K

config SOC_CY8C4147LDE_HVS034X
	bool
	select SOC_SERIES_PSOC4HVMS128K

config SOC_CY8C4127LDE_HVS104
	bool
	select SOC_SERIES_PSOC4HVMS128K

config SOC_CY8C4127LDE_HVS114
	bool
	select SOC_SERIES_PSOC4HVMS128K

config SOC_CY8C4147LDE_HVS104
	bool
	select SOC_SERIES_PSOC4HVMS128K

config SOC_CY8C4147LDE_HVS114
	bool
	select SOC_SERIES_PSOC4HVMS128K

config SOC_CY8C4147LDE_HVS124
	bool
	select SOC_SERIES_PSOC4HVMS128K

config SOC_CY8C4147LDE_HVS134
	bool
	select SOC_SERIES_PSOC4HVMS128K

config SOC_CY8C4147LDE_HVS124X
	bool
	select SOC_SERIES_PSOC4HVMS128K

config SOC_CY8C4147LDE_HVS134X
	bool
	select SOC_SERIES_PSOC4HVMS128K

config SOC_CY8C4127LWE_HVS005
	bool
	select SOC_SERIES_PSOC4HVMS128K

config SOC_CY8C4127LWE_HVS015
	bool
	select SOC_SERIES_PSOC4HVMS128K

config SOC_CY8C4147LWE_HVS005
	bool
	select SOC_SERIES_PSOC4HVMS128K

config SOC_CY8C4147LWE_HVS015
	bool
	select SOC_SERIES_PSOC4HVMS128K

config SOC_CY8C4147LWE_HVS025
	bool
	select SOC_SERIES_PSOC4HVMS128K

config SOC_CY8C4147LWE_HVS035
	bool
	select SOC_SERIES_PSOC4HVMS128K

config SOC_CY8C4147LWE_HVS025X
	bool
	select SOC_SERIES_PSOC4HVMS128K

config SOC_CY8C4147LWE_HVS035X
	bool
	select SOC_SERIES_PSOC4HVMS128K

config SOC_CY8C4127LWE_HVS105
	bool
	select SOC_SERIES_PSOC4HVMS128K

config SOC_CY8C4127LWE_HVS115
	bool
	select SOC_SERIES_PSOC4HVMS128K

config SOC_CY8C4147LWE_HVS105
	bool
	select SOC_SERIES_PSOC4HVMS128K

config SOC_CY8C4147LWE_HVS115
	bool
	select SOC_SERIES_PSOC4HVMS128K

config SOC_CY8C4147LWE_HVS125
	bool
	select SOC_SERIES_PSOC4HVMS128K

config SOC_CY8C4147LWE_HVS135
	bool
	select SOC_SERIES_PSOC4HVMS128K

config SOC_CY8C4147LWE_HVS125X
	bool
	select SOC_SERIES_PSOC4HVMS128K

config SOC_CY8C4147LWE_HVS135X
	bool
	select SOC_SERIES_PSOC4HVMS128K

config SOC_CY8C4127LQE_HVS006
	bool
	select SOC_SERIES_PSOC4HVMS128K

config SOC_CY8C4127LQE_HVS016
	bool
	select SOC_SERIES_PSOC4HVMS128K

config SOC_CY8C4147LQE_HVS006
	bool
	select SOC_SERIES_PSOC4HVMS128K

config SOC_CY8C4147LQE_HVS016
	bool
	select SOC_SERIES_PSOC4HVMS128K

config SOC_CY8C4147LQE_HVS026
	bool
	select SOC_SERIES_PSOC4HVMS128K

config SOC_CY8C4147LQE_HVS036
	bool
	select SOC_SERIES_PSOC4HVMS128K

config SOC_CY8C4147LQE_HVS026X
	bool
	select SOC_SERIES_PSOC4HVMS128K

config SOC_CY8C4147LQE_HVS036X
	bool
	select SOC_SERIES_PSOC4HVMS128K

config SOC_CY8C4127LQE_HVS106
	bool
	select SOC_SERIES_PSOC4HVMS128K

config SOC_CY8C4127LQE_HVS116
	bool
	select SOC_SERIES_PSOC4HVMS128K

config SOC_CY8C4147LQE_HVS106
	bool
	select SOC_SERIES_PSOC4HVMS128K

config SOC_CY8C4147LQE_HVS116
	bool
	select SOC_SERIES_PSOC4HVMS128K

config SOC_CY8C4147LQE_HVS126
	bool
	select SOC_SERIES_PSOC4HVMS128K

config SOC_CY8C4147LQE_HVS136
	bool
	select SOC_SERIES_PSOC4HVMS128K

config SOC_CY8C4147LQE_HVS126X
	bool
	select SOC_SERIES_PSOC4HVMS128K

config SOC_CY8C4147LQE_HVS136X
	bool
	select SOC_SERIES_PSOC4HVMS128K

config SOC_CY8C4127LCE_HVS003
	bool
	select SOC_SERIES_PSOC4HVMS128K

config SOC_CY8C4127LCE_HVS013
	bool
	select SOC_SERIES_PSOC4HVMS128K

config SOC_CY8C4127LCE_HVS103
	bool
	select SOC_SERIES_PSOC4HVMS128K

config SOC_CY8C4127LCE_HVS113
	bool
	select SOC_SERIES_PSOC4HVMS128K

config SOC_CY8C4147LCE_HVS003
	bool
	select SOC_SERIES_PSOC4HVMS128K

config SOC_CY8C4147LCE_HVS013
	bool
	select SOC_SERIES_PSOC4HVMS128K

config SOC_CY8C4147LCE_HVS023
	bool
	select SOC_SERIES_PSOC4HVMS128K

config SOC_CY8C4147LCE_HVS023X
	bool
	select SOC_SERIES_PSOC4HVMS128K

config SOC_CY8C4147LCE_HVS033
	bool
	select SOC_SERIES_PSOC4HVMS128K

config SOC_CY8C4147LCE_HVS033X
	bool
	select SOC_SERIES_PSOC4HVMS128K

config SOC_CY8C4147LCE_HVS103
	bool
	select SOC_SERIES_PSOC4HVMS128K

config SOC_CY8C4147LCE_HVS113
	bool
	select SOC_SERIES_PSOC4HVMS128K

config SOC_CY8C4147LCE_HVS123
	bool
	select SOC_SERIES_PSOC4HVMS128K

config SOC_CY8C4147LCE_HVS123X
	bool
	select SOC_SERIES_PSOC4HVMS128K

config SOC_CY8C4147LCE_HVS133
	bool
	select SOC_SERIES_PSOC4HVMS128K

config SOC_CY8C4147LCE_HVS133X
	bool
	select SOC_SERIES_PSOC4HVMS128K

config SOC
	default "cy8c4127lde_hvs004" if SOC_CY8C4127LDE_HVS004
	default "cy8c4127lde_hvs014" if SOC_CY8C4127LDE_HVS014
	default "cy8c4147lde_hvs004" if SOC_CY8C4147LDE_HVS004
	default "cy8c4147lde_hvs014" if SOC_CY8C4147LDE_HVS014
	default "cy8c4147lde_hvs024" if SOC_CY8C4147LDE_HVS024
	default "cy8c4147lde_hvs034" if SOC_CY8C4147LDE_HVS034
	default "cy8c4147lde_hvs024x" if SOC_CY8C4147LDE_HVS024X
	default "cy8c4147lde_hvs034x" if SOC_CY8C4147LDE_HVS034X
	default "cy8c4127lde_hvs104" if SOC_CY8C4127LDE_HVS104
	default "cy8c4127lde_hvs114" if SOC_CY8C4127LDE_HVS114
	default "cy8c4147lde_hvs104" if SOC_CY8C4147LDE_HVS104
	default "cy8c4147lde_hvs114" if SOC_CY8C4147LDE_HVS114
	default "cy8c4147lde_hvs124" if SOC_CY8C4147LDE_HVS124
	default "cy8c4147lde_hvs134" if SOC_CY8C4147LDE_HVS134
	default "cy8c4147lde_hvs124x" if SOC_CY8C4147LDE_HVS124X
	default "cy8c4147lde_hvs134x" if SOC_CY8C4147LDE_HVS134X
	default "cy8c4127lwe_hvs005" if SOC_CY8C4127LWE_HVS005
	default "cy8c4127lwe_hvs015" if SOC_CY8C4127LWE_HVS015
	default "cy8c4147lwe_hvs005" if SOC_CY8C4147LWE_HVS005
	default "cy8c4147lwe_hvs015" if SOC_CY8C4147LWE_HVS015
	default "cy8c4147lwe_hvs025" if SOC_CY8C4147LWE_HVS025
	default "cy8c4147lwe_hvs035" if SOC_CY8C4147LWE_HVS035
	default "cy8c4147lwe_hvs025x" if SOC_CY8C4147LWE_HVS025X
	default "cy8c4147lwe_hvs035x" if SOC_CY8C4147LWE_HVS035X
	default "cy8c4127lwe_hvs105" if SOC_CY8C4127LWE_HVS105
	default "cy8c4127lwe_hvs115" if SOC_CY8C4127LWE_HVS115
	default "cy8c4147lwe_hvs105" if SOC_CY8C4147LWE_HVS105
	default "cy8c4147lwe_hvs115" if SOC_CY8C4147LWE_HVS115
	default "cy8c4147lwe_hvs125" if SOC_CY8C4147LWE_HVS125
	default "cy8c4147lwe_hvs135" if SOC_CY8C4147LWE_HVS135
	default "cy8c4147lwe_hvs125x" if SOC_CY8C4147LWE_HVS125X
	default "cy8c4147lwe_hvs135x" if SOC_CY8C4147LWE_HVS135X
	default "cy8c4127lqe_hvs006" if SOC_CY8C4127LQE_HVS006
	default "cy8c4127lqe_hvs016" if SOC_CY8C4127LQE_HVS016
	default "cy8c4147lqe_hvs006" if SOC_CY8C4147LQE_HVS006
	default "cy8c4147lqe_hvs016" if SOC_CY8C4147LQE_HVS016
	default "cy8c4147lqe_hvs026" if SOC_CY8C4147LQE_HVS026
	default "cy8c4147lqe_hvs036" if SOC_CY8C4147LQE_HVS036
	default "cy8c4147lqe_hvs026x" if SOC_CY8C4147LQE_HVS026X
	default "cy8c4147lqe_hvs036x" if SOC_CY8C4147LQE_HVS036X
	default "cy8c4127lqe_hvs106" if SOC_CY8C4127LQE_HVS106
	default "cy8c4127lqe_hvs116" if SOC_CY8C4127LQE_HVS116
	default "cy8c4147lqe_hvs106" if SOC_CY8C4147LQE_HVS106
	default "cy8c4147lqe_hvs116" if SOC_CY8C4147LQE_HVS116
	default "cy8c4147lqe_hvs126" if SOC_CY8C4147LQE_HVS126
	default "cy8c4147lqe_hvs136" if SOC_CY8C4147LQE_HVS136
	default "cy8c4147lqe_hvs126x" if SOC_CY8C4147LQE_HVS126X
	default "cy8c4147lqe_hvs136x" if SOC_CY8C4147LQE_HVS136X
	default "cy8c4127lce_hvs003" if SOC_CY8C4127LCE_HVS003
	default "cy8c4127lce_hvs013" if SOC_CY8C4127LCE_HVS013
	default "cy8c4127lce_hvs103" if SOC_CY8C4127LCE_HVS103
	default "cy8c4127lce_hvs113" if SOC_CY8C4127LCE_HVS113
	default "cy8c4147lce_hvs003" if SOC_CY8C4147LCE_HVS003
	default "cy8c4147lce_hvs013" if SOC_CY8C4147LCE_HVS013
	default "cy8c4147lce_hvs023" if SOC_CY8C4147LCE_HVS023
	default "cy8c4147lce_hvs023x" if SOC_CY8C4147LCE_HVS023X
	default "cy8c4147lce_hvs033" if SOC_CY8C4147LCE_HVS033
	default "cy8c4147lce_hvs033x" if SOC_CY8C4147LCE_HVS033X
	default "cy8c4147lce_hvs103" if SOC_CY8C4147LCE_HVS103
	default "cy8c4147lce_hvs113" if SOC_CY8C4147LCE_HVS113
	default "cy8c4147lce_hvs123" if SOC_CY8C4147LCE_HVS123
	default "cy8c4147lce_hvs123x" if SOC_CY8C4147LCE_HVS123X
	default "cy8c4147lce_hvs133" if SOC_CY8C4147LCE_HVS133
	default "cy8c4147lce_hvs133x" if SOC_CY8C4147LCE_HVS133X
```

## soc/infineon/psoc4/psoc4hvms64k/Kconfig
```kconfig
# SPDX-FileCopyrightText: Copyright (c) 2026 Infineon Technologies AG,
# SPDX-FileCopyrightText: or an affiliate of Infineon Technologies AG. All rights reserved.
#
# SPDX-License-Identifier: Apache-2.0

# SOC Packages for Infineon PSOC4HVMS64K series MCUs
config SOC_PACKAGE_PSOC4HVMS64K_32_QFN
	bool
	help
	  32-pin QFN package

config SOC_PACKAGE_PSOC4HVMS64K_48_QFN
	bool
	help
	  48-pin QFN package

config SOC_PACKAGE_PSOC4HVMS64K_56_QFN
	bool
	help
	  56-pin QFN package

# Hardware configuration for PSOC4HVMS64K series
config SOC_SERIES_PSOC4HVMS64K
	select ARM
	select CPU_CORTEX_M0PLUS
	select CPU_CORTEX_M_HAS_VTOR
	select CPU_HAS_ARM_MPU
	select BUILD_OUTPUT_HEX
	select BUILD_OUTPUT_BIN
	select DYNAMIC_INTERRUPTS
	select SOC_EARLY_INIT_HOOK
	select SOC_EARLY_RESET_HOOK
	select CPU_CORTEX_M_HAS_SYSTICK

config SOC_CY8C4125LCE_HVS003
	select SOC_PACKAGE_PSOC4HVMS64K_32_QFN

config SOC_CY8C4125LCE_HVS013
	select SOC_PACKAGE_PSOC4HVMS64K_32_QFN

config SOC_CY8C4126LCE_HVS003
	select SOC_PACKAGE_PSOC4HVMS64K_32_QFN

config SOC_CY8C4126LCE_HVS013
	select SOC_PACKAGE_PSOC4HVMS64K_32_QFN

config SOC_CY8C4146LCE_HVS003
	select SOC_PACKAGE_PSOC4HVMS64K_32_QFN

config SOC_CY8C4146LCE_HVS013
	select SOC_PACKAGE_PSOC4HVMS64K_32_QFN

config SOC_CY8C4146LCE_HVS003X
	select SOC_PACKAGE_PSOC4HVMS64K_32_QFN

config SOC_CY8C4146LCE_HVS013X
	select SOC_PACKAGE_PSOC4HVMS64K_32_QFN

config SOC_CY8C4125LCE_HVS103
	select SOC_PACKAGE_PSOC4HVMS64K_32_QFN

config SOC_CY8C4125LCE_HVS113
	select SOC_PACKAGE_PSOC4HVMS64K_32_QFN

config SOC_CY8C4126LCE_HVS103
	select SOC_PACKAGE_PSOC4HVMS64K_32_QFN

config SOC_CY8C4126LCE_HVS113
	select SOC_PACKAGE_PSOC4HVMS64K_32_QFN

config SOC_CY8C4146LCE_HVS103
	select SOC_PACKAGE_PSOC4HVMS64K_32_QFN

config SOC_CY8C4146LCE_HVS113
	select SOC_PACKAGE_PSOC4HVMS64K_32_QFN

config SOC_CY8C4146LCE_HVS103X
	select SOC_PACKAGE_PSOC4HVMS64K_32_QFN

config SOC_CY8C4146LCE_HVS113X
	select SOC_PACKAGE_PSOC4HVMS64K_32_QFN

config SOC_CY8C4125LDE_HVS004
	select SOC_PACKAGE_PSOC4HVMS64K_48_QFN

config SOC_CY8C4125LDE_HVS014
	select SOC_PACKAGE_PSOC4HVMS64K_48_QFN

config SOC_CY8C4126LDE_HVS004
	select SOC_PACKAGE_PSOC4HVMS64K_48_QFN

config SOC_CY8C4126LDE_HVS014
	select SOC_PACKAGE_PSOC4HVMS64K_48_QFN

config SOC_CY8C4146LDE_HVS004
	select SOC_PACKAGE_PSOC4HVMS64K_48_QFN

config SOC_CY8C4146LDE_HVS014
	select SOC_PACKAGE_PSOC4HVMS64K_48_QFN

config SOC_CY8C4146LDE_HVS004X
	select SOC_PACKAGE_PSOC4HVMS64K_48_QFN

config SOC_CY8C4146LDE_HVS014X
	select SOC_PACKAGE_PSOC4HVMS64K_48_QFN

config SOC_CY8C4125LDE_HVS104
	select SOC_PACKAGE_PSOC4HVMS64K_48_QFN

config SOC_CY8C4125LDE_HVS114
	select SOC_PACKAGE_PSOC4HVMS64K_48_QFN

config SOC_CY8C4126LDE_HVS104
	select SOC_PACKAGE_PSOC4HVMS64K_48_QFN

config SOC_CY8C4126LDE_HVS114
	select SOC_PACKAGE_PSOC4HVMS64K_48_QFN

config SOC_CY8C4146LDE_HVS104
	select SOC_PACKAGE_PSOC4HVMS64K_48_QFN

config SOC_CY8C4146LDE_HVS114
	select SOC_PACKAGE_PSOC4HVMS64K_48_QFN

config SOC_CY8C4146LDE_HVS104X
	select SOC_PACKAGE_PSOC4HVMS64K_48_QFN

config SOC_CY8C4146LDE_HVS114X
	select SOC_PACKAGE_PSOC4HVMS64K_48_QFN

config SOC_CY8C4125LWE_HVS005
	select SOC_PACKAGE_PSOC4HVMS64K_56_QFN

config SOC_CY8C4125LWE_HVS015
	select SOC_PACKAGE_PSOC4HVMS64K_56_QFN

config SOC_CY8C4126LWE_HVS005
	select SOC_PACKAGE_PSOC4HVMS64K_56_QFN

config SOC_CY8C4126LWE_HVS015
	select SOC_PACKAGE_PSOC4HVMS64K_56_QFN

config SOC_CY8C4146LWE_HVS005
	select SOC_PACKAGE_PSOC4HVMS64K_56_QFN

config SOC_CY8C4146LWE_HVS015
	select SOC_PACKAGE_PSOC4HVMS64K_56_QFN

config SOC_CY8C4146LWE_HVS005X
	select SOC_PACKAGE_PSOC4HVMS64K_56_QFN

config SOC_CY8C4146LWE_HVS015X
	select SOC_PACKAGE_PSOC4HVMS64K_56_QFN

config SOC_CY8C4125LWE_HVS105
	select SOC_PACKAGE_PSOC4HVMS64K_56_QFN

config SOC_CY8C4125LWE_HVS115
	select SOC_PACKAGE_PSOC4HVMS64K_56_QFN

config SOC_CY8C4126LWE_HVS105
	select SOC_PACKAGE_PSOC4HVMS64K_56_QFN

config SOC_CY8C4126LWE_HVS115
	select SOC_PACKAGE_PSOC4HVMS64K_56_QFN

config SOC_CY8C4146LWE_HVS105
	select SOC_PACKAGE_PSOC4HVMS64K_56_QFN

config SOC_CY8C4146LWE_HVS115
	select SOC_PACKAGE_PSOC4HVMS64K_56_QFN

config SOC_CY8C4146LWE_HVS105X
	select SOC_PACKAGE_PSOC4HVMS64K_56_QFN

config SOC_CY8C4146LWE_HVS115X
	select SOC_PACKAGE_PSOC4HVMS64K_56_QFN
```
