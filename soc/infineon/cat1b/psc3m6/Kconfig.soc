## soc/infineon/cat1b/psc3m6/Kconfig.soc
```kconfig
# SPDX-FileCopyrightText: Copyright (c) 2026 Infineon Technologies AG,
# SPDX-FileCopyrightText: or an affiliate of Infineon Technologies AG. All rights reserved.
#
# SPDX-License-Identifier: Apache-2.0

# Infineon PSC3M6 series MCUs
config SOC_SERIES_PSC3M6
	bool

config SOC_SERIES
	default "psc3m6" if SOC_SERIES_PSC3M6

config SOC_DIE_PSC3M6
	bool
	select SOC_FAMILY_INFINEON_CAT1B

config SOC_DIE_PSC3P6
	bool
	select SOC_FAMILY_INFINEON_CAT1B

# SOC Packages for Infineon PSC3M6 series MCUs
config SOC_PACKAGE_PSC3M6_E_LQFP_100
	bool

config SOC_PACKAGE_PSC3M6_E_LQFP_80
	bool

config SOC_PACKAGE_PSC3M6_E_LQFP_64
	bool

# Infineon PSC3M6 series MPNs
config SOC_PSC3M6GES3AHQ1
	bool
	select SOC_PACKAGE_PSC3M6_E_LQFP_100
	select SOC_SERIES_PSC3M6
	select SOC_DIE_PSC3M6

config SOC_PSC3P6GES3AHQ1
	bool
	select SOC_PACKAGE_PSC3M6_E_LQFP_100
	select SOC_SERIES_PSC3M6
	select SOC_DIE_PSC3P6

config SOC_PSC3M6FDS2AHQ1
	bool
	select SOC_PACKAGE_PSC3M6_E_LQFP_100
	select SOC_SERIES_PSC3M6
	select SOC_DIE_PSC3M6

config SOC_PSC3P6FDS2AHQ1
	bool
	select SOC_PACKAGE_PSC3M6_E_LQFP_100
	select SOC_SERIES_PSC3M6
	select SOC_DIE_PSC3P6

config SOC_PSC3M6GES3AFQ1
	bool
	select SOC_PACKAGE_PSC3M6_E_LQFP_80
	select SOC_SERIES_PSC3M6
	select SOC_DIE_PSC3M6

config SOC_PSC3P6GES3AFQ1
	bool
	select SOC_PACKAGE_PSC3M6_E_LQFP_80
	select SOC_SERIES_PSC3M6
	select SOC_DIE_PSC3P6

config SOC_PSC3M6FDS2AFQ1
	bool
	select SOC_PACKAGE_PSC3M6_E_LQFP_80
	select SOC_SERIES_PSC3M6
	select SOC_DIE_PSC3M6

config SOC_PSC3P6FDS2AFQ1
	bool
	select SOC_PACKAGE_PSC3M6_E_LQFP_80
	select SOC_SERIES_PSC3M6
	select SOC_DIE_PSC3P6

config SOC_PSC3M6GES3ACQ1
	bool
	select SOC_PACKAGE_PSC3M6_E_LQFP_64
	select SOC_SERIES_PSC3M6
	select SOC_DIE_PSC3M6

config SOC_PSC3P6GES3ACQ1
	bool
	select SOC_PACKAGE_PSC3M6_E_LQFP_64
	select SOC_SERIES_PSC3M6
	select SOC_DIE_PSC3P6

config SOC_PSC3M6FDS2ACQ1
	bool
	select SOC_PACKAGE_PSC3M6_E_LQFP_64
	select SOC_SERIES_PSC3M6
	select SOC_DIE_PSC3M6

config SOC_PSC3P6FDS2ACQ1
	bool
	select SOC_PACKAGE_PSC3M6_E_LQFP_64
	select SOC_SERIES_PSC3M6
	select SOC_DIE_PSC3P6

config SOC
	default "psc3m6ges3ahq1" if SOC_PSC3M6GES3AHQ1
	default "psc3p6ges3ahq1" if SOC_PSC3P6GES3AHQ1
	default "psc3m6fds2ahq1" if SOC_PSC3M6FDS2AHQ1
	default "psc3p6fds2ahq1" if SOC_PSC3P6FDS2AHQ1
	default "psc3m6ges3afq1" if SOC_PSC3M6GES3AFQ1
	default "psc3p6ges3afq1" if SOC_PSC3P6GES3AFQ1
	default "psc3m6fds2afq1" if SOC_PSC3M6FDS2AFQ1
	default "psc3p6fds2afq1" if SOC_PSC3P6FDS2AFQ1
	default "psc3m6ges3acq1" if SOC_PSC3M6GES3ACQ1
	default "psc3p6ges3acq1" if SOC_PSC3P6GES3ACQ1
	default "psc3m6fds2acq1" if SOC_PSC3M6FDS2ACQ1
	default "psc3p6fds2acq1" if SOC_PSC3P6FDS2ACQ1
```

## soc/infineon/cat1c/cyt4dn/Kconfig
```kconfig
# SPDX-FileCopyrightText: Copyright (c) 2026 Linumiz
# SPDX-FileCopyrightText: Copyright (c) 2026 Infineon Technologies AG,
# SPDX-FileCopyrightText: or an affiliate of Infineon Technologies AG. All rights reserved.
#
# SPDX-License-Identifier: Apache-2.0

if SOC_SERIES_CYT4DN

rsource "*/Kconfig"

endif
```

## soc/infineon/cat1c/cyt4dn/m7/Kconfig
```kconfig
# SPDX-FileCopyrightText: Copyright (c) 2026 Linumiz
# SPDX-FileCopyrightText: Copyright (c) 2026 Infineon Technologies AG,
# SPDX-FileCopyrightText: or an affiliate of Infineon Technologies AG. All rights reserved.
#
# SPDX-License-Identifier: Apache-2.0

if SOC_SERIES_CYT4DN

config SOC_CYT4DNJBZS_M7_0
	select ARM
	select CPU_CORTEX_M7
	select CPU_CORTEX_M_HAS_SYSTICK
	select CPU_CORTEX_M_HAS_VTOR
	select CPU_HAS_ARM_MPU
	select CPU_HAS_ICACHE
	select CPU_HAS_DCACHE
	select CPU_HAS_FPU
	select SOC_PREP_HOOK
	select SOC_EARLY_INIT_HOOK

config SOC_CYT4DNJBZS_M7_1
	select ARM
	select CPU_CORTEX_M7
	select CPU_CORTEX_M_HAS_SYSTICK
	select CPU_CORTEX_M_HAS_VTOR
	select CPU_HAS_ARM_MPU
	select CPU_HAS_ICACHE
	select CPU_HAS_DCACHE
	select CPU_HAS_FPU
	select SOC_PREP_HOOK
	select SOC_EARLY_INIT_HOOK

endif
```

## soc/infineon/cat3/Kconfig
```kconfig
# SPDX-License-Identifier: Apache-2.0
#
# Copyright (c) 2020 Linumiz
# Author: Parthiban Nallathambi <parthiban@linumiz.com>

config SOC_FAMILY_INFINEON_XMC
	select HAS_SEGGER_RTT
	select SOC_RESET_HOOK

if SOC_FAMILY_INFINEON_XMC

rsource "*/Kconfig"

endif # SOC_FAMILY_INFINEON_XMC
```

## soc/infineon/edge/Kconfig.defconfig
```kconfig
# SPDX-FileCopyrightText: Copyright (c) 2026 Infineon Technologies AG,
# SPDX-FileCopyrightText: or an affiliate of Infineon Technologies AG. All rights reserved.
#
# SPDX-License-Identifier: Apache-2.0

# PSOC CAT1B Configuration

if SOC_FAMILY_INFINEON_EDGE

config CLOCK_CONTROL_IFX_PERI_CLOCK_HAS_GROUP
	default y

rsource "*/Kconfig.defconfig"

endif # SOC_FAMILY_INFINEON_EDGE
```

## soc/infineon/edge/pse84/Kconfig
```kconfig
# SPDX-FileCopyrightText: Copyright (c) 2026 Infineon Technologies AG,
# SPDX-FileCopyrightText: or an affiliate of Infineon Technologies AG. All rights reserved.
#
# SPDX-License-Identifier: Apache-2.0

config SOC_SERIES_PSE84
	select ARM
	select CPU_HAS_FPU
	select ARMV8_M_DSP
	select CPU_HAS_ARM_MPU
	select BUILD_OUTPUT_HEX
	select BUILD_OUTPUT_BIN
	select DYNAMIC_INTERRUPTS
	select SOC_EARLY_INIT_HOOK
	select HAS_PM
	select PM_STATE_SET_IRQ_UNLOCKED
	select HAS_POWEROFF
	select CPU_HAS_CUSTOM_FIXED_SOC_MPU_REGIONS

config SOC_SERIES_PSE84_M33
	select CPU_CORTEX_M33
	select CPU_HAS_ARM_SAU
	select ARM_TRUSTZONE_M
	select ARCH_HAS_TRUSTED_EXECUTION

config SOC_SERIES_PSE84_M55
	select CPU_CORTEX_M55
	select ARMV8_1_M_MVEI
	select ARMV8_1_M_MVEF
	select CACHE_MANAGEMENT

config SOC_SERIES_PSE84_M33
	select SOC_LATE_INIT_HOOK

config PSOC_EDGE_M55_SRF_SUPPORT
	bool "Select whether to enable the SRF support on m55"
	select USE_INFINEON_ABSTRACTION_RTOS
	help
	  This option enables the SRF support on m55 core on pse84 and the infrastructure setup on m33/ns to deal with that.

if SOC_SERIES_PSE84_M33

config SOC_PSE84_M55_ENABLE
	bool "m55 core support"
	help
	  This option enables the m55 core on pse84, by m33 core.

config SOC_PSE84_M55_RAM_LOAD
	bool "Copy the m55 image into RAM before release"
	depends on SOC_PSE84_M55_ENABLE
	help
	  Instead of launching the m55 core in place from flash0_sahb/m55_xip
	  (XIP), copy its code, rodata, and data to RAM first and launch it
	  there. The image is still stored in m55_xip -- this only changes
	  where it executes from -- so SMIF0 never needs to stay in
	  XIP/memory-mapped mode once the m55 core is running there (see
	  CONFIG_SOC_PSE84_M55_DISABLE_SMIF_XIP, set independently on the m55
	  core's own build). The copy destination is the
	  "zephyr,boot-ram-load-region" devicetree chosen node, provided by a
	  board/application overlay; it must be kept equal to the address and
	  size the m55 core's own CONFIG_FLASH_BASE_ADDRESS/CONFIG_FLASH_SIZE
	  resolve to (set directly in m55's own board/application .conf,
	  rather than derived from a zephyr,flash chosen node -- m55's
	  separate zephyr,sram region is never touched by m33 at all).

endif # SOC_SERIES_PSE84_M33

if SOC_SERIES_PSE84_M55

config SOC_PSE84_M55_DISABLE_SMIF_XIP
	bool "Leave SMIF0 XIP mode once m55 init is done"
	select USE_INFINEON_SMIF
	help
	  Once this core's own code/data are fully resident in RAM (copied
	  there by m33 before release -- see CONFIG_SOC_PSE84_M55_RAM_LOAD on
	  the m33 side), nothing on either core needs SMIF0 in
	  XIP/memory-mapped mode anymore. Leaving it set keeps
	  Cy_SMIF_MemEraseSector()'s critical-section guard engaged for every
	  flash_area erase performed later, freezing this core's interrupts
	  for the duration of the erase. This clears it once, for the
	  system's whole remaining life.

	  CONFIG_SOC_PSE84_M55_RAM_LOAD lives in the m33 image's own Kconfig
	  tree, a separate build this one cannot see into, so enabling this
	  without it is a real, unchecked-by-Kconfig way to hang this core:
	  it would still be executing from m55_xip when SMIF0 leaves XIP
	  mode. A BUILD_ASSERT in soc_pse84_m55.c catches the one symptom
	  visible from this side instead -- a zephyr,flash chosen node still
	  being present, which would mean this core is still linked to
	  execute from m55_xip rather than from its RAM destination.

endif # SOC_SERIES_PSE84_M55

config SOC_PSE84_LPM_TIMER
	bool
	default y if SYSTEM_TIMER_LPM_COMPANION_HOOKS
	select USE_INFINEON_LPTIMER
	help
	  Enable MCWDT as a low-power companion timer for the SysTick.
	  The MCWDT runs from PILO (32 kHz) and provides timekeeping
	  during deepsleep when HF clocks (and thus SysTick) are stopped.
```

## soc/infineon/psoc4/Kconfig
```kconfig
# SPDX-FileCopyrightText: Copyright (c) 2026 Infineon Technologies AG,
# SPDX-FileCopyrightText: or an affiliate of Infineon Technologies AG. All rights reserved.
#
# SPDX-License-Identifier: Apache-2.0

config SOC_FAMILY_INFINEON_PSOC4
	select SPI_INFINEON_PDL_PERIPHERAL_NO_CLOCK_STALL if SPI

rsource "*/Kconfig"
```

## soc/infineon/psoc4/Kconfig.soc
```kconfig
# SPDX-FileCopyrightText: Copyright (c) 2026 Infineon Technologies AG,
# SPDX-FileCopyrightText: or an affiliate of Infineon Technologies AG. All rights reserved.
#
# SPDX-License-Identifier: Apache-2.0

# Family definitions
config SOC_FAMILY_INFINEON_PSOC4
	bool

rsource "*/Kconfig.soc"
```

## soc/infineon/psoc4/psoc4000t/Kconfig
```kconfig
# SPDX-FileCopyrightText: Copyright (c) 2026 Infineon Technologies AG,
# SPDX-FileCopyrightText: or an affiliate of Infineon Technologies AG. All rights reserved.
#
# SPDX-License-Identifier: Apache-2.0

# SOC Packages for Infineon PSOC4000T series MCUs
config SOC_PACKAGE_PSOC4000T_16_QFN
	bool
	help
	  16-pin QFN package

config SOC_PACKAGE_PSOC4000T_24_QFN
	bool
	help
	  24-pin QFN package

config SOC_PACKAGE_PSOC4000T_25_WLCSP
	bool
	help
	  25-pin WLCSP package

# Hardware configuration for PSOC4000T series
config SOC_SERIES_PSOC4000T
	select ARM
	select CPU_CORTEX_M0PLUS
	select CPU_CORTEX_M_HAS_VTOR
	select BUILD_OUTPUT_HEX
	select BUILD_OUTPUT_BIN
	select DYNAMIC_INTERRUPTS
	select SOC_EARLY_INIT_HOOK
	select CPU_CORTEX_M_HAS_SYSTICK

# Infineon PSOC4000T series MPNs
config SOC_CY8C4046LQI_T452
	select SOC_PACKAGE_PSOC4000T_24_QFN

# Automotive-qualified (AUTO) MPN used by the CY8CPROTO-040T-AUTO board
config SOC_CY8C4046LQE_T1
	select SOC_PACKAGE_PSOC4000T_24_QFN

config SOC_CY8C4025LQI_T411
	select SOC_PACKAGE_PSOC4000T_16_QFN

config SOC_CY8C4025LQI_T441
	select SOC_PACKAGE_PSOC4000T_16_QFN

config SOC_CY8C4025LQI_T451
	select SOC_PACKAGE_PSOC4000T_16_QFN

config SOC_CY8C4026LQI_T411
	select SOC_PACKAGE_PSOC4000T_16_QFN

config SOC_CY8C4026LQI_T441
	select SOC_PACKAGE_PSOC4000T_16_QFN

config SOC_CY8C4045LQI_T411
	select SOC_PACKAGE_PSOC4000T_16_QFN

config SOC_CY8C4045LQI_T441
	select SOC_PACKAGE_PSOC4000T_16_QFN

config SOC_CY8C4045LQI_T451
	select SOC_PACKAGE_PSOC4000T_16_QFN

config SOC_CY8C4046LQI_T411
	select SOC_PACKAGE_PSOC4000T_16_QFN

config SOC_CY8C4046LQI_T441
	select SOC_PACKAGE_PSOC4000T_16_QFN

config SOC_CY8C4046LQI_T451
	select SOC_PACKAGE_PSOC4000T_16_QFN

config SOC_CY8C4025LQI_T412
	select SOC_PACKAGE_PSOC4000T_24_QFN

config SOC_CY8C4025LQI_T442
	select SOC_PACKAGE_PSOC4000T_24_QFN

config SOC_CY8C4025LQI_T452
	select SOC_PACKAGE_PSOC4000T_24_QFN

config SOC_CY8C4026LQI_T412
	select SOC_PACKAGE_PSOC4000T_24_QFN

config SOC_CY8C4026LQI_T442
	select SOC_PACKAGE_PSOC4000T_24_QFN

config SOC_CY8C4045LQI_T412
	select SOC_PACKAGE_PSOC4000T_24_QFN

config SOC_CY8C4045LQI_T442
	select SOC_PACKAGE_PSOC4000T_24_QFN

config SOC_CY8C4045LQI_T452
	select SOC_PACKAGE_PSOC4000T_24_QFN

config SOC_CY8C4045LQE_T1
	select SOC_PACKAGE_PSOC4000T_24_QFN

config SOC_CY8C4045LQS_T1
	select SOC_PACKAGE_PSOC4000T_24_QFN

config SOC_CY8C4046LQI_T412
	select SOC_PACKAGE_PSOC4000T_24_QFN

config SOC_CY8C4046LQI_T442
	select SOC_PACKAGE_PSOC4000T_24_QFN

config SOC_CY8C4046LQS_T1
	select SOC_PACKAGE_PSOC4000T_24_QFN

config SOC_CY8C4046LQQ_T412
	select SOC_PACKAGE_PSOC4000T_24_QFN

config SOC_CY8C4025FNI_T412
	select SOC_PACKAGE_PSOC4000T_25_WLCSP

config SOC_CY8C4025FNI_T442
	select SOC_PACKAGE_PSOC4000T_25_WLCSP

config SOC_CY8C4025FNI_T452
	select SOC_PACKAGE_PSOC4000T_25_WLCSP

config SOC_CY8C4026FNI_T412
	select SOC_PACKAGE_PSOC4000T_25_WLCSP

config SOC_CY8C4026FNI_T442
	select SOC_PACKAGE_PSOC4000T_25_WLCSP

config SOC_CY8C4045FNI_T412
	select SOC_PACKAGE_PSOC4000T_25_WLCSP

config SOC_CY8C4045FNI_T442
	select SOC_PACKAGE_PSOC4000T_25_WLCSP

config SOC_CY8C4045FNI_T452
	select SOC_PACKAGE_PSOC4000T_25_WLCSP

config SOC_CY8C4046FNI_T412
	select SOC_PACKAGE_PSOC4000T_25_WLCSP

config SOC_CY8C4046FNI_T442
	select SOC_PACKAGE_PSOC4000T_25_WLCSP

config SOC_CY8C4046FNI_T452
	select SOC_PACKAGE_PSOC4000T_25_WLCSP
```
