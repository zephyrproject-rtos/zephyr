## soc/infineon/psoc4/psoc4000t/Kconfig.soc
```kconfig
# SPDX-FileCopyrightText: Copyright (c) 2026 Infineon Technologies AG,
# SPDX-FileCopyrightText: or an affiliate of Infineon Technologies AG. All rights reserved.
#
# SPDX-License-Identifier: Apache-2.0

# MCU series
config SOC_SERIES_PSOC4000T
	bool
	select SOC_FAMILY_INFINEON_PSOC4
	help
	  PSOC4000T Series MCU

config SOC_SERIES
	default "psoc4000t" if SOC_SERIES_PSOC4000T

config SOC_CY8C4046LQI_T452
	bool
	select SOC_SERIES_PSOC4000T

# Automotive-qualified (AUTO) MPN used by the CY8CPROTO-040T-AUTO board
config SOC_CY8C4046LQE_T1
	bool
	select SOC_SERIES_PSOC4000T

config SOC_CY8C4025LQI_T411
	bool
	select SOC_SERIES_PSOC4000T

config SOC_CY8C4025LQI_T441
	bool
	select SOC_SERIES_PSOC4000T

config SOC_CY8C4025LQI_T451
	bool
	select SOC_SERIES_PSOC4000T

config SOC_CY8C4026LQI_T411
	bool
	select SOC_SERIES_PSOC4000T

config SOC_CY8C4026LQI_T441
	bool
	select SOC_SERIES_PSOC4000T

config SOC_CY8C4045LQI_T411
	bool
	select SOC_SERIES_PSOC4000T

config SOC_CY8C4045LQI_T441
	bool
	select SOC_SERIES_PSOC4000T

config SOC_CY8C4045LQI_T451
	bool
	select SOC_SERIES_PSOC4000T

config SOC_CY8C4046LQI_T411
	bool
	select SOC_SERIES_PSOC4000T

config SOC_CY8C4046LQI_T441
	bool
	select SOC_SERIES_PSOC4000T

config SOC_CY8C4046LQI_T451
	bool
	select SOC_SERIES_PSOC4000T

config SOC_CY8C4025LQI_T412
	bool
	select SOC_SERIES_PSOC4000T

config SOC_CY8C4025LQI_T442
	bool
	select SOC_SERIES_PSOC4000T

config SOC_CY8C4025LQI_T452
	bool
	select SOC_SERIES_PSOC4000T

config SOC_CY8C4026LQI_T412
	bool
	select SOC_SERIES_PSOC4000T

config SOC_CY8C4026LQI_T442
	bool
	select SOC_SERIES_PSOC4000T

config SOC_CY8C4045LQI_T412
	bool
	select SOC_SERIES_PSOC4000T

config SOC_CY8C4045LQI_T442
	bool
	select SOC_SERIES_PSOC4000T

config SOC_CY8C4045LQI_T452
	bool
	select SOC_SERIES_PSOC4000T

config SOC_CY8C4045LQE_T1
	bool
	select SOC_SERIES_PSOC4000T

config SOC_CY8C4045LQS_T1
	bool
	select SOC_SERIES_PSOC4000T

config SOC_CY8C4046LQI_T412
	bool
	select SOC_SERIES_PSOC4000T

config SOC_CY8C4046LQI_T442
	bool
	select SOC_SERIES_PSOC4000T

config SOC_CY8C4046LQS_T1
	bool
	select SOC_SERIES_PSOC4000T

config SOC_CY8C4046LQQ_T412
	bool
	select SOC_SERIES_PSOC4000T

config SOC_CY8C4025FNI_T412
	bool
	select SOC_SERIES_PSOC4000T

config SOC_CY8C4025FNI_T442
	bool
	select SOC_SERIES_PSOC4000T

config SOC_CY8C4025FNI_T452
	bool
	select SOC_SERIES_PSOC4000T

config SOC_CY8C4026FNI_T412
	bool
	select SOC_SERIES_PSOC4000T

config SOC_CY8C4026FNI_T442
	bool
	select SOC_SERIES_PSOC4000T

config SOC_CY8C4045FNI_T412
	bool
	select SOC_SERIES_PSOC4000T

config SOC_CY8C4045FNI_T442
	bool
	select SOC_SERIES_PSOC4000T

config SOC_CY8C4045FNI_T452
	bool
	select SOC_SERIES_PSOC4000T

config SOC_CY8C4046FNI_T412
	bool
	select SOC_SERIES_PSOC4000T

config SOC_CY8C4046FNI_T442
	bool
	select SOC_SERIES_PSOC4000T

config SOC_CY8C4046FNI_T452
	bool
	select SOC_SERIES_PSOC4000T

config SOC
	default "cy8c4046lqi_t452" if SOC_CY8C4046LQI_T452
	default "cy8c4046lqe_t1" if SOC_CY8C4046LQE_T1
	default "cy8c4025lqi_t411" if SOC_CY8C4025LQI_T411
	default "cy8c4025lqi_t441" if SOC_CY8C4025LQI_T441
	default "cy8c4025lqi_t451" if SOC_CY8C4025LQI_T451
	default "cy8c4026lqi_t411" if SOC_CY8C4026LQI_T411
	default "cy8c4026lqi_t441" if SOC_CY8C4026LQI_T441
	default "cy8c4045lqi_t411" if SOC_CY8C4045LQI_T411
	default "cy8c4045lqi_t441" if SOC_CY8C4045LQI_T441
	default "cy8c4045lqi_t451" if SOC_CY8C4045LQI_T451
	default "cy8c4046lqi_t411" if SOC_CY8C4046LQI_T411
	default "cy8c4046lqi_t441" if SOC_CY8C4046LQI_T441
	default "cy8c4046lqi_t451" if SOC_CY8C4046LQI_T451
	default "cy8c4025lqi_t412" if SOC_CY8C4025LQI_T412
	default "cy8c4025lqi_t442" if SOC_CY8C4025LQI_T442
	default "cy8c4025lqi_t452" if SOC_CY8C4025LQI_T452
	default "cy8c4026lqi_t412" if SOC_CY8C4026LQI_T412
	default "cy8c4026lqi_t442" if SOC_CY8C4026LQI_T442
	default "cy8c4045lqi_t412" if SOC_CY8C4045LQI_T412
	default "cy8c4045lqi_t442" if SOC_CY8C4045LQI_T442
	default "cy8c4045lqi_t452" if SOC_CY8C4045LQI_T452
	default "cy8c4045lqe_t1" if SOC_CY8C4045LQE_T1
	default "cy8c4045lqs_t1" if SOC_CY8C4045LQS_T1
	default "cy8c4046lqi_t412" if SOC_CY8C4046LQI_T412
	default "cy8c4046lqi_t442" if SOC_CY8C4046LQI_T442
	default "cy8c4046lqs_t1" if SOC_CY8C4046LQS_T1
	default "cy8c4046lqq_t412" if SOC_CY8C4046LQQ_T412
	default "cy8c4025fni_t412" if SOC_CY8C4025FNI_T412
	default "cy8c4025fni_t442" if SOC_CY8C4025FNI_T442
	default "cy8c4025fni_t452" if SOC_CY8C4025FNI_T452
	default "cy8c4026fni_t412" if SOC_CY8C4026FNI_T412
	default "cy8c4026fni_t442" if SOC_CY8C4026FNI_T442
	default "cy8c4045fni_t412" if SOC_CY8C4045FNI_T412
	default "cy8c4045fni_t442" if SOC_CY8C4045FNI_T442
	default "cy8c4045fni_t452" if SOC_CY8C4045FNI_T452
	default "cy8c4046fni_t412" if SOC_CY8C4046FNI_T412
	default "cy8c4046fni_t442" if SOC_CY8C4046FNI_T442
	default "cy8c4046fni_t452" if SOC_CY8C4046FNI_T452
```

## soc/infineon/psoc4/psoc4100splus/Kconfig.soc
```kconfig
# SPDX-FileCopyrightText: Copyright (c) 2026 Infineon Technologies AG,
# SPDX-FileCopyrightText: or an affiliate of Infineon Technologies AG. All rights reserved.
#
# SPDX-License-Identifier: Apache-2.0

# MCU series
config SOC_SERIES_PSOC4100SPLUS
	bool
	select SOC_FAMILY_INFINEON_PSOC4
	help
	  PSOC4100Splus Series MCU

config SOC_SERIES
	default "psoc4100splus" if SOC_SERIES_PSOC4100SPLUS

config SOC_CY8C4147AZI_S475
	bool
	select SOC_SERIES_PSOC4100SPLUS

config SOC
	default "cy8c4147azi_s475" if SOC_CY8C4147AZI_S475
```

## soc/infineon/psoc4/psoc4100tp/Kconfig.defconfig
```kconfig
# SPDX-FileCopyrightText: Copyright (c) 2026 Infineon Technologies AG,
# SPDX-FileCopyrightText: or an affiliate of Infineon Technologies AG. All rights reserved.
#
# SPDX-License-Identifier: Apache-2.0

if SOC_SERIES_PSOC4100TP

config NUM_IRQS
	default 23

config SYS_CLOCK_HW_CYCLES_PER_SEC
	default $(dt_node_int_prop_int,/cpus/cpu@0,clock-frequency)

if PM

choice SYSTEM_TIMER_LPM_COMPANION
	default SYSTEM_TIMER_LPM_COMPANION_HOOKS
endchoice

endif # PM

endif # SOC_SERIES_PSOC4100TP
```

## soc/infineon/psoc4/psoc4_hvpa_144k/Kconfig.soc
```kconfig
# SPDX-FileCopyrightText: <text>Copyright (c) 2026 Infineon Technologies AG,
# or an affiliate of Infineon Technologies AG. All rights reserved.</text>
#
# SPDX-License-Identifier: Apache-2.0

# MCU series
config SOC_SERIES_PSOC4_HVPA_144K
	bool
	select SOC_FAMILY_INFINEON_PSOC4
	help
	  PSOC4 HVPA 144K Series MCU

config SOC_SERIES
	default "psoc4_hvpa_144k" if SOC_SERIES_PSOC4_HVPA_144K

config SOC_CY8C4147LCE_HV423
	bool
	select SOC_SERIES_PSOC4_HVPA_144K

config SOC
	default "cy8c4147lce_hv423" if SOC_CY8C4147LCE_HV423
```

## soc/infineon/psoc4/psoc4hvms128k/Kconfig
```kconfig
# SPDX-FileCopyrightText: Copyright (c) 2026 Infineon Technologies AG,
# SPDX-FileCopyrightText: or an affiliate of Infineon Technologies AG. All rights reserved.
#
# SPDX-License-Identifier: Apache-2.0

# SOC Packages for Infineon PSOC4HVMS128K series MCUs
config SOC_PACKAGE_PSOC4HVMS128K_32_QFN
	bool
	help
	  32-pin QFN package

config SOC_PACKAGE_PSOC4HVMS128K_48_QFN
	bool
	help
	  48-pin QFN package

config SOC_PACKAGE_PSOC4HVMS128K_56_QFN
	bool
	help
	  56-pin QFN package

config SOC_PACKAGE_PSOC4HVMS128K_64_QFN
	bool
	help
	  64-pin QFN package

# Hardware configuration for PSOC4HVMS128K series
config SOC_SERIES_PSOC4HVMS128K
	select ARM
	select CPU_CORTEX_M0PLUS
	select CPU_CORTEX_M_HAS_VTOR
	select CPU_HAS_ARM_MPU
	select BUILD_OUTPUT_HEX
	select BUILD_OUTPUT_BIN
	select DYNAMIC_INTERRUPTS
	select SOC_EARLY_INIT_HOOK
	select SOC_EARLY_RESET_HOOK
	select CPU_CORTEX_M_HAS_SYSTICK

config SOC_CY8C4127LDE_HVS004
	select SOC_PACKAGE_PSOC4HVMS128K_48_QFN

config SOC_CY8C4127LDE_HVS014
	select SOC_PACKAGE_PSOC4HVMS128K_48_QFN

config SOC_CY8C4147LDE_HVS004
	select SOC_PACKAGE_PSOC4HVMS128K_48_QFN

config SOC_CY8C4147LDE_HVS014
	select SOC_PACKAGE_PSOC4HVMS128K_48_QFN

config SOC_CY8C4147LDE_HVS024
	select SOC_PACKAGE_PSOC4HVMS128K_48_QFN

config SOC_CY8C4147LDE_HVS034
	select SOC_PACKAGE_PSOC4HVMS128K_48_QFN

config SOC_CY8C4147LDE_HVS024X
	select SOC_PACKAGE_PSOC4HVMS128K_48_QFN

config SOC_CY8C4147LDE_HVS034X
	select SOC_PACKAGE_PSOC4HVMS128K_48_QFN

config SOC_CY8C4127LDE_HVS104
	select SOC_PACKAGE_PSOC4HVMS128K_48_QFN

config SOC_CY8C4127LDE_HVS114
	select SOC_PACKAGE_PSOC4HVMS128K_48_QFN

config SOC_CY8C4147LDE_HVS104
	select SOC_PACKAGE_PSOC4HVMS128K_48_QFN

config SOC_CY8C4147LDE_HVS114
	select SOC_PACKAGE_PSOC4HVMS128K_48_QFN

config SOC_CY8C4147LDE_HVS124
	select SOC_PACKAGE_PSOC4HVMS128K_48_QFN

config SOC_CY8C4147LDE_HVS134
	select SOC_PACKAGE_PSOC4HVMS128K_48_QFN

config SOC_CY8C4147LDE_HVS124X
	select SOC_PACKAGE_PSOC4HVMS128K_48_QFN

config SOC_CY8C4147LDE_HVS134X
	select SOC_PACKAGE_PSOC4HVMS128K_48_QFN

config SOC_CY8C4127LWE_HVS005
	select SOC_PACKAGE_PSOC4HVMS128K_56_QFN

config SOC_CY8C4127LWE_HVS015
	select SOC_PACKAGE_PSOC4HVMS128K_56_QFN

config SOC_CY8C4147LWE_HVS005
	select SOC_PACKAGE_PSOC4HVMS128K_56_QFN

config SOC_CY8C4147LWE_HVS015
	select SOC_PACKAGE_PSOC4HVMS128K_56_QFN

config SOC_CY8C4147LWE_HVS025
	select SOC_PACKAGE_PSOC4HVMS128K_56_QFN

config SOC_CY8C4147LWE_HVS035
	select SOC_PACKAGE_PSOC4HVMS128K_56_QFN

config SOC_CY8C4147LWE_HVS025X
	select SOC_PACKAGE_PSOC4HVMS128K_56_QFN

config SOC_CY8C4147LWE_HVS035X
	select SOC_PACKAGE_PSOC4HVMS128K_56_QFN

config SOC_CY8C4127LWE_HVS105
	select SOC_PACKAGE_PSOC4HVMS128K_56_QFN

config SOC_CY8C4127LWE_HVS115
	select SOC_PACKAGE_PSOC4HVMS128K_56_QFN

config SOC_CY8C4147LWE_HVS105
	select SOC_PACKAGE_PSOC4HVMS128K_56_QFN

config SOC_CY8C4147LWE_HVS115
	select SOC_PACKAGE_PSOC4HVMS128K_56_QFN

config SOC_CY8C4147LWE_HVS125
	select SOC_PACKAGE_PSOC4HVMS128K_56_QFN

config SOC_CY8C4147LWE_HVS135
	select SOC_PACKAGE_PSOC4HVMS128K_56_QFN

config SOC_CY8C4147LWE_HVS125X
	select SOC_PACKAGE_PSOC4HVMS128K_56_QFN

config SOC_CY8C4147LWE_HVS135X
	select SOC_PACKAGE_PSOC4HVMS128K_56_QFN

config SOC_CY8C4127LQE_HVS006
	select SOC_PACKAGE_PSOC4HVMS128K_64_QFN

config SOC_CY8C4127LQE_HVS016
	select SOC_PACKAGE_PSOC4HVMS128K_64_QFN

config SOC_CY8C4147LQE_HVS006
	select SOC_PACKAGE_PSOC4HVMS128K_64_QFN

config SOC_CY8C4147LQE_HVS016
	select SOC_PACKAGE_PSOC4HVMS128K_64_QFN

config SOC_CY8C4147LQE_HVS026
	select SOC_PACKAGE_PSOC4HVMS128K_64_QFN

config SOC_CY8C4147LQE_HVS036
	select SOC_PACKAGE_PSOC4HVMS128K_64_QFN

config SOC_CY8C4147LQE_HVS026X
	select SOC_PACKAGE_PSOC4HVMS128K_64_QFN

config SOC_CY8C4147LQE_HVS036X
	select SOC_PACKAGE_PSOC4HVMS128K_64_QFN

config SOC_CY8C4127LQE_HVS106
	select SOC_PACKAGE_PSOC4HVMS128K_64_QFN

config SOC_CY8C4127LQE_HVS116
	select SOC_PACKAGE_PSOC4HVMS128K_64_QFN

config SOC_CY8C4147LQE_HVS106
	select SOC_PACKAGE_PSOC4HVMS128K_64_QFN

config SOC_CY8C4147LQE_HVS116
	select SOC_PACKAGE_PSOC4HVMS128K_64_QFN

config SOC_CY8C4147LQE_HVS126
	select SOC_PACKAGE_PSOC4HVMS128K_64_QFN

config SOC_CY8C4147LQE_HVS136
	select SOC_PACKAGE_PSOC4HVMS128K_64_QFN

config SOC_CY8C4147LQE_HVS126X
	select SOC_PACKAGE_PSOC4HVMS128K_64_QFN

config SOC_CY8C4147LQE_HVS136X
	select SOC_PACKAGE_PSOC4HVMS128K_64_QFN

config SOC_CY8C4127LCE_HVS003
	select SOC_PACKAGE_PSOC4HVMS128K_32_QFN

config SOC_CY8C4127LCE_HVS013
	select SOC_PACKAGE_PSOC4HVMS128K_32_QFN

config SOC_CY8C4127LCE_HVS103
	select SOC_PACKAGE_PSOC4HVMS128K_32_QFN

config SOC_CY8C4127LCE_HVS113
	select SOC_PACKAGE_PSOC4HVMS128K_32_QFN

config SOC_CY8C4147LCE_HVS003
	select SOC_PACKAGE_PSOC4HVMS128K_32_QFN

config SOC_CY8C4147LCE_HVS013
	select SOC_PACKAGE_PSOC4HVMS128K_32_QFN

config SOC_CY8C4147LCE_HVS023
	select SOC_PACKAGE_PSOC4HVMS128K_32_QFN

config SOC_CY8C4147LCE_HVS023X
	select SOC_PACKAGE_PSOC4HVMS128K_32_QFN

config SOC_CY8C4147LCE_HVS033
	select SOC_PACKAGE_PSOC4HVMS128K_32_QFN

config SOC_CY8C4147LCE_HVS033X
	select SOC_PACKAGE_PSOC4HVMS128K_32_QFN

config SOC_CY8C4147LCE_HVS103
	select SOC_PACKAGE_PSOC4HVMS128K_32_QFN

config SOC_CY8C4147LCE_HVS113
	select SOC_PACKAGE_PSOC4HVMS128K_32_QFN

config SOC_CY8C4147LCE_HVS123
	select SOC_PACKAGE_PSOC4HVMS128K_32_QFN

config SOC_CY8C4147LCE_HVS123X
	select SOC_PACKAGE_PSOC4HVMS128K_32_QFN

config SOC_CY8C4147LCE_HVS133
	select SOC_PACKAGE_PSOC4HVMS128K_32_QFN

config SOC_CY8C4147LCE_HVS133X
	select SOC_PACKAGE_PSOC4HVMS128K_32_QFN
```

## soc/infineon/psoc4/psoc4hvms128k/Kconfig.defconfig
```kconfig
# SPDX-FileCopyrightText: Copyright (c) 2026 Infineon Technologies AG,
# SPDX-FileCopyrightText: or an affiliate of Infineon Technologies AG. All rights reserved.
#
# SPDX-License-Identifier: Apache-2.0

if SOC_SERIES_PSOC4HVMS128K

config NUM_IRQS
	default 31

endif # SOC_SERIES_PSOC4HVMS128K
```
