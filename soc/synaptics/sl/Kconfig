## soc/synaptics/sl/Kconfig
```kconfig
# Copyright (c) 2026 Synaptics Incorporated
# Author: Jisheng Zhang <jszhang@kernel.org>
# SPDX-License-Identifier: Apache-2.0

if SOC_FAMILY_SYNA_SL

rsource "*/Kconfig"

endif # SOC_FAMILY_SYNA_SL
```

## soc/synaptics/sl/Kconfig.defconfig
```kconfig
# Copyright (c) 2026 Synaptics Incorporated
# Author: Jisheng Zhang <jszhang@kernel.org>
# SPDX-License-Identifier: Apache-2.0

if SOC_FAMILY_SYNA_SL

rsource "*/Kconfig.defconfig"

endif # SOC_FAMILY_SYNA_SL
```

## soc/synaptics/sl/Kconfig.soc
```kconfig
# Copyright (c) 2026 Synaptics Incorporated
# Author: Jisheng Zhang <jszhang@kernel.org>
# SPDX-License-Identifier: Apache-2.0

config SOC_FAMILY_SYNA_SL
	bool

config SOC_FAMILY
	default "syna_sl" if SOC_FAMILY_SYNA_SL

rsource "*/Kconfig.soc"
```

## soc/synaptics/sl/sl261x/Kconfig
```kconfig
# Copyright (c) 2026 Synaptics Incorporated
# SPDX-License-Identifier: Apache-2.0

config SOC_SL2619_A55
        select ARM64
        select CPU_CORTEX_A55
        select ARM_ARCH_TIMER
```

## soc/synaptics/sl/sl261x/Kconfig.defconfig
```kconfig
# Copyright (c) 2026 Synaptics Incorporated
# SPDX-License-Identifier: Apache-2.0

if SOC_SERIES_SL261X

rsource "Kconfig.defconfig.*"

endif # SOC_SERIES_SL261X
```

## soc/synaptics/sl/sl261x/Kconfig.defconfig.sl2619.a55
```kconfig
# Copyright (c) 2026 Synaptics Incorporated
# SPDX-License-Identifier: Apache-2.0

if SOC_SL2619_A55

config NUM_IRQS
	default 209

config SYS_CLOCK_HW_CYCLES_PER_SEC
	default 25000000

# Workaround for not being able to have commas in macro arguments
DT_CHOSEN_Z_FLASH := zephyr,flash

config FLASH_SIZE
	default $(dt_chosen_reg_size_int,$(DT_CHOSEN_Z_FLASH),0,K)

config FLASH_BASE_ADDRESS
	default $(dt_chosen_reg_addr_hex,$(DT_CHOSEN_Z_FLASH))

config ARM64_DCACHE_ALL_OPS
	depends on CACHE_MANAGEMENT && DCACHE
	default y

config ARM64_BOOT_DISABLE_DCACHE
	depends on CACHE_MANAGEMENT && DCACHE
	default y

endif
```

## soc/synaptics/sl/sl261x/Kconfig.soc
```kconfig
# Copyright (c) 2026 Synaptics Incorporated
# SPDX-License-Identifier: Apache-2.0

config SOC_SERIES_SL261X
	bool
	select SOC_FAMILY_SYNA_SL

config SOC_SERIES
	default "sl261x" if SOC_SERIES_SL261X

config SOC_SL2619
	bool
	select SOC_SERIES_SL261X

config SOC_SL2619_A55
	bool
	select SOC_SL2619
	help
	  SYNA SL2619 A55

config SOC
	default "sl2619" if SOC_SL2619
```

## soc/synopsys/emsk/Kconfig
```kconfig
# Copyright (c) 2014 Wind River Systems, Inc.
# Copyright (c) 2018 Synopsys, Inc. All rights reserved.
# SPDX-License-Identifier: Apache-2.0

config SOC_EMSK
	select ARC

config SOC_EMSK_EM7D
	select CPU_HAS_MPU

config SOC_EMSK_EM9D
	select CPU_HAS_FPU

config SOC_EMSK_EM11D
	select CPU_HAS_FPU
```

## soc/synopsys/hsdk/Kconfig.soc
```kconfig
# Copyright (c) 2019 Synopsys, Inc. All rights reserved.
# SPDX-License-Identifier: Apache-2.0

config SOC_ARC_HSDK
	bool

config SOC
	default "arc_hsdk" if SOC_ARC_HSDK
```

## soc/synopsys/hsdk4xd/Kconfig
```kconfig
# Copyright (c) 2023 Synopsys, Inc. All rights reserved.
# SPDX-License-Identifier: Apache-2.0

config SOC_ARC_HSDK4XD
	select ARC
	select CPU_HAS_FPU
	select CPU_HAS_DSP
```

## soc/synopsys/hsdk4xd/Kconfig.soc
```kconfig
# Copyright (c) 2023 Synopsys, Inc. All rights reserved.
# SPDX-License-Identifier: Apache-2.0

config SOC_ARC_HSDK4XD
	bool
	help
	  Synopsys ARC HSDK4XD SoC

config SOC
	default "arc_hsdk4xd" if SOC_ARC_HSDK4XD
```

## soc/synopsys/nsim/Kconfig
```kconfig
# Copyright (c) 2018 Synopsys, Inc. All rights reserved.
# SPDX-License-Identifier: Apache-2.0

config SOC_NSIM
	select ARC

config SOC_NSIM_EM
	select CPU_HAS_MPU

config SOC_NSIM_EM7D_V22
	select CPU_HAS_MPU
	select CPU_HAS_FPU

config SOC_NSIM_EM11D
	select CPU_HAS_MPU
	select CPU_HAS_DSP

config SOC_NSIM_SEM
	select CPU_HAS_MPU
	select CPU_HAS_FPU
	select ARC_HAS_SECURE

config SOC_NSIM_HS
	select CPU_HAS_FPU
	select CPU_HAS_MPU

config SOC_NSIM_HS_SMP
	select CPU_HAS_FPU

config SOC_NSIM_HS_MPUV6
	select CPU_HAS_MPU
	select CPU_HAS_FPU
```

## soc/synopsys/nsim/Kconfig.defconfig
```kconfig
# Copyright (c) 2018 Synopsys, Inc. All rights reserved.
# SPDX-License-Identifier: Apache-2.0

if SOC_NSIM

config XIP
	default n

rsource "Kconfig.defconfig.*"

endif # SOC_NSIM
```

## soc/synopsys/nsim/Kconfig.soc
```kconfig
# Copyright (c) 2018 Synopsys, Inc. All rights reserved.
# SPDX-License-Identifier: Apache-2.0

config SOC_NSIM
	bool

config SOC_NSIM_EM
	bool
	select SOC_NSIM
	help
	  Synopsys ARC EM4 in nSIM

config SOC_NSIM_EM7D_V22
	bool
	select SOC_NSIM
	help
	  Synopsys ARC EM7D_V22 in nSIM

config SOC_NSIM_EM11D
	bool
	select SOC_NSIM
	help
	  Synopsys ARC EM11D in nSIM

config SOC_NSIM_SEM
	bool
	select SOC_NSIM
	help
	  Synopsys ARC SEM in nSIM

config SOC_NSIM_HS
	bool
	select SOC_NSIM
	help
	  Synopsys ARC HS3X in nSIM

config SOC_NSIM_HS_SMP
	bool
	select SOC_NSIM
	help
	  Multi-core Synopsys ARC HS3X in nSIM

config SOC_NSIM_HS_MPUV6
	bool
	select SOC_NSIM
	help
	  Synopsys ARC HS3X with MPU v6 in nSIM

config SOC_NSIM_VPX5
	bool
	select SOC_NSIM
	help
	  Synopsys ARC VPX5 in nSIM

config SOC_NSIM_HS5X
	bool
	select SOC_NSIM
	help
	  Synopsys ARC HS5x in nSIM

config SOC_NSIM_HS5X_SMP
	bool
	select SOC_NSIM
	help
	  Multi-core Synopsys ARC HS5x in nSIM

config SOC_NSIM_HS6X
	bool
	select SOC_NSIM
	help
	  Synopsys ARC HS6x in nSIM

config SOC_NSIM_HS6X_SMP
	bool
	select SOC_NSIM
	help
	  Multi-core Synopsys ARC HS6x in nSIM

config SOC
	default "nsim_em" if SOC_NSIM_EM
	default "nsim_em7d_v22" if SOC_NSIM_EM7D_V22
	default "nsim_em11d" if SOC_NSIM_EM11D
	default "nsim_sem" if SOC_NSIM_SEM
	default "nsim_hs" if SOC_NSIM_HS
	default "nsim_hs_smp" if SOC_NSIM_HS_SMP
	default "nsim_hs_mpuv6" if SOC_NSIM_HS_MPUV6
	default "nsim_vpx5" if SOC_NSIM_VPX5
	default "nsim_hs5x" if SOC_NSIM_HS5X
	default "nsim_hs5x_smp" if SOC_NSIM_HS5X_SMP
	default "nsim_hs6x" if SOC_NSIM_HS6X
	default "nsim_hs6x_smp" if SOC_NSIM_HS6X_SMP

config SOC_SERIES
	default "nsim" if SOC_NSIM
```

## soc/tcc/tcc7045/Kconfig
```kconfig
# Copyright 2024 Hounjoung Rim <hounjoung@tsnlab.com>
# SPDX-License-Identifier: Apache-2.0

config SOC_TCC7045
	select ARM
	select CPU_CORTEX_R5
	select CPU_HAS_ARM_MPU
	select VFP_DP_D16
	select CPU_HAS_FPU
	select ARMV7_R
	select ARMV7_R_FP
	select SOC_EARLY_INIT_HOOK
	select TIC
	select TCC_VCPTTC_TIMER
	select CLOCK_CONTROL
	select CLOCK_CONTROL_TCC_CCU
	select SYSCON
	select TIMEOUT_64BIT
```

## soc/tcc/tcc7045/Kconfig.defconfig
```kconfig
# Copyright 2024 Hounjoung Rim <hounjoung@tsnlab.com>
# SPDX-License-Identifier: Apache-2.0

if SOC_TCC7045

config ARM_CUSTOM_INTERRUPT_CONTROLLER
	default y

config GEN_IRQ_VECTOR_TABLE
	default y

config SHARED_INTERRUPTS
	def_bool y

config NUM_IRQS
	default 220

config TICKLESS_KERNEL
	def_bool n

config TCCVCP_CONSOLE
	def_bool y

config ARM_MPU
	def_bool y

config SYS_CLOCK_HW_CYCLES_PER_SEC
	default $(dt_node_int_prop_int,/cpus/cpu@0,clock-frequency)

DT_CHOSEN_Z_FLASH := zephyr,flash

config FLASH_SIZE
	default $(dt_chosen_reg_size_int,$(DT_CHOSEN_Z_FLASH),0,K)

config FLASH_BASE_ADDRESS
	default $(dt_chosen_reg_addr_hex,$(DT_CHOSEN_Z_FLASH))

endif
```

## soc/tcc/tcc7045/Kconfig.soc
```kconfig
# Copyright 2024 Hounjoung Rim <hounjoung@tsnlab.com>
# SPDX-License-Identifier: Apache-2.0

config SOC_TCC7045
	bool

config SOC
	default "tcc7045" if SOC_TCC7045

config SYS_CLOCK_TICKS_PER_SEC
	def_int 1000 if SOC_TCC7045
```

## soc/telink/tlsr/Kconfig
```kconfig
# Copyright (c) 2024 Nordic Semiconductor ASA
# SPDX-License-Identifier: Apache-2.0

if SOC_FAMILY_TELINK_TLSR

rsource "*/Kconfig"

endif # SOC_FAMILY_TELINK_TLSR
```

## soc/telink/tlsr/Kconfig.soc
```kconfig
# Copyright (c) 2024 Nordic Semiconductor ASA
# SPDX-License-Identifier: Apache-2.0

config SOC_FAMILY_TELINK_TLSR
	bool

config SOC_FAMILY
	default "telink_tlsr" if SOC_FAMILY_TELINK_TLSR

rsource "*/Kconfig.soc"
```

## soc/telink/tlsr/telink_b9x/Kconfig
```kconfig
# Copyright (c) 2021-2024 Telink Semiconductor
# SPDX-License-Identifier: Apache-2.0

config SOC_RISCV_TELINK_B9X
	bool
	select RISCV
	select RISCV_ISA_RV32I
	select RISCV_ISA_EXT_M
	select RISCV_ISA_EXT_A
	select RISCV_ISA_EXT_C
	select RISCV_ISA_EXT_ZICSR
	select RISCV_ISA_EXT_ZIFENCEI
	select RISCV_PRIVILEGED
	select RISCV_HAS_PLIC
	select HAS_TELINK_DRIVERS
	select ATOMIC_OPERATIONS_BUILTIN
	select CPU_HAS_FPU
	select INCLUDE_RESET_VECTOR
	imply XIP
	select SOC_EARLY_INIT_HOOK
	select ARCH_HAS_CUSTOM_CPU_IDLE if SOC_RISCV_TELINK_B92
	select ARCH_HAS_CUSTOM_CPU_ATOMIC_IDLE if SOC_RISCV_TELINK_B92

if SOC_RISCV_TELINK_B9X

config TELINK_B92_PMP
	bool "Support Hardware Memory Protection"
	depends on SOC_RISCV_TELINK_B92
	select RISCV_PMP
	help
		This option enables Telink B92 PMP(memory protection) module.

config TELINK_B95_PMP
	bool "Support Hardware Memory Protection"
	depends on SOC_RISCV_TELINK_B95
	select RISCV_PMP
	help
		This option enables Telink B95 PMP(memory protection) module.

config TELINK_B9X_HWDSP
	bool "Support Hardware DSP"
	select RISCV_SOC_CONTEXT_SAVE

config TELINK_B9X_PFT_ARCH
	bool "Support performance throttling"
	default y
	select RISCV_SOC_CONTEXT_SAVE

config TELINK_B9X_MBEDTLS_HW_ACCELERATION
	bool "Use Telink B9x platform mbedtls HW acceleration"
	depends on MBEDTLS
	default y
	help
		This option enables Telink B9x hardware accelerated mbedtls version

config TELINK_SOC_REBOOT_ON_FAULT
	bool "Reboot system when fault happened"
	help
		This option enables Telink B9x chip reboot after fault.

config TELINK_SOC_REBOOT_ON_FAULT_DELAY
	int "Reboot system delay in mS"
	depends on TELINK_SOC_REBOOT_ON_FAULT
	default 1000
	range 0 30000
	help
		This option sets Telink B91 chip reboot on fault delay in mS.

config TELINK_B91_USB_SWI_DISABLE
	bool "Don't use USB SWI interface"
	help
		This option disables USB SWI interface

config TELINK_B9X_2_WIRE_SPI_ENABLE
	bool "Use 2-wire SPI interface to FLASH"
	help
		This option enables 2-wire SPI interface to FLASH

config TELINK_B9X_MALLOC_FAILED_HOOK
	bool "Stop SW execution when system heap allocation failed"
	default y
	help
		This option stops SW execution when system heap allocation failed.

config SOC_SERIES_RISCV_TELINK_B9X_RETENTION
	bool "Telink B9x SoCs retention memory layout"
	help
		Telink B9x SoCs retention memory layout

config SOC_SERIES_RISCV_TELINK_B9X_NON_RETENTION_RAM_CODE
	bool "Telink B9x SoCs non retention ram code"
	depends on SOC_SERIES_RISCV_TELINK_B9X_RETENTION
	help
		Place Telink B9x SoCs ram code in non-retention area
		and restore this are after each retention.

config TELINK_B9X_MATTER_RETENTION_LAYOUT
	bool "Support Matter retention layout"
	depends on SOC_SERIES_RISCV_TELINK_B9X_RETENTION
	help
		This option enables support Matter retention layout

if MCUBOOT

config TELINK_B9X_MCUBOOT_STARTUP
	bool "Telink B9x MCUBoot startup handler"
	help
		Run Telink specific vendor code before MCUBoot
		main process

config COMPRESS_LZMA
	bool "Support LZMA compression"
	default n
	select LZMA
	select BOOT_IMAGE_ACCESS_HOOKS
	help
		This option enables LZMA compression with MCUBoot

config COMPRESS_LZMA_DICTIONARY_SIZE
	int "Set LZMA compression dictionary size"
	default 32768
	depends on COMPRESS_LZMA
	help
		This option sets LZMA compression dictionary size

endif # MCUBOOT

endif # SOC_RISCV_TELINK_B9X
```

## soc/telink/tlsr/telink_b9x/Kconfig.defconfig
```kconfig
# Copyright (c) 2021-2024 Telink Semiconductor
# SPDX-License-Identifier: Apache-2.0

if SOC_RISCV_TELINK_B9X

config SYS_CLOCK_EXISTS
	default y

config SYS_CLOCK_HW_CYCLES_PER_SEC
	default 32000

config RISCV_SOC_INTERRUPT_INIT
	default y

config RISCV_GP
	default y

config 2ND_LVL_INTR_00_OFFSET
	default 11

config 2ND_LVL_ISR_TBL_OFFSET
	default 12

config NUM_IRQS
	default 64 if SOC_RISCV_TELINK_B95
	default 59

config PINCTRL
	default y

config XIP
	default n

config FLASH
	default y

config STACK_SENTINEL
	default y

config THREAD_NAME
	default y if STACK_SENTINEL

config MAIN_STACK_SIZE
	default 2048

config IDLE_STACK_SIZE
	default 1536

config SYSTEM_WORKQUEUE_STACK_SIZE
	int
	default 2048

config LOG_PROCESS_THREAD_STACK_SIZE
	int
	default 2048

config OPENTHREAD_RADIO_WORKQUEUE_STACK_SIZE
	default 2048

config TEST_EXTRA_STACK_SIZE
	default 1024

config COMMON_LIBC_MALLOC
	default y

config COMMON_LIBC_MALLOC_ARENA_SIZE
	default 8192

config HEAP_MEM_POOL_SIZE
	default 4096

config HAS_FLASH_LOAD_OFFSET
	default y if BOOTLOADER_MCUBOOT

config HAS_PM
	default y

config PM_DEVICE
	default y if PM

config MBEDTLS_USER_CONFIG_ENABLE
	default y

config MBEDTLS_USER_CONFIG_FILE
	default "telink_b9x_mbedtls_user_config.h"

config MBEDTLS_ENTROPY_POLL_ZEPHYR
	default y if ENTROPY_HAS_DRIVER

config MBEDTLS_ENTROPY_C
	default y if MBEDTLS_TEST && TELINK_B9X_MBEDTLS_HW_ACCELERATION

config MBEDTLS_CTR_DRBG_ENABLED
	default y if MBEDTLS_TEST && TELINK_B9X_MBEDTLS_HW_ACCELERATION

config MBEDTLS_CIPHER_AES_ENABLED
	default y if MBEDTLS_TEST && TELINK_B9X_MBEDTLS_HW_ACCELERATION

# Workaround for not being able to have commas in macro arguments
DT_LABEL_Z_STORAGE := $(dt_nodelabel_path,storage_partition)

# Set the sector count of NVS as the storage partition size divided by the sector size (4 KB)
config SETTINGS_NVS_SECTOR_COUNT
	default $(shell,expr $(dt_node_reg_size_int,$(DT_LABEL_Z_STORAGE),0,K) / 4)

endif # SOC_RISCV_TELINK_B9X
```

## soc/telink/tlsr/telink_b9x/Kconfig.soc
```kconfig
# Copyright (c) 2021-2024 Telink Semiconductor
# SPDX-License-Identifier: Apache-2.0

config SOC_RISCV_TELINK_B9X
	bool
	select SOC_FAMILY_TELINK_TLSR
	help
	  Telink B9X

config SOC_SERIES
	default "telink_b9x" if SOC_RISCV_TELINK_B9X

config SOC
	default "telink_b91" if SOC_RISCV_TELINK_B91
	default "telink_b92" if SOC_RISCV_TELINK_B92
	default "telink_b95" if SOC_RISCV_TELINK_B95
```
