## soc/riscv/renode_virt/Kconfig.soc
```kconfig
# Copyright (c) 2023 Meta
# SPDX-License-Identifier: Apache-2.0

config SOC_RISCV32_VIRTUAL_RENODE
	bool "Renode RISCV32 Virtual system implementation"
	select RISCV
	select RISCV_PRIVILEGED
	select ATOMIC_OPERATIONS_BUILTIN
	select INCLUDE_RESET_VECTOR
	select RISCV_ISA_RV32I
	select RISCV_ISA_EXT_M
	select RISCV_ISA_EXT_A
	select RISCV_ISA_EXT_C
	select RISCV_ISA_EXT_ZICSR
	select RISCV_ISA_EXT_ZIFENCEI
	select RISCV_HAS_PLIC
```

## soc/riscv/riscv-ite/Kconfig
```kconfig
# Copyright (c) 2020 ITE Corporation. All Rights Reserved.
# SPDX-License-Identifier: Apache-2.0

config SOC_FAMILY_RISCV_ITE
	bool
	help
	  omit prompt to signify a "hidden" option

config SOC_FAMILY
	string
	default "riscv-ite"
	depends on SOC_FAMILY_RISCV_ITE

source "soc/riscv/riscv-ite/*/Kconfig.soc"
```

## soc/riscv/riscv-ite/Kconfig.soc
```kconfig
# Copyright (c) 2020 ITE Corporation. All Rights Reserved.
# SPDX-License-Identifier: Apache-2.0

source "soc/riscv/riscv-ite/*/Kconfig.series"
```

## soc/riscv/riscv-ite/it8xxx2/Kconfig.defconfig.series
```kconfig
# Copyright (c) 2020 ITE Corporation. All Rights Reserved.
# SPDX-License-Identifier: Apache-2.0

if SOC_SERIES_RISCV32_IT8XXX2

config SOC_SERIES
	default "it8xxx2"

config ITE_IT8XXX2_INTC
	default y
	select FLASH
	select FLASH_HAS_PAGE_LAYOUT
	select FLASH_HAS_DRIVER_ENABLED
	select HAS_FLASH_LOAD_OFFSET

config RISCV_GP
	default y

config ITE_IT8XXX2_TIMER
	default y

config ARCH_HAS_CUSTOM_BUSY_WAIT
	default y

config SYS_CLOCK_HW_CYCLES_PER_SEC
	default 32768

config SYS_CLOCK_TICKS_PER_SEC
	default 8192

config UART_NS16550
	default y
	depends on SERIAL

config UART_NS16550_WA_ISR_REENABLE_INTERRUPT
	default y
	depends on UART_NS16550

config UART_ITE_IT8XXX2
	default y
	depends on UART_NS16550

config RISCV_HAS_CPU_IDLE
	default y

config WDT_ITE_IT8XXX2
	default y
	depends on WATCHDOG

config KSCAN_ITE_IT8XXX2
	default y
	depends on KSCAN

config GPIO_ITE_IT8XXX2
	default y
	depends on GPIO

config ADC_ITE_IT8XXX2
	default y
	depends on ADC

config SOC_FLASH_ITE_IT8XXX2
	default y
	depends on FLASH

config FLASH_INIT_PRIORITY
	default 0

config IT8XXX2_PLL_SEQUENCE_PRIORITY
	int
	default 1
	depends on SOC_IT8XXX2_PLL_FLASH_48M

config PWM_ITE_IT8XXX2
	default y
	depends on PWM

config TACH_IT8XXX2
	default y
	depends on SENSOR

config PECI_ITE_IT8XXX2
	default y
	depends on PECI
	select PECI_INTERRUPT_DRIVEN

config PINCTRL
	default y

if ITE_IT8XXX2_INTC
config NUM_IRQS
	default 185

config DYNAMIC_INTERRUPTS
	default y

config GEN_ISR_TABLES
	default y

config GEN_IRQ_START_VECTOR
	default 0

config GEN_SW_ISR_TABLE
	default y

config RISCV_SOC_INTERRUPT_INIT
	default y

endif # ITE_IT8XXX2_INTC

source "soc/riscv/riscv-ite/it8xxx2/Kconfig.defconfig.it81*"

endif # SOC_SERIES_RISCV32_IT8XXX2
```

## soc/riscv/riscv-ite/it8xxx2/Kconfig.series
```kconfig
# Copyright (c) 2020 ITE Corporation. All Rights Reserved.
# SPDX-License-Identifier: Apache-2.0

config SOC_SERIES_RISCV32_IT8XXX2
	bool "ITE IT8XXX2 implementation"
	#depends on RISCV
	# TODO:
	# Error of can't link soft-float modules with single-float modules.
	# No library built with -mabi=ilp32f -march=rv32iafc?
	select CPU_HAS_FPU if RISCV_ISA_EXT_M
	select SOC_FAMILY_RISCV_ITE
	help
	    Enable support for ITE IT8XXX2
```

## soc/riscv/riscv-ite/it8xxx2/Kconfig.soc
```kconfig
# Copyright (c) 2020 ITE Corporation. All Rights Reserved.
# SPDX-License-Identifier: Apache-2.0

choice
prompt "ITE IT8XXX2 system implementation"
depends on SOC_SERIES_RISCV32_IT8XXX2

config SOC_IT8XXX2
	bool "ITE IT8XXX2 system implementation"
	select RISCV
	select ATOMIC_OPERATIONS_BUILTIN
	select RISCV_ISA_RV32I
	# Workaround mul instruction bug, see:
	# https://www.ite.com.tw/uploads/product_download/it81202-bx-chip-errata.pdf
	#select RISCV_ISA_EXT_M
	select RISCV_ISA_EXT_A
	select RISCV_ISA_EXT_C

endchoice

if SOC_IT8XXX2

choice IT8XXX2_SERIES
	prompt "IT8XXX2 Series"
	default SOC_IT81302_BX

config SOC_IT81302_BX
	bool "IT81302 BX version"

config SOC_IT81202_BX
	bool "IT81202 BX version"

endchoice

config SOC_IT8XXX2_PLL_FLASH_48M
	bool "Flash frequency is 48MHz"
	default y
	help
	  Change frequency of PLL, CPU, and flash to 48MHz during initialization.

	  Set n to use the default settings.
	  (PLL and CPU run at 48MHz, flash frequency is 16MHz)

config SOC_IT8XXX2_GPIO_GROUP_K_L_DEFAULT_PULL_DOWN
	bool "The pins of GPIO group K and L aren't bonding with pad"
	default y
	help
	  On IT81202 (128-pins package), the pins of GPIO group K and L aren't
	  bonding with pad. So we configure these pins as internal pull-down
	  at default to prevent leakage current due to floating.

config SOC_IT8XXX2_GPIO_H7_DEFAULT_OUTPUT_LOW
	bool "The GPIOH7 isn't bonding with pad and is left floating internally"
	default y
	help
	  On IT81202/IT81302, the GPIOH7 isn't bonding with pad and is left
	  floating internally. We need to enable internal pull-down for the pin
	  to prevent leakage current, but IT81202/IT81302 doesn't have the
	  capability to pull it down. We can only set it as output low,
	  so we enable output low for it at initialization to prevent leakage.

config SOC_IT8XXX2_CPU_IDLE_GATING
	bool
	help
	  This option determines whether the entering CPU idle mode can be
	  gated by individual drivers. When this option is disabled, CPU idle
	  mode is always permitted.

choice
	prompt "Clock source for PLL reference clock"

config SOC_IT8XXX2_INT_32K
	bool "Use the +/-2.3% internal clock generator"

config SOC_IT8XXX2_EXT_32K
	bool "Use external 32.768 kHz clock source"

endchoice

endif # SOC_IT8XXX2
```

## soc/riscv/riscv-privilege/Kconfig
```kconfig
# Configuration options for riscv SOCs supporting the riscv privileged
# architecture specification

# Copyright (c) 2017 Jean-Paul Etienne <fractalclone@gmail.com>
# SPDX-License-Identifier: Apache-2.0

config SOC_FAMILY_RISCV_PRIVILEGE
	bool

config SOC_FAMILY
	string
	default "riscv-privilege"
	depends on SOC_FAMILY_RISCV_PRIVILEGE

config RISCV_HAS_PLIC
	bool "Does the SOC provide support for a Platform Level Interrupt Controller (PLIC)"
	depends on SOC_FAMILY_RISCV_PRIVILEGE
	help
	  Does the SOC provide support for a Platform Level Interrupt Controller (PLIC).

config RISCV_HAS_CLIC
	bool "Does the SOC provide support for a Core-Local Interrupt Controller (CLIC)"
	depends on SOC_FAMILY_RISCV_PRIVILEGE
	help
	  Does the SOC provide support for a Core-Local Interrupt Controller (CLIC).

config RISCV_MTVEC_VECTORED_MODE
	bool "Should the SOC use mtvec in vectored mode"
	depends on SOC_FAMILY_RISCV_PRIVILEGE
	help
	  Should the SOC use mtvec in vectored mode

source "soc/riscv/riscv-privilege/*/Kconfig.soc"
```

## soc/riscv/riscv-privilege/Kconfig.defconfig
```kconfig
# riscv SOC family supporting the riscv privileged architecture spec

# Copyright (c) 2017 Jean-Paul Etienne <fractalclone@gmail.com>
# SPDX-License-Identifier: Apache-2.0

source "soc/riscv/riscv-privilege/*/Kconfig.defconfig.series"
```

## soc/riscv/riscv-privilege/Kconfig.soc
```kconfig
# riscv SOC series supporting the riscv privileged architecture spec

# Copyright (c) 2017 Jean-Paul Etienne <fractalclone@gmail.com>
# SPDX-License-Identifier: Apache-2.0

source "soc/riscv/riscv-privilege/*/Kconfig.series"
```

## soc/riscv/riscv-privilege/andes_v5/Kconfig.defconfig.ae350
```kconfig
# Copyright (c) 2021 Andes Technology Corporation
# SPDX-License-Identifier: Apache-2.0

if SOC_RISCV_ANDES_AE350

config SOC
	default "ae350"

config SYS_CLOCK_TICKS_PER_SEC
	default 100 if !CACHE_ENABLE

config MAIN_STACK_SIZE
	default 2048

config IDLE_STACK_SIZE
	default 1536

config TEST_EXTRA_STACK_SIZE
	default 1024

endif # SOC_RISCV_ANDES_AE350
```

## soc/riscv/riscv-privilege/andes_v5/Kconfig.defconfig.series
```kconfig
# Copyright (c) 2021 Andes Technology Corporation
# SPDX-License-Identifier: Apache-2.0

if SOC_SERIES_RISCV_ANDES_V5

# Kconfig picks the first default with a satisfied condition.
# SoC defaults should be parsed before SoC Series defaults, because SoCs usually
# overrides SoC Series values.
source "soc/riscv/riscv-privilege/andes_v5/Kconfig.defconfig.ae*"

config SOC_SERIES
	default "andes_v5"

config SYS_CLOCK_HW_CYCLES_PER_SEC
	default 60000000

config KERNEL_ENTRY
	default "entry"

config RISCV_GENERIC_TOOLCHAIN
	default y if "$(ZEPHYR_TOOLCHAIN_VARIANT)" = "zephyr"
	default n

config RISCV_SOC_INTERRUPT_INIT
	default y

config RISCV_HAS_CPU_IDLE
	default y

config RISCV_HAS_PLIC
	default y

config RISCV_GP
	default y

config 2ND_LVL_ISR_TBL_OFFSET
	default 12

config 2ND_LVL_INTR_00_OFFSET
	default 11

config MAX_IRQ_PER_AGGREGATOR
	default 52

config NUM_IRQS
	default 64

endif # SOC_SERIES_RISCV_ANDES_V5
```

## soc/riscv/riscv-privilege/andes_v5/Kconfig.series
```kconfig
# Copyright (c) 2021 Andes Technology Corporation
# SPDX-License-Identifier: Apache-2.0

config SOC_SERIES_RISCV_ANDES_V5
	bool "Andes V5 SoC Series Implementation"
	select RISCV
	select SOC_FAMILY_RISCV_PRIVILEGE
	help
	  Enable support for Andes V5 SoC Series
```

## soc/riscv/riscv-privilege/andes_v5/Kconfig.soc
```kconfig
# Copyright (c) 2021 Andes Technology Corporation
# SPDX-License-Identifier: Apache-2.0

choice
prompt "Andes V5 SoC Selection"
depends on SOC_SERIES_RISCV_ANDES_V5

config SOC_RISCV_ANDES_AE350
	bool "Andes AE350 SoC implementation"
	select ATOMIC_OPERATIONS_BUILTIN

endchoice

if SOC_SERIES_RISCV_ANDES_V5

choice
prompt "Base CPU ISA options"
default RV32I_CPU

config RV32I_CPU
	bool "RISCV32 CPU ISA"

config RV64I_CPU
	bool "RISCV64 CPU ISA"
	select 64BIT

endchoice

choice
prompt "FPU options"
default NO_FPU

config NO_FPU
	bool "No FPU"

config SINGLE_PRECISION_FPU
	bool "Single precision FPU"
	select CPU_HAS_FPU

config DOUBLE_PRECISION_FPU
	bool "Double precision FPU"
	select CPU_HAS_FPU_DOUBLE_PRECISION

endchoice

config CACHE_ENABLE
	bool "Enable cache"
	default n

endif # SOC_SERIES_RISCV_ANDES_V5
```

## soc/riscv/riscv-privilege/ariane/Kconfig.series
```kconfig
# SPDX-License-Identifier: Apache-2.0

config SOC_SERIES_RISCV64_ARIANE
	bool "Ariane implementation"
	select RISCV
	select SOC_FAMILY_RISCV_PRIVILEGE
	help
	  Enable support for Ariane RISCV
```

## soc/riscv/riscv-privilege/ariane/Kconfig.soc
```kconfig
# SPDX-License-Identifier: Apache-2.0

choice
	prompt "Ariane system implementation"
	depends on SOC_SERIES_RISCV64_ARIANE

config SOC_RISCV64_ARIANE
	bool "Ariane RISCV implementation"
	select ATOMIC_OPERATIONS_C
    select RISCV

endchoice
```

## soc/riscv/riscv-privilege/ch32v/Kconfig.defconfig.ch32v307
```kconfig
# Copyright (c) 2022 TOKITA Hiroshi <tokita.hiroshi@gmail.com>
# SPDX-License-Identifier: Apache-2.0

if SOC_CH32V307

config SOC
	default "ch32v307"

config PINCTRL
	default y

config RESET
	default y

config CLOCK_CONTROL
	default y

endif # SOC_CH32V307
```

## soc/riscv/riscv-privilege/ch32v/Kconfig.defconfig.series
```kconfig
# Copyright (c) 2022 TOKITA Hiroshi <tokita.hiroshi@gmail.com>
# SPDX-License-Identifier: Apache-2.0

if SOC_SERIES_CH32V30X

source "soc/riscv/riscv-privilege/ch32v/Kconfig.defconfig.ch32v*"

config SOC_SERIES
	default "ch32v"

config FPU
	default y

config RISCV_SOC_INTERRUPT_INIT
	default y

config RISCV_HAS_CPU_IDLE
	default y

config RISCV_GP
	default y

config NUM_IRQS
	default 88

config FLASH_BASE_ADDRESS
	default $(dt_node_reg_addr_hex,flash0@0)

config SYS_CLOCK_HW_CYCLES_PER_SEC
	default $(dt_node_int_prop_int,/cpus/cpu@0,clock-frequency)

endif # SOC_SERIES_CH32V30X
```

## soc/riscv/riscv-privilege/ch32v/Kconfig.series
```kconfig
# CH32V30X SOC implementation

# Copyright (c) 2022 TOKITA Hiroshi <tokita.hiroshi@gmail.com>
# SPDX-License-Identifier: Apache-2.0

config SOC_SERIES_CH32V30X
	bool "WCH CH32V30X series SoC implementation"
	select RISCV
	select CPU_HAS_FPU
	select SOC_FAMILY_RISCV_PRIVILEGE
	select ATOMIC_OPERATIONS_C
	select INCLUDE_RESET_VECTOR
	select BUILD_OUTPUT_HEX
	select XIP
	select HAS_CH32_HAL
	select USE_GD32_COMPAT

	help
	  Enable support for WCH CH32V30X series SoC
```

## soc/riscv/riscv-privilege/ch32v/Kconfig.soc
```kconfig
# CH32V30X SOC configuration options

# Copyright (c) 2022 TOKITA Hiroshi <tokita.hiroshi@gmail.com>
# SPDX-License-Identifier: Apache-2.0

choice
	prompt "WCH CH32V30X SOC implementation"
	depends on SOC_SERIES_CH32V30X

config SOC_CH32V307
	bool "CH32V307"
	select RISCV_ISA_RV32I
	select RISCV_ISA_EXT_M
	select RISCV_ISA_EXT_A
	select RISCV_ISA_EXT_C
	select RISCV_ISA_EXT_F
	select RISCV_ISA_EXT_ZICSR
	select RISCV_ISA_EXT_ZIFENCEI

endchoice
```

## soc/riscv/riscv-privilege/gd32vf103/Kconfig.defconfig.gd32vf103
```kconfig
# Copyright (c) 2021 Tokita, Hiroshi <tokita.hiroshi@gmail.com>
# SPDX-License-Identifier: Apache-2.0

if SOC_GD32VF103

config SOC
	default "gd32vf103"

config KERNEL_ENTRY
	default "__nuclei_start"

config SYS_CLOCK_HW_CYCLES_PER_SEC
	default $(dt_node_int_prop_int,/cpus/cpu@0,clock-frequency) if RISCV_MACHINE_TIMER

config RISCV_MACHINE_TIMER_SYSTEM_CLOCK_DIVIDER
	default $(dt_node_int_prop_int,/soc/timer@d1000000,clk-divider) if RISCV_MACHINE_TIMER

config RISCV_SOC_MCAUSE_EXCEPTION_MASK
	default $(dt_node_int_prop_hex,/cpus/cpu@0,mcause-exception-mask)

config RISCV_SOC_INTERRUPT_INIT
	default y

config RISCV_HAS_CPU_IDLE
	default y

config RISCV_GP
	default y

config RISCV_HAS_PLIC
	default n

config NUM_IRQS
	default 87 if  NUCLEI_ECLIC
	default 16 if !NUCLEI_ECLIC

config 2ND_LEVEL_INTERRUPTS
	default y

config PINCTRL
	default y

config RESET
	default y

config CLOCK_CONTROL
	default y

endif # GD32VF103
```

## soc/riscv/riscv-privilege/gd32vf103/Kconfig.soc
```kconfig
# GD32VF103 SOC configuration options

# Copyright (c) 2021 Tokita, Hiroshi <tokita.hiroshi@gmail.com>
# SPDX-License-Identifier: Apache-2.0

config SOC_GD32VF103
	bool
	select RISCV_ISA_RV32I
	select RISCV_ISA_EXT_M
	select RISCV_ISA_EXT_A
	select RISCV_ISA_EXT_C
	select RISCV_ISA_EXT_ZICSR
	select RISCV_ISA_EXT_ZIFENCEI
	help
	  GD32VF103
```

## soc/riscv/riscv-privilege/gigadevice-gd32v/Kconfig.defconfig.series
```kconfig
# Copyright (c) 2021 Tokita, Hiroshi <tokita.hiroshi@gmail.com>
# SPDX-License-Identifier: Apache-2.0

if SOC_SERIES_RISCV_GIGADEVICE_GD32V

config KERNEL_ENTRY
	default "__nuclei_start"

config SOC_SERIES
	default "gigadevice-gd32v"

config SYS_CLOCK_HW_CYCLES_PER_SEC
	default 32768

config COMPRESSED_ISA
	default y

config RISCV_HAS_CPU_IDLE
	default y

config HAS_FLASH_LOAD_OFFSET
	default y

config FLASH_BASE_ADDRESS
	default $(dt_node_reg_addr_hex,flash0@8000000)

config FLASH_LOAD_OFFSET
	default 0x0

config PLIC
	default n

config NUCLEI_ECLIC
	default y

config NUM_IRQS
	default 64

config CLOCK_CONTROL_GD32
	default y
	depends on CLOCK_CONTROL

config UART_GD32
	default y
	depends on SERIAL

if GPIO

config GPIO_GD32
	default y

endif # GPIO

endif # SOC_SERIES_RISCV_GIGADEVICE_GD32V
```

## soc/riscv/riscv-privilege/gigadevice-gd32v/Kconfig.series
```kconfig
# SERIES_RISCV_GIGADEVICE_GD32V SOC implementation

# Copyright (c) 2021 Tokita, Hiroshi <tokita.hiroshi@gmail.com>
# SPDX-License-Identifier: Apache-2.0

config SOC_SERIES_RISCV_GIGADEVICE_GD32V
	bool "GigaDevice GD32VF103 series SoC implementation"
	select ATOMIC_OPERATIONS_C
	select RISCV
	select SOC_FAMILY_RISCV_PRIVILEGE
	select BUILD_OUTPUT_HEX

	help
	  Enable support for GigaDevice GD32V series SoC
```

## soc/riscv/riscv-privilege/gigadevice-gd32v/Kconfig.soc
```kconfig
# RISCV_GIGADEVICE_GD32VF103 SOC configuration options

# Copyright (c) 2021 Tokita, Hiroshi <tokita.hiroshi@gmail.com>
# SPDX-License-Identifier: Apache-2.0

choice
	prompt "GigaDevice GD32VF103 SOC implementation"
	depends on SOC_SERIES_RISCV_GIGADEVICE_GD32V

config SOC_RISCV_GIGADEVICE_GD32VF103
	bool "GigaDevice GD32VF103 SOC implementation"

endchoice
```
