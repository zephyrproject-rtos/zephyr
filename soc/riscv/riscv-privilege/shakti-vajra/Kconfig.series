## soc/riscv/riscv-privilege/telink_w91/Kconfig.defconfig.series
```kconfig
# Copyright (c) 2023 Telink Semiconductor
# SPDX-License-Identifier: Apache-2.0

if SOC_SERIES_RISCV_TELINK_W91

config SOC_SERIES
	string
	default "telink_w91"

config SYS_CLOCK_HW_CYCLES_PER_SEC
	int
	default 10000000

config RISCV_SOC_INTERRUPT_INIT
	bool
	default y

config RISCV_HAS_CPU_IDLE
	bool
	default y

config RISCV_HAS_PLIC
	bool
	default y

config RISCV_GP
	bool
	default y

config NUM_IRQS
	int
	default 59

config 2ND_LVL_ISR_TBL_OFFSET
	int
	default 12

config PINCTRL
	default y

config XIP
	bool
	default n

config MAIN_STACK_SIZE
	int
	default 2048

config IDLE_STACK_SIZE
	int
	default 1536

config TEST_EXTRA_STACK_SIZE
	int
	default 1024

config HAS_FLASH_LOAD_OFFSET
	default y if BOOTLOADER_MCUBOOT

config MBEDTLS_ZEPHYR_ENTROPY
	default y if ENTROPY_HAS_DRIVER

config COMMON_LIBC_MALLOC
	default y

config COMMON_LIBC_MALLOC_ARENA_SIZE
	default 8192

config OPENTHREAD_RADIO_WORKQUEUE_STACK_SIZE
	default 2048 if NET_L2_OPENTHREAD && NETWORKING

config STACK_SENTINEL
	default y

config THREAD_NAME
	default y if STACK_SENTINEL

config TELINK_W91_2_WIRE_SPI_ENABLE
	bool
	default n

config REBOOT
	default y

endif # SOC_SERIES_RISCV_TELINK_W91
```

## soc/riscv/riscv-privilege/telink_w91/Kconfig.n22
```kconfig
# Copyright (c) 2023 Telink Semiconductor
# SPDX-License-Identifier: Apache-2.0

config TELINK_W91_FETCH_N22_BIN
	bool "Fetch N22 binary after build"
	default y
	depends on SOC_SERIES_RISCV_TELINK_W91
	help
		This option fetching N22 binary after build.

config TELINK_W91_FETCH_N22_BIN_REVISION
	string "N22 binaries revision"
	default "73b93e78cd6c6681ff6dfc49d7bce37fbf4e37c8"
	depends on TELINK_W91_FETCH_N22_BIN
	help
		This option sets N22 binary revision.
```

## soc/riscv/riscv-privilege/telink_w91/Kconfig.series
```kconfig
# Copyright (c) 2023 Telink Semiconductor
# SPDX-License-Identifier: Apache-2.0

config SOC_SERIES_RISCV_TELINK_W91
	bool "Telink W91 SoCs Implementation"
	select RISCV
	select RISCV_ISA_RV32I
	select RISCV_ISA_EXT_M
	select RISCV_ISA_EXT_A
	select RISCV_ISA_EXT_C
	select RISCV_ISA_EXT_ZICSR
	select RISCV_ISA_EXT_ZIFENCEI
	select SOC_FAMILY_RISCV_PRIVILEGE
	help
	  Enable support for Telink W91 SoC
```

## soc/riscv/riscv-privilege/telink_w91/Kconfig.soc
```kconfig
# Copyright (c) 2023 Telink Semiconductor
# SPDX-License-Identifier: Apache-2.0

choice
prompt "CPU Architecture of SoC"
depends on SOC_SERIES_RISCV_TELINK_W91

config W91CPU_RISCV32
	bool "RISCV32 CPU Architecture"
	select RISCV_ISA_RV32I
	select RISCV_ISA_EXT_M
	select RISCV_ISA_EXT_A
	select RISCV_ISA_EXT_C
	select RISCV_ISA_EXT_ZICSR
	select RISCV_ISA_EXT_ZIFENCEI

endchoice

config TELINK_W91_HWDSP
	bool "Support Hardware DSP"
	select RISCV_SOC_CONTEXT_SAVE
	depends on SOC_SERIES_RISCV_TELINK_W91
	default n

config TELINK_W91_PFT_ARCH
	bool "Support performance throttling"
	default y
	select RISCV_SOC_CONTEXT_SAVE
	depends on SOC_SERIES_RISCV_TELINK_W91

choice
prompt "Telink W91 SoCs implementation"
depends on SOC_SERIES_RISCV_TELINK_W91

config SOC_RISCV_TELINK_W91
	bool "Telink W91 SoC implementation"
	select ATOMIC_OPERATIONS_BUILTIN
	select CPU_HAS_FPU
	select CPU_HAS_DCACHE
	select CPU_HAS_ICACHE
	select CACHE_MANAGEMENT
	select INCLUDE_RESET_VECTOR

endchoice

config TELINK_SOC_REBOOT_ON_FAULT
	bool "Reboot system when fault happened"
	depends on SOC_SERIES_RISCV_TELINK_W91
	default n
	help
		This option enables Telink W91 chip reboot after fault.

config TELINK_SOC_REBOOT_ON_FAULT_DELAY
	int "Reboot system delay in mS"
	depends on SOC_SERIES_RISCV_TELINK_W91 && TELINK_SOC_REBOOT_ON_FAULT
	default 1000
	range 0 30000
	help
		This option sets Telink W91 chip reboot on fault delay in mS.

config TELINK_W91_2_WIRE_SPI_ENABLE
	bool "Use 2-wire SPI interface to FLASH"
	depends on SOC_SERIES_RISCV_TELINK_W91
	default n
	help
		This option enables 2-wire SPI interface to FLASH

config TELINK_W91_MALLOC_FAILED_HOOK
	bool "Stop SW execution when system heap allocation failed"
	depends on SOC_SERIES_RISCV_TELINK_W91
	default y
	help
		This option stops SW execution when system heap allocation failed.

config TELINK_W91_DEBUG_ENABLE
	bool "Telink W91 debug enable"
	depends on SOC_SERIES_RISCV_TELINK_W91
	default y
	help
		This option enables Telink W91 debug feature.

config TELINK_W91_DEBUG_PORT
	int "Telink W91 debug port"
	range 0 1
	default 0
	depends on TELINK_W91_DEBUG_ENABLE
	help
		This option sets Telink W91 debug port.

config TELINK_W91_DEBUG_BAUDRATE
	int "Telink W91 debug baudrate"
	default 115200
	depends on TELINK_W91_DEBUG_ENABLE
	help
		This option sets Telink W91 debug baudrate, bps.

source "soc/riscv/riscv-privilege/telink_w91/ipc/Kconfig.ipc"

source "soc/riscv/riscv-privilege/telink_w91/blocking_core/Kconfig.blocking"

source "soc/riscv/riscv-privilege/telink_w91/core_heartbeat/Kconfig.heartbeat"

source "soc/riscv/riscv-privilege/telink_w91/bluetooth/Kconfig.bt"

source "soc/riscv/riscv-privilege/telink_w91/crypto/Kconfig.crypto"

source "soc/riscv/riscv-privilege/telink_w91/Kconfig.n22"
```

## soc/riscv/riscv-privilege/telink_w91/blocking_core/Kconfig.blocking
```kconfig
# Copyright (c) 2024 Telink Semiconductor
# SPDX-License-Identifier: Apache-2.0

config TELINK_W91_BLOCKING_CORE
	bool "Telink W91 blocking core"
	depends on SOC_SERIES_RISCV_TELINK_W91
	default y
	help
		This option enables Telink W91 blocking core.

if TELINK_W91_BLOCKING_CORE

config TELINK_W91_BLOCKING_CORE_THREAD_STACK_SIZE
	int "Blocking thread stack size"
	default 1024
	help
	  Blocking thread stack size.

config BLOCKING_CORE_TELINK_W91_CORE_STOP_TIMEOUT_MS
	int "Core stop timeout"
	default 100
	help
	  This option sets core stop timeout in uS.

endif # TELINK_W91_BLOCKING_CORE
```

## soc/riscv/riscv-privilege/telink_w91/bluetooth/Kconfig.bt
```kconfig
# Copyright (c) 2024 Telink Semiconductor
# SPDX-License-Identifier: Apache-2.0

if BT

menu "Telink W91 BLE"

choice TELINK_W91_BLE_MAC_TYPE
	prompt "MAC address type"
	default TELINK_W91_BLE_MAC_TYPE_PUBLIC
config TELINK_W91_BLE_MAC_TYPE_PUBLIC
	bool "Public"
config TELINK_W91_BLE_MAC_TYPE_RANDOM_STATIC
	bool "Random static"
endchoice

config TELINK_W91_BLE_MAC_PUBLIC_DEBUG
	bool "Public address debug"
	default n
	help
	  Enable BLE public MAC address generation

endmenu

endif # BT
```

## soc/riscv/riscv-privilege/telink_w91/core_heartbeat/Kconfig.heartbeat
```kconfig
# Copyright (c) 2024 Telink Semiconductor
# SPDX-License-Identifier: Apache-2.0

config TELINK_W91_CORE_HEARTBEAT
	bool "Telink W91 intercore heartbeat"
	default y
	help
		This option enables Telink W91 heartbeat messages between cores.

if TELINK_W91_CORE_HEARTBEAT

config CORE_HEARTBEAT_TELINK_W91_TIMEOUT_MS
	int "Heartbeat signal interval, ms"
	default 2000
	help
	  This option sets heartbeat timeout in mS.

endif # TELINK_W91_CORE_HEARTBEAT
```

## soc/riscv/riscv-privilege/telink_w91/crypto/Kconfig.crypto
```kconfig
# Copyright (c) 2024 Telink Semiconductor
# SPDX-License-Identifier: Apache-2.0

if MBEDTLS

config MBEDTLS_USER_CONFIG_FILE
	default "crypto/telink_w91_mbedtls_user_config.h"
	depends on SOC_SERIES_RISCV_TELINK_W91

config TELINK_W91_ECC_HW_ACC
	bool "Telink W91 EC cryptography HW acceleration"
	default y
	depends on MBEDTLS_ECP_C
	help
		This option enables Telink W91 EC cryptography HW acceleration.

endif # MBEDTLS
```

## soc/riscv/riscv-privilege/virt/Kconfig.defconfig.series
```kconfig
# Copyright (c) 2020 Cobham Gaisler AB
# SPDX-License-Identifier: Apache-2.0

if SOC_SERIES_RISCV_VIRT

config SOC_SERIES
	default "virt"

config SYS_CLOCK_HW_CYCLES_PER_SEC
	default 10000000

config RISCV_SOC_INTERRUPT_INIT
	default y

config RISCV_HAS_CPU_IDLE
	default y

config RISCV_HAS_PLIC
	default y

config RISCV_GP
	default y

config 2ND_LVL_ISR_TBL_OFFSET
	default 12

config 2ND_LVL_INTR_00_OFFSET
	default 11

config MAX_IRQ_PER_AGGREGATOR
	default 52

config NUM_IRQS
	default 64

config PMP_SLOTS
	default 16

endif
```

## soc/riscv/riscv-privilege/virt/Kconfig.series
```kconfig
# Copyright (c) 2020 Cobham Gaisler AB
# SPDX-License-Identifier: Apache-2.0

config SOC_SERIES_RISCV_VIRT
	bool
	select RISCV
	select SOC_FAMILY_RISCV_PRIVILEGE
	help
	  QEMU RISC-V VirtIO Board
```

## soc/riscv/riscv-privilege/virt/Kconfig.soc
```kconfig
# Copyright (c) 2020 Cobham Gaisler AB
# SPDX-License-Identifier: Apache-2.0

choice
	prompt "QEMU RISC-V VirtIO Board"
	depends on SOC_SERIES_RISCV_VIRT

config SOC_RISCV_VIRT
	bool "QEMU RISC-V VirtIO Board"
	select ATOMIC_OPERATIONS_BUILTIN
	select INCLUDE_RESET_VECTOR
	select RISCV_ISA_EXT_M
	select RISCV_ISA_EXT_A
	select RISCV_ISA_EXT_C

endchoice
```

## soc/riscv/riscv-privileged/Kconfig
```kconfig
# Configuration options for riscv SOCs supporting the riscv privileged
# architecture specification

# Copyright (c) 2017 Jean-Paul Etienne <fractalclone@gmail.com>
# SPDX-License-Identifier: Apache-2.0

config SOC_FAMILY_RISCV_PRIVILEGE
	bool
	select DEPRECATED

config SOC_FAMILY_RISCV_PRIVILEGED
	bool

config SOC_FAMILY
	string
	default "riscv-privileged"
	depends on SOC_FAMILY_RISCV_PRIVILEGED

config RISCV_HAS_PLIC
	bool "Does the SOC provide support for a Platform Level Interrupt Controller (PLIC)"
	depends on SOC_FAMILY_RISCV_PRIVILEGED
	help
	  Does the SOC provide support for a Platform Level Interrupt Controller (PLIC).

config RISCV_HAS_CLIC
	bool "Does the SOC provide support for a Core-Local Interrupt Controller (CLIC)"
	depends on SOC_FAMILY_RISCV_PRIVILEGED
	help
	  Does the SOC provide support for a Core-Local Interrupt Controller (CLIC).

config RISCV_VECTORED_MODE
	bool "Should the SOC use vectored mode"
	depends on SOC_FAMILY_RISCV_PRIVILEGED
	help
	  Should the SOC use vectored mode.

source "soc/riscv/riscv-privileged/*/Kconfig.soc"
```
