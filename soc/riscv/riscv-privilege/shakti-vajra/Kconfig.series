## soc/riscv/riscv-privilege/shakti-vajra/Kconfig.series
```kconfig
# Kconfig - RISCV64 SHAKTI VAJRA SOC implementation
#
# SPDX-License-Identifier: Apache-2.0
#

config SOC_SERIES_RISCV64_SHAKTI
	bool "Shakti Vajra SOC implementation"
	select RISCV
	select 64BIT
	select SOC_FAMILY_RISCV_PRIVILEGE
```

## soc/riscv/riscv-privilege/sifive-freedom/Kconfig.defconfig.series
```kconfig
# SPDX-License-Identifier: Apache-2.0

if SOC_SERIES_RISCV_SIFIVE_FREEDOM

config SOC_SERIES
	default "sifive-freedom"

config SYS_CLOCK_HW_CYCLES_PER_SEC
	default 32768

config RISCV_SOC_INTERRUPT_INIT
	default y

config RISCV_HAS_CPU_IDLE
	default y

config RISCV_HAS_PLIC
	default y

config RISCV_GP
	default y

config 2ND_LVL_ISR_TBL_OFFSET
	default 12

config 2ND_LVL_INTR_00_OFFSET
	default 11

config MAX_IRQ_PER_AGGREGATOR
	default 52

config NUM_IRQS
	default 64

endif # SOC_SERIES_RISCV_SIFIVE_FREEDOM
```

## soc/riscv/riscv-privilege/sifive-freedom/Kconfig.series
```kconfig
# RISCV_SIFIVE_FREEDOM SOC implementation

# Copyright (c) 2017 Jean-Paul Etienne <fractalclone@gmail.com>
# SPDX-License-Identifier: Apache-2.0

config SOC_SERIES_RISCV_SIFIVE_FREEDOM
	bool "SiFive Freedom SOC implementation"
	select RISCV
	select SOC_FAMILY_RISCV_PRIVILEGE
	help
	  Enable support for SiFive Freedom SOC
```

## soc/riscv/riscv-privilege/sifive-freedom/Kconfig.soc
```kconfig
# RISCV_SIFIVE_FREEDOM SOC configuration options

# Copyright (c) 2017 Jean-Paul Etienne <fractalclone@gmail.com>
# SPDX-License-Identifier: Apache-2.0

choice
	prompt "SiFive Freedom SOC implementation"
	depends on SOC_SERIES_RISCV_SIFIVE_FREEDOM

config SOC_RISCV_SIFIVE_FREEDOM
	bool "SiFive Freedom SOC implementation"
	select ATOMIC_OPERATIONS_C
	select INCLUDE_RESET_VECTOR
	select RISCV_ISA_RV32I
	select RISCV_ISA_EXT_M
	select RISCV_ISA_EXT_A
	select RISCV_ISA_EXT_ZICSR
	select RISCV_ISA_EXT_ZIFENCEI

config SOC_RISCV_SIFIVE_FU540
	bool "SiFive Freedom U540 SOC implementation"
	select ATOMIC_OPERATIONS_C
	select INCLUDE_RESET_VECTOR
	select 64BIT
	select RISCV_ISA_RV64I
	select RISCV_ISA_EXT_M
	select RISCV_ISA_EXT_A
	select RISCV_ISA_EXT_C
	select RISCV_ISA_EXT_ZICSR
	select RISCV_ISA_EXT_ZIFENCEI

config SOC_RISCV_SIFIVE_FU740
	bool "SiFive Freedom U740 SOC implementation"
	select ATOMIC_OPERATIONS_C
	select INCLUDE_RESET_VECTOR
	select 64BIT
	select RISCV_ISA_RV64I
	select RISCV_ISA_EXT_M
	select RISCV_ISA_EXT_A
	select RISCV_ISA_EXT_C
	select RISCV_ISA_EXT_ZICSR
	select RISCV_ISA_EXT_ZIFENCEI

endchoice
```

## soc/riscv/riscv-privilege/starfive_jh71xx/Kconfig.defconfig.series
```kconfig
# Copyright (c) 2021 Rajnesh Kanwal <rajnesh.kanwal49@gmail.com>
# SPDX-License-Identifier: Apache-2.0

if SOC_SERIES_STARFIVE_JH71XX

config SOC_SERIES
	default "starfive_jh71xx"

config SYS_CLOCK_HW_CYCLES_PER_SEC
	default 6250000

config RISCV_SOC_INTERRUPT_INIT
	default y

config RISCV_HAS_CPU_IDLE
	default y

config RISCV_HAS_PLIC
	default y

config RISCV_GP
	default y

config 2ND_LVL_ISR_TBL_OFFSET
	default 12

config 2ND_LVL_INTR_00_OFFSET
	default 11

config NUM_IRQS
	default 139

endif
```

## soc/riscv/riscv-privilege/starfive_jh71xx/Kconfig.soc
```kconfig
# Copyright (c) 2021 Rajnesh Kanwal <rajnesh.kanwal49@gmail.com>
# SPDX-License-Identifier: Apache-2.0

config SOC_JH7100
	bool
	select ATOMIC_OPERATIONS_BUILTIN
	select INCLUDE_RESET_VECTOR
	select RISCV_ISA_RV64I
	select RISCV_ISA_EXT_M
	select RISCV_ISA_EXT_A
	select RISCV_ISA_EXT_C
	select RISCV_ISA_EXT_ZICSR
	select RISCV_ISA_EXT_ZIFENCEI
	help
	  Starfive JH7100
```

## soc/riscv/riscv-privilege/telink_b91/Kconfig.defconfig.series
```kconfig
# Copyright (c) 2021 Telink Semiconductor
# SPDX-License-Identifier: Apache-2.0

if SOC_SERIES_RISCV_TELINK_B91

config SOC_SERIES
	string
	default "telink_b91"

config SYS_CLOCK_HW_CYCLES_PER_SEC
	int
	default 32000

config RISCV_SOC_INTERRUPT_INIT
	bool
	default y

config RISCV_HAS_CPU_IDLE
	bool
	default y

config RISCV_HAS_PLIC
	bool
	default y

config NUM_IRQS
	int
	default 64

config XIP
	bool
	default n

config MAIN_STACK_SIZE
	int
	default 2048

config IDLE_STACK_SIZE
	int
	default 1536

config TEST_EXTRA_STACKSIZE
	int
	default 1024

endif # SOC_SERIES_RISCV_TELINK_B91
```

## soc/riscv/riscv-privilege/telink_b91/Kconfig.series
```kconfig
# Copyright (c) 2021 Telink Semiconductor
# SPDX-License-Identifier: Apache-2.0

config SOC_SERIES_RISCV_TELINK_B91
	bool "Telink B91 SoC Implementation"
	select RISCV
	select RISCV_ISA_RV32I
	select RISCV_ISA_EXT_M
	select RISCV_ISA_EXT_A
	select RISCV_ISA_EXT_C
	select RISCV_ISA_EXT_ZICSR
	select RISCV_ISA_EXT_ZIFENCEI
	select SOC_FAMILY_RISCV_PRIVILEGE
	select HAS_TELINK_DRIVERS
	help
	  Enable support for Telink B91 SoC
```

## soc/riscv/riscv-privilege/telink_b91/Kconfig.soc
```kconfig
# Copyright (c) 2021 Telink Semiconductor
# SPDX-License-Identifier: Apache-2.0

choice
prompt "CPU Architecture of SoC"
depends on SOC_SERIES_RISCV_TELINK_B91

config B91_CPU_RISCV32
	bool "RISCV32 CPU Architecture"
	select RISCV_ISA_RV32I
	select RISCV_ISA_EXT_M
	select RISCV_ISA_EXT_A
	select RISCV_ISA_EXT_C
	select RISCV_ISA_EXT_ZICSR
	select RISCV_ISA_EXT_ZIFENCEI

endchoice

config TELINK_B91_HWDSP
	bool "Support Hardware DSP"
	select RISCV_SOC_CONTEXT_SAVE
	depends on SOC_SERIES_RISCV_TELINK_B91

config TELINK_B91_MBEDTLS_HW_ACCELERATION
	bool "Use Telink B91 platform mbedtls HW acceleration"
	depends on SOC_SERIES_RISCV_TELINK_B91 && MBEDTLS
	default y
	help
		This option enables Telink B91 hardware accelerated mbedtls version.

config TELINK_B91_PFT_ARCH
	bool "Support performance throttling"
	default y
	select RISCV_SOC_CONTEXT_SAVE
	depends on SOC_SERIES_RISCV_TELINK_B91

choice
prompt "Telink B91 SoC implementation"
depends on SOC_SERIES_RISCV_TELINK_B91

config SOC_RISCV_TELINK_B91
	bool "Telink B91 SoC implementation"
	select ATOMIC_OPERATIONS_BUILTIN
	select CPU_HAS_FPU
	select INCLUDE_RESET_VECTOR

endchoice

config FLASH_BASE_ADDRESS
	hex
	default $(dt_chosen_reg_addr_hex,$(DT_CHOSEN_Z_FLASH))

config PM_DEVICE
	default y if PM

config SHELL_BACKENDS
	default n if PM

config TELINK_B91_REBOOT_ON_FAULT
	bool "Reboot system when fault happened"
	depends on SOC_SERIES_RISCV_TELINK_B91
	default n
	help
		This option enables Telink B91 chip reboot after fault.

config TELINK_B91_REBOOT_ON_FAULT_DELAY
	int "Reboot system delay in mS"
	depends on SOC_SERIES_RISCV_TELINK_B91 && TELINK_B91_REBOOT_ON_FAULT
	default 1000
	range 0 30000
	help
		This option sets Telink B91 chip reboot on fault delay in mS.

config TELINK_B91_USB_SWI_DISABLE
	bool "Don't use USB SWI interface"
	depends on SOC_SERIES_RISCV_TELINK_B91
	default n
	help
		This option disables USB SWI interface

config TELINK_B91_2_WIRE_SPI_ENABLE
	bool "Use 2-wire SPI interface to FLASH"
	depends on SOC_SERIES_RISCV_TELINK_B91
	default n
	help
		This option enables 2-wire SPI interface to FLASH
```

## soc/riscv/riscv-privilege/telink_b9x/Kconfig.series
```kconfig
# Copyright (c) 2021-2023 Telink Semiconductor
# SPDX-License-Identifier: Apache-2.0

config SOC_SERIES_RISCV_TELINK_B9X
	bool "Telink B9x SoCs Implementation"
	select RISCV
	select RISCV_ISA_RV32I
	select RISCV_ISA_EXT_M
	select RISCV_ISA_EXT_A
	select RISCV_ISA_EXT_C
	select RISCV_ISA_EXT_ZICSR
	select RISCV_ISA_EXT_ZIFENCEI
	select SOC_FAMILY_RISCV_PRIVILEGE
	select HAS_TELINK_DRIVERS
	select FLASH if BT
	help
	  Enable support for Telink B9x SoC

config SOC_SERIES_RISCV_TELINK_B9X_RETENTION
	bool "Telink B9x SoCs retention memory layout"
	depends on SOC_SERIES_RISCV_TELINK_B9X
	help
	  Telink B9x SoCs retention memory layout

config SOC_SERIES_RISCV_TELINK_B9X_NON_RETENTION_RAM_CODE
	bool "Telink B9x SoCs non retention ram code"
	depends on SOC_SERIES_RISCV_TELINK_B9X_RETENTION
	help
	  Place Telink B9x SoCs ram code in non-retention area
	  and restore this are after each retention.
```

## soc/riscv/riscv-privilege/telink_b9x/Kconfig.soc
```kconfig
# Copyright (c) 2021-2023 Telink Semiconductor
# SPDX-License-Identifier: Apache-2.0

choice
prompt "CPU Architecture of SoC"
depends on SOC_SERIES_RISCV_TELINK_B9X

config B9xCPU_RISCV32
	bool "RISCV32 CPU Architecture"
	select RISCV_ISA_RV32I
	select RISCV_ISA_EXT_M
	select RISCV_ISA_EXT_A
	select RISCV_ISA_EXT_C
	select RISCV_ISA_EXT_ZICSR
	select RISCV_ISA_EXT_ZIFENCEI

endchoice

config TELINK_B92_PMP
	bool "Support Hardware Memory Protection"
	depends on SOC_RISCV_TELINK_B92
	select RISCV_PMP
	help
		This option enables Telink B92 PMP(memory protection) module.

config TELINK_B9x_HWDSP
	bool "Support Hardware DSP"
	select RISCV_SOC_CONTEXT_SAVE
	depends on SOC_SERIES_RISCV_TELINK_B9X

config TELINK_B9X_MBEDTLS_HW_ACCELERATION
	bool "Use Telink B9x platform mbedtls HW acceleration"
	depends on SOC_SERIES_RISCV_TELINK_B9X && MBEDTLS
	default y
	help
		This option enables Telink B9x hardware accelerated mbedtls version.

config TELINK_B9X_PFT_ARCH
	bool "Support performance throttling"
	default y
	select RISCV_SOC_CONTEXT_SAVE
	depends on SOC_SERIES_RISCV_TELINK_B9X

choice
prompt "Telink B9x SoCs implementation"
depends on SOC_SERIES_RISCV_TELINK_B9X

config SOC_RISCV_TELINK_B91
	bool "Telink B91 SoC implementation"
	select ATOMIC_OPERATIONS_BUILTIN
	select CPU_HAS_FPU
	select INCLUDE_RESET_VECTOR

config SOC_RISCV_TELINK_B92
	bool "Telink B92 SoC implementation"
	select ATOMIC_OPERATIONS_BUILTIN
	select CPU_HAS_FPU
	select INCLUDE_RESET_VECTOR

endchoice

config PMP_SLOTS
	default 16

config PM_DEVICE
	default y if PM

config SHELL_BACKENDS
	default n if PM

config TELINK_B9X_REBOOT_ON_FAULT
	bool "Reboot system when fault happened"
	depends on SOC_SERIES_RISCV_TELINK_B9X
	default n
	help
		This option enables Telink B9x chip reboot after fault.

config TELINK_B9X_REBOOT_ON_FAULT_DELAY
	int "Reboot system delay in mS"
	depends on SOC_SERIES_RISCV_TELINK_B9X && TELINK_B9X_REBOOT_ON_FAULT
	default 1000
	range 0 30000
	help
		This option sets Telink B91 chip reboot on fault delay in mS.

config TELINK_B91_USB_SWI_DISABLE
	bool "Don't use USB SWI interface"
	depends on SOC_SERIES_RISCV_TELINK_B9X
	default n
	help
		This option disables USB SWI interface

config TELINK_B9X_2_WIRE_SPI_ENABLE
	bool "Use 2-wire SPI interface to FLASH"
	depends on SOC_SERIES_RISCV_TELINK_B9X
	default n
	help
		This option enables 2-wire SPI interface to FLASH

config TELINK_B9X_MALLOC_FAILED_HOOK
	bool "Stop SW execution when system heap allocation failed"
	depends on SOC_SERIES_RISCV_TELINK_B9X
	default y
	help
		This option stops SW execution when system heap allocation failed.

config TELINK_B9x_MATTER_RETENTION_LAYOUT
	bool "Support Matter retention layout"
	depends on SOC_SERIES_RISCV_TELINK_B9X && (BOARD_TLSR9518ADK80D_RETENTION || BOARD_TLSR9528A_RETENTION)
	default n
	help
		This option enables support Matter retention layout
```

## soc/riscv/riscv-privilege/telink_tlx/Kconfig.series
```kconfig
# Copyright (c) 2021-2023 Telink Semiconductor
# SPDX-License-Identifier: Apache-2.0

config SOC_SERIES_RISCV_TELINK_TLX
	bool "Telink TLx SoCs Implementation"
	select RISCV
	select RISCV_ISA_RV32I
	select RISCV_ISA_EXT_M
	select RISCV_ISA_EXT_A
	select RISCV_ISA_EXT_C
	select RISCV_ISA_EXT_ZICSR
	select RISCV_ISA_EXT_ZIFENCEI
	select SOC_FAMILY_RISCV_PRIVILEGE
	select HAS_TELINK_DRIVERS
	select FLASH if BT
	help
	  Enable support for Telink TLx SoC

config SOC_SERIES_RISCV_TELINK_TLX_RETENTION
	bool "Telink TLx SoCs retention memory layout"
	depends on SOC_SERIES_RISCV_TELINK_TLX
	help
	  Telink TLx SoCs retention memory layout

config SOC_SERIES_RISCV_TELINK_TLX_NON_RETENTION_RAM_CODE
	bool "Telink TLx SoCs non retention ram code"
	depends on SOC_SERIES_RISCV_TELINK_TLX_RETENTION
	help
	  Place Telink TLx SoCs ram code in non-retention area
	  and restore this are after each retention.
```

## soc/riscv/riscv-privilege/telink_tlx/Kconfig.soc
```kconfig
# Copyright (c) 2021-2023 Telink Semiconductor
# SPDX-License-Identifier: Apache-2.0

choice
prompt "CPU Architecture of SoC"
depends on SOC_SERIES_RISCV_TELINK_TLX

config TLxCPU_RISCV32
	bool "RISCV32 CPU Architecture"
	select RISCV_ISA_RV32I
	select RISCV_ISA_EXT_M
	select RISCV_ISA_EXT_A
	select RISCV_ISA_EXT_C
	select RISCV_ISA_EXT_ZICSR
	select RISCV_ISA_EXT_ZIFENCEI

endchoice

config TELINK_TL321X_PMP
	bool "Support Hardware Memory Protection"
	depends on SOC_RISCV_TELINK_TL321X
	select RISCV_PMP
	help
		This option enables Telink TL321X PMP(memory protection) module.

config TELINK_B95_PMP
	bool "Support Hardware Memory Protection"
	depends on SOC_RISCV_TELINK_B95
	select RISCV_PMP
	help
		This option enables Telink B95 PMP(memory protection) module.

config TELINK_TLX_HWDSP
	bool "Support Hardware DSP"
	select RISCV_SOC_CONTEXT_SAVE
	depends on SOC_SERIES_RISCV_TELINK_TLX
	default n

config TELINK_TLX_MBEDTLS_HW_ACCELERATION
	bool "Use Telink TLx platform mbedtls HW acceleration"
	depends on SOC_SERIES_RISCV_TELINK_TLX && MBEDTLS
	default y
	help
		This option enables Telink TLx hardware accelerated mbedtls version.

config TELINK_TLX_PFT_ARCH
	bool "Support performance throttling"
	default y
	select RISCV_SOC_CONTEXT_SAVE
	depends on SOC_SERIES_RISCV_TELINK_TLX

choice
prompt "Telink TLx SoCs implementation"
depends on SOC_SERIES_RISCV_TELINK_TLX

config SOC_RISCV_TELINK_TL321X
	bool "Telink TL321X SoC implementation"
	select ATOMIC_OPERATIONS_BUILTIN
	select CPU_HAS_FPU
	select INCLUDE_RESET_VECTOR

endchoice

config PMP_SLOTS
	default 16

config PM_DEVICE
	default y if PM

config SHELL_BACKENDS
	default n if PM

config TELINK_SOC_REBOOT_ON_FAULT
	bool "Reboot system when fault happened"
	depends on SOC_SERIES_RISCV_TELINK_TLX
	default n
	help
		This option enables Telink B9x chip reboot after fault.

config TELINK_SOC_REBOOT_ON_FAULT_DELAY
	int "Reboot system delay in mS"
	depends on SOC_SERIES_RISCV_TELINK_TLX && TELINK_SOC_REBOOT_ON_FAULT
	default 1000
	range 0 30000
	help
		This option sets Telink B91 chip reboot on fault delay in mS.

config TELINK_B91_USB_SWI_DISABLE
	bool "Don't use USB SWI interface"
	depends on SOC_SERIES_RISCV_TELINK_TLX
	default n
	help
		This option disables USB SWI interface

config TELINK_B9X_2_WIRE_SPI_ENABLE
	bool "Use 2-wire SPI interface to FLASH"
	depends on SOC_SERIES_RISCV_TELINK_TLX
	default n
	help
		This option enables 2-wire SPI interface to FLASH

config TELINK_TLX_2_WIRE_SPI_ENABLE
	bool "Use 2-wire SPI interface to FLASH"
	depends on SOC_SERIES_RISCV_TELINK_TLX
	default n
	help
		This option enables 2-wire SPI interface to FLASH

config TELINK_TLX_MALLOC_FAILED_HOOK
	bool "Stop SW execution when system heap allocation failed"
	depends on SOC_SERIES_RISCV_TELINK_TLX
	default y
	help
		This option stops SW execution when system heap allocation failed.

config TELINK_TLX_MATTER_RETENTION_LAYOUT
	bool "Support Matter retention layout"
	depends on SOC_SERIES_RISCV_TELINK_TLX_RETENTION
	default n
	help
		This option enables support Matter retention layout
```
