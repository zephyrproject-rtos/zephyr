## soc/riscv/riscv-privilege/hi3861/Kconfig.series
```kconfig
# Copyright (c) 2023 Chen Xingyu <hi@xingrz.me>
# SPDX-License-Identifier: Apache-2.0

config SOC_SERIES_HI3861
	bool "HiSilicon Hi3861"
	select RISCV
	select RISCV_ISA_RV32I
	select RISCV_ISA_EXT_M
	select RISCV_ISA_EXT_C
	select RISCV_ISA_EXT_ZICSR
	select SOC_FAMILY_RISCV_PRIVILEGE
	select INCLUDE_RESET_VECTOR
	select ATOMIC_OPERATIONS_C
	select SYSCON
	help
	  Enable support for HiSilicon Hi3861
```

## soc/riscv/riscv-privilege/hi3861/Kconfig.soc
```kconfig
# Copyright (c) 2023 Chen Xingyu <hi@xingrz.me>
# SPDX-License-Identifier: Apache-2.0

choice
	prompt "HiSilicon Hi3861"
	depends on SOC_SERIES_HI3861

config SOC_HI3861V100
	bool "HiSilicon Hi3861V100"

endchoice
```

## soc/riscv/riscv-privilege/hummingbird/Kconfig.defconfig.series
```kconfig
# Copyright (c) 2021 TOKITA Hiroshi
# SPDX-License-Identifier: Apache-2.0

if SOC_SERIES_HUMMINGBIRD

config SOC_SERIES
	default "hummingbird"

config SOC
	default "hummingbird"

config SYS_CLOCK_HW_CYCLES_PER_SEC
	default 32768

config RISCV_SOC_INTERRUPT_INIT
	default y

config RISCV_HAS_CPU_IDLE
	default y

config RISCV_GP
	default y

config RISCV_HAS_PLIC
	default y

config NUM_IRQS
	default 16

endif # SOC_SERIES_HUMMINGBIRD
```

## soc/riscv/riscv-privilege/hummingbird/Kconfig.series
```kconfig
# HummingBird core implementation

# Copyright (c) 2021 TOKITA Hiroshi
# SPDX-License-Identifier: Apache-2.0

config SOC_SERIES_HUMMINGBIRD
	bool "Nuclei HummingBird SoC Core"
	select RISCV
	select SOC_FAMILY_RISCV_PRIVILEGE
	select ATOMIC_OPERATIONS_C
	select COMPRESSED_ISA
	select INCLUDE_RESET_VECTOR
	select BUILD_OUTPUT_HEX

	help
	  Enable support for Nuclei HummingBird series SoC core
```

## soc/riscv/riscv-privilege/hummingbird/Kconfig.soc
```kconfig
# HummingBird core implementation

# Copyright (c) 2021 TOKITA Hiroshi
# SPDX-License-Identifier: Apache-2.0

choice
	prompt "Nuclei HummingBird SoC Core"
	depends on SOC_SERIES_HUMMINGBIRD

config SOC_HUMMINGBIRD
	bool "Nuclei HummingBird SoC Core"
	help
	  Enable support for Nuclei HummingBird SoC core

endchoice
```

## soc/riscv/riscv-privilege/miv/Kconfig.defconfig.series
```kconfig
# SPDX-License-Identifier: Apache-2.0

if SOC_SERIES_RISCV32_MIV

config SOC_SERIES
	default "miv"

config SYS_CLOCK_HW_CYCLES_PER_SEC
	default 4000000

config RISCV_SOC_INTERRUPT_INIT
	default y

config RISCV_HAS_CPU_IDLE
	default y

config RISCV_HAS_PLIC
	default y

config RISCV_GP
	default y

config 2ND_LVL_ISR_TBL_OFFSET
	default 12

config 2ND_LVL_INTR_00_OFFSET
	default 11

config MAX_IRQ_PER_AGGREGATOR
	default 30

config NUM_IRQS
	default 42

endif # SOC_SERIES_RISCV32_MIV
```

## soc/riscv/riscv-privilege/miv/Kconfig.series
```kconfig
# RISCV32_MIV implementation

# Copyright (c) 2018 Antmicro <www.antmicro.com>
# SPDX-License-Identifier: Apache-2.0

config SOC_SERIES_RISCV32_MIV
	bool "Microchip Mi-V implementation"
	select RISCV
	select SOC_FAMILY_RISCV_PRIVILEGED
	help
	  Enable support for Microchip Mi-V
```

## soc/riscv/riscv-privilege/miv/Kconfig.soc
```kconfig
# RISCV32_MIV configuration options

# Copyright (c) 2018 Antmicro <www.antmicro.com>
# SPDX-License-Identifier: Apache-2.0

choice
	prompt "Microsemi Mi-V system implementation"
	depends on SOC_SERIES_RISCV32_MIV

config SOC_RISCV32_MIV
	bool "Microsemi Mi-V system implementation"
	select ATOMIC_OPERATIONS_C
	select INCLUDE_RESET_VECTOR
	select RISCV_ISA_RV32I
	select RISCV_ISA_EXT_M
	select RISCV_ISA_EXT_A

endchoice
```

## soc/riscv/riscv-privilege/mpfs/Kconfig.series
```kconfig
# RISCV64_MIV implementation

# Copyright (c) 2018 Antmicro <www.antmicro.com>
# SPDX-License-Identifier: Apache-2.0

config SOC_SERIES_RISCV64_MIV
	bool "Microchip RV64 implementation"
	select RISCV
	select SOC_FAMILY_RISCV_PRIVILEGE
	help
	  Enable support for Microchip RISCV 64bit
```

## soc/riscv/riscv-privilege/mpfs/Kconfig.soc
```kconfig
# RISCV64_MIV Microchip Polarfire SOC configuration options

# Copyright (c) 2020-2021 Microchip Technology Inc
# SPDX-License-Identifier: Apache-2.0

choice
	prompt "Microchip Polarfire SOC implementation"
	depends on SOC_SERIES_RISCV64_MIV

config SOC_MPFS
	bool "Microchip MPFS system implementation"
	select ATOMIC_OPERATIONS_BUILTIN
	select RISCV_GP
	select USE_SWITCH_SUPPORTED
	select USE_SWITCH
	select CPU_HAS_FPU
	select SCHED_IPI_SUPPORTED
	select RISCV_ISA_RV64I
	select RISCV_ISA_EXT_M
	select RISCV_ISA_EXT_A
	select RISCV_ISA_EXT_C

endchoice

config MPFS_HAL
	depends on SOC_MPFS
	bool "Microchip Polarfire SOC hardware abstracton layer"
	select HAS_MPFS_HAL
```

## soc/riscv/riscv-privilege/neorv32/Kconfig.soc
```kconfig
# Copyright (c) 2021 Henrik Brix Andersen <henrik@brixandersen.dk>
# SPDX-License-Identifier: Apache-2.0

choice
	prompt "NEORV32 Version"
	depends on SOC_SERIES_NEORV32

config SOC_NEORV32_V1_6_1
	bool "v1.6.1"
	# NEORV32 RISC-V ISA A extension implements only LR/SC, not AMO
	select ATOMIC_OPERATIONS_C

endchoice

if SOC_SERIES_NEORV32

config SOC_NEORV32_VERSION
	hex
	default 0x01060100 if SOC_NEORV32_V1_6_1
	help
	  The targeted NEORV32 version as BCD-coded number. The format is
	  identical to that of the NEORV32 Machine implementation ID (mimpid)
	  register.

config SOC_NEORV32_ISA_C
	bool "RISC-V ISA Extension \"C\""
	select RISCV_ISA_EXT_C
	help
	  Enable this if the NEORV32 CPU implementation supports the RISC-V ISA
	  "C" extension (Compressed Instructions).

endif # SOC_SERIES_NEORV32
```

## soc/riscv/riscv-privilege/niosv/Kconfig.series
```kconfig
# Copyright (C) 2023, Intel Corporation
# SPDX-License-Identifier: Apache-2.0

config SOC_SERIES_NIOSV
	bool "INTEL FPGA NIOSV"
	select RISCV
	select SOC_FAMILY_RISCV_PRIVILEGE
	help
	  Enable support for the INTEL FPGA NIOSV.
```

## soc/riscv/riscv-privilege/noel/Kconfig.defconfig.series
```kconfig
# Copyright (c) 2020 Cobham Gaisler AB
# SPDX-License-Identifier: Apache-2.0

if SOC_SERIES_RISCV_NOEL

config SOC_SERIES
	default "noel"

config SYS_CLOCK_HW_CYCLES_PER_SEC
	default 20000000

config RISCV_SOC_INTERRUPT_INIT
	default y

config RISCV_HAS_PLIC
	default y

config 2ND_LVL_ISR_TBL_OFFSET
	default 12

config 2ND_LVL_INTR_00_OFFSET
	default 11

config MAX_IRQ_PER_AGGREGATOR
	default 30

config NUM_IRQS
	default 42

config DYNAMIC_INTERRUPTS
	default y

endif
```

## soc/riscv/riscv-privilege/noel/Kconfig.series
```kconfig
# Copyright (c) 2020 Cobham Gaisler AB
# SPDX-License-Identifier: Apache-2.0

config SOC_SERIES_RISCV_NOEL
	bool "NOEL-V"
	select RISCV
	select SOC_FAMILY_RISCV_PRIVILEGE
	help
	  Enable support for Cobham Gaisler NOEL-V
```

## soc/riscv/riscv-privilege/noel/Kconfig.soc
```kconfig
# Copyright (c) 2020 Cobham Gaisler AB
# SPDX-License-Identifier: Apache-2.0

choice
	prompt "NOEL-V system implementation"
	depends on SOC_SERIES_RISCV_NOEL

config SOC_RISCV_NOEL
	bool "NOEL-V system implementation"
	select ATOMIC_OPERATIONS_C

endchoice
```

## soc/riscv/riscv-privilege/opentitan/Kconfig.defconfig.series
```kconfig
# Copyright (c) 2023 Rivos Inc.
# SPDX-License-Identifier: Apache-2.0

if SOC_SERIES_RISCV_OPENTITAN

config SOC_SERIES
	default "opentitan"

config SYS_CLOCK_HW_CYCLES_PER_SEC
	default 1000000

config RISCV_SOC_INTERRUPT_INIT
	default y

config RISCV_HAS_CPU_IDLE
	default y

config RISCV_HAS_PLIC
	default y

config RISCV_GP
	default y

config 2ND_LVL_ISR_TBL_OFFSET
	default 32

config NUM_IRQS
	default 216

endif # SOC_SERIES_RISCV_OPENTITAN
```

## soc/riscv/riscv-privilege/opentitan/Kconfig.series
```kconfig
# Copyright (c) 2023 Rivos Inc.
# SPDX-License-Identifier: Apache-2.0

config SOC_SERIES_RISCV_OPENTITAN
	bool "OpenTitan implementation"
	select RISCV
	select SOC_FAMILY_RISCV_PRIVILEGE
	# OpenTitan Ibex core mtvec mode is read-only / forced to vectored mode.
	select RISCV_MTVEC_VECTORED_MODE
	select GEN_IRQ_VECTOR_TABLE
	help
	  Enable support for OpenTitan
```

## soc/riscv/riscv-privilege/opentitan/Kconfig.soc
```kconfig
# Copyright (c) 2023 Rivos Inc.
# SPDX-License-Identifier: Apache-2.0

choice
	prompt "OpenTitan implementation"
	depends on SOC_SERIES_RISCV_OPENTITAN

config SOC_RISCV_OPENTITAN
	bool "OpenTitan implementation"
	select ATOMIC_OPERATIONS_C
	select INCLUDE_RESET_VECTOR
	select RISCV_ISA_RV32I
	select RISCV_ISA_EXT_M
	select RISCV_ISA_EXT_C
	select RISCV_ISA_EXT_ZICSR
	select RISCV_ISA_EXT_ZIFENCEI
	select RISCV_ISA_EXT_ZBA
	select RISCV_ISA_EXT_ZBB
	select RISCV_ISA_EXT_ZBC
	select RISCV_ISA_EXT_ZBS

endchoice
```

## soc/riscv/riscv-privilege/qemu_virt/Kconfig.series
```kconfig
# SPDX-License-Identifier: Apache-2.0

config SOC_SERIES_RISCV_QEMU_VIRT
	bool "QEMU Virt Machine implementation"
	select RISCV
	select SOC_FAMILY_RISCV_PRIVILEGE
	help
	  Enable support for QEMU RISCV VIRT SoC
```

## soc/riscv/riscv-privilege/qemu_virt/Kconfig.soc
```kconfig
# SPDX-License-Identifier: Apache-2.0

choice
	prompt "QEMU Virt Machine implementation"
	depends on SOC_SERIES_RISCV_QEMU_VIRT

config SOC_RISCV_QEMU_VIRT
	bool "QEMU Virt Machine implementation"
	select ATOMIC_OPERATIONS_BUILTIN if SMP
	select ATOMIC_OPERATIONS_C if !SMP
	select CPU_HAS_FPU_DOUBLE_PRECISION

endchoice
```

## soc/riscv/riscv-privilege/rv32-virt/Kconfig.defconfig.series
```kconfig
# Copyright (c) 2020 Katsuhiro Suzuki
# SPDX-License-Identifier: Apache-2.0

if SOC_SERIES_QEMU_RV32_VIRT

config SOC_SERIES
	default "rv32-virt"

config RISCV_HAS_PLIC
	default n

config NUM_IRQS
	default 16

config XIP
	default n

endif #SOC_SERIES_QEMU_RV32_VIRT
```

## soc/riscv/riscv-privilege/rv32-virt/Kconfig.series
```kconfig
# QEMU_RV32_VIRT SOC implementation

# Copyright (c) 2020 Katsuhiro Suzuki
# SPDX-License-Identifier: Apache-2.0

config SOC_SERIES_QEMU_RV32_VIRT
	bool "QEMU RV32 virt series SOC implementation"
	select RISCV
	select SOC_FAMILY_RISCV_PRIVILEGE
	help
	  Enable support for QEMU RV32 virt series SOC
```

## soc/riscv/riscv-privilege/rv32-virt/Kconfig.soc
```kconfig
# QEMU_RV32_VIRT SOC configuration options

# Copyright (c) 2020 Katsuhiro Suzuki
# SPDX-License-Identifier: Apache-2.0

choice
	prompt "QEMU RV32 virt series SOC implementation"
	depends on SOC_SERIES_QEMU_RV32_VIRT

config SOC_QEMU_RV32_VIRT
	bool "QEMU RV32 virt SOC implementation"
	select ATOMIC_OPERATIONS_C if !SMP
	select ATOMIC_OPERATIONS_BUILTIN if SMP

endchoice
```

## soc/riscv/riscv-privilege/rv64-virt/Kconfig.series
```kconfig
# QEMU_RV64_VIRT SOC implementation

# Copyright (c) 2020 Katsuhiro Suzuki
# SPDX-License-Identifier: Apache-2.0

config SOC_SERIES_QEMU_RV64_VIRT
	bool "QEMU RV64 virt series SOC implementation"
	select RISCV
	select SOC_FAMILY_RISCV_PRIVILEGE
	help
	  Enable support for QEMU RV64 virt series SOC
```

## soc/riscv/riscv-privilege/rv64-virt/Kconfig.soc
```kconfig
# QEMU_RV64_VIRT SOC configuration options

# Copyright (c) 2020 Katsuhiro Suzuki
# SPDX-License-Identifier: Apache-2.0

choice
	prompt "QEMU RV64 virt series SOC implementation"
	depends on SOC_SERIES_QEMU_RV64_VIRT

config SOC_QEMU_RV64_VIRT
	bool "QEMU RV64 virt SOC implementation"
	select ATOMIC_OPERATIONS_C if !SMP
	select ATOMIC_OPERATIONS_BUILTIN if SMP

endchoice
```
