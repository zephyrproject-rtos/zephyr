## soc/riscv/intel_niosv/Kconfig.defconfig
```kconfig
# Copyright (c) 2024 Nordic Semiconductor ASA
# SPDX-License-Identifier: Apache-2.0

source "soc/riscv/intel_niosv/*/Kconfig.defconfig.series"
```

## soc/riscv/ite_ec/Kconfig
```kconfig
# Copyright (c) 2020 ITE Corporation. All Rights Reserved.
# SPDX-License-Identifier: Apache-2.0

config SOC_FAMILY_ITE_EC
	bool
	help
	  ITE Embedded Controller SoC family

if SOC_FAMILY_ITE_EC

config SOC_FAMILY
	string
	default "ite_ec"

source "soc/riscv/ite_ec/*/Kconfig.soc"

endif # SOC_FAMILY_ITE_EC
```

## soc/riscv/ite_ec/Kconfig.defconfig
```kconfig
# Copyright (c) 2020 ITE Corporation. All Rights Reserved.
# SPDX-License-Identifier: Apache-2.0

source "soc/riscv/ite_ec/*/Kconfig.defconfig.series"
```

## soc/riscv/ite_ec/it8xxx2/Kconfig.defconfig.it81302bx
```kconfig
# Copyright (c) 2022 ITE Corporation.
# SPDX-License-Identifier: Apache-2.0

if SOC_IT81302_BX

config SOC
	default "it81302bx"

config SOC_IT8XXX2_GPIO_GROUP_K_L_DEFAULT_PULL_DOWN
	default n

endif
```

## soc/riscv/ite_ec/it8xxx2/Kconfig.defconfig.it82302ax
```kconfig
# Copyright (c) 2023 ITE Corporation.
# SPDX-License-Identifier: Apache-2.0

if SOC_IT82302_AX

config SOC
	default "it82302ax"

endif
```

## soc/riscv/litex-vexriscv/Kconfig.defconfig
```kconfig
# Copyright (c) 2018 - 2019 Antmicro <www.antmicro.com>
# SPDX-License-Identifier: Apache-2.0

if SOC_RISCV32_LITEX_VEXRISCV

config SOC
	default "litex-vexriscv"

config SYS_CLOCK_HW_CYCLES_PER_SEC
	default 100000000

config RISCV_HAS_CPU_IDLE
	bool

config RISCV_HAS_PLIC
	bool

config NUM_IRQS
	default 12

endif # SOC_RISCV32_LITEX_VEXRISCV
```

## soc/riscv/litex-vexriscv/Kconfig.soc
```kconfig
# Copyright (c) 2018 - 2019 Antmicro <www.antmicro.com>
# SPDX-License-Identifier: Apache-2.0

config SOC_RISCV32_LITEX_VEXRISCV
	bool "LiteX VexRiscv system implementation"
	select RISCV
	select ATOMIC_OPERATIONS_C
	select INCLUDE_RESET_VECTOR

if SOC_RISCV32_LITEX_VEXRISCV

config LITEX_CSR_DATA_WIDTH
	int "Select Control/Status register width"
	default 32

endif # SOC_RISCV32_LITEX_VEXRISCV
```

## soc/riscv/litex_vexriscv/Kconfig.defconfig
```kconfig
# Copyright (c) 2018 - 2019 Antmicro <www.antmicro.com>
# SPDX-License-Identifier: Apache-2.0

if SOC_RISCV32_LITEX_VEXRISCV

config SOC
	default "litex_vexriscv"

config SYS_CLOCK_HW_CYCLES_PER_SEC
	default 100000000

config NUM_IRQS
	default 12

endif # SOC_RISCV32_LITEX_VEXRISCV
```

## soc/riscv/microchip_miv/Kconfig
```kconfig
# Copyright (c) 2024 Nordic Semiconductor ASA
# SPDX-License-Identifier: Apache-2.0

config SOC_FAMILY_MICROCHIP_MIV
	bool

if SOC_FAMILY_MICROCHIP_MIV

config SOC_FAMILY
	string
	default "microchip_miv"

source "soc/riscv/microchip_miv/*/Kconfig.soc"

endif # SOC_FAMILY_MICROCHIP_MIV
```

## soc/riscv/microchip_miv/Kconfig.defconfig
```kconfig
# Copyright (c) 2024 Nordic Semiconductor ASA
# SPDX-License-Identifier: Apache-2.0

source "soc/riscv/microchip_miv/*/Kconfig.defconfig.series"
```

## soc/riscv/microchip_miv/miv/Kconfig.series
```kconfig
# RISCV32_MIV implementation

# Copyright (c) 2018 Antmicro <www.antmicro.com>
# SPDX-License-Identifier: Apache-2.0

config SOC_SERIES_MIV
	bool "Microchip Mi-V implementation"
	select SOC_FAMILY_MICROCHIP_MIV
	select RISCV
	select RISCV_PRIVILEGED
	select RISCV_HAS_PLIC
	help
	  Enable support for Microchip Mi-V
```

## soc/riscv/microchip_miv/polarfire/Kconfig.series
```kconfig
# RISCV64_MIV implementation

# Copyright (c) 2018 Antmicro <www.antmicro.com>
# SPDX-License-Identifier: Apache-2.0

config SOC_SERIES_POLARFIRE
	bool "Microchip RV64 implementation"
	select SOC_FAMILY_MICROCHIP_MIV
	select RISCV
	select RISCV_PRIVILEGED
	select RISCV_HAS_PLIC
	help
	  Enable support for Microchip RISCV 64bit
```

## soc/riscv/nordic_nrf/Kconfig
```kconfig
# Copyright (c) 2024 Nordic Semiconductor ASA
# SPDX-License-Identifier: Apache-2.0

config SOC_FAMILY_NRF
	bool

if SOC_FAMILY_NRF

config SOC_FAMILY
	string
	default "nordic_nrf"

source "soc/riscv/nordic_nrf/common/Kconfig"

source "soc/common/nordic_nrf/Kconfig.peripherals"
source "soc/riscv/nordic_nrf/*/Kconfig.soc"

endif # SOC_FAMILY_NRF
```

## soc/riscv/nordic_nrf/Kconfig.defconfig
```kconfig
# Copyright (c) 2024 Nordic Semiconductor ASA
# SPDX-License-Identifier: Apache-2.0

if SOC_FAMILY_NRF

source "soc/riscv/nordic_nrf/common/Kconfig.defconfig"

endif # SOC_FAMILY_NRF
```

## soc/riscv/nordic_nrf/common/Kconfig
```kconfig
# Copyright (c) 2024 Nordic Semiconductor ASA
# SPDX-License-Identifier: Apache-2.0

source "soc/riscv/nordic_nrf/common/vpr/Kconfig"
```

## soc/riscv/nordic_nrf/common/Kconfig.defconfig
```kconfig
# Copyright (c) 2024 Nordic Semiconductor ASA
# SPDX-License-Identifier: Apache-2.0

if RISCV_CORE_NORDIC_VPR

source "soc/riscv/nordic_nrf/common/vpr/Kconfig.defconfig"

endif # RISCV_CORE_NORDIC_VPR
```

## soc/riscv/nordic_nrf/nrf54h/Kconfig.defconfig.series
```kconfig
# Copyright (c) 2024 Nordic Semiconductor ASA
# SPDX-License-Identifier: Apache-2.0

if SOC_SERIES_NRF54HX

rsource "Kconfig.defconfig.nrf54h*"

config SOC_SERIES
	default "nrf54h"

DT_CHOSEN_Z_SRAM = zephyr,sram
DT_CHOSEN_Z_CODE = zephyr,code-partition

config BUILD_OUTPUT_ADJUST_LMA
	depends on !XIP
	default "$(dt_chosen_partition_addr_hex,$(DT_CHOSEN_Z_CODE)) - \
		 $(dt_chosen_reg_addr_hex,$(DT_CHOSEN_Z_SRAM))"

endif # SOC_SERIES_NRF54HX
```

## soc/riscv/nordic_nrf/nrf54h/Kconfig.series
```kconfig
# Copyright (c) 2024 Nordic Semiconductor ASA
# SPDX-License-Identifier: Apache-2.0

config SOC_SERIES_NRF54HX
	bool "Nordic Semiconductor nRF54H series MCU"
	select SOC_FAMILY_NRF
	select HAS_NRFX
	select HAS_NORDIC_DRIVERS
	help
	  Enable support for nRF54H MCU series
```

## soc/riscv/openisa_rv32m1/Kconfig
```kconfig
# Copyright (c) 2018 Foundries.io Ltd
# SPDX-License-Identifier: Apache-2.0

# The OpenISA RV32M1 SoC directory in riscv supports the RISC-V
# cores on OpenISA RV32M1 SoCs.
#
# The Zephyr "soc" abstraction isn't a great fit here. These SoCs (in
# the strict physical sense of "systems on chip") also contain Arm
# cores, so this type of "soc" doesn't really belong to a single "arch".
#
# However, due to constraints imposed by Zephyr's file hierarchy
# conventions, those "other" cores would need to be supported under a
# different soc subdirectory, e.g. soc/arm instead of soc/riscv.

choice
	prompt "OpenISA RV32M1 RISC-V Core Selection"
	depends on SOC_OPENISA_RV32M1_RISCV32

config SOC_OPENISA_RV32M1_RI5CY
	bool "OpenISA RV32M1 RI5CY core"

config SOC_OPENISA_RV32M1_ZERO_RISCY
	bool "OpenISA RV32M1 ZERO-RISCY core"

endchoice
```

## soc/riscv/openisa_rv32m1/Kconfig.defconfig
```kconfig
# RV32M1 SoC RISC-V core default configuration values

# Copyright (c) 2018 Foundries.io Ltd
# SPDX-License-Identifier: Apache-2.0

if SOC_OPENISA_RV32M1_RISCV32

config SOC
	default "openisa_rv32m1"

# 32 from event unit + 32 * (1 + max enabled INTMUX channel)
config NUM_IRQS
	default 288 if RV32M1_INTMUX_CHANNEL_7
	default 256 if RV32M1_INTMUX_CHANNEL_6
	default 224 if RV32M1_INTMUX_CHANNEL_5
	default 192 if RV32M1_INTMUX_CHANNEL_4
	default 160 if RV32M1_INTMUX_CHANNEL_3
	default 128 if RV32M1_INTMUX_CHANNEL_2
	default 96 if RV32M1_INTMUX_CHANNEL_1
	default 64 if RV32M1_INTMUX_CHANNEL_0
	default 32

config RISCV_GENERIC_TOOLCHAIN
	default y if "$(ZEPHYR_TOOLCHAIN_VARIANT)" = "zephyr"
	default n

config RISCV_SOC_CONTEXT_SAVE
	default y if SOC_OPENISA_RV32M1_RI5CY

config RISCV_SOC_OFFSETS
	default y

config RISCV_SOC_INTERRUPT_INIT
	default y

# We need to disable the watchdog out of reset, as it's enabled by
# default. Use the WDOG_INIT hook for doing that.
config WDOG_INIT
	def_bool y

config SYS_CLOCK_HW_CYCLES_PER_SEC
	default 8000000

if MULTI_LEVEL_INTERRUPTS

config MAX_IRQ_PER_AGGREGATOR
	default 32

config LEVEL_2_INTERRUPTS
	default y

config LVL_2_ISR_TBL_OFFSET
	default 32

config NUM_LEVEL_2_AGGREGATORS
	default 8 if RV32M1_INTMUX_CHANNEL_7
	default 7 if RV32M1_INTMUX_CHANNEL_6
	default 6 if RV32M1_INTMUX_CHANNEL_5
	default 5 if RV32M1_INTMUX_CHANNEL_4
	default 4 if RV32M1_INTMUX_CHANNEL_3
	default 3 if RV32M1_INTMUX_CHANNEL_2
	default 2 if RV32M1_INTMUX_CHANNEL_1
	default 1		# just channel 0

config LVL_2_INTR_00_OFFSET
	default 24

config LVL_2_INTR_01_OFFSET
	int
	default 25

config LVL_2_INTR_02_OFFSET
	int
	default 26

config LVL_2_INTR_03_OFFSET
	int
	default 27

config LVL_2_INTR_04_OFFSET
	int
	default 28

config LVL_2_INTR_05_OFFSET
	int
	default 29

config LVL_2_INTR_06_OFFSET
	int
	default 30

config LVL_2_INTR_07_OFFSET
	int
	default 31

config RV32M1_INTMUX_CHANNEL_0
	default y

config RV32M1_INTMUX_CHANNEL_1
	default y

config RV32M1_INTMUX_CHANNEL_2
	default y

config RV32M1_INTMUX_CHANNEL_3
	default y

config RV32M1_INTMUX_CHANNEL_4
	default y

config RV32M1_INTMUX_CHANNEL_5
	default y

config RV32M1_INTMUX_CHANNEL_6
	default y

config RV32M1_INTMUX_CHANNEL_7
	default y

endif # MULTI_LEVEL_INTERRUPTS

endif # SOC_OPENISA_RV32M1_RISCV32
```

## soc/riscv/openisa_rv32m1/Kconfig.soc
```kconfig
# Copyright (c) 2018 Foundries.io Ltd
# SPDX-License-Identifier: Apache-2.0

config SOC_OPENISA_RV32M1_RISCV32
	bool "OpenISA RV32M1 RISC-V cores"
	select RISCV
	# The following select is due to limitations in the linker script.
	# (We can't make it a 'depends on' without causing a dependency loop).
	select XIP
	select HAS_RV32M1_LPUART
	select HAS_RV32M1_LPI2C
	select HAS_RV32M1_LPSPI
	select HAS_RV32M1_TPM
	select ATOMIC_OPERATIONS_C
	select VEGA_SDK_HAL
	select RISCV_SOC_INTERRUPT_INIT
	select CLOCK_CONTROL
	select HAS_RV32M1_FTFX
	select HAS_FLASH_LOAD_OFFSET
	select BUILD_OUTPUT_HEX
	select RISCV_ISA_RV32I
	select RISCV_ISA_EXT_M
	select RISCV_ISA_EXT_A
	select RISCV_ISA_EXT_ZICSR
	select RISCV_ISA_EXT_ZIFENCEI
	help
	  Enable support for OpenISA RV32M1 RISC-V processors. Choose
	  this option to target the RI5CY or ZERO-RISCY core. This
	  option should not be used to target either Arm core.
```

## soc/riscv/qemu_virt_riscv/Kconfig
```kconfig
# Copyright (c) 2024 Antmicro <www.antmicro.com>
# SPDX-License-Identifier: Apache-2.0

config SOC_FAMILY_QEMU_VIRT_RISCV
	select ATOMIC_OPERATIONS_BUILTIN
	select INCLUDE_RESET_VECTOR
	select RISCV_ISA_EXT_M
	select RISCV_ISA_EXT_A
	select RISCV_ISA_EXT_C
	select RISCV
	select RISCV_PRIVILEGED
	select RISCV_HAS_PLIC

if SOC_FAMILY_QEMU_VIRT_RISCV

rsource "*/Kconfig"

endif # SOC_FAMILY_QEMU_VIRT_RISCV
```

## soc/riscv/qemu_virt_riscv/qemu_virt_riscv32/Kconfig
```kconfig
# Copyright (c) 2024 Antmicro <www.antmicro.com>
# SPDX-License-Identifier: Apache-2.0

config SOC_QEMU_VIRT_RISCV32
	select CPU_HAS_FPU
	select RISCV_ISA_RV32I
	select RISCV_ISA_EXT_ZICSR
	select RISCV_ISA_EXT_ZIFENCEI
```

## soc/riscv/qemu_virt_riscv/qemu_virt_riscv64/Kconfig
```kconfig
# Copyright (c) 2024 Antmicro <www.antmicro.com>
# SPDX-License-Identifier: Apache-2.0

config SOC_QEMU_VIRT_RISCV64
	select 64BIT
	select CPU_HAS_FPU_DOUBLE_PRECISION
	select RISCV_ISA_RV64I
	select RISCV_ISA_EXT_ZICSR
	select RISCV_ISA_EXT_ZIFENCEI
```

## soc/riscv/renode_virt/Kconfig.defconfig
```kconfig
# Copyright (c) 2023 Meta
# SPDX-License-Identifier: Apache-2.0

if SOC_RISCV32_VIRTUAL_RENODE

config SOC
	default "renode_virt"

config SYS_CLOCK_HW_CYCLES_PER_SEC
	default 4000000

config RISCV_SOC_INTERRUPT_INIT
	default y

config RISCV_GP
	default y

config 1ST_LEVEL_INTERRUPT_BITS
	default 4

config NUM_2ND_LEVEL_AGGREGATORS
	default 2

config 2ND_LEVEL_INTERRUPT_BITS
	default 11

config 2ND_LVL_ISR_TBL_OFFSET
	default 12

config 2ND_LVL_INTR_00_OFFSET
	default 11

config 2ND_LVL_INTR_01_OFFSET
	default 4

config MAX_IRQ_PER_AGGREGATOR
	default 1023

config NUM_IRQS
	default 2058

endif # SOC_RISCV32_VIRTUAL_RENODE
```
