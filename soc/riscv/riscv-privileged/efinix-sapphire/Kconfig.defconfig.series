## soc/riscv/riscv-privileged/efinix-sapphire/Kconfig.defconfig.series
```kconfig
# Copyright (c) 2023 Efinix Inc.
# SPDX-License-Identifier: Apache-2.0

if SOC_SERIES_EFINIX_SAPPHIRE

config SOC_SERIES
	default "efinix-sapphire"

config SYS_CLOCK_HW_CYCLES_PER_SEC
	default 100000000

config RISCV_HAS_CPU_IDLE
	bool

config RISCV_SOC_INTERRUPT_INIT
	bool
	default y

config RISCV_HAS_PLIC
	bool
	default y

config NUM_IRQS
	int
	default 36

config 2ND_LVL_INTR_00_OFFSET
	default 11

endif # SOC_SERIES_EFINIX_SAPPHIRE
```

## soc/riscv/riscv-privileged/efinix-sapphire/Kconfig.series
```kconfig
# Copyright (c) 2023 Efinix Inc.
# SPDX-License-Identifier: Apache-2.0

config SOC_SERIES_EFINIX_SAPPHIRE
	bool "Efinix Sapphire SOC implementation"
	select RISCV
	select SOC_FAMILY_RISCV_PRIVILEGED
	help
	  Enable support for Efinix Sapphire SOC implementation
```

## soc/riscv/riscv-privileged/efinix-sapphire/Kconfig.soc
```kconfig
# Copyright (c) 2023 Efinix Inc.
# SPDX-License-Identifier: Apache-2.0

choice
	prompt "Efinix SoC selection"
	depends on SOC_SERIES_EFINIX_SAPPHIRE

config SOC_RISCV32_EFINIX_SAPPHIRE
	bool "Efinix Sapphire VexRiscv system implementation"
	select ATOMIC_OPERATIONS_BUILTIN
	select INCLUDE_RESET_VECTOR
	select RISCV_ISA_RV32I
	select RISCV_ISA_EXT_M
	select RISCV_ISA_EXT_A
	select RISCV_ISA_EXT_ZICSR
	select RISCV_ISA_EXT_ZIFENCEI

endchoice
```

## soc/riscv/riscv-privileged/gd32vf103/Kconfig.defconfig.series
```kconfig
# Copyright (c) 2021 Tokita, Hiroshi <tokita.hiroshi@gmail.com>
# SPDX-License-Identifier: Apache-2.0

if SOC_SERIES_GD32VF103

source "soc/riscv/riscv-privileged/gd32vf103/Kconfig.defconfig.gd32vf103*"

config SOC_SERIES
	default "gd32vf103"

endif # SOC_SERIES_GD32VF103
```

## soc/riscv/riscv-privileged/gd32vf103/Kconfig.series
```kconfig
# GD32VF103 SOC implementation

# Copyright (c) 2021 Tokita, Hiroshi <tokita.hiroshi@gmail.com>
# SPDX-License-Identifier: Apache-2.0

config SOC_SERIES_GD32VF103
	bool "GigaDevice GD32VF103 series SoC implementation"
	select RISCV
	select SOC_FAMILY_RISCV_PRIVILEGED
	select ATOMIC_OPERATIONS_C
	select INCLUDE_RESET_VECTOR
	select BUILD_OUTPUT_HEX
	select XIP
	select GD32_HAS_AFIO_PINMUX
	select GD32_HAS_IRC_40K
	select HAS_GD32_HAL
	select RISCV_HAS_CLIC

	help
	  Enable support for GigaDevice GD32VF1 series SoC
```

## soc/riscv/riscv-privileged/hpmicro/Kconfig.series
```kconfig
# Copyright (c) 2022 HPMicro
# SPDX-License-Identifier: Apache-2.0

config SOC_SERIES_HPMICRO
	bool "HPMicro HPM6700_6400 Series"
	select RISCV
	select SOC_FAMILY_RISCV_PRIVILEGED
	select HAS_HPMICRO_HAL
	help
	  Enable support for HPMicro HPM6700_6400 series SoC
```

## soc/riscv/riscv-privileged/miv/Kconfig.soc
```kconfig
# RISCV32_MIV configuration options

# Copyright (c) 2018 Antmicro <www.antmicro.com>
# SPDX-License-Identifier: Apache-2.0

choice
	prompt "Microchip Mi-V system implementation"
	depends on SOC_SERIES_RISCV32_MIV

config SOC_RISCV32_MIV
	bool "Microchip Mi-V system implementation"
	select ATOMIC_OPERATIONS_BUILTIN
	select INCLUDE_RESET_VECTOR
	select RISCV_ISA_RV32I
	select RISCV_ISA_EXT_M
	select RISCV_ISA_EXT_A
	select RISCV_ISA_EXT_ZICSR
	select RISCV_ISA_EXT_ZIFENCEI

endchoice
```

## soc/riscv/riscv-privileged/neorv32/Kconfig.series
```kconfig
# Copyright (c) 2021 Henrik Brix Andersen <henrik@brixandersen.dk>
# SPDX-License-Identifier: Apache-2.0

config SOC_SERIES_NEORV32
	bool "NEORV32 Processor"
	select RISCV
	select RISCV_ISA_RV32I
	select RISCV_ISA_EXT_M
	select RISCV_ISA_EXT_A
	select RISCV_ISA_EXT_ZICSR
	select RISCV_ISA_EXT_ZIFENCEI
	select SOC_FAMILY_RISCV_PRIVILEGED
	help
	  Enable support for the NEORV32 Processor (SoC).

	  The NEORV32 CPU implementation must have the following RISC-V ISA
	  extensions enabled in order to support Zephyr:
	  - M (Integer Multiplication and Division)
	  - Zicsr (Control and Status Register (CSR) Instructions)

	  The following NEORV32 CPU ISA extensions are not currently supported
	  by Zephyr and can safely be disabled:
	  - A (Atomic Instructions)
	  - E (Embedded, only 16 integer registers)
	  - Zbb (Basic Bit Manipulation)
	  - Zfinx (Floating Point in Integer Registers)
```

## soc/riscv/riscv-privileged/niosv/Kconfig.defconfig.series
```kconfig
# Copyright (C) 2023, Intel Corporation
# SPDX-License-Identifier: Apache-2.0

if SOC_SERIES_NIOSV

config SOC_SERIES
	default "niosv"

config SYS_CLOCK_HW_CYCLES_PER_SEC
	default $(dt_node_int_prop_int,/cpus/cpu@0,clock-frequency)

config NUM_IRQS # Platform interrupts IRQs index start from index 16
	default 32

config RISCV_HAS_CPU_IDLE
	default y

config RISCV_GP
	default y

config RISCV_SOC_INTERRUPT_INIT
	default y

endif # SOC_SERIES_NIOSV
```

## soc/riscv/riscv-privileged/niosv/Kconfig.soc
```kconfig
# Copyright (C) 2023, Intel Corporation
# SPDX-License-Identifier: Apache-2.0

choice
	prompt "FPGA NIOSV"
	depends on SOC_SERIES_NIOSV

config SOC_NIOSV_M
	bool "Intel FPGA NIOSV Microcontroller Core Processor"
	select ATOMIC_OPERATIONS_BUILTIN
	select INCLUDE_RESET_VECTOR
	select RISCV_ISA_RV32I
	select RISCV_ISA_EXT_A
	select RISCV_ISA_EXT_ZICSR
	select RISCV_ISA_EXT_ZIFENCEI

config SOC_NIOSV_G
	bool "Intel FPGA NIOSV General Purpose Processor"
	select ATOMIC_OPERATIONS_BUILTIN
	select INCLUDE_RESET_VECTOR
	select RISCV_ISA_RV32I
	select RISCV_ISA_EXT_A
	select RISCV_ISA_EXT_M
	select RISCV_ISA_EXT_ZICSR
	select RISCV_ISA_EXT_ZIFENCEI

endchoice
```

## soc/riscv/riscv-privileged/renode_virt/Kconfig.series
```kconfig
# Copyright (c) 2023 Meta
# SPDX-License-Identifier: Apache-2.0

config SOC_SERIES_RISCV32_VIRTUAL_RENODE
	bool "Renode RISC-V32 Virtual SoC implementation"
	select RISCV
	select SOC_FAMILY_RISCV_PRIVILEGED
	help
	  Enable support for Renode RISC-V Virtual
```

## soc/riscv/riscv-privileged/shakti-vajra/Kconfig.defconfig.series
```kconfig
if SOC_SERIES_RISCV64_SHAKTI

config SOC_SERIES
	default "shakti-vajra" if SOC_RISCV64_SHAKTI
	depends on SOC_RISCV64_SHAKTI

config SYS_CLOCK_HW_CYCLES_PER_SEC
	default 100000000

config RISCV_SOC_INTERRUPT_INIT
	bool
	default y

config RISCV_HAS_CPU_IDLE
	bool
	default y

config NUM_IRQS
	int
	default 32

config RISCV_RAM_BASE_ADDR
	hex
	default	0x80000000

config RISCV_RAM_SIZE
	hex
	default 0x10000000

config RISCV_HAS_PLIC
	default y

config ATOMIC_OPERATIONS_C
	default y

endif
```

## soc/riscv/riscv-privileged/shakti-vajra/Kconfig.soc
```kconfig
# Kconfig - RISCV64 SHAKTI-VAJRA SOC configuration options
#
# SPDX-License-Identifier: Apache-2.0
#

choice
prompt "Shakti Vajra SOC implementation"
depends on SOC_SERIES_RISCV64_SHAKTI

config SOC_RISCV64_SHAKTI
	bool "Shakti Vajra SOC implementation"
	select ATOMIC_OPERATIONS_ARCH
	select ATOMIC_OPERATIONS_BUILTIN
	select RISCV_ISA_EXT_M
    select RISCV_ISA_EXT_A
    select RISCV_ISA_EXT_C
	select INCLUDE_RESET_VECTOR
endchoice
```

## soc/riscv/riscv-privileged/starfive_jh71xx/Kconfig.series
```kconfig
# Copyright (c) 2021 Rajnesh Kanwal <rajnesh.kanwal49@gmail.com>
# SPDX-License-Identifier: Apache-2.0

config SOC_SERIES_STARFIVE_JH71XX
	bool "Starfive JH71XX series"
	select RISCV
	select SOC_FAMILY_RISCV_PRIVILEGED
	help
	  Enable support for Starfive JH71XX SoC Series.
```

## soc/riscv/riscv-privileged/starfive_jh71xx/Kconfig.soc
```kconfig
# Copyright (c) 2021 Rajnesh Kanwal <rajnesh.kanwal49@gmail.com>
# SPDX-License-Identifier: Apache-2.0

choice
	prompt "Starfive JH7100 SoC"
	depends on SOC_SERIES_STARFIVE_JH71XX

config SOC_JH7100
	bool "Starfive JH7100"
	select ATOMIC_OPERATIONS_BUILTIN
	select INCLUDE_RESET_VECTOR
	select RISCV_ISA_RV64I
	select RISCV_ISA_EXT_M
	select RISCV_ISA_EXT_A
	select RISCV_ISA_EXT_C
	select RISCV_ISA_EXT_ZICSR
	select RISCV_ISA_EXT_ZIFENCEI

endchoice
```

## soc/riscv/riscv-privileged/virt/Kconfig.series
```kconfig
# Copyright (c) 2020 Cobham Gaisler AB
# SPDX-License-Identifier: Apache-2.0

config SOC_SERIES_RISCV_VIRT
	bool "QEMU RISC-V VirtIO Board"
	select RISCV
	select SOC_FAMILY_RISCV_PRIVILEGED
```

## soc/riscv/riscv-privileged/wch_ch32v/Kconfig.defconfig.ch56x
```kconfig
# Copyright (c) 2023 Chen Xingyu <hi@xingrz.me>
# SPDX-License-Identifier: Apache-2.0

if SOC_CH56X

config RISCV_WFI_ON_CPU_IDLE
	default n

config NUM_IRQS
	int
	default 256

config SYS_CLOCK_HW_CYCLES_PER_SEC
	default $(dt_node_int_prop_int,$(dt_nodelabel_path,clkmux),clock-frequency)

config CLOCK_CONTROL
	default y

endif # SOC_CH56X
```

## soc/riscv/riscv-privileged/wch_ch32v/Kconfig.defconfig.series
```kconfig
# Copyright (c) 2023 Chen Xingyu <hi@xingrz.me>
# SPDX-License-Identifier: Apache-2.0

if SOC_SERIES_CH32V

config SOC_SERIES
	default "wch_ch32v"

config RISCV_GP
	default y

source "soc/riscv/riscv-privileged/wch_ch32v/Kconfig.defconfig.ch*"

endif # SOC_SERIES_CH32V
```

## soc/riscv/riscv-privileged/wch_ch32v/Kconfig.series
```kconfig
# Copyright (c) 2023 Chen Xingyu <hi@xingrz.me>
# SPDX-License-Identifier: Apache-2.0

source "soc/riscv/riscv-privileged/wch_ch32v/Kconfig.series.*"
```

## soc/riscv/riscv-privileged/wch_ch32v/Kconfig.series.qingke_v3
```kconfig
# Copyright (c) 2023 Chen Xingyu <hi@xingrz.me>
# SPDX-License-Identifier: Apache-2.0

config SOC_SERIES_CH32V_QINGKE_V3A
	bool "WCH CH32V QingKe V3A series SoC implementation"
	select SOC_SERIES_CH32V
	select RISCV_ISA_RV32I
	select RISCV_ISA_EXT_M
	select RISCV_ISA_EXT_A
	select RISCV_ISA_EXT_C
	select RISCV_ISA_EXT_ZICSR
```

## soc/riscv/riscv-privileged/wch_ch32v/Kconfig.soc
```kconfig
# Copyright (c) 2023 Chen Xingyu <hi@xingrz.me>
# SPDX-License-Identifier: Apache-2.0

config SOC_SERIES_CH32V
	bool
	select RISCV
	select RISCV_CUSTOM_INTERRUPT_CONTROLLER
	select SOC_FAMILY_RISCV_PRIVILEGED
	select INCLUDE_RESET_VECTOR
	select ATOMIC_OPERATIONS_C

source "soc/riscv/riscv-privileged/wch_ch32v/Kconfig.soc.*"
```

## soc/riscv/riscv-privileged/wch_ch32v/Kconfig.soc.ch56x
```kconfig
# Copyright (c) 2023 Chen Xingyu <hi@xingrz.me>
# SPDX-License-Identifier: Apache-2.0

config SOC_CH56X
	bool
	depends on SOC_SERIES_CH32V_QINGKE_V3A

config SOC_CH565
	bool "WCH CH565"
	select SOC_CH56X

config SOC_CH569
	bool "WCH CH569"
	select SOC_CH56X
```

## soc/riscv/sifive_freedom/Kconfig
```kconfig
# Copyright (c) 2024 Nordic Semiconductor ASA
# SPDX-License-Identifier: Apache-2.0

config SOC_FAMILY_SIFIVE_FREEDOM
	bool

if SOC_FAMILY_SIFIVE_FREEDOM

config SOC_FAMILY
	string
	default "sifive_freedom"

source "soc/riscv/sifive_freedom/*/Kconfig.soc"

endif # SOC_FAMILY_SIFIVE_FREEDOM
```

## soc/riscv/sifive_freedom/e300/Kconfig.defconfig.e340
```kconfig
# Copyright (c) 2017 Jean-Paul Etienne <fractalclone@gmail.com>
# SPDX-License-Identifier: Apache-2.0

config SOC
	default "e340" if SOC_SIFIVE_FREEDOM_E340
```

## soc/riscv/sifive_freedom/e300/Kconfig.defconfig.series
```kconfig
# Copyright (c) 2017 Jean-Paul Etienne <fractalclone@gmail.com>
# SPDX-License-Identifier: Apache-2.0

if SOC_SERIES_SIFIVE_FREEDOM_E300

config SOC_SERIES
	default "e300"

config SYS_CLOCK_HW_CYCLES_PER_SEC
	default 32768

config RISCV_SOC_INTERRUPT_INIT
	default y

config RISCV_GP
	default y

config 2ND_LVL_ISR_TBL_OFFSET
	default 12

config 2ND_LVL_INTR_00_OFFSET
	default 11

config MAX_IRQ_PER_AGGREGATOR
	default 52

config NUM_IRQS
	default 64

source "soc/riscv/sifive_freedom/e300/Kconfig.defconfig.e*"

endif # SOC_SERIES_SIFIVE_FREEDOM_E300
```
