## soc/riscv/sifive_freedom/e300/Kconfig.series
```kconfig
# RISCV_SIFIVE_FREEDOM SOC implementation

# Copyright (c) 2017 Jean-Paul Etienne <fractalclone@gmail.com>
# SPDX-License-Identifier: Apache-2.0

config SOC_SERIES_SIFIVE_FREEDOM_E300
	bool "SiFive Freedom E300 SOC implementation"
	select RISCV
	select RISCV_PRIVILEGED
	select RISCV_HAS_PLIC
	select SOC_FAMILY_SIFIVE_FREEDOM
	help
	  Enable support for SiFive Freedom FE300 SOC
```

## soc/riscv/sifive_freedom/e300/Kconfig.soc
```kconfig
# RISCV_SIFIVE_FREEDOM SOC configuration options

# Copyright (c) 2017 Jean-Paul Etienne <fractalclone@gmail.com>
# SPDX-License-Identifier: Apache-2.0

choice
	prompt "SiFive Freedom SOC implementation"
	depends on SOC_SERIES_SIFIVE_FREEDOM_E300

config SOC_SIFIVE_FREEDOM_E340
	bool "SiFive Freedom SOC implementation"
	select ATOMIC_OPERATIONS_C
	select INCLUDE_RESET_VECTOR
	select RISCV_ISA_RV32I
	select RISCV_ISA_EXT_M
	select RISCV_ISA_EXT_A
	select RISCV_ISA_EXT_ZICSR
	select RISCV_ISA_EXT_ZIFENCEI

endchoice
```

## soc/riscv/sifive_freedom/u500/Kconfig.defconfig.u540
```kconfig
# Copyright (c) 2017 Jean-Paul Etienne <fractalclone@gmail.com>
# SPDX-License-Identifier: Apache-2.0

config SOC
	default "u540" if SOC_SIFIVE_FREEDOM_U540
```

## soc/riscv/sifive_freedom/u700/Kconfig.soc
```kconfig
# RISCV_SIFIVE_FREEDOM SOC configuration options

# Copyright (c) 2017 Jean-Paul Etienne <fractalclone@gmail.com>
# SPDX-License-Identifier: Apache-2.0

choice
	prompt "SiFive Freedom SOC implementation"
	depends on SOC_SERIES_SIFIVE_FREEDOM_U700

config SOC_SIFIVE_FREEDOM_U740
	bool "SiFive Freedom U740 SOC implementation"
	select ATOMIC_OPERATIONS_C
	select INCLUDE_RESET_VECTOR
	select 64BIT
	select RISCV_ISA_RV64I
	select RISCV_ISA_EXT_M
	select RISCV_ISA_EXT_A
	select RISCV_ISA_EXT_C
	select RISCV_ISA_EXT_ZICSR
	select RISCV_ISA_EXT_ZIFENCEI

endchoice
```

## soc/riscv/starfive_jh71xx/Kconfig
```kconfig
# Copyright (c) 2024 Nordic Semiconductor ASA
# SPDX-License-Identifier: Apache-2.0

config SOC_FAMILY_STARFIVE_JH71XX
	bool

if SOC_FAMILY_STARFIVE_JH71XX

config SOC_FAMILY
	string
	default "starfive_jh71xx"

source "soc/riscv/starfive_jh71xx/*/Kconfig.soc"

endif # SOC_FAMILY_STARFIVE_JH71XX
```

## soc/riscv/starfive_jh71xx/Kconfig.defconfig
```kconfig
# Copyright (c) 2024 Nordic Semiconductor ASA
# SPDX-License-Identifier: Apache-2.0

source "soc/riscv/starfive_jh71xx/*/Kconfig.defconfig.series"
```

## soc/riscv/starfive_jh71xx/jh71xx/Kconfig.defconfig.jh7100
```kconfig
# Copyright (c) 2024 Nordic Semiconductor ASA
# SPDX-License-Identifier: Apache-2.0

config SOC
	default "jh7100" if SOC_JH7100
```

## soc/riscv/starfive_jh71xx/jh71xx/Kconfig.defconfig.jh7110
```kconfig
# Copyright (c) 2024 Pratik Farkase <pratik.farkase@wsisweden.com> 
# Copyright (c) 2024 Sigma Connectivity WSI AB

# SPDX-License-Identifier: Apache-2.0

config SOC
	default "jh7110" if SOC_JH7110
```

## soc/riscv/starfive_jh71xx/jh71xx/Kconfig.series
```kconfig
# Copyright (c) 2021 Rajnesh Kanwal <rajnesh.kanwal49@gmail.com>
# SPDX-License-Identifier: Apache-2.0

config SOC_SERIES_STARFIVE_JH71XX
	bool "Starfive JH71XX series"
	select RISCV
	select RISCV_PRIVILEGED
	select RISCV_HAS_PLIC
	help
	  Enable support for Starfive JH71XX SoC Series.
```

## soc/riscv/telink_tlsr/Kconfig
```kconfig
# Copyright (c) 2024 Nordic Semiconductor ASA
# SPDX-License-Identifier: Apache-2.0

config SOC_FAMILY_TELINK_TLSR
	bool

if SOC_FAMILY_TELINK_TLSR

config SOC_FAMILY
	string
	default "telink_tlsr"

source "soc/riscv/telink_tlsr/*/Kconfig.soc"

endif # SOC_FAMILY_TELINK_TLSR
```

## soc/riscv/telink_tlsr/tlsr951x/Kconfig.defconfig.series
```kconfig
# Copyright (c) 2021 Telink Semiconductor
# SPDX-License-Identifier: Apache-2.0

if SOC_SERIES_TELINK_TLSR951X

config SOC_SERIES
	string
	default "tlsr951x"

config SYS_CLOCK_HW_CYCLES_PER_SEC
	int
	default 32000

config RISCV_SOC_INTERRUPT_INIT
	bool
	default y

config RISCV_GP
	bool
	default y

config NUM_IRQS
	int
	default 64

config PINCTRL
	default y

config XIP
	bool
	default n

config MAIN_STACK_SIZE
	int
	default 2048

config IDLE_STACK_SIZE
	int
	default 1536

config TEST_EXTRA_STACK_SIZE
	int
	default 1024

config 2ND_LVL_INTR_00_OFFSET
	default 11

config HAS_FLASH_LOAD_OFFSET
	default y if BOOTLOADER_MCUBOOT

source "soc/riscv/telink_tlsr/tlsr951x/Kconfig.defconfig.tlsr*"

endif # SOC_SERIES_TELINK_TLSR951X
```

## soc/riscv/telink_tlsr/tlsr951x/Kconfig.soc
```kconfig
# Copyright (c) 2021 Telink Semiconductor
# SPDX-License-Identifier: Apache-2.0

if SOC_SERIES_TELINK_TLSR951X

choice
	prompt "Telink TLSR951X SoC implementation"

config SOC_TELINK_TLSR9518
	bool "Telink TLSR9518"

endchoice

config TELINK_B91_HWDSP
	bool "Support Hardware DSP"
	select RISCV_SOC_CONTEXT_SAVE

config TELINK_B91_PFT_ARCH
	bool "Support performance throttling"
	default y
	select RISCV_SOC_CONTEXT_SAVE

endif # SOC_SERIES_TELINK_TLSR951X
```

## soc/riscv/virt/Kconfig.soc
```kconfig
# Copyright (c) 2020 Cobham Gaisler AB
# SPDX-License-Identifier: Apache-2.0

config SOC_RISCV_VIRT
	bool "QEMU RISC-V VirtIO Board"
	select ATOMIC_OPERATIONS_BUILTIN
	select INCLUDE_RESET_VECTOR
	select RISCV_ISA_EXT_M
	select RISCV_ISA_EXT_A
	select RISCV_ISA_EXT_C
	select RISCV
	select RISCV_PRIVILEGED
	select RISCV_HAS_PLIC
```

## soc/riscv32/litex-vexriscv/Kconfig.defconfig
```kconfig
#
# Copyright (c) 2018 - 2019 Antmicro <www.antmicro.com>
#
# SPDX-License-Identifier: Apache-2.0
#

if SOC_RISCV32_LITEX_VEXRISCV

config SOC
	string
	default "litex-vexriscv"

config SYS_CLOCK_HW_CYCLES_PER_SEC
	int
	default 100000000

config RISCV_HAS_CPU_IDLE
	bool

config RISCV_HAS_PLIC
	bool

config NUM_IRQS
	int
	default 12

endif # SOC_RISCV32_LITEX_VEXRISCV
```

## soc/riscv32/openisa_rv32m1/Kconfig.defconfig
```kconfig
# Kconfig.defconfig: RV32M1 SoC RISC-V core default configuration values
#
# Copyright (c) 2018 Foundries.io Ltd
#
# SPDX-License-Identifier: Apache-2.0

if SOC_OPENISA_RV32M1_RISCV32

config SOC
	string
	default "openisa_rv32m1"

# 32 from event unit + 32 * (1 + max enabled INTMUX channel)
config NUM_IRQS
	int
	default 288 if RV32M1_INTMUX_CHANNEL_7
	default 256 if RV32M1_INTMUX_CHANNEL_6
	default 224 if RV32M1_INTMUX_CHANNEL_5
	default 192 if RV32M1_INTMUX_CHANNEL_4
	default 160 if RV32M1_INTMUX_CHANNEL_3
	default 128 if RV32M1_INTMUX_CHANNEL_2
	default 96 if RV32M1_INTMUX_CHANNEL_1
	default 64 if RV32M1_INTMUX_CHANNEL_0
	default 32

config XIP
	bool
	default y

config RISCV_GENERIC_TOOLCHAIN
	bool
	default y if "$(ZEPHYR_TOOLCHAIN_VARIANT)" = "zephyr"
	default n

config RISCV_SOC_CONTEXT_SAVE
	bool
	default y if SOC_OPENISA_RV32M1_RI5CY

config RISCV_SOC_INTERRUPT_INIT
	bool
	default y

# We need to disable the watchdog out of reset, as it's enabled by
# default. Use the WDOG_INIT hook for doing that.
config WDOG_INIT
	def_bool y

# Built-in flash allocated to each chip. This configuration
# assumes the Arm cores are disabled, as these base addresses
# contain the Arm core vector tables if they are used.
config RISCV32_RV32M1_ROM_BASE_ADDR
	hex
	default 0x00000000 if SOC_OPENISA_RV32M1_RI5CY
	default 0x01000000 if SOC_OPENISA_RV32M1_ZERO_RISCY

config RISCV32_RV32M1_ROM_SIZE
	hex
	default 0x000FFF00 if SOC_OPENISA_RV32M1_RI5CY
	default 0x0003FF00 if SOC_OPENISA_RV32M1_ZERO_RISCY

config RISCV32_RV32M1_RAM_BASE_ADDR
	hex
	default 0x20000000 if SOC_OPENISA_RV32M1_RI5CY
	default 0x09000000 if SOC_OPENISA_RV32M1_ZERO_RISCY

config RISCV32_RV32M1_RAM_SIZE
	hex
	default 0x00030000 if SOC_OPENISA_RV32M1_RI5CY
	default 0x00020000 if SOC_OPENISA_RV32M1_ZERO_RISCY

# The event unit looks for vector tables at the end of each core's
# flash space. These vector tables are not relocatable.
config RISCV32_RV32M1_VECTOR_BASE_ADDR
	hex
	default 0x000FFF00 if SOC_OPENISA_RV32M1_RI5CY
	default 0x0103FF00 if SOC_OPENISA_RV32M1_ZERO_RISCY

config RISCV32_RV32M1_VECTOR_SIZE
	hex
	default 0x100

config SYS_CLOCK_HW_CYCLES_PER_SEC
	int
	default 8000000 if SOC_OPENISA_RV32M1_RI5CY # SIRC at 8MHz

if MULTI_LEVEL_INTERRUPTS

config MAX_IRQ_PER_AGGREGATOR
	int
	default 32

config 2ND_LEVEL_INTERRUPTS
	def_bool y

config 2ND_LVL_ISR_TBL_OFFSET
	int
	default 32

config NUM_2ND_LEVEL_AGGREGATORS
	int
	default 8 if RV32M1_INTMUX_CHANNEL_7
	default 7 if RV32M1_INTMUX_CHANNEL_6
	default 6 if RV32M1_INTMUX_CHANNEL_5
	default 5 if RV32M1_INTMUX_CHANNEL_4
	default 4 if RV32M1_INTMUX_CHANNEL_3
	default 3 if RV32M1_INTMUX_CHANNEL_2
	default 2 if RV32M1_INTMUX_CHANNEL_1
	default 1		# just channel 0

config 2ND_LVL_INTR_00_OFFSET
	int
	default 24

config 2ND_LVL_INTR_01_OFFSET
	int
	default 25

config 2ND_LVL_INTR_02_OFFSET
	int
	default 26

config 2ND_LVL_INTR_03_OFFSET
	int
	default 27

config 2ND_LVL_INTR_04_OFFSET
	int
	default 28

config 2ND_LVL_INTR_05_OFFSET
	int
	default 29

config 2ND_LVL_INTR_06_OFFSET
	int
	default 30

config 2ND_LVL_INTR_07_OFFSET
	int
	default 31

config RV32M1_INTMUX
	def_bool y

config RV32M1_INTMUX_CHANNEL_0
	def_bool y

config RV32M1_INTMUX_CHANNEL_1
	def_bool y

config RV32M1_INTMUX_CHANNEL_2
	def_bool y

config RV32M1_INTMUX_CHANNEL_3
	def_bool y

config RV32M1_INTMUX_CHANNEL_4
	def_bool y

config RV32M1_INTMUX_CHANNEL_5
	def_bool y

config RV32M1_INTMUX_CHANNEL_6
	def_bool y

config RV32M1_INTMUX_CHANNEL_7
	def_bool y

endif # MULTI_LEVEL_INTERRUPTS

config PINMUX_RV32M1
	def_bool y

if GPIO

config GPIO_RV32M1
	def_bool y

endif # GPIO

if SERIAL

config UART_RV32M1_LPUART
	def_bool y

endif # SERIAL

endif # SOC_OPENISA_RV32M1_RISCV32
```

## soc/riscv32/pulpino/Kconfig.defconfig
```kconfig
if SOC_RISCV32_PULPINO

config SOC
	string
	default "pulpino"

config SYS_CLOCK_HW_CYCLES_PER_SEC
	int
	default 5000000

config RISCV_SOC_CONTEXT_SAVE
	bool
	default y

config RISCV_SOC_INTERRUPT_INIT
	bool
	default y

config RISCV_HAS_CPU_IDLE
	bool
	default y

config INCLUDE_RESET_VECTOR
	bool
	default y

config NUM_IRQS
	int
	default 32

config ITCM_BASE_ADDRESS
	hex
	default	0x00000000

config ITCM_SIZE
	hex
	default 0x8000

config DTCM_BASE_ADDRESS
	hex
	default 0x00100000

config DTCM_SIZE
	hex
	default 0x8000

if UART_NS16550

config UART_NS16550_PCI
	bool
	default n

config UART_NS16750
	bool
	default y

config UART_NS16550_PORT_0
	bool
	default y

endif # UART_NS16550

endif # SOC_RISCV32_PULPINO
```

## soc/riscv32/pulpino/Kconfig.soc
```kconfig
config SOC_RISCV32_PULPINO
	bool "Pulpino SOC implementation"
	select ATOMIC_OPERATIONS_C
```

## soc/riscv32/riscv-privilege/cloudbear-bm310/Kconfig.defconfig.series
```kconfig
if SOC_SERIES_RISCV32_CLOUDBEAR_BM310

config SOC_SERIES
	string
	default "cloudbear-bm310"

config SYS_CLOCK_HW_CYCLES_PER_SEC
	int
	default 50000000

config RISCV_SOC_INTERRUPT_INIT
	bool
	default y

config INCLUDE_RESET_VECTOR
	bool
	default y

config NUM_IRQS
	int
	default 43
	# IRQ #0..11 are reserved for generic RISC-V interrupts,
	# IRQ #12 - uart0
	# 31 PLIC interrupts

config RISCV_RAM_BASE_ADDR
	hex
	default 0x80000000

config RISCV_RAM_SIZE
	hex
	default 0x20000

endif # SOC_SERIES_RISCV32_CLOUDBEAR_BM310
```

## soc/riscv32/riscv-privilege/cloudbear-bm310/Kconfig.series
```kconfig
# Kconfig - CloudBEAR BM-310 SOC implementation
#
# Copyright (c) 2018 Vitaly Gaiduk <vitaly.gaiduk@cloudbear.ru>
#
# SPDX-License-Identifier: Apache-2.0
#

config SOC_SERIES_RISCV32_CLOUDBEAR_BM310
	bool "CloudBEAR BM-310 SOC implementation"
	depends on RISCV32
	select SOC_FAMILY_RISCV_PRIVILEGE
	help
	  Enable support for CloudBEAR BM-310 SOC implementation
```

## soc/riscv32/riscv-privilege/cloudbear-bm310/Kconfig.soc
```kconfig
# Kconfig - CloudBEAR BM-310 SOC configuration options
#
# Copyright (c) 2018 Vitaly Gaiduk <vitaly.gaiduk@cloudbear.ru>
#
# SPDX-License-Identifier: Apache-2.0
#

choice
prompt "CloudBEAR BM-310 SOC implementation"
depends on SOC_SERIES_RISCV32_CLOUDBEAR_BM310

config SOC_RISCV32_CLOUDBEAR_BM310
	bool "CloudBEAR BM-310 SOC implementation"
endchoice
```

## soc/riscv32/riscv-privilege/miv/Kconfig.defconfig.series
```kconfig
if SOC_SERIES_RISCV32_MIV

config SOC_SERIES
	string
	default "miv"

config SYS_CLOCK_HW_CYCLES_PER_SEC
	int
	default 660000

config RISCV_SOC_INTERRUPT_INIT
	bool
	default y

config RISCV_HAS_CPU_IDLE
	bool
	default y

config RISCV_HAS_PLIC
	bool
	default y

config NUM_IRQS
	int
	default 42

config XIP
	bool
	default y

config RISCV_ROM_BASE_ADDR
	hex
	default 0x80000000

config RISCV_ROM_SIZE
	hex
	default 0x40000

config RISCV_RAM_BASE_ADDR
	hex
	default	0x80040000

config RISCV_RAM_SIZE
	hex
	default 0x40000

endif # SOC_SERIES_RISCV32_MIV
```

## soc/riscv32/riscv-privilege/miv/Kconfig.series
```kconfig
# Kconfig - RISCV32_MIV implementation
#
# Copyright (c) 2018 Antmicro <www.antmicro.com>
#

config SOC_SERIES_RISCV32_MIV
	bool "Microsemi Mi-V implementation"
	depends on RISCV32
	select SOC_FAMILY_RISCV_PRIVILEGE
	help
	Enable support for Microsemi Mi-V
```

## soc/riscv32/riscv-privilege/miv/Kconfig.soc
```kconfig
# SPDX-License-Identifier: Apache-2.0

# Kconfig - RISCV32_MIV configuration options
#
# Copyright (c) 2018 Antmicro <www.antmicro.com>
#

choice
prompt "Microsemi Mi-V system implementation"
depends on SOC_SERIES_RISCV32_MIV

config SOC_RISCV32_MIV
	bool "Microsemi Mi-V system implementation"
	select ATOMIC_OPERATIONS_C

endchoice
```

## soc/riscv32/riscv-privilege/riscv32-qemu/Kconfig.series
```kconfig
# Kconfig - riscv32 QEMU SOC implementation
#
# Copyright (c) 2017 Jean-Paul Etienne <fractalclone@gmail.com>
#
# SPDX-License-Identifier: Apache-2.0
#

config SOC_SERIES_RISCV32_QEMU
	bool "riscv32 QEMU SOC implementation"
	depends on RISCV32
	select SOC_FAMILY_RISCV_PRIVILEGE
	help
	  Enable support for riscv32 QEMU SOC implementation
```

## soc/riscv32/riscv-privilege/sifive-freedom/Kconfig.defconfig.series
```kconfig
# SPDX-License-Identifier: Apache-2.0

if SOC_SERIES_RISCV32_SIFIVE_FREEDOM

config SOC_SERIES
	string
	default "sifive-freedom"

config SYS_CLOCK_HW_CYCLES_PER_SEC
	int
	default 32768

config RISCV_SOC_INTERRUPT_INIT
	bool
	default y

config RISCV_HAS_CPU_IDLE
	bool
	default y

config RISCV_HAS_PLIC
	bool
	default y

config NUM_IRQS
	int
	default 64

config XIP
	bool
	default y

endif # SOC_SERIES_RISCV32_SIFIVE_FREEDOM
```
