## soc/riscv/andes_v5/hpmicro/hpm68xx/Kconfig.series
```kconfig
# Copyright (c) 2024 HPMicro
# SPDX-License-Identifier: Apache-2.0

config SOC_SERIES_HPM68XX
	bool "HPM68XX Series MCU"
	select RISCV
	help
	  Enable support for HPM68XX MCU series
```

## soc/riscv/andes_v5/hpmicro/hpm68xx/Kconfig.soc
```kconfig
# Copyright (c) 2024 HPMicro
# SPDX-License-Identifier: Apache-2.0

choice
	prompt "HPM68XX MCU Selection"
	depends on SOC_SERIES_HPM68XX

config SOC_HPM6800
	bool "HPM6800"

endchoice
```

## soc/riscv/bouffalolab/Kconfig
```kconfig
# Copyright (c) 2021, ATL Electronics
# SPDX-License-Identifier: Apache-2.0

config SOC_FAMILY_BFLB
	bool
	select HAS_BFLB_HAL
	select BUILD_OUTPUT_HEX
	select PINCTRL

config SOC_FAMILY
	string
	default "bouffalolab"
	depends on SOC_FAMILY_BFLB

if SOC_FAMILY_BFLB

source "soc/riscv/bouffalolab/*/Kconfig.soc"

endif # SOC_FAMILY_BFLB
```

## soc/riscv/bouffalolab/Kconfig.defconfig
```kconfig
# Copyright (c) 2021, ATL Electronics
# SPDX-License-Identifier: Apache-2.0

source "soc/riscv/bouffalolab/*/Kconfig.defconfig.series"
```

## soc/riscv/bouffalolab/bflb/Kconfig.defconfig.bl6
```kconfig
# Copyright (c) 2021, ATL Electronics
# SPDX-License-Identifier: Apache-2.0

if SOC_SERIES_BL6

config SOC_SERIES
	default "bflb"

config SOC_SUB_SERIES
	string
	default "bl602"

config SOC_PART_NUMBER
	string
	default "bl602c00q2i" if SOC_PART_NUMBER_BL602C00Q2I
	default "bl602c20q2i" if SOC_PART_NUMBER_BL602C20Q2I
	default "bl604e20q2i" if SOC_PART_NUMBER_BL604C20Q2I

config SYS_CLOCK_HW_CYCLES_PER_SEC
	default 192000000

config NUM_IRQS
	default 64

endif   # SOC_SERIES_BL6
```

## soc/riscv/bouffalolab/bflb/Kconfig.defconfig.series
```kconfig
# Copyright (c) 2021, ATL Electronics
# SPDX-License-Identifier: Apache-2.0

source "soc/riscv/bouffalolab/bflb/Kconfig.defconfig.bl*"
```

## soc/riscv/bouffalolab/bflb/Kconfig.series
```kconfig
# Copyright (c) 2021, ATL Electronics
# SPDX-License-Identifier: Apache-2.0

config SOC_SERIES_BL6
	bool "Bouffalo Lab BL6 series MCU"
	select RISCV
#	select RISCV_GP
	select RISCV_HAS_CPU_IDLE
	select RISCV_MACHINE_TIMER
	select ATOMIC_OPERATIONS_C
	select COMPRESSED_ISA
	select SOC_FAMILY_BFLB
	select CPU_HAS_FPU
	help
	  Enable support for Bouffalo Lab BL6 MCU series
```

## soc/riscv/bouffalolab/bflb/Kconfig.soc.bl6
```kconfig
# Copyright (c) 2021, ATL Electronics
# SPDX-License-Identifier: Apache-2.0

choice
	prompt "bouffalo Lab BL6 MCU Selection"
	depends on SOC_SERIES_BL6

	config SOC_PART_NUMBER_BL602C00Q2I
		bool "BL602C00Q2I"

	config SOC_PART_NUMBER_BL602C20Q2I
		bool "BL602C20Q2I"

	config SOC_PART_NUMBER_BL604C20Q2I
		bool "BL604E20Q2I"

endchoice
```

## soc/riscv/common/riscv-privileged/Kconfig
```kconfig
# Configuration options for riscv SOCs supporting the riscv privileged
# architecture specification

# Copyright (c) 2017 Jean-Paul Etienne <fractalclone@gmail.com>
# SPDX-License-Identifier: Apache-2.0

config RISCV_PRIVILEGED_STANDALONE
	bool

config SOC_FAMILY
	string
	default "riscv-privileged" if RISCV_PRIVILEGED && !RISCV_PRIVILEGED_STANDALONE

config RISCV_HAS_PLIC
	bool "Does the SOC provide support for a Platform Level Interrupt Controller (PLIC)"
	depends on RISCV_PRIVILEGED
	help
	  Does the SOC provide support for a Platform Level Interrupt Controller (PLIC).

config RISCV_HAS_CLIC
	bool "Does the SOC provide support for a Core-Local Interrupt Controller (CLIC)"
	depends on RISCV_PRIVILEGED
	help
	  Does the SOC provide support for a Core-Local Interrupt Controller (CLIC).

config RISCV_VECTORED_MODE
	bool "Should the SOC use vectored mode"
	depends on RISCV_PRIVILEGED
	help
	  Should the SOC use vectored mode.
```

## soc/riscv/efinix_sapphire/Kconfig.soc
```kconfig
# Copyright (c) 2023 Efinix Inc.
# SPDX-License-Identifier: Apache-2.0

config SOC_EFINIX_SAPPHIRE
	bool "Efinix Sapphire VexRiscv system implementation"
	select ATOMIC_OPERATIONS_BUILTIN
	select INCLUDE_RESET_VECTOR
	select RISCV_ISA_RV32I
	select RISCV_ISA_EXT_M
	select RISCV_ISA_EXT_A
	select RISCV_ISA_EXT_ZICSR
	select RISCV_ISA_EXT_ZIFENCEI
	select RISCV
	select RISCV_PRIVILEGED
	select RISCV_HAS_PLIC
```

## soc/riscv/esp32c3/Kconfig.defconfig
```kconfig
# ESP32C3 board configuration

# Copyright (c) 2021 Espressif Systems (Shanghai) Co., Ltd.
# SPDX-License-Identifier: Apache-2.0

if SOC_ESP32C3

if BOOTLOADER_MCUBOOT

config HAS_FLASH_LOAD_OFFSET
	default y

config MCUBOOT_GENERATE_UNSIGNED_IMAGE
	default y

config MCUBOOT_GENERATE_CONFIRMED_IMAGE
	default y

config ROM_START_OFFSET
	default 0x20

config HAS_DYNAMIC_DEVICE_HANDLES
	default y

endif

config SOC
	default "esp32c3"

config NUM_IRQS
	default 62

config GEN_ISR_TABLES
	default y

config GEN_SW_ISR_TABLE
	default y

config GEN_IRQ_VECTOR_TABLE
	default n

config DYNAMIC_INTERRUPTS
	default y

config ISR_STACK_SIZE
	default 2048

config ATOMIC_OPERATIONS_C
	default y

config MINIMAL_LIBC_OPTIMIZE_STRING_FOR_SIZE
	default n

config SYS_CLOCK_HW_CYCLES_PER_SEC
	default 16000000

endif
```

## soc/riscv/esp32c3/Kconfig.soc
```kconfig
# Copyright (c) 2021 Espressif Systems (Shanghai) Co., Ltd.
# SPDX-License-Identifier: Apache-2.0

config SOC_ESP32C3
	bool "ESP32C3"
	select RISCV
	select RISCV_GP
	select DYNAMIC_INTERRUPTS
	select CLOCK_CONTROL
	select PINCTRL
	select XIP
	select HAS_ESPRESSIF_HAL
	select RISCV_ISA_RV32I
	select RISCV_ISA_EXT_M
	select RISCV_ISA_EXT_C
	select RISCV_ISA_EXT_ZICSR

if SOC_ESP32C3

config SOC_FAMILY_ESP32
	bool
	default y

config IDF_TARGET_ESP32C3
	bool "ESP32C3 as target board"
	default y

config ESPTOOLPY_FLASHFREQ_80M
	bool
	default y

config FLASH_SIZE
	int
	default $(dt_node_reg_size_int,/soc/flash-controller@60002000/flash@0,0)

config FLASH_BASE_ADDRESS
	hex
	default $(dt_node_reg_addr_hex,/soc/flash-controller@60002000/flash@0)

config ESP_SYSTEM_RTC_EXT_XTAL
	bool

config ESP_SYSTEM_RTC_EXT_OSC
	bool

choice ESP32C3_RTC_CLK_SRC
	prompt "RTC clock source"
	default ESP32C3_RTC_CLK_SRC_INT_RC
	help
	  Choose which clock is used as RTC clock source.

config ESP32C3_RTC_CLK_SRC_INT_RC
	bool "Internal 150kHz RC oscillator"

config ESP32C3_RTC_CLK_SRC_EXT_CRYS
	bool "External 32kHz crystal"
	select ESP_SYSTEM_RTC_EXT_XTAL

config ESP32C3_RTC_CLK_SRC_EXT_OSC
	bool "External 32kHz oscillator at 32K_XP pin"
	select ESP_SYSTEM_RTC_EXT_OSC

config ESP32C3_RTC_CLK_SRC_INT_8MD256
	bool "Internal 8MHz oscillator, divided by 256 (~32kHz)"

endchoice

config ESP32C3_RTC_CLK_CAL_CYCLES
	int "Number of cycles for RTC_SLOW_CLK calibration"
	default 3000 if ESP32C3_RTC_CLK_SRC_EXT_CRYS || ESP32C3_RTC_CLK_SRC_EXT_OSC || ESP32C3_RTC_CLK_SRC_INT_8MD256
	default 1024 if ESP32C3_RTC_CLK_SRC_INT_RC
	range 0 27000 if ESP32C3_RTC_CLK_SRC_EXT_CRYS || ESP32C3_RTC_CLK_SRC_EXT_OSC || ESP32C3_RTC_CLK_SRC_INT_8MD256
	range 0 32766 if ESP32C3_RTC_CLK_SRC_INT_RC
	help
	  When the startup code initializes RTC_SLOW_CLK, it can perform
	  calibration by comparing the RTC_SLOW_CLK frequency with main XTAL
	  frequency. This option sets the number of RTC_SLOW_CLK cycles measured
	  by the calibration routine. Higher numbers increase calibration
	  precision, which may be important for applications which spend a lot of
	  time in deep sleep. Lower numbers reduce startup time.

	  When this option is set to 0, clock calibration will not be performed at
	  startup, and approximate clock frequencies will be assumed:

	  - 150000 Hz if internal RC oscillator is used as clock source. For this use value 1024.
	  - 32768 Hz if the 32k crystal oscillator is used. For this use value 3000 or more.
	    In case more value will help improve the definition of the launch of the crystal.
	    If the crystal could not start, it will be switched to internal RC.

config ESP32_PHY_MAX_WIFI_TX_POWER
	int "Max WiFi TX power (dBm)"
	range 10 20
	default 20
	help
	  Set maximum transmit power for WiFi radio. Actual transmit power for high
	  data rates may be lower than this setting.

config ESP32_PHY_MAX_TX_POWER
	int
	default ESP32_PHY_MAX_WIFI_TX_POWER

config MAC_BB_PD
	bool "Power down MAC and baseband of Wi-Fi and Bluetooth when PHY is disabled"
	depends on SOC_ESP32C3 && TICKLESS_KERNEL
	default n
	help
	  If enabled, the MAC and baseband of Wi-Fi and Bluetooth will be powered
	  down when PHY is disabled. Enabling this setting reduces power consumption
	  by a small amount but increases RAM use by approximately 4 KB(Wi-Fi only),
	  2 KB(Bluetooth only) or 5.3 KB(Wi-Fi + Bluetooth).

endif
```

## soc/riscv/espressif_esp32/Kconfig.defconfig
```kconfig
# Copyright (c) 2023 Espressif Systems (Shanghai) Co., Ltd.
# SPDX-License-Identifier: Apache-2.0

source "soc/riscv/espressif_esp32/common/Kconfig.defconfig.series"
source "soc/riscv/espressif_esp32/*/Kconfig.defconfig.series"
```

## soc/riscv/espressif_esp32/common/Kconfig.soc
```kconfig
# Copyright (c) 2023 Espressif Systems (Shanghai) Co., Ltd.
# SPDX-License-Identifier: Apache-2.0

if SOC_FAMILY_ESP32

config ESPTOOLPY_FLASHFREQ_80M
	bool

config FLASH_SIZE
	int

config FLASH_BASE_ADDRESS
	hex

endif # SOC_FAMILY_ESP32
```

## soc/riscv/espressif_esp32/esp32c3/Kconfig.series
```kconfig
# Copyright (c) 2023 Espressif Systems (Shanghai) Co., Ltd.
# SPDX-License-Identifier: Apache-2.0

config SOC_SERIES_ESP32C3
	bool "ESP32C3"
	select RISCV
	select RISCV_GP
	select DYNAMIC_INTERRUPTS
	select CLOCK_CONTROL
	select PINCTRL
	select RISCV_ISA_RV32I
	select RISCV_ISA_EXT_M
	select RISCV_ISA_EXT_C
	select RISCV_ISA_EXT_ZICSR
	select HAS_ESPRESSIF_HAL
	select SOC_FAMILY_ESP32
	select XIP if !MCUBOOT
	select HAS_PM
	select HAS_POWEROFF
	help
	  Enable support for Espressif ESP32-C3
```

## soc/riscv/gd_gd32/Kconfig
```kconfig
# Copyright (c) 2024 Nordic Semiconductor ASA
# SPDX-License-Identifier: Apache-2.0

config SOC_FAMILY_GD32
	bool

if SOC_FAMILY_GD32

config SOC_FAMILY
	string
	default "gd_gd32"

source "soc/riscv/gd_gd32/*/Kconfig.soc"

endif # SOC_FAMILY_GIGADEVICE_GD32
```

## soc/riscv/gd_gd32/Kconfig.defconfig
```kconfig
# Copyright (c) 2024 Nordic Semiconductor ASA
# SPDX-License-Identifier: Apache-2.0

source "soc/riscv/gd_gd32/*/Kconfig.defconfig.series"
```

## soc/riscv/gd_gd32/gd32vf103/Kconfig.soc
```kconfig
# GD32VF103 SOC configuration options

# Copyright (c) 2021 Tokita, Hiroshi <tokita.hiroshi@gmail.com>
# SPDX-License-Identifier: Apache-2.0

choice
	prompt "GigaDevice GD32VF103 SOC implementation"
	depends on SOC_SERIES_GD32VF103

config SOC_GD32VF103
	bool "GD32VF103"
	select RISCV_ISA_RV32I
	select RISCV_ISA_EXT_M
	select RISCV_ISA_EXT_A
	select RISCV_ISA_EXT_C
	select RISCV_ISA_EXT_ZICSR
	select RISCV_ISA_EXT_ZIFENCEI

endchoice
```

## soc/riscv/hpmicro_d45/Kconfig
```kconfig
# Copyright (c) 2024 HPMicro
# SPDX-License-Identifier: Apache-2.0

config SOC_FAMILY_HPMICRO_D45
	bool

if SOC_FAMILY_HPMICRO_D45

config SOC_FAMILY
	string
	default "hpmicro_d45"

source "soc/riscv/hpmicro_d45/*/Kconfig.soc"

endif # SOC_FAMILY_HPMICRO_D45
```

## soc/riscv/hpmicro_d45/Kconfig.soc
```kconfig
# Copyright (c) 2024 HPMicro
# SPDX-License-Identifier: Apache-2.0

source "soc/riscv/hpmicro_d45/*/Kconfig.series"
```

## soc/riscv/hpmicro_d45/hpm6750/Kconfig.defconfig.hpm6750
```kconfig
# Copyright (c) 2022 HPMicro
# SPDX-License-Identifier: Apache-2.0

if SOC_HPM6750

config SOC
	default "hpm6750"

config SYS_CLOCK_TICKS_PER_SEC
	default 1000

config MAIN_STACK_SIZE
	default 4096

config IDLE_STACK_SIZE
	default 2048

config TEST_EXTRA_STACK_SIZE
	default 2048

endif # SOC_HPM6750
```

## soc/riscv/hpmicro_d45/hpm6750/Kconfig.defconfig.series
```kconfig
# Copyright (c) 2022 HPMicro
# SPDX-License-Identifier: Apache-2.0

if SOC_SERIES_HPM6750

source "soc/riscv/hpmicro_d45/hpm6750/Kconfig.defconfig.hpm6*"

config SOC_SERIES
	default "hpm6750"

config SYS_CLOCK_HW_CYCLES_PER_SEC
	default 24000000

config KERNEL_ENTRY
	default "_start"

config RISCV_GENERIC_TOOLCHAIN
	default y if "$(ZEPHYR_TOOLCHAIN_VARIANT)" = "zephyr"
	default n

config RISCV_SOC_INTERRUPT_INIT
	default y

config RISCV_HAS_PLIC
	default y

config RISCV_GP
	default y

config MAX_IRQ_PER_AGGREGATOR
	default 112

config NUM_IRQS
	default 128

endif # SOC_SERIES_HPM6750
```

## soc/riscv/hpmicro_d45/hpm6750/Kconfig.series
```kconfig
# Copyright (c) 2022 HPMicro
# SPDX-License-Identifier: Apache-2.0

config SOC_SERIES_HPM6750
	bool "HPMicro HPM6700_6400 Series"
	select RISCV
	select RISCV_PRIVILEGED
	select HAS_HPMICRO_HAL
	select SOC_FAMILY_HPMICRO_D45
	help
	  Enable support for HPMicro HPM6700_6400 series SoC
```

## soc/riscv/hpmicro_d45/hpm6750/Kconfig.soc
```kconfig
# Copyright (c) 2022 HPMicro
# SPDX-License-Identifier: Apache-2.0

choice
	prompt "HPMicro HPM6700_6400 SoC Selection"
	depends on SOC_SERIES_HPM6750

config SOC_HPM6750
	bool "HPMicro HPM6750 SoC implementation"
	select ATOMIC_OPERATIONS_BUILTIN
	select INCLUDE_RESET_VECTOR
	select RISCV_ISA_EXT_M
	select RISCV_ISA_EXT_A
	select RISCV_ISA_RV32I
	select RISCV_ISA_EXT_ZICSR
	select RISCV_ISA_EXT_ZIFENCEI
	select USE_HPMSDK_PDM
	select USE_HPMSDK_PLLCTL
	select USE_HPMSDK_PMP

endchoice

if SOC_SERIES_HPM6750

choice
prompt "FPU options"
default SOC_HPMICRO_NO_FPU

config SOC_HPMICRO_NO_FPU
	bool "No FPU"

config SOC_HPMICRO_SINGLE_PRECISION_FPU
	bool "Single precision FPU"
	select CPU_HAS_FPU

config SOC_HPMICRO_DOUBLE_PRECISION_FPU
	bool "Double precision FPU"
	select CPU_HAS_FPU_DOUBLE_PRECISION

endchoice

endif # SOC_SERIES_HPM6750
```

## soc/riscv/intel_niosv/Kconfig
```kconfig
# Copyright (c) 2024 Nordic Semiconductor ASA
# SPDX-License-Identifier: Apache-2.0

config SOC_FAMILY_INTEL_NIOSV
	bool

if SOC_FAMILY_INTEL_NIOSV

config SOC_FAMILY
	string
	default "intel_niosv"

source "soc/riscv/intel_niosv/*/Kconfig.soc"

endif # SOC_FAMILY_INTEL_NIOSV
```
