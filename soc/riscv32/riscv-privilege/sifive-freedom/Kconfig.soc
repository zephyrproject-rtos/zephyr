## soc/riscv32/riscv-privilege/sifive-freedom/Kconfig.soc
```kconfig
# Kconfig - RISCV32_SIFIVE_FREEDOM SOC configuration options
#
# Copyright (c) 2017 Jean-Paul Etienne <fractalclone@gmail.com>
#
# SPDX-License-Identifier: Apache-2.0
#

choice
prompt "SiFive Freedom SOC implementation"
depends on SOC_SERIES_RISCV32_SIFIVE_FREEDOM

config SOC_RISCV32_SIFIVE_FREEDOM
	bool "SiFive Freedom SOC implementation"
	select ATOMIC_OPERATIONS_C

endchoice
```

## soc/rockchip/Kconfig
```kconfig
#
# Copyright 2021 Huawei France Technologies SASU
#
# SPDX-License-Identifier: Apache-2.0
#

rsource "*/Kconfig"
```

## soc/rockchip/Kconfig.defconfig
```kconfig
#
# Copyright 2021 Huawei France Technologies SASU
#
# SPDX-License-Identifier: Apache-2.0
#

if SOC_FAMILY_ROCKCHIP

rsource "*/Kconfig.defconfig"

endif
```

## soc/rockchip/Kconfig.soc
```kconfig
#
# Copyright 2021 Huawei France Technologies SASU
#
# SPDX-License-Identifier: Apache-2.0
#

config SOC_FAMILY_ROCKCHIP
	bool

config SOC_FAMILY
	default "rockchip" if SOC_FAMILY_ROCKCHIP

rsource "*/Kconfig.soc"
```

## soc/rockchip/rk3399/Kconfig
```kconfig
#
# Copyright 2022 Huawei France Technologies SASU
#
# SPDX-License-Identifier: Apache-2.0
#

config SOC_RK3399
	select ARM64
	select CPU_CORTEX_A53
	select ARM_ARCH_TIMER if SYS_CLOCK_EXISTS

config SOC_PART_NUMBER
	default "RK3399" if SOC_SERIES_RK3399
```

## soc/rockchip/rk3399/Kconfig.defconfig
```kconfig
#
# Copyright 2022 Huawei France Technologies SASU
#
# SPDX-License-Identifier: Apache-2.0
#

if SOC_SERIES_RK3399

rsource "Kconfig.defconfig.rk3399"

endif # SOC_SERIES_RK3399
```

## soc/rockchip/rk3399/Kconfig.defconfig.rk3399
```kconfig
#
# Copyright 2022 Huawei France Technologies SASU
#
# SPDX-License-Identifier: Apache-2.0
#

if SOC_RK3399

config NUM_IRQS
	default 240

config FLASH_SIZE
	default 0

config FLASH_BASE_ADDRESS
	default 0

endif
```

## soc/rockchip/rk3399/Kconfig.soc
```kconfig
#
# Copyright 2022 Huawei France Technologies SASU
#
# SPDX-License-Identifier: Apache-2.0
#

config SOC_RK3399
	bool
	select SOC_SERIES_RK3399

config SOC_SERIES_RK3399
	bool
	select SOC_FAMILY_ROCKCHIP

config SOC
	default "rk3399" if SOC_RK3399

config SOC_SERIES
	default "rk3399" if SOC_SERIES_RK3399
```

## soc/rockchip/rk35/Kconfig.soc
```kconfig
# Copyright 2024 Université Gustave Eiffel
# SPDX-License-Identifier: Apache-2.0

config SOC_SERIES_RK35
	bool
	select SOC_FAMILY_ROCKCHIP

config SOC_SERIES
	default "rk35" if SOC_SERIES_RK35

rsource "*/Kconfig.soc"
```

## soc/rockchip/rk35/rk3506/Kconfig
```kconfig
# Copyright 2026 Hiyajomaho Num9
# SPDX-License-Identifier: Apache-2.0

config SOC_RK3506
	select ARM
	select CPU_CORTEX_A7
	select ARM_ARCH_TIMER
	select SYS_CLOCK_EXISTS
	select ARM_AARCH32_MMU
	select SOC_RESET_HOOK

config SOC_PART_NUMBER
	default "RK3506" if SOC_RK3506
```

## soc/rockchip/rk35/rk3506/Kconfig.defconfig
```kconfig
# Copyright 2026 Hiyajomaho Num9
# SPDX-License-Identifier: Apache-2.0

if SOC_RK3506

config NUM_IRQS
	default 192

config SYS_CLOCK_HW_CYCLES_PER_SEC
	default 24000000

config FLASH_BASE_ADDRESS
	default 0

config FLASH_SIZE
	default 0

configdefault UART_NS16550_DW8250_DW_APB
	default y

configdefault UART_NS16550_ACCESS_WORD_ONLY
	default y

endif # SOC_RK3506
```

## soc/rockchip/rk35/rk3506/Kconfig.soc
```kconfig
# Copyright 2026 Hiyajomaho Num9
# SPDX-License-Identifier: Apache-2.0

config SOC_RK3506
	bool
	select SOC_SERIES_RK35

config SOC
	default "rk3506" if SOC_RK3506
```

## soc/rockchip/rk35/rk3568/Kconfig.defconfig
```kconfig
# Copyright 2022 HNU-ESNL
# Copyright 2022 openEuler SIG-Zephyr
# SPDX-License-Identifier: Apache-2.0

if SOC_RK3568

rsource "Kconfig.defconfig.rk3568"

endif # SOC_SERIES_RK3568
```

## soc/rockchip/rk35/rk3568/Kconfig.soc
```kconfig
# Copyright 2022 HNU-ESNL
# Copyright 2022 openEuler SIG-Zephyr
# SPDX-License-Identifier: Apache-2.0

config SOC_RK3568
	bool
	select SOC_SERIES_RK35

config SOC
	default "rk3568" if SOC_RK3568
```

## soc/rockchip/rk35/rk3588/Kconfig
```kconfig
# Copyright (c) 2025 Syswonder
# SPDX-License-Identifier: Apache-2.0

config SOC_RK3588
	select ARM64
	select CPU_CORTEX_A55
	select ARM_ARCH_TIMER

config SOC_PART_NUMBER
	default "RK3588" if SOC_RK3588
```

## soc/rockchip/rk35/rk3588/Kconfig.defconfig
```kconfig
# Copyright (c) 2025 Syswonder
# SPDX-License-Identifier: Apache-2.0

if SOC_RK3588

rsource "Kconfig.defconfig.rk3588"

endif # SOC_SERIES_RK3588
```

## soc/rockchip/rk35/rk3588/Kconfig.soc
```kconfig
# Copyright (c) 2025 Syswonder
# SPDX-License-Identifier: Apache-2.0

config SOC_RK3588
	bool
	select SOC_SERIES_RK35

config SOC
	default "rk3588" if SOC_RK3588
```

## soc/rockchip/rk35/rk3588s/Kconfig
```kconfig
# Copyright 2024 Université Gustave Eiffel
# SPDX-License-Identifier: Apache-2.0

config SOC_RK3588S
	select ARM64
	select CPU_CORTEX_A55
	select ARM_ARCH_TIMER if SYS_CLOCK_EXISTS

config SOC_PART_NUMBER
	default "RK3588S" if SOC_RK3588S
```

## soc/rockchip/rk35/rk3588s/Kconfig.defconfig
```kconfig
# Copyright 2024 Université Gustave Eiffel
# SPDX-License-Identifier: Apache-2.0

if SOC_RK3588S

rsource "Kconfig.defconfig.rk3588s"

endif # SOC_RK3588S
```

## soc/rockchip/rk35/rk3588s/Kconfig.defconfig.rk3588s
```kconfig
# Copyright 2024 Université Gustave Eiffel
# SPDX-License-Identifier: Apache-2.0

if SOC_RK3588S

config NUM_IRQS
	default 544

config FLASH_SIZE
	default 0

config FLASH_BASE_ADDRESS
	default 0

configdefault UART_NS16550_ACCESS_WORD_ONLY
	default y

endif
```

## soc/rockchip/rk35/rk3588s/Kconfig.soc
```kconfig
# Copyright 2024 Université Gustave Eiffel
# SPDX-License-Identifier: Apache-2.0

config SOC_RK3588S
	bool
	select SOC_SERIES_RK35

config SOC
	default "rk3588s" if SOC_RK3588S
```

## soc/rockchip/rk3568/Kconfig
```kconfig
# Copyright 2022 HNU-ESNL
# Copyright 2022 openEuler SIG-Zephyr
# SPDX-License-Identifier: Apache-2.0

config SOC_SERIES_RK3568
	select ARM64
	select CPU_CORTEX_A55
	select ARM_ARCH_TIMER
	select GIC_V3

config SOC_PART_NUMBER
	default "RK3568" if SOC_SERIES_RK3568
```

## soc/rockchip/rk3568/Kconfig.defconfig.rk3568
```kconfig
# Copyright 2022 HNU-ESNL
# Copyright 2022 openEuler SIG-Zephyr
# SPDX-License-Identifier: Apache-2.0

if SOC_RK3568

config FLASH_SIZE
	default 0

config FLASH_BASE_ADDRESS
	default 0

config NUM_IRQS
	default 240

config SYS_CLOCK_HW_CYCLES_PER_SEC
	default 24000000

endif
```

## soc/rockchip/rk3568/Kconfig.soc
```kconfig
# Copyright 2022 HNU-ESNL
# Copyright 2022 openEuler SIG-Zephyr
# SPDX-License-Identifier: Apache-2.0

config SOC_SERIES_RK3568
	bool
	select SOC_FAMILY_ROCKCHIP

config SOC_RK3568
	bool
	select SOC_SERIES_RK3568

config SOC
	default "rk3568" if SOC_RK3568

config SOC_SERIES
	default "rk3568" if SOC_RK3568
```

## soc/rockchip/rv1106/Kconfig
```kconfig
# Copyright 2026 Patryk Koscik
# SPDX-License-Identifier: Apache-2.0

config SOC_RV1106
	select ARM
	select CPU_CORTEX_A7
	select ARM_ARCH_TIMER
	select SYS_CLOCK_EXISTS
```
