## soc/nordic_nrf/Kconfig.soc
```kconfig
# Copyright (c) 2022 Nordic Semiconductor ASA

# SPDX-License-Identifier: Apache-2.0

# This file contains Zephyr hw modul v2 Kconfig description for
# Nordic Semiconductor SoCs.
# The hw model v2 is generic and contains no Kconfig references outside its own
# tree structure and is therefore reusable in Kconfig trees outside a Zephyr build.

config SOC_SERIES
	default "nrf51" if SOC_SERIES_NRF51X
	default "nrf52" if SOC_SERIES_NRF52X
	default "nrf53" if SOC_SERIES_NRF53X
	default "nrf91" if SOC_SERIES_NRF91X

config SOC_FAMILY_NRF
	bool

config SOC_FAMILY
	string
	default "nordic_nrf"
	depends on SOC_FAMILY_NRF

config SOC_SERIES_NRF51X
	bool
	help
	  Enable support for NRF51 MCU series

config SOC_SERIES_NRF52X
	bool
	select SOC_FAMILY_NRF
	help
	  Enable support for NRF52 MCU series

config SOC_SERIES_NRF53X
	bool
	select SOC_FAMILY_NRF
	help
	 Enable support for NRF53 MCU series

config SOC_SERIES_NRF91X
	bool
	select SOC_FAMILY_NRF
	help
	  Enable support for NRF91 MCU series

rsource "*/Kconfig.soc"
```

## soc/nordic_nrf/nrf51/Kconfig.defconfig
```kconfig
# Nordic Semiconductor nRF51 MCU line

# Copyright (c) 2016 Linaro Limited
# Copyright (c) 2018 Nordic Semiconductor ASA
# SPDX-License-Identifier: Apache-2.0

if SOC_SERIES_NRF51X

config NUM_IRQS
	default 26

# If the kernel has timer support, enable the timer
config NRF_RTC_TIMER
	default y if SYS_CLOCK_EXISTS

endif # SOC_SERIES_NRF51X
```

## soc/nordic_nrf/nrf51/Kconfig.soc
```kconfig
# Nordic Semiconductor nRF51 MCU line

# Copyright (c) 2016 Linaro Limited
# SPDX-License-Identifier: Apache-2.0

config SOC_SERIES_NRF51X
	select SOC_FAMILY_NRF
	help
	  Enable support for NRF51 MCU series

config SOC_NRF51822_QFAA
	bool
	select SOC_SERIES_NRF51X

config SOC_NRF51822_QFAB
	bool
	select SOC_SERIES_NRF51X

config SOC_NRF51822_QFAC
	bool
	select SOC_SERIES_NRF51X

config SOC
	default "nRF51822_QFAA" if SOC_NRF51822_QFAA
	default "nRF51822_QFAB" if SOC_NRF51822_QFAB
	default "nRF51822_QFAC" if SOC_NRF51822_QFAC
```

## soc/nordic_nrf/nrf52/Kconfig.defconfig.nrf52840_QFAA
```kconfig
# Nordic Semiconductor nRF52840 MCU

# Copyright (c) 2023 Nordic Semiconductor ASA
# SPDX-License-Identifier: Apache-2.0

if SOC_NRF52840_QFAA

config SOC
	default "nRF52840_QFAA"

config NUM_IRQS
	default 48

endif # SOC_NRF52840_QFAA
```

## soc/nordic_nrf/nrf52/Kconfig.soc
```kconfig
# Nordic Semiconductor nRF52 MCU line, Zephyr hw model v2 compliant

# Copyright (c) 2022-2023 Nordic Semiconductor ASA
# SPDX-License-Identifier: Apache-2.0

config SOC_SERIES_NRF52X
	select SOC_FAMILY_NRF
	help
	  Enable support for NRF52 MCU series

config SOC_NRF52805
	bool
	select SOC_SERIES_NRF52X

config SOC_NRF52810
	bool
	select SOC_SERIES_NRF52X

config SOC_NRF52811
	bool
	select SOC_SERIES_NRF52X

config SOC_NRF52820
	bool
	select SOC_SERIES_NRF52X

config SOC_NRF52832
	bool
	select SOC_SERIES_NRF52X

config SOC_NRF52833
	bool
	select SOC_SERIES_NRF52X

config SOC_NRF52840
	bool
	select SOC_SERIES_NRF52X

config SOC_NRF52805_CAAA
	bool
	select SOC_NRF52805

config SOC_NRF52810_QFAA
	bool
	select SOC_NRF52810

config SOC_NRF52811_QFAA
	bool
	select SOC_NRF52811

config SOC_NRF52820_QDAA
	bool
	select SOC_NRF52820

config SOC_NRF52832_CIAA
	bool
	select SOC_NRF52832

config SOC_NRF52832_QFAA
	bool
	select SOC_NRF52832

config SOC_NRF52832_QFAB
	bool
	select SOC_NRF52832

config SOC_NRF52833_QDAA
	bool
	select SOC_NRF52833

config SOC_NRF52833_QIAA
	bool
	select SOC_NRF52833

config SOC_NRF52840_QFAA
	bool
	select SOC_NRF52840

config SOC_NRF52840_QIAA
	bool
	select SOC_NRF52840

config SOC
	default "nRF52805_CAAA" if SOC_NRF52805_CAAA
	default "nRF52810_QFAA" if SOC_NRF52810_QFAA
	default "nRF52811_QFAA" if SOC_NRF52811_QFAA
	default "nRF52820_QDAA" if SOC_NRF52820_QDAA
	default "nRF52832_CIAA" if SOC_NRF52832_CIAA
	default "nRF52832_QFAA" if SOC_NRF52832_QFAA
	default "nRF52832_QFAB" if SOC_NRF52832_QFAB
	default "nRF52833_QDAA" if SOC_NRF52833_QDAA
	default "nRF52833_QIAA" if SOC_NRF52833_QIAA
	default "nRF52840_QFAA" if SOC_NRF52840_QFAA
	default "nRF52840_QIAA" if SOC_NRF52840_QIAA
```

## soc/nordic_nrf/nrf53/Kconfig.soc
```kconfig
# Nordic Semiconductor nRF52 MCU line, Zephyr hw model v2 compliant

# Copyright (c) 2023 Nordic Semiconductor ASA
# SPDX-License-Identifier: Apache-2.0

config SOC_SERIES_NRF53X
	bool
	select SOC_FAMILY_NRF
	help
	 Enable support for NRF53 MCU series

config SOC_NRF5340_CPUAPP
	bool
	select SOC_SERIES_NRF53X

config SOC_NRF5340_CPUNET
	bool
	select SOC_SERIES_NRF53X

config SOC_NRF5340_CPUAPP_QKAA
	bool
	select SOC_NRF5340_CPUAPP

config SOC_NRF5340_CPUNET_QKAA
	bool
	select SOC_NRF5340_CPUNET

config SOC
	default "nRF5340_CPUAPP_QKAA" if SOC_NRF5340_CPUAPP_QKAA
	default "nRF5340_CPUNET_QKAA" if SOC_NRF5340_CPUNET_QKAA
```

## soc/nordic_nrf/nrf54l/Kconfig
```kconfig
# Nordic Semiconductor nRF54 MCU line

# Copyright (c) 2024 Nordic Semiconductor ASA
# SPDX-License-Identifier: Apache-2.0

config SOC_SERIES_NRF54LX
	select HAS_NRFX
	select HAS_NORDIC_DRIVERS
	select HAS_SEGGER_RTT if ZEPHYR_SEGGER_MODULE

config SOC_NRF54L15_ENGA_CPUAPP
	select ARM
	select ARMV8_M_DSP
	select CPU_CORTEX_M33
	select CPU_HAS_ARM_MPU
	select CPU_HAS_ICACHE
	select CPU_HAS_ARM_SAU
	select CPU_HAS_FPU
	select HAS_HW_NRF_RADIO_IEEE802154
	select HAS_POWEROFF

if SOC_SERIES_NRF54LX

config SOC_NRF54LX_SKIP_CLOCK_CONFIG
	bool "Skip clock frequency configuration in system initialization"
	help
	  With this option, the CPU clock frequency is not set during system initialization.
	  The CPU runs with the default, hardware-selected frequency.

config SOC_NRF_FORCE_CONSTLAT
	bool "Force constant-latency mode"
	help
	  In constant latency mode the CPU wakeup latency and the PPI task response
	  will be constant and kept at a minimum. This is secured by forcing a set
	  of base resources on while in sleep. The advantage of having a constant
	  and predictable latency will be at the cost of having increased power consumption.

config SOC_NRF54L_VREG_MAIN_DCDC
	bool "NRF54L DC/DC converter."
	help
	  To enable, an inductor must be connected to the DC/DC converter pin.

config SOC_NRF54L_NORMAL_VOLTAGE_MODE
	bool "NRF54L Normal Voltage Mode."

config SOC_NRF54L_GLITCHDET_WORKAROUND
	bool "Workaround that disables glitch detector"
	default y
	help
	  Temporary workaround - disabling glitch detector to limit power consumption.

if NRF_GRTC_TIMER

config ELV_GRTC_LFXO_ALLOWED
	bool
	depends on NRF_GRTC_SLEEP_ALLOWED
	select EXPERIMENTAL
	help
	  This feature allows using ELV mode when GRTC operates with the LFXO as
	  a low-frequency clock source. The LFXO is automatically activated when
	  preparing to system-off.
	  WARNING! This feature is EXPERIMENTAL and may brick your device!

endif # NRF_GRTC_TIMER

endif # SOC_SERIES_NRF54LX
```

## soc/nordic_nrf/nrf91/Kconfig
```kconfig
# Nordic Semiconductor nRF91 MCU line

# Copyright (c) 2018 Nordic Semiconductor ASA
# SPDX-License-Identifier: Apache-2.0

if SOC_SERIES_NRF91X

config NRF_ENABLE_ICACHE
	bool "Instruction cache (I-Cache)"
	default y

endif # SOC_SERIES_NRF91X
```

## soc/nuvoton/nct/Kconfig
```kconfig
# Nuvoton Cortex-M4 Embedded Controller

# Copyright (c) 2025 Nuvoton Technology Corporation.
# SPDX-License-Identifier: Apache-2.0

if SOC_FAMILY_NCT

endif # SOC_FAMILY_NCT

# Select SoC Part No. and configuration options
rsource "*/Kconfig"
```

## soc/nuvoton/nct/Kconfig.defconfig
```kconfig
# SPDX-License-Identifier: Apache-2.0

# Copyright (c) 2025 Nuvoton Technology Corporation.
# SPDX-License-Identifier: Apache-2.0

if SOC_FAMILY_NCT

rsource "*/Kconfig.defconfig"

endif # SOC_FAMILY_NCT
```

## soc/nuvoton/nct/Kconfig.soc
```kconfig
# Nuvoton Cortex-M4 Embedded Controller

# Copyright (c) 2025 Nuvoton Technology Corporation.
# SPDX-License-Identifier: Apache-2.0

config SOC_FAMILY_NCT
	bool

config SOC_FAMILY
	default "nuvoton_nct" if SOC_FAMILY_NCT

rsource "*/Kconfig.soc"
```

## soc/nuvoton/nct/nct6/Kconfig
```kconfig
# Nuvoton Cortex-M4 Embedded Controller NCT6 series

# Copyright (c) 2025 Nuvoton Technology Corporation.
# SPDX-License-Identifier: Apache-2.0

config SOC_SERIES_NCT6
	select ARM
	select CPU_CORTEX_M4
	select CPU_CORTEX_M_HAS_DWT
	select SOC_FAMILY_NCT
	select CPU_HAS_ARM_MPU
	help
	  Enable support for Nuvoton NCT6 series

config USBH_OHCI
    bool "Enable Nuvoton NCT USB OHCI Host Driver"
    default y
    help
      Enable support for USB OHCI host controller.
      
config USBH_HID
    bool "Enable USB Host HID"
    default y
    depends on USBH_OHCI
    help
      Enable support for HID on USBH.

config USBH_INIT_PRIORITY
    int "USBH initialization priority"
    default 50
```

## soc/nuvoton/nct/nct6/Kconfig.defconfig
```kconfig
# Nuvoton Cortex-M4 Embedded Controller

# Copyright (c) 2025 Nuvoton Technology Corporation.
# SPDX-License-Identifier: Apache-2.0

if SOC_SERIES_NCT6

config NUM_IRQS
	default 82

config CORTEX_M_SYSTICK
	default !NCT_ITIM_SYSTICK

config ESPI_TAF_NCT
	default y
	depends on ESPI_SAF

DT_CHOSEN_Z_FLASH := zephyr,flash

config FLASH_SIZE
	int "Flash Size in kB"
	default $(dt_chosen_reg_size_int,$(DT_CHOSEN_Z_FLASH),0,K) if !XIP
	help
	  This option specifies the size of the flash in kB.  It is normally set by
	  the board's defconfig file and the user should generally avoid modifying
	  it via the menu configuration.

config FLASH_BASE_ADDRESS
	hex "Flash Base Address"
	default $(dt_chosen_reg_addr_hex,$(DT_CHOSEN_Z_FLASH)) if !XIP
	help
	  This option specifies the base address of the flash on the board. It is
	  normally set by the board's defconfig file and the user should generally
	  avoid modifying it via the menu configuration.

config ROM_START_OFFSET
	default 0x0
	
config ENTER_CPU_IDLE_HOOK
	bool "CPU idle hook enable"
	default n
	imply ARM_ON_ENTER_CPU_IDLE_HOOK
	help
	  Enables a hook (z_arm_on_enter_cpu_idle()) that is called when
	  the CPU is made idle (by k_cpu_idle() or k_cpu_atomic_idle()).
	  If needed, this hook can be used to prevent the CPU from actually
	  entering sleep by skipping the WFE/WFI instruction.

config ESIO_EXT_SIGN
	bool "Use external signing tool"
	default n	

endif # SOC_SERIES_NCT6
```

## soc/nuvoton/nct/nct6/Kconfig.soc
```kconfig
# Nuvoton Cortex-M4 Embedded Controller NCT6 series

# Copyright (c) 2025 Nuvoton Technology Corporation.
# SPDX-License-Identifier: Apache-2.0

config SOC_SERIES_NCT6
	bool
	select SOC_FAMILY_NCT
	help
	  Enable support for Nuvoton NCT6 series

config SOC_NCT6694B
	bool
	select SOC_SERIES_NCT6
	help
	  NCT6694B

config SOC_SERIES
	default "nct6" if SOC_SERIES_NCT6

config SOC
	default "nct6694b" if SOC_NCT6694B
```

## soc/nuvoton/nct/nct66/Kconfig
```kconfig
# Nuvoton Cortex-M4 Embedded Controller NCT66 series

# Copyright (c) 2025 Nuvoton Technology Corporation.
# SPDX-License-Identifier: Apache-2.0

config SOC_SERIES_NCT66
	select ARM
	select CPU_CORTEX_M4
	select CPU_CORTEX_M_HAS_DWT
	select SOC_FAMILY_NCT
	select CPU_HAS_ARM_MPU
	help
	  Enable support for Nuvoton NCT66 series
```

## soc/nuvoton/nct/nct66/Kconfig.soc
```kconfig
# Nuvoton Cortex-M4 Embedded Controller NCT66 series

# Copyright (c) 2025 Nuvoton Technology Corporation.
# SPDX-License-Identifier: Apache-2.0

config SOC_SERIES_NCT66
	bool
	select SOC_FAMILY_NCT
	help
	  Enable support for Nuvoton NCT6 series

config SOC_NCT6694B
	bool
	select SOC_SERIES_NCT66
	help
	  NCT6694B

config SOC_SERIES
	default "nct66" if SOC_SERIES_NCT66

config SOC
	default "nct6694b" if SOC_NCT6694B
```

## soc/nuvoton/nct/nct68/Kconfig.soc
```kconfig
# Nuvoton Cortex-M4 Embedded Controller NCT68 series

# Copyright (c) 2025 Nuvoton Technology Corporation.
# SPDX-License-Identifier: Apache-2.0

config SOC_SERIES_NCT68
	bool
	select SOC_FAMILY_NCT
	help
	  Enable support for Nuvoton NCT6 series

config SOC_NCT6832D
	bool
	select SOC_SERIES_NCT68
	help
	  NCT6832D

config SOC_SERIES
	default "nct68" if SOC_SERIES_NCT68

config SOC
	default "nct6832d" if SOC_NCT6832D
```

## soc/nuvoton/npcm/Kconfig
```kconfig
# Copyright (c) 2024 Nuvoton Technology Corporation.
#
# SPDX-License-Identifier: Apache-2.0

if SOC_FAMILY_NPCM

rsource "*/Kconfig"

endif # SOC_FAMILY_NPCM
```

## soc/nuvoton/npcm/Kconfig.soc
```kconfig
# Copyright (c) 2024 Nuvoton Technology Corporation.
#
# SPDX-License-Identifier: Apache-2.0

config SOC_FAMILY_NPCM
	bool

config SOC_FAMILY
	default "npcm" if SOC_FAMILY_NPCM

rsource "*/Kconfig.soc"
```

## soc/nuvoton/npcm/npcm4/Kconfig
```kconfig
# Copyright (c) 2024 Nuvoton Technology Corporation.
#
# SPDX-License-Identifier: Apache-2.0

config SOC_SERIES_NPCM4
	select ARM
	select CPU_CORTEX_M4
	select CPU_CORTEX_M_HAS_DWT
	select CORTEX_M_SYSTICK
	select CPU_HAS_ARM_MPU
	select CLOCK_CONTROL
```

## soc/nuvoton/npcm/npcm4/Kconfig.defconfig
```kconfig
# Copyright (c) 2024 Nuvoton Technology Corporation.
#
# SPDX-License-Identifier: Apache-2.0

if SOC_SERIES_NPCM4

config NUM_IRQS
	default 82

config ROM_START_OFFSET
	default 0x600 if XIP
	default 0x0   if !XIP

endif # SOC_SERIES_NPCM4
```

## soc/nuvoton/npcm/npcm4/Kconfig.soc
```kconfig
# Copyright (c) 2024 Nuvoton Technology Corporation.
#
# SPDX-License-Identifier: Apache-2.0

config SOC_SERIES_NPCM4
	bool
	select SOC_FAMILY_NPCM
	help
	  Enable support for Nuvoton NPCM4 series

config SOC_NPCM400
	bool
	select SOC_SERIES_NPCM4

config SOC_SERIES
	default "npcm4" if SOC_SERIES_NPCM4

config SOC
	default "npcm400" if SOC_NPCM400
```

## soc/nuvoton/npcx/Kconfig.defconfig
```kconfig
# SPDX-License-Identifier: Apache-2.0

# Copyright (c) 2020 Nuvoton Technology Corporation.
# SPDX-License-Identifier: Apache-2.0

if SOC_FAMILY_NPCX

rsource "*/Kconfig.defconfig"

endif # SOC_FAMILY_NPCX
```

## soc/nuvoton/npcx/Kconfig.soc
```kconfig
# Nuvoton Cortex-M4 Embedded Controller

# Copyright (c) 2020 Nuvoton Technology Corporation.
# SPDX-License-Identifier: Apache-2.0

config SOC_FAMILY_NPCX
	bool

config SOC_FAMILY
	default "nuvoton_npcx" if SOC_FAMILY_NPCX

config NPCX_SOC_VARIANT_NPCXN
	bool
	select SOC_FAMILY_NPCX

config NPCX_SOC_VARIANT_NPCKN
	bool
	select SOC_FAMILY_NPCX

config NPCX_SOC_VARIANT
	string
	default "npcxn" if NPCX_SOC_VARIANT_NPCXN
	default "npckn" if NPCX_SOC_VARIANT_NPCKN

rsource "*/Kconfig.soc"
```

## soc/nuvoton/npcx/npck3/Kconfig.soc
```kconfig
# Nuvoton NPCK3 EC series

# Copyright (c) 2025 Nuvoton Technology Corporation.
# SPDX-License-Identifier: Apache-2.0

config SOC_SERIES_NPCK3
	bool
	select NPCX_SOC_VARIANT_NPCKN
	help
	  Enable support for Nuvoton NPCK3 series

config SOC_NPCK3M8K
	bool
	select SOC_SERIES_NPCK3
	help
	  NPCK3M8K

config SOC_SERIES
	default "npck3" if SOC_SERIES_NPCK3

config SOC
	default "npck3m8k" if SOC_NPCK3M8K
```
