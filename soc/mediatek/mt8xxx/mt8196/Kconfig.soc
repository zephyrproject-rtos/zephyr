## soc/mediatek/mt8xxx/mt8196/Kconfig.soc
```kconfig
# Copyright 2024 The ChromiumOS Authors
# SPDX-License-Identifier: Apache-2.0

config SOC_MT8196
	bool
	select SOC_SERIES_MT8196

config SOC_MT8196_ADSP
	bool
	select SOC_MT8196
	select SOC_MTK_ADSP
	help
	  Mediatek MT8196 audio DSP

config SOC
	default "mt8196" if SOC_MT8196
```

## soc/mediatek/mt8xxx/mt8365/Kconfig.defconfig
```kconfig
# Copyright 2025 Mediatek
# SPDX-License-Identifier: Apache-2.0

if SOC_MT8365

rsource "Kconfig.defconfig.*"

endif # SOC_MT8365
```

## soc/mediatek/mt8xxx/mt8365/Kconfig.soc
```kconfig
# Copyright 2025 Mediatek
# SPDX-License-Identifier: Apache-2.0

config SOC_MT8365
	bool
	select SOC_SERIES_MT8365

config SOC_MT8365_ADSP
	bool
	select SOC_MT8365
	select SOC_MTK_ADSP
	help
	  Mediatek MT8365 audio DSP

config SOC
	default "mt8365" if SOC_MT8365
```

## soc/microchip/common/Kconfig
```kconfig
# SPDX-FileCopyrightText: Copyright 2026 Muhammed Asif
# SPDX-License-Identifier: Apache-2.0

rsource "drivers/Kconfig"
```

## soc/microchip/common/drivers/Kconfig
```kconfig
# SPDX-FileCopyrightText: Copyright 2026 Muhammed Asif
# SPDX-License-Identifier: Apache-2.0

# zephyr-keep-sorted-start
rsource "mchp_evsys/Kconfig"
# zephyr-keep-sorted-stop
```

## soc/microchip/mec/mec15xx/Kconfig.defconfig.mec1501hsz
```kconfig
# Microchip MEC1501HSZ MCU

# Copyright (c) 2018 Intel Corporation
# SPDX-License-Identifier: Apache-2.0

if SOC_MEC1501_HSZ

config GPIO
	default y

config ESPI_XEC
	default y
	depends on ESPI

endif # SOC_MEC1501_HSZ
```

## soc/microchip/pic32c/pic32ck_sg_gc/Kconfig.defconfig
```kconfig
# Copyright (c) 2026 Microchip Technology Inc.
# SPDX-License-Identifier: Apache-2.0

if SOC_FAMILY_MICROCHIP_PIC32CK_SG_GC

config NUM_IRQS
	default 158

config SYS_CLOCK_HW_CYCLES_PER_SEC
	default $(dt_node_int_prop_int,/cpus/cpu@0,clock-frequency)

config ARM_TRUSTZONE_M
	default y
	depends on SOC_SERIES_PIC32CK_SG00 || SOC_SERIES_PIC32CK_SG01

config CPU_HAS_ARM_SAU
	default y
	depends on SOC_SERIES_PIC32CK_SG00 || SOC_SERIES_PIC32CK_SG01

endif # SOC_FAMILY_MICROCHIP_PIC32CK_SG_GC
```

## soc/microchip/pic32c/pic32cx_bz/Kconfig.defconfig
```kconfig
# Copyright (c) 2025 Microchip Technology Inc.
# SPDX-License-Identifier: Apache-2.0

config DEVICE_SUPPORT_REQUIRED
	bool
	default y if (BT || ENABLE_PMU_BUCK_MODE || IEEE802154)

config FPU
	default y if (BT || PM || CRYPTO || ENTROPY_GENERATOR || IEEE802154)

config IDLE_STACK_SIZE
	default 1024 if PM
	default 512 if BT

config MAIN_STACK_SIZE
	default 3072 if BT
	default 4096 if IEEE802154

config SYSTEM_WORKQUEUE_STACK_SIZE
	default 4096 if BT

config BT_RX_STACK_SIZE
	default 3072 if BT

config BT_HCI_ACL_FLOW_CONTROL
	default n if BT

config BUILD_OUTPUT_HEX
	default y

config BT_BUF_ACL_TX_COUNT
	default 10 if BT

config BT_BUF_EVT_RX_COUNT
	default 11 if BT

# To avoid error logs being printed periodically when BT does not allowed entering sleep mode
config PM_DEVICE_LOG_LEVEL
	default 0 if PM

config ENABLE_PMU_BUCK_MODE
	default y if PM

rsource "*/Kconfig.defconfig"
```

## soc/microchip/pic32c/pic32cx_bz/Kconfig.image_header
```kconfig
# Copyright (c) 2025 Microchip Technology Inc.
# SPDX-License-Identifier: Apache-2.0

menu "Image Header Settings"
	depends on SOC_FAMILY_MICROCHIP_PIC32CX_BZ6

config MD_SEQ_NUM
	hex "Metadata Sequence Number of the image"
	default 0xfffffffe

config AUTH_MTHD
	int "Metadata authentication method"
	range 0 0
	default 0
	help
	  0: None

config FW_IMG_REV
	hex "Firmware Image revision"
	default 0x01000000

endmenu
```

## soc/microchip/pic32c/pic32cx_bz/Kconfig.soc
```kconfig
# Copyright (c) 2025 Microchip Technology Inc.
# SPDX-License-Identifier: Apache-2.0

config ENABLE_PMU_BUCK_MODE
	bool "PMU Buck Mode support"

config CUSTOM_ANTENNA_GAIN
	int "Custom Antenna Gain (dBm)"
	default 3
	range -5 6

rsource "*/Kconfig.soc"
rsource "Kconfig.image_header"
rsource "Kconfig.system_config"
```

## soc/microchip/pic32c/pic32cx_bz/bz6x/Kconfig
```kconfig
# Copyright (c) 2025 Microchip Technology Inc.
# SPDX-License-Identifier: Apache-2.0

config SOC_FAMILY_MICROCHIP_PIC32CX_BZ6
	select ARM
	select MICROCHIP_PIC32C
	select CPU_CORTEX_M4
	select CPU_CORTEX_M_HAS_DWT
	select CPU_HAS_ARM_MPU
	select CPU_HAS_FPU
	select SOC_EARLY_INIT_HOOK
	select SOC_LATE_INIT_HOOK
	select HAS_CMSIS_CORE
	select HAS_SEGGER_RTT if ZEPHYR_SEGGER_MODULE
	select ARM_ON_ENTER_CPU_IDLE_PREPARE_HOOK if BT
	select HAS_PM

	select CLOCK_CONTROL
```

## soc/microchip/pic32c/pic32cx_bz/bz6x/Kconfig.defconfig
```kconfig
# Copyright (c) 2025 Microchip Technology Inc.
# SPDX-License-Identifier: Apache-2.0

if SOC_FAMILY_MICROCHIP_PIC32CX_BZ6

config NUM_IRQS
	default 58

config ROM_START_OFFSET
	default 0x400 if BOOTLOADER_MCUBOOT

config SYS_CLOCK_HW_CYCLES_PER_SEC
	default $(dt_node_int_prop_int,/cpus/cpu@0,clock-frequency)

config FLASH_LOAD_OFFSET
	default 0x200

endif # SOC_FAMILY_MICROCHIP_PIC32CX_BZ6
```

## soc/microchip/pic32c/pic32cx_bz/bz6x/Kconfig.soc
```kconfig
# Copyright (c) 2025 Microchip Technology Inc.
# SPDX-License-Identifier: Apache-2.0

config SOC_FAMILY_MICROCHIP_PIC32CX_BZ6
	bool

config SOC_FAMILY
	default "microchip_pic32cx_bz6" if SOC_FAMILY_MICROCHIP_PIC32CX_BZ6

config SOC_SERIES_REVISION_N
	bool
	depends on SOC_FAMILY_MICROCHIP_PIC32CX_BZ6

config SOC_SERIES_REVISION
	string
	default "n" if SOC_SERIES_REVISION_N
	default ""
	depends on SOC_FAMILY_MICROCHIP_PIC32CX_BZ6

config SOC_SERIES_PIC32CX_BZ62
	bool
	select SOC_FAMILY_MICROCHIP_PIC32CX_BZ6
	help
	  Enable support for Microchip PIC32CX_BZ6 Cortex-M4F microcontrollers.

config SOC_SERIES_PIC32CX_BZ66
	bool
	select SOC_FAMILY_MICROCHIP_PIC32CX_BZ6
	help
	  Enable support for Microchip PIC32CX_BZ6 Cortex-M4F microcontrollers.

config SOC_SERIES
	default "bz62" if SOC_SERIES_PIC32CX_BZ62
	default "bz66" if SOC_SERIES_PIC32CX_BZ66

config SOC_PIC32CX2051BZ62132
	bool
	select SOC_SERIES_PIC32CX_BZ62

config SOC_PIC32CX2051BZ62064
	bool
	select SOC_SERIES_PIC32CX_BZ62

config SOC_PIC32CX2051BZ66048
	bool
	select SOC_SERIES_PIC32CX_BZ66

config SOC
	default "pic32cx2051bz62132" if SOC_PIC32CX2051BZ62132
	default "pic32cx2051bz62064" if SOC_PIC32CX2051BZ62064
	default "pic32cx2051bz66048" if SOC_PIC32CX2051BZ66048
```

## soc/microchip/polarfire/Kconfig
```kconfig
# Copyright (c) 2026 Microchip Technology Inc
# SPDX-License-Identifier: Apache-2.0

if SOC_FAMILY_MICROCHIP_POLARFIRE

rsource "*/Kconfig"

endif # SOC_FAMILY_MICROCHIP_POLARFIRE
```

## soc/microchip/polarfire/Kconfig.defconfig
```kconfig
# Copyright (c) 2026 Microchip Technology Inc
# SPDX-License-Identifier: Apache-2.0

if SOC_FAMILY_MICROCHIP_POLARFIRE

rsource "*/Kconfig.defconfig"

endif # SOC_FAMILY_MICROCHIP_POLARFIRE
```

## soc/microchip/polarfire/Kconfig.soc
```kconfig
# Copyright (c) 2026 Microchip Technology Inc
# SPDX-License-Identifier: Apache-2.0

config SOC_FAMILY_MICROCHIP_POLARFIRE
	bool

config SOC_FAMILY
	default "microchip_polarfire" if SOC_FAMILY_MICROCHIP_POLARFIRE

rsource "*/Kconfig.soc"
```

## soc/microchip/sam/sam9/Kconfig
```kconfig
# Copyright (C) 2025-2026 Microchip Technology Inc.
#
# SPDX-License-Identifier: Apache-2.0
#

config SOC_FAMILY_MICROCHIP_SAM9
	select MICROCHIP_SAM
	select ARM
	select CPU_ARM926EJ_S
	select ARM_CUSTOM_INTERRUPT_CONTROLLER
	select ATOMIC_OPERATIONS_C if "$(ZEPHYR_TOOLCHAIN_VARIANT)" = "zephyr"
```

## soc/microchip/sam/sam9/Kconfig.defconfig
```kconfig
# Copyright (C) 2025-2026 Microchip Technology Inc.
#
# SPDX-License-Identifier: Apache-2.0
#

if SOC_FAMILY_MICROCHIP_SAM9

configdefault SOC_EARLY_INIT_HOOK
	default y

configdefault CLOCK_CONTROL
	default y

endif # SOC_FAMILY_MICROCHIP_SAM9

rsource "*/Kconfig.defconfig"
```

## soc/microchip/sam/sam9/Kconfig.soc
```kconfig
# Copyright (C) 202-2026 Microchip Technology Inc.
#
# SPDX-License-Identifier: Apache-2.0
#

config SOC_FAMILY_MICROCHIP_SAM9
	bool
	help
	  Enable support for Microchip SAM9 ARM926EJ-S Microprocessors.

config SOC_FAMILY
	default "microchip_sam9" if SOC_FAMILY_MICROCHIP_SAM9

rsource "*/Kconfig.soc"
```

## soc/microchip/sam/sam9/sam9x7/Kconfig.defconfig
```kconfig
# Copyright (C) 2025-2026 Microchip Technology Inc.
#
# SPDX-License-Identifier: Apache-2.0
#

if SOC_SERIES_SAM9X7

DT_CHOSEN_Z_SYS_TIMER := zephyr,system-timer

configdefault NUM_IRQS
	default 102

configdefault SYS_CLOCK_HW_CYCLES_PER_SEC
	default $(dt_node_int_prop_int,$(dt_chosen_path,$(DT_CHOSEN_Z_SYS_TIMER)),clock-frequency)

endif # SOC_SERIES_SAM9X7
```

## soc/nordic/nrf71/Kconfig.soc
```kconfig
# Nordic Semiconductor nRF71 MCU line

# Copyright (c) 2025 Nordic Semiconductor ASA
# SPDX-License-Identifier: Apache-2.0

config SOC_SERIES_NRF71
	bool
	select SOC_FAMILY_NORDIC_NRF
	help
	  Nordic Semiconductor nRF71 series MCU

config SOC_NRF7120
	bool
	select SOC_SERIES_NRF71
	help
	  NRF7120

config SOC_SERIES
	default "nrf71" if SOC_SERIES_NRF71

config SOC_NRF7120_CPUAPP
	bool
	select SOC_NRF7120
	help
	  NRF7120 CPUAPP

config SOC_NRF7120_CPUFLPR
	bool
	select SOC_NRF7120
	help
	  NRF7120 CPUFLPR

config SOC_NRF7120E
	bool
	select SOC_SERIES_NRF71
	help
	  NRF7120E

config SOC_NRF7120E_CPUAPP
	bool
	select SOC_NRF7120E
	help
	  NRF7120E CPUAPP

config SOC_NRF7120E_CPUFLPR
	bool
	select SOC_NRF7120E
	help
	  NRF7120E CPUFLPR

config SOC
	default "nrf7120" if SOC_NRF7120
	default "nrf7120e" if SOC_NRF7120E
```
