## soc/ambiq/apollo3x/Kconfig.soc
```kconfig
# SPDX-License-Identifier: Apache-2.0
#
# Copyright (c) 2023 Ambiq Micro Inc. <www.ambiq.com>

config SOC_SERIES_APOLLO3X
	bool
	select SOC_FAMILY_AMBIQ
	help
	  Apollo3 Series MCU

config SOC_APOLLO3P_BLUE
	bool
	select SOC_SERIES_APOLLO3X
	select SOC_AMBIQ_BT_SUPPORTED
	help
	  Apollo3P Blue

config SOC_APOLLO3_BLUE
	bool
	select SOC_SERIES_APOLLO3X
	select SOC_AMBIQ_BT_SUPPORTED
	help
	  Apollo3 Blue

config SOC_SERIES
	default "apollo3x" if SOC_SERIES_APOLLO3X

config SOC
	default "apollo3_blue" if SOC_APOLLO3_BLUE
	default "apollo3p_blue" if SOC_APOLLO3P_BLUE
```

## soc/ambiq/apollo4x/Kconfig
```kconfig
# SPDX-License-Identifier: Apache-2.0
#
# Copyright (c) 2023 Antmicro <www.antmicro.com>
# Copyright (c) 2023 Ambiq Micro Inc. <www.ambiq.com>

config SOC_SERIES_APOLLO4X
	select ARM
	select CPU_CORTEX_M4
	select CPU_CORTEX_M_HAS_DWT
	select CPU_HAS_FPU
	select CPU_HAS_ARM_MPU
	select HAS_SWO
	select AMBIQ_HAL
	select HAS_PM
	select SOC_EARLY_INIT_HOOK
```

## soc/ambiq/apollo4x/Kconfig.defconfig
```kconfig
# SPDX-License-Identifier: Apache-2.0
#
# Copyright (c) 2023 Antmicro <www.antmicro.com>

if SOC_SERIES_APOLLO4X

rsource "Kconfig.defconfig.apollo4*"

# Need to enlarge the IDLE stack size because the power
# management operations are executed in the idle task
config IDLE_STACK_SIZE
	default 2048 if PM

endif # SOC_SERIES_APOLLO4X
```

## soc/ambiq/apollo4x/Kconfig.defconfig.apollo4p
```kconfig
# SPDX-License-Identifier: Apache-2.0
#
# Copyright (c) 2023 Antmicro <www.antmicro.com>

if SOC_APOLLO4P

config NUM_IRQS
	default 83

endif # SOC_APOLLO4P
```

## soc/ambiq/apollo4x/Kconfig.defconfig.apollo4p_blue
```kconfig
# SPDX-License-Identifier: Apache-2.0
#
# Copyright (c) 2023 Ambiq Micro Inc. <www.ambiq.com>

if SOC_APOLLO4P_BLUE

config NUM_IRQS
	default 83

endif # SOC_APOLLO4P_BLUE
```

## soc/ambiq/apollo4x/Kconfig.soc
```kconfig
# SPDX-License-Identifier: Apache-2.0
#
# Copyright (c) 2023 Antmicro <www.antmicro.com>
# Copyright (c) 2023 Ambiq Micro Inc. <www.ambiq.com>

config SOC_SERIES_APOLLO4X
	bool
	select SOC_FAMILY_AMBIQ

config SOC_APOLLO4P
	bool
	select SOC_SERIES_APOLLO4X

config SOC_APOLLO4P_BLUE
	bool
	select SOC_SERIES_APOLLO4X

config SOC_SERIES
	default "apollo4x" if SOC_SERIES_APOLLO4X

config SOC
	default "apollo4p" if SOC_APOLLO4P
	default "apollo4p_blue" if SOC_APOLLO4P_BLUE
```

## soc/ambiq/apollo5x/Kconfig
```kconfig
# SPDX-License-Identifier: Apache-2.0
#
# Copyright (c) 2025 Ambiq Micro Inc.

config SOC_SERIES_APOLLO5X
	select ARM
	select CPU_CORTEX_M55
	select CPU_CORTEX_M_HAS_DWT
	select CPU_CORTEX_M_HAS_VTOR
	select CPU_HAS_ARM_SAU
	select CPU_HAS_ARM_MPU
	select CPU_HAS_FPU
	select ARMV8_M_DSP
	select ARMV8_1_M_MVEI
	select ARMV8_1_M_MVEF
	select ARMV8_1_M_PMU
	select HAS_SWO
	select AMBIQ_HAL
	select HAS_PM
	select SOC_EARLY_INIT_HOOK
	select REQUIRES_FULL_LIBC

config SOC_AMBIQ_HAS_PUF
	bool "Ambiq PUF support"
	default y
	help
	  This option enables the Ambiq PUF support.
	  It is required for the true random number generator.

config SOC_AMBIQ_DCACHE_SIZE
	int
	default 65536 if SOC_APOLLO510

config SOC_AMBIQ_DMA_BUFF_LOCATION
	hex "Byte offset to SRAM_BASE_ADDRESS"
	default 0x50000
	help
	  This option specifies the cacheable DMA buffers' start address

config SOC_AMBIQ_DMA_BUFF_ALIGNMENT
	int "Byte alignment of the DMA buffer"
	default DCACHE_LINE_SIZE if DCACHE
	default 1
	help
	  This option specifies the DMA buffers' alignment

config ARMV8_1_M_PMU_EVENTCNT
	int
	default 8 if SOC_APOLLO510
```

## soc/ambiq/apollo5x/Kconfig.defconfig
```kconfig
# SPDX-License-Identifier: Apache-2.0
#
# Copyright (c) 2025 Ambiq Micro Inc.

if SOC_SERIES_APOLLO5X

rsource "Kconfig.defconfig.apollo5*"

config CACHE_MANAGEMENT
	default y

configdefault DCACHE_LINE_SIZE
	default 32

config DCACHE
	default y

config ICACHE
	default y

# Need to enlarge the IDLE stack size because the power
# management operations are executed in the idle task
config IDLE_STACK_SIZE
	default 2048 if PM

configdefault FLASH_MSPI_RANGE_HANDLE_CACHE_SIZE
	default SOC_AMBIQ_DCACHE_SIZE

configdefault MSPI_AMBIQ_BUFF_RAM_LOCATION
	default SOC_AMBIQ_DMA_BUFF_LOCATION

configdefault MSPI_AMBIQ_BUFF_ALIGNMENT
	default SOC_AMBIQ_DMA_BUFF_ALIGNMENT

endif # SOC_SERIES_APOLLO5X
```

## soc/ambiq/apollo5x/Kconfig.defconfig.apollo510
```kconfig
# SPDX-License-Identifier: Apache-2.0
#
# Copyright (c) 2025 Ambiq Micro Inc.

if SOC_APOLLO510

config NUM_IRQS
	default 134

config HAS_CPU_FREQ
	def_bool y

config SOC_AMBIQ_DCACHE_SIZE
	default 65536

endif # SOC_APOLLO510
```

## soc/ambiq/apollo5x/Kconfig.gpu
```kconfig
# SPDX-License-Identifier: Apache-2.0
#
# Copyright (c) 2025 Ambiq Micro Inc.

config GPU_AMBIQ
	bool "Ambiq GPU Driver"
	default y
	depends on DT_HAS_AMBIQ_NEMA_GPU_ENABLED
	help
	  Enables the GPU driver for Ambiq devices.

if GPU_AMBIQ
module = GPU_AMBIQ
module-str = gpu_ambiq
source "subsys/logging/Kconfig.template.log_config"

config GPU_AMBIQ_INIT_PRIORITY
	int "Init priority"
	default 91
	help
	  Ambiq GPU driver initialization priority.
endif
```

## soc/ambiq/apollo5x/Kconfig.soc
```kconfig
# SPDX-License-Identifier: Apache-2.0
#
# Copyright (c) 2025 Ambiq Micro Inc.

config SOC_SERIES_APOLLO5X
	bool
	select SOC_FAMILY_AMBIQ
	help
	  Apollo5 Series MCU

config SOC_APOLLO510
    bool
	select SOC_SERIES_APOLLO5X

config ARMV8_1_M_PMU_EVENTCNT
    int
    default 8

config SOC_SERIES
	default "apollo5x" if SOC_SERIES_APOLLO5X

config SOC
	default "apollo510" if SOC_APOLLO510
```

## soc/amd/acp_6_0/Kconfig
```kconfig
# Copyright 2024 AMD
# SPDX-License-Identifier: Apache-2.0
config SOC_ACP_6_0
	select XTENSA
	select XTENSA_GEN_HANDLERS
	select XTENSA_HAL if ("$(ZEPHYR_TOOLCHAIN_VARIANT)" != "xcc" && "$(ZEPHYR_TOOLCHAIN_VARIANT)" != "xt-clang")
	select XTENSA_RESET_VECTOR
	select ATOMIC_OPERATIONS_BUILTIN
```

## soc/amd/acp_6_0/Kconfig.defconfig
```kconfig
# Copyright (c) 2024 AMD
# SPDX-License-Identifier: Apache-2.0

if SOC_ACP_6_0
config DCACHE_LINE_SIZE
	default 128

config CACHE_MANAGEMENT
	default n

config XTENSA_TIMER
	default y

config SYS_CLOCK_HW_CYCLES_PER_SEC
	default 600000000 if XTENSA_TIMER

config MULTI_LEVEL_INTERRUPTS
	default n

config 2ND_LEVEL_INTERRUPTS
	default n

config KERNEL_ENTRY
	default "__start"
endif
```

## soc/amd/acp_6_0/Kconfig.soc
```kconfig
# Copyright (c) 2024 AMD
# SPDX-License-Identifier: Apache-2.0

config SOC_ACP_6_0
	bool

config SOC
	default "acp_6_0" if SOC_ACP_6_0

config SOC_TOOLCHAIN_NAME
	string
	default "amd_acp_6_0_adsp" if SOC_ACP_6_0
```

## soc/amd/acp_7_0/Kconfig
```kconfig
# Copyright (c) 2026 AMD
# SPDX-License-Identifier: Apache-2.0

config SOC_ACP_7_0
	select XTENSA
	select XTENSA_HAL if ("$(ZEPHYR_TOOLCHAIN_VARIANT)" != "xcc" && "$(ZEPHYR_TOOLCHAIN_VARIANT)" != "xt-clang")
	select ATOMIC_OPERATIONS_C
```

## soc/amd/acp_7_0/Kconfig.defconfig
```kconfig
# Copyright (c) 2026 AMD
# SPDX-License-Identifier: Apache-2.0

if SOC_ACP_7_0

config DCACHE
	default y

choice CACHE_TYPE
	default ARCH_CACHE
endchoice

config DCACHE_LINE_SIZE
	default 128

config CACHE_MANAGEMENT
	default y

config XTENSA_TIMER
	default y

config SYS_CLOCK_HW_CYCLES_PER_SEC
	default $(dt_node_int_prop_int,/cpus/cpu@0,clock-frequency)

config KERNEL_ENTRY
	default "__start"

endif # SOC_ACP_7_0
```

## soc/amd/acp_7_0/Kconfig.soc
```kconfig
# Copyright (c) 2026 AMD
# SPDX-License-Identifier: Apache-2.0

config SOC_ACP_7_0
	bool

config SOC
	default "acp_7_0" if SOC_ACP_7_0

config SOC_TOOLCHAIN_NAME
	string
	default "amd_acp_7_0_adsp" if SOC_ACP_7_0
```

## soc/amd/acp_7_x/Kconfig
```kconfig
# SPDX-FileCopyrightText: Copyright (c) 2026 AMD
# SPDX-License-Identifier: Apache-2.0

config SOC_ACP_7_X
	select XTENSA
	select XTENSA_HAL if ("$(ZEPHYR_TOOLCHAIN_VARIANT)" != "xcc" && "$(ZEPHYR_TOOLCHAIN_VARIANT)" != "xt-clang")
	select ATOMIC_OPERATIONS_C
```

## soc/amd/acp_7_x/Kconfig.soc
```kconfig
# SPDX-FileCopyrightText: Copyright (c) 2026 AMD
# SPDX-License-Identifier: Apache-2.0

config SOC_ACP_7_X
	bool

config SOC
	default "acp_7_x" if SOC_ACP_7_X

config SOC_TOOLCHAIN_NAME
	string
	default "amd_acp_7_3_adsp" if SOC_ACP_7_X
```

## soc/andestech/Kconfig
```kconfig
# Copyright (c) 2024 Nordic Semiconductor ASA
# SPDX-License-Identifier: Apache-2.0

if SOC_FAMILY_ANDES_V5

rsource "*/Kconfig"

endif # SOC_FAMILY_ANDES_V5
```

## soc/andestech/Kconfig.soc
```kconfig
# Copyright (c) 2024 Nordic Semiconductor ASA
# SPDX-License-Identifier: Apache-2.0

config SOC_FAMILY_ANDES_V5
	bool

config SOC_FAMILY
	default "andes_v5" if SOC_FAMILY_ANDES_V5

rsource "*/Kconfig.soc"
```

## soc/andestech/ae350/Kconfig.defconfig
```kconfig
# Copyright (c) 2021 Andes Technology Corporation
# SPDX-License-Identifier: Apache-2.0

if SOC_SERIES_ANDES_AE350

rsource "Kconfig.defconfig.ae*"

config SYS_CLOCK_HW_CYCLES_PER_SEC
	default 60000000

config RISCV_GENERIC_TOOLCHAIN
	default y if "$(ZEPHYR_TOOLCHAIN_VARIANT)" = "zephyr"
	default n

config RISCV_SOC_INTERRUPT_INIT
	default y

if RISCV_HAS_PLIC

config 2ND_LVL_ISR_TBL_OFFSET
	default 12

config 2ND_LVL_INTR_00_OFFSET
	default 11

config 2ND_LVL_INTR_01_OFFSET
	default 3

config MAX_IRQ_PER_AGGREGATOR
	default 52

config NUM_2ND_LEVEL_AGGREGATORS
	default 2

config NUM_IRQS
	default 116

endif # RISCV_HAS_PLIC

if RISCV_HAS_CLIC

config NUM_IRQS
	default 48

config RISCV_MCAUSE_EXCEPTION_MASK
	default 0xFFF

config ARCH_IRQ_VECTOR_TABLE_ALIGN
	default 512 if RISCV_ISA_RV64I
	default 256

endif # RISCV_HAS_CLIC

choice CACHE_TYPE
	default EXTERNAL_CACHE
endchoice

endif # SOC_SERIES_ANDES_AE350
```

## soc/antmicro/myra/Kconfig
```kconfig
# Copyright (c) 2024 Antmicro <www.antmicro.com>
# SPDX-License-Identifier: Apache-2.0

config SOC_MYRA
	select SOC_STM32G491XX
```

## soc/antmicro/myra/Kconfig.soc
```kconfig
# Copyright (c) 2024 Antmicro <www.antmicro.com>
# SPDX-License-Identifier: Apache-2.0

# The Myra is technically a SiP (System-in-Package) that consists of
# the STM32G491REI6 MCU and additional components like FRAM. So for
# Antmicro Myra SiP Baseboard the STM32G491XX SoC is to be indicated as
# the build target, but since the Myra SiP is what a user can actually
# see on a board, using only STM32G491XX in the Zephyr build
# infrastructure might be confusing. That's why in the top level of SoC
# definitions (for user-configurable options in Kconfig, for example)
# the Myra term is used and STM32G491XX underneath.
config SOC_MYRA
	bool
	help
	  Antmicro Myra System-in-Package

config SOC
	default "myra" if SOC_MYRA
```

## soc/arc/quark_se_c1000_ss/Kconfig
```kconfig
#
# Copyright (c) 2016 Intel Corporation
#
# SPDX-License-Identifier: Apache-2.0
#

if ARC && SOC_QUARK_SE_C1000_SS

if IPM
config QUARK_SE_SS_IPM_IRQ_PRI
	int "IPM interrupt priority"
	default 1
	help
	  Priority level for interrupts coming in from the inter-processor
	  mailboxes.

endif # IPM
endif # SOC_QUARK_SE_C1000_SS
```
