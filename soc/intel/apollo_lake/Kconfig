## soc/intel/apollo_lake/Kconfig
```kconfig
# Copyright (c) 2018-2024 Intel Corporation Inc.
# SPDX-License-Identifier: Apache-2.0

config SOC_APOLLO_LAKE
	select X86
	select X86_64
	select CPU_APOLLO_LAKE
	select PCIE
	select PCIE_MSI
	select DYNAMIC_INTERRUPTS
	select X86_MMU
	select ARCH_HAS_RESERVED_PAGE_FRAMES
```

## soc/intel/apollo_lake/Kconfig.defconfig
```kconfig
# Apollo Lake SoC configuration options

# Copyright (c) 2018-2019 Intel Corporation
# Copyright (c) 2014-2015 Wind River Systems, Inc.
# SPDX-License-Identifier: Apache-2.0

if SOC_APOLLO_LAKE

config PCIE_MMIO_CFG
	default y

if APIC_TIMER

config APIC_TIMER_IRQ
	default 24

endif # APIC_TIMER

config X86_DYNAMIC_IRQ_STUBS
	default 16
	depends on DYNAMIC_INTERRUPTS

endif # SOC_APOLLO_LAKE
```

## soc/intel/apollo_lake/Kconfig.soc
```kconfig
# Copyright (c) 2018-2024 Intel Corporation Inc.
# SPDX-License-Identifier: Apache-2.0

config SOC_APOLLO_LAKE
	bool

config SOC
	default "apollo_lake" if SOC_APOLLO_LAKE
```

## soc/intel/atom/Kconfig
```kconfig
# SPDX-License-Identifier: Apache-2.0
# Copyright (c) 2011-2014, Wind River Systems, Inc.

config SOC_ATOM
	select X86
	select CPU_ATOM
	imply X86_MMU
	select ARCH_HAS_RESERVED_PAGE_FRAMES
```

## soc/intel/elkhart_lake/Kconfig
```kconfig
# Copyright (c) 2018-2024 Intel Corporation Inc.
# SPDX-License-Identifier: Apache-2.0

config SOC_ELKHART_LAKE
	select X86
	select X86_64
	select CPU_ATOM
	select PCIE
	select PCIE_MSI
	select DYNAMIC_INTERRUPTS
	select X86_MMU
```

## soc/intel/elkhart_lake/Kconfig.defconfig
```kconfig
# Elkhart Lake SoC configuration options

# Copyright (c) 2018-2020 Intel Corporation
# Copyright (c) 2014-2015 Wind River Systems, Inc.
# SPDX-License-Identifier: Apache-2.0

if SOC_ELKHART_LAKE

config PCIE_MMIO_CFG
	default y

config X86_DYNAMIC_IRQ_STUBS
	default 16
	depends on DYNAMIC_INTERRUPTS

endif # SOC_ELKHART_LAKE
```

## soc/intel/elkhart_lake/Kconfig.soc
```kconfig
# Copyright (c) 2018-2024 Intel Corporation Inc.
# SPDX-License-Identifier: Apache-2.0

config SOC_ELKHART_LAKE
	bool

config SOC
	default "elkhart_lake" if SOC_ELKHART_LAKE
```

## soc/intel/intel_adsp/Kconfig
```kconfig
# Intel CAVS SoC family configuration options
#
# Copyright (c) 2020-2024 Intel Corporation
# SPDX-License-Identifier: Apache-2.0

config SOC_FAMILY_INTEL_ADSP
	select WINSTREAM
	select ARCH_SUPPORTS_COREDUMP
	select CPU_HAS_DCACHE
	select CPU_HAS_ICACHE
	select ARCH_HAS_USERSPACE if XTENSA_MMU
	imply XTENSA_MMU_DOUBLE_MAP
	select CPU_CACHE_INCOHERENT
	select IPC_SERVICE if DT_HAS_INTEL_ADSP_HOST_IPC_ENABLED

if SOC_FAMILY_INTEL_ADSP

rsource "*/Kconfig"

config INTEL_ADSP_SIM
	bool "Intel ADSP Simulator"
	select SIMULATOR_XTENSA
	help
	  Running this SoC family in a simulator.

if INTEL_ADSP_SIM

config INTEL_ADSP_SIM_NO_SECONDARY_CORE_FLOW
	bool "No secondary core flow."
	help
	  Select if simulator doesn't use the normal secondary core flow
	  to initialise secondary clocks.

endif # INTEL_ADSP_SIM

config INTEL_ADSP_FWREADY_MSG
	bool "Send firmware ready message to host"
	default y if INTEL_ADSP_SIM
	help
	  Send a firmware ready message to the host once the system is up
	  and running.

config INTEL_ADSP_IPC
	bool "Driver for the host IPC interrupt delivery"
	select DEPRECATED
	help
	  Deprecated config for IPC. Will be removed in the future.

config INTEL_ADSP_IPC_OLD_INTERFACE
	bool "Expose old interface for the IPC"
	depends on IPC_SERVICE_BACKEND_INTEL_ADSP_HOST_IPC
	default y
	select INTEL_ADSP_IPC
	help
	  Expose the old IPC interface (intel_adsp_ipc_* functions) to
	  maintain backward compatibility.

config MEMORY_WIN_0_SIZE
	int "Size of memory window 0"
	default 8192
	help
	  Size of memory window 0.

	  This window is used for firmware status & outbox/uplink mbox.

config MEMORY_WIN_1_SIZE
	int "Size of memory window 1"
	default 8192
	help
	  Size of memory window 1.

	  This window is used for inbox/downlink mbox.

config MEMORY_WIN_2_SIZE
	int "Size of memory window 2"
	default 8192
	help
	  Size of memory window 2.

	  This window is used for debug.

config MEMORY_WIN_3_SIZE
	int "Size of memory window 3"
	default 8192
	help
	  Size of memory window 3.

	  This window is used for trace.

config ADSP_CLOCK
	bool
	help
	  Driver for the CAVS clocks. Allow type of clock (and
	  thus frequency) to be chosen.

config HP_SRAM_RESERVE
	int "Bytes to reserve at start of HP-SRAM"
	default 65536
	help
	  Bytes to reserve at the start of HP-SRAM.  Zephyr will not
	  place any symbols here, though the host windows have
	  addresses here.  The SOF application also makes direct use
	  of this region, so be very careful changing this value.

config ADSP_TRACE_SIMCALL
	bool "Emit SIMCALL output in addition to window tracing"
	help
	  When true, the trace_out layer will also use a SIMCALL
	  instruction to emit the passed data to the standard output
	  of an enclosing simulator process.  All window contents will
	  remain identical.

config ADSP_NEED_POWER_ON_CACHE
	bool
	help
	  Need to power cache SRAM banks on.

config ADSP_INIT_HPSRAM
	bool
	default y
	help
	  Need to init HP SRAM.

config ADSP_POWER_DOWN_HPSRAM
	bool "Switch off HP SRAM during power down"
	default n if ZTEST
	default y
	help
	 Switch off HP SRAM during power down. Platform-configurable.

config ADSP_DISABLE_L2CACHE_AT_BOOT
	bool

config ADSP_IMR_CONTEXT_SAVE
	bool "Saves FW context into IMR before core is shut down"
	default n
	help
	  When true, FW will store its entire context into IMR before
	  entering D3 state. Later this context can be used to FW restore
	  when Host power up DSP again.

config XTENSA_CPU_IDLE_SPIN
	bool "Use busy loop for k_cpu_idle"
	help
	  Use a spin loop instead of WAITI for the CPU idle state.

config XTENSA_WAITI_BUG
	bool "Workaround sequence for WAITI bug on LX6"
	help
	  SOF traditionally contains this workaround on its ADSP
	  platforms which prefixes a WAITI entry with 128 NOP
	  instructions followed by an ISYNC and EXTW.

config ADSP_IDLE_CLOCK_GATING
	bool "DSP clock gating in Idle"
	help
	  When true, FW will run with enabled clock gating. This option changes
	  HW configuration of a DSP. Every time core goes to the WAITI state
	  (wait for interrupt) during idle, the clock can be gated (however, this
	  does not mean that this will happen).

endif # SOC_FAMILY_INTEL_ADSP
```

## soc/intel/intel_adsp/Kconfig.defconfig
```kconfig
# Intel CAVS SoC family default configuration options
#
# Copyright (c) 2020-2024 Intel Corporation
# SPDX-License-Identifier: Apache-2.0

if SOC_FAMILY_INTEL_ADSP

rsource "*/Kconfig.defconfig.series"

# A workaround for HWMv2 to recover SOF arch/xtensa defaults overridden by arch/host.

# console can't handle the amount of data coming from many tests, so introduce
# a delay between testcases.
if ZTEST
config ZTEST_TEST_DELAY_MS
	default 100
endif

config CONSOLE
	def_bool y

if CONSOLE && !SIMULATOR_XTENSA
config WINSTREAM_CONSOLE
	def_bool y
endif

config CACHE_MANAGEMENT
	def_bool y

choice CACHE_TYPE
	default SOC_CACHE
endchoice

config DCACHE_LINE_SIZE
	default 64

endif # SOC_FAMILY_INTEL_ADSP
```

## soc/intel/intel_adsp/Kconfig.soc
```kconfig
# Intel CAVS SoC series selection
#
# Copyright (c) 2020-2024 Intel Corporation
# SPDX-License-Identifier: Apache-2.0

config SOC_FAMILY_INTEL_ADSP
	bool

config SOC_FAMILY
	default "intel_adsp" if SOC_FAMILY_INTEL_ADSP

rsource "*/Kconfig.soc"
```

## soc/intel/intel_adsp/ace/Kconfig
```kconfig
# Copyright (c) 2022-2024 Intel Corporation
#
# SPDX-License-Identifier: Apache-2.0

config SOC_SERIES_INTEL_ADSP_ACE
	select XTENSA
	select XTENSA_HAL if (("$(ZEPHYR_TOOLCHAIN_VARIANT)" != "xcc") && ("$(ZEPHYR_TOOLCHAIN_VARIANT)" != "xt-clang"))
	select ATOMIC_OPERATIONS_BUILTIN if "$(ZEPHYR_TOOLCHAIN_VARIANT)" != "xcc"
	select ARCH_HAS_COHERENCE
	select SCHED_IPI_SUPPORTED
	select ARCH_HAS_CUSTOM_CPU_IDLE
	select DW_ICTL_ACE
	select SOC_HAS_RUNTIME_NUM_CPUS
	select HAS_PM
	select XTENSA_CPU_HAS_HIFI3
	select XTENSA_CPU_HAS_HIFI4
	select ARCH_HAS_RESERVED_PAGE_FRAMES if MMU

config SOC_INTEL_COMM_WIDGET
	bool "Intel Communication Widget driver"
	default y
	depends on DT_HAS_INTEL_ADSP_COMMUNICATION_WIDGET_ENABLED
	help
	  Select this to enable Intel Communication Widget driver.
	  DSP Communication Widget is a device for generic sideband message transmit/receive.

config SRAM_RETENTION_MODE
	bool "SRAM retention mode during initialization"
	default y
	help
	  When this option is enabled, the SRAM retention mode will be
	  activated during the firmware boot-up process. If disabled,
	  the retention mode will not be activated.

config SOC_SERIES_INTEL_ADSP_ACE_CUSTOM_MORE_SPIN_RELAX_NOPS
	bool "Use Intel Audio DSP specific arch_spin_relax() with more NOPs"
	depends on !XTENSA_MORE_SPIN_RELAX_NOPS
	default y if SMP && MP_MAX_NUM_CPUS > 1
	help
	  Add some NOPs after failure to lock a spinlock. This gives
	  the bus extra time to synchronize the RCW transaction
	  among CPUs.

config SOC_SERIES_INTEL_ADSP_ACE_NUM_SPIN_RELAX_NOPS
	int "Number of NOPs to be used in Intel Audio DSP specific arch_spin_relax()"
	depends on SOC_SERIES_INTEL_ADSP_ACE_CUSTOM_MORE_SPIN_RELAX_NOPS
	default 32 if MP_MAX_NUM_CPUS = 1
	default 64 if MP_MAX_NUM_CPUS = 2
	default 96 if MP_MAX_NUM_CPUS = 3
	default 128 if MP_MAX_NUM_CPUS = 4
	default 160 if MP_MAX_NUM_CPUS = 5
	help
	  Specify the number of NOPs in Intel Audio DSP specific
	  arch_spin_relax().
```

## soc/intel/intel_adsp/ace/Kconfig.defconfig.ace15_mtpm
```kconfig
# Copyright (c) 2022-2024 Intel Corporation
# SPDX-License-Identifier: Apache-2.0

if SOC_INTEL_ACE15_MTPM

config MP_MAX_NUM_CPUS
	default 3

config SYS_CLOCK_HW_CYCLES_PER_SEC
	default 393216000 if XTENSA_TIMER
	default 1000000 if INTEL_ADSP_SIM
	default 38400000 if INTEL_ADSP_TIMER

config XTENSA_CCOUNT_HZ
	default 393216000

endif
```

## soc/intel/intel_adsp/ace/Kconfig.defconfig.ace20_lnl
```kconfig
# Copyright (c) 2022-2024 Intel Corporation
# SPDX-License-Identifier: Apache-2.0

if SOC_INTEL_ACE20_LNL

config MP_MAX_NUM_CPUS
	default 5

endif
```

## soc/intel/intel_adsp/ace/Kconfig.defconfig.ace30
```kconfig
# Copyright (c) 2024 Intel Corporation
# SPDX-License-Identifier: Apache-2.0


if SOC_INTEL_ACE30

config MP_MAX_NUM_CPUS
	default 5 if BOARD_INTEL_ADSP_ACE30_PTL || BOARD_INTEL_ADSP_ACE30_PTL_SIM
	default 3 if BOARD_INTEL_ADSP_ACE30_WCL || BOARD_INTEL_ADSP_ACE30_WCL_SIM

config SYS_CLOCK_HW_CYCLES_PER_SEC
	default 614400000 if XTENSA_TIMER && BOARD_INTEL_ADSP_ACE30_WCL
	default 442368000 if XTENSA_TIMER && BOARD_INTEL_ADSP_ACE30_PTL
	default 1000000 if INTEL_ADSP_SIM
	default 38400000 if INTEL_ADSP_TIMER

config XTENSA_CCOUNT_HZ
	default 614400000 if BOARD_INTEL_ADSP_ACE30_WCL || BOARD_INTEL_ADSP_ACE30_WCL_SIM
	default 442368000 if BOARD_INTEL_ADSP_ACE30_PTL || BOARD_INTEL_ADSP_ACE30_PTL_SIM

config CPU_HAS_MMU
	def_bool y

config XTENSA_MMU
	def_bool y

config XTENSA_MMU_NUM_L2_TABLES
	# Need to have enough to accommodate samples and tests.
	# Also need to have some room for future expansions or
	# else we will be chasing changes all the time.
	default 64

endif
```

## soc/intel/intel_adsp/ace/Kconfig.defconfig.ace30_ptl
```kconfig
# Copyright (c) 2024 Intel Corporation
# SPDX-License-Identifier: Apache-2.0


if SOC_INTEL_ACE30_PTL

config MP_MAX_NUM_CPUS
	default 5

config CPU_HAS_MMU
	def_bool y

config XTENSA_MMU
	def_bool y

config XTENSA_MMU_NUM_L2_TABLES
	# Need to have enough to accommodate samples and tests.
	# Also need to have some room for future expansions or
	# else we will be chasing changes all the time.
	default 64

endif
```

## soc/intel/intel_adsp/ace/Kconfig.defconfig.ace40
```kconfig
# Copyright (c) 2025 Intel Corporation
# SPDX-License-Identifier: Apache-2.0


if SOC_INTEL_ACE40

config MP_MAX_NUM_CPUS
	default 4 if BOARD_INTEL_ADSP_ACE40_NVL
	default 4 if BOARD_INTEL_ADSP_ACE40_NVL_SIM
	default 2 if BOARD_INTEL_ADSP_ACE40_NVLS

config SYS_CLOCK_HW_CYCLES_PER_SEC
	default 614400000 if XTENSA_TIMER && !BOARD_INTEL_ADSP_ACE40_NVLS
	default 438857000 if XTENSA_TIMER && BOARD_INTEL_ADSP_ACE40_NVLS
	default 1000000 if INTEL_ADSP_SIM
	default 38400000 if INTEL_ADSP_TIMER

config XTENSA_CCOUNT_HZ
	default 614400000 if BOARD_INTEL_ADSP_ACE40_NVL
	default 614400000 if BOARD_INTEL_ADSP_ACE40_NVL_SIM
	default 438857000 if BOARD_INTEL_ADSP_ACE40_NVLS

config CPU_HAS_MMU
	def_bool y

config XTENSA_MMU
	def_bool y

config XTENSA_MMU_NUM_L2_TABLES
	# Need to have enough to accommodate samples and tests.
	# Also need to have some room for future expansions or
	# else we will be chasing changes all the time.
	default 64
endif
```

## soc/intel/intel_adsp/ace/Kconfig.defconfig.series
```kconfig
# Copyright (c) 2022-2024 Intel Corporation
# SPDX-License-Identifier: Apache-2.0

if SOC_SERIES_INTEL_ADSP_ACE

config SMP
	default y

config POWER_DOMAIN
	default y

# MTL leaves the upper mapping in the same spot as cAVS, but moves the
# lower one inexplicably.
config XTENSA_UNCACHED_REGION
	default 2

# Parameters for gen_isr_tables.py:

config 2ND_LVL_INTR_00_OFFSET
	default 4

config MULTI_LEVEL_INTERRUPTS
	default y

config MAX_IRQ_PER_AGGREGATOR
	default 30

config NUM_2ND_LEVEL_AGGREGATORS
	default 1

config 2ND_LVL_ISR_TBL_OFFSET
	default 9

config 2ND_LEVEL_INTERRUPTS
	default y

config XTENSA_TIMER
	default n

config XTENSA_TIMER_ID
	default 0

config SYS_CLOCK_TICKS_PER_SEC
	default 100 if INTEL_ADSP_SIM
	default 12000

config INTEL_ADSP_TIMER
	default y

config DYNAMIC_INTERRUPTS
	default y

if LOG

config LOG_BACKEND_ADSP
	default y

endif # LOG

if KERNEL_VM_SUPPORT

config KERNEL_VM_SIZE
	default 0xfe0000

endif

rsource "Kconfig.defconfig.ace*"

endif # SOC_SERIES_INTEL_ADSP_ACE
```

## soc/intel/intel_adsp/ace/Kconfig.soc
```kconfig
# Copyright (c) 2022-2024 Intel Corporation
#
# SPDX-License-Identifier: Apache-2.0

config SOC_SERIES_INTEL_ADSP_ACE
	bool
	select SOC_FAMILY_INTEL_ADSP
	help
	  Intel ADSP ACE

config SOC_INTEL_ACE15_MTPM
	bool
	select SOC_SERIES_INTEL_ADSP_ACE
	help
	  ACE 1.5 Meteor Lake PCH M

config SOC_INTEL_ACE20_LNL
	bool
	select SOC_SERIES_INTEL_ADSP_ACE
	help
	  ACE 2.0 Lunar Lake PCH

config SOC_INTEL_ACE30
	bool
	select SOC_SERIES_INTEL_ADSP_ACE
	help
	  ACE 3.0 Panther Lake PCH

config SOC_SERIES
	default "intel_adsp_ace" if SOC_SERIES_INTEL_ADSP_ACE

config SOC_TOOLCHAIN_NAME
	default "intel_ace15_mtpm" if SOC_INTEL_ACE15_MTPM
	default "intel_ace15_mtpm" if SOC_INTEL_ACE20_LNL
	default "intel_ace30_ptl" if SOC_INTEL_ACE30

config SOC
	default "ace15_mtpm" if SOC_INTEL_ACE15_MTPM
	default "ace20_lnl" if SOC_INTEL_ACE20_LNL
	default "ace30" if SOC_INTEL_ACE30
```

## soc/intel/intel_adsp/cavs/Kconfig
```kconfig
# Copyright (c) 2017,2022-2024 Intel Corporation
#
# SPDX-License-Identifier: Apache-2.0

config SOC_SERIES_INTEL_ADSP_CAVS
	select XTENSA
	select XTENSA_HAL if ("$(ZEPHYR_TOOLCHAIN_VARIANT)" != "xcc" && ("$(ZEPHYR_TOOLCHAIN_VARIANT)" != "xt-clang"))
	select XTENSA_RESET_VECTOR
	select XTENSA_USE_CORE_CRT1
	select ATOMIC_OPERATIONS_BUILTIN if "$(ZEPHYR_TOOLCHAIN_VARIANT)" != "xcc"
	select ATOMIC_OPERATIONS_ARCH if "$(ZEPHYR_TOOLCHAIN_VARIANT)" = "xcc"
	select ARCH_HAS_COHERENCE
	select HAS_PM

config SOC_INTEL_CAVS_V25
	select XTENSA_WAITI_BUG
	select SCHED_IPI_SUPPORTED
```
