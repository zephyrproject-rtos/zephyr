## soc/intel/intel_adsp/cavs/Kconfig.defconfig.cavs_v25
```kconfig
# Copyright (c) 2020,2022-2024 Intel Corporation
# SPDX-License-Identifier: Apache-2.0

if SOC_INTEL_CAVS_V25

# For backward compatibility, to be removed
config SOC_SERIES_INTEL_CAVS_V25
	def_bool y

# Hardware has four cores, limited to two pending test fixes
config MP_MAX_NUM_CPUS
	default 2

config SYS_CLOCK_HW_CYCLES_PER_SEC
	default 400000000 if XTENSA_TIMER
	default 38400000 if INTEL_ADSP_TIMER

config CAVS_ICTL_0_OFFSET
	default 6
config CAVS_ICTL_1_OFFSET
	default 10
config CAVS_ICTL_2_OFFSET
	default 13
config CAVS_ICTL_3_OFFSET
	default 16

config 2ND_LVL_INTR_00_OFFSET
	default CAVS_ICTL_0_OFFSET
config 2ND_LVL_INTR_01_OFFSET
	default CAVS_ICTL_1_OFFSET
config 2ND_LVL_INTR_02_OFFSET
	default CAVS_ICTL_2_OFFSET
config 2ND_LVL_INTR_03_OFFSET
	default CAVS_ICTL_3_OFFSET

config MAX_IRQ_PER_AGGREGATOR
	default 32
config NUM_2ND_LEVEL_AGGREGATORS
	default 4
config 2ND_LVL_ISR_TBL_OFFSET
	default 21

config CAVS_ISR_TBL_OFFSET
	default 2ND_LVL_ISR_TBL_OFFSET

if KERNEL_VM_SUPPORT

config KERNEL_VM_SIZE
	default 0x800000

endif

config ADSP_NEED_POWER_ON_CACHE
	default y

endif # SOC_INTEL_CAVS_V25
```

## soc/intel/intel_adsp/cavs/Kconfig.defconfig.series
```kconfig
# Copyright (c) 2020-2024 Intel Corporation
#
# SPDX-License-Identifier: Apache-2.0

if SOC_SERIES_INTEL_ADSP_CAVS

config INTEL_ADSP_CAVS
	def_bool y

rsource "Kconfig.defconfig.cavs*"

config DMA_INTEL_ADSP_GPDMA
	default y
	depends on DMA

config XTENSA_CCOUNT_HZ
	default 400000000

config SYS_CLOCK_TICKS_PER_SEC
	default 50000

config SMP
	default y

config XTENSA_TIMER
	default n

config KERNEL_ENTRY
	default "_MainEntry"

config MULTI_LEVEL_INTERRUPTS
	default y

config 2ND_LEVEL_INTERRUPTS
	default y

config DYNAMIC_INTERRUPTS
	default y

if LOG

config LOG_BACKEND_ADSP
	default y

endif # LOG

if GDBSTUB

# GDB expects 420 byte G-packet, so double for hexadecimal digits.
config GDBSTUB_BUF_SZ
	default 840 if GDBSTUB

endif

endif # SOC_SERIES_INTEL_ADSP_CAVS
```

## soc/intel/intel_adsp/cavs/Kconfig.soc
```kconfig
# Copyright (c) 2020-2024 Intel Corporation
#
# SPDX-License-Identifier: Apache-2.0

config SOC_SERIES_INTEL_ADSP_CAVS
	bool
	select SOC_FAMILY_INTEL_ADSP
	help
	  Intel ADSP CAVS

config SOC_SERIES
	default "intel_adsp_cavs" if SOC_SERIES_INTEL_ADSP_CAVS

config SOC_INTEL_CAVS_V25
	bool
	select SOC_SERIES_INTEL_ADSP_CAVS
	help
	  Intel Tiger Lake

config SOC
	default "cavs25" if SOC_INTEL_CAVS_V25

config SOC_TOOLCHAIN_NAME
	default "intel_tgl_adsp" if SOC_INTEL_CAVS_V25
```

## soc/intel/intel_ish/Kconfig
```kconfig
# Intel ISH family configuration options
#
# Copyright (c) 2023-2024 Intel Corporation
#
# SPDX-License-Identifier: Apache-2.0

config SOC_FAMILY_INTEL_ISH
	select X86
	select CPU_LAKEMONT_VALUE
	select X86_NO_SPECULATIVE_VULNERABILITIES
	select IOAPIC
	select LOAPIC
	select INTEL_HAL
	select HAS_PM
	select HAS_COVERAGE_SUPPORT
	select SOC_EARLY_INIT_HOOK
```

## soc/intel/intel_ish/Kconfig.defconfig
```kconfig
# Intel ISH family default configuration options
#
# Copyright (c) 2023-2024 Intel Corporation
#
# SPDX-License-Identifier: Apache-2.0

if SOC_FAMILY_INTEL_ISH

config SYS_CLOCK_HW_CYCLES_PER_SEC
	default 32768 if HPET_TIMER
	default 96000000 if APIC_TIMER_TSC && SOC_INTEL_ISH_5_4_1
	default 100000000 if APIC_TIMER_TSC && !SOC_INTEL_ISH_5_4_1

config X86_VERY_EARLY_CONSOLE
	default n

config SRAM_OFFSET
	hex
	default 0x0

# Target platforms are not PC-compatible
# (e.g. without BIOS, ACPI, CMOS, etc.).
config X86_PC_COMPATIBLE
	default n

if APIC_TIMER_TSC

config DYNAMIC_INTERRUPTS
	default y

if SOC_INTEL_ISH_5_4_1

config APIC_TIMER_TSC_N
	default 1280

config APIC_TIMER_TSC_M
	default 256
endif
endif

rsource "*/Kconfig.defconfig.series"

endif # SOC_FAMILY_INTEL_ISH
```

## soc/intel/intel_ish/Kconfig.soc
```kconfig
# Intel ISH family selection
#
# Copyright (c) 2023-2024 Intel Corporation
#
# SPDX-License-Identifier: Apache-2.0

config SOC_FAMILY_INTEL_ISH
	bool

config SOC_FAMILY
	default "intel_ish" if SOC_FAMILY_INTEL_ISH

rsource "*/Kconfig.soc"
```
