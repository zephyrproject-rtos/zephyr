## soc/intel/intel_ish/intel_ish5/Kconfig.defconfig.series
```kconfig
# Copyright (c) 2023-2024 Intel Corporation
#
# SPDX-License-Identifier: Apache-2.0
#

if SOC_SERIES_INTEL_ISH5

rsource "pm/Kconfig.pm"

endif # SOC_SERIES_INTEL_ISH5
```

## soc/intel/intel_ish/intel_ish5/Kconfig.soc
```kconfig
# Copyright (c) 2023-2024 Intel Corporation
#
# SPDX-License-Identifier: Apache-2.0

config SOC_SERIES_INTEL_ISH5
	bool
	select SOC_FAMILY_INTEL_ISH

config SOC_SERIES
	default "intel_ish5" if SOC_SERIES_INTEL_ISH5

config SOC_INTEL_ISH_5_4_1
	bool
	select SOC_SERIES_INTEL_ISH5

config SOC_INTEL_ISH_5_6_0
	bool
	select SOC_SERIES_INTEL_ISH5

config SOC_INTEL_ISH_5_8_0
	bool
	select SOC_SERIES_INTEL_ISH5

config SOC
	default "intel_ish_5_4_1" if SOC_INTEL_ISH_5_4_1
	default "intel_ish_5_6_0" if SOC_INTEL_ISH_5_6_0
	default "intel_ish_5_8_0" if SOC_INTEL_ISH_5_8_0
```

## soc/intel/intel_niosv/Kconfig
```kconfig
# Copyright (c) 2024 Nordic Semiconductor ASA
# Copyright (c) 2023-2024 Intel Corporation
#
# SPDX-License-Identifier: Apache-2.0

if SOC_FAMILY_INTEL_NIOSV

rsource "*/Kconfig"

endif # SOC_FAMILY_INTEL_NIOSV
```

## soc/intel/intel_niosv/Kconfig.soc
```kconfig
# Copyright (c) 2024 Nordic Semiconductor ASA
# Copyright (c) 2023-2024 Intel Corporation
#
# SPDX-License-Identifier: Apache-2.0

config SOC_FAMILY_INTEL_NIOSV
	bool

config SOC_FAMILY
	default "intel_niosv" if SOC_FAMILY_INTEL_NIOSV

rsource "*/Kconfig.soc"
```

## soc/intel/intel_niosv/niosv/Kconfig
```kconfig
# Copyright (C) 2023-2024, Intel Corporation
#
# SPDX-License-Identifier: Apache-2.0

config SOC_SERIES_NIOSV
	select RISCV
	select RISCV_PRIVILEGED
	select INCLUDE_RESET_VECTOR
	select RISCV_SOC_HAS_GP_RELATIVE_ADDRESSING
	imply XIP

config SOC_NIOSV_M
	help
	  Intel FPGA NIOSV Microcontroller Core Processor

config SOC_NIOSV_G
	help
	  Intel FPGA NIOSV General Purpose Processor
```

## soc/intel/intel_niosv/niosv/Kconfig.defconfig.series
```kconfig
# Copyright (C) 2023-2024, Intel Corporation
#
# SPDX-License-Identifier: Apache-2.0

if SOC_SERIES_NIOSV

config SYS_CLOCK_HW_CYCLES_PER_SEC
	default $(dt_node_int_prop_int,/cpus/cpu@0,clock-frequency)

config NUM_IRQS # Platform interrupts IRQs index start from index 16
	default 32

config RISCV_GP
	default y

config RISCV_SOC_INTERRUPT_INIT
	default y

endif # SOC_SERIES_NIOSV
```

## soc/intel/intel_niosv/niosv/Kconfig.soc
```kconfig
# Copyright (C) 2023-2024, Intel Corporation
#
# SPDX-License-Identifier: Apache-2.0

config SOC_SERIES_NIOSV
	bool
	select SOC_FAMILY_INTEL_NIOSV
	help
	  Intel FPGA NIOSV

config SOC_SERIES
	default "niosv" if SOC_SERIES_NIOSV

config SOC_NIOSV_M
	bool
	select SOC_SERIES_NIOSV
	help
	  Intel FPGA NIOSV Microcontroller Core Processor

config SOC_NIOSV_G
	bool
	select SOC_SERIES_NIOSV
	help
	  Intel FPGA NIOSV General Purpose Processor

config SOC
	default "niosv_m" if SOC_NIOSV_M
	default "niosv_g" if SOC_NIOSV_G
```

## soc/intel/intel_socfpga/Kconfig.defconfig
```kconfig
# Copyright (c) 2021-2024 Intel Corporation
# SPDX-License-Identifier: Apache-2.0

if SOC_FAMILY_INTEL_SOCFPGA

rsource "*/Kconfig.defconfig.series"

endif # SOC_FAMILY_INTEL_SOCFPGA
```

## soc/intel/intel_socfpga/Kconfig.soc
```kconfig
# Copyright (c) 2021-2024 Intel Corporation
# SPDX-License-Identifier: Apache-2.0

config SOC_FAMILY_INTEL_SOCFPGA
	bool

config SOC_FAMILY
	default "intel_socfpga" if SOC_FAMILY_INTEL_SOCFPGA

rsource "*/Kconfig.soc"
```

## soc/intel/intel_socfpga/agilex/Kconfig
```kconfig
# Copyright (c) 2021-2024 Intel Corporation
# SPDX-License-Identifier: Apache-2.0

config SOC_SERIES_AGILEX
	select ARM64
	select CPU_CORTEX_A53
```

## soc/intel/intel_socfpga/agilex/Kconfig.defconfig.agilex
```kconfig
# Copyright (c) 2021-2024 Intel Corporation
# SPDX-License-Identifier: Apache-2.0

if SOC_AGILEX

# must be >= the highest interrupt number used
# - include the UART interrupts 173 or 204
config NUM_IRQS
	default 205

config SYS_CLOCK_HW_CYCLES_PER_SEC
	default 25000000

config KERNEL_VM_SIZE
	default 0x180000

endif
```

## soc/intel/intel_socfpga/agilex/Kconfig.defconfig.series
```kconfig
# Copyright (c) 2021-2024 Intel Corporation
# SPDX-License-Identifier: Apache-2.0

if SOC_SERIES_AGILEX

rsource "Kconfig.defconfig.agilex*"

endif # SOC_SERIES_AGILEX
```

## soc/intel/intel_socfpga/agilex/Kconfig.soc
```kconfig
# Copyright (c) 2021-2024 Intel Corporation
# SPDX-License-Identifier: Apache-2.0

config SOC_SERIES_AGILEX
	bool
	select SOC_FAMILY_INTEL_SOCFPGA
	help
	  Intel SoC FPGA Agilex Series

config SOC_SERIES
	default "agilex" if SOC_SERIES_AGILEX

config SOC_AGILEX
	bool
	select SOC_SERIES_AGILEX
	help
	  Intel SoC FPGA Agilex

config SOC
	default "agilex" if SOC_AGILEX
```

## soc/intel/intel_socfpga/agilex5/Kconfig
```kconfig
# Copyright (c) 2022-2024 Intel Corporation
# SPDX-License-Identifier: Apache-2.0

config SOC_SERIES_AGILEX5
	select ARM64
	select CPU_CORTEX_A76_A55
```

## soc/intel/intel_socfpga/agilex5/Kconfig.defconfig.series
```kconfig
# Copyright (c) 2022-2024 Intel Corporation
# SPDX-License-Identifier: Apache-2.0

if SOC_SERIES_AGILEX5

rsource "Kconfig.defconfig.agilex5*"

endif # SOC_SERIES_AGILEX5
```

## soc/intel/intel_socfpga/agilex5/Kconfig.soc
```kconfig
# Copyright (c) 2022-2024 Intel Corporation
# SPDX-License-Identifier: Apache-2.0

config SOC_SERIES_AGILEX5
	bool
	select SOC_FAMILY_INTEL_SOCFPGA
	help
	  Intel SoC FPGA Agilex5 Series

config SOC_SERIES
	default "agilex5" if SOC_SERIES_AGILEX5

config SOC_AGILEX5
	bool
	select SOC_SERIES_AGILEX5
	help
	  Intel SoC FPGA Agilex5

config SOC
	default "agilex5" if SOC_AGILEX5
```

## soc/intel/intel_socfpga_std/Kconfig.defconfig
```kconfig
# Copyright (c) 2022-2024 Intel Corporation
# SPDX-License-Identifier: Apache-2.0

if SOC_FAMILY_INTEL_SOCFPGA_STD

rsource "*/Kconfig.defconfig.series"

endif # SOC_FAMILY_INTEL_SOCFPGA_STD
```

## soc/intel/intel_socfpga_std/Kconfig.soc
```kconfig
# Copyright (c) 2021-2024 Intel Corporation
# SPDX-License-Identifier: Apache-2.0

config SOC_FAMILY_INTEL_SOCFPGA_STD
	bool

config SOC_FAMILY
	default "intel_socfpga_std" if SOC_FAMILY_INTEL_SOCFPGA_STD

rsource "*/Kconfig.soc"
```

## soc/intel/intel_socfpga_std/cyclonev/Kconfig
```kconfig
# Copyright (c) 2022-2024 Intel Corporation
# SPDX-License-Identifier: Apache-2.0

config SOC_SERIES_CYCLONEV
	select ARM
	select CPU_CORTEX_A9
	select ARM_ARCH_TIMER_ERRATUM_740657 if ARM_ARCH_TIMER
	select ARCH_HAS_RESERVED_PAGE_FRAMES
```

## soc/intel/intel_socfpga_std/cyclonev/Kconfig.defconfig.series
```kconfig
# Copyright (c) 2022-2024 Intel Corporation
# SPDX-License-Identifier: Apache-2.0

if SOC_SERIES_CYCLONEV

rsource "Kconfig.defconfig.cyclonev*"

endif # SOC_SERIES_CYCLONEV
```

## soc/intel/intel_socfpga_std/cyclonev/Kconfig.soc
```kconfig
# Copyright (c) 2021-2024 Intel Corporation
# SPDX-License-Identifier: Apache-2.0

config SOC_SERIES_CYCLONEV
	bool
	select SOC_FAMILY_INTEL_SOCFPGA_STD
	help
	  Intel SoC FPGA Cyclone V Series

config SOC_SERIES
	default "cyclonev" if SOC_SERIES_CYCLONEV

config SOC_CYCLONEV
	bool
	select SOC_SERIES_CYCLONEV
	help
	  Intel SoC FPGA Cyclone V

config SOC
	default "cyclonev" if SOC_CYCLONEV
```

## soc/intel/lakemont/Kconfig
```kconfig
# Copyright (c) 2021-2024 Intel Corporation
#
# SPDX-License-Identifier: Apache-2.0

config SOC_LAKEMONT
	select X86
	select CPU_LAKEMONT
	select X86_MMU if FPU
	select X86_SSE if FPU
	select X86_SSE2 if FPU
	select X86_SSE3 if FPU
	select X86_SSSE3 if FPU
	select ARCH_HAS_USERSPACE
```

## soc/intel/lakemont/Kconfig.defconfig
```kconfig
# Copyright (c) 2021-2024 Intel Corporation
#
# SPDX-License-Identifier: Apache-2.0

if SOC_LAKEMONT

config SYS_CLOCK_HW_CYCLES_PER_SEC
	default 32768

# Can be enabled once UART is defined in board
# configuration.
config X86_VERY_EARLY_CONSOLE
	default n

# Target platforms are usually not PC-compatible
# (e.g. without BIOS, ACPI, etc.).
config X86_PC_COMPATIBLE
	default n

endif
```

## soc/intel/lakemont/Kconfig.soc
```kconfig
# Copyright (c) 2021-2024 Intel Corporation Inc.
# SPDX-License-Identifier: Apache-2.0

config SOC_LAKEMONT
	bool

config SOC
	default "lakemont" if SOC_LAKEMONT
```

## soc/intel/nova_lake/Kconfig.soc
```kconfig
# Copyright (c) 2026 Intel Corporation Inc.
# SPDX-License-Identifier: Apache-2.0

config SOC_NOVA_LAKE
	bool

config SOC
	default "nova_lake" if SOC_NOVA_LAKE
```
