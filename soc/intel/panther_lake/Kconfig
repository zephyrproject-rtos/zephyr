## soc/intel/panther_lake/Kconfig
```kconfig
# Copyright (c) 2025 Intel Corporation Inc.
# SPDX-License-Identifier: Apache-2.0

config SOC_PANTHER_LAKE
	select X86
	select X86_64
	select CPU_ATOM
	select PCIE
	select PCIE_MSI
	select DYNAMIC_INTERRUPTS
	select X86_MMU
```

## soc/intel/panther_lake/Kconfig.defconfig
```kconfig
# Panther Lake SoC configuration options

# Copyright (c) 2025 Intel Corporation
# SPDX-License-Identifier: Apache-2.0

if SOC_PANTHER_LAKE

config PCIE_MMIO_CFG
	default y

config X86_DYNAMIC_IRQ_STUBS
	default 16
	depends on DYNAMIC_INTERRUPTS

endif # SOC_PANTHER_LAKE
```

## soc/intel/panther_lake/Kconfig.soc
```kconfig
# Copyright (c) 2025 Intel Corporation Inc.
# SPDX-License-Identifier: Apache-2.0

config SOC_PANTHER_LAKE
	bool

config SOC
	default "panther_lake" if SOC_PANTHER_LAKE
```

## soc/intel/raptor_lake/Kconfig.soc
```kconfig
# Copyright (c) 2022-2024 Intel Corporation Inc.
# SPDX-License-Identifier: Apache-2.0

config SOC_RAPTOR_LAKE
	bool

config SOC
	default "raptor_lake" if SOC_RAPTOR_LAKE
```

## soc/intel/wildcat_lake/Kconfig.soc
```kconfig
# Copyright (c) 2025 Intel Corporation Inc.
# SPDX-License-Identifier: Apache-2.0

config SOC_WILDCAT_LAKE
	bool

config SOC
	default "wildcat_lake" if SOC_WILDCAT_LAKE
```

## soc/ite/ec/Kconfig
```kconfig
# Copyright (c) 2020 ITE Corporation. All Rights Reserved.
# SPDX-License-Identifier: Apache-2.0

if SOC_FAMILY_ITE_EC

rsource "*/Kconfig"

endif # SOC_FAMILY_ITE_EC
```

## soc/ite/ec/Kconfig.defconfig
```kconfig
# Copyright (c) 2020 ITE Corporation. All Rights Reserved.
# SPDX-License-Identifier: Apache-2.0

if SOC_FAMILY_ITE_EC

rsource "*/Kconfig.defconfig.series"

choice PM_POLICY
	default PM_POLICY_CUSTOM if SOC_FAMILY_ITE_EC
endchoice

endif # SOC_FAMILY_ITE_EC
```

## soc/ite/ec/Kconfig.soc
```kconfig
# Copyright (c) 2020 ITE Corporation. All Rights Reserved.
# SPDX-License-Identifier: Apache-2.0

config SOC_FAMILY_ITE_EC
	bool

config SOC_FAMILY
	default "ite_ec" if SOC_FAMILY_ITE_EC

rsource "*/Kconfig.soc"
```

## soc/ite/ec/it51xxx/Kconfig
```kconfig
# Copyright (c) 2025 ITE Corporation. All Rights Reserved.
# SPDX-License-Identifier: Apache-2.0

config SOC_SERIES_IT51XXX
	select HAS_PM
	select ARCH_HAS_CUSTOM_CPU_IDLE
	select ARCH_HAS_CUSTOM_CPU_ATOMIC_IDLE
	select SOC_PREP_HOOK

if SOC_SERIES_IT51XXX

config SOC_IT51XXX
	select RISCV
	select FLASH
	imply XIP

config SOC_IT51XXX_CPU_IDLE_GATING
	bool
	help
	  This option determines whether the entering CPU idle mode can be
	  gated by individual drivers. When this option is disabled, CPU idle
	  mode is always permitted.

config SOC_IT51XXX_USE_ILM
	bool
	default y
	help
	  If enabled, Instruction Local Memory (ILM) will be configured to execute
	  code placed in the .__ram_code section out of RAM. This consumes RAM in
	  blocks of 4 kilobytes, but performance of code in ILM is much more
	  predictable than executing from Flash directly, and some code (such as code
	  that writes to the internal Flash) must execute out of RAM.

config SOC_IT51XXX_SHA256_HW_ACCELERATE
	bool "HW SHA256 calculation"
	help
	  IT51XXX HW support sha256 calculation, and its calculation is faster than FW.

config SOC_IT515XX_SHA256_DLM_OFFSET
	hex
	default 0x03E000
	depends on SOC_IT51XXX_SHA256_HW_ACCELERATE
	help
	  Due to the hardware requirements of the IT515XX, the SHA-256 data must be
	  placed within the specific address range (0x83E000 to 0x83EFFF by default).

config ILM_MAX_SIZE
	int "ILM Size in kB"
	default 4

config SOC_IT51XXX_SIGNATURE_FLAG
	hex "Hardware mirror signature flag"
	range 0x0 0xFF
	default 0xB4
	help
	  Hardware mirror signature flag.

config SOC_IT51XXX_CMP_RANGE_ADDR
	hex "Comparison range address"
	range 0x0 0xFF
	default 0xAA
	help
	  Specifies the comparison range address [17:10] between e-flash and SPI
	  flash. When bit[5] of SOC_IT51XXX_SIGNATURE_FLAG is set (1'b1), this
	  option must be 0xAA.

config SOC_IT51XXX_SIGNATURE_DATA_EXTENSION
	bool "Custom signature extension"
	help
	  Enable project-specific signature extension data appended to the vector
	  table. When enabled, signature_custom.S is included into the SoC vector
	  layout. The custom signature extension starts at offset 0x50.

endif # SOC_SERIES_IT51XXX
```

## soc/ite/ec/it51xxx/Kconfig.defconfig.series
```kconfig
# Copyright (c) 2025 ITE Corporation. All Rights Reserved.
# SPDX-License-Identifier: Apache-2.0

if SOC_SERIES_IT51XXX

config ARCH_HAS_CUSTOM_BUSY_WAIT
	default y

config SYS_CLOCK_HW_CYCLES_PER_SEC
	default $(dt_node_int_prop_int,/cpus/cpu@0,clock-frequency)

config SYS_CLOCK_TICKS_PER_SEC
	default 4096

config UART_NS16550_WA_ISR_REENABLE_INTERRUPT
	default y
	depends on UART_NS16550

config FLASH_INIT_PRIORITY
	default 0

config NUM_IRQS
	default 225

config DYNAMIC_INTERRUPTS
	default y

config GEN_ISR_TABLES
	default y

config GEN_IRQ_START_VECTOR
	default 0

config GEN_SW_ISR_TABLE
	default y

config RISCV_SOC_INTERRUPT_INIT
	default y

endif # SOC_SERIES_IT51XXX
```

## soc/ite/ec/it51xxx/Kconfig.soc
```kconfig
# Copyright (c) 2025 ITE Corporation. All Rights Reserved.
# SPDX-License-Identifier: Apache-2.0

config SOC_SERIES_IT51XXX
	bool
	select SOC_FAMILY_ITE_EC
	help
	  Enable support for ITE IT51XXX

config SOC_IT51XXX
	bool
	select SOC_SERIES_IT51XXX

config SOC_IT51526AW
	bool
	select SOC_IT51XXX

config SOC_SERIES
	default "it51xxx" if SOC_SERIES_IT51XXX

config SOC
	default "it51526aw" if SOC_IT51526AW
```

## soc/ite/ec/it8xxx2/Kconfig
```kconfig
# Copyright (c) 2020 ITE Corporation. All Rights Reserved.
# SPDX-License-Identifier: Apache-2.0

config SOC_SERIES_IT8XXX2
	select CPU_HAS_FPU if "$(ZEPHYR_TOOLCHAIN_VARIANT)" != "zephyr" || RISCV_ISA_EXT_M
	select HAS_PM

if SOC_SERIES_IT8XXX2

config SOC_IT8XXX2
	select RISCV
	select ATOMIC_OPERATIONS_BUILTIN
	select RISCV_ISA_RV32I
	select RISCV_ISA_EXT_ZICSR
	select RISCV_ISA_EXT_ZIFENCEI
	# Workaround mul instruction bug, see:
	# https://www.ite.com.tw/uploads/product_download/it81202-bx-chip-errata.pdf
	select RISCV_ISA_EXT_M if !(SOC_IT81302BX || SOC_IT81202BX)
	select RISCV_ISA_EXT_A
	select RISCV_ISA_EXT_C

config SOC_IT8XXX2_REG_SET_V1
	bool
	help
	  This option is selected by a variable of which soc, and will
	  determine the register for the IT81xx2 specification.

config SOC_IT8XXX2_REG_SET_V2
	bool
	help
	  This option is selected by a variable of which soc, and will
	  determine the register for the IT82xx2 specification.

config SOC_IT8XXX2_USBPD_PHY_V1
	bool
	help
	  This option is automatically selected by variant soc and sets
	  the USBPD PHY version.

config SOC_IT8XXX2_USBPD_PHY_V2
	bool
	help
	  This option is automatically selected by variant soc and sets
	  the USBPD PHY version.

config SOC_IT81302BX
	select SOC_IT8XXX2_REG_SET_V1
	select SOC_IT8XXX2_USBPD_PHY_V1

config SOC_IT81202BX
	select SOC_IT8XXX2_REG_SET_V1
	select SOC_IT8XXX2_USBPD_PHY_V1

config SOC_IT81302CX
	select SOC_IT8XXX2_REG_SET_V1
	select SOC_IT8XXX2_USBPD_PHY_V2

config SOC_IT81202CX
	select SOC_IT8XXX2_REG_SET_V1
	select SOC_IT8XXX2_USBPD_PHY_V2

config SOC_IT82202AX
	select SOC_IT8XXX2_REG_SET_V2
	select SOC_IT8XXX2_EC_BUS_24MHZ if !DT_HAS_ITE_IT82XX2_USB_ENABLED
	select SOC_IT8XXX2_USBPD_PHY_V2

config SOC_IT82302AX
	select SOC_IT8XXX2_REG_SET_V2
	select SOC_IT8XXX2_EC_BUS_24MHZ if !DT_HAS_ITE_IT82XX2_USB_ENABLED
	select SOC_IT8XXX2_USBPD_PHY_V2

config SOC_IT82002AW
	select SOC_IT8XXX2_REG_SET_V2
	select SOC_IT8XXX2_EC_BUS_24MHZ if !DT_HAS_ITE_IT82XX2_USB_ENABLED
	select SOC_IT8XXX2_USBPD_PHY_V2

config SOC_IT82202BW
	select SOC_IT8XXX2_REG_SET_V2
	select SOC_IT8XXX2_EC_BUS_24MHZ if !DT_HAS_ITE_IT82XX2_USB_ENABLED
	select SOC_IT8XXX2_USBPD_PHY_V2

config SOC_IT82302BW
	select SOC_IT8XXX2_REG_SET_V2
	select SOC_IT8XXX2_EC_BUS_24MHZ if !DT_HAS_ITE_IT82XX2_USB_ENABLED
	select SOC_IT8XXX2_USBPD_PHY_V2

config SOC_IT8XXX2_PLL_FLASH_48M
	bool "Flash frequency is 48MHz"
	default y
	select FLASH
	help
	  Change frequency of PLL, CPU, and flash to 48MHz during initialization.

	  Set n to use the default settings.
	  (PLL and CPU run at 48MHz, flash frequency is 16MHz)

config SOC_IT8XXX2_GPIO_GROUP_K_L_DEFAULT_PULL_DOWN
	bool "The pins of GPIO group K and L aren't bonding with pad"
	default y
	help
	  On IT81202 (128-pins package), the pins of GPIO group K and L aren't
	  bonding with pad. So we configure these pins as internal pull-down
	  at default to prevent leakage current due to floating.

config SOC_IT8XXX2_GPIO_H7_DEFAULT_OUTPUT_LOW
	bool "The GPIOH7 isn't bonding with pad and is left floating internally"
	default y
	help
	  On IT81202/IT81302, the GPIOH7 isn't bonding with pad and is left
	  floating internally. We need to enable internal pull-down for the pin
	  to prevent leakage current, but IT81202/IT81302 doesn't have the
	  capability to pull it down. We can only set it as output low,
	  so we enable output low for it at initialization to prevent leakage.

config SOC_IT8XXX2_CPU_IDLE_GATING
	bool
	help
	  This option determines whether the entering CPU idle mode can be
	  gated by individual drivers. When this option is disabled, CPU idle
	  mode is always permitted.

config SOC_IT8XXX2_EC_BUS_24MHZ
	bool "EC bus is 24MHz"
	help
	  Raise EC bus to 24MHz (default is 8MHz).
	  This reduces read/write EC registers latency by 50%.
	  NOTE: There is limitation to enabling this config on it81xx2 series.
	  The clock_frequency of ite,it8xxx2-i2c node (i2c0, i2c1, and i2c2) will
	  be fixed at 400KHz.

config SOC_IT8XXX2_JTAG_DEBUG_INTERFACE
	bool "JTAG debug interface"
	help
	  If enabled, the below five pins are configured as JTAG debug interface:
	  - GPIOA0 -> TCK
	  - GPIOA1 -> TDI
	  - GPIOA4 -> TDO
	  - GPIOA5 -> TMS
	  - GPIOA6 -> TRST
	  Supported I/O voltage is 3.3V.

choice
	prompt "Clock source for PLL reference clock"

config SOC_IT8XXX2_INT_32K
	bool "Use the +/-2.3% internal clock generator"

config SOC_IT8XXX2_EXT_32K
	bool "Use external 32.768 kHz clock source"

endchoice

config SOC_IT8XXX2_USE_ILM
	bool
	default y
	help
	  If enabled, Instruction Local Memory (ILM) will be configured to execute
	  code placed in the .__ram_code section out of RAM. This consumes RAM in
	  blocks of 4 kilobytes, but performance of code in ILM is much more
	  predictable than executing from Flash directly, and some code (such as code
	  that writes to the internal Flash) must execute out of RAM.

config SOC_IT8XXX2_EXCEPTIONS_IN_RAM
	bool "Place exception handling code in RAM"
	default y
	select SOC_IT8XXX2_USE_ILM
	help
	  Place exception handling (ISR entry/exit and related) code in ILM, which
	  has more reliable performance characteristics than executing directly from
	  Flash. This can significantly improve performance when under I-cache
	  pressure.

config SOC_IT8XXX2_SHA256_HW_ACCELERATE
	bool "HW SHA256 calculation"
	help
	  IT8XXX2 HW support sha256 calculation, and its calculation is faster than FW.
	  We place SHA256 message, hash and key data (total 512bytes) in RAM.
	  If we enable this config, because HW limits, the sha256 data must place in
	  first 4KB of RAM.

config SOC_IT8XXX2_SHA256_BLOCK_SIZE
	hex
	default 0x500 if SOC_IT8XXX2_REG_SET_V2
	default 0x200

DT_CHOSEN_ZEPHYR_FLASH := zephyr,flash

config SOC_IT8XXX2_FLASH_SIZE_BYTES
	hex
	default $(dt_chosen_reg_size_hex,$(DT_CHOSEN_ZEPHYR_FLASH))
	help
	  Total size of writable flash.

config ILM_MAX_SIZE
	int "ILM Size in kB"
	default 60 if SOC_IT81202CX || SOC_IT81302CX
	default SRAM_SIZE

endif # SOC_SERIES_IT8XXX2
```

## soc/ite/ec/it8xxx2/Kconfig.defconfig.it81202cx
```kconfig
# Copyright (c) 2022 ITE Corporation.
# SPDX-License-Identifier: Apache-2.0

if SOC_IT81202CX

config ILM_MAX_SIZE
	default 60

config SOC_IT8XXX2_GPIO_GROUP_K_L_DEFAULT_PULL_DOWN
	default y

endif
```

## soc/ite/ec/it8xxx2/Kconfig.defconfig.it81202dx
```kconfig
# Copyright (c) 2024 ITE Corporation.
# SPDX-License-Identifier: Apache-2.0

if SOC_IT81202DX

config ILM_MAX_SIZE
	default 60

config SOC_IT8XXX2_GPIO_GROUP_K_L_DEFAULT_PULL_DOWN
	default y

endif
```

## soc/ite/ec/it8xxx2/Kconfig.defconfig.it82000bw
```kconfig
# Copyright (c) 2025 ITE Corporation.
# SPDX-License-Identifier: Apache-2.0

if SOC_IT82000BW

config SOC_IT8XXX2_GPIO_GROUP_K_L_DEFAULT_PULL_DOWN
	default y

endif #SOC_IT82000BW
```

## soc/ite/ec/it8xxx2/Kconfig.defconfig.it82002aw
```kconfig
# Copyright (c) 2023 ITE Corporation.
# SPDX-License-Identifier: Apache-2.0

if SOC_IT82002AW

config SOC_IT8XXX2_GPIO_GROUP_K_L_DEFAULT_PULL_DOWN
	default y

endif
```

## soc/ite/ec/it8xxx2/Kconfig.defconfig.it82202bw
```kconfig
# Copyright (c) 2024 ITE Corporation.
# SPDX-License-Identifier: Apache-2.0

if SOC_IT82202BW

config SOC_IT8XXX2_GPIO_GROUP_K_L_DEFAULT_PULL_DOWN
	default y

endif
```

## soc/ite/ec/it8xxx2/Kconfig.defconfig.series
```kconfig
# Copyright (c) 2020 ITE Corporation. All Rights Reserved.
# SPDX-License-Identifier: Apache-2.0

if SOC_SERIES_IT8XXX2

config RISCV_GP
	default y

config ARCH_HAS_CUSTOM_BUSY_WAIT
	default y

config SYS_CLOCK_HW_CYCLES_PER_SEC
	default 32768

config SYS_CLOCK_TICKS_PER_SEC
	default 4096

config UART_NS16550_WA_ISR_REENABLE_INTERRUPT
	default y
	depends on UART_NS16550

config FLASH_INIT_PRIORITY
	default 0

config IT8XXX2_PLL_SEQUENCE_PRIORITY
	int
	default 1
	depends on SOC_IT8XXX2_PLL_FLASH_48M

config VCMP_IT8XXX2_INIT_PRIORITY
	default 91 if VCMP_IT8XXX2_WORKQUEUE

config NUM_IRQS
	default 185

config DYNAMIC_INTERRUPTS
	default y

config GEN_ISR_TABLES
	default y

config GEN_IRQ_START_VECTOR
	default 0

config GEN_SW_ISR_TABLE
	default y

config RISCV_SOC_INTERRUPT_INIT
	default y

rsource "Kconfig.defconfig.it8*"

endif # SOC_SERIES_IT8XXX2
```

## soc/ite/ec/it8xxx2/Kconfig.soc
```kconfig
# Copyright (c) 2020 ITE Corporation. All Rights Reserved.
# SPDX-License-Identifier: Apache-2.0

config SOC_SERIES_IT8XXX2
	bool
	select SOC_FAMILY_ITE_EC
	help
	    Enable support for ITE IT8XXX2

config SOC_IT8XXX2
	bool
	select SOC_SERIES_IT8XXX2

config SOC_IT81302BX
	bool
	select SOC_IT8XXX2

config SOC_IT81202BX
	bool
	select SOC_IT8XXX2

config SOC_IT81302CX
	bool
	select SOC_IT8XXX2

config SOC_IT81202CX
	bool
	select SOC_IT8XXX2

config SOC_IT81302DX
	bool
	select SOC_IT8XXX2

config SOC_IT81202DX
	bool
	select SOC_IT8XXX2

config SOC_IT82202AX
	bool
	select SOC_IT8XXX2

config SOC_IT82302AX
	bool
	select SOC_IT8XXX2

config SOC_IT82002AW
	bool
	select SOC_IT8XXX2

config SOC_IT82002BW
	bool
	select SOC_IT8XXX2

config SOC_IT82202BW
	bool
	select SOC_IT8XXX2

config SOC_IT82302BW
	bool
	select SOC_IT8XXX2

config SOC_IT82000BW
	bool
	select SOC_IT8XXX2

config SOC_SERIES
	default "it8xxx2" if SOC_SERIES_IT8XXX2

config SOC
	default "it81202bx" if SOC_IT81202BX
	default "it81202cx" if SOC_IT81202CX
	default "it81202dx" if SOC_IT81202DX
	default "it81302bx" if SOC_IT81302BX
	default "it81302cx" if SOC_IT81302CX
	default "it81302dx" if SOC_IT81302DX
	default "it82000bw" if SOC_IT82000BW
	default "it82002aw" if SOC_IT82002AW
	default "it82002bw" if SOC_IT82002BW
	default "it82202ax" if SOC_IT82202AX
	default "it82302ax" if SOC_IT82302AX
	default "it82202bw" if SOC_IT82202BW
	default "it82302bw" if SOC_IT82302BW
```

## soc/litex/Kconfig.soc
```kconfig
# SPDX-FileCopyrightText: Copyright The Zephyr Project Contributors
# SPDX-License-Identifier: Apache-2.0

config SOC_FAMILY_LITEX
	bool

config SOC_FAMILY
	default "litex" if SOC_FAMILY_LITEX

rsource "*/Kconfig.soc"
```

## soc/litex/litex_vexiiriscv/Kconfig
```kconfig
# SPDX-FileCopyrightText: Copyright The Zephyr Project Contributors
# SPDX-License-Identifier: Apache-2.0

config SOC_LITEX_VEXIIRISCV
	select RISCV
	select INCLUDE_RESET_VECTOR
	select RISCV_PRIVILEGED
	select RISCV_HAS_PLIC
	select RISCV_SOC_HAS_GP_RELATIVE_ADDRESSING
```
