## soc/litex/litex_vexiiriscv/Kconfig.soc
```kconfig
# SPDX-FileCopyrightText: Copyright The Zephyr Project Contributors
# SPDX-License-Identifier: Apache-2.0

config SOC_SERIES
	default "litex_vexiiriscv" if SOC_SERIES_LITEX_VEXIIRISCV

config SOC_SERIES_LITEX_VEXIIRISCV
	bool
	select SOC_FAMILY_LITEX

config SOC_LITEX_VEXIIRISCV
	bool
	select SOC_SERIES_LITEX_VEXIIRISCV

config SOC
	default "litex_vexiiriscv" if SOC_LITEX_VEXIIRISCV
```

## soc/litex/litex_vexriscv/Kconfig
```kconfig
# SPDX-FileCopyrightText: Copyright (c) 2018 - 2019 Antmicro <www.antmicro.com>
# SPDX-License-Identifier: Apache-2.0

config SOC_LITEX_VEXRISCV
	select RISCV
	select INCLUDE_RESET_VECTOR
	# There are varriants of the Vexriscv without cache, be able to set it
	select CPU_HAS_ICACHE if $(dt_node_int_prop_int,/cpus/cpu@0,i-cache-line-size) > 0
	select CPU_HAS_DCACHE if $(dt_node_int_prop_int,/cpus/cpu@0,d-cache-line-size) > 0
```

## soc/litex/litex_vexriscv/Kconfig.defconfig
```kconfig
# SPDX-FileCopyrightText: Copyright The Zephyr Project Contributors
# SPDX-License-Identifier: Apache-2.0

if SOC_LITEX_VEXRISCV

config NUM_IRQS
	default 12

endif # SOC_LITEX_VEXRISCV
```
