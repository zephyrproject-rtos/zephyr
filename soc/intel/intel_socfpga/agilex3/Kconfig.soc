## soc/intel/intel_socfpga/agilex3/Kconfig.soc
```kconfig
# Copyright (c) 2022-2024 Intel Corporation
# Copyright (c) 2026 Altera Corporation
# SPDX-License-Identifier: Apache-2.0

config SOC_AGILEX3
	bool
	select SOC_FAMILY_INTEL_SOCFPGA
	help
	  Intel SoC FPGA Agilex3

config SOC
	default "agilex3" if SOC_AGILEX3
```

## soc/intel/intel_socfpga_std/cyclonev/Kconfig.defconfig.cyclonev
```kconfig
# Copyright (c) 2022-2024 Intel Corporation
# SPDX-License-Identifier: Apache-2.0

if SOC_CYCLONEV

config NUM_IRQS
	default 211

endif
```

## soc/ite/ec/it51xxx/Kconfig.defconfig.it51526bw
```kconfig
# Copyright (c) 2026 ITE Corporation. All Rights Reserved.
# SPDX-License-Identifier: Apache-2.0

if SOC_IT51526BW

configdefault ITE_IT51XXX_TIMER_COUNTUP_IN_COMBINATION_MODE
	default y

config NUM_IRQS
	default 225

endif # SOC_IT51526BW
```

## soc/litex/Kconfig
```kconfig
# SPDX-FileCopyrightText: Copyright The Zephyr Project Contributors
# SPDX-License-Identifier: Apache-2.0

if SOC_FAMILY_LITEX

rsource "*/Kconfig"

endif # SOC_FAMILY_LITEX
```

## soc/litex/Kconfig.defconfig
```kconfig
# SPDX-FileCopyrightText: Copyright The Zephyr Project Contributors
# SPDX-License-Identifier: Apache-2.0

if SOC_FAMILY_LITEX

rsource "*/Kconfig.defconfig"

config REBOOT
	depends on DT_HAS_LITEX_SOC_CONTROLLER_ENABLED
	default y

endif # SOC_FAMILY_LITEX
```

## soc/mediatek/mt7xxx/Kconfig
```kconfig
# SPDX-FileCopyrightText: 2026 Muhammad Waleed Badar
# SPDX-License-Identifier: Apache-2.0

if SOC_FAMILY_MT7XXX

rsource "*/Kconfig"

endif # SOC_FAMILY_MT7XXX
```

## soc/mediatek/mt7xxx/Kconfig.defconfig
```kconfig
# SPDX-FileCopyrightText: 2026 Muhammad Waleed Badar
# SPDX-License-Identifier: Apache-2.0

orsource "*/Kconfig.defconfig"
```

## soc/mediatek/mt7xxx/Kconfig.soc
```kconfig
# SPDX-FileCopyrightText: 2026 Muhammad Waleed Badar
# SPDX-License-Identifier: Apache-2.0

config SOC_FAMILY_MT7XXX
	bool

config SOC_FAMILY
	default "mt7xxx" if SOC_FAMILY_MT7XXX

config SOC_SERIES_MT76X8
	bool
	select SOC_FAMILY_MT7XXX
	help
	  Mediatek MT76x8

config SOC_SERIES
	default "mt76x8" if SOC_SERIES_MT76X8

rsource "*/Kconfig.soc"
```

## soc/mediatek/mt7xxx/mt7628/Kconfig
```kconfig
# SPDX-FileCopyrightText: 2026 Muhammad Waleed Badar
# SPDX-License-Identifier: Apache-2.0

config SOC_MT7628
	select MIPS
	select MIPS_CP0_TIMER
```

## soc/mediatek/mt7xxx/mt7628/Kconfig.soc
```kconfig
# SPDX-FileCopyrightText: 2026 Muhammad Waleed Badar
# SPDX-License-Identifier: Apache-2.0

config SOC_MT7628
	bool
	select SOC_SERIES_MT76X8
	help
	  Mediatek MT7628

config SOC
	default "mt7628" if SOC_MT7628
```

## soc/mediatek/mt8xxx/Kconfig
```kconfig
# Copyright 2024 The ChromiumOS Authors
# SPDX-License-Identifier: Apache-2.0

if SOC_FAMILY_MT8XXX

rsource "*/Kconfig"

endif # SOC_FAMILY_MT8XXX
```

## soc/mediatek/mt8xxx/Kconfig.defconfig
```kconfig
# Copyright 2023 The ChromiumOS Authors
# SPDX-License-Identifier: Apache-2.0

orsource "*/Kconfig.defconfig"
```

## soc/mediatek/mt8xxx/Kconfig.soc
```kconfig
# Copyright 2024 The ChromiumOS Authors
# SPDX-License-Identifier: Apache-2.0

config SOC_FAMILY_MT8XXX
	bool

config SOC_FAMILY
	default "mt8xxx" if SOC_FAMILY_MT8XXX

config SOC_SERIES_MT8195
	bool
	select SOC_FAMILY_MT8XXX
	help
	  Mediatek MT8195

config SOC_SERIES_MT818X
	bool
	select SOC_FAMILY_MT8XXX
	help
	  Mediatek MT818x

config SOC_SERIES_MT8196
	bool
	select SOC_FAMILY_MT8XXX
	help
	  Mediatek MT8196

config SOC_SERIES_MT8365
	bool
	select SOC_FAMILY_MT8XXX
	help
	  Mediatek MT8365

config SOC_SERIES
	default "mt8195" if SOC_SERIES_MT8195
	default "mt818x" if SOC_SERIES_MT818X
	default "mt8196" if SOC_SERIES_MT8196
	default "mt8365" if SOC_SERIES_MT8365

rsource "*/Kconfig.soc"
```

## soc/mediatek/mt8xxx/mt8186/Kconfig.soc
```kconfig
# Copyright 2024 The ChromiumOS Authors
# SPDX-License-Identifier: Apache-2.0

config SOC_MT8186
	bool
	select SOC_SERIES_MT818X

config SOC_MT8186_ADSP
	bool
	select SOC_MT8186
	select SOC_MTK_ADSP
	help
	  Mediatek MT8186 audio DSP

config SOC
	default "mt8186" if SOC_MT8186
```

## soc/mediatek/mt8xxx/mt8188/Kconfig
```kconfig
# Copyright (c) 2026 MediaTek Inc.
# SPDX-License-Identifier: Apache-2.0

config SOC_MT8188_A55
	select ARM64
	select CPU_CORTEX_A55
	select ARM_ARCH_TIMER if SYS_CLOCK_EXISTS
	select TIMER_READS_ITS_FREQUENCY_AT_RUNTIME if ARM_ARCH_TIMER
```

## soc/mediatek/mt8xxx/mt8188/Kconfig.defconfig
```kconfig
# Copyright 2024 The ChromiumOS Authors
# SPDX-License-Identifier: Apache-2.0

if SOC_MT8188

rsource "Kconfig.defconfig.*"

endif # SOC_MT8188
```

## soc/mediatek/mt8xxx/mt8188/Kconfig.soc
```kconfig
# Copyright 2024 The ChromiumOS Authors
# SPDX-License-Identifier: Apache-2.0

config SOC_MT8188
	bool
	select SOC_SERIES_MT818X

config SOC_MT8188_ADSP
	bool
	select SOC_MT8188
	select SOC_MTK_ADSP
	help
	  Mediatek MT8188 audio DSP

config SOC
	default "mt8188" if SOC_MT8188
```

## soc/mediatek/mt8xxx/mt8195/Kconfig.defconfig
```kconfig
# Copyright 2023 The ChromiumOS Authors
# SPDX-License-Identifier: Apache-2.0

if SOC_MT8195

rsource "Kconfig.defconfig.*"

endif # SOC_MT8195
```

## soc/mediatek/mt8xxx/mt8195/Kconfig.soc
```kconfig
# Copyright 2024 The ChromiumOS Authors
# SPDX-License-Identifier: Apache-2.0

config SOC_MT8195
	bool
	select SOC_SERIES_MT8195

config SOC_MT8195_ADSP
	bool
	select SOC_MT8195
	select SOC_MTK_ADSP
	help
	  Mediatek MT8195 audio DSP

config SOC
	default "mt8195" if SOC_MT8195
```

## soc/mediatek/mt8xxx/mt8196/Kconfig
```kconfig
# Copyright 2024 The ChromiumOS Authors
# SPDX-License-Identifier: Apache-2.0

config SOC_MT8196_ADSP
	select XTENSA
	select CPU_HAS_DCACHE
	select ARCH_HAS_NOCACHE_MEMORY_SUPPORT
```

## soc/mediatek/mt8xxx/mt8196/Kconfig.defconfig
```kconfig
# Copyright 2024 The ChromiumOS Authors
# SPDX-License-Identifier: Apache-2.0

if SOC_MT8196

rsource "Kconfig.defconfig.*"

endif # SOC_MT8196
```
