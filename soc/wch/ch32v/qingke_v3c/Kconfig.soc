## soc/wch/ch32v/qingke_v3c/Kconfig.soc
```kconfig
# SPDX-FileCopyrightText: 2026 SMILE (smile.eu)
# SPDX-License-Identifier: Apache-2.0

config SOC_SERIES_QINGKE_V3C
	bool
	select SOC_FAMILY_CH32V

config SOC_SERIES
	default "qingke_v3c" if SOC_SERIES_QINGKE_V3C

rsource "Kconfig.soc.*"
```

## soc/wch/ch32v/qingke_v3c/Kconfig.soc.ch570
```kconfig
# SPDX-FileCopyrightText: 2026 SMILE (smile.eu)
# SPDX-License-Identifier: Apache-2.0

config SOC_CH570
	bool
	select SOC_SERIES_QINGKE_V3C

config SOC
	default "ch570" if SOC_CH570
```

## soc/wch/ch32v/qingke_v3c/Kconfig.soc.ch572
```kconfig
# SPDX-FileCopyrightText: 2026 SMILE (smile.eu)
# SPDX-License-Identifier: Apache-2.0

config SOC_CH572
	bool
	select SOC_SERIES_QINGKE_V3C

config SOC
	default "ch572" if SOC_CH572
```

## soc/wch/ch32v/qingke_v4/Kconfig
```kconfig
# Copyright (c) 2025 MASSDRIVER EI (massdriver.space)
# SPDX-License-Identifier: Apache-2.0

rsource "*/Kconfig"
```

## soc/wch/ch32v/qingke_v4/Kconfig.soc
```kconfig
# Copyright (c) 2025 MASSDRIVER EI (massdriver.space)
# SPDX-License-Identifier: Apache-2.0

config SOC_SERIES_QINGKE_V4
	bool
	select SOC_FAMILY_CH32V

config SOC_SERIES
	default "qingke_v4" if SOC_SERIES_QINGKE_V4

rsource "*/Kconfig.soc.*"
```

## soc/wch/ch32v/qingke_v4b/Kconfig.soc.ch32v203
```kconfig
# Copyright (c) 2025 MASSDRIVER EI (massdriver.space)
# SPDX-License-Identifier: Apache-2.0

config SOC_CH32V203
	bool
	select SOC_SERIES_QINGKE_V4B

config SOC
	default "ch32v203" if SOC_CH32V203
```

## soc/wch/ch32v/qingke_v4c/Kconfig
```kconfig
# Copyright (c) 2025 MASSDRIVER EI (massdriver.space)
# SPDX-License-Identifier: Apache-2.0

config SOC_SERIES_QINGKE_V4C
```

## soc/wch/ch32v/qingke_v4c/Kconfig.defconfig
```kconfig
# Copyright (c) 2025 MASSDRIVER EI (massdriver.space)
# SPDX-License-Identifier: Apache-2.0

if SOC_SERIES_QINGKE_V4C

config SYS_CLOCK_HW_CYCLES_PER_SEC
	default $(dt_node_int_prop_int,/cpus/cpu@0,clock-frequency)

config CLOCK_CONTROL
	default y

rsource "Kconfig.defconfig.*"

endif # SOC_SERIES_QINGKE_V4C
```

## soc/wch/ch32v/qingke_v4c/Kconfig.defconfig.ch32l103
```kconfig
# Copyright (c) 2025 Paul Wedeck
# SPDX-License-Identifier: Apache-2.0

if SOC_CH32L103

config VECTOR_TABLE_SIZE
	default 68

config NUM_IRQS
	default 128

endif # SOC_CH32L103
```

## soc/wch/ch32v/qingke_v4c/Kconfig.defconfig.ch32v208
```kconfig
# Copyright (c) 2025 MASSDRIVER EI (massdriver.space)
# SPDX-License-Identifier: Apache-2.0

if SOC_CH32V208

config VECTOR_TABLE_SIZE
	default 103

config NUM_IRQS
	default 128

endif # SOC_CH32V208
```

## soc/wch/ch32v/qingke_v4c/Kconfig.soc
```kconfig
# Copyright (c) 2025 MASSDRIVER EI (massdriver.space)
# SPDX-License-Identifier: Apache-2.0

config SOC_SERIES_QINGKE_V4C
	bool
	select SOC_FAMILY_CH32V

config SOC_SERIES
	default "qingke_v4c" if SOC_SERIES_QINGKE_V4C

rsource "Kconfig.soc.*"
```

## soc/wch/ch32v/qingke_v4c/Kconfig.soc.ch32l103
```kconfig
# Copyright (c) 2025 Paul Wedeck
# SPDX-License-Identifier: Apache-2.0

config SOC_CH32L103
	bool
	select SOC_SERIES_QINGKE_V4C

config SOC
	default "ch32l103" if SOC_CH32L103
```

## soc/wch/ch32v/qingke_v4c/Kconfig.soc.ch32v208
```kconfig
# Copyright (c) 2025 MASSDRIVER EI (massdriver.space)
# SPDX-License-Identifier: Apache-2.0

config SOC_CH32V208
	bool
	select SOC_SERIES_QINGKE_V4C

config SOC
	default "ch32v208" if SOC_CH32V208
```

## soc/wch/ch32v/qingke_v4f/Kconfig
```kconfig
# Copyright (c) 2025 Bootlin
# SPDX-License-Identifier: Apache-2.0

config SOC_SERIES_QINGKE_V4F
```

## soc/wch/ch32v/qingke_v4f/Kconfig.defconfig
```kconfig
# Copyright (c) 2025 Bootlin
# SPDX-License-Identifier: Apache-2.0

if SOC_SERIES_QINGKE_V4F

config SYS_CLOCK_HW_CYCLES_PER_SEC
	default $(dt_node_int_prop_int,/cpus/cpu@0,clock-frequency)

config CLOCK_CONTROL
	default y

rsource "Kconfig.defconfig.*"

endif # SOC_SERIES_QINGKE_V4F
```

## soc/wch/ch32v/qingke_v4f/Kconfig.defconfig.ch32v303
```kconfig
# Copyright (c) 2025 Bootlin
# SPDX-License-Identifier: Apache-2.0

if SOC_CH32V303

config VECTOR_TABLE_SIZE
	default 103

config NUM_IRQS
	default 128

endif # SOC_CH32V303
```

## soc/wch/ch32v/qingke_v4f/Kconfig.defconfig.ch32v307
```kconfig
# Copyright (c) 2025 Thomas Boje
# SPDX-License-Identifier: Apache-2.0

if SOC_CH32V307

config VECTOR_TABLE_SIZE
	default 103

config NUM_IRQS
	default 128

endif # SOC_CH32V307
```

## soc/wch/ch32v/qingke_v4f/Kconfig.defconfig.ch32v317
```kconfig
# Copyright (c) 2026 James Bennion-Pedley
# SPDX-License-Identifier: Apache-2.0

if SOC_CH32V317

config VECTOR_TABLE_SIZE
	default 103

config NUM_IRQS
	default 128

endif # SOC_CH32V317
```

## soc/wch/ch32v/qingke_v4f/Kconfig.soc
```kconfig
# Copyright (c) 2025 Bootlin
# SPDX-License-Identifier: Apache-2.0

config SOC_SERIES_QINGKE_V4F
	bool
	select SOC_FAMILY_CH32V

config SOC_SERIES
	default "qingke_v4f" if SOC_SERIES_QINGKE_V4F

rsource "Kconfig.soc.*"
```

## soc/wch/ch32v/qingke_v4f/Kconfig.soc.ch32v303
```kconfig
# Copyright (c) 2025 Bootlin
# SPDX-License-Identifier: Apache-2.0

config SOC_CH32V303
	bool
	select SOC_SERIES_QINGKE_V4F

config SOC
	default "ch32v303" if SOC_CH32V303
```

## soc/wch/ch32v/qingke_v4f/Kconfig.soc.ch32v307
```kconfig
# Copyright (c) 2025 Thomas Boje
# SPDX-License-Identifier: Apache-2.0

config SOC_CH32V307
	bool
	select SOC_SERIES_QINGKE_V4F

config SOC
	default "ch32v307" if SOC_CH32V307
```

## soc/wch/ch32v/qingke_v4f/Kconfig.soc.ch32v317
```kconfig
# Copyright (c) 2026 James Bennion-Pedley
# SPDX-License-Identifier: Apache-2.0

config SOC_CH32V317
	bool
	select SOC_SERIES_QINGKE_V4F

config SOC
	default "ch32v317" if SOC_CH32V317
```

## soc/wch/ch32v00x/Kconfig
```kconfig
# Copyright (c) 2024 Michael Hope
# SPDX-License-Identifier: Apache-2.0

config SOC_CH32V003
	select RISCV
	select BUILD_OUTPUT_HEX
	select RISCV_ISA_RV32E
	select RISCV_ISA_EXT_ZICSR
	select RISCV_ISA_EXT_ZIFENCEI
	select RISCV_ISA_EXT_C
	select CH32V00X_SYSTICK
	select ATOMIC_OPERATIONS_C
	imply XIP
```

## soc/wch/ch32v00x/Kconfig.defconfig
```kconfig
# Copyright (c) 2024 Michael Hope
# SPDX-License-Identifier: Apache-2.0

if SOC_CH32V003

config NUM_IRQS
	default 48

config SYS_CLOCK_HW_CYCLES_PER_SEC
	default $(dt_node_int_prop_int,/cpus/cpu@0,clock-frequency)

config MAIN_STACK_SIZE
	default 512

config IDLE_STACK_SIZE
	default 256

config ISR_STACK_SIZE
	default 256

config CLOCK_CONTROL
	default y

endif # SOC_CH32V003
```

## soc/wch/ch32v00x/Kconfig.soc
```kconfig
# Copyright (c) 2024 Michael Hope
# SPDX-License-Identifier: Apache-2.0

config SOC_SERIES_CH32V00X
	bool

config SOC_CH32V003
	bool
	select SOC_SERIES_CH32V00X

config SOC_SERIES
	default "ch32v00x" if SOC_SERIES_CH32V00X

config SOC
	default "ch32v003" if SOC_CH32V003
```
