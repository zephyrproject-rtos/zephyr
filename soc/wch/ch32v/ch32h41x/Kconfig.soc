## soc/wch/ch32v/ch32h41x/Kconfig.soc
```kconfig
# Copyright (c) 2026 Liu Changjie
# SPDX-License-Identifier: Apache-2.0

# CH32H41X is an SoC series (not a single SoC): it groups the dual-core CH32H41x
# parts, which pair a QingKe V3F boot core with a QingKe V5F application core.
# Because the series spans two heterogeneous QingKe cores it is named after the
# chip subfamily rather than a single core (cf. SOC_SERIES_QINGKE_V4B), the same
# way Zephyr models other multi-core parts such as the STM32H7 series.
config SOC_SERIES_CH32H41X
	bool
	select SOC_FAMILY_CH32V

config SOC_SERIES
	default "ch32h41x" if SOC_SERIES_CH32H41X

rsource "Kconfig.soc.*"
```

## soc/wch/ch32v/ch32h41x/Kconfig.soc.ch32h417
```kconfig
# Copyright (c) 2026 Liu Changjie
# SPDX-License-Identifier: Apache-2.0

config SOC_CH32H417
	bool
	select SOC_SERIES_CH32H41X

config SOC_CH32H417_V3F
	bool
	select SOC_CH32H417
	help
	  This hidden configuration targets the QingKe V3F boot core in the
	  CH32H417 AMP SoC. When SOC_CH32H417_BOOT_V5F is enabled, the boot core
	  wakes the V5F application core from soc_early_init_hook() (see
	  soc_v3f.c).

config SOC_CH32H417_V5F
	bool
	select SOC_CH32H417
	help
	  This hidden configuration targets the QingKe V5F application core in the
	  CH32H417 AMP SoC.

config SOC
	default "ch32h417" if SOC_CH32H417
```

## soc/wch/ch32v/ch32v00x/Kconfig
```kconfig
# Copyright (c) 2025 Michael Hope <michaelh@juju.nz>
# SPDX-License-Identifier: Apache-2.0

config SOC_SERIES_CH32V00X
```

## soc/wch/ch32v/ch32v00x/Kconfig.defconfig
```kconfig
# Copyright (c) 2025 Michael Hope <michaelh@juju.nz>
# SPDX-License-Identifier: Apache-2.0

if SOC_SERIES_CH32V00X

config SYS_CLOCK_HW_CYCLES_PER_SEC
	default $(dt_node_int_prop_int,/cpus/cpu@0,clock-frequency)

config CLOCK_CONTROL
	default y

rsource "Kconfig.defconfig.*"

endif # SOC_SERIES_CH32V00X
```

## soc/wch/ch32v/ch32v00x/Kconfig.defconfig.ch32v006
```kconfig
# Copyright (c) 2025 Michael Hope <michaelh@juju.nz>
# SPDX-License-Identifier: Apache-2.0

if SOC_SERIES_CH32V00X

config VECTOR_TABLE_SIZE
	default 41

config NUM_IRQS
	default 41

endif # SOC_SERIES_CH32V00X
```

## soc/wch/ch32v/ch32v00x/Kconfig.soc
```kconfig
# Copyright (c) 2025 Michael Hope <michaelh@juju.nz>
# SPDX-License-Identifier: Apache-2.0

config SOC_SERIES_CH32V00X
	bool
	select SOC_FAMILY_CH32V

config SOC_SERIES
	default "ch32v00x" if SOC_SERIES_CH32V00X

rsource "Kconfig.soc.*"
```

## soc/wch/ch32v/ch32v00x/Kconfig.soc.ch32v006
```kconfig
# Copyright (c) 2025 Michael Hope <michaelh@juju.nz>
# SPDX-License-Identifier: Apache-2.0

config SOC_CH32V006
	bool
	select SOC_SERIES_CH32V00X

config SOC
	default "ch32v006" if SOC_CH32V006
```

## soc/wch/ch32v/qingke_v2a/Kconfig
```kconfig
# Copyright (c) 2024 Michael Hope
# SPDX-License-Identifier: Apache-2.0

config SOC_SERIES_QINGKE_V2A
```

## soc/wch/ch32v/qingke_v2a/Kconfig.defconfig.ch32v003
```kconfig
# Copyright (c) 2024 Michael Hope
# SPDX-License-Identifier: Apache-2.0

if SOC_CH32V003

config VECTOR_TABLE_SIZE
	default 38

config NUM_IRQS
	default 48

endif # SOC_CH32V003
```

## soc/wch/ch32v/qingke_v2a/Kconfig.soc
```kconfig
# Copyright (c) 2024 Jianxiong Gu
# SPDX-License-Identifier: Apache-2.0

config SOC_SERIES_QINGKE_V2A
	bool
	select SOC_FAMILY_CH32V

config SOC_SERIES
	default "qingke_v2a" if SOC_SERIES_QINGKE_V2A

rsource "Kconfig.soc.*"
```

## soc/wch/ch32v/qingke_v2a/Kconfig.soc.ch32v003
```kconfig
# Copyright (c) 2024 Michael Hope
# SPDX-License-Identifier: Apache-2.0

config SOC_CH32V003
	bool
	select SOC_SERIES_QINGKE_V2A

config SOC
	default "ch32v003" if SOC_CH32V003
```

## soc/wch/ch32v/qingke_v2c/Kconfig
```kconfig
# Copyright (c) 2025 Michael Hope <michaelh@juju.nz>
# SPDX-License-Identifier: Apache-2.0

config SOC_SERIES_QINGKE_V2C
```

## soc/wch/ch32v/qingke_v2c/Kconfig.defconfig.ch32v006
```kconfig
# Copyright (c) 2025 Michael Hope <michaelh@juju.nz>
# SPDX-License-Identifier: Apache-2.0

if SOC_CH32V006

config VECTOR_TABLE_SIZE
	default 41

config NUM_IRQS
	default 41

endif # SOC_CH32V006
```

## soc/wch/ch32v/qingke_v2c/Kconfig.soc
```kconfig
# Copyright (c) 2025 Michael Hope <michaelh@juju.nz>
# SPDX-License-Identifier: Apache-2.0

config SOC_SERIES_QINGKE_V2C
	bool
	select SOC_FAMILY_CH32V

config SOC_SERIES
	default "qingke_v2c" if SOC_SERIES_QINGKE_V2C

rsource "Kconfig.soc.*"
```

## soc/wch/ch32v/qingke_v2c/Kconfig.soc.ch32v006
```kconfig
# Copyright (c) 2025 Michael Hope <michaelh@juju.nz>
# SPDX-License-Identifier: Apache-2.0

config SOC_CH32V006
	bool
	select SOC_SERIES_QINGKE_V2C

config SOC
	default "ch32v006" if SOC_CH32V006
```

## soc/wch/ch32v/qingke_v3/Kconfig
```kconfig
# Copyright (c) 2023-2024 Chen Xingyu <hi@xingrz.me>
# SPDX-License-Identifier: Apache-2.0

config SOC_SERIES_CH32V_QINGKE_V3A
	select RISCV_ISA_RV32I
	select RISCV_ISA_EXT_M
	select RISCV_ISA_EXT_A
	select RISCV_ISA_EXT_C
	select RISCV_ISA_EXT_ZICSR
```

## soc/wch/ch32v/qingke_v3/Kconfig.defconfig
```kconfig
# Copyright (c) 2023-2024 Chen Xingyu <hi@xingrz.me>
# SPDX-License-Identifier: Apache-2.0

if SOC_SERIES_CH32V_QINGKE_V3A

config RISCV_GP
	default y

rsource "Kconfig.defconfig.*"

endif # SOC_SERIES_CH32V_QINGKE_V3A
```

## soc/wch/ch32v/qingke_v3/Kconfig.defconfig.ch56x
```kconfig
# Copyright (c) 2023-2024 Chen Xingyu <hi@xingrz.me>
# SPDX-License-Identifier: Apache-2.0

if SOC_CH56X

config NUM_IRQS
	int
	default 36

config SYS_CLOCK_HW_CYCLES_PER_SEC
	default $(dt_node_int_prop_int,$(dt_nodelabel_path,hclk),clock-frequency)

config CLOCK_CONTROL
	default y

endif # SOC_CH56X
```

## soc/wch/ch32v/qingke_v3/Kconfig.soc
```kconfig
# Copyright (c) 2023-2024 Chen Xingyu <hi@xingrz.me>
# SPDX-License-Identifier: Apache-2.0

config SOC_SERIES_CH32V_QINGKE_V3A
	bool
	select SOC_FAMILY_CH32V

config SOC_SERIES
	default "qingke_v3" if SOC_SERIES_CH32V_QINGKE_V3A

rsource "Kconfig.soc.*"
```

## soc/wch/ch32v/qingke_v3/Kconfig.soc.ch56x
```kconfig
# Copyright (c) 2023-2024 Chen Xingyu <hi@xingrz.me>
# SPDX-License-Identifier: Apache-2.0

config SOC_CH56X
	bool
	select SOC_SERIES_CH32V_QINGKE_V3A

config SOC_CH565
	bool "WCH CH565"
	select SOC_CH56X

config SOC_CH569
	bool "WCH CH569"
	select SOC_CH56X

config SOC
	default "ch565" if SOC_CH565
	default "ch569" if SOC_CH569
```

## soc/wch/ch32v/qingke_v3a/Kconfig
```kconfig
# Copyright (c) 2026 Lucy Wong
# SPDX-License-Identifier: Apache-2.0

config SOC_SERIES_QINGKE_V3A
```

## soc/wch/ch32v/qingke_v3a/Kconfig.defconfig.ch32v103
```kconfig
# Copyright (c) 2026 Lucy Wong
# SPDX-License-Identifier: Apache-2.0

if SOC_CH32V103

config VECTOR_TABLE_SIZE
	default 68

config NUM_IRQS
	default 76

endif # SOC_CH32V103
```

## soc/wch/ch32v/qingke_v3a/Kconfig.soc
```kconfig
# Copyright (c) 2026 Lucy Wong
# SPDX-License-Identifier: Apache-2.0

config SOC_SERIES_QINGKE_V3A
	bool
	select SOC_FAMILY_CH32V

config SOC_SERIES
	default "qingke_v3a" if SOC_SERIES_QINGKE_V3A

rsource "Kconfig.soc.*"
```

## soc/wch/ch32v/qingke_v3a/Kconfig.soc.ch32v103
```kconfig
# Copyright (c) 2026 Lucy Wong
# SPDX-License-Identifier: Apache-2.0

config SOC_CH32V103
	bool
	select SOC_SERIES_QINGKE_V3A

config SOC
	default "ch32v103" if SOC_CH32V103
```

## soc/wch/ch32v/qingke_v3c/Kconfig.defconfig.ch570
```kconfig
# SPDX-FileCopyrightText: 2026 SMILE (smile.eu)
# SPDX-License-Identifier: Apache-2.0

if SOC_CH570

config VECTOR_TABLE_SIZE
	default 35

config NUM_IRQS
	default 36

endif # SOC_CH570
```
