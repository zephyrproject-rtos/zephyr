## soc/wch/ch32v20x/Kconfig
```kconfig
# Copyright (c) 2024 MASSDRIVER EI (massdriver.space)
# SPDX-License-Identifier: Apache-2.0

config SOC_SERIES_CH32V20X
	select RISCV
	select BUILD_OUTPUT_HEX
	select RISCV_ISA_RV32I
	select RISCV_ISA_EXT_M
	select RISCV_ISA_EXT_A
	select RISCV_ISA_EXT_C
	select RISCV_ISA_EXT_ZICSR
	select RISCV_ISA_EXT_ZIFENCEI
	select CH32V00X_SYSTICK
	select ATOMIC_OPERATIONS_C
	imply XIP
```

## soc/wch/ch32v20x/Kconfig.defconfig
```kconfig
# Copyright (c) 2024 MASSDRIVER EI (massdriver.space)
# SPDX-License-Identifier: Apache-2.0

if SOC_SERIES_CH32V20X

config NUM_IRQS
	default 128

config SYS_CLOCK_HW_CYCLES_PER_SEC
	default $(dt_node_int_prop_int,/cpus/cpu@0,clock-frequency)

config MAIN_STACK_SIZE
	default 512

config IDLE_STACK_SIZE
	default 256

config ISR_STACK_SIZE
	default 256

config CLOCK_CONTROL
	default y

endif # SOC_SERIES_CH32V20X
```

## soc/wch/ch32v20x/Kconfig.soc
```kconfig
# Copyright (c) 2024 MASSDRIVER EI (massdriver.space)
# SPDX-License-Identifier: Apache-2.0

config SOC_SERIES_CH32V20X
	bool

config SOC_CH32V208
	bool
	select SOC_SERIES_CH32V20X

config SOC_CH32V203
	bool
	select SOC_SERIES_CH32V20X

config SOC_SERIES
	default "ch32v20x" if SOC_SERIES_CH32V20X

config SOC
	default "ch32v203" if SOC_CH32V203
	default "ch32v208" if SOC_CH32V208
```

## soc/wch/ch5xx/Kconfig
```kconfig
# Copyright (c) 2026 Mike Kasprzak (distraction.engineer)
# SPDX-License-Identifier: Apache-2.0

rsource "Kconfig_wch"

config SOC_FAMILY_CH5XX
	select RISCV
	select BUILD_OUTPUT_HEX
	select WCH_HAS_CODEFLASH
	select WCH_HAS_DATAFLASH
	select WCH_HAS_INFOFLASH
	select WCH_HAS_SRAM0

if SOC_FAMILY_CH5XX

config VECTOR_TABLE_SIZE
	int "Number of Interrupt and Exception Vectors"
	range 20 256
	help
	  This option defines the total number of interrupt and exception
	  vectors in the vector table.

rsource "ch5*/Kconfig"

endif # SOC_FAMILY_CH5XX
```

## soc/wch/ch5xx/Kconfig.defconfig
```kconfig
# Copyright (c) 2026 Mike Kasprzak (distraction.engineer)
# SPDX-License-Identifier: Apache-2.0

if SOC_FAMILY_CH5XX

rsource "ch5*/Kconfig.defconfig"

endif # SOC_FAMILY_CH5XX
```

## soc/wch/ch5xx/Kconfig.soc
```kconfig
# Copyright (c) 2026 Mike Kasprzak (distraction.engineer)
# SPDX-License-Identifier: Apache-2.0

config SOC_FAMILY_CH5XX
  bool

config SOC_FAMILY
  default "ch5xx" if SOC_FAMILY_CH5XX

rsource "ch5*/Kconfig.soc"
```

## soc/wch/ch5xx/ch591/Kconfig
```kconfig
# Copyright (c) 2026 Mike Kasprzak (distraction.engineer)
# SPDX-License-Identifier: Apache-2.0

config SOC_SERIES_CH591
```

## soc/wch/ch5xx/ch591/Kconfig.soc
```kconfig
# Copyright (c) 2026 Mike Kasprzak (distraction.engineer)
# SPDX-License-Identifier: Apache-2.0

config SOC_SERIES_CH591
	bool
	select SOC_FAMILY_CH5XX
	select SOC_HAS_BOOTLOADER
	select SOC_HAS_SRAM1

config SOC_SERIES
	default "ch591" if SOC_SERIES_CH591

rsource "Kconfig.soc.*"
```

## soc/wch/ch5xx/ch591/kconfig.soc.ch591f
```kconfig
# Copyright (c) 2026 Mike Kasprzak (distraction.engineer)
# SPDX-License-Identifier: Apache-2.0

config SOC_CH591F
	bool
	select SOC_SERIES_CH591

config SOC
	default "ch591f" if SOC_CH591F
```

## soc/wch/ch5xx/ch592/Kconfig.soc
```kconfig
# Copyright (c) 2026 Mike Kasprzak (distraction.engineer)
# SPDX-License-Identifier: Apache-2.0

config SOC_SERIES_CH592
	bool
	select SOC_FAMILY_CH5XX
	select SOC_HAS_BOOTLOADER
	select SOC_HAS_SRAM1

config SOC_SERIES
	default "ch592" if SOC_SERIES_CH592

rsource "Kconfig.soc.*"
```

## soc/wch/ch5xx/ch592/kconfig.soc.ch592
```kconfig
# Copyright (c) 2026 Mike Kasprzak (distraction.engineer)
# SPDX-License-Identifier: Apache-2.0

config SOC_CH592F
	bool
	select SOC_SERIES_CH592

config SOC
	default "ch592f" if SOC_CH592F
```

## soc/wch/ch5xx/ch59x/Kconfig.soc
```kconfig
# Copyright (c) 2026 Mike Kasprzak (distraction.engineer)
# SPDX-License-Identifier: Apache-2.0

config SOC_SERIES_CH59X
  bool
  select SOC_FAMILY_CH5XX
  select SOC_HAS_BOOTLOADER
  select SOC_HAS_SRAM1

config SOC_SERIES
  default "ch59x" if SOC_SERIES_CH59X

rsource "Kconfig.soc.*"
```

## soc/wch/ch5xx/ch59x/Kconfig.soc.ch591
```kconfig
# Copyright (c) 2026 Mike Kasprzak (distraction.engineer)
# SPDX-License-Identifier: Apache-2.0

config SOC_SERIES_CH591
	bool
	select SOC_FAMILY_CH5XX
	select SOC_HAS_BOOTLOADER
	select SOC_HAS_SRAM1

config SOC_SERIES
	default "ch591" if SOC_SERIES_CH591

config SOC_CH591F
	bool
	select SOC_SERIES_CH591

config SOC_CH591D
	bool
	select SOC_SERIES_CH591

config SOC_CH591R
	bool
	select SOC_SERIES_CH591

config SOC
	default "ch591f" if SOC_CH591F
	default "ch591d" if SOC_CH591D
	default "ch591r" if SOC_CH591R
```

## soc/wch/ch5xx/ch59x/Kconfig.soc.ch592
```kconfig
# Copyright (c) 2026 Mike Kasprzak (distraction.engineer)
# SPDX-License-Identifier: Apache-2.0

config SOC_SERIES_CH592
	bool
	select SOC_FAMILY_CH5XX
	select SOC_HAS_BOOTLOADER
	select SOC_HAS_SRAM1

config SOC_SERIES
	default "ch592" if SOC_SERIES_CH592

config SOC_CH592X
	bool
	select SOC_SERIES_CH592

config SOC_CH592F
	bool
	select SOC_SERIES_CH592

config SOC_CH592A
	bool
	select SOC_SERIES_CH592

config SOC_CH592D
	bool
	select SOC_SERIES_CH592

config SOC
	default "ch592x" if SOC_CH592X
	default "ch592f" if SOC_CH592F
	default "ch592a" if SOC_CH592A
	default "ch592d" if SOC_CH592D
```

## soc/wch/ch5xx/ch59x/kconfig.soc.ch591
```kconfig
# Copyright (c) 2026 Mike Kasprzak (distraction.engineer)
# SPDX-License-Identifier: Apache-2.0

config SOC_CH591
	bool
	select SOC_SERIES_CH59X

config SOC
	default "ch591" if SOC_CH591
```

## soc/wch/ch5xx/ch59x/kconfig.soc.ch592
```kconfig
# Copyright (c) 2026 Mike Kasprzak (distraction.engineer)
# SPDX-License-Identifier: Apache-2.0

config SOC_CH592
  bool
  select SOC_SERIES_CH59X

config SOC
  default "ch592" if SOC_CH592
```

## soc/x86/alder_lake/Kconfig.defconfig
```kconfig
# Alder Lake SoC configuration options

# Copyright (c) 2018-2023 Intel Corporation
# Copyright (c) 2014-2015 Wind River Systems, Inc.
# SPDX-License-Identifier: Apache-2.0

if SOC_ALDER_LAKE

config SOC
	default "alder_lake"

config PCIE_MMIO_CFG
	default y

config X86_DYNAMIC_IRQ_STUBS
	default 16
	depends on DYNAMIC_INTERRUPTS

endif # SOC_ALDER_LAKE
```

## soc/x86/apollo_lake/Kconfig.defconfig
```kconfig
# Apollo Lake SoC configuration options

# Copyright (c) 2018-2019 Intel Corporation
# Copyright (c) 2014-2015 Wind River Systems, Inc.
# SPDX-License-Identifier: Apache-2.0

if SOC_APOLLO_LAKE

config SOC
	default "apollo_lake"

config SYS_CLOCK_HW_CYCLES_PER_SEC
	default 19200000

config HPET_TIMER
	default y

config APIC_TIMER
	default y if !HPET_TIMER

config PCIE_MMIO_CFG
	default y

if APIC_TIMER

config APIC_TIMER_IRQ
	default 24

config APIC_TIMER_TSC
	default y

if APIC_TIMER_TSC

config APIC_TIMER_TSC_M
	default 3

config APIC_TIMER_TSC_N
	default 249

endif # APIC_TIMER_TSC

endif # APIC_TIMER

config CLFLUSH_DETECT
	default y if CACHE_FLUSHING

config X86_DYNAMIC_IRQ_STUBS
	default 16
	depends on DYNAMIC_INTERRUPTS

config I2C_DW
	default y
	depends on I2C

config GPIO_INTEL_APL
	default y
	depends on GPIO

endif # SOC_APOLLO_LAKE
```

## soc/x86/apollo_lake/Kconfig.soc
```kconfig
# Copyright (c) 2018 Intel Corporation Inc.
# SPDX-License-Identifier: Apache-2.0

config SOC_APOLLO_LAKE
	bool "Intel Apollo Lake Soc"
	select X86
	select CPU_APOLLO_LAKE
	select HAS_I2C_DW if I2C
	select PCIE
	select PCIE_MSI
	select DYNAMIC_INTERRUPTS
	select X86_MMU
```

## soc/x86/atom/Kconfig.defconfig
```kconfig
# ATOM SoC configuration options

# Copyright (c) 2014-2015 Wind River Systems, Inc.
# SPDX-License-Identifier: Apache-2.0

if SOC_ATOM

config SOC
	default "atom"

config SYS_CLOCK_HW_CYCLES_PER_SEC
	default 25000000  if HPET_TIMER

config UART_NS16550_ACCESS_IOPORT
	default y if UART_NS16550

endif
```

## soc/x86/atom/Kconfig.soc
```kconfig
# SPDX-License-Identifier: Apache-2.0

config SOC_ATOM
	bool "Intel ATOM SoC"
	select X86
	select CPU_ATOM
	select X86_MMU
	select ARCH_HAS_USERSPACE
	select ARCH_HAS_RESERVED_PAGE_FRAMES
```

## soc/x86/elkhart_lake/Kconfig.defconfig
```kconfig
# Elkhart Lake SoC configuration options

# Copyright (c) 2018-2020 Intel Corporation
# Copyright (c) 2014-2015 Wind River Systems, Inc.
# SPDX-License-Identifier: Apache-2.0

if SOC_ELKHART_LAKE

config SOC
	default "elkhart_lake"

config PCIE_MMIO_CFG
	default y

config X86_DYNAMIC_IRQ_STUBS
	default 16
	depends on DYNAMIC_INTERRUPTS

config I2C_DW
	default y
	depends on I2C

endif # SOC_ELKHART_LAKE
```

## soc/x86/elkhart_lake/Kconfig.soc
```kconfig
# Copyright (c) 2018-2020 Intel Corporation Inc.
# SPDX-License-Identifier: Apache-2.0

config SOC_ELKHART_LAKE
	bool "Intel Elkhart Lake Soc"
	select X86
	select CPU_ATOM
	select HAS_I2C_DW if I2C
	select PCIE
	select PCIE_MSI
	select DYNAMIC_INTERRUPTS
	select X86_MMU
```

## soc/x86/ia32/Kconfig.defconfig
```kconfig
# Generic PC platform configuration options

# Copyright (c) 2014-2015 Wind River Systems, Inc.
# SPDX-License-Identifier: Apache-2.0

if SOC_IA32

config SOC
	default "ia32"

config SYS_CLOCK_HW_CYCLES_PER_SEC
	default 25000000  if HPET_TIMER

config UART_NS16550_ACCESS_IOPORT
	default y if UART_NS16550

endif
```

## soc/x86/ia32/Kconfig.soc
```kconfig
# SPDX-License-Identifier: Apache-2.0

config SOC_IA32
	bool "Generic IA32 SoC"
	select X86
	select CPU_MINUTEIA
	select X86_CPU_HAS_MMX
	select X86_CPU_HAS_SSE
	select ARCH_HAS_RESERVED_PAGE_FRAMES if SRAM_BASE_ADDRESS = 0
```
