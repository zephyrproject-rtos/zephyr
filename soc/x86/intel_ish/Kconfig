## soc/x86/intel_ish/Kconfig
```kconfig
# Intel ISH family configuration options
#
# Copyright (c) 2023 Intel Corporation
#
# SPDX-License-Identifier: Apache-2.0

config SOC_FAMILY_INTEL_ISH
	bool "Intel ISH SoC family"
	select X86
	select X86_NO_SPECULATIVE_VULNERABILITIES
	select IOAPIC
	select LOAPIC
	select CPU_HAS_FPU
	select INTEL_HAL
	select HAS_PM
	select HAS_COVERAGE_SUPPORT
```

## soc/x86/intel_ish/intel_ish5/Kconfig.series
```kconfig
# Copyright (c) 2023 Intel Corporation
#
# SPDX-License-Identifier: Apache-2.0
#

config SOC_SERIES_INTEL_ISH5
	bool "Intel ISH5 SoC"
	select SOC_FAMILY_INTEL_ISH
```

## soc/x86/intel_quark/Kconfig
```kconfig
#
# Copyright (c) 2016 Intel Corporation
#
# SPDX-License-Identifier: Apache-2.0
#

config SOC_FAMILY_QUARK
	bool

if SOC_FAMILY_QUARK
config SOC_FAMILY
	string
	default "intel_quark"
endif

source "soc/x86/intel_quark/*/Kconfig.soc"

source "soc/x86/intel_quark/*/Kconfig"
```

## soc/x86/intel_quark/Kconfig.defconfig
```kconfig
# SPDX-License-Identifier: Apache-2.0

source "soc/x86/intel_quark/*/Kconfig.defconfig.series"
```

## soc/x86/intel_quark/Kconfig.soc
```kconfig
#
# Copyright (c) 2016 Intel Corporation
#
# SPDX-License-Identifier: Apache-2.0
#

source "soc/x86/intel_quark/*/Kconfig.series"
```

## soc/x86/intel_quark/quark_d2000/Kconfig.defconfig.quark_d2000
```kconfig
# Kconfig - Quark D2000 configuration options

#
# Copyright (c) 2015-2016 Intel Corporation
#
# SPDX-License-Identifier: Apache-2.0
#

if SOC_QUARK_D2000

config SOC
	default "quark_d2000"

endif # SOC_QUARK_D2000
```

## soc/x86/intel_quark/quark_d2000/Kconfig.defconfig.series
```kconfig
#
# Copyright (c) 2015-2016 Intel Corporation
#
# SPDX-License-Identifier: Apache-2.0
#

if SOC_SERIES_QUARK_D2000

config SOC_SERIES
	default "quark_d2000"

config X86_IAMCU
        default y

config SYS_CLOCK_HW_CYCLES_PER_SEC
	default 32000000

config IDT_NUM_VECTORS
	default 64

config IOAPIC_NUM_RTES
	default 32

config LOAPIC_TIMER_IRQ
	default 10

config LOAPIC_TIMER_IRQ_PRIORITY
	default 2

config QMSI
	default y

if PINMUX
config PINMUX_QMSI
	default y
endif

if UART_QMSI
config UART_QMSI_0
	default y
config UART_QMSI_0_IRQ_PRI
	int
	default 0
config UART_QMSI_1
	default y
config UART_QMSI_1_IRQ_PRI
	int
	default 0
endif # UART_QMSI

if WATCHDOG
config WDT_QMSI
	default y
endif # WATCHDOG

if COUNTER
config RTC_QMSI
	default y

config RTC_0_IRQ_PRI
	int
	default 0

endif # RTC

if GPIO

config GPIO_QMSI
	default y
config GPIO_QMSI_0
	default y
config GPIO_QMSI_0_IRQ_PRI
	int
	default 0

endif # GPIO

if PWM
config PWM_QMSI
	default y
endif

if I2C
config I2C_QMSI
	default y

if I2C_QMSI
config I2C_0
	default y

config I2C_0_IRQ_PRI
	default 0
endif # I2C_QMSI

config I2C_SDA_SETUP
	default 2

config I2C_SDA_TX_HOLD
	default 16

config I2C_SDA_RX_HOLD
	default 24

endif # I2C


if AIO_COMPARATOR
config AIO_COMPARATOR_QMSI
	default y
endif

if COUNTER
config AON_COUNTER_QMSI
	default y
config AON_TIMER_QMSI
	default y
config AON_TIMER_IRQ_PRI
	default 0
endif

if ADC
config ADC_INTEL_QUARK_D2000
	default y
config ADC_0_IRQ_PRI
	int
	default 2
endif

if DMA
config DMA_QMSI
	default y
endif

if SPI
config SPI_DW
	default y
config SPI_DW_FIFO_DEPTH
	default 7
config SPI_0
	default y
endif # SPI

if SOC_FLASH_QMSI
config SOC_FLASH_QMSI_SYS_SIZE
	default 0x8000
endif # SOC_FLASH_QMSI


source "soc/x86/intel_quark/quark_d2000/Kconfig.defconfig.quark_d2000"

endif # SOC_SERIES_QUARK_D2000
```

## soc/x86/intel_quark/quark_d2000/Kconfig.series
```kconfig
# Copyright (c) 2016 Intel Corporation Inc.
#
# SPDX-License-Identifier: Apache-2.0
#

config SOC_SERIES_QUARK_D2000
	bool "Quark D2000 Series MCU"
	select CPU_MINUTEIA
	select LOAPIC_TIMER
	select XIP
	select MVIC
	select HAS_QMSI
	select SOC_FAMILY_QUARK
	help
	 Enable support for Intel Quark D2000
```

## soc/x86/intel_quark/quark_d2000/Kconfig.soc
```kconfig
# SPDX-License-Identifier: Apache-2.0

config SOC_QUARK_D2000
	bool "Intel Quark D2000"
	depends on SOC_SERIES_QUARK_D2000
	select HAS_SPI_DW
```

## soc/x86/intel_quark/quark_se/Kconfig
```kconfig
# Kconfig - Quark SE configuration options

#
# Copyright (c) 2016 Intel Corporation
#
# SPDX-License-Identifier: Apache-2.0
#

if X86 && SOC_QUARK_SE_C1000

config EOI_FORWARDING_BUG
	bool
	default y
	help
	  Quark SE LOAPIC has issues with forwarding EOI to the IOAPIC for level
	  triggered interrupts, this is a SW workaround.

config SS_RESET_VECTOR
	hex "Sensor Subsystem Reset Vector"
	default 0x40000000
	help
	  Sensor subsystem reset vector. This value is needed to init the ARC
	  system on the SoC.

config ARC_INIT
	bool "Quark SE ARC Kickoff"
	help
	  Allows x86 processor to kickoff the ARC slave processor.

config ARC_GDB_ENABLE
	bool "Allows the usage of GDB with the ARC processor."
	depends on ARC_INIT
	help
	  This option will stop the master processor from boot-strapping
	  the ARC slave processor. This will allow GDB to halt and
	  engage the ARC processor to proceed step by step execution.

if IPM
config QUARK_SE_IPM_IRQ_PRI
	int "IPM interrupt priority"
	default 2
	help
	  Priority level for interrupts coming in from the inter-processor
	  mailboxes.

if IPM_CONSOLE_RECEIVER
config QUARK_SE_IPM_CONSOLE_RING_BUF_SIZE32
	int "IPM Console Ring Buffer Size"
	default 256
	help
	  Size of the buffer for the console receiver, for incoming
	  console messages from the ARC side. Must be a power of 2.
endif
endif

config BSP_SHARED_RESTORE_INFO_RAM_ADDR
	hex "Address of the restore information in RAM shared with the QMSI Bootloader"
	default 0xA8013FDC
	help
	  Address of the memory shared between the BSP and the Bootloader in order
	  to store restore information.

config BSP_SHARED_RESTORE_INFO_SIZE
	hex "Size of the restore information in RAM shared with the QMSI Bootloader"
	default 0x4
	help
	  Size of the memory shared between the BSP and the Bootloader in order
	  to store restore information.

config SHARED_GDT_RAM_ADDR
	hex "Address of the GDT in RAM shared with the QMSI Bootloader"
	default 0xA8013FE0
	help
	  Address of the memory shared between the BSP and the Bootloader in order
	  to store the GDT.

config SHARED_GDT_RAM_SIZE
	hex "Size of the GDT in RAM shared with the QMSI Bootloader"
	default 0x20
	help
	  Size of the memory shared between the BSP and the Bootloader in order
	  to store the GDT.

endif #SOC_QUARK_SE_C1000_X86
```

## soc/x86/intel_quark/quark_se/Kconfig.defconfig.curie
```kconfig
# Kconfig - Curie configuration options

#
# Copyright (c) 2015-2016 Intel Corporation
#
# SPDX-License-Identifier: Apache-2.0
#

if SOC_QUARK_SE_CURIE

config SOC
	default "curie"

endif
```

## soc/x86/intel_quark/quark_se/Kconfig.defconfig.series
```kconfig
#
# Copyright (c) 2016 Intel Corporation Inc.
#
# SPDX-License-Identifier: Apache-2.0
#

if SOC_SERIES_QUARK_SE

config SOC_SERIES
	default "quark_se"

config X86_IAMCU
	default y

config X86_MULTIBOOT
	default n

config X86_NO_MELTDOWN
	default y

config	SYS_CLOCK_HW_CYCLES_PER_SEC
	default 32000000

config IOAPIC_NUM_RTES
	default 64 if IOAPIC

config LOAPIC_TIMER_IRQ
	default 64 if LOAPIC_TIMER

config QMSI
	default y

if PWM
config PWM_QMSI
	default y
endif

if PINMUX
config PINMUX_QMSI
	default y
endif

if GPIO
config GPIO_QMSI
	default y

config GPIO_QMSI_0
	default y

config GPIO_QMSI_1
	default y
endif # GPIO

if I2C
config I2C_QMSI
	default y

config I2C_0
	default y

config I2C_1
	default y

config I2C_SDA_SETUP
	default 2

config I2C_SDA_TX_HOLD
	default 16

config I2C_SDA_RX_HOLD
	default 24

endif # I2C


if CLOCK_CONTROL

config CLOCK_CONTROL_QUARK_SE
	default y

if CLOCK_CONTROL_QUARK_SE

config CLOCK_CONTROL_QUARK_SE_PERIPHERAL
	default y
config CLOCK_CONTROL_QUARK_SE_PERIPHERAL_DRV_NAME
	default "clk_peripheral"

config CLOCK_CONTROL_QUARK_SE_EXTERNAL
	default y
config CLOCK_CONTROL_QUARK_SE_EXTERNAL_DRV_NAME
	default "clk_external"

config CLOCK_CONTROL_QUARK_SE_SENSOR
	default y
config CLOCK_CONTROL_QUARK_SE_SENSOR_DRV_NAME
	default "clk_sensor"

endif # CLOCK_CONTROL_QUARK_SE

endif # CLOCK_CONTROL


if COUNTER
config AON_COUNTER_QMSI
	default y
config AON_TIMER_QMSI
	default y
config AON_TIMER_IRQ_PRI
	default 2

endif


if SPI
config SPI_DW
	default y

config SPI_0
	default y

config SPI_1
	default y

config SPI_DW_FIFO_DEPTH
	default 7

if SPI_SLAVE

config SPI_2
	default y

config SPI_2_OP_MODES
	default 2

endif # SPI_SLAVE

endif # SPI


if AIO_COMPARATOR
config AIO_COMPARATOR_QMSI
	default y
endif


if WATCHDOG
config WDT_QMSI
	default y
endif # WATCHDOG

if COUNTER
config RTC_QMSI
	default y
endif # RTC

if BT_H4

config UART_QMSI_0
	default y

config UART_QMSI_0_HW_FC
	default y

endif # BT_H4

if UART_QMSI

config UART_QMSI_1
	default y

endif # UART_QMSI

if SOC_FLASH_QMSI
config SOC_FLASH_QMSI_SYS_SIZE
	default 0x60000
endif # SOC_FLASH_QMSI

if DMA
config DMA_QMSI
	default y
endif

if USB
config USB_DW
	default y
config GPIO
	default y
config USB_DW_IRQ_PRI
	default 3
endif # USB

source "soc/x86/intel_quark/quark_se/Kconfig.defconfig.quark_se*"
source "soc/x86/intel_quark/quark_se/Kconfig.defconfig.curie*"

endif # SOC_SERIES_QUARK_SE
```

## soc/x86/intel_quark/quark_se/Kconfig.series
```kconfig
# Copyright (c) 2016 Intel Corporation Inc.
#
# SPDX-License-Identifier: Apache-2.0
#

config SOC_SERIES_QUARK_SE
	bool "Quark SE Series MCU"
	select SOC_FAMILY_QUARK
	select CPU_MINUTEIA
	select IOAPIC
	select LOAPIC
	select LOAPIC_TIMER
	select XIP
	select HAS_STATE_LOW_POWER_1
	select HAS_STATE_LOW_POWER_2
	select HAS_STATE_LOW_POWER_3
	select HAS_STATE_DEEP_SLEEP_1
	select HAS_STATE_DEEP_SLEEP_2
	select BOOTLOADER_CONTEXT_RESTORE_SUPPORTED
	select HAS_QMSI
	help
	 Enable support for Quark SE
```

## soc/x86/intel_quark/quark_se/Kconfig.soc
```kconfig
# Copyright (c) 2016 Intel Corporation Inc.
#
# SPDX-License-Identifier: Apache-2.0
#
choice
	prompt "Quark SE Selection"
	depends on SOC_SERIES_QUARK_SE

config SOC_QUARK_SE_C1000
	bool "Intel Quark SE C1000"
	select HAS_SPI_DW

config SOC_QUARK_SE_CURIE
	bool "Intel Curie"
	select HAS_SPI_DW

endchoice
```

## soc/x86/intel_quark/quark_x1000/Kconfig.series
```kconfig
# SPDX-License-Identifier: Apache-2.0

config SOC_SERIES_QUARK_X1000
	bool "Intel Quark X1000 Series"
	select CPU_MINUTEIA
	select CPU_HAS_FPU
	select HPET_TIMER
	select PCI
	select PCI_ENUMERATION
	select PCIE
	select PCIE_MSI
	select SOC_FAMILY_QUARK
	select HAS_I2C_DW
	help
	  Intel Quark X1000 SoC.
```

## soc/x86/intel_quark/quark_x1000/Kconfig.soc
```kconfig
# SPDX-License-Identifier: Apache-2.0

config SOC_QUARK_X1000
	bool "Quark X1000"
	select CPU_MINUTEIA
	select CPU_HAS_FPU
	select HPET_TIMER
	select PCI
	select PCI_ENUMERATION
	select PCIE
	select PCIE_MSI
	select HAS_I2C_DW
	depends on SOC_SERIES_QUARK_X1000
	help
	  Intel Quark X1000 SoC.
```

## soc/x86/raptor_lake/Kconfig.defconfig
```kconfig
# Raptor Lake SoC configuration options

# Copyright (c) 2022 Intel Corporation
# SPDX-License-Identifier: Apache-2.0

if SOC_RAPTOR_LAKE

config SOC
	default "raptor_lake"

config PCIE_MMIO_CFG
	default y

config X86_DYNAMIC_IRQ_STUBS
	default 16
	depends on DYNAMIC_INTERRUPTS

endif # SOC_RAPTOR_LAKE
```

## soc/x86/raptor_lake/Kconfig.soc
```kconfig
# Copyright (c) 2022 Intel Corporation Inc.
# SPDX-License-Identifier: Apache-2.0

config SOC_RAPTOR_LAKE
	bool "Intel Raptor Lake Soc"
	select X86
	select CPU_ATOM
	select PCIE
	select PCIE_MSI
	select DYNAMIC_INTERRUPTS
	select X86_MMU
```

## soc/x86_64/x86_64/Kconfig.defconfig
```kconfig
# SPDX-License-Identifier: Apache-2.0

if SOC_X86_64

config SOC
	default "x86_64"

config USE_SWITCH
	default y

# Make this the default even if we have only one CPU, mostly for test
# coverage.  Uniprocessor apps for production purposes can get a
# moderate code size savings by turning it off.
config SMP
	default y

endif
```

## soc/x86_64/x86_64/Kconfig.soc
```kconfig
# SPDX-License-Identifier: Apache-2.0

config SOC_X86_64
	bool "Generic x86_64 PC"
```

## soc/xen/Kconfig.defconfig
```kconfig
# Copyright 2020 EPAM Systems
# SPDX-License-Identifier: Apache-2.0

if SOC_XENVM

config NUM_IRQS
	default 500

config SYS_CLOCK_HW_CYCLES_PER_SEC
	default 8320000

# We need at least 16M of virtual address space to map memory of Xen node
# 32M should be enough for basic use-cases
config KERNEL_VM_SIZE
	default 0x2000000

endif
```

## soc/xen/Kconfig.soc
```kconfig
# Copyright 2020 EPAM Systems
# SPDX-License-Identifier: Apache-2.0

config SOC_XENVM
	bool

config SOC
	default "xenvm" if SOC_XENVM
```

## soc/xhsc/hc32/Kconfig
```kconfig
# Copyright (c) 2026 Liu Changjie <liucj1228@outlook.com>
# SPDX-License-Identifier: Apache-2.0

config SOC_FAMILY_XHSC_HC32
	select BUILD_OUTPUT_HEX
	select HAS_HC32_DDL

if SOC_FAMILY_XHSC_HC32

rsource "*/Kconfig"

endif # SOC_FAMILY_XHSC_HC32
```

## soc/xhsc/hc32/Kconfig.defconfig
```kconfig
# Copyright (c) 2026 Liu Changjie <liucj1228@outlook.com>
# SPDX-License-Identifier: Apache-2.0

if SOC_FAMILY_XHSC_HC32

rsource "*/Kconfig.defconfig"

endif # SOC_FAMILY_XHSC_HC32
```

## soc/xhsc/hc32/Kconfig.soc
```kconfig
# Copyright (c) 2026 Liu Changjie <liucj1228@outlook.com>
# SPDX-License-Identifier: Apache-2.0

config SOC_FAMILY_XHSC_HC32
	bool

config SOC_FAMILY
	default "xhsc_hc32" if SOC_FAMILY_XHSC_HC32

rsource "*/Kconfig.soc"
```
