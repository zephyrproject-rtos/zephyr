## soc/realtek/ameba/Kconfig.defconfig
```kconfig
# Copyright (c) 2024 Realtek Semiconductor Corp.
# SPDX-License-Identifier: Apache-2.0

if SOC_FAMILY_REALTEK_AMEBA

rsource "*/Kconfig.defconfig"

endif # SOC_FAMILY_REALTEK_AMEBA
```

## soc/realtek/ameba/Kconfig.soc
```kconfig
# Copyright (c) 2024 Realtek Semiconductor Corp.
# SPDX-License-Identifier: Apache-2.0

config SOC_FAMILY_REALTEK_AMEBA
	bool

config SOC_FAMILY
	default "realtek_ameba" if SOC_FAMILY_REALTEK_AMEBA

rsource "*/Kconfig.soc"
```

## soc/realtek/ameba/amebad/Kconfig
```kconfig
# Copyright (c) 2024 Realtek Semiconductor Corp.
# SPDX-License-Identifier: Apache-2.0

config SOC_SERIES_AMEBAD
	select ARM
	select CPU_CORTEX_M33
	select CPU_HAS_DCACHE
	select CPU_HAS_ICACHE
	select CPU_HAS_ARM_SAU
	select CPU_HAS_FPU
	select CPU_HAS_VFP
	select ARMV8_M_DSP
	select CPU_HAS_ARM_MPU
	select ARM_MPU
	select ARM_TRUSTZONE_M
	select ARM_ON_EXIT_CPU_IDLE
```

## soc/realtek/ameba/amebad/Kconfig.defconfig
```kconfig
# Copyright (c) 2024 Realtek Semiconductor Corp.
# SPDX-License-Identifier: Apache-2.0

if SOC_SERIES_AMEBAD

config NUM_IRQS
	default 64

config SYS_CLOCK_HW_CYCLES_PER_SEC
	default $(dt_node_int_prop_int,/clocks/clk_sys,clock-frequency)

config CACHE_MANAGEMENT
	default y

endif #SOC_SERIES_AMEBAD
```

## soc/realtek/ameba/amebad/Kconfig.soc
```kconfig
# Copyright (c) 2024 Realtek Semiconductor Corp.
# SPDX-License-Identifier: Apache-2.0

config SOC_SERIES_AMEBAD
	bool
	select SOC_FAMILY_REALTEK_AMEBA

config SOC_SERIES
	default "amebad" if SOC_SERIES_AMEBAD

config SOC_RTL872XD
	bool
	select SOC_SERIES_AMEBAD

config SOC
	default "rtl872xd" if SOC_RTL872XD
```

## soc/realtek/ameba/amebadplus/Kconfig
```kconfig
# Copyright (c) 2024 Realtek Semiconductor Corp.
# SPDX-License-Identifier: Apache-2.0

config SOC_AMEBADPLUS
	select ARM
	select CPU_CORTEX_M55
	select CPU_HAS_DCACHE
	select CPU_HAS_ICACHE
	select CPU_HAS_ARM_SAU
	select CPU_HAS_FPU
	select CPU_HAS_VFP
	select ARMV8_M_DSP
	select CPU_HAS_ARM_MPU
	select ARM_TRUSTZONE_M
```

## soc/realtek/ameba/amebadplus/Kconfig.defconfig
```kconfig
# Copyright (c) 2024 Realtek Semiconductor Corp.
# SPDX-License-Identifier: Apache-2.0

if SOC_AMEBADPLUS

config NUM_IRQS
	default 96

config SYS_CLOCK_HW_CYCLES_PER_SEC
	default $(dt_node_int_prop_int,/clocks/clk_sys,clock-frequency)

config CACHE_MANAGEMENT
	default y

endif #SOC_AMEBADPLUS
```

## soc/realtek/ameba/amebadplus/Kconfig.soc
```kconfig
# Copyright (c) 2024 Realtek Semiconductor Corp.
# SPDX-License-Identifier: Apache-2.0

config SOC_SERIES_AMEBADPLUS
	bool
	select SOC_FAMILY_REALTEK_AMEBA

config SOC_SERIES
	default "amebadplus" if SOC_SERIES_AMEBADPLUS

config SOC_RTL8721DX
	bool
	select SOC_SERIES_AMEBADPLUS

config SOC
	default "rtl8721dx" if SOC_RTL8721DX
```

## soc/realtek/ameba/amebag2/Kconfig
```kconfig
# Copyright (c) 2024 Realtek Semiconductor Corp.
# SPDX-License-Identifier: Apache-2.0

config SOC_SERIES_AMEBAG2
	select ARM
	select CPU_CORTEX_M55
	select CPU_HAS_DCACHE
	select CPU_HAS_ICACHE
	select CPU_HAS_ARM_SAU
	select CPU_HAS_ARM_MPU
	select ARM_MPU
	select ARM_TRUSTZONE_M
```
