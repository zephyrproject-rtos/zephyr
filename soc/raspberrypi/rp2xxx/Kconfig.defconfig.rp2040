## soc/raspberrypi/rp2xxx/Kconfig.defconfig.rp2040
```kconfig
# # Raspberry Pi RP2040 MCU

# Copyright (c) 2021 Nordic Semiconductor ASA
# SPDX-License-Identifier: Apache-2.0

config BUILD_OUTPUT_UF2_USE_FLASH_BASE
	default y if RP2_REQUIRES_SECOND_STAGE_BOOT || BOOTLOADER_MCUBOOT

config BUILD_OUTPUT_UF2_USE_FLASH_OFFSET
	default y if !RP2_REQUIRES_SECOND_STAGE_BOOT
```

## soc/raspberrypi/rp2xxx/Kconfig.soc
```kconfig
# Raspberry Pi RP2XXX MCU line

# Copyright (c) 2021 Nordic Semiconductor ASA
# Copyright (c) 2021 Yonatan Schachter
# SPDX-License-Identifier: Apache-2.0

config SOC_RP2040
	bool
	select SOC_SERIES_RP2XXX

config SOC_SERIES_RP2XXX
	bool
	select SOC_FAMILY_RPI_PICO

config SOC_SERIES
	default "rp2xxx" if SOC_SERIES_RP2XXX

config SOC
	default "rp2040" if SOC_RP2040
```

## soc/raspberrypi/rpi_pico/Kconfig
```kconfig
# Raspberry Pi (RP) MCU line

# Copyright (c) 2021 Nordic Semiconductor ASA
# Copyright (c) 2021 Yonatan Schachter
# SPDX-License-Identifier: Apache-2.0

if SOC_FAMILY_RPI_PICO

rsource "*/Kconfig"

config RPI_PICO_ROM_BOOTLOADER
	bool
	default y
	depends on RETENTION_BOOT_MODE

config RPI_PICO_USE_ROMFUNC
	bool
	default y
	depends on !NULL_POINTER_EXCEPTION_DETECTION_MPU
	help
	  Enable the use of ROM functions and add corresponding MPU entry if needed.

endif # SOC_FAMILY_RPI_PICO
```

## soc/raspberrypi/rpi_pico/Kconfig.defconfig
```kconfig
# Raspberry Pi (RP) MCU line

# Copyright (c) 2021 Nordic Semiconductor ASA
# SPDX-License-Identifier: Apache-2.0

if SOC_FAMILY_RPI_PICO

rsource "*/Kconfig.defconfig"

endif # SOC_FAMILY_RPI_PICO
```

## soc/raspberrypi/rpi_pico/Kconfig.soc
```kconfig
# Raspberry Pi (RP) MCU line

# Copyright (c) 2021 Nordic Semiconductor ASA
# Copyright (c) 2024 Andrew Featherstone
# SPDX-License-Identifier: Apache-2.0

config SOC_FAMILY_RPI_PICO
	bool

config SOC_FAMILY
	default "rpi_pico" if SOC_FAMILY_RPI_PICO

config SOC_SERIES
	default "rp2040" if SOC_SERIES_RP2040
	default "rp2350" if SOC_SERIES_RP2350

config SOC_SERIES_RP2040
	bool
	select SOC_FAMILY_RPI_PICO

config SOC_SERIES_RP2350
	bool
	select SOC_FAMILY_RPI_PICO

rsource "*/Kconfig.soc"
```

## soc/raspberrypi/rpi_pico/common/Kconfig
```kconfig
# Copyright (c) 2025 TOKITA Hiroshi
# SPDX-License-Identifier: Apache-2.0

source "soc/raspberrypi/rpi_pico/common/Kconfig.*"
```

## soc/raspberrypi/rpi_pico/common/Kconfig.binary_info
```kconfig
# Copyright (c) 2024 TOKITA Hiroshi
# SPDX-License-Identifier: Apache-2.0

config RPI_PICO_BINARY_INFO
	bool "Generate Raspberry Pi Pico binary info"
	help
	  Binary info is able to embed machine readable information with the binary in flash.
	  It can be read with picotool (https://github.com/raspberrypi/picotool).
	  Binary info is generated automatically when this option is enabled,

	  When this feature is enabled, pinctrl groups are restricted to consisting
	  of pins with a single rpi_pico function.
	  In other words, SPI's MISO and MOSI can be in the same group, but I2C's
	  SDA cannot be included in this group. This is rarely an issue in normal use,
	  and can be resolved by dividing them into separate groups.

if RPI_PICO_BINARY_INFO

config RPI_PICO_BINARY_INFO_PROGRAM_NAME
	bool "Generate program_name in binary info"
	default y

if RPI_PICO_BINARY_INFO_PROGRAM_NAME

config RPI_PICO_BINARY_INFO_OVERRIDE_PROGRAM_NAME
	string "Override program_name in binary info"
	depends on RPI_PICO_BINARY_INFO_PROGRAM_NAME

config RPI_PICO_BINARY_INFO_PROGRAM_NAME_OVERRIDDEN
	bool
	default RPI_PICO_BINARY_INFO_OVERRIDE_PROGRAM_NAME != ""
	depends on RPI_PICO_BINARY_INFO_PROGRAM_NAME

endif

config RPI_PICO_BINARY_INFO_PROGRAM_URL
	bool "Generate program_url in binary info"
	default y

if RPI_PICO_BINARY_INFO_PROGRAM_URL

config RPI_PICO_BINARY_INFO_OVERRIDE_PROGRAM_URL
	string "Override program_url in binary info"
	depends on RPI_PICO_BINARY_INFO_PROGRAM_URL

config RPI_PICO_BINARY_INFO_PROGRAM_URL_OVERRIDDEN
	bool
	default RPI_PICO_BINARY_INFO_OVERRIDE_PROGRAM_URL != ""
	depends on RPI_PICO_BINARY_INFO_PROGRAM_URL

endif

config RPI_PICO_BINARY_INFO_PROGRAM_DESCRIPTION
	bool "Generate program_description in binary info"
	default y

if RPI_PICO_BINARY_INFO_PROGRAM_DESCRIPTION

config RPI_PICO_BINARY_INFO_OVERRIDE_PROGRAM_DESCRIPTION
	string "Override program_description in binary info"
	depends on RPI_PICO_BINARY_INFO_PROGRAM_DESCRIPTION

config RPI_PICO_BINARY_INFO_PROGRAM_DESCRIPTION_OVERRIDDEN
	bool
	default RPI_PICO_BINARY_INFO_OVERRIDE_PROGRAM_DESCRIPTION != ""
	depends on RPI_PICO_BINARY_INFO_PROGRAM_DESCRIPTION

endif

config RPI_PICO_BINARY_INFO_PROGRAM_BUILD_DATE
	bool "Generate program_build_date in binary info"
	default y

if RPI_PICO_BINARY_INFO_PROGRAM_BUILD_DATE

config RPI_PICO_BINARY_INFO_OVERRIDE_PROGRAM_BUILD_DATE
	string "Override program_build_date in binary info"
	depends on RPI_PICO_BINARY_INFO_PROGRAM_BUILD_DATE

config RPI_PICO_BINARY_INFO_PROGRAM_BUILD_DATE_OVERRIDDEN
	bool
	default RPI_PICO_BINARY_INFO_OVERRIDE_PROGRAM_BUILD_DATE != ""
	depends on RPI_PICO_BINARY_INFO_PROGRAM_BUILD_DATE

endif

config RPI_PICO_BINARY_INFO_PROGRAM_VERSION_STRING
	bool "Generate program_version_string in binary info"
	default y

if RPI_PICO_BINARY_INFO_PROGRAM_VERSION_STRING

config RPI_PICO_BINARY_INFO_OVERRIDE_PROGRAM_VERSION_STRING
	string "Override program_version_string in binary info"
	depends on RPI_PICO_BINARY_INFO_PROGRAM_VERSION_STRING

config RPI_PICO_BINARY_INFO_PROGRAM_VERSION_STRING_OVERRIDDEN
	bool
	default RPI_PICO_BINARY_INFO_OVERRIDE_PROGRAM_VERSION_STRING != ""
	depends on RPI_PICO_BINARY_INFO_PROGRAM_VERSION_STRING

endif

config RPI_PICO_BINARY_INFO_SDK_VERSION_STRING
	bool "Generate sdk_version_string in binary info"
	default y

if RPI_PICO_BINARY_INFO_SDK_VERSION_STRING

config RPI_PICO_BINARY_INFO_OVERRIDE_SDK_VERSION_STRING
	string "Override sdk_version_string in binary info"
	depends on RPI_PICO_BINARY_INFO_SDK_VERSION_STRING

config RPI_PICO_BINARY_INFO_SDK_VERSION_STRING_OVERRIDDEN
	bool
	default RPI_PICO_BINARY_INFO_OVERRIDE_SDK_VERSION_STRING != ""
	depends on RPI_PICO_BINARY_INFO_SDK_VERSION_STRING

endif

config RPI_PICO_BINARY_INFO_PICO_BOARD
	bool "Generate pico_board in binary info"
	default y

if RPI_PICO_BINARY_INFO_PICO_BOARD

config RPI_PICO_BINARY_INFO_OVERRIDE_PICO_BOARD
	string "Override pico_board in binary info"
	depends on RPI_PICO_BINARY_INFO_PICO_BOARD

config RPI_PICO_BINARY_INFO_PICO_BOARD_OVERRIDDEN
	bool
	default RPI_PICO_BINARY_INFO_OVERRIDE_PICO_BOARD != ""
	depends on RPI_PICO_BINARY_INFO_PICO_BOARD

endif

config RPI_PICO_BINARY_INFO_ATTRIBUTE_BUILD_TYPE
	bool "Generate attribute_build_type in binary info"
	default y

if RPI_PICO_BINARY_INFO_ATTRIBUTE_BUILD_TYPE

config RPI_PICO_BINARY_INFO_OVERRIDE_ATTRIBUTE_BUILD_TYPE
	string "Override attribute_build_type in binary info"
	depends on RPI_PICO_BINARY_INFO_ATTRIBUTE_BUILD_TYPE

config RPI_PICO_BINARY_INFO_ATTRIBUTE_BUILD_TYPE_OVERRIDDEN
	bool
	default RPI_PICO_BINARY_INFO_OVERRIDE_ATTRIBUTE_BUILD_TYPE != ""
	depends on RPI_PICO_BINARY_INFO_ATTRIBUTE_BUILD_TYPE

endif

config RPI_PICO_BINARY_INFO_BOOT_STAGE2_NAME
	bool "Generate boot_stage2_name in binary info"
	default y

if RPI_PICO_BINARY_INFO_BOOT_STAGE2_NAME

config RPI_PICO_BINARY_INFO_OVERRIDE_BOOT_STAGE2_NAME
	string "Override boot_stage2_name in binary info"
	depends on RPI_PICO_BINARY_INFO_BOOT_STAGE2_NAME

config RPI_PICO_BINARY_INFO_BOOT_STAGE2_NAME_OVERRIDDEN
	bool
	default RPI_PICO_BINARY_INFO_OVERRIDE_BOOT_STAGE2_NAME != ""
	depends on RPI_PICO_BINARY_INFO_BOOT_STAGE2_NAME

endif

config RPI_PICO_BINARY_INFO_PIN_CONFIGURATIONS
	bool "Generate pin configuration info in binary info"
	default y

endif
```

## soc/raspberrypi/rpi_pico/common/Kconfig.defconfig
```kconfig
# Copyright (c) Qualcomm Technologies, Inc. and/or its subsidiaries.
# SPDX-License-Identifier: Apache-2.0

if SOC_FAMILY_RPI_PICO_CPU1

# Running CPU1 from flash is not recommended due to XIP cache contention with
# CPU0. If !XIP, we move the code partition from flash into SRAM at CPU0 init
# and run CPU1 from SRAM. !XIP is the default.
DT_CHOSEN_CODE_PARTITION = zephyr,code-partition
DT_CHOSEN_SRAM = zephyr,sram

config BUILD_OUTPUT_ADJUST_LMA
	default "$(dt_chosen_partition_addr_hex,$(DT_CHOSEN_CODE_PARTITION)) - \
	$(dt_chosen_reg_addr_hex,$(DT_CHOSEN_SRAM))" if !XIP && \
	$(dt_chosen_enabled,$(DT_CHOSEN_CODE_PARTITION)) && \
	$(dt_chosen_enabled,$(DT_CHOSEN_SRAM))

endif # SOC_FAMILY_RPI_PICO_CPU1
```

## soc/raspberrypi/rpi_pico/rp2040/Kconfig.defconfig
```kconfig
# Raspberry Pi RP2040 MCU line

# Copyright (c) 2021 Nordic Semiconductor ASA
# Copyright (c) 2021 Yonatan Schachter
# SPDX-License-Identifier: Apache-2.0

if SOC_SERIES_RP2040

rsource "Kconfig.defconfig.rp2*"

config NUM_IRQS
	default 26

endif # SOC_SERIES_RP2040
```

## soc/raspberrypi/rpi_pico/rp2040/Kconfig.soc
```kconfig
# Raspberry Pi RP2040 MCU line

# Copyright (c) 2021 Nordic Semiconductor ASA
# Copyright (c) 2021 Yonatan Schachter
# SPDX-License-Identifier: Apache-2.0

config SOC_SERIES
	default "rp2040" if SOC_SERIES_RP2040

config SOC_SERIES_RP2040
	bool
	select SOC_FAMILY_RPI_PICO

config SOC_RP2040
	bool
	select SOC_SERIES_RP2040

config SOC
	default "rp2040" if SOC_RP2040
```

## soc/raspberrypi/rpi_pico/rp2350/Kconfig
```kconfig
# Raspberry Pi RP235XX MCU line

# Copyright (c) 2024 Andrew Featherstone
# SPDX-License-Identifier: Apache-2.0

config SOC_SERIES_RP2350
	select HAS_RPI_PICO
	select HAS_SEGGER_RTT if ZEPHYR_SEGGER_MODULE
	select SOC_RESET_HOOK
	imply XIP

config SOC_RP2350A_HAZARD3
	select ARCH_HAS_RAMFUNC_SUPPORT if XIP
	select HAS_FLASH_LOAD_OFFSET
	select INCLUDE_RESET_VECTOR
	select RISCV

config SOC_RP2350A_M33
	select ARM
	select ARM_TRUSTZONE_M
	select CPU_CORTEX_M_HAS_SYSTICK
	select CPU_CORTEX_M_HAS_VTOR
	select CPU_CORTEX_M33
	select CPU_HAS_ARM_MPU
	select CPU_HAS_ARM_SAU
	select CPU_HAS_FPU
	select ARMV8_M_DSP

config SOC_RP2350B_HAZARD3
	select ARCH_HAS_RAMFUNC_SUPPORT if XIP
	select HAS_FLASH_LOAD_OFFSET
	select INCLUDE_RESET_VECTOR
	select RISCV

config SOC_RP2350A_M33_CPU0
	select ARM
	select ARM_TRUSTZONE_M
	select CPU_CORTEX_M_HAS_SYSTICK
	select CPU_CORTEX_M_HAS_VTOR
	select CPU_CORTEX_M33
	select CPU_HAS_ARM_MPU
	select CPU_HAS_ARM_SAU
	select CPU_HAS_FPU
	select ARMV8_M_DSP

config SOC_RP2350A_M33_CPU1
	select ARM
	select ARM_TRUSTZONE_M
	select CPU_CORTEX_M_HAS_SYSTICK
	select CPU_CORTEX_M_HAS_VTOR
	select CPU_CORTEX_M33
	select CPU_HAS_ARM_MPU
	select CPU_HAS_ARM_SAU
	select CPU_HAS_FPU
	select ARMV8_M_DSP

config SOC_RP2350B_M33
	select ARM
	select ARM_TRUSTZONE_M
	select CPU_CORTEX_M_HAS_SYSTICK
	select CPU_CORTEX_M_HAS_VTOR
	select CPU_CORTEX_M33
	select CPU_HAS_ARM_MPU
	select CPU_HAS_ARM_SAU
	select CPU_HAS_FPU
	select ARMV8_M_DSP

if SOC_SERIES_RP2350

config RP2_REQUIRES_IMAGE_DEFINITION_BLOCK
	bool
	# IMAGE_DEF should be used to define the image for booting CPU0
	default y if !SOC_RP2350A_M33_CPU1
	depends on SOC_SERIES_RP2350
	help
	  Include an Image Definition Block (IMAGE_DEF) to enable the bootroom in
	  RP23XX devices to consider this a valid image in flash.

endif # SOC_SERIES_RP2350

config SOC_RP2350_CPU1_ENABLE
	bool "Boot the RP2350 CPU1"
	default y if IPM || MBOX
	depends on SOC_RP2350A_M33_CPU0
	depends on $(dt_nodelabel_enabled,sram0_cpu1)
	select SOC_LATE_INIT_HOOK
	help
	  If enabled, the second CPU will be powered up and pointed to its application
	  entrypoint during SoC late init hook.

config SOC_RP2350_CPU1_ENABLE_CHECK_VTOR
	bool "Check VTOR before booting the second core"
	default y
	depends on SOC_RP2350_CPU1_ENABLE
	help
	  Verify that VTOR pointers are valid before booting the second CPU.
```

## soc/raspberrypi/rpi_pico/rp2350/Kconfig.defconfig
```kconfig
# Raspberry Pi RP2350 MCU line

# Copyright (c) 2024 Andrew Featherstone
# SPDX-License-Identifier: Apache-2.0

if SOC_SERIES_RP2350

config BUILD_OUTPUT_UF2_USE_FLASH_BASE
	default y if RP2_REQUIRES_IMAGE_DEFINITION_BLOCK

config BUILD_OUTPUT_UF2_USE_FLASH_OFFSET
	default y if !RP2_REQUIRES_IMAGE_DEFINITION_BLOCK

config NUM_IRQS
	default 52

DT_CLK_SYS_PATH := $(dt_nodelabel_path,clk_sys)

config SYS_CLOCK_HW_CYCLES_PER_SEC
	default $(dt_node_int_prop_int,$(DT_CLK_SYS_PATH),clock-frequency)

if SOC_RP2350A_M33_CPU1

# If a code partition is defined for the CPU1 core,
# make sure we relocate the code to be stored in that partition
# Use cpu1_slot0_partition alias to make init code copy this to the RAM
# Running CPU1 from flash is not recommended due to
# access conflicts with CPU0 writes
DT_CHOSEN_CODE_PARTITION = zephyr,code-partition
DT_CHOSEN_SRAM = zephyr,sram

config BUILD_OUTPUT_ADJUST_LMA
	default "$(dt_chosen_partition_addr_hex,$(DT_CHOSEN_CODE_PARTITION)) - \
		 $(dt_chosen_reg_addr_hex,$(DT_CHOSEN_SRAM))" if SOC_RP2350A_M33_CPU1 && \
			$(dt_chosen_enabled,$(DT_CHOSEN_CODE_PARTITION)) && \
			$(dt_chosen_enabled,$(DT_CHOSEN_SRAM))

endif # SOC_RP2350A_M33_CPU1

endif # SOC_SERIES_RP2350
```

## soc/raspberrypi/rpi_pico/rp2350/Kconfig.defconfig_rp2350a_cm33_cpu0
```kconfig
# Raspberry Pi RP2350 MCU line
# ARM Cortex M33, CPU0

# Copyright (c) 2025 Dan Collins
# SPDX-License-Identifier: Apache-2.0

if SOC_RP2350A_M33_CPU0

# For CPU0, we need to use the base address of the flash rather than the
# code address - because the image definition block needs to be at the
# start of flash for the boot ROM to find it. If we don't have the image
# definition block, then we should just use the offset.

config BUILD_OUTPUT_UF2_USE_FLASH_BASE
	default y if RP2_REQUIRES_IMAGE_DEFINITION_BLOCK

config BUILD_OUTPUT_UF2_USE_FLASH_OFFSET
	default y if !RP2_REQUIRES_IMAGE_DEFINITION_BLOCK

endif # SOC_RP2350A_M33_CPU0
```

## soc/raspberrypi/rpi_pico/rp2350/Kconfig.defconfig_rp2350a_cm33_cpu1
```kconfig
# Raspberry Pi RP2350 MCU line
# ARM Cortex M33, CPU1

# Copyright (c) 2025 Dan Collins
# SPDX-License-Identifier: Apache-2.0

if SOC_RP2350A_M33_CPU1

# For CPU1, we need to use both the base address of flash as well as the
# offset - as our partition table puts the code section well above the
# base address of the flash.

config BUILD_OUTPUT_UF2_USE_FLASH_BASE
	default y

config BUILD_OUTPUT_UF2_USE_FLASH_OFFSET
	default y

# Don't initialise the clock controller on CPU1 as this is handled by CPU0!
config RPI_PICO_SKIP_CLOCK_INIT
	default y if SOC_RP2350A_M33_CPU1

endif # SOC_RP2350A_M33_CPU1
```

## soc/raspberrypi/rpi_pico/rp2350/Kconfig.soc
```kconfig
# Raspberry Pi RP2350 MCU line

# Copyright (c) 2024 Andrew Featherstone
# SPDX-License-Identifier: Apache-2.0

config SOC_SERIES_RP2350
	bool
	select SOC_FAMILY_RPI_PICO

config SOC_SERIES
	default "rp2350" if SOC_SERIES_RP2350

config SOC_RP2350A
	bool
	select SOC_SERIES_RP2350

config SOC_RP2350A_M33
	bool
	select SOC_RP2350A
	help
	  Use the RP2350A with a Cortex-M33 core in both 'sockets'.

config SOC_RP2350B
	bool
	select SOC_SERIES_RP2350

config SOC_RP2350B_M33
	bool
	select SOC_RP2350B
	help
	  Use the RP2350B with a Cortex-M33 core in both 'sockets'.

config SOC
	default "rp2350a" if SOC_RP2350A
	default "rp2350b" if SOC_RP2350B
```

## soc/realtek/ameba/Kconfig
```kconfig
# Copyright (c) 2024 Realtek Semiconductor Corp.
# SPDX-License-Identifier: Apache-2.0

config SOC_FAMILY_REALTEK_AMEBA
	select BUILD_OUTPUT_HEX
	select SOC_EARLY_INIT_HOOK

if SOC_FAMILY_REALTEK_AMEBA

rsource "*/Kconfig"

choice SOC_AMEBA_NP_CORE
	prompt "Ameba NP prebuilt images"
	default SOC_AMEBA_NP_DISABLED
	help
	  Choose the prebuilt image to be executed on the NP core of the Ameba multi-core MCU.
	  The image is responsible for booting the NP on the device.

config SOC_AMEBA_NP_DISABLED
	bool "None"
	help
	  Do not include any prebuilt image for the NP core.

config SOC_AMEBA_NP_IMAGE
	bool "DeepSleep"
	help
	  DeepSleep prebuilt image is executed on the NP core of the Ameba multi-core MCU.

endchoice

endif # SOC_FAMILY_REALTEK_AMEBA
```
