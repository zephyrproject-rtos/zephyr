## soc/atmel/sam0/same51/Kconfig.defconfig
```kconfig
# Atmel SAME51 MCU series configuration options

# Copyright (c) 2019 ML!PA Consulting GmbH
# Copyright (c) 2024 Gerson Fernando Budke <nandojve@gmail.com>
# SPDX-License-Identifier: Apache-2.0

if SOC_SERIES_SAME51

config NUM_IRQS
	default 137

config ROM_START_OFFSET
	default 0x400 if BOOTLOADER_MCUBOOT

endif # SOC_SERIES_SAME51
```

## soc/atmel/sam0/same51/Kconfig.soc
```kconfig
# Atmel SAME51 MCU series

# Copyright (c) 2019 ML!PA Consulting GmbH
# Copyright (c) 2024 Gerson Fernando Budke <nandojve@gmail.com>
# SPDX-License-Identifier: Apache-2.0

config SOC_SERIES_SAME51
	bool
	select SOC_FAMILY_ATMEL_SAM0
	help
	  Enable support for Atmel SAME51 Cortex-M4F microcontrollers.

config SOC_SERIES
	default "same51" if SOC_SERIES_SAME51

config SOC_SAME51J18A
	bool
	select SOC_SERIES_SAME51

config SOC_SAME51J19A
	bool
	select SOC_SERIES_SAME51

config SOC_SAME51J20A
	bool
	select SOC_SERIES_SAME51

config SOC_SAME51N19A
	bool
	select SOC_SERIES_SAME51

config SOC_SAME51N20A
	bool
	select SOC_SERIES_SAME51

config SOC
	default "same51j18a" if SOC_SAME51J18A
	default "same51j19a" if SOC_SAME51J19A
	default "same51j20a" if SOC_SAME51J20A
	default "same51n19a" if SOC_SAME51N19A
	default "same51n20a" if SOC_SAME51N20A
```

## soc/atmel/sam0/same53/Kconfig
```kconfig
# Atmel SAME53 MCU series

# Copyright (c) 2019 ML!PA Consulting GmbH
# Copyright (c) 2023-2024 Gerson Fernando Budke <nandojve@gmail.com>
# SPDX-License-Identifier: Apache-2.0

config SOC_SERIES_SAME53
	select ARM
	select CPU_CORTEX_M4
	select CPU_CORTEX_M_HAS_DWT
	select CPU_HAS_ARM_MPU
	select CPU_HAS_FPU
	select SOC_RESET_HOOK
```

## soc/atmel/sam0/same53/Kconfig.soc
```kconfig
# Atmel SAME53 MCU series

# Copyright (c) 2019 ML!PA Consulting GmbH
# Copyright (c) 2024 Gerson Fernando Budke <nandojve@gmail.com>
# SPDX-License-Identifier: Apache-2.0

config SOC_SERIES_SAME53
	bool
	select SOC_FAMILY_ATMEL_SAM0
	help
	  Enable support for Atmel SAME53 Cortex-M4F microcontrollers.

config SOC_SERIES
	default "same53" if SOC_SERIES_SAME53

config SOC_SAME53J18A
	bool
	select SOC_SERIES_SAME53

config SOC_SAME53J19A
	bool
	select SOC_SERIES_SAME53

config SOC_SAME53J20A
	bool
	select SOC_SERIES_SAME53

config SOC_SAME53N19A
	bool
	select SOC_SERIES_SAME53

config SOC_SAME53N20A
	bool
	select SOC_SERIES_SAME53

config SOC
	default "same53j18a" if SOC_SAME53J18A
	default "same53j19a" if SOC_SAME53J19A
	default "same53j20a" if SOC_SAME53J20A
	default "same53n19a" if SOC_SAME53N19A
	default "same53n20a" if SOC_SAME53N20A
```

## soc/atmel/sam0/same54/Kconfig.soc
```kconfig
# Atmel SAME54 MCU series

# Copyright (c) 2019 ML!PA Consulting GmbH
# Copyright (c) 2024 Gerson Fernando Budke <nandojve@gmail.com>
# SPDX-License-Identifier: Apache-2.0

config SOC_SERIES_SAME54
	bool
	select SOC_FAMILY_ATMEL_SAM0
	help
	  Enable support for Atmel SAME54 Cortex-M4F microcontrollers.

config SOC_SERIES
	default "same54" if SOC_SERIES_SAME54

config SOC_SAME54N19A
	bool
	select SOC_SERIES_SAME54

config SOC_SAME54N20A
	bool
	select SOC_SERIES_SAME54

config SOC_SAME54P19A
	bool
	select SOC_SERIES_SAME54

config SOC_SAME54P20A
	bool
	select SOC_SERIES_SAME54

config SOC
	default "same54n19a" if SOC_SAME54N19A
	default "same54n20a" if SOC_SAME54N20A
	default "same54p19a" if SOC_SAME54P19A
	default "same54p20a" if SOC_SAME54P20A
```

## soc/atmel/sam0/saml21/Kconfig
```kconfig
# Atmel SAML21 MCU series

# Copyright (c) 2021 Argentum Systems Ltd.
# Copyright (c) 2024 Gerson Fernando Budke <nandojve@gmail.com>
# SPDX-License-Identifier: Apache-2.0

config SOC_SERIES_SAML21
	select ARM
	select CPU_CORTEX_M0PLUS
	select CPU_CORTEX_M_HAS_SYSTICK
	select CPU_CORTEX_M_HAS_VTOR
	select PLATFORM_SPECIFIC_INIT
```

## soc/atmel/sam0/saml21/Kconfig.defconfig
```kconfig
# Atmel SAML21 MCU series configuration options

# Copyright (c) 2021 Argentum Systems Ltd.
# Copyright (c) 2024 Gerson Fernando Budke <nandojve@gmail.com>
# SPDX-License-Identifier: Apache-2.0

if SOC_SERIES_SAML21

config NUM_IRQS
	default 29

endif # SOC_SERIES_SAML21
```

## soc/atmel/sam0/saml21/Kconfig.soc
```kconfig
# Atmel SAML21 MCU series

# Copyright (c) 2021 Argentum Systems Ltd.
# Copyright (c) 2024 Gerson Fernando Budke <nandojve@gmail.com>
# SPDX-License-Identifier: Apache-2.0

config SOC_SERIES_SAML21
	bool
	select SOC_FAMILY_ATMEL_SAM0
	help
	  Enable support for Atmel SAML21 Cortex-M0+ microcontrollers.

config SOC_SERIES
	default "saml21" if SOC_SERIES_SAML21

config SOC_SAML21E15B
	bool
	select SOC_SERIES_SAML21

config SOC_SAML21E16B
	bool
	select SOC_SERIES_SAML21

config SOC_SAML21E17B
	bool
	select SOC_SERIES_SAML21

config SOC_SAML21E18B
	bool
	select SOC_SERIES_SAML21

config SOC_SAML21G16B
	bool
	select SOC_SERIES_SAML21

config SOC_SAML21G17B
	bool
	select SOC_SERIES_SAML21

config SOC_SAML21G18B
	bool
	select SOC_SERIES_SAML21

config SOC_SAML21J16B
	bool
	select SOC_SERIES_SAML21

config SOC_SAML21J17B
	bool
	select SOC_SERIES_SAML21

config SOC_SAML21J18B
	bool
	select SOC_SERIES_SAML21

config SOC_SAML21J17BU
	bool
	select SOC_SERIES_SAML21

config SOC_SAML21J18BU
	bool
	select SOC_SERIES_SAML21

config SOC
	default "saml21e15b" if SOC_SAML21E15B
	default "saml21e16b" if SOC_SAML21E16B
	default "saml21e17b" if SOC_SAML21E17B
	default "saml21e18b" if SOC_SAML21E18B
	default "saml21g16b" if SOC_SAML21G16B
	default "saml21g17b" if SOC_SAML21G17B
	default "saml21g18b" if SOC_SAML21G18B
	default "saml21j16b" if SOC_SAML21J16B
	default "saml21j17b" if SOC_SAML21J17B
	default "saml21j18b" if SOC_SAML21J18B
	default "saml21j17bu" if SOC_SAML21J17BU
	default "saml21j18bu" if SOC_SAML21J18BU
```

## soc/atmel/sam0/samr21/Kconfig.soc
```kconfig
# Atmel SAMR21 MCU series

# Copyright (c) 2017 Google LLC.
# Copyright (c) 2024 Gerson Fernando Budke <nandojve@gmail.com>
# SPDX-License-Identifier: Apache-2.0

config SOC_SERIES_SAMR21
	bool
	select SOC_FAMILY_ATMEL_SAM0
	help
	  Enable support for Atmel SAMR21 Cortex-M0+ microcontrollers.

config SOC_SERIES
	default "samr21" if SOC_SERIES_SAMR21

config SOC_SAMR21E16A
	bool
	select SOC_SERIES_SAMR21

config SOC_SAMR21E17A
	bool
	select SOC_SERIES_SAMR21

config SOC_SAMR21E18A
	bool
	select SOC_SERIES_SAMR21

config SOC_SAMR21E19A
	bool
	select SOC_SERIES_SAMR21

config SOC_SAMR21G16A
	bool
	select SOC_SERIES_SAMR21

config SOC_SAMR21G17A
	bool
	select SOC_SERIES_SAMR21

config SOC_SAMR21G18A
	bool
	select SOC_SERIES_SAMR21

config SOC
	default "samr21e16a" if SOC_SAMR21E16A
	default "samr21e17a" if SOC_SAMR21E17A
	default "samr21e18a" if SOC_SAMR21E18A
	default "samr21e19a" if SOC_SAMR21E19A
	default "samr21g16a" if SOC_SAMR21G16A
	default "samr21g17a" if SOC_SAMR21G17A
	default "samr21g18a" if SOC_SAMR21G18A
```

## soc/atmel/sam0/samr34/Kconfig.defconfig
```kconfig
# Atmel SAML MCU series configuration options

# Copyright (c) 2021 Argentum Systems Ltd.
# Copyright (c) 2024 Gerson Fernando Budke <nandojve@gmail.com>
# SPDX-License-Identifier: Apache-2.0

if SOC_SERIES_SAMR34

config NUM_IRQS
	default 23

endif # SOC_SERIES_SAMR34
```

## soc/atmel/sam0/samr34/Kconfig.soc
```kconfig
# Atmel SAMR34 MCU series

# Copyright (c) 2021 Argentum Systems Ltd.
# Copyright (c) 2024 Gerson Fernando Budke <nandojve@gmail.com>
# SPDX-License-Identifier: Apache-2.0

config SOC_SERIES_SAMR34
	bool
	select SOC_FAMILY_ATMEL_SAM0
	help
	  Enable support for Atmel SAMR34 Cortex-M0+ microcontrollers.

config SOC_SERIES
	default "samr34" if SOC_SERIES_SAMR34

config SOC_SAMR34J16B
	bool
	select SOC_SERIES_SAMR34

config SOC_SAMR34J17B
	bool
	select SOC_SERIES_SAMR34

config SOC_SAMR34J18B
	bool
	select SOC_SERIES_SAMR34

config SOC
	default "samr34j16b" if SOC_SAMR34J16B
	default "samr34j17b" if SOC_SAMR34J17B
	default "samr34j18b" if SOC_SAMR34J18B
```

## soc/atmel/sam0/samr35/Kconfig
```kconfig
# Atmel SAMR35 MCU series

# Copyright (c) 2021 Argentum Systems Ltd.
# Copyright (c) 2023-2024 Gerson Fernando Budke <nandojve@gmail.com>
# SPDX-License-Identifier: Apache-2.0

config SOC_SERIES_SAMR35
	select ARM
	select CPU_CORTEX_M0PLUS
	select CPU_CORTEX_M_HAS_SYSTICK
	select CPU_CORTEX_M_HAS_VTOR
	select SOC_RESET_HOOK
```

## soc/atmel/sam0/samr35/Kconfig.defconfig
```kconfig
# Atmel SAMR35 MCU series configuration options

# Copyright (c) 2021 Argentum Systems Ltd.
# Copyright (c) 2024 Gerson Fernando Budke <nandojve@gmail.com>
# SPDX-License-Identifier: Apache-2.0

if SOC_SERIES_SAMR35

config NUM_IRQS
	default 23

endif # SOC_SERIES_SAMR35
```

## soc/atmel/sam0/samr35/Kconfig.soc
```kconfig
# Atmel SAMR35 MCU series

# Copyright (c) 2021 Argentum Systems Ltd.
# Copyright (c) 2024 Gerson Fernando Budke <nandojve@gmail.com>
# SPDX-License-Identifier: Apache-2.0

config SOC_SERIES_SAMR35
	bool
	select SOC_FAMILY_ATMEL_SAM0
	help
	  Enable support for Atmel SAMR35 Cortex-M0+ microcontrollers.

config SOC_SERIES
	default "samr35" if SOC_SERIES_SAMR35

config SOC_SAMR35J16B
	bool
	select SOC_SERIES_SAMR35

config SOC_SAMR35J17B
	bool
	select SOC_SERIES_SAMR35

config SOC_SAMR35J18B
	bool
	select SOC_SERIES_SAMR35

config SOC
	default "samr35j16b" if SOC_SAMR35J16B
	default "samr35j17b" if SOC_SAMR35J17B
	default "samr35j18b" if SOC_SAMR35J18B
```

## soc/atmosic/ATM33/Kconfig.defconfig
```kconfig
# Copyright (c) 2021-2024 Atmosic
#
# SPDX-License-Identifier: Apache-2.0

if SOC_SERIES_ATM33

config ROM_START_OFFSET
	default 0 if MERGE_SPE_NSPE && BOOTLOADER_MCUBOOT
	default 0x800 if BOOTLOADER_MCUBOOT

config SYS_CLOCK_HW_CYCLES_PER_SEC
	int
	default 16000000

config NUM_IRQS
	int
	default 448

config BUILD_OUTPUT_HEX
	default y

config HW_STACK_PROTECTION
	default y

if ENTROPY_ATM_TRNG

# entropy driver needs additional support (i.e. BLE driver)
config HEAP_MEM_POOL_SIZE
       default 32768

endif # ENTROPY_ATM_TRNG

if PM

config IDLE_STACK_SIZE
	int
	default 1024

endif # PM


SLOT0_NODE_LABEL := $(dt_nodelabel_path,slot0_partition)
SLOT0_SIZE := $(dt_node_reg_size_int,$(SLOT0_NODE_LABEL),0)
SLOT0_PARENT := $(dt_node_parent,$(SLOT0_NODE_LABEL))
SLOT0_GPARENT := $(dt_node_parent,$(SLOT0_PARENT))
SLOT0_GPARENT_EB := $(dt_node_int_prop_int,$(SLOT0_GPARENT),erase-block-size)
# MAX_SECTORS relies on using the FLASH device with the smallest sector size - on ATM33, that is always slot0 (RRAM)
MAX_SECTORS := $(shell, python3 -c "print(int($(SLOT0_SIZE)/$(SLOT0_GPARENT_EB))) if $(SLOT0_SIZE) else print(0)")

if MCUBOOT || BOOTLOADER_MCUBOOT

config BOOT_MAX_IMG_SECTORS
	int
	default $(MAX_SECTORS)

endif #  MCUBOOT || BOOTLOADER_MCUBOOT

if TRUSTED_EXECUTION_NONSECURE

config SPE_PATH
	string "Path to SPE build directory"

config ATM_ARM_FIRMWARE_USES_SECURE_ENTRY_FUNCS
	bool "ATM Non-Secure Firmware uses Secure Entry functions"
	default y if SPE_PATH != ""
	help
	  Option as ARM_FIRMWARE_USES_SECURE_ENTRY_FUNCS.

config ATM_ARM_ENTRY_VENEERS_LIB_NAME
	string "ATM Entry Veneers symbol file"
	depends on SPE_PATH != ""
	default "libentryveneers.a"
	help
	  Library file as ARM_ENTRY_VENEERS_LIB_NAME.

config MERGE_SPE_NSPE
	bool "Merge SPE and application into single image"
	depends on SPE_PATH != ""
	default y if BOOTLOADER_MCUBOOT
	default n
	help
	  Option to merge SPE and NSPE to a single image. This config must
	  be set if building with MCUboot as the merged image is signed.
	  However, it can also be set to allow a single `west flash` to flash
	  both the spe and nspe.

if BOOTLOADER_MCUBOOT

config MCUBOOT_EXTRA_IMGTOOL_ARGS
	# Need to override header-size for image tool to the SPE header allocation
	default "--header-size=0x800" if MERGE_SPE_NSPE

endif # BOOTLOADER_MCUBOOT

endif # TRUSTED_EXECUTION_NONSECURE

endif # SOC_SERIES_ATM33
```

## soc/atmosic/ATM33/Kconfig.soc
```kconfig
# Copyright (c) 2021-2024 Atmosic
#
# SPDX-License-Identifier: Apache-2.0

config SOC_SERIES_ATM33
	bool
	select SOC_FAMILY_ATM

config SOC_SERIES
	default "ATM33" if SOC_SERIES_ATM33

config SOC_ATM33XX_5
	bool
	select SOC_SERIES_ATM33

config SOC
	default "ATM33xx-5" if SOC_ATM33XX_5
```

## soc/atmosic/ATM34/Kconfig
```kconfig
# Copyright (c) 2021-2024 Atmosic
#
# SPDX-License-Identifier: Apache-2.0

config SOC_SERIES_ATM34
	select ARM
	select CPU_CORTEX_M33
	select CPU_HAS_ARM_SAU
	select CPU_HAS_ARM_MPU
	select CPU_HAS_FPU
	select FPU
	select ARMV8_M_DSP
	select CPU_HAS_TEE
	select HAS_PM
	help
	  Enable support for ATM34 series
```

## soc/atmosic/ATM34/Kconfig.defconfig
```kconfig
# Copyright (c) 2021-2024 Atmosic
#
# SPDX-License-Identifier: Apache-2.0

if SOC_SERIES_ATM34

config ROM_START_OFFSET
	default 0 if MERGE_SPE_NSPE && BOOTLOADER_MCUBOOT && !ATM_SPLIT_IMG
	default 0x800 if BOOTLOADER_MCUBOOT

config SYS_CLOCK_HW_CYCLES_PER_SEC
	int
	default 16000000 if CORTEX_M_SYSTICK_EXTERNAL_REF
	default 32000000

config NUM_IRQS
	int
	default 448

config BUILD_OUTPUT_HEX
	default y

if PM

config IDLE_STACK_SIZE
	int
	default 1024

endif # PM

# MCUBOOT uses BOOT_MAX_IMG_SECTORS to size the sector swap map for both
# SLOT1 and SLOT3 in a multi-image swap (a known limitation).
# The value needs to be sufficiently large to handle the largest number of sectors
# in either slot. Since the trailer must have a minimum size and alignment of 4K
# to flash memory we can use a conservative value of 512 image sectors for the
# non-volatile and in-memory swap maps.
# The default value results in:
#  -) slot2/slot3 (FLASH/FLASH) can have up to a 2MB slot size
#  -) slot0/slot1 (RRAM/FLASH) can be up to 512KB slot sizes

config BOOT_MAX_IMG_SECTORS
	int
	default 512
	depends on MCUBOOT || BOOTLOADER_MCUBOOT

if TRUSTED_EXECUTION_NONSECURE

config SPE_PATH
	string "Path to SPE build directory"

config ARM_FIRMWARE_USES_SECURE_ENTRY_FUNCS
	default y if SPE_PATH != ""

config MERGE_SPE_NSPE
	bool "Merge SPE and application into single image"
	depends on SPE_PATH != ""
	default y if BOOTLOADER_MCUBOOT
	default n
	help
	  Option to merge SPE and NSPE to a single image. This config must
	  be set if building with MCUboot as the merged image is signed.
	  However, it can also be set to allow a single `west flash` to flash
	  both the spe and nspe.

config ATM_SPLIT_IMG
	depends on FLASH
	bool "Image split across multiple memory regions"

config MCUBOOT_EXTRA_IMGTOOL_ARGS
	# Need to override header-size for image tool to the SPE header allocation
	default "--header-size=0x800" if MERGE_SPE_NSPE || ATM_SPLIT_IMG
	depends on BOOTLOADER_MCUBOOT

endif # TRUSTED_EXECUTION_NONSECURE

endif # SOC_SERIES_ATM34
```

## soc/atmosic/ATM34/Kconfig.soc
```kconfig
# Copyright (c) 2021-2024 Atmosic
#
# SPDX-License-Identifier: Apache-2.0

config SOC_SERIES_ATM34
	bool
	select SOC_FAMILY_ATM

config SOC_SERIES
	default "ATM34" if SOC_SERIES_ATM34

config SOC_ATM34XX_2
	bool
	select SOC_SERIES_ATM34

config SOC_ATM34XX_5
	bool
	select SOC_SERIES_ATM34

config SOC
	default "ATM34xx-2" if SOC_ATM34XX_2
	default "ATM34xx-5" if SOC_ATM34XX_5
```

## soc/atmosic/ATMx2/Kconfig
```kconfig
# Copyright (c) 2021-2024 Atmosic
#
# SPDX-License-Identifier: Apache-2.0

config SOC_SERIES_ATMX2
	select ARM
	select CPU_CORTEX_M0
	select CPU_CORTEX_M_HAS_SYSTICK
	select HAS_PM
	help
	  Enable support for ATMx2 series
```

## soc/atmosic/ATMx2/Kconfig.defconfig
```kconfig
# Copyright (c) 2021-2024 Atmosic
#
# SPDX-License-Identifier: Apache-2.0

if SOC_SERIES_ATMX2

config ATMx2_ROM
	bool
	default y

config SYS_CLOCK_HW_CYCLES_PER_SEC
	int
	default 16000000

config NUM_IRQS
	int
	default 32

if PM

config IDLE_STACK_SIZE
	int
	default 1024

endif # PM

endif # SOC_SERIES_ATMX2
```

## soc/atmosic/ATMx2/Kconfig.soc
```kconfig
# Copyright (c) 2024 Atmosic
#
# SPDX-License-Identifier: Apache-2.0

config SOC_SERIES_ATMX2
	bool
	select SOC_FAMILY_ATM

config SOC_SERIES
	default "ATMx2" if SOC_SERIES_ATMX2

config SOC_ATMX2XX_X1X
	bool
	select SOC_SERIES_ATMX2

config SOC
	default "ATMx2xx-x1x" if SOC_ATMX2XX_X1X
```
