## soc/atmosic/Kconfig
```kconfig
# Copyright (c) 2021-2025 Atmosic
#
# SPDX-License-Identifier: Apache-2.0

if SOC_FAMILY_ATM

rsource "*/Kconfig"

config ATM_SOC_ALLOW
        string "list of specific soc series support list"
        help
          Used when build with test item in sample.yaml. When specified, the
          build will checking if SOC support or not. Default will be empty.
          It should be the value of SOC_SERIES, split with comma when multiple
          soc support, ex: ATM33 or ATM33,ATM34

endif # SOC_FAMILY_ATM
```

## soc/atmosic/Kconfig.defconfig
```kconfig
# Copyright (c) 2021-2024 Atmosic
#
# SPDX-License-Identifier: Apache-2.0

if SOC_FAMILY_ATM

rsource "*/Kconfig.defconfig"

config SOC_FAMILY_ATM
	select HAS_SEGGER_RTT if ZEPHYR_SEGGER_MODULE
	select HAS_COVERAGE_SUPPORT

config AUTO_TEST
	bool "Enable Auto Test"
	default n

if ENTROPY_ATM_TRNG

# NOTE: To get the best performance from the TRNG, a suitable
# PRNG should be used for random and cryptographically secure
# random number generators.  TRNG only provides a source of
# entropy for these generators.
# Avoid the use of ENTROPY_DEVICE_RANDOM_GENERATOR or
# HARDWARE_DEVICE_CS_GENERATOR option that acquire numbers
# directly from the entropy generator.

# default the RNG to a PRNG seeded by the ATM TRNG
choice RNG_GENERATOR_CHOICE
	default XOSHIRO_RANDOM_GENERATOR
endchoice

# ATM TRNG HW should be used as an entropy source for a
# secure PRNG implementation.  Use the default AES-CTR mode drbg.
choice CSPRNG_GENERATOR_CHOICE
	default CTR_DRBG_CSPRNG_GENERATOR
endchoice

# CTR_DRBG_CSPRNG requires MBEDTLS
config ATM_REQUIRES_MBEDTLS
	bool
	default y
	select MBEDTLS

config BT_RX_STACK_SIZE
	int
	default 1856 if ATM_BLE && ATM_AES_HW
	default 1792
	depends on ATM_REQUIRES_MBEDTLS
	depends on BT

config MAIN_STACK_SIZE
	int
	default 2560 if COVERAGE_GCOV
	default 1856 if ATM_BLE && ATM_AES_HW
	default 1792 if ATM_REQUIRES_MBEDTLS

config ZTEST_STACK_SIZE
	int
	default 2048 if COVERAGE_GCOV
	default 1792 if ATM_REQUIRES_MBEDTLS

config THREAD_NAME
	bool
	default y if COVERAGE_GCOV

endif # ENTROPY_ATM_TRNG

endif # SOC_FAMILY_ATM
```

## soc/atmosic/Kconfig.soc
```kconfig
# Copyright (c) 2021-2024 Atmosic
#
# SPDX-License-Identifier: Apache-2.0

config SOC_FAMILY_ATM
	bool

config SOC_FAMILY
	default "atmosic" if SOC_FAMILY_ATM

rsource "*/Kconfig.soc"
```
