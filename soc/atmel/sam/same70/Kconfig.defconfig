## soc/atmel/sam/same70/Kconfig.defconfig
```kconfig
# Atmel SAM E70 MCU series configuration options

# Copyright (c) 2016 Piotr Mienkowski
# Copyright (c) 2023-2024 Gerson Fernando Budke <nandojve@gmail.com>
# SPDX-License-Identifier: Apache-2.0

if SOC_SERIES_SAME70

config NUM_IRQS
	default 74 if SOC_ATMEL_SAME70_REVB
	default 71

endif # SOC_SERIES_SAME70
```

## soc/atmel/sam/same70/Kconfig.soc
```kconfig
# Atmel SAM E70 MCU series

# Copyright (c) 2016 Piotr Mienkowski
# Copyright (c) 2024 Gerson Fernando Budke <nandojve@gmail.com>
# SPDX-License-Identifier: Apache-2.0

config SOC_SERIES_SAME70
	bool
	select SOC_FAMILY_ATMEL_SAM
	help
	  Enable support for Atmel SAM E70 ARM Cortex-M7 Microcontrollers.
	  Part No.: SAME70J19, SAME70J20, SAME70J21, SAME70N19, SAME70N20,
	  SAME70N21, SAME70Q19, SAME70Q20, SAME70Q21, SAME70J19B, SAME70J20B,
	  SAME70J21B, SAME70N19B, SAME70N20B, SAME70N21B, SAME70Q19B,
	  SAME70Q20B, SAME70Q21B

config SOC_ATMEL_SAME70_REVB
	bool

config SOC_SERIES
	default "same70" if SOC_SERIES_SAME70

config SOC_SAME70J19
	bool
	select SOC_SERIES_SAME70

config SOC_SAME70J20
	bool
	select SOC_SERIES_SAME70

config SOC_SAME70J21
	bool
	select SOC_SERIES_SAME70

config SOC_SAME70N19
	bool
	select SOC_SERIES_SAME70

config SOC_SAME70N20
	bool
	select SOC_SERIES_SAME70

config SOC_SAME70N21
	bool
	select SOC_SERIES_SAME70

config SOC_SAME70Q19
	bool
	select SOC_SERIES_SAME70

config SOC_SAME70Q20
	bool
	select SOC_SERIES_SAME70

config SOC_SAME70Q21
	bool
	select SOC_SERIES_SAME70

config SOC_SAME70J19B
	bool
	select SOC_SERIES_SAME70
	select SOC_ATMEL_SAME70_REVB

config SOC_SAME70J20B
	bool
	select SOC_SERIES_SAME70
	select SOC_ATMEL_SAME70_REVB

config SOC_SAME70J21B
	bool
	select SOC_SERIES_SAME70
	select SOC_ATMEL_SAME70_REVB

config SOC_SAME70N19B
	bool
	select SOC_SERIES_SAME70
	select SOC_ATMEL_SAME70_REVB

config SOC_SAME70N20B
	bool
	select SOC_SERIES_SAME70
	select SOC_ATMEL_SAME70_REVB

config SOC_SAME70N21B
	bool
	select SOC_SERIES_SAME70
	select SOC_ATMEL_SAME70_REVB

config SOC_SAME70Q19B
	bool
	select SOC_SERIES_SAME70
	select SOC_ATMEL_SAME70_REVB

config SOC_SAME70Q20B
	bool
	select SOC_SERIES_SAME70
	select SOC_ATMEL_SAME70_REVB

config SOC_SAME70Q21B
	bool
	select SOC_SERIES_SAME70
	select SOC_ATMEL_SAME70_REVB

config SOC
	default "same70j19" if SOC_SAME70J19
	default "same70j20" if SOC_SAME70J20
	default "same70j21" if SOC_SAME70J21
	default "same70n19" if SOC_SAME70N19
	default "same70n20" if SOC_SAME70N20
	default "same70n21" if SOC_SAME70N21
	default "same70q19" if SOC_SAME70Q19
	default "same70q20" if SOC_SAME70Q20
	default "same70q21" if SOC_SAME70Q21
	default "same70j19b" if SOC_SAME70J19B
	default "same70j20b" if SOC_SAME70J20B
	default "same70j21b" if SOC_SAME70J21B
	default "same70n19b" if SOC_SAME70N19B
	default "same70n20b" if SOC_SAME70N20B
	default "same70n21b" if SOC_SAME70N21B
	default "same70q19b" if SOC_SAME70Q19B
	default "same70q20b" if SOC_SAME70Q20B
	default "same70q21b" if SOC_SAME70Q21B
```

## soc/atmel/sam/samv71/Kconfig
```kconfig
# Atmel SAM V71 MCU series

# Copyright (c) 2016 Piotr Mienkowski
# Copyright (c) 2019-2024 Gerson Fernando Budke <nandojve@gmail.com>
# SPDX-License-Identifier: Apache-2.0

config SOC_SERIES_SAMV71
	select ARM
	select CPU_CORTEX_M7
	select CPU_CORTEX_M_HAS_DWT
	select CPU_HAS_ARM_MPU
	select CPU_HAS_FPU_DOUBLE_PRECISION
	select CPU_HAS_ICACHE
	select CPU_HAS_DCACHE
	select INIT_ARCH_HW_AT_BOOT
	select SOC_RESET_HOOK
	select HAS_SWO
	select XIP
	select HAS_POWEROFF
	select SOC_EARLY_INIT_HOOK
```

## soc/atmel/sam/samv71/Kconfig.defconfig
```kconfig
# Atmel SAM V71 MCU series configuration options

# Copyright (c) 2016 Piotr Mienkowski
# Copyright (c) 2019-2024 Gerson Fernando Budke <nandojve@gmail.com>
# SPDX-License-Identifier: Apache-2.0

if SOC_SERIES_SAMV71

config NUM_IRQS
	default 74 if SOC_ATMEL_SAMV71_REVB
	default 71

endif # SOC_SERIES_SAMV71
```

## soc/atmel/sam/samv71/Kconfig.soc
```kconfig
# Atmel SAM V71 MCU series

# Copyright (c) 2016 Piotr Mienkowski
# Copyright (c) 2019-2024 Gerson Fernando Budke <nandojve@gmail.com>
# SPDX-License-Identifier: Apache-2.0

config SOC_SERIES_SAMV71
	bool
	select SOC_FAMILY_ATMEL_SAM
	help
	  Enable support for Atmel SAM V71 ARM Cortex-M7 Microcontrollers.
	  Part No.: SAMV71J19, SAMV71J20, SAMV71J21, SAMV71N19, SAMV71N20,
	  SAMV71N21, SAMV71Q19, SAMV71Q20, SAMV71Q21, SAMV71J19B, SAMV71J20B,
	  SAMV71J21B, SAMV71N19B, SAMV71N20B, SAMV71N21B, SAMV71Q19B,
	  SAMV71Q20B, SAMV71Q21B

config SOC_ATMEL_SAMV71_REVB
	bool

config SOC_SERIES
	default "samv71" if SOC_SERIES_SAMV71

config SOC_SAMV71J19
	bool
	select SOC_SERIES_SAMV71

config SOC_SAMV71J20
	bool
	select SOC_SERIES_SAMV71

config SOC_SAMV71J21
	bool
	select SOC_SERIES_SAMV71

config SOC_SAMV71N19
	bool
	select SOC_SERIES_SAMV71

config SOC_SAMV71N20
	bool
	select SOC_SERIES_SAMV71

config SOC_SAMV71N21
	bool
	select SOC_SERIES_SAMV71

config SOC_SAMV71Q19
	bool
	select SOC_SERIES_SAMV71

config SOC_SAMV71Q20
	bool
	select SOC_SERIES_SAMV71

config SOC_SAMV71Q21
	bool
	select SOC_SERIES_SAMV71

config SOC_SAMV71J19B
	bool
	select SOC_SERIES_SAMV71
	select SOC_ATMEL_SAMV71_REVB

config SOC_SAMV71J20B
	bool
	select SOC_SERIES_SAMV71
	select SOC_ATMEL_SAMV71_REVB

config SOC_SAMV71J21B
	bool
	select SOC_SERIES_SAMV71
	select SOC_ATMEL_SAMV71_REVB

config SOC_SAMV71N19B
	bool
	select SOC_SERIES_SAMV71
	select SOC_ATMEL_SAMV71_REVB

config SOC_SAMV71N20B
	bool
	select SOC_SERIES_SAMV71
	select SOC_ATMEL_SAMV71_REVB

config SOC_SAMV71N21B
	bool
	select SOC_SERIES_SAMV71
	select SOC_ATMEL_SAMV71_REVB

config SOC_SAMV71Q19B
	bool
	select SOC_SERIES_SAMV71
	select SOC_ATMEL_SAMV71_REVB

config SOC_SAMV71Q20B
	bool
	select SOC_SERIES_SAMV71
	select SOC_ATMEL_SAMV71_REVB

config SOC_SAMV71Q21B
	bool
	select SOC_SERIES_SAMV71
	select SOC_ATMEL_SAMV71_REVB

config SOC
	default "samv71j19" if SOC_SAMV71J19
	default "samv71j20" if SOC_SAMV71J20
	default "samv71j21" if SOC_SAMV71J21
	default "samv71n19" if SOC_SAMV71N19
	default "samv71n20" if SOC_SAMV71N20
	default "samv71n21" if SOC_SAMV71N21
	default "samv71q19" if SOC_SAMV71Q19
	default "samv71q20" if SOC_SAMV71Q20
	default "samv71q21" if SOC_SAMV71Q21
	default "samv71j19b" if SOC_SAMV71J19B
	default "samv71j20b" if SOC_SAMV71J20B
	default "samv71j21b" if SOC_SAMV71J21B
	default "samv71n19b" if SOC_SAMV71N19B
	default "samv71n20b" if SOC_SAMV71N20B
	default "samv71n21b" if SOC_SAMV71N21B
	default "samv71q19b" if SOC_SAMV71Q19B
	default "samv71q20b" if SOC_SAMV71Q20B
	default "samv71q21b" if SOC_SAMV71Q21B
```

## soc/atmel/sam/samx7x/Kconfig.defconfig
```kconfig
# Atmel SAM E70/S70/V70/V71 MCU series configuration options

# Copyright (c) 2016 Piotr Mienkowski
# Copyright (c) 2019-2024 Gerson Fernando Budke <nandojve@gmail.com>
# SPDX-License-Identifier: Apache-2.0

if SOC_SERIES_SAMX7X

config NUM_IRQS
	default 74 if SOC_ATMEL_SAME70_REVB
	default 74 if SOC_ATMEL_SAMV71_REVB
	default 71

endif # SOC_SERIES_SAMX7X
```

## soc/atmel/sam/samx7x/Kconfig.soc
```kconfig
# Atmel SAM E70/S70/V70/V71 MCU series

# Copyright (c) 2016 Piotr Mienkowski
# Copyright (c) 2019-2024 Gerson Fernando Budke <nandojve@gmail.com>
# Copyright (c) 2024 Henrik Brix Andersen <henrik@brixandersen.dk>
# SPDX-License-Identifier: Apache-2.0

config SOC_SERIES_SAMX7X
	bool
	select SOC_FAMILY_ATMEL_SAM
	help
	  Enable support for Atmel SAM E70/S70/V70/V71 ARM Cortex-M7 Microcontrollers.

config SOC_SERIES
	default "samx7x" if SOC_SERIES_SAMX7X

rsource "Kconfig.soc.sam*"
```

## soc/atmel/sam/samx7x/Kconfig.soc.same70
```kconfig
# Atmel SAM E70 MCU series

# Copyright (c) 2016 Piotr Mienkowski
# Copyright (c) 2024 Gerson Fernando Budke <nandojve@gmail.com>
# Copyright (c) 2024 Henrik Brix Andersen <henrik@brixandersen.dk>
# SPDX-License-Identifier: Apache-2.0

config SOC_ATMEL_SAME70
	select SOC_SERIES_SAMX7X
	bool

config SOC_ATMEL_SAME70_REVB
	select SOC_SERIES_SAMX7X
	bool

config SOC_SAME70J19
	bool
	select SOC_ATMEL_SAME70

config SOC_SAME70J20
	bool
	select SOC_ATMEL_SAME70

config SOC_SAME70J21
	bool
	select SOC_ATMEL_SAME70

config SOC_SAME70N19
	bool
	select SOC_ATMEL_SAME70

config SOC_SAME70N20
	bool
	select SOC_ATMEL_SAME70

config SOC_SAME70N21
	bool
	select SOC_ATMEL_SAME70

config SOC_SAME70Q19
	bool
	select SOC_ATMEL_SAME70

config SOC_SAME70Q20
	bool
	select SOC_ATMEL_SAME70

config SOC_SAME70Q21
	bool
	select SOC_ATMEL_SAME70

config SOC_SAME70J19B
	bool
	select SOC_ATMEL_SAME70_REVB

config SOC_SAME70J20B
	bool
	select SOC_ATMEL_SAME70_REVB

config SOC_SAME70J21B
	bool
	select SOC_ATMEL_SAME70_REVB

config SOC_SAME70N19B
	bool
	select SOC_ATMEL_SAME70_REVB

config SOC_SAME70N20B
	bool
	select SOC_ATMEL_SAME70_REVB

config SOC_SAME70N21B
	bool
	select SOC_ATMEL_SAME70_REVB

config SOC_SAME70Q19B
	bool
	select SOC_ATMEL_SAME70_REVB

config SOC_SAME70Q20B
	bool
	select SOC_ATMEL_SAME70_REVB

config SOC_SAME70Q21B
	bool
	select SOC_ATMEL_SAME70_REVB

config SOC
	default "same70j19" if SOC_SAME70J19
	default "same70j20" if SOC_SAME70J20
	default "same70j21" if SOC_SAME70J21
	default "same70n19" if SOC_SAME70N19
	default "same70n20" if SOC_SAME70N20
	default "same70n21" if SOC_SAME70N21
	default "same70q19" if SOC_SAME70Q19
	default "same70q20" if SOC_SAME70Q20
	default "same70q21" if SOC_SAME70Q21
	default "same70j19b" if SOC_SAME70J19B
	default "same70j20b" if SOC_SAME70J20B
	default "same70j21b" if SOC_SAME70J21B
	default "same70n19b" if SOC_SAME70N19B
	default "same70n20b" if SOC_SAME70N20B
	default "same70n21b" if SOC_SAME70N21B
	default "same70q19b" if SOC_SAME70Q19B
	default "same70q20b" if SOC_SAME70Q20B
	default "same70q21b" if SOC_SAME70Q21B
```

## soc/atmel/sam/samx7x/Kconfig.soc.samv71
```kconfig
# Atmel SAM V71 MCU series

# Copyright (c) 2016 Piotr Mienkowski
# Copyright (c) 2019-2024 Gerson Fernando Budke <nandojve@gmail.com>
# Copyright (c) 2024 Henrik Brix Andersen <henrik@brixandersen.dk>
# SPDX-License-Identifier: Apache-2.0

config SOC_ATMEL_SAMV71
	bool
	select SOC_SERIES_SAMX7X

config SOC_ATMEL_SAMV71_REVB
	bool
	select SOC_SERIES_SAMX7X

config SOC_SAMV71J19
	bool
	select SOC_ATMEL_SAMV71

config SOC_SAMV71J20
	bool
	select SOC_ATMEL_SAMV71

config SOC_SAMV71J21
	bool
	select SOC_ATMEL_SAMV71

config SOC_SAMV71N19
	bool
	select SOC_ATMEL_SAMV71

config SOC_SAMV71N20
	bool
	select SOC_ATMEL_SAMV71

config SOC_SAMV71N21
	bool
	select SOC_ATMEL_SAMV71

config SOC_SAMV71Q19
	bool
	select SOC_ATMEL_SAMV71

config SOC_SAMV71Q20
	bool
	select SOC_ATMEL_SAMV71

config SOC_SAMV71Q21
	bool
	select SOC_ATMEL_SAMV71

config SOC_SAMV71J19B
	bool
	select SOC_ATMEL_SAMV71_REVB

config SOC_SAMV71J20B
	bool
	select SOC_ATMEL_SAMV71_REVB

config SOC_SAMV71J21B
	bool
	select SOC_ATMEL_SAMV71_REVB

config SOC_SAMV71N19B
	bool
	select SOC_ATMEL_SAMV71_REVB

config SOC_SAMV71N20B
	bool
	select SOC_ATMEL_SAMV71_REVB

config SOC_SAMV71N21B
	bool
	select SOC_ATMEL_SAMV71_REVB

config SOC_SAMV71Q19B
	bool
	select SOC_ATMEL_SAMV71_REVB

config SOC_SAMV71Q20B
	bool
	select SOC_ATMEL_SAMV71_REVB

config SOC_SAMV71Q21B
	bool
	select SOC_ATMEL_SAMV71_REVB

config SOC
	default "samv71j19" if SOC_SAMV71J19
	default "samv71j20" if SOC_SAMV71J20
	default "samv71j21" if SOC_SAMV71J21
	default "samv71n19" if SOC_SAMV71N19
	default "samv71n20" if SOC_SAMV71N20
	default "samv71n21" if SOC_SAMV71N21
	default "samv71q19" if SOC_SAMV71Q19
	default "samv71q20" if SOC_SAMV71Q20
	default "samv71q21" if SOC_SAMV71Q21
	default "samv71j19b" if SOC_SAMV71J19B
	default "samv71j20b" if SOC_SAMV71J20B
	default "samv71j21b" if SOC_SAMV71J21B
	default "samv71n19b" if SOC_SAMV71N19B
	default "samv71n20b" if SOC_SAMV71N20B
	default "samv71n21b" if SOC_SAMV71N21B
	default "samv71q19b" if SOC_SAMV71Q19B
	default "samv71q20b" if SOC_SAMV71Q20B
	default "samv71q21b" if SOC_SAMV71Q21B
```

## soc/atmel/sam0/Kconfig
```kconfig
# Atmel SAM0 MCU family configuration options

# Copyright (c) 2017 Google LLC.
# Copyright (c) 2024 Gerson Fernando Budke <nandojve@gmail.com>
# SPDX-License-Identifier: Apache-2.0

config SOC_FAMILY_ATMEL_SAM0
	select ASF
	select HAS_SEGGER_RTT if ZEPHYR_SEGGER_MODULE

if SOC_FAMILY_ATMEL_SAM0

rsource "common/Kconfig.sam*"
rsource "*/Kconfig"

endif # SOC_FAMILY_ATMEL_SAM0
```

## soc/atmel/sam0/Kconfig.soc
```kconfig
# Copyright (c) 2017 Google LLC.
# Copyright (c) 2022-2024 Gerson Fernando Budke <nandojve@gmail.com>
# SPDX-License-Identifier: Apache-2.0

config SOC_FAMILY_ATMEL_SAM0
	bool

config SOC_FAMILY
	default "atmel_sam0" if SOC_FAMILY_ATMEL_SAM0

config SOC_SERIES_REVISION_N
	bool
	depends on SOC_FAMILY_ATMEL_SAM0

config SOC_SERIES_REVISION
	string
	default "n" if SOC_SERIES_REVISION_N
	default ""
	depends on SOC_FAMILY_ATMEL_SAM0

rsource "*/Kconfig.soc"
```
