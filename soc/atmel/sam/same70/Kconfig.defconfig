## soc/atmel/sam0/common/Kconfig.samd2x
```kconfig
# Copyright (c) 2024-2025 Gerson Fernando Budke <nandojve@gmail.com>
# SPDX-License-Identifier: Apache-2.0

if SOC_SERIES_SAMD20 || SOC_SERIES_SAMD21 || SOC_SERIES_SAMR21

config SOC_ATMEL_SAMD_NVM_WAIT_STATES
	int "NVM wait states"
	default 1
	help
	  Wait states to set for NVM. Consult the datasheet as these are highly
	  dependent on the device operationg conditions.

config SOC_ATMEL_SAMD_OSC32K
	bool "Internal 32.768 kHz RC oscillator"
	help
	  Enable the internal 32.768 kHz RC oscillator at startup.
	  This can then be selected as the main clock reference for the SOC.

config SOC_ATMEL_SAMD_OSC8M
	bool "Internal 8 MHz RC oscillator"
	help
	  Enable the internal 8 MHz RC oscillator at startup.
	  This can then be selected as the main clock reference for the SOC.

config SOC_ATMEL_SAMD_XOSC32K
	bool "External 32.768 kHz clock source"
	help
	  Enable the external 32.768 kHz clock source at startup.
	  This can then be selected as the main clock reference for the SOC.

config SOC_ATMEL_SAMD_XOSC32K_CRYSTAL
	bool "External 32.768 kHz clock is a crystal oscillator"
	depends on SOC_ATMEL_SAMD_XOSC32K
	default y
	help
	  Enable the crystal oscillator (if disabled, expect a clock signal on
	  XIN32).

DT_ATMEL_RTC := $(dt_nodelabel_path,rtc)
DT_ATMEL_RTC_COUNTER_CLOCK_MODE := $(dt_node_str_prop_equals,$(DT_ATMEL_RTC),counter-mode,clock)

config SOC_ATMEL_SAMD_XOSC32K_PRESCALER
	int "XOSC32 Generic Clock Prescaler"
	range 1 512
	default 32 if "$(DT_ATMEL_RTC_COUNTER_CLOCK_MODE)"
	default 1
	depends on SOC_ATMEL_SAMD_XOSC32K
	help
	  Configure the prescaler for the generic clock output
	  connected on the xosc32. When using RTC in calendar mode
	  the GCLK should be divided by 32 to RTC receive the
	  1024 Hz reference clock.

config SOC_ATMEL_SAMD_XOSC
	bool "External 0.4..32 MHz clock source"
	help
	  Enable the external 0.4..32 MHz clock source at startup.
	  This can then be selected as the main clock reference for the SOC.

config SOC_ATMEL_SAMD_XOSC_CRYSTAL
	bool "External 0.4..32 MHz clock is a crystal oscillator"
	depends on SOC_ATMEL_SAMD_XOSC
	default y
	help
	  Enable the crystal oscillator (if disabled, expect a clock signal on
	  XIN).

config SOC_ATMEL_SAMD_XOSC_FREQ_HZ
	int "External 0.4..32 MHz clock oscillator frequency"
	range 400000 32000000
	default 8000000
	depends on SOC_ATMEL_SAMD_XOSC
	help
	  External 0.4..32 MHz clock oscillator reference frequency.

choice
	prompt "Main clock reference"
	default SOC_ATMEL_SAMD_DEFAULT_AS_MAIN
	help
	  Selects the clock that will be used for the DFLL48M's reference.
	  Main clocks, such as the CPU and AHB clocks will be derived from
	  DFLL48M.

config SOC_ATMEL_SAMD_DEFAULT_AS_MAIN
	bool "DEFAULT"
	help
	  This choice will leave all clocks to their current state.
	  This can be the default reset state or a state set by a bootloader.

config SOC_ATMEL_SAMD_OSC32K_AS_MAIN
	bool "OSC32K"
	depends on SOC_ATMEL_SAMD_OSC32K

config SOC_ATMEL_SAMD_XOSC32K_AS_MAIN
	bool "XOSC32K"
	depends on SOC_ATMEL_SAMD_XOSC32K

config SOC_ATMEL_SAMD_OSC8M_AS_MAIN
	bool "OSC8M"
	depends on SOC_ATMEL_SAMD_OSC8M

config SOC_ATMEL_SAMD_XOSC_AS_MAIN
	bool "XOSC"
	depends on SOC_ATMEL_SAMD_XOSC

endchoice

endif # SOC_SERIES_SAMD20 || SOC_SERIES_SAMD21 || SOC_SERIES_SAMR21
```

## soc/atmel/sam0/common/Kconfig.samd5x
```kconfig
# Copyright (c) 2019 ML!PA Consulting GmbH
# Copyright (c) 2024-2025 Gerson Fernando Budke <nandojve@gmail.com>
# SPDX-License-Identifier: Apache-2.0

if SOC_SERIES_SAMD51 || SOC_SERIES_SAME51 || SOC_SERIES_SAME53 || SOC_SERIES_SAME54

config SOC_ATMEL_SAMD5X_XOSC32K
	bool "The external 32 kHz crystal oscillator"
	help
	  Say y to enable the external 32 kHZ crystal oscillator at
	  startup.  This can then be selected as the main clock source
	  for the SOC.

config SOC_ATMEL_SAMD5X_XOSC32K_STARTUP
	depends on SOC_ATMEL_SAMD5X_XOSC32K
	hex "Startup time external 32 kHz crystal oscillator"
	range 0x0 0x6
	default 0x1
	help
	  Selects the startup time for the external 32 kHz crystal oscillator.

config SOC_ATMEL_SAMD5X_XOSC32K_CRYSTAL
	bool "External 32.768 kHz clock is a crystal oscillator"
	depends on SOC_ATMEL_SAMD5X_XOSC32K
	default y
	help
	  Enable the crystal oscillator (if disabled, expect a clock
	  signal on XIN32).

config SOC_ATMEL_SAMD5X_XOSC32K_GAIN_HS
	bool "XOSC32 High Speed gain"
	depends on SOC_ATMEL_SAMD5X_XOSC32K
	help
	  When this option is selected the gain is set High Speed
	  instead standard.

DT_ATMEL_RTC := $(dt_nodelabel_path,rtc)
DT_ATMEL_RTC_COUNTER_CLOCK_MODE := $(dt_node_str_prop_equals,$(DT_ATMEL_RTC),counter-mode,clock)

config SOC_ATMEL_SAMD5X_OSC32K_PRESCALER
	int "XOSC32 Generic Clock Prescaler"
	range 1 512
	default 32 if "$(DT_ATMEL_RTC_COUNTER_CLOCK_MODE)"
	default 1
	help
	  Configure the prescaler for the generic clock output connected on the
	  xosc32 or osculp32k. When using RTC in calendar mode the GCLK should
	  be divided by 32 to RTC receive the 1024 Hz reference clock.

choice
	prompt "Main clock source"
	default SOC_ATMEL_SAMD5X_DEFAULT_AS_MAIN
	help
	  Selects the clock that the main clocks, such as the CPU
	  clock and AHB clock, will be derived from.

config SOC_ATMEL_SAMD5X_DEFAULT_AS_MAIN
	bool "DEFAULT"
	help
	  This choice will leave all clocks to their current state.
	  This can be the default reset state or a state set by a bootloader.

config SOC_ATMEL_SAMD5X_XOSC32K_AS_MAIN
	depends on SOC_ATMEL_SAMD5X_XOSC32K
	bool "XOSC32K"

config SOC_ATMEL_SAMD5X_OSCULP32K_AS_MAIN
	bool "OSCULP32K"

endchoice

endif
```

## soc/atmel/sam0/samc20/Kconfig
```kconfig
# Atmel SAMC20 MCU series

# Copyright (c) 2022 Kamil Serwus
# Copyright (c) 2023-2024 Gerson Fernando Budke <nandojve@gmail.com>
# SPDX-License-Identifier: Apache-2.0

config SOC_SERIES_SAMC20
	select ARM
	select CPU_CORTEX_M0PLUS
	select CPU_CORTEX_M_HAS_SYSTICK
	select CPU_CORTEX_M_HAS_VTOR
	select SOC_RESET_HOOK
```

## soc/atmel/sam0/samc20/Kconfig.defconfig
```kconfig
# Atmel SAMC20 MCU series configuration options

# Copyright (c) 2022 Kamil Serwus
# Copyright (c) 2024 Gerson Fernando Budke <nandojve@gmail.com>
# SPDX-License-Identifier: Apache-2.0

if SOC_SERIES_SAMC20

config NUM_IRQS
	default 32

endif # SOC_SERIES_SAMC20
```

## soc/atmel/sam0/samc20/Kconfig.soc
```kconfig
# Atmel SAMC20 MCU series

# Copyright (c) 2022 Kamil Serwus
# Copyright (c) 2024 Gerson Fernando Budke <nandojve@gmail.com>
# SPDX-License-Identifier: Apache-2.0

config SOC_SERIES_SAMC20
	bool
	select SOC_FAMILY_ATMEL_SAM0
	help
	  Enable support for Atmel SAMC20 Cortex-M0+ microcontrollers.

config SOC_SERIES
	default "samc20" if SOC_SERIES_SAMC20

config SOC_SAMC20E15A
	bool
	select SOC_SERIES_SAMC20

config SOC_SAMC20E16A
	bool
	select SOC_SERIES_SAMC20

config SOC_SAMC20E17A
	bool
	select SOC_SERIES_SAMC20

config SOC_SAMC20E18A
	bool
	select SOC_SERIES_SAMC20

config SOC_SAMC20G15A
	bool
	select SOC_SERIES_SAMC20

config SOC_SAMC20G16A
	bool
	select SOC_SERIES_SAMC20

config SOC_SAMC20G17A
	bool
	select SOC_SERIES_SAMC20

config SOC_SAMC20G18A
	bool
	select SOC_SERIES_SAMC20

config SOC_SAMC20J15A
	bool
	select SOC_SERIES_SAMC20

config SOC_SAMC20J16A
	bool
	select SOC_SERIES_SAMC20

config SOC_SAMC20J17A
	bool
	select SOC_SERIES_SAMC20

config SOC_SAMC20J18A
	bool
	select SOC_SERIES_SAMC20

config SOC_SAMC20J17AU
	bool
	select SOC_SERIES_SAMC20

config SOC_SAMC20J18AU
	bool
	select SOC_SERIES_SAMC20

config SOC_SAMC20N17A
	bool
	select SOC_SERIES_SAMC20
	select SOC_SERIES_REVISION_N

config SOC_SAMC20N18A
	bool
	select SOC_SERIES_SAMC20
	select SOC_SERIES_REVISION_N

config SOC
	default "samc20e15a" if SOC_SAMC20E15A
	default "samc20e16a" if SOC_SAMC20E16A
	default "samc20e17a" if SOC_SAMC20E17A
	default "samc20e18a" if SOC_SAMC20E18A
	default "samc20g15a" if SOC_SAMC20G15A
	default "samc20g16a" if SOC_SAMC20G16A
	default "samc20g17a" if SOC_SAMC20G17A
	default "samc20g18a" if SOC_SAMC20G18A
	default "samc20j15a" if SOC_SAMC20J15A
	default "samc20j16a" if SOC_SAMC20J16A
	default "samc20j17a" if SOC_SAMC20J17A
	default "samc20j18a" if SOC_SAMC20J18A
	default "samc20j17au" if SOC_SAMC20J17AU
	default "samc20j18au" if SOC_SAMC20J18AU
	default "samc20n17a" if SOC_SAMC20N17A
	default "samc20n18a" if SOC_SAMC20N18A
```

## soc/atmel/sam0/samc21/Kconfig
```kconfig
# Atmel SAMC21 MCU series

# Copyright (c) 2022 Kamil Serwus
# Copyright (c) 2023-2024 Gerson Fernando Budke <nandojve@gmail.com>
# SPDX-License-Identifier: Apache-2.0

config SOC_SERIES_SAMC21
	select ARM
	select CPU_CORTEX_M0PLUS
	select CPU_CORTEX_M_HAS_SYSTICK
	select CPU_CORTEX_M_HAS_VTOR
	select CPU_HAS_ARM_MPU
	select SOC_RESET_HOOK
```

## soc/atmel/sam0/samc21/Kconfig.soc
```kconfig
# Atmel SAMC21 MCU series

# Copyright (c) 2022 Kamil Serwus
# Copyright (c) 2024 Gerson Fernando Budke <nandojve@gmail.com>
# SPDX-License-Identifier: Apache-2.0

config SOC_SERIES_SAMC21
	bool
	select SOC_FAMILY_ATMEL_SAM0
	help
	  Enable support for Atmel SAMC21 Cortex-M0+ microcontrollers.

config SOC_SERIES
	default "samc21" if SOC_SERIES_SAMC21

config SOC_SAMC21E15A
	bool
	select SOC_SERIES_SAMC21

config SOC_SAMC21E16A
	bool
	select SOC_SERIES_SAMC21

config SOC_SAMC21E17A
	bool
	select SOC_SERIES_SAMC21

config SOC_SAMC21E18A
	bool
	select SOC_SERIES_SAMC21

config SOC_SAMC21G15A
	bool
	select SOC_SERIES_SAMC21

config SOC_SAMC21G16A
	bool
	select SOC_SERIES_SAMC21

config SOC_SAMC21G17A
	bool
	select SOC_SERIES_SAMC21

config SOC_SAMC21G18A
	bool
	select SOC_SERIES_SAMC21

config SOC_SAMC21J15A
	bool
	select SOC_SERIES_SAMC21

config SOC_SAMC21J16A
	bool
	select SOC_SERIES_SAMC21

config SOC_SAMC21J17A
	bool
	select SOC_SERIES_SAMC21

config SOC_SAMC21J18A
	bool
	select SOC_SERIES_SAMC21

config SOC_SAMC21J17AU
	bool
	select SOC_SERIES_SAMC21

config SOC_SAMC21J18AU
	bool
	select SOC_SERIES_SAMC21

config SOC_SAMC21N17A
	bool
	select SOC_SERIES_SAMC21
	select SOC_SERIES_REVISION_N

config SOC_SAMC21N18A
	bool
	select SOC_SERIES_SAMC21
	select SOC_SERIES_REVISION_N

config SOC
	default "samc21e15a" if SOC_SAMC21E15A
	default "samc21e16a" if SOC_SAMC21E16A
	default "samc21e17a" if SOC_SAMC21E17A
	default "samc21e18a" if SOC_SAMC21E18A
	default "samc21g15a" if SOC_SAMC21G15A
	default "samc21g16a" if SOC_SAMC21G16A
	default "samc21g17a" if SOC_SAMC21G17A
	default "samc21g18a" if SOC_SAMC21G18A
	default "samc21j15a" if SOC_SAMC21J15A
	default "samc21j16a" if SOC_SAMC21J16A
	default "samc21j17a" if SOC_SAMC21J17A
	default "samc21j18a" if SOC_SAMC21J18A
	default "samc21j17au" if SOC_SAMC21J17AU
	default "samc21j18au" if SOC_SAMC21J18AU
	default "samc21n17a" if SOC_SAMC21N17A
	default "samc21n18a" if SOC_SAMC21N18A
```

## soc/atmel/sam0/samd20/Kconfig
```kconfig
# Atmel SAMD20 MCU series

# Copyright (c) 2018 Sean Nyekjaer
# Copyright (c) 2023-2024 Gerson Fernando Budke <nandojve@gmail.com>
# SPDX-License-Identifier: Apache-2.0

config SOC_SERIES_SAMD20
	select ARM
	select CPU_CORTEX_M0PLUS
	select CPU_CORTEX_M_HAS_SYSTICK
	select CPU_CORTEX_M_HAS_VTOR
	select PLATFORM_SPECIFIC_INIT
```

## soc/atmel/sam0/samd20/Kconfig.defconfig
```kconfig
# Atmel SAMD20 MCU series configuration options

# Copyright (c) 2018 Sean Nyekjaer
# Copyright (c) 2024 Gerson Fernando Budke <nandojve@gmail.com>
# SPDX-License-Identifier: Apache-2.0

if SOC_SERIES_SAMD20

config NUM_IRQS
	default 25

endif # SOC_SERIES_SAMD20
```

## soc/atmel/sam0/samd20/Kconfig.soc
```kconfig
# Atmel SAMD20 MCU series

# Copyright (c) 2018 Sean Nyekjaer
# Copyright (c) 2024 Gerson Fernando Budke <nandojve@gmail.com>
# SPDX-License-Identifier: Apache-2.0

config SOC_SERIES_SAMD20
	bool
	select SOC_FAMILY_ATMEL_SAM0
	help
	  Enable support for Atmel SAMD20 Cortex-M0+ microcontrollers.

config SOC_SERIES
	default "samd20" if SOC_SERIES_SAMD20

config SOC_SAMD20E14
	bool
	select SOC_SERIES_SAMD20

config SOC_SAMD20E15
	bool
	select SOC_SERIES_SAMD20

config SOC_SAMD20E16
	bool
	select SOC_SERIES_SAMD20

config SOC_SAMD20E17
	bool
	select SOC_SERIES_SAMD20

config SOC_SAMD20E18
	bool
	select SOC_SERIES_SAMD20

config SOC_SAMD20G14
	bool
	select SOC_SERIES_SAMD20

config SOC_SAMD20G15
	bool
	select SOC_SERIES_SAMD20

config SOC_SAMD20G16
	bool
	select SOC_SERIES_SAMD20

config SOC_SAMD20G17
	bool

config SOC_SAMD20G18
	bool
	select SOC_SERIES_SAMD20

config SOC_SAMD20G17U
	bool
	select SOC_SERIES_SAMD20

config SOC_SAMD20G18U
	bool
	select SOC_SERIES_SAMD20

config SOC_SAMD20J14
	bool
	select SOC_SERIES_SAMD20

config SOC_SAMD20J15
	bool
	select SOC_SERIES_SAMD20

config SOC_SAMD20J16
	bool
	select SOC_SERIES_SAMD20

config SOC_SAMD20J17
	bool
	select SOC_SERIES_SAMD20

config SOC_SAMD20J18
	bool
	select SOC_SERIES_SAMD20

config SOC
	default "samd20e14" if SOC_SAMD20E14
	default "samd20e15" if SOC_SAMD20E15
	default "samd20e16" if SOC_SAMD20E16
	default "samd20e17" if SOC_SAMD20E17
	default "samd20e18" if SOC_SAMD20E18
	default "samd20g14" if SOC_SAMD20G14
	default "samd20g15" if SOC_SAMD20G15
	default "samd20g16" if SOC_SAMD20G16
	default "samd20g17" if SOC_SAMD20G17
	default "samd20g18" if SOC_SAMD20G18
	default "samd20g17u" if SOC_SAMD20G17U
	default "samd20g18u" if SOC_SAMD20G18U
	default "samd20j14" if SOC_SAMD20J14
	default "samd20j15" if SOC_SAMD20J15
	default "samd20j16" if SOC_SAMD20J16
	default "samd20j17" if SOC_SAMD20J17
	default "samd20j18" if SOC_SAMD20J18
```

## soc/atmel/sam0/samd21/Kconfig.defconfig
```kconfig
# Atmel SAMD21 MCU series configuration options

# Copyright (c) 2017 Google LLC.
# Copyright (c) 2024 Gerson Fernando Budke <nandojve@gmail.com>
# SPDX-License-Identifier: Apache-2.0

if SOC_SERIES_SAMD21

config NUM_IRQS
	default 28

config BUILD_OUTPUT_UF2_FAMILY_ID
	default "0x68ed2b88"

endif # SOC_SERIES_SAMD21
```

## soc/atmel/sam0/samd21/Kconfig.soc
```kconfig
# Atmel SAMD21 MCU series

# Copyright (c) 2017 Google LLC.
# Copyright (c) 2024 Gerson Fernando Budke <nandojve@gmail.com>
# SPDX-License-Identifier: Apache-2.0

config SOC_SERIES_SAMD21
	bool
	select SOC_FAMILY_ATMEL_SAM0
	help
	  Enable support for Atmel SAMD21 Cortex-M0+ microcontrollers.

config SOC_SERIES
	default "samd21" if SOC_SERIES_SAMD21

config SOC_SAMD21E15A
	bool
	select SOC_SERIES_SAMD21

config SOC_SAMD21E16A
	bool
	select SOC_SERIES_SAMD21

config SOC_SAMD21E17A
	bool
	select SOC_SERIES_SAMD21

config SOC_SAMD21E18A
	bool
	select SOC_SERIES_SAMD21

config SOC_SAMD21E19A
	bool
	select SOC_SERIES_SAMD21

config SOC_SAMD21G15A
	bool
	select SOC_SERIES_SAMD21

config SOC_SAMD21G16A
	bool
	select SOC_SERIES_SAMD21

config SOC_SAMD21G17A
	bool
	select SOC_SERIES_SAMD21

config SOC_SAMD21G18A
	bool
	select SOC_SERIES_SAMD21

config SOC_SAMD21G17AU
	bool
	select SOC_SERIES_SAMD21

config SOC_SAMD21G18AU
	bool
	select SOC_SERIES_SAMD21

config SOC_SAMD21J15A
	bool
	select SOC_SERIES_SAMD21

config SOC_SAMD21J16A
	bool
	select SOC_SERIES_SAMD21

config SOC_SAMD21J17A
	bool
	select SOC_SERIES_SAMD21

config SOC_SAMD21J18A
	bool
	select SOC_SERIES_SAMD21

config SOC
	default "samd21e15a" if SOC_SAMD21E15A
	default "samd21e16a" if SOC_SAMD21E16A
	default "samd21e17a" if SOC_SAMD21E17A
	default "samd21e18a" if SOC_SAMD21E18A
	default "samd21g15a" if SOC_SAMD21G15A
	default "samd21g16a" if SOC_SAMD21G16A
	default "samd21g17a" if SOC_SAMD21G17A
	default "samd21g18a" if SOC_SAMD21G18A
	default "samd21g17au" if SOC_SAMD21G17AU
	default "samd21g18au" if SOC_SAMD21G18AU
	default "samd21j15a" if SOC_SAMD21J15A
	default "samd21j16a" if SOC_SAMD21J16A
	default "samd21j17a" if SOC_SAMD21J17A
	default "samd21j18a" if SOC_SAMD21J18A
```

## soc/atmel/sam0/samd51/Kconfig
```kconfig
# Atmel SAMD51 MCU series

# Copyright (c) 2019 ML!PA Consulting GmbH
# Copyright (c) 2023-2024 Gerson Fernando Budke <nandojve@gmail.com>
# SPDX-License-Identifier: Apache-2.0

config SOC_SERIES_SAMD51
	select ARM
	select CPU_CORTEX_M4
	select CPU_CORTEX_M_HAS_DWT
	select CPU_HAS_ARM_MPU
	select CPU_HAS_FPU
	select PLATFORM_SPECIFIC_INIT
```
