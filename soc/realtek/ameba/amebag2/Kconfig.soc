## soc/realtek/ameba/amebag2/Kconfig.soc
```kconfig
# Copyright (c) 2024 Realtek Semiconductor Corp.
# SPDX-License-Identifier: Apache-2.0

config SOC_SERIES_AMEBAG2
	bool
	select SOC_FAMILY_REALTEK_AMEBA

config SOC_SERIES
	default "amebag2" if SOC_SERIES_AMEBAG2

config SOC_RTL8721F
	bool
	select SOC_SERIES_AMEBAG2

config SOC
	default "rtl8721f" if SOC_RTL8721F
```

## soc/realtek/bee/Kconfig
```kconfig
# Copyright (c) 2026, Realtek Semiconductor Corporation
# SPDX-License-Identifier: Apache-2.0

config SOC_FAMILY_REALTEK_BEE
	select BUILD_OUTPUT_HEX
	select HAS_SEGGER_RTT if ZEPHYR_SEGGER_MODULE

if SOC_FAMILY_REALTEK_BEE

rsource "*/Kconfig"

config SOC_FAMILY_REALTEK_BEE_IMAGE_HEADER
	bool
	default y
	help
	  This config will prepend bee_image_header on the zephyr binary.

endif # SOC_FAMILY_REALTEK_BEE
```

## soc/realtek/bee/Kconfig.defconfig
```kconfig
# Copyright (c) 2026, Realtek Semiconductor Corporation
# SPDX-License-Identifier: Apache-2.0
if SOC_FAMILY_REALTEK_BEE

rsource "*/Kconfig.defconfig.series"

endif
```

## soc/realtek/bee/Kconfig.soc
```kconfig
# Copyright (c) 2026, Realtek Semiconductor Corporation
# SPDX-License-Identifier: Apache-2.0
config SOC_FAMILY_REALTEK_BEE
	bool

config SOC_FAMILY
	default "realtek_bee" if SOC_FAMILY_REALTEK_BEE

rsource "*/Kconfig.soc"
```

## soc/realtek/bee/rtl8752h/Kconfig
```kconfig
# Copyright (c) 2026, Realtek Semiconductor Corporation.
# SPDX-License-Identifier: Apache-2.0

config SOC_SERIES_RTL8752H
	select ARM
	select CPU_CORTEX_M0PLUS
	select CPU_CORTEX_M_HAS_VTOR
	select CPU_CORTEX_M_HAS_SYSTICK
	select CPU_HAS_ARM_MPU
	select CLOCK_CONTROL
	select GEN_ISR_TABLES
	select PINCTRL
	select DYNAMIC_INTERRUPTS
	select THREAD_STACK_INFO
	select SOC_EARLY_RESET_HOOK
	help
	  Enable support for RTL8752H MCU series
```

## soc/realtek/bee/rtl8752h/Kconfig.defconfig.series
```kconfig
# Copyright (c) 2026, Realtek Semiconductor Corporation.
# SPDX-License-Identifier: Apache-2.0

if SOC_SERIES_RTL8752H

config NUM_IRQS
	default 32

config USE_DT_CODE_PARTITION
	default y

config SYS_CLOCK_HW_CYCLES_PER_SEC
	default $(dt_node_int_prop_int,/clocks/clk-32K-systick,clock-frequency)

config SYS_CLOCK_TICKS_PER_SEC
	default 1000

config TIMESLICE_SIZE
	default 10

config ARCH_HAS_CUSTOM_BUSY_WAIT
	default y

if BT

config NUM_METAIRQ_PRIORITIES
	default 1

config MAIN_STACK_SIZE
	default 2048

config BT_BUF_ACL_TX_COUNT
	default 5

config BT_BUF_EVT_RX_COUNT
	default 8

endif # BT

endif # SOC_SERIES_RTL8752H
```

## soc/realtek/bee/rtl8752h/Kconfig.soc
```kconfig
# Copyright (c) 2026, Realtek Semiconductor Corporation.
# SPDX-License-Identifier: Apache-2.0

config SOC_SERIES_RTL8752H
	bool
	select SOC_FAMILY_REALTEK_BEE

config SOC_SERIES
	default "rtl8752h" if SOC_SERIES_RTL8752H

config SOC_RTL8752HJL
	bool
	select SOC_SERIES_RTL8752H

config SOC_RTL8752HMF
	bool
	select SOC_SERIES_RTL8752H

config SOC_RTL8752HKF
	bool
	select SOC_SERIES_RTL8752H

config SOC_RTL8752HJF
	bool
	select SOC_SERIES_RTL8752H

config SOC
	default "rtl8752hjl" if SOC_RTL8752HJL
	default "rtl8752hmf" if SOC_RTL8752HMF
	default "rtl8752hkf" if SOC_RTL8752HKF
	default "rtl8752hjf" if SOC_RTL8752HJF
```

## soc/realtek/bee/rtl87x2g/Kconfig
```kconfig
# Copyright (c) 2026, Realtek Semiconductor Corporation
# SPDX-License-Identifier: Apache-2.0

config SOC_SERIES_RTL87X2G
	select ARM
	select CPU_CORTEX_M55
	select CPU_HAS_ARM_SAU
	select CPU_HAS_FPU
	select CPU_HAS_ARM_MPU
	select CLOCK_CONTROL
	select DYNAMIC_INTERRUPTS
	select ARMV8_M_DSP
	select ARMV8_1_M_MVEI
	select ARMV8_1_M_MVEF
	select ARM_TRUSTZONE_M
	select XIP
	select THREAD_STACK_INFO
	select SOC_EARLY_INIT_HOOK
```

## soc/realtek/bee/rtl87x2g/Kconfig.defconfig.series
```kconfig
# Copyright (c) 2026, Realtek Semiconductor Corporation
# SPDX-License-Identifier: Apache-2.0

if SOC_SERIES_RTL87X2G

config NUM_IRQS
	default 96

config CODE_DATA_RELOCATION
	default y

config USE_DT_CODE_PARTITION
	default y

config SYS_CLOCK_HW_CYCLES_PER_SEC
	default $(dt_node_int_prop_int,/clocks/clk-32K-systick,clock-frequency)

config SYS_CLOCK_TICKS_PER_SEC
	default 1000

config ARCH_HAS_CUSTOM_BUSY_WAIT
	default y

config TIMESLICE_SIZE
	default 10

config INIT_STACKS
	default y

config FPU
	default y if CPU_HAS_FPU

if BT

config NUM_METAIRQ_PRIORITIES
	default 1

config MAIN_STACK_SIZE
	default 2048

config BT_BUF_ACL_TX_COUNT
	default 10

config BT_BUF_EVT_RX_COUNT
	default 16

endif # BT

endif # SOC_SERIES_RTL87X2G
```

## soc/realtek/bee/rtl87x2g/Kconfig.soc
```kconfig
# Copyright (c) 2026, Realtek Semiconductor Corporation
# SPDX-License-Identifier: Apache-2.0

config SOC_SERIES_RTL87X2G
	bool
	select SOC_FAMILY_REALTEK_BEE
	help
	  Enable support for Realtek RTL87x2G series

config SOC_RTL8762GC
	bool
	select SOC_SERIES_RTL87X2G

config SOC_RTL8762GKU
	bool
	select SOC_SERIES_RTL87X2G

config SOC_RTL8762GKH
	bool
	select SOC_SERIES_RTL87X2G

config SOC_RTL8762GRU
	bool
	select SOC_SERIES_RTL87X2G

config SOC_RTL8762GRH
	bool
	select SOC_SERIES_RTL87X2G

config SOC_RTL8762GTP
	bool
	select SOC_SERIES_RTL87X2G

config SOC_RTL8762GTU
	bool
	select SOC_SERIES_RTL87X2G

config SOC_RTL8762GTH
	bool
	select SOC_SERIES_RTL87X2G

config SOC_RTL8772GWF
	bool
	select SOC_SERIES_RTL87X2G

config SOC_RTL8772GWP
	bool
	select SOC_SERIES_RTL87X2G

config SOC_SERIES
	default "rtl87x2g" if SOC_SERIES_RTL87X2G

config SOC
	default "rtl8762gc" if SOC_RTL8762GC
	default "rtl8762gkh" if SOC_RTL8762GKH
	default "rtl8762gku" if SOC_RTL8762GKU
	default "rtl8762grh" if SOC_RTL8762GRH
	default "rtl8762gru" if SOC_RTL8762GRU
	default "rtl8762gth" if SOC_RTL8762GTH
	default "rtl8762gtp" if SOC_RTL8762GTP
	default "rtl8762gtu" if SOC_RTL8762GTU
	default "rtl8772gwf" if SOC_RTL8772GWF
	default "rtl8772gwp" if SOC_RTL8772GWP
```

## soc/realtek/ec/Kconfig
```kconfig
# SPDX-License-Identifier: Apache-2.0
#
# Copyright (c) 2024 Realtek Semiconductor Corporation, SIBG-SD7
#

if SOC_FAMILY_REALTEK_EC

menuconfig REALTEK_RTS5912_BOOTROM_HEADER
	bool "Create BOOTROM header for RTS5912"
	help
	  The RTS5912 BOOTROM needs the information about boot up progress.
	  Invoke the 'rts5912_imgtool' to generates the RTS5912 bootrom header.

if REALTEK_RTS5912_BOOTROM_HEADER

config REALTEK_HEADER_CHIP
	string
	default "RTS5912" if SOC_RTS5912

DT_CHOSEN_Z_FLASH := zephyr,flash
FLASH_BASE := $(dt_chosen_reg_addr_hex,$(DT_CHOSEN_Z_FLASH))

config REALTEK_RTS5912_BOOTROM_HEADER_LOAD_ADDRESS
	string "Set the address for BOOTROM"
	default "$(FLASH_BASE) - 0x20"
	help
	  This address will be used by the RTS5912 BOOTROM to decide where firmware image start.

endif # REALTEK_RTS5912_BOOTROM_HEADER

# Select SoC Part No. and configuration options
rsource "*/Kconfig"

endif # SOC_FAMILY_REALTEK_EC
```

## soc/realtek/ec/Kconfig.defconfig
```kconfig
# SPDX-License-Identifier: Apache-2.0
#
# Copyright (c) 2024 Realtek Semiconductor Corporation, SIBG-SD7
#

if SOC_FAMILY_REALTEK_EC

rsource "*/Kconfig.defconfig.series"

endif # SOC_FAMILY_REALTEK_EC
```

## soc/realtek/ec/Kconfig.soc
```kconfig
# SPDX-License-Identifier: Apache-2.0
#
# Copyright (c) 2024 Realtek Semiconductor Corporation, SIBG-SD7
#

config SOC_FAMILY_REALTEK_EC
	bool

config SOC_FAMILY
	string
	default "realtek_ec" if SOC_FAMILY_REALTEK_EC

rsource "*/Kconfig.soc"
```

## soc/realtek/ec/rts5912/Kconfig
```kconfig
# SPDX-License-Identifier: Apache-2.0
#
# Copyright (c) 2024 Realtek Semiconductor Corporation, SIBG-SD7
#

config SOC_SERIES_RTS5912
	select ARM
	select CPU_CORTEX_M33
	select SYS_CLOCK_EXISTS
	select DYNAMIC_INTERRUPTS
	select SOC_EARLY_INIT_HOOK

if SOC_SERIES_RTS5912

config RTS5912_ON_ENTER_CPU_IDLE_HOOK
	bool "CPU idle hook enable"
	default y
	imply ARM_ON_ENTER_CPU_IDLE_HOOK
	help
	  Enables a hook (z_arm_on_enter_cpu_idle()) that is called when
	  the CPU is made idle (by k_cpu_idle() or k_cpu_atomic_idle()).
	  If needed, this hook can be used to prevent the CPU from actually
	  entering sleep by skipping the WFE/WFI instruction.

endif # SOC_SERIES_RTS5912
```

## soc/realtek/ec/rts5912/Kconfig.defconfig.rts5912
```kconfig
# SPDX-License-Identifier: Apache-2.0
#
# Copyright (c) 2024 Realtek Semiconductor Corporation, SIBG-SD7
#

if SOC_RTS5912

if REALTEK_RTS5912_RTMR

config PM
	default y

config SYS_CLOCK_HW_CYCLES_PER_SEC
	default 32768

config SYS_CLOCK_TICKS_PER_SEC
	default 32768

config ARCH_HAS_CUSTOM_BUSY_WAIT
	default y
	depends on !COUNTER_REALTEK_RTS5912_SLWTMR

endif # REALTEK_RTS5912_RTMR

endif # SOC_RTS5912
```

## soc/realtek/ec/rts5912/Kconfig.defconfig.series
```kconfig
# SPDX-License-Identifier: Apache-2.0
#
# Copyright (c) 2024 Realtek Semiconductor Corporation, SIBG-SD7
#

if SOC_SERIES_RTS5912

config NUM_IRQS
	default 240

rsource "Kconfig.defconfig.rts5912"

endif # SOC_SERIES_RTS5912
```

## soc/realtek/ec/rts5912/Kconfig.soc
```kconfig
# SPDX-License-Identifier: Apache-2.0
#
# Copyright (c) 2024 Realtek Semiconductor Corporation, SIBG-SD7
#

config SOC_SERIES_RTS5912
	bool
	select SOC_FAMILY_REALTEK_EC
	help
	  Enable support for REALTEK EC MCU series

config SOC_SERIES
	default "rts5912" if SOC_SERIES_RTS5912

config SOC_RTS5912
	bool
	select SOC_SERIES_RTS5912

config SOC_SERIES_RTS5915
	bool
	help
	  The Token for the RTS5915. There are no driver or software changes needed.

config SOC_RTS5915
	bool
	select SOC_SERIES_RTS5915
	select SOC_SERIES_RTS5912
	select SOC_RTS5912
	help
	  The RTS5915 is a repackage of the RTS5912. There are no driver or software
	  changes needed.

config SOC
	default "rts5912" if SOC_RTS5912
	default "rts5915" if SOC_RTS5915
```

## soc/realtek/fingerprint/Kconfig
```kconfig
# Copyright (c) 2024 Realtek Semiconductor, Inc.
# SPDX-License-Identifier: Apache-2.0

if SOC_FAMILY_FINGERPRINT

rsource "*/Kconfig"

endif # SOC_FAMILY_FINGERPRINT
```

## soc/realtek/fingerprint/Kconfig.defconfig
```kconfig
# Copyright (c) 2025 Realtek Semiconductor, Inc.
# SPDX-License-Identifier: Apache-2.0

if SOC_FAMILY_REALTEK_FINGERPRINT

rsource "*/Kconfig.defconfig"

endif # SOC_FAMILY_REALTEK_FINGERPRINT
```

## soc/realtek/fingerprint/Kconfig.soc
```kconfig
# Copyright (c) 2025 Realtek Semiconductor, Inc.
# SPDX-License-Identifier: Apache-2.0

config SOC_FAMILY_REALTEK_FINGERPRINT
	bool

config SOC_FAMILY
	default "realtek_fingerprint" if SOC_FAMILY_REALTEK_FINGERPRINT

rsource "*/Kconfig.soc"
```

## soc/realtek/fingerprint/rts5817/Kconfig.defconfig
```kconfig
# Copyright (c) 2025 Realtek Semiconductor, Inc.
# SPDX-License-Identifier: Apache-2.0

if SOC_RTS5817

config SYS_CLOCK_HW_CYCLES_PER_SEC
	default $(dt_node_int_prop_int,/cpus/cpu@0,clock-frequency)

config NUM_IRQS
	default 32

endif # SOC_RTS5817
```

## soc/realtek/fingerprint/rts5817/Kconfig.soc
```kconfig
# Copyright (c) 2025 Realtek Semiconductor, Inc.
# SPDX-License-Identifier: Apache-2.0

config SOC_RTS5817
	bool
	select SOC_FAMILY_REALTEK_FINGERPRINT

config SOC
	default "rts5817" if SOC_RTS5817
```

## soc/renesas/ra/Kconfig
```kconfig
# Copyright (c) 2023 TOKITA Hiroshi <tokita.hiroshi@fujitsu.com>
# SPDX-License-Identifier: Apache-2.0

config SOC_FAMILY_RENESAS_RA
	select HAS_SEGGER_RTT if ZEPHYR_SEGGER_MODULE

if SOC_FAMILY_RENESAS_RA

config SERIES_SPECIFIC_SOC_INIT
	bool "Use series specific initialize"

config OUTPUT_RPD
	bool "Build a Renesas Partition Data in rpd format"
	depends on CPU_HAS_RENESAS_RA_IDAU
	help
	  Build a partition data zephyr/zephyr.rpd in the build directory.
	  The name of this file can be customized with CONFIG_KERNEL_BIN_NAME.

config CPU_HAS_RENESAS_RA_IDAU
	bool
	select CPU_HAS_TEE
	help
	  MCU implements the ARM Implementation-Defined Attribution Unit (IDAU).

rsource "*/Kconfig"

config SOC_RA_ENABLE_START_SECOND_CORE
	bool "Allows the primary core to start the secondary core"
	depends on (SOC_SERIES_RA8P1 && CPU_CORTEX_M85)
	select SOC_LATE_INIT_HOOK
	help
	  Indicates the second core will be start in the soc_late_init_hook when enabled

config SOC_RA_SECOND_CORE_BUILD
	bool "Indicates the image is built for the secondary core"
	help
	  Indicates the image is built for the secondary core when enabled

config SOC_RA_SKIP_CLOCK_INIT
	bool "Skip clock frequency configuration in system initialization"
	depends on SOC_RA_SECOND_CORE_BUILD
	default y
	help
	  With this option, the CPU clock frequency is not set during system
	  initialization.

endif # SOC_FAMILY_RENESAS_RA
```

## soc/renesas/ra/Kconfig.defconfig
```kconfig
# Copyright (c) 2023 TOKITA Hiroshi <tokita.hiroshi@fujitsu.com>
# SPDX-License-Identifier: Apache-2.0

if SOC_FAMILY_RENESAS_RA

rsource "*/Kconfig.defconfig"

endif # SOC_FAMILY_RENESAS_RA
```

## soc/renesas/ra/Kconfig.soc
```kconfig
# Copyright (c) 2023 TOKITA Hiroshi <tokita.hiroshi@fujitsu.com>
# SPDX-License-Identifier: Apache-2.0

config SOC_FAMILY_RENESAS_RA
	bool

config SOC_FAMILY
	default "renesas_ra" if SOC_FAMILY_RENESAS_RA

rsource "*/Kconfig.soc"
```
