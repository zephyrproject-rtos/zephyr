## soc/litex/litex_vexriscv/Kconfig.soc
```kconfig
# SPDX-FileCopyrightText: Copyright The Zephyr Project Contributors
# SPDX-License-Identifier: Apache-2.0

config SOC_SERIES
	default "litex_vexriscv" if SOC_SERIES_LITEX_VEXRISCV

config SOC_SERIES_LITEX_VEXRISCV
	bool
	select SOC_FAMILY_LITEX

config SOC_LITEX_VEXRISCV
	bool
	select SOC_SERIES_LITEX_VEXRISCV

config SOC
	default "litex_vexriscv" if SOC_LITEX_VEXRISCV
```

## soc/lowrisc/opentitan/Kconfig
```kconfig
# Copyright (c) 2023 Rivos Inc.
# SPDX-License-Identifier: Apache-2.0

config SOC_OPENTITAN
	select ATOMIC_OPERATIONS_C
	select INCLUDE_RESET_VECTOR
	select RISCV
	select RISCV_PRIVILEGED
	select RISCV_HAS_PLIC
	select RISCV_SOC_HAS_GP_RELATIVE_ADDRESSING
	# OpenTitan Ibex core mtvec mode is read-only / forced to vectored mode.
	select RISCV_VECTORED_MODE
	select GEN_IRQ_VECTOR_TABLE
	imply XIP
	select SOC_EARLY_INIT_HOOK
```

## soc/lowrisc/opentitan/Kconfig.defconfig
```kconfig
# Copyright (c) 2023 Rivos Inc.
# SPDX-License-Identifier: Apache-2.0

if SOC_OPENTITAN

config SYS_CLOCK_HW_CYCLES_PER_SEC
	default 1000000

config RISCV_SOC_INTERRUPT_INIT
	default y

config 2ND_LVL_ISR_TBL_OFFSET
	default 32

config 2ND_LVL_INTR_00_OFFSET
	default 11

config NUM_IRQS
	default 256

# The OpenTitan SoC requires a manifest in front of the
# application binary.
config ROM_START_OFFSET
	default 0x400

endif # SOC_OPENTITAN
```

## soc/lowrisc/opentitan/Kconfig.soc
```kconfig
# Copyright (c) 2023 Rivos Inc.
# SPDX-License-Identifier: Apache-2.0

config SOC_OPENTITAN
	bool

config SOC
	default "opentitan" if SOC_OPENTITAN
```

## soc/mediatek/mt8xxx/mt8186/Kconfig.defconfig
```kconfig
# Copyright 2024 The ChromiumOS Authors
# SPDX-License-Identifier: Apache-2.0

if SOC_MT8186

# FIXME: move this to 818x series code to share w/8188
config NUM_2ND_LEVEL_AGGREGATORS
	default 1

config 2ND_LVL_INTR_00_OFFSET
	default 2

endif
```

## soc/mediatek/mtk_adsp/Kconfig
```kconfig
# Copyright 2024 The ChromiumOS Authors
# SPDX-License-Identifier: Apache-2.0

config SOC_FAMILY_MTK_ADSP
	select XTENSA
	select XTENSA_GEN_HANDLERS
```

## soc/mediatek/mtk_adsp/Kconfig.defconfig
```kconfig
# Copyright 2023 The ChromiumOS Authors
# SPDX-License-Identifier: Apache-2.0

orsource "*/Kconfig.defconfig"

if SOC_FAMILY_MTK_ADSP

config SOC_FAMILY
	default "mtk_adsp"

config INTC_MTK_ADSP
	default y

config XTENSA_SMALL_VECTOR_TABLE_ENTRY
	default y

config XTENSA_USE_CORE_CRT1
	default n

config MULTI_LEVEL_INTERRUPTS
	default y
config 2ND_LEVEL_INTERRUPTS
	default y
config MAX_IRQ_PER_AGGREGATOR
	default 32
config 2ND_LVL_ISR_TBL_OFFSET
	default 32

config MTK_ADSP_TIMER
	default y
config XTENSA_TIMER
	default n

config MAIN_STACK_SIZE
	default 2048

# This platform has a single big DRAM region where most linkage
# happens.  The libc heap normally wants to steal all of it, when in
# fact SOF has its own heap.  Just leave a little for stray malloc()
# calls to find.
config COMMON_LIBC_MALLOC_ARENA_SIZE
	default 32768

# Don't build the HAL if the toolchain already includes it.  Note that
# this is done in the SOC layer historically, really this belongs in
# arch/xtensa or the toolchain integration.
#
config XTENSA_HAL
	default n if "$(ZEPHYR_TOOLCHAIN_VARIANT)" = "xcc"
	default n if "$(ZEPHYR_TOOLCHAIN_VARIANT)" = "xt-clang"
	default y

config SOC_TOOLCHAIN_NAME
	default "mtk_mt8195_adsp"

config XTENSA_RESET_VECTOR
	default n

# This single-core device doesn't have S32C1I and so has no built-in
# atomics.  Note we must disable _ARCH explicitly because
# CONFIG_XTENSA turns it on (due to an xcc lack of gcc builtins?)
#
config ATOMIC_OPERATIONS_C
	default y
config ATOMIC_OPERATIONS_ARCH
	default n

config GEN_ISR_TABLES
	default y
config GEN_SW_ISR_TABLE
	default y
config GEN_IRQ_VECTOR_TABLE
	default n

endif # SOC_FAMILY_MTK_ADSP
```

## soc/mediatek/mtk_adsp/Kconfig.soc
```kconfig
# Copyright 2024 The ChromiumOS Authors
# SPDX-License-Identifier: Apache-2.0

config SOC_MT8195_ADSP
	bool

config SOC
	default "mt8195_adsp" if SOC_MT8195_ADSP
```

## soc/mediatek/mtk_adsp/mt8195_adsp/Kconfig.defconfig
```kconfig
# Copyright 2023 The ChromiumOS Authors
# SPDX-License-Identifier: Apache-2.0

if SOC_SERIES_MT8195_ADSP

config NUM_2ND_LEVEL_AGGREGATORS
	default 2
config 2ND_LVL_INTR_00_OFFSET
	default 1
config 2ND_LVL_INTR_01_OFFSET
	default 23

endif # SOC_SERIES_MT8195_ADSP
```

## soc/microblaze/microblaze_demo/Kconfig
```kconfig
# Copyright (c) 2023 Advanced Micro Devices, Inc. (AMD)
# Copyright (c) 2023 Alp Sayin <alpsayin@gmail.com>
# SPDX-License-Identifier: Apache-2.0


config SOC_XLNX_MICROBLAZE_DEMO
	select MICROBLAZE
	select XLNX_INTC
	select XLNX_TMRCTR
```

## soc/microblaze/microblaze_demo/Kconfig.defconfig
```kconfig
# Copyright (c) 2023 Advanced Micro Devices, Inc. (AMD)
# Copyright (c) 2023 Alp Sayin <alpsayin@gmail.com>
# SPDX-License-Identifier: Apache-2.0


if SOC_XLNX_MICROBLAZE_DEMO

config SYS_CLOCK_HW_CYCLES_PER_SEC
	default 200000000

config SYS_CLOCK_TICKS_PER_SEC
	default 100

config NUM_IRQS
	default 32

endif # SOC_XLNX_MICROBLAZE_DEMO
```

## soc/microblaze/microblaze_demo/Kconfig.soc
```kconfig
# Copyright (c) 2023 Advanced Micro Devices, Inc. (AMD)
# Copyright (c) 2023 Alp Sayin <alpsayin@gmail.com>
# SPDX-License-Identifier: Apache-2.0


config SOC_XLNX_MICROBLAZE_DEMO
	bool

config SOC
	default "microblaze_demo" if SOC_XLNX_MICROBLAZE_DEMO
```

## soc/microchip/Kconfig.soc
```kconfig
# Copyright (c) 2024 Microchip

# SPDX-License-Identifier: Apache-2.0

config SOC_FAMILY_MICROCHIP_PIC32CXSG
	bool

config SOC_FAMILY
	default "microchip_pic32cxsg" if SOC_FAMILY_MICROCHIP_PIC32CXSG

config SOC_SERIES_REVISION_N
	bool
	depends on SOC_FAMILY_MICROCHIP_PIC32CXSG

config SOC_SERIES_REVISION
	string
	default "n" if SOC_SERIES_REVISION_N
	default ""
	depends on SOC_FAMILY_MICROCHIP_PIC32CXSG

rsource "*/Kconfig.soc"
```

## soc/microchip/dspic33/Kconfig.defconfig
```kconfig
# Copyright (c) 2025, Microchip Technology Inc.
# SPDX-License-Identifier: Apache-2.0

if SOC_FAMILY_MICROCHIP_DSPIC33
	rsource "*/Kconfig.defconfig.series"
endif # SOC_FAMILY_MICROCHIP_DSPIC33
```

## soc/microchip/dspic33/Kconfig.soc
```kconfig
# Copyright (c) 2025, Microchip Technology Inc.
# SPDX-License-Identifier: Apache-2.0

config SOC_FAMILY_MICROCHIP_DSPIC33
	bool

config BUILD_OUTPUT_HEX
	bool
	default y

config SOC_FAMILY
	default "microchip_dspic33" if SOC_FAMILY_MICROCHIP_DSPIC33

rsource "*/Kconfig.soc"
```

## soc/microchip/dspic33/dspic33a/Kconfig
```kconfig
# Copyright (c) 2025, Microchip Technology Inc.
# SPDX-License-Identifier: Apache-2.0

config SOC_SERIES_DSPIC33A
	select DSPIC
	select CPU_HAS_FPU
	select CPU_HAS_DSP
	select FPU
	select GEN_ISR_TABLES
	select GEN_IRQ_VECTOR_TABLE
	select GEN_SW_ISR_TABLE
	select HAS_PM
```

## soc/microchip/dspic33/dspic33a/Kconfig.defconfig.p33ak128mc106
```kconfig
# Copyright (c) 2025, Microchip Technology Inc.
# SPDX-License-Identifier: Apache-2.0

if SOC_P33AK128MC106

config SRAM_SIZE
	default $(dt_chosen_reg_size_int,$(DT_CHOSEN_Z_SRAM),0,K)

config SRAM_BASE_ADDRESS
	default $(dt_chosen_reg_addr_hex,$(DT_CHOSEN_Z_SRAM))

config FLASH_SIZE
	default $(dt_chosen_reg_size_int,$(DT_CHOSEN_Z_FLASH),0,K)

config FLASH_BASE_ADDRESS
	default $(dt_chosen_reg_addr_hex,$(DT_CHOSEN_Z_FLASH))

config SYS_CLOCK_HW_CYCLES_PER_SEC
	default $(dt_node_int_prop_int,/cpus/cpu@0,clock-frequency)

config SYS_CLOCK_TICKS_PER_SEC
	default 10000

config MAIN_STACK_SIZE
	default 2048 if NO_OPTIMIZATIONS
	default 1024

config NUM_IRQS
	default 279

config IDLE_STACK_SIZE
	default 1024 if NO_OPTIMIZATIONS
	default 512

endif # SOC_P33AK128MC106
```

## soc/microchip/dspic33/dspic33a/Kconfig.defconfig.p33ak512mps512
```kconfig
# Copyright (c) 2025, Microchip Technology Inc.
# SPDX-License-Identifier: Apache-2.0

if SOC_P33AK512MPS512

config SRAM_SIZE
	default $(dt_chosen_reg_size_int,$(DT_CHOSEN_Z_SRAM),0,K)

config SRAM_BASE_ADDRESS
	default $(dt_chosen_reg_addr_hex,$(DT_CHOSEN_Z_SRAM))

config FLASH_SIZE
	default $(dt_chosen_reg_size_int,$(DT_CHOSEN_Z_FLASH),0,K)

config FLASH_BASE_ADDRESS
	default $(dt_chosen_reg_addr_hex,$(DT_CHOSEN_Z_FLASH))

config MAIN_STACK_SIZE
	default 1024

config IDLE_STACK_SIZE
	default 512

config NUM_IRQS
	default 355
	
config MINIMAL_LIBC_SUPPORTED
	bool
	default n

config NEWLIB_LIBC_SUPPORTED
	bool
	default n

config SPIN_VALIDATE
	bool
	default n

# Picolibc with C++ support in Zephyr SDK is handled by Zephyr SDK's own Kconfig.
config PICOLIBC_SUPPORTED
	bool
	default n

endif # SOC_P33AK512MPS512
```

## soc/microchip/dspic33/dspic33a/Kconfig.defconfig.series
```kconfig
if SOC_SERIES_DSPIC33A
	rsource "Kconfig.defconfig.p33ak*"
endif # SOC_SERIES_DSPIC33A
```

## soc/microchip/dspic33/dspic33a/Kconfig.soc
```kconfig
# Copyright (c) 2025, Microchip Technology Inc.
# SPDX-License-Identifier: Apache-2.0

config SOC_SERIES_DSPIC33A
	bool

select SOC_FAMILY_MICROCHIP_DSPIC33
	help
	Enable support for Microchip DSPIC33 DSC series

config SOC_SERIES
	default "dspic33a" if SOC_SERIES_DSPIC33A

config SOC_P33AK128MC106
	bool
	select SOC_SERIES_DSPIC33A

config SOC_P33AK256MC506
	bool
	select SOC_SERIES_DSPIC33A

config SOC
	default "p33ak128mc106" if SOC_P33AK128MC106
	default "p33ak256mc506" if SOC_P33AK256MC506
```

## soc/microchip/mec/Kconfig
```kconfig
# Microchip MEC MCU line

# Copyright (c) 2018, Intel Corporation
# Copyright (c) 2022, Microchip Technology Inc.
# SPDX-License-Identifier: Apache-2.0

if SOC_FAMILY_MICROCHIP_MEC

menuconfig MCHP_MEC_UNSIGNED_HEADER
	bool "Create an unsigned output binary with MCHP MEC binary header"
	help
	  On Microchip MEC series chip, the ROM code loads firmware image from flash
	  to RAM using a TAG to locate a Header which specifies the location and
	  size of the firmware image. Enable this to invoke the mec_spi_gen tool
	  which generates an SPI image with TAG, Header, and firmware binary. This
	  tool does not produce a signed image which can be authenticated by the
	  Boot-ROM. Use the full Microchip SPI image generator program for
	  authentication and all other Boot-ROM loader features. Refer to the MCHP
	  EVB boards for an example.

if MCHP_MEC_UNSIGNED_HEADER

config MCHP_MEC_HEADER_CHIP
	string
	default "mec15xx" if SOC_SERIES_MEC15XX
	default "mec172x" if SOC_SERIES_MEC172X

choice MCHP_MEC_HEADER_SPI_FREQ_MHZ_CHOICE
	prompt "Clock rate to use for SPI flash"
	default MCHP_MEC_HEADER_SPI_FREQ_MHZ_12
	help
	  This selects the SPI clock frequency that will be used for loading
	  firmware binary from flash to RAM.

config MCHP_MEC_HEADER_SPI_FREQ_MHZ_12
	bool "SPI flash clock rate of 12 MHz"

config MCHP_MEC_HEADER_SPI_FREQ_MHZ_16
	bool "SPI flash clock rate of 16 MHz"

config MCHP_MEC_HEADER_SPI_FREQ_MHZ_24
	bool "SPI flash clock rate of 24 MHz"

config MCHP_MEC_HEADER_SPI_FREQ_MHZ_48
	bool "SPI flash clock rate of 48 MHz"

endchoice

config MCHP_MEC_HEADER_SPI_FREQ_MHZ
	int
	default 12 if MCHP_MEC_HEADER_SPI_FREQ_MHZ_12
	default 25 if MCHP_MEC_HEADER_SPI_FREQ_MHZ_16
	default 24 if MCHP_MEC_HEADER_SPI_FREQ_MHZ_24
	default 48 if MCHP_MEC_HEADER_SPI_FREQ_MHZ_48

choice MCHP_MEC_HEADER_SPI_READ_MODE_CHOICE
	prompt "Reading mode used by the SPI flash"
	default MCHP_MEC_HEADER_SPI_READ_MODE_FAST
	help
	  This sets the reading mode that can be used by the SPI flash.
	  Reading modes supported are normal, fast, dual, and quad.

config MCHP_MEC_HEADER_SPI_READ_MODE_NORMAL
	bool "SPI flash operates full-duplex with frequency (< 25 MHz)"

config MCHP_MEC_HEADER_SPI_READ_MODE_FAST
	bool "SPI flash operates full-duplex with fast reading mode"

config MCHP_MEC_HEADER_SPI_READ_MODE_DUAL
	bool "SPI flash operates with dual data reading mode"

config MCHP_MEC_HEADER_SPI_READ_MODE_QUAD
	bool "SPI flash operates with quad data reading mode"

endchoice

config MCHP_MEC_HEADER_SPI_READ_MODE
	string
	default "slow" if MCHP_MEC_HEADER_SPI_READ_MODE_NORMAL
	default "fast" if MCHP_MEC_HEADER_SPI_READ_MODE_FAST
	default "dual" if MCHP_MEC_HEADER_SPI_READ_MODE_DUAL
	default "quad" if MCHP_MEC_HEADER_SPI_READ_MODE_QUAD

choice MCHP_MEC_HEADER_FLASH_SIZE_CHOICE
	prompt "Flash size"
	default MCHP_MEC_HEADER_FLASH_SIZE_16M
	help
	  This sets the SPI flash size.

config MCHP_MEC_HEADER_FLASH_SIZE_256K
	bool "SPI flash size 256K Bytes"
	help
	  The SPI flash size is 256K Bytes.

config MCHP_MEC_HEADER_FLASH_SIZE_512K
	bool "SPI flash size 512K Bytes"
	help
	  The SPI flash size is 512K Bytes.

config MCHP_MEC_HEADER_FLASH_SIZE_1M
	bool "SPI flash size 1M Bytes"
	help
	  The SPI flash size is 1M Bytes.

config MCHP_MEC_HEADER_FLASH_SIZE_2M
	bool "SPI flash size 2M Bytes"
	help
	  The SPI flash size is 2M Bytes.

config MCHP_MEC_HEADER_FLASH_SIZE_4M
	bool "SPI flash size 4M Bytes"
	help
	  The SPI flash size is 4M Bytes.

config MCHP_MEC_HEADER_FLASH_SIZE_8M
	bool "SPI flash size 8M Bytes"
	help
	  The SPI flash size is 8M Bytes.

config MCHP_MEC_HEADER_FLASH_SIZE_16M
	bool "SPI flash size 16M Bytes"
	help
	  The SPI flash size is 16M Bytes.

endchoice

config MCHP_MEC_HEADER_FLASH_SIZE
	int
	default 256 if MCHP_MEC_HEADER_FLASH_SIZE_256K
	default 512 if MCHP_MEC_HEADER_FLASH_SIZE_512K
	default 1024 if MCHP_MEC_HEADER_FLASH_SIZE_1M
	default 2048 if MCHP_MEC_HEADER_FLASH_SIZE_2M
	default 4096 if MCHP_MEC_HEADER_FLASH_SIZE_4M
	default 8192 if MCHP_MEC_HEADER_FLASH_SIZE_8M
	default 16384 if MCHP_MEC_HEADER_FLASH_SIZE_16M

choice MCHP_MEC_HEADER_SPI_DRVSTR_CHOICE
	prompt "Flash drive strength"
	default MCHP_MEC_HEADER_SPI_DRVSTR_1X
	help
	  This sets the SPI flash size.

config MCHP_MEC_HEADER_SPI_DRVSTR_1X
	bool "SPI flash drive strength multiplier 1"
	help
	  The SPI flash size is 256K Bytes.

config MCHP_MEC_HEADER_SPI_DRVSTR_2X
	bool "SPI flash drive strength multiplier 2"
	help
	  The SPI flash size is 256K Bytes.

config MCHP_MEC_HEADER_SPI_DRVSTR_4X
	bool "SPI flash drive strength multiplier 4"
	help
	  The SPI flash size is 512K Bytes.

config MCHP_MEC_HEADER_SPI_DRVSTR_6X
	bool "SPI flash drive strength multiplier 6"
	help
	  The SPI flash size is 1M Bytes.

endchoice

config MCHP_MEC_HEADER_SPI_DRVSTR
	string
	default "1x" if MCHP_MEC_HEADER_SPI_DRVSTR_1X
	default "2x" if MCHP_MEC_HEADER_SPI_DRVSTR_2X
	default "4x" if MCHP_MEC_HEADER_SPI_DRVSTR_4X
	default "6x" if MCHP_MEC_HEADER_SPI_DRVSTR_6X

choice MCHP_MEC_HEADER_SPI_SLEW_RATE_CHOICE
	prompt "Slew rate of SPI pins"
	default MCHP_MEC_HEADER_SPI_SLEW_RATE_SLOW
	help
	  This sets the slew rate of the SPI pins. Default is slow
	  slew rate which is 1/2 the AHB clock rate. Fast slew is the
	  AHB clock rate.

config MCHP_MEC_HEADER_SPI_SLEW_RATE_SLOW
	bool "SPI pins slew rate is 1/2 AHB frequency"

config MCHP_MEC_HEADER_SPI_SLEW_RATE_FAST
	bool "SPI pins slew rate is 1x AHB frequency"

endchoice

config MCHP_MEC_HEADER_SPI_SLEW_RATE
	string
	default "slow" if MCHP_MEC_HEADER_SPI_SLEW_RATE_SLOW
	default "fast" if MCHP_MEC_HEADER_SPI_SLEW_RATE_FAST

config MCHP_MEC_HEADER_FLASH_SPI_MODE
	int "Flash SPI Mode"
	range 0 7
	default 0
	help
	  This three bit value corresponds to the QMSPI controllers clock idle and
	  input/output data phases. Bits[0:2] are CPOL:CPHA_MOSI:CPHA_MISO. Refer
	  to the data sheet. Default value is 0 corresponding to SPI Mode 0
	  signalling.
	  Setting this field to 0 selects mode 0, CPOL=0, CPHA_MOSI=0, CPHA_MISO=0
	  Setting this filed to 7 selects mode 3, CPOL=1, CPHA_MOSI=1, CPHA_MISO=1

config MCHP_HEADER_VERBOSE_OUTPUT
	bool "Debug console output"
	default n
	help
	  Enable print output from SPI generator script for debug

endif # MCHP_MEC_UNSIGNED_HEADER

config SOC_MEC_PROC_CLK_DIV
	int "PROC_CLK_DIV"
	default 1
	range 1 48
	help
	  This divisor defines a ratio between processor clock (HCLK)
	  and main 96 MHz clock (MCK):
	  HCLK = MCK / PROC_CLK_DIV
	  Allowed divider values: 1, 3, 4, 16, and 48.

# Select SoC Part No. and configuration options
rsource "*/Kconfig"

endif # SOC_FAMILY_MICROCHIP_MEC
```
