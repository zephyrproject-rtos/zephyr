## soc/infineon/cat1b/psc3/Kconfig.soc
```kconfig
# SPDX-FileCopyrightText: Copyright (c) 2026 Infineon Technologies AG,
# SPDX-FileCopyrightText: or an affiliate of Infineon Technologies AG. All rights reserved.
#
# SPDX-License-Identifier: Apache-2.0
#
# Licensed under the Apache License, Version 2.0 (the "License");
# you may not use this file except in compliance with the License.
# You may obtain a copy of the License at
#
#     http://www.apache.org/licenses/LICENSE-2.0
#
# Unless required by applicable law or agreed to in writing, software
# distributed under the License is distributed on an "AS IS" BASIS,
# WITHOUT WARRANTIES OR CONDITIONS OF ANY KIND, either express or implied.
# See the License for the specific language governing permissions and
# limitations under the License.

# Infineon PSC3 series MCUs
config SOC_SERIES_PSC3
	bool

config SOC_SERIES
	default "psc3" if SOC_SERIES_PSC3

config SOC_DIE_PSC3M5
	bool
	select SOC_FAMILY_INFINEON_CAT1B

config SOC_DIE_PSC3P5
	bool
	select SOC_FAMILY_INFINEON_CAT1B

config SOC_DIE_PSC3P2
	bool
	select SOC_FAMILY_INFINEON_CAT1B

config SOC_DIE_PSC3M3
	bool
	select SOC_FAMILY_INFINEON_CAT1B

config SOC_DIE_PSC3M6
	bool
	select SOC_FAMILY_INFINEON_CAT1B

# SOC Packages for Infineon PSC3 series MCUs
config SOC_PACKAGE_PSC3_E_LQFP_80
	bool

config SOC_PACKAGE_PSC3_E_LQFP_64
	bool

config SOC_PACKAGE_PSC3_VQFN_64
	bool

config SOC_PACKAGE_PSC3_VQFN_48
	bool

config SOC_PACKAGE_PSC3_E_LQFP_48
	bool

config SOC_PACKAGE_PSC3_E_LQFP_100
	bool

# Infineon PSC3 series MPNs
config SOC_PSC3M5FDS2AFQ1
	bool
	select SOC_PACKAGE_PSC3_E_LQFP_80
	select SOC_SERIES_PSC3
	select SOC_DIE_PSC3M5

config SOC_PSC3M5FDS2LGQ1
	bool
	select SOC_PACKAGE_PSC3_VQFN_48
	select SOC_SERIES_PSC3
	select SOC_DIE_PSC3M5

config SOC_PSC3M5FDS2ACQ1
	bool
	select SOC_PACKAGE_PSC3_E_LQFP_64
	select SOC_SERIES_PSC3
	select SOC_DIE_PSC3M5

config SOC_PSC3M5FDS2LHQ1
	bool
	select SOC_PACKAGE_PSC3_VQFN_64
	select SOC_SERIES_PSC3
	select SOC_DIE_PSC3M5

config SOC_PSC3M5FDS2ABQ1
	bool
	select SOC_PACKAGE_PSC3_E_LQFP_48
	select SOC_SERIES_PSC3
	select SOC_DIE_PSC3M5

config SOC_PSC3M5EDAFQ1
	bool
	select SOC_PACKAGE_PSC3_E_LQFP_80
	select SOC_SERIES_PSC3
	select SOC_DIE_PSC3M5

config SOC_PSC3M5EDLGQ1
	bool
	select SOC_PACKAGE_PSC3_VQFN_48
	select SOC_SERIES_PSC3
	select SOC_DIE_PSC3M5

config SOC_PSC3M5EDACQ1
	bool
	select SOC_PACKAGE_PSC3_E_LQFP_64
	select SOC_SERIES_PSC3
	select SOC_DIE_PSC3M5

config SOC_PSC3M5EDLHQ1
	bool
	select SOC_PACKAGE_PSC3_VQFN_64
	select SOC_SERIES_PSC3
	select SOC_DIE_PSC3M5

config SOC_PSC3M5EDABQ1
	bool
	select SOC_PACKAGE_PSC3_E_LQFP_48
	select SOC_SERIES_PSC3
	select SOC_DIE_PSC3M5

config SOC_PSC3P5EDLGQ1
	bool
	select SOC_PACKAGE_PSC3_VQFN_48
	select SOC_SERIES_PSC3
	select SOC_DIE_PSC3P5

config SOC_PSC3P5FDS2LGQ1
	bool
	select SOC_PACKAGE_PSC3_VQFN_48
	select SOC_SERIES_PSC3
	select SOC_DIE_PSC3P5

config SOC_PSC3P5EDACQ1
	bool
	select SOC_PACKAGE_PSC3_E_LQFP_64
	select SOC_SERIES_PSC3
	select SOC_DIE_PSC3P5

config SOC_PSC3P5FDS2ACQ1
	bool
	select SOC_PACKAGE_PSC3_E_LQFP_64
	select SOC_SERIES_PSC3
	select SOC_DIE_PSC3P5

config SOC_PSC3P5EDLHQ1
	bool
	select SOC_PACKAGE_PSC3_VQFN_64
	select SOC_SERIES_PSC3
	select SOC_DIE_PSC3P5

config SOC_PSC3P5FDS2LHQ1
	bool
	select SOC_PACKAGE_PSC3_VQFN_64
	select SOC_SERIES_PSC3
	select SOC_DIE_PSC3P5

config SOC_PSC3P5EDABQ1
	bool
	select SOC_PACKAGE_PSC3_E_LQFP_48
	select SOC_SERIES_PSC3
	select SOC_DIE_PSC3P5

config SOC_PSC3P5FDS2ABQ1
	bool
	select SOC_PACKAGE_PSC3_E_LQFP_48
	select SOC_SERIES_PSC3
	select SOC_DIE_PSC3P5

config SOC_PSC3P2EDLGQ1
	bool
	select SOC_PACKAGE_PSC3_VQFN_48
	select SOC_SERIES_PSC3
	select SOC_DIE_PSC3P2

config SOC_PSC3P2FDS2LGQ1
	bool
	select SOC_PACKAGE_PSC3_VQFN_48
	select SOC_SERIES_PSC3
	select SOC_DIE_PSC3P2

config SOC_PSC3M3EDLGQ1
	bool
	select SOC_PACKAGE_PSC3_VQFN_48
	select SOC_SERIES_PSC3
	select SOC_DIE_PSC3M3

config SOC_PSC3M3FDS2LGQ1
	bool
	select SOC_PACKAGE_PSC3_VQFN_48
	select SOC_SERIES_PSC3
	select SOC_DIE_PSC3M3

config SOC_PSC3P2EDACQ1
	bool
	select SOC_PACKAGE_PSC3_E_LQFP_64
	select SOC_SERIES_PSC3
	select SOC_DIE_PSC3P2

config SOC_PSC3P2FDS2ACQ1
	bool
	select SOC_PACKAGE_PSC3_E_LQFP_64
	select SOC_SERIES_PSC3
	select SOC_DIE_PSC3P2

config SOC_PSC3M3EDACQ1
	bool
	select SOC_PACKAGE_PSC3_E_LQFP_64
	select SOC_SERIES_PSC3
	select SOC_DIE_PSC3M3

config SOC_PSC3M3FDS2ACQ1
	bool
	select SOC_PACKAGE_PSC3_E_LQFP_64
	select SOC_SERIES_PSC3
	select SOC_DIE_PSC3M3

config SOC_PSC3P2EDLHQ1
	bool
	select SOC_PACKAGE_PSC3_VQFN_64
	select SOC_SERIES_PSC3
	select SOC_DIE_PSC3P2

config SOC_PSC3P2FDS2LHQ1
	bool
	select SOC_PACKAGE_PSC3_VQFN_64
	select SOC_SERIES_PSC3
	select SOC_DIE_PSC3P2

config SOC_PSC3M3EDLHQ1
	bool
	select SOC_PACKAGE_PSC3_VQFN_64
	select SOC_SERIES_PSC3
	select SOC_DIE_PSC3M3

config SOC_PSC3M3FDS2LHQ1
	bool
	select SOC_PACKAGE_PSC3_VQFN_64
	select SOC_SERIES_PSC3
	select SOC_DIE_PSC3M3

config SOC_PSC3P2EDABQ1
	bool
	select SOC_PACKAGE_PSC3_E_LQFP_48
	select SOC_SERIES_PSC3
	select SOC_DIE_PSC3P2

config SOC_PSC3P2FDS2ABQ1
	bool
	select SOC_PACKAGE_PSC3_E_LQFP_48
	select SOC_SERIES_PSC3
	select SOC_DIE_PSC3P2

config SOC_PSC3M3EDABQ1
	bool
	select SOC_PACKAGE_PSC3_E_LQFP_48
	select SOC_SERIES_PSC3
	select SOC_DIE_PSC3M3

config SOC_PSC3M3FDS2ABQ1
	bool
	select SOC_PACKAGE_PSC3_E_LQFP_48
	select SOC_SERIES_PSC3
	select SOC_DIE_PSC3M3

config SOC_PSC3M6GES3AHQ1
	bool
	select SOC_PACKAGE_PSC3_E_LQFP_100
	select SOC_SERIES_PSC3
	select SOC_DIE_PSC3M6

config SOC_PSC3M6FDS2AHQ1
	bool
	select SOC_PACKAGE_PSC3_E_LQFP_100
	select SOC_SERIES_PSC3
	select SOC_DIE_PSC3M6

config SOC_PSC3M6GES3AFQ1
	bool
	select SOC_PACKAGE_PSC3_E_LQFP_80
	select SOC_SERIES_PSC3
	select SOC_DIE_PSC3M6

config SOC_PSC3M6FDS2AFQ1
	bool
	select SOC_PACKAGE_PSC3_E_LQFP_80
	select SOC_SERIES_PSC3
	select SOC_DIE_PSC3M6

config SOC_PSC3M6GES3ACQ1
	bool
	select SOC_PACKAGE_PSC3_E_LQFP_64
	select SOC_SERIES_PSC3
	select SOC_DIE_PSC3M6

config SOC_PSC3M6FDS2ACQ1
	bool
	select SOC_PACKAGE_PSC3_E_LQFP_64
	select SOC_SERIES_PSC3
	select SOC_DIE_PSC3M6

config SOC
	default "psc3m5fds2afq1" if SOC_PSC3M5FDS2AFQ1
	default "psc3m5fds2lgq1" if SOC_PSC3M5FDS2LGQ1
	default "psc3m5fds2acq1" if SOC_PSC3M5FDS2ACQ1
	default "psc3m5fds2lhq1" if SOC_PSC3M5FDS2LHQ1
	default "psc3m5fds2abq1" if SOC_PSC3M5FDS2ABQ1
	default "psc3m5edafq1" if SOC_PSC3M5EDAFQ1
	default "psc3m5edlgq1" if SOC_PSC3M5EDLGQ1
	default "psc3m5edacq1" if SOC_PSC3M5EDACQ1
	default "psc3m5edlhq1" if SOC_PSC3M5EDLHQ1
	default "psc3m5edabq1" if SOC_PSC3M5EDABQ1
	default "psc3p5edlgq1" if SOC_PSC3P5EDLGQ1
	default "psc3p5fds2lgq1" if SOC_PSC3P5FDS2LGQ1
	default "psc3p5edacq1" if SOC_PSC3P5EDACQ1
	default "psc3p5fds2acq1" if SOC_PSC3P5FDS2ACQ1
	default "psc3p5edlhq1" if SOC_PSC3P5EDLHQ1
	default "psc3p5fds2lhq1" if SOC_PSC3P5FDS2LHQ1
	default "psc3p5edabq1" if SOC_PSC3P5EDABQ1
	default "psc3p5fds2abq1" if SOC_PSC3P5FDS2ABQ1
	default "psc3p2edlgq1" if SOC_PSC3P2EDLGQ1
	default "psc3p2fds2lgq1" if SOC_PSC3P2FDS2LGQ1
	default "psc3m3edlgq1" if SOC_PSC3M3EDLGQ1
	default "psc3m3fds2lgq1" if SOC_PSC3M3FDS2LGQ1
	default "psc3p2edacq1" if SOC_PSC3P2EDACQ1
	default "psc3p2fds2acq1" if SOC_PSC3P2FDS2ACQ1
	default "psc3m3edacq1" if SOC_PSC3M3EDACQ1
	default "psc3m3fds2acq1" if SOC_PSC3M3FDS2ACQ1
	default "psc3p2edlhq1" if SOC_PSC3P2EDLHQ1
	default "psc3p2fds2lhq1" if SOC_PSC3P2FDS2LHQ1
	default "psc3m3edlhq1" if SOC_PSC3M3EDLHQ1
	default "psc3m3fds2lhq1" if SOC_PSC3M3FDS2LHQ1
	default "psc3p2edabq1" if SOC_PSC3P2EDABQ1
	default "psc3p2fds2abq1" if SOC_PSC3P2FDS2ABQ1
	default "psc3m3edabq1" if SOC_PSC3M3EDABQ1
	default "psc3m3fds2abq1" if SOC_PSC3M3FDS2ABQ1
	default "psc3m6ges3ahq1" if SOC_PSC3M6GES3AHQ1
	default "psc3m6fds2ahq1" if SOC_PSC3M6FDS2AHQ1
	default "psc3m6ges3afq1" if SOC_PSC3M6GES3AFQ1
	default "psc3m6fds2afq1" if SOC_PSC3M6FDS2AFQ1
	default "psc3m6ges3acq1" if SOC_PSC3M6GES3ACQ1
	default "psc3m6fds2acq1" if SOC_PSC3M6FDS2ACQ1
```

## soc/infineon/cat1b/psc3m6/Kconfig
```kconfig
# SPDX-FileCopyrightText: Copyright (c) 2026 Infineon Technologies AG,
# SPDX-FileCopyrightText: or an affiliate of Infineon Technologies AG. All rights reserved.
#
# SPDX-License-Identifier: Apache-2.0

config SOC_SERIES_PSC3M6
	select ARM
	select CPU_HAS_FPU
	select ARMV8_M_DSP
	select CPU_HAS_ARM_MPU
	select CPU_HAS_ARM_SAU
	select ARM_TRUSTZONE_M
	select ARCH_HAS_TRUSTED_EXECUTION
	select BUILD_OUTPUT_HEX
	select BUILD_OUTPUT_BIN
	select CPU_CORTEX_M_HAS_CMSE
	select SOC_EARLY_INIT_HOOK
	select CPU_CORTEX_M33
	select NOINIT_SNIPPET_FIRST
	select HAS_PM
```
