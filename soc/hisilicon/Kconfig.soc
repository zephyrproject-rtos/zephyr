## soc/hisilicon/Kconfig.soc
```kconfig
# SPDX-FileCopyrightText: Copyright The Zephyr Project Contributors
# SPDX-License-Identifier: Apache-2.0

config SOC_FAMILY_HISILICON
	bool

config SOC_FAMILY
	default "hisilicon" if SOC_FAMILY_HISILICON

rsource "hi3861/Kconfig.soc"
```

## soc/hisilicon/hi3861/Kconfig
```kconfig
# SPDX-FileCopyrightText: Copyright The Zephyr Project Contributors
# SPDX-License-Identifier: Apache-2.0

config SOC_HI3861
	select RISCV
	select RISCV_SOC_INTERRUPT_INIT
	select SOC_EARLY_INIT_HOOK
```

## soc/hisilicon/hi3861/Kconfig.defconfig
```kconfig
# SPDX-FileCopyrightText: Copyright The Zephyr Project Contributors
# SPDX-License-Identifier: Apache-2.0

if SOC_HI3861

DT_CHOSEN_ZEPHYR_SYSTEM_TIMER := zephyr,system-timer
DT_CHOSEN_ZEPHYR_SYSTEM_TIMER_PATH := $(dt_chosen_path,$(DT_CHOSEN_ZEPHYR_SYSTEM_TIMER))

config SYS_CLOCK_HW_CYCLES_PER_SEC
	default $(dt_node_int_prop_int,$(DT_CHOSEN_ZEPHYR_SYSTEM_TIMER_PATH),clock-frequency)

config NUM_IRQS
	default 62

config INCLUDE_RESET_VECTOR
	default n

config RISCV_GENERIC_TOOLCHAIN
	default y

config KERNEL_ENTRY
	default "__reset"

endif
```

## soc/hisilicon/hi3861/Kconfig.soc
```kconfig
# SPDX-FileCopyrightText: Copyright The Zephyr Project Contributors
# SPDX-License-Identifier: Apache-2.0

config SOC_SERIES_HI3861
	bool
	select SOC_FAMILY_HISILICON

config SOC_HI3861
	bool
	select SOC_SERIES_HI3861

config SOC_SERIES
	default "hi3861" if SOC_SERIES_HI3861

config SOC
	default "hi3861" if SOC_HI3861
```

## soc/hpmicro/Kconfig
```kconfig
# Copyright (c) 2026 Cody Gu <gujiaqi@iscas.ac.cn>
# SPDX-License-Identifier: Apache-2.0

if SOC_FAMILY_HPMICRO

rsource "hpm5300/Kconfig"

endif # SOC_FAMILY_HPMICRO
```

## soc/hpmicro/Kconfig.defconfig
```kconfig
# Copyright (c) 2026 Cody Gu <gujiaqi@iscas.ac.cn>
# SPDX-License-Identifier: Apache-2.0

rsource "hpm5300/Kconfig.defconfig"
```

## soc/hpmicro/Kconfig.soc
```kconfig
# Copyright (c) 2024 HPMicro
# Copyright (c) 2026 Cody Gu <gujiaqi@iscas.ac.cn>
# SPDX-License-Identifier: Apache-2.0

config SOC_FAMILY_HPMICRO
	bool

config SOC_FAMILY
	default "hpmicro" if SOC_FAMILY_HPMICRO

rsource "hpm5300/Kconfig.soc"
```

## soc/hpmicro/hpm5300/Kconfig
```kconfig
# Copyright (c) 2026 Cody Gu <gujiaqi@iscas.ac.cn>
# SPDX-License-Identifier: Apache-2.0

config SOC_SERIES_HPM5300
	select RISCV
	select RISCV_PRIVILEGED
	select RISCV_HAS_PLIC
	select RISCV_SOC_HAS_GP_RELATIVE_ADDRESSING
	select DYNAMIC_INTERRUPTS

config SOC_HPM5361
	select ATOMIC_OPERATIONS_C
	select INCLUDE_RESET_VECTOR
	select CPU_HAS_DCACHE
	select CPU_HAS_ICACHE
	select ARCH_HAS_NOCACHE_MEMORY_SUPPORT
	select RISCV_PMP if !MCUBOOT
	select USE_HPMSDK_PCFG
	select USE_HPMSDK_PLLCTLV2
	select HAS_HPMSDK_ACMP
	select HAS_HPMSDK_ADC16
	select HAS_HPMSDK_CRC
	select HAS_HPMSDK_DAC
	select HAS_HPMSDK_DMAMUX
	select HAS_HPMSDK_DMAV2
	select HAS_HPMSDK_EWDG
	select HAS_HPMSDK_GPIO
	select HAS_HPMSDK_GPIOM
	select HAS_HPMSDK_GPTMR
	select HAS_HPMSDK_I2C
	select HAS_HPMSDK_IOC
	select HAS_HPMSDK_KEYM
	select HAS_HPMSDK_MBX
	select HAS_HPMSDK_MCAN
	select HAS_HPMSDK_MCHTMR
	select HAS_HPMSDK_MMC
	select HAS_HPMSDK_MON
	select HAS_HPMSDK_OPAMP
	select HAS_HPMSDK_OTP
	select HAS_HPMSDK_PCFG
	select HAS_HPMSDK_PDGO
	select HAS_HPMSDK_PGPR
	select HAS_HPMSDK_PLB
	select HAS_HPMSDK_PLIC
	select HAS_HPMSDK_PLICSW
	select HAS_HPMSDK_PLLCTLV2
	select HAS_HPMSDK_PMP
	select HAS_HPMSDK_PPOR
	select HAS_HPMSDK_PTPC
	select HAS_HPMSDK_PWM
	select HAS_HPMSDK_QEIV2
	select HAS_HPMSDK_QEO
	select HAS_HPMSDK_RDC
	select HAS_HPMSDK_RNG
	select HAS_HPMSDK_SDP
	select HAS_HPMSDK_SEC
	select HAS_HPMSDK_SEI
	select HAS_HPMSDK_SPI
	select HAS_HPMSDK_SYNT
	select HAS_HPMSDK_SYSCTL
	select HAS_HPMSDK_TRGM
	select HAS_HPMSDK_TSNS
	select HAS_HPMSDK_UART
	select HAS_HPMSDK_USB
	select HAS_HPMSDK_XPI
	help
	  HPM5361 single-core RISC-V MCU. The CPU has no programmable PMA.
	  Uncached sections use the fixed data local memory (DLM), as in the
	  vendor linker scripts; no memory attribute CSRs need programming.
```

## soc/hpmicro/hpm5300/Kconfig.defconfig
```kconfig
# Copyright (c) 2026 Cody Gu <gujiaqi@iscas.ac.cn>
# SPDX-License-Identifier: Apache-2.0

rsource "Kconfig.defconfig.series"
```

## soc/hpmicro/hpm5300/Kconfig.defconfig.series
```kconfig
# Copyright (c) 2025 HPMicro
# Copyright (c) 2026 Cody Gu <gujiaqi@iscas.ac.cn>
# SPDX-License-Identifier: Apache-2.0

if SOC_SERIES_HPM5300

configdefault SOC_SERIES
	default "hpm5300"

configdefault CLOCK_CONTROL
	default y

configdefault SYS_CLOCK_HW_CYCLES_PER_SEC
	default $(dt_node_int_prop_int,$(dt_nodelabel_path,mtimer),clock-frequency)

configdefault KERNEL_ENTRY
	default "_start"

configdefault ICACHE
	default y

configdefault DCACHE
	default y

configdefault RISCV_SOC_INTERRUPT_INIT
	default y

configdefault 2ND_LVL_ISR_TBL_OFFSET
	default 12

configdefault 2ND_LVL_INTR_00_OFFSET
	default 11

configdefault MAX_IRQ_PER_AGGREGATOR
	default 128

configdefault NUM_IRQS
	default 140

configdefault CACHE_MANAGEMENT
	default y

configdefault CACHE_ANDES_INIT_PRIORITY
	default 60

choice CACHE_TYPE
	default EXTERNAL_CACHE
endchoice

endif # SOC_SERIES_HPM5300
```

## soc/hpmicro/hpm5300/Kconfig.soc
```kconfig
# Copyright (c) 2025 HPMicro
# Copyright (c) 2026 Cody Gu <gujiaqi@iscas.ac.cn>
# SPDX-License-Identifier: Apache-2.0

config SOC_SERIES_HPM5300
	bool
	select SOC_FAMILY_HPMICRO
	help
	  Enable support for the HPMicro HPM5300 SoC series.

config SOC_SERIES
	default "hpm5300" if SOC_SERIES_HPM5300

config SOC_HPM5361
	bool
	select SOC_SERIES_HPM5300
	help
	  HPMicro HPM5361 SoC.

config SOC
	default "hpm5361" if SOC_HPM5361
```

## soc/infineon/aurix/Kconfig.defconfig
```kconfig
# SPDX-FileCopyrightText: Copyright (c) 2024 Infineon Technologies AG,
# SPDX-FileCopyrightText: or an affiliate of Infineon Technologies AG. All rights reserved.
# SPDX-FileCopyrightText: Copyright (c) 2026 Linumiz
#
# SPDX-License-Identifier: Apache-2.0

if SOC_SERIES_TC3X

config NUM_IRQS
	default 256

config CLOCK_CONTROL
	default y

endif

if SOC_SERIES_TC4X

config NUM_IRQS
	default 16

config CLOCK_CONTROL
	default y

endif

rsource "*/Kconfig.defconfig"
```

## soc/infineon/aurix/Kconfig.soc
```kconfig
# SPDX-FileCopyrightText: Copyright (c) 2024 Infineon Technologies AG,
# SPDX-FileCopyrightText: or an affiliate of Infineon Technologies AG. All rights reserved.
# SPDX-FileCopyrightText: Copyright (c) 2026 Linumiz
#
# SPDX-License-Identifier: Apache-2.0

config SOC_FAMILY_AURIX
	bool

config SOC_FAMILY
	default "aurix" if SOC_FAMILY_AURIX

config SOC_SERIES_TC3X
	bool
	select SOC_FAMILY_AURIX

config SOC_SERIES_TC4X
	bool
	select SOC_FAMILY_AURIX

config SOC_SERIES
	default "tc3x" if SOC_SERIES_TC3X
	default "tc4x" if SOC_SERIES_TC4X

rsource "*/Kconfig.soc"
```

## soc/infineon/aurix/qemu/Kconfig.soc
```kconfig
# SPDX-FileCopyrightText: Copyright (c) 2026 Infineon Technologies AG,
# SPDX-FileCopyrightText: or an affiliate of Infineon Technologies AG. All rights reserved.
# SPDX-FileCopyrightText: Copyright (c) 2026 Linumiz
#
# SPDX-License-Identifier: Apache-2.0

config SOC_QEMU_TC3X
	bool
	select SOC_SERIES_TC3X

config SOC_QEMU_TC4X
	bool
	select SOC_SERIES_TC4X

config SOC
	default "qemu_tc3x" if SOC_QEMU_TC3X
	default "qemu_tc4x" if SOC_QEMU_TC4X
```

## soc/infineon/aurix/tc3x/Kconfig.defconfig
```kconfig
# SPDX-FileCopyrightText: Copyright (c) 2024 Infineon Technologies AG,
# SPDX-FileCopyrightText: or an affiliate of Infineon Technologies AG. All rights reserved.
# SPDX-FileCopyrightText: Copyright (c) 2026 Linumiz
#
# SPDX-License-Identifier: Apache-2.0

if SOC_TC375TP

config BUILD_OUTPUT_HEX
	default y

endif
```

## soc/infineon/aurix/tc3x/Kconfig.soc
```kconfig
# SPDX-FileCopyrightText: Copyright (c) 2024 Infineon Technologies AG,
# SPDX-FileCopyrightText: or an affiliate of Infineon Technologies AG. All rights reserved.
# SPDX-FileCopyrightText: Copyright (c) 2026 Linumiz
#
# SPDX-License-Identifier: Apache-2.0

config SOC_TC375TP
	bool
	select SOC_SERIES_TC3X

config SOC_TC375TP_CPU0
	bool
	select SOC_TC375TP

config SOC
	default "tc375tp" if SOC_TC375TP
```

## soc/infineon/aurix/tc4x/Kconfig.soc
```kconfig
# SPDX-FileCopyrightText: Copyright (c) 2024 Infineon Technologies AG,
# SPDX-FileCopyrightText: or an affiliate of Infineon Technologies AG. All rights reserved.
# SPDX-FileCopyrightText: Copyright (c) 2026 Linumiz
#
# SPDX-License-Identifier: Apache-2.0

config SOC_TC4D7XP
	bool
	select SOC_SERIES_TC4X

config SOC_TC4D7XP_CPU0
	bool
	select SOC_TC4D7XP

config SOC
	default "tc4d7xp" if SOC_TC4D7XP
```

## soc/infineon/cat1b/Kconfig.defconfig
```kconfig
# PSOC CAT1B Configuration

# Copyright (c) 2024 Cypress Semiconductor Corporation.
# SPDX-License-Identifier: Apache-2.0

if SOC_FAMILY_INFINEON_CAT1B

config CLOCK_CONTROL_IFX_PERI_CLOCK_HAS_GROUP
	default y

rsource "*/Kconfig.defconfig"

endif # SOC_FAMILY_INFINEON_CAT1B
```
