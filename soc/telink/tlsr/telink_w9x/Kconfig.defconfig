## soc/telink/tlsr/telink_w9x/Kconfig.defconfig
```kconfig
# Copyright (c) 2024 Telink Semiconductor
# SPDX-License-Identifier: Apache-2.0

if SOC_RISCV_TELINK_W9X

config SYS_CLOCK_EXISTS
	bool
	default y

config SYS_CLOCK_HW_CYCLES_PER_SEC
	int
	default 10000000

config RISCV_SOC_INTERRUPT_INIT
	bool
	default y

config RISCV_GP
	bool
	default y

config 2ND_LVL_INTR_00_OFFSET
	int
	default 11

config 2ND_LVL_ISR_TBL_OFFSET
	int
	default 12

config NUM_IRQS
	int
	default 59

config PINCTRL
	bool
	default y

config XIP
	bool
	default n

config FLASH
	bool
	default y

config STACK_SENTINEL
	bool
	default y

config THREAD_NAME
	bool
	default y if STACK_SENTINEL

config MAIN_STACK_SIZE
	int
	default 2048

config IDLE_STACK_SIZE
	int
	default 1536

config TEST_EXTRA_STACK_SIZE
	int
	default 1024

config COMMON_LIBC_MALLOC
	bool
	default y

config COMMON_LIBC_MALLOC_ARENA_SIZE
	int
	default 8192

config HEAP_MEM_POOL_SIZE
	int
	default 4096

config HAS_FLASH_LOAD_OFFSET
	bool
	default y if BOOTLOADER_MCUBOOT

# Workaround for not being able to have commas in macro arguments
DT_LABEL_Z_STORAGE := $(dt_nodelabel_path,storage_partition)

# Set the sector count of NVS as the storage partition size divided by the sector size (4 KB)
config SETTINGS_NVS_SECTOR_COUNT
	int
	default $(shell,expr $(dt_node_reg_size_int,$(DT_LABEL_Z_STORAGE),0,K) / 4)

endif # SOC_RISCV_TELINK_W9X
```

## soc/telink/tlsr/telink_w9x/Kconfig.n22
```kconfig
# Copyright (c) 2024 Telink Semiconductor
# SPDX-License-Identifier: Apache-2.0

config TELINK_W91_N22_HART
	int "N22 HART ID"
	default 1
	help
		This option sets N22 HART ID.

config TELINK_W91_FETCH_N22_BIN
	bool "Fetch N22 binary after build"
	default y
	help
		This option fetching N22 binary after build.

config TELINK_W91_FETCH_N22_BIN_REVISION
	string "N22 binaries revision"
	default "0000000000000000000000000000000000000001"
	depends on TELINK_W91_FETCH_N22_BIN
	help
		This option sets N22 binary revision.

config TELINK_W91_N22_PARTITION_ADDR
	hex "N22 partition address"
	default $(dt_node_reg_addr_hex,$(dt_nodelabel_path,n22_partition),0)

config TELINK_W91_N22_MATTER_OTA_LAYOUT
	bool "Support Matter dual core OTA"
	depends on TELINK_W91_FETCH_N22_BIN
	default n
	help
		This option enables support Matter dual core OTA
```

## soc/telink/tlsr/telink_w9x/Kconfig.soc
```kconfig
# Copyright (c) 2024 Telink Semiconductor
# SPDX-License-Identifier: Apache-2.0

config SOC_RISCV_TELINK_W9X
	bool
	select SOC_FAMILY_TELINK_TLSR
	help
	  Telink W9X

config SOC_SERIES
	default "telink_w9x" if SOC_RISCV_TELINK_W9X

config SOC
	default "telink_w91" if SOC_RISCV_TELINK_W91
```

## soc/telink/tlsr/telink_w9x/blocking_core/Kconfig.blocking
```kconfig
# Copyright (c) 2024 Telink Semiconductor
# SPDX-License-Identifier: Apache-2.0

config TELINK_W91_BLOCKING_CORE
	bool "Telink W91 blocking core"
	default y
	help
		This option enables Telink W91 blocking core.

if TELINK_W91_BLOCKING_CORE

config BLOCKING_CORE_TELINK_W91_CORE_STOP_TIMEOUT_MS
	int "Core stop timeout"
	default 100
	help
	  This option sets core stop timeout in uS.

endif # TELINK_W91_BLOCKING_CORE
```

## soc/telink/tlsr/telink_w9x/crypto/Kconfig.crypto
```kconfig
# Copyright (c) 2024 Telink Semiconductor
# SPDX-License-Identifier: Apache-2.0

if MBEDTLS

config MBEDTLS_USER_CONFIG_FILE
	default "crypto/telink_w91_mbedtls_user_config.h"

config MBEDTLS_ENTROPY_POLL_ZEPHYR
	default y if ENTROPY_HAS_DRIVER

config TELINK_W91_ECC_HW_ACC
	bool "Telink W91 EC cryptography HW acceleration"
	default y
	depends on MBEDTLS_ECP_C
	help
		This option enables Telink W91 EC cryptography HW acceleration.

if TELINK_W91_ECC_HW_ACC

config MBEDTLS_ENTROPY_C
	default y if MBEDTLS_TEST

config MBEDTLS_CTR_DRBG_ENABLED
	default y if MBEDTLS_TEST

config MBEDTLS_CIPHER_AES_ENABLED
	default y if MBEDTLS_TEST

endif # TELINK_W91_ECC_HW_ACC

endif # MBEDTLS
```

## soc/telink/tlsr/telink_w9x/ipc/Kconfig.ipc
```kconfig
# Copyright (c) 2024 Telink Semiconductor
# SPDX-License-Identifier: Apache-2.0

config TELINK_W91_IPC_DISPATCHER
	bool "Telink W91 IPC driver"
	default y
	depends on DT_HAS_ZEPHYR_IPC_ICMSG_ENABLED
	select MBOX
	select IPC_SERVICE
	select IPC_SERVICE_BACKEND_ICMSG
	select SPSC_PBUF
	help
		This option enables Telink W91 IPC dispatching extension.

config MBOX_INIT_PRIORITY
	default 50 if TELINK_W91_IPC_DISPATCHER

config IPC_SERVICE_REG_BACKEND_PRIORITY
	default 50 if TELINK_W91_IPC_DISPATCHER

config IPC_SERVICE_BACKEND_ICMSG_WQ_STACK_SIZE
	default 2048 if TELINK_W91_IPC_DISPATCHER

config TELINK_W91_IPC_DISPATCHER_INIT_PRIORITY
	int "Telink IPC dispatcher init priority"
	default 51
	depends on TELINK_W91_IPC_DISPATCHER
	help
		This option sets Telink IPC dispatcher init priority.

config TELINK_W91_IPC_PRE_DRIVERS_INIT_PRIORITY
	int "Telink IPC pre drivers init priority"
	default 52
	depends on TELINK_W91_IPC_DISPATCHER
	help
		This option sets Telink IPC pre drivers init priority.

config TELINK_W91_IPC_DRIVERS_INIT_PRIORITY
	int "Telink IPC drivers init priority"
	default 53
	depends on TELINK_W91_IPC_DISPATCHER
	help
		This option sets Telink IPC drivers init priority.

config TELINK_W91_IPC_DISPATCHER_BOUND_TIMEOUT_MS
	int "Telink IPC dispatcher bound timeout"
	default 2000
	depends on TELINK_W91_IPC_DISPATCHER
	help
		This option sets Telink IPC dispatcher bound timeout in mS.

config TELINK_W91_IPC_DISPATCHER_TIMEOUT_MS
	int "Telink IPC dispatcher timeout"
	default 1500
	depends on TELINK_W91_IPC_DISPATCHER
	help
		This option sets Telink IPC dispatcher requests timeout in mS.

config PBUF_RX_READ_BUF_SIZE
	default 1504 if WIFI_W91
	default 1024

config IPC_SERVICE_ICMSG_WORK_QUEUE_STACK_SIZE
	int "ICMSG work queue stack size"
	default 2048

if SPSC_PBUF_CACHE_FLAG || SPSC_PBUF_CACHE_ALWAYS

config SPSC_PBUF_REMOTE_DCACHE_LINE
	default 0

config DCACHE_LINE_SIZE
	default 32

endif # SPSC_PBUF_CACHE_FLAG || SPSC_PBUF_CACHE_ALWAYS
```

## soc/telink/tlsr/telink_w9x/ot_rcp/Kconfig.ot_rcp
```kconfig
# Copyright (c) 2025 Telink Semiconductor
# SPDX-License-Identifier: Apache-2.0

if IEEE802154

config TELINK_W91_OT_RCP
	bool "Telink W91 Openthread spinel interface"
	default y
	select RING_BUFFER
	select CRC
	help
		This option enables Telink W91 Openthread RCP interface.

if TELINK_W91_OT_RCP

config OPENTHREAD_RADIO_WORKQUEUE_STACK_SIZE
	default 2048

config TELINK_W91_OT_RCP_BUFFER_SIZE
	int "Telink W91 Openthread RCP UART TX/RX buffer size"
	default 256
	help
		This option sets Telink W91 Openthread RCP UART TX/RX buffer size.

config TELINK_W91_OT_RCP_THREAD_PRIORITY
	int "Telink W91 Openthread spinel interface reception thread priority"
	default 0
	help
		This option sets Telink W91 Openthread RCP reception thread priority.

config TELINK_W91_OT_RCP_THREAD_STACK_SIZE
	int "Telink W91 Openthread spinel interface reception thread stack size"
	default 2048
	help
		This option sets Telink W91 Openthread RCP reception thread stack size.

config TELINK_W91_OT_SPINEL_RX_BUFFER_SIZE
	int "Telink W91 Openthread spinel reception buffer size"
	default 256
	help
		This option sets Telink W91 Openthread spinel reception buffer size.

config TELINK_W91_OT_SPINEL_RX_BUFFER_COUNT
	int "Telink W91 Openthread spinel reception buffers count"
	default 4
	help
		This option sets Telink W91 Openthread spinel reception buffers count.

config TELINK_W91_OT_SPINEL_RESPONSE_TIMEOUT_MS
	int "Telink W91 Openthread spinel response timeout, mS"
	default 100
	help
		This option sets Telink W91 Openthread spinel response timeout, mS.

endif # TELINK_W91_OT_RCP

endif # IEEE802154
```

## soc/telink/tlsr/tlsr951x/Kconfig
```kconfig
# Copyright (c) 2021 Telink Semiconductor
# SPDX-License-Identifier: Apache-2.0

config SOC_SERIES_TLSR951X
	bool
	select RISCV
	select RISCV_ISA_RV32I
	select RISCV_ISA_EXT_M
	select RISCV_ISA_EXT_A
	select RISCV_ISA_EXT_C
	select RISCV_ISA_EXT_F
	select RISCV_ISA_EXT_ZICSR
	select RISCV_ISA_EXT_ZIFENCEI
	select RISCV_PRIVILEGED
	select RISCV_HAS_PLIC
	select RISCV_SOC_HAS_GP_RELATIVE_ADDRESSING
	select HAS_TELINK_DRIVERS
	select CPU_HAS_DCACHE
	select CPU_HAS_ICACHE
	select CPU_HAS_ANDES_HWDSP
	select CPU_HAS_ANDES_PFT
	select RISCV_SOC_CONTEXT_SAVE if RISCV_CUSTOM_CSR_ANDES_HWDSP
	select RISCV_SOC_CONTEXT_SAVE if RISCV_CUSTOM_CSR_ANDES_PFT
	imply XIP
	select SOC_EARLY_INIT_HOOK

if SOC_SERIES_TLSR951X

config TELINK_B91_HWDSP
	bool
	select DEPRECATED

config TELINK_B91_PFT_ARCH
	bool
	select DEPRECATED

endif # SOC_SERIES_TLSR951X
```

## soc/telink/tlsr/tlsr951x/Kconfig.defconfig
```kconfig
# Copyright (c) 2021 Telink Semiconductor
# SPDX-License-Identifier: Apache-2.0

if SOC_SERIES_TLSR951X

config SYS_CLOCK_HW_CYCLES_PER_SEC
	default 32000

config RISCV_SOC_INTERRUPT_INIT
	default y

config NUM_IRQS
	default 64

config PINCTRL
	default y

config XIP
	default n

config MAIN_STACK_SIZE
	default 2048

config IDLE_STACK_SIZE
	default 1536

config TEST_EXTRA_STACK_SIZE
	default 1024

config 2ND_LVL_INTR_00_OFFSET
	default 11

config HAS_FLASH_LOAD_OFFSET
	default y if BOOTLOADER_MCUBOOT

endif # SOC_SERIES_TLSR951X
```

## soc/telink/tlsr/tlsr951x/Kconfig.soc
```kconfig
# Copyright (c) 2021 Telink Semiconductor
# SPDX-License-Identifier: Apache-2.0

config SOC_SERIES_TLSR951X
	bool
	select SOC_FAMILY_TELINK_TLSR

config SOC_TLSR9518
	bool
	select SOC_SERIES_TLSR951X

config SOC_SERIES
	default "tlsr951x" if SOC_SERIES_TLSR951X

config SOC
	default "tlsr9518" if SOC_TLSR9518
```

## soc/ti/am13/Kconfig.soc
```kconfig
# Texas Instruments AM13 MCU Family
#
# Copyright (c) 2026 Texas Instruments Incorporated
#
# SPDX-License-Identifier: Apache-2.0

config SOC_FAMILY_TI_AM13
	bool

config SOC_FAMILY
	default "ti_am13" if SOC_FAMILY_TI_AM13

rsource "*/Kconfig.soc"
```

## soc/ti/am13/am13e/Kconfig.defconfig
```kconfig
# Texas Instruments AM13E MCU Series
#
# Copyright (c) 2026 Texas Instruments Incorporated
#
# SPDX-License-Identifier: Apache-2.0

if SOC_SERIES_AM13E

config NUM_IRQS
	default 48

config SYS_CLOCK_HW_CYCLES_PER_SEC
	default 32000000

config ARM_MPU
	default y

config CPU_HAS_CUSTOM_FIXED_SOC_MPU_REGIONS
	default y

endif # SOC_SERIES_AM13E
```

## soc/ti/am13/am13e/Kconfig.soc
```kconfig
# Texas Instruments AM13E MCU Series
#
# Copyright (c) 2026 Texas Instruments Incorporated
#
# SPDX-License-Identifier: Apache-2.0

config SOC_SERIES_AM13E
	bool
	select SOC_FAMILY_TI_AM13
	help
		Enable support for TI AM13E series SoCs

config SOC_AM13E230X
	bool
	select SOC_SERIES_AM13E

config SOC_SERIES
	default "am13e" if SOC_SERIES_AM13E

config SOC
	default "am13e230x" if SOC_AM13E230X
```

## soc/ti/am26x/Kconfig.defconfig
```kconfig
# Texas Instruments AM26x MCU Family
#
# Copyright (c) 2025 Texas Instruments Incorporated
#
# SPDX-License-Identifier: Apache-2.0
if SOC_FAMILY_TI_AM26X

rsource "*/Kconfig.defconfig"

endif # SOC_FAMILY_TI_AM26X
```

## soc/ti/am26x/Kconfig.soc
```kconfig
# Texas Instruments AM26x MCU Family
#
# Copyright (c) 2025 Texas Instruments Incorporated
#
# SPDX-License-Identifier: Apache-2.0

config SOC_FAMILY_TI_AM26X
	bool
	default y

config SOC_FAMILY
	default "ti_am26x" if SOC_FAMILY_TI_AM26X

rsource "*/Kconfig.soc"
```

## soc/ti/am26x/am261x/Kconfig
```kconfig
# Texas Instruments AM261x MCU series
#
# Copyright (c) 2026 Texas Instruments Incorporated
#
# SPDX-License-Identifier: Apache-2.0

config SOC_SERIES_AM261X_R5F
	select ARM
	select ARM_CUSTOM_INTERRUPT_CONTROLLER
	select CPU_CORTEX_R5
	select CPU_HAS_ARM_MPU
	select CPU_HAS_FPU
	select CPU_HAS_DCACHE
	select CPU_HAS_ICACHE
	select PINCTRL
	select SOC_EARLY_INIT_HOOK
	select SOC_PREP_HOOK
	select TI_VIM

config SOC_PART_NUMBER
	default "AM2612" if SOC_AM261X_R5F0_0 || SOC_AM261X_R5F0_1

config CORES_IN_LOCKSTEP_MODE
	bool "Run R5F cores in lockstep mode"
	depends on SOC_SERIES_AM261X_R5F
	help
	  Configure the dual Cortex-R5F cores to operate in lockstep mode.
	  When disabled (default), cores run independently in dual-core mode.
```

## soc/ti/am26x/am261x/Kconfig.defconfig
```kconfig
# Texas Instruments AM261x MCU series
#
# Copyright (c) 2026 Texas Instruments Incorporated
#
# SPDX-License-Identifier: Apache-2.0

if SOC_SERIES_AM261X

config MAX_CPUS_NUM
	int
	default 2 if SOC_SERIES_AM261X

config KERNEL_ENTRY
	default "_vector_table" if SOC_SERIES_AM261X_R5F

config SYS_CLOCK_HW_CYCLES_PER_SEC
	# Input frequency to RTI is 250MHz, but prescaler halves frequency to 125MHz by default
	default 125000000

config NUM_IRQS
	default 222

config ARM_MPU
	default y if SOC_SERIES_AM261X_R5F

endif # SOC_SERIES_AM261X
```

## soc/ti/am26x/am261x/Kconfig.soc
```kconfig
# Texas Instruments AM261x MCU series
#
# Copyright (c) 2025 Texas Instruments Incorporated
#
# SPDX-License-Identifier: Apache-2.0

config SOC_SERIES_AM261X
	bool "TI AM261x Series MCU"
	select SOC_FAMILY_TI_AM26X
	help
	  Enable support for TI AM261x MCU series

config SOC_SERIES_AM261X_R5F
	bool
	select SOC_SERIES_AM261X

config SOC_AM261X_R5F0_0
	bool
	select SOC_SERIES_AM261X_R5F

config SOC_AM261X_R5F0_1
	bool
	select SOC_SERIES_AM261X_R5F

config SOC_AM2612_R5F
	bool
	default y if SOC_AM261X_R5F0_0 || SOC_AM261X_R5F0_1

config SOC_SERIES
	default "am261x" if SOC_SERIES_AM261X

config SOC
	default "am2612" if SOC_AM2612_R5F
```

## soc/ti/am335x/Kconfig
```kconfig
# Copyright (c) 2024 Abe Kohandel <abe.kohandel@gmail.com>
# SPDX-License-Identifier: Apache-2.0

config SOC_AM3358
	select ARM
	select ARM_CUSTOM_INTERRUPT_CONTROLLER
	select CPU_CORTEX_A8
	select CPU_HAS_FPU
	select VFP_DP_D16
```

## soc/ti/am335x/Kconfig.defconfig
```kconfig
# Copyright (c) 2024 Abe Kohandel <abe.kohandel@gmail.com>
# SPDX-License-Identifier: Apache-2.0

if SOC_AM3358

config NUM_IRQS
	default 128

endif # SOC_AM3358
```

## soc/ti/am335x/Kconfig.soc
```kconfig
# Copyright (c) 2024 Abe Kohandel <abe.kohandel@gmail.com>
# SPDX-License-Identifier: Apache-2.0

config SOC_SERIES_AM335X
	bool

config SOC_AM3358
	bool
	select SOC_SERIES_AM335X

config SOC
	default "am3358" if SOC_AM3358
```

## soc/ti/hercules/Kconfig
```kconfig
# Copyright (c) 2025 ispace, inc.
# SPDX-License-Identifier: Apache-2.0

if SOC_FAMILY_TI_HERCULES

rsource "*/Kconfig"

endif # SOC_FAMILY_TI_HERCULES
```

## soc/ti/hercules/Kconfig.soc
```kconfig
# Copyright (c) 2025 ispace, inc.
# SPDX-License-Identifier: Apache-2.0

config SOC_FAMILY_TI_HERCULES
	bool

config SOC_FAMILY
	default "ti_hercules" if SOC_FAMILY_TI_HERCULES

rsource "*/Kconfig.soc"
```

## soc/ti/hercules/ti_tms570lc43x/Kconfig
```kconfig
# Copyright (c) 2025 ispace, inc.
# SPDX-License-Identifier: Apache-2.0

config SOC_TI_TMS570LC43X
	select ARM
	select CPU_CORTEX_R5
	select BIG_ENDIAN
	select CPU_HAS_DCLS
	select CPU_HAS_ARM_MPU
	select CPU_HAS_DCACHE
	select CPU_HAS_ICACHE
	select CACHE_MANAGEMENT
	select SOC_RESET_HOOK
	select ARM_CUSTOM_INTERRUPT_CONTROLLER
	select HAS_TMS570_HALCOGEN_CODE
	imply XIP
```

## soc/ti/hercules/ti_tms570lc43x/Kconfig.defconfig
```kconfig
# Copyright (c) Copyright (c) 2025 ispace, inc.
# SPDX-License-Identifier: Apache-2.0

if SOC_TI_TMS570LC43X

config SYS_CLOCK_EXISTS
	default n

config MULTITHREADING
	default n

config GEN_SW_ISR_TABLE
	default n

config GEN_ISR_TABLES
	default n

# launchpad is 16MHz
config SYS_CLOCK_HW_CYCLES_PER_SEC
	default $(dt_node_int_prop_int,/soc/rti,clock-frequency)

config NUM_IRQS
	# must be >= the highest interrupt number used
	default 127

endif # SOC_TI_TMS570LC43X
```
