## soc/sifli/sf32/Kconfig
```kconfig
# Copyright (c) 2025 Core Devices LLC
# SPDX-License-Identifier: Apache-2.0

config SOC_FAMILY_SF32
	select HAS_SIFLI_HAL

if SOC_FAMILY_SF32

rsource "*/Kconfig"

endif # SOC_FAMILY_SF32
```

## soc/sifli/sf32/Kconfig.defconfig
```kconfig
# Copyright (c) 2025 Core Devices LLC
# SPDX-License-Identifier: Apache-2.0

if SOC_FAMILY_SF32

config BUILD_OUTPUT_HEX
	default y

configdefault BT_HCI_ACL_FLOW_CONTROL
	default n

rsource "*/Kconfig.defconfig"

endif # SOC_FAMILY_SF32
```

## soc/sifli/sf32/Kconfig.soc
```kconfig
# Copyright (c) 2025 Core Devices LLC
# SPDX-License-Identifier: Apache-2.0

config SOC_FAMILY_SF32
	bool

config SOC_FAMILY
	default "sf32" if SOC_FAMILY_SF32

rsource "*/Kconfig.soc"
```

## soc/sifli/sf32/sf32lb52x/Kconfig
```kconfig
# Copyright (c) 2025 Core Devices LLC
# SPDX-License-Identifier: Apache-2.0

config SOC_SERIES_SF32LB52X
	select ARM
	# NOTE: Star-MC1, Cortex-M33 compatible
	select CPU_CORTEX_M33
	select CPU_HAS_ARM_MPU
	select CPU_HAS_FPU
	select ARMV8_M_DSP
	select CPU_HAS_ICACHE
	select CPU_HAS_DCACHE
	select SOC_EARLY_INIT_HOOK

if SOC_SERIES_SF32LB52X

config SF32LB52X_BOOTROM_FLASH_ON_DELAY_MS
	int "Boot ROM flash on delay (ms)"
	default 0
	range 0 4095
	help
	  Configure boot ROM flash on delay (PA21) in milliseconds. Boot ROM
	  will by default set on/off delays to 0ms before jumping to firmware.
	  Enabling this option allows to configure the on/off delays to non-zero
	  values. A flash power cycle guarantees to put the external flash into
	  a known state before executing code from it. This is required if using
	  4-byte address mode in the external flash, as the boot ROM will always
	  use 3-byte address mode when reading from external flash.

config SF32LB52X_BOOTROM_FLASH_OFF_DELAY_MS
	int "Boot ROM flash off delay (ms)"
	default 0
	range 0 255
	help
	  Configure boot ROM flash off delay (PA21) in milliseconds. See
	  SF32LB52X_BOOTROM_FLASH_ON_DELAY_MS help for more details.

endif # SOC_SERIES_SF32LB52X
```

## soc/sifli/sf32/sf32lb52x/Kconfig.defconfig
```kconfig
# Copyright (c) 2025 Core Devices LLC
# SPDX-License-Identifier: Apache-2.0

if SOC_SERIES_SF32LB52X

DT_CHOSEN_Z_FLASH := zephyr,flash
DT_CHOSEN_FLASH_NODE := $(dt_chosen_path,$(DT_CHOSEN_Z_FLASH))
DT_CHOSEN_FLASH_PARENT := $(dt_node_parent,$(DT_CHOSEN_FLASH_NODE))

config SYS_CLOCK_HW_CYCLES_PER_SEC
	default $(dt_node_int_prop_int,/cpus/cpu@0,clock-frequency)

config FLASH_BASE_ADDRESS
	default $(dt_node_reg_addr_by_name_hex,$(DT_CHOSEN_FLASH_PARENT),nor)

config USE_DT_CODE_PARTITION
	default y

config CACHE_MANAGEMENT
	default y

config NUM_IRQS
	default 100

endif # SOC_SERIES_SF32LB52X
```

## soc/sifli/sf32/sf32lb52x/Kconfig.soc
```kconfig
# Copyright (c) 2025 Core Devices LLC
# SPDX-License-Identifier: Apache-2.0

config SOC_SERIES_SF32LB52X
	bool
	select SOC_FAMILY_SF32

config SOC_SERIES
	default "sf32lb52x" if SOC_SERIES_SF32LB52X

config SOC_SF32LB520U36
	bool
	select SOC_SERIES_SF32LB52X

config SOC_SF32LB523UB6
	bool
	select SOC_SERIES_SF32LB52X

config SOC_SF32LB525UC6
	bool
	select SOC_SERIES_SF32LB52X

config SOC_SF32LB527UD6
	bool
	select SOC_SERIES_SF32LB52X

config SOC_SF32LB52BU36
	bool
	select SOC_SERIES_SF32LB52X

config SOC_SF32LB52EUB6
	bool
	select SOC_SERIES_SF32LB52X

config SOC_SF32LB52GUC6
	bool
	select SOC_SERIES_SF32LB52X

config SOC_SF32LB52JUD6
	bool
	select SOC_SERIES_SF32LB52X

config SOC
	default "sf32lb520u36" if SOC_SF32LB520U36
	default "sf32lb523ub6" if SOC_SF32LB523UB6
	default "sf32lb525uc6" if SOC_SF32LB525UC6
	default "sf32lb527ud6" if SOC_SF32LB527UD6
	default "sf32lb52bu36" if SOC_SF32LB52BU36
	default "sf32lb52eub6" if SOC_SF32LB52EUB6
	default "sf32lb52guc6" if SOC_SF32LB52GUC6
	default "sf32lb52jud6" if SOC_SF32LB52JUD6
```

## soc/sifli/sf32/sf32lb58/Kconfig
```kconfig
# Copyright (c) 2025 Qingdao IotPi Ltd.
#
# SPDX-License-Identifier: Apache-2.0

config SOC_SERIES_SF32LB58
       bool
       select ARM
       select CPU_CORTEX_M33
       select CPU_HAS_ARM_MPU
       select CPU_HAS_FPU
       select CPU_HAS_ICACHE
       select CPU_HAS_DCACHE
       select ARMV8_M_DSP
       select PINCTRL
```

## soc/sifli/sf32/sf32lb58/Kconfig.defconfig
```kconfig
# Copyright (c) 2025 Qingdao IotPi Ltd.
#
# SPDX-License-Identifier: Apache-2.0

if SOC_SERIES_SF32LB58

rsource "Kconfig.defconfig.*"

endif # SOC_SERIES_SF32LB58
```

## soc/sifli/sf32/sf32lb58/Kconfig.defconfig.sf32lb58_hcpu
```kconfig
# Copyright (c) 2025 Qingdao IotPi Ltd.
#
# SPDX-License-Identifier: Apache-2.0

config NUM_IRQS
       default 69

config SYS_CLOCK_HW_CYCLES_PER_SEC
       default 1000000
config HAS_SIFLI_HAL
       default y
```

## soc/sifli/sf32/sf32lb58/Kconfig.soc
```kconfig
# Copyright (c) 2025 Qingdao IotPi Ltd.
#
# SPDX-License-Identifier: Apache-2.0


config SOC_SERIES_SF32LB58
	bool
	select SOC_FAMILY_SF32

config SOC_SERIES
	default "sf32lb58" if SOC_SERIES_SF32LB58

config SOC_SF32LB586_HCPU
	bool
    select SOC_SERIES_SF32LB58

config SOC_SF32LB586_ACPU
	bool
    select SOC_SERIES_SF32LB58

config SOC_SF32LB586_LCPU
	bool
    select SOC_SERIES_SF32LB58

config SOC
	default "sf32lb586" if SOC_SF32LB586_HCPU || SOC_SF32LB586_ACPU || SOC_SF32LB586_LCPU
```

## soc/sifli/sf32/sf32lb58x/Kconfig.defconfig
```kconfig
# Copyright (c) 2026 Qingsong Gou <gouqs@hotmail.com>
# SPDX-License-Identifier: Apache-2.0

if SOC_SERIES_SF32LB58X

config SYS_CLOCK_HW_CYCLES_PER_SEC
	default $(dt_node_int_prop_int,/cpus/cpu@0,clock-frequency)

config USE_DT_CODE_PARTITION
	default y

config CACHE_MANAGEMENT
	default y

config NUM_IRQS
	default 100

endif # SOC_SERIES_SF32LB58X
```

## soc/sifli/sf32/sf32lb58x/Kconfig.soc
```kconfig
# Copyright (c) 2026 Qingsong Gou <gouqs@hotmail.com>
# SPDX-License-Identifier: Apache-2.0

config SOC_SERIES_SF32LB58X
	bool
	select SOC_FAMILY_SF32

config SOC_SERIES
	default "sf32lb58x" if SOC_SERIES_SF32LB58X

config SOC_SF32LB580VNN36
	bool
	select SOC_SERIES_SF32LB58X

config SOC_SF32LB581VCN36
	bool
	select SOC_SERIES_SF32LB58X

config SOC_SF32LB583VCC36
	bool
	select SOC_SERIES_SF32LB58X

config SOC_SF32LB585V5E56
	bool
	select SOC_SERIES_SF32LB58X

config SOC_SF32LB586VDD36
	bool
	select SOC_SERIES_SF32LB58X

config SOC_SF32LB587VEE36
	bool
	select SOC_SERIES_SF32LB58X

config SOC
	default "sf32lb580vnn36" if SOC_SF32LB580VNN36
	default "sf32lb581vcn36" if SOC_SF32LB581VCN36
	default "sf32lb583vcc36" if SOC_SF32LB583VCC36
	default "sf32lb585v5e56" if SOC_SF32LB585V5E56
	default "sf32lb586vdd36" if SOC_SF32LB586VDD36
	default "sf32lb587vee36" if SOC_SF32LB587VEE36
```

## soc/silabs/Kconfig
```kconfig
# Copyright (c) 2017 Christian Taedcke
# Copyright (c) 2018 Gil Benkoe
# SPDX-License-Identifier: Apache-2.0

rsource "*/Kconfig"

config SILABS_SHELL
	bool
	depends on SHELL
	help
	  Hidden option that enables the "silabs" shell command namespace.
	  Selected by any Silicon Labs SoC feature that registers a subcommand.

if SOC_FAMILY_SILABS_S1 || SOC_FAMILY_SILABS_S2

config SOC_GECKO_HAS_RADIO
	bool
	help
	  If enabled, indicates that the SoC has a Radio PHY.

config SOC_GECKO_USE_RAIL
	bool "Use RAIL (Radio Abstraction Interface Layer)"
	depends on SOC_GECKO_HAS_RADIO
	select SILABS_SISDK_LDMA if HAS_SILABS_SISDK
	select SILABS_SISDK_TIMER if BT_CHANNEL_SOUNDING
	help
	  RAIL (Radio Abstraction Interface Layer) is a library needed to use the EFR radio
	  hardware. This option enable the proper set of features to allow to properly compile
	  with the RAIL blob.

config SOC_GECKO_CUSTOM_RADIO_PHY
	bool "Use RAIL for custom radio phy packet sending and receiving"
	depends on SOC_GECKO_HAS_RADIO
	select SOC_GECKO_USE_RAIL
	help
	  If enabled, RAIL can be used for user generated custom radio phy
	  management, sending and receiving packets on radio phy. User has
	  to provide the radio_config.c and radio_config.h files for the phy.

endif # SOC_FAMILY_SILABS_S1 || SOC_FAMILY_SILABS_S2

if SOC_FAMILY_SILABS_S0 || SOC_FAMILY_SILABS_S1

config SILABS_GECKO_EMU_DCDC
	bool "SoC DC/DC regulator"
	select SILABS_GECKO_EMU
	help
	  Enable the on chip DC/DC regulator

choice SILABS_GECKO_EMU_DCDC_MODE
	prompt "DC/DC mode"
	depends on SILABS_GECKO_EMU_DCDC
	help
	  Select power configuration mode of the on chip DC/DC converter.

	config SILABS_GECKO_EMU_DCDC_MODE_UNCONFIGURED
		bool "Initial / Unconfigured"

	config SILABS_GECKO_EMU_DCDC_MODE_ON
		bool "DC/DC On"

	config SILABS_GECKO_EMU_DCDC_MODE_OFF
		bool "DC/DC Off"

	config SILABS_GECKO_EMU_DCDC_MODE_BYPASS
		bool "Bypass"
endchoice

config SOC_GECKO_HAS_INDIVIDUAL_PIN_LOCATION
	bool
	help
	  If enabled, indicates that SoC allows to configure individual pin
	  locations. This is supported by e.g. efr32fg1p, efr32mg12p series.
	  If disabled, indicates that pin locations are configured in groups.
	  This is supported by e.g. efm32hg, efm32wg series.

config SOC_GECKO_HAS_ERRATA_RTCC_E201
	bool
	help
	  Set if the SoC is affected by errata RTCC_E201:
	  "When the RTCC is configured with a prescaler, the CCV1 top value enable
	  feature enabled by setting CCV1TOP in RTCC_CTRL fails to wrap the counter
	  when RTCC_CNT is equal to RTCC_CC1_CCV, as intended."

endif # SOC_FAMILY_SILABS_S0 || SOC_FAMILY_SILABS_S1
```

## soc/silabs/Kconfig.siwx91x
```kconfig
# Kconfig entries for SOC_FAMILY_SILABS_SIWX91X

config SOC_SILABS_SLEEPTIMER
	bool
	select CODE_DATA_RELOCATION
	help
	  Set if the Sleeptimer HAL module is used for SIWX91X.
```

## soc/silabs/Kconfig.soc
```kconfig
# Copyright (c) 2017 Christian Taedcke
# SPDX-License-Identifier: Apache-2.0

config SOC_FAMILY
	default "silabs_s0" if SOC_FAMILY_SILABS_S0
	default "silabs_s1" if SOC_FAMILY_SILABS_S1
	default "silabs_s2" if SOC_FAMILY_SILABS_S2
	default "silabs_sim3" if SOC_FAMILY_SILABS_SIM3

rsource "*/Kconfig.soc"
```

## soc/silabs/exx32/Kconfig.soc
```kconfig
# Copyright (c) 2017 Christian Taedcke
# SPDX-License-Identifier: Apache-2.0

config SOC_FAMILY_SILABS_EXX32
	bool

config SOC_FAMILY
	default "silabs_exx32" if SOC_FAMILY_SILABS_EXX32

rsource "*/Kconfig.soc"
```

## soc/silabs/exx32/efm32gg11b/Kconfig.defconfig.efm32gg11b
```kconfig
# Silicon Labs EFM32GG-STK3701A platform configuration options
# Copyright (c) 2019 Interay Solutions B.V.
# Copyright (c) 2019 Oane Kingma
# SPDX-License-Identifier: Apache-2.0

config GPIO_GECKO
	default y
	depends on GPIO || LOG_BACKEND_SWO
```

## soc/silabs/exx32/efm32gg12b/Kconfig.defconfig
```kconfig
# EFM32GG12B series configuration options
# Copyright (c) 2023 Antmicro <www.antmicro.com>
# SPDX-License-Identifier: Apache-2.0

if SOC_SERIES_EFM32GG12B

config NUM_IRQS
	int
	# must be >= the highest interrupt number used
	default 68

rsource "Kconfig.defconfig.efm32gg12b"

endif # SOC_SERIES_EFM32GG12B
```

## soc/silabs/exx32/efr32fg13p/Kconfig.defconfig
```kconfig
# EFR32FG13P series configuration options

# Copyright (c) 2018 Christian Taedcke
# SPDX-License-Identifier: Apache-2.0

if SOC_SERIES_EFR32FG13P

config NUM_IRQS
	# must be >= the highest interrupt number used
	default 45

endif # SOC_SERIES_EFR32FG13P
```

## soc/silabs/exx32/efr32mg21/Kconfig.defconfig
```kconfig
# Silicon Labs EFR32MG21 (Might Gecko) series configuration options

# Copyright (c) 2020 TriaGnoSys GmbH
# SPDX-License-Identifier: Apache-2.0

if SOC_SERIES_EFR32MG21

config NUM_IRQS
	int
	# must be >= the highest interrupt number used
	default 61

rsource "Kconfig.defconfig.efr32mg21"

endif # SOC_SERIES_EFR32MG21
```

## soc/silabs/silabs_s0/Kconfig
```kconfig
# Copyright (c) 2024 GARDENA GmbH
#
# SPDX-License-Identifier: Apache-2.0

if SOC_FAMILY_SILABS_S0

config SOC_FAMILY_SILABS_S0
	select HAS_SEGGER_RTT if ZEPHYR_SEGGER_MODULE
	select BUILD_OUTPUT_HEX

rsource "*/Kconfig"

endif # SOC_FAMILY_SILABS_S0
```

## soc/silabs/silabs_s0/Kconfig.soc
```kconfig
# Copyright (c) 2017 Christian Taedcke
# SPDX-License-Identifier: Apache-2.0

config SOC_FAMILY_SILABS_S0
	bool
	select SOC_VENDOR_SILABS

rsource "*/Kconfig.soc"
```

## soc/silabs/silabs_s0/efm32hg/Kconfig
```kconfig
# Copyright (c) 2018 Marcio Montenegro
# SPDX-License-Identifier: Apache-2.0

config SOC_SERIES_EFM32HG
	select ARM
	select CPU_CORTEX_M0PLUS
	select CPU_CORTEX_M_HAS_SYSTICK
	select CPU_CORTEX_M_HAS_VTOR
	select HAS_SILABS_GECKO
	select SILABS_GECKO_CMU
	select SILABS_GECKO_GPIO
	select SILABS_GECKO_WDOG
	select HAS_PM
```

## soc/silabs/silabs_s0/efm32hg/Kconfig.defconfig
```kconfig
# Copyright (c) 2018 Christian Taedcke
# Copyright (c) 2018 Marcio Montenegro
# SPDX-License-Identifier: Apache-2.0

if SOC_SERIES_EFM32HG

config SYS_CLOCK_HW_CYCLES_PER_SEC
	default $(dt_node_int_prop_int,/cpus/cpu@0,clock-frequency)

config NUM_IRQS
	# must be >= the highest interrupt number used
	default 20

endif
```

## soc/silabs/silabs_s0/efm32hg/Kconfig.soc
```kconfig
# Copyright (c) 2018 Marcio Montenegro
# SPDX-License-Identifier: Apache-2.0

config SOC_SERIES_EFM32HG
	bool
	select SOC_FAMILY_SILABS_S0
	help
	  Silicon Labs EFM32HG (Happy Gecko) Series MCU

config SOC_EFM32HG322F64
	bool
	select SOC_SERIES_EFM32HG

config SOC_SERIES
	default "efm32hg" if SOC_SERIES_EFM32HG

config SOC
	default "efm32hg322f64" if SOC_EFM32HG322F64
```
