## soc/brcm/bcm2712/Kconfig
```kconfig
# Copyright 2024 Junho Lee <junho@tsnlab.com>
# SPDX-License-Identifier: Apache-2.0

config SOC_BCM2712
	select ARM64
	select CPU_CORTEX_A76
	select ARM_ARCH_TIMER if SYS_CLOCK_EXISTS
	select ARM64_GIC_SOC_IRQ_HOOKS if BCM2712_MIP
```

## soc/brcm/bcm2712/Kconfig.defconfig
```kconfig
# Copyright 2024 Junho Lee <junho@tsnlab.com>
# SPDX-License-Identifier: Apache-2.0

if SOC_BCM2712

configdefault NUM_IRQS
	default 512

configdefault SYS_CLOCK_HW_CYCLES_PER_SEC
	default 54000000

endif
```

## soc/brcm/bcm2835/Kconfig
```kconfig
# Copyright (c) 2026 Jonathan Elliot Peace <jep@alphabetiq.com>
# SPDX-License-Identifier: Apache-2.0

config SOC_BCM2835
	select ARM
	select CPU_ARM1176JZF_S
	select ARM_CUSTOM_INTERRUPT_CONTROLLER
	select CLOCK_CONTROL_FIXED_RATE_CLOCK if DT_HAS_FIXED_CLOCK_ENABLED
	select KERNEL_DIRECT_MAP if MMU
```

## soc/canaan/k230/Kconfig
```kconfig
# Copyright (c) 2026 Process Mission
# SPDX-License-Identifier: Apache-2.0

config SOC_K230_C908
	select RISCV
	select CPU_THEAD_C908
	select RISCV_HAS_PLIC
	select RISCV_SOC_HAS_GP_RELATIVE_ADDRESSING
```

## soc/canaan/k230/Kconfig.defconfig
```kconfig
# Copyright (c) 2026 Process Mission
# SPDX-License-Identifier: Apache-2.0

if SOC_K230_C908

configdefault RISCV_SOC_INTERRUPT_INIT
	default y

configdefault 2ND_LVL_ISR_TBL_OFFSET
	default 12

configdefault 2ND_LVL_INTR_00_OFFSET
	default 11

configdefault MAX_IRQ_PER_AGGREGATOR
	default 209

configdefault NUM_IRQS
	default 221

configdefault UART_NS16550_ACCESS_WORD_ONLY
	default y

endif # SOC_K230_C908
```

## soc/canaan/k230/Kconfig.soc
```kconfig
# Copyright (c) 2026 Process Mission
# SPDX-License-Identifier: Apache-2.0

config SOC_K230
	bool
	help
	  Canaan Kendryte K230

config SOC_K230_C908
	bool
	select SOC_K230
	help
	  Canaan Kendryte K230 little core (XuanTie C908)

config SOC
	default "k230" if SOC_K230
```

## soc/espressif/common/Kconfig.brownout
```kconfig
# Copyright (c) 2026 Espressif Systems (Shanghai) Co., Ltd.
# SPDX-License-Identifier: Apache-2.0

config SOC_FAMILY_ESPRESSIF_BROWNOUT
	bool "Espressif brown-out detector"
	default y
	depends on DT_HAS_ESPRESSIF_ESP32_BROWNOUT_ENABLED
	help
	  Enable the Espressif VDD brown-out detector. The threshold and the
	  reset or interrupt action come from the devicetree node.
```

## soc/espressif/common/Kconfig.esp_timer
```kconfig
# Copyright (c) 2026 Espressif Systems (Shanghai) Co., Ltd.
# SPDX-License-Identifier: Apache-2.0

choice SOC_FAMILY_ESPRESSIF_TIMER_TASK_CORE
	prompt "esp_timer task core"
	depends on SMP && SCHED_CPU_MASK
	default SOC_FAMILY_ESPRESSIF_TIMER_TASK_PINNED_TO_CORE_1 if ESP32_WIFI_TASK_PINNED_TO_CORE_1
	default SOC_FAMILY_ESPRESSIF_TIMER_TASK_PINNED_TO_CORE_0
	help
	  Core the esp_timer dispatch task is pinned to under SMP. esp_timer
	  callbacks drive Wi-Fi housekeeping, so the task should share the
	  core where the Wi-Fi task runs to avoid cross-core wakeups and lock
	  contention.

config SOC_FAMILY_ESPRESSIF_TIMER_TASK_PINNED_TO_CORE_0
	bool "Core 0"

config SOC_FAMILY_ESPRESSIF_TIMER_TASK_PINNED_TO_CORE_1
	bool "Core 1"
	depends on MP_MAX_NUM_CPUS > 1

endchoice # SOC_FAMILY_ESPRESSIF_TIMER_TASK_CORE

config SOC_FAMILY_ESPRESSIF_TIMER_TASK_CORE_ID
	int
	default 1 if SOC_FAMILY_ESPRESSIF_TIMER_TASK_PINNED_TO_CORE_1
	default 0
	help
	  Resolved core id for the esp_timer task (0 or 1). Consumed by the
	  esp_timer task-create path to pin the task.
```

## soc/espressif/esp32s31/Kconfig.caps
```kconfig
# Copyright (c) 2026 Espressif Systems (Shanghai) Co., Ltd.
# SPDX-License-Identifier: Apache-2.0

config SOC_FAMILY_ESPRESSIF_SPI_MEM_SUPPORT_TIMING_TUNING
	bool
	default y

config SOC_FAMILY_ESPRESSIF_WIFI_HE_SUPPORT
	bool
	default y

config SOC_FAMILY_ESPRESSIF_ETM_SUPPORTED
	bool
	default y

config SOC_FAMILY_ESPRESSIF_FLASH_ENCRYPTION_XTS_AES
	bool
	default y

config SOC_FAMILY_ESPRESSIF_FLASH_ENCRYPTION_XTS_AES_OPTIONS
	bool
	default y

config SOC_FAMILY_ESPRESSIF_FLASH_ENCRYPTION_XTS_AES_128
	bool
	default y

config SOC_FAMILY_ESPRESSIF_FLASH_ENCRYPTION_XTS_AES_256
	bool
	default y

config SOC_FAMILY_ESPRESSIF_EFUSE_XTS_AES_KEY_128
	bool
	default y

config SOC_FAMILY_ESPRESSIF_EFUSE_XTS_AES_KEY_256
	bool
	default y

config SOC_FAMILY_ESPRESSIF_ECDSA_SUPPORT_CURVE_P384
	bool
	default y

config SOC_FAMILY_ESPRESSIF_FLASH_ENCRYPTION_XTS_AES_SUPPORT_PSEUDO_ROUND
	bool
	default y
```

## soc/espressif/esp32s31/Kconfig.defconfig
```kconfig
# Copyright (c) 2026 Espressif Systems (Shanghai) Co., Ltd.
# SPDX-License-Identifier: Apache-2.0

if SOC_SERIES_ESP32S31

configdefault FPU
	default y if SOC_ESP32S31_HPCORE

configdefault RISCV_IMPRECISE_FPU_STATE_TRACKING
	default y

configdefault CACHE_MANAGEMENT
	default y

choice CACHE_TYPE
	default EXTERNAL_CACHE if CACHE_MANAGEMENT
endchoice

configdefault NUM_IRQS
	default 48

configdefault RISCV_MCAUSE_EXCEPTION_MASK
	default 0xFFF

configdefault RISCV_RESERVED_IRQ_ISR_TABLES_OFFSET
	default 16

configdefault RISCV_SOC_CONTEXT_SAVE
	default y

configdefault RISCV_ALWAYS_SWITCH_THROUGH_ECALL
	default y if MULTITHREADING

configdefault RISCV_SOC_HAS_SYSCALL_INTMASK
	default y if SOC_ESP32S31_HPCORE && USERSPACE && RISCV_SOC_CONTEXT_SAVE && \
		RISCV_ALWAYS_SWITCH_THROUGH_ECALL

configdefault RISCV_USER_STRING_NLEN_VALIDATE
	default y if SOC_ESP32S31_HPCORE && USERSPACE

configdefault RISCV_SOC_SYSCALL_CLOSE_ECALL
	default y if SOC_ESP32S31_HPCORE && USERSPACE

configdefault PMP_SLOTS
	default 16

configdefault PMP_GRANULARITY
	default 128 if SOC_ESP32S31_HPCORE && RISCV_PMP

configdefault NULL_POINTER_EXCEPTION_REGION_SIZE
	default 0x80 if SOC_ESP32S31_HPCORE && NULL_POINTER_EXCEPTION_DETECTION_PMP

# ESP32-S31 uses MMU to map flash to virtual addresses for code execution.
# The PMP init code runs from IRAM while the main rom region is in flash.
# Locked PMP entries would block IRAM execution before proper coverage is set.
# Use unlocked entries with MPRV-based enforcement instead.
configdefault PMP_NO_LOCK_GLOBAL
	default y

configdefault MAIN_STACK_SIZE
	default 2048

endif # SOC_SERIES_ESP32S31

if SOC_ESP32S31_LPCORE

configdefault GEN_ISR_TABLES
	default n

configdefault SYS_CLOCK_EXISTS
	default n

configdefault KERNEL_MEM_POOL
	default n

configdefault COMMON_LIBC_MALLOC_ARENA_SIZE
	default 0

configdefault MULTITHREADING
	default n

configdefault NUM_PREEMPT_PRIORITIES
	default 0

endif
```

## soc/hisilicon/Kconfig
```kconfig
# SPDX-FileCopyrightText: Copyright The Zephyr Project Contributors
# SPDX-License-Identifier: Apache-2.0

if SOC_FAMILY_HISILICON

rsource "hi3861/Kconfig"

endif # SOC_FAMILY_HISILICON
```

## soc/hisilicon/hi3861/Kconfig.defconfig
```kconfig
# SPDX-FileCopyrightText: Copyright The Zephyr Project Contributors
# SPDX-License-Identifier: Apache-2.0

if SOC_HI3861

DT_CHOSEN_ZEPHYR_SYSTEM_TIMER := zephyr,system-timer
DT_CHOSEN_ZEPHYR_SYSTEM_TIMER_PATH := $(dt_chosen_path,$(DT_CHOSEN_ZEPHYR_SYSTEM_TIMER))

configdefault SYS_CLOCK_HW_CYCLES_PER_SEC
	default $(dt_node_int_prop_int,$(DT_CHOSEN_ZEPHYR_SYSTEM_TIMER_PATH),clock-frequency)

configdefault NUM_IRQS
	default 62

configdefault INCLUDE_RESET_VECTOR
	default n

configdefault RISCV_GENERIC_TOOLCHAIN
	default y

configdefault KERNEL_ENTRY
	default "__reset"

endif
```

## soc/infineon/cat1a/cyt2bx/Kconfig.soc
```kconfig
# Copyright (c) 2026 Linumiz
# Copyright (c) 2026 Infineon Technologies AG
# SPDX-License-Identifier: Apache-2.0

# SOC Series
config SOC_SERIES_CYT2BX
	bool
	select SOC_FAMILY_INFINEON_CAT1
	select SOC_FAMILY_INFINEON_CAT1A

config SOC_SERIES
	default "cyt2bx" if SOC_SERIES_CYT2BX

config SOC_DIE_CYT2B7
	bool

config SOC_DIE_CYT2BL
	bool

config SOC_CYT2B75CAE
	bool
	select SOC_SERIES_CYT2BX
	select SOC_DIE_CYT2B7

config SOC_CYT2B75CAE_M0P
	bool
	select SOC_CYT2B75CAE
	select SOC_SERIES_CYT2BX_M0P

config SOC_CYT2B75CAE_M4
	bool
	select SOC_CYT2B75CAE
	select SOC_SERIES_CYT2BX_M4


config SOC
	default "cyt2b75cae" if SOC_CYT2B75CAE
```

## soc/infineon/cat1c/cyt4xx/Kconfig.soc
```kconfig
# SPDX-FileCopyrightText: Copyright (c) 2026 Linumiz
# SPDX-FileCopyrightText: Copyright (c) 2026 Infineon Technologies AG,
# SPDX-FileCopyrightText: or an affiliate of Infineon Technologies AG. All rights reserved.
#
# SPDX-License-Identifier: Apache-2.0

# SOC series
config SOC_SERIES_CYT4XX
	bool
	select SOC_FAMILY_INFINEON_CAT1C

# Shared CPU-cluster selectors for the cyt4xx series.
config SOC_SERIES_CYT4XX_M0P
	bool

config SOC_SERIES_CYT4XX_M7_0
	bool

config SOC_SERIES_CYT4XX_M7_1
	bool

config SOC_SERIES
	default "cyt4xx" if SOC_SERIES_CYT4XX

config SOC_DIE_CYT4DN
	bool

# cyt4dnjbzs
config SOC_CYT4DNJBZS
	bool
	select SOC_SERIES_CYT4XX
	select SOC_DIE_CYT4DN

config SOC_CYT4DNJBZS_M0P
	bool
	select SOC_CYT4DNJBZS
	select SOC_SERIES_CYT4XX_M0P

config SOC_CYT4DNJBZS_M7_0
	bool
	select SOC_CYT4DNJBZS
	select SOC_SERIES_CYT4XX_M7_0

config SOC_CYT4DNJBZS_M7_1
	bool
	select SOC_CYT4DNJBZS
	select SOC_SERIES_CYT4XX_M7_1

config SOC
	default "cyt4dnjbzs" if SOC_CYT4DNJBZS
```

## soc/infineon/psoc4/psoc4hvpaspm10/Kconfig
```kconfig
# SPDX-FileCopyrightText: Copyright (c) 2026 Infineon Technologies AG,
# SPDX-FileCopyrightText: or an affiliate of Infineon Technologies AG. All rights reserved.
#
# SPDX-License-Identifier: Apache-2.0

# SOC Packages for Infineon PSOC4HVPA-SPM 1.0 series MCUs
config SOC_PACKAGE_PSOC4HVPASPM10_48_QFN
	bool
	help
	  48-pin QFN package

# Hardware configuration for PSOC4HVPA-SPM 1.0 series
config SOC_SERIES_PSOC4HVPASPM10
	select ARM
	select CPU_CORTEX_M0PLUS
	select CPU_CORTEX_M_HAS_VTOR
	select CPU_HAS_ARM_MPU
	select BUILD_OUTPUT_HEX
	select BUILD_OUTPUT_BIN
	select DYNAMIC_INTERRUPTS
	select SOC_EARLY_INIT_HOOK
	select SOC_EARLY_RESET_HOOK
	select CPU_CORTEX_M_HAS_SYSTICK

config SOC_CY8C4147LDE_HV504
	select SOC_PACKAGE_PSOC4HVPASPM10_48_QFN

config SOC_CY8C4147LDE_HV534
	select SOC_PACKAGE_PSOC4HVPASPM10_48_QFN

config SOC_CY8C4147LDE_HV604
	select SOC_PACKAGE_PSOC4HVPASPM10_48_QFN

config SOC_CY8C4147LDE_HV634
	select SOC_PACKAGE_PSOC4HVPASPM10_48_QFN

config SOC_CY8C4147LDE_HV704
	select SOC_PACKAGE_PSOC4HVPASPM10_48_QFN

config SOC_CY8C4147LDE_HV734
	select SOC_PACKAGE_PSOC4HVPASPM10_48_QFN
```

## soc/infineon/psoc4/psoc4hvpaspm10/Kconfig.defconfig
```kconfig
# SPDX-FileCopyrightText: Copyright (c) 2026 Infineon Technologies AG,
# SPDX-FileCopyrightText: or an affiliate of Infineon Technologies AG. All rights reserved.
#
# SPDX-License-Identifier: Apache-2.0

if SOC_SERIES_PSOC4HVPASPM10

config NUM_IRQS
	default 32

endif # SOC_SERIES_PSOC4HVPASPM10
```

## soc/infineon/psoc4/psoc4hvpaspm10/Kconfig.soc
```kconfig
# SPDX-FileCopyrightText: Copyright (c) 2026 Infineon Technologies AG,
# SPDX-FileCopyrightText: or an affiliate of Infineon Technologies AG. All rights reserved.
#
# SPDX-License-Identifier: Apache-2.0

# MCU series
config SOC_SERIES_PSOC4HVPASPM10
	bool
	select SOC_FAMILY_INFINEON_PSOC4
	help
	  PSOC4 HVPA-SPM 1.0 Series MCU

config SOC_SERIES
	default "psoc4hvpaspm10" if SOC_SERIES_PSOC4HVPASPM10

config SOC_CY8C4147LDE_HV504
	bool
	select SOC_SERIES_PSOC4HVPASPM10

config SOC_CY8C4147LDE_HV534
	bool
	select SOC_SERIES_PSOC4HVPASPM10

config SOC_CY8C4147LDE_HV604
	bool
	select SOC_SERIES_PSOC4HVPASPM10

config SOC_CY8C4147LDE_HV634
	bool
	select SOC_SERIES_PSOC4HVPASPM10

config SOC_CY8C4147LDE_HV704
	bool
	select SOC_SERIES_PSOC4HVPASPM10

config SOC_CY8C4147LDE_HV734
	bool
	select SOC_SERIES_PSOC4HVPASPM10

config SOC
	default "cy8c4147lde_hv504" if SOC_CY8C4147LDE_HV504
	default "cy8c4147lde_hv534" if SOC_CY8C4147LDE_HV534
	default "cy8c4147lde_hv604" if SOC_CY8C4147LDE_HV604
	default "cy8c4147lde_hv634" if SOC_CY8C4147LDE_HV634
	default "cy8c4147lde_hv704" if SOC_CY8C4147LDE_HV704
	default "cy8c4147lde_hv734" if SOC_CY8C4147LDE_HV734
```

## soc/microchip/pic32c/pic32cx_bz/Kconfig.defconfig
```kconfig
# SPDX-FileCopyrightText: Copyright (c) 2026 Microchip Technology Inc.
# SPDX-License-Identifier: Apache-2.0

config BUILD_OUTPUT_HEX
	default y

rsource "*/Kconfig.defconfig"
```

## soc/microchip/pic32c/pic32cx_bz/Kconfig.soc
```kconfig
# SPDX-FileCopyrightText: Copyright (c) 2026 Microchip Technology Inc.
# SPDX-License-Identifier: Apache-2.0

config ENABLE_PMU_BUCK_MODE
	bool "PMU Buck Mode support"

rsource "*/Kconfig.soc"
rsource "Kconfig.image_header"
rsource "Kconfig.system_config"
```

## soc/microchip/pic32c/pic32cx_bz/bz6x/Kconfig.soc
```kconfig
# SPDX-FileCopyrightText: Copyright (c) 2026 Microchip Technology Inc.
# SPDX-License-Identifier: Apache-2.0

config SOC_FAMILY_MICROCHIP_PIC32CX_BZ6
	bool

config SOC_FAMILY
	default "microchip_pic32cx_bz6" if SOC_FAMILY_MICROCHIP_PIC32CX_BZ6

config SOC_SERIES_REVISION_N
	bool
	depends on SOC_FAMILY_MICROCHIP_PIC32CX_BZ6

config SOC_SERIES_REVISION
	string
	default "n" if SOC_SERIES_REVISION_N
	default ""
	depends on SOC_FAMILY_MICROCHIP_PIC32CX_BZ6

rsource "*/Kconfig.soc"
```

## soc/microchip/pic32c/pic32cx_bz/bz6x/bz62/Kconfig.soc
```kconfig
# SPDX-FileCopyrightText: Copyright (c) 2026 Microchip Technology Inc.
# SPDX-License-Identifier: Apache-2.0

config SOC_SERIES_PIC32CX_BZ62
	bool
	select SOC_FAMILY_MICROCHIP_PIC32CX_BZ6
	help
	  Enable support for Microchip PIC32CX_BZ6 Cortex-M4F microcontrollers.

config SOC_SERIES
	default "bz62" if SOC_SERIES_PIC32CX_BZ62

config SOC_PIC32CX2051BZ62132
	bool
	select SOC_SERIES_PIC32CX_BZ62

config SOC_PIC32CX2051BZ62064
	bool
	select SOC_SERIES_PIC32CX_BZ62

config SOC
	default "pic32cx2051bz62132" if SOC_PIC32CX2051BZ62132
```

## soc/microchip/pic32c/pic32cx_bz/bz6x/bz66/Kconfig.soc
```kconfig
# SPDX-FileCopyrightText: Copyright (c) 2026 Microchip Technology Inc.
# SPDX-License-Identifier: Apache-2.0

config SOC_SERIES_PIC32CX_BZ66
	bool
	select SOC_FAMILY_MICROCHIP_PIC32CX_BZ6
	help
	  Enable support for Microchip PIC32CX_BZ6 Cortex-M4F microcontrollers.

config SOC_SERIES
	default "bz66" if SOC_SERIES_PIC32CX_BZ66

config SOC_PIC32CX2051BZ66048
	bool
	select SOC_SERIES_PIC32CX_BZ66

config SOC
	default "pic32cx2051bz66048" if SOC_PIC32CX2051BZ66048
```
