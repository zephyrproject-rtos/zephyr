## soc/aesc/Kconfig.soc
```kconfig
# Copyright (c) 2025 Aesc Silicon
# SPDX-License-Identifier: Apache-2.0

rsource "*/Kconfig.soc"
```

## soc/aesc/hydrogen/Kconfig
```kconfig
# SPDX-FileCopyrightText: 2026 Aesc Silicon
# SPDX-License-Identifier: Apache-2.0

config SOC_SERIES_HYDROGEN
	select RISCV
	select RISCV_PRIVILEGED
	select RISCV_HAS_PLIC
	select INCLUDE_RESET_VECTOR
	select PINCTRL

config SOC_PART_NUMBER
	default "elemrv_h" if SOC_ELEMRV_H
```

## soc/aesc/hydrogen/Kconfig.soc
```kconfig
# SPDX-FileCopyrightText: 2026 Aesc Silicon
# SPDX-License-Identifier: Apache-2.0

config SOC_SERIES_HYDROGEN
	bool

config SOC_ELEMRV_H
	bool
	select SOC_SERIES_HYDROGEN

config SOC_SERIES
	default "hydrogen" if SOC_SERIES_HYDROGEN

config SOC
	default "elemrv_h" if SOC_ELEMRV_H
```

## soc/aesc/nitrogen/Kconfig
```kconfig
# SPDX-FileCopyrightText: 2025 Aesc Silicon
# SPDX-License-Identifier: Apache-2.0

config SOC_SERIES_NITROGEN
	select RISCV
	select RISCV_PRIVILEGED
	select RISCV_HAS_PLIC
	select INCLUDE_RESET_VECTOR
	select PINCTRL

config SOC_PART_NUMBER
	default "elemrv_n" if SOC_ELEMRV_N
```

## soc/aesc/nitrogen/Kconfig.defconfig
```kconfig
# SPDX-FileCopyrightText: 2025 Aesc Silicon
# SPDX-License-Identifier: Apache-2.0

if SOC_SERIES_NITROGEN

config SYS_CLOCK_HW_CYCLES_PER_SEC
	default $(dt_node_int_prop_int,/cpus/cpu@0,clock-frequency)

config RISCV_SOC_INTERRUPT_INIT
	default y

config 2ND_LVL_ISR_TBL_OFFSET
	default 12

config 2ND_LVL_INTR_00_OFFSET
	default 11

config XIP
	default n

if SOC_ELEMRV_N

config NUM_IRQS
	default 32

endif # SOC_ELEMRV_N

endif # SOC_SERIES_NITROGEN
```

## soc/aesc/nitrogen/Kconfig.soc
```kconfig
# Copyright (c) 2025 Aesc Silicon
# SPDX-License-Identifier: Apache-2.0

config SOC_SERIES_NITROGEN
	bool

config SOC_ELEMRV_N
	bool
	select SOC_SERIES_NITROGEN

config SOC_SERIES
	default "nitrogen" if SOC_SERIES_NITROGEN

config SOC
	default "elemrv_n" if SOC_ELEMRV_N
```

## soc/aifoundry/erbium/Kconfig.defconfig
```kconfig
# Copyright (c) 2026 AIFoundry
# SPDX-License-Identifier: Apache-2.0

if SOC_ERBIUM

config SYS_CLOCK_HW_CYCLES_PER_SEC
	default $(dt_nodelabel_int_prop,mtimer,clock-frequency)

config 2ND_LVL_ISR_TBL_OFFSET
	default 12

config 2ND_LVL_INTR_00_OFFSET
	default 11

config MAX_IRQ_PER_AGGREGATOR
	default 32

config NUM_IRQS
	default 44

# Single-hart timer: arch_proc_id() must return 0 for correct mtimecmp access
config RISCV_HART_MASK
	default 0

# Erbium requires mtvec/stvec to be 4KB aligned.
config RISCV_TRAP_HANDLER_ALIGNMENT
	default 4096

endif
```

## soc/aifoundry/erbium/Kconfig.soc
```kconfig
# Copyright (c) 2026 AIFoundry
# SPDX-License-Identifier: Apache-2.0

config SOC_ERBIUM
	bool

config SOC
	default "erbium" if SOC_ERBIUM
```

## soc/alif/balletto/Kconfig
```kconfig
# SPDX-FileCopyrightText: Copyright Alif Semiconductor
# SPDX-License-Identifier: Apache-2.0

if SOC_FAMILY_BALLETTO

rsource "*/Kconfig"

endif # SOC_FAMILY_BALLETTO
```

## soc/alif/balletto/Kconfig.defconfig
```kconfig
# SPDX-FileCopyrightText: Copyright Alif Semiconductor
# SPDX-License-Identifier: Apache-2.0

# Default configurations applied to the whole Balletto family

if SOC_FAMILY_BALLETTO

# Source series Kconfig files first, so SoCs
# can override the defaults given here
rsource "*/Kconfig.defconfig"

configdefault CLOCK_CONTROL
	default y

configdefault CACHE_MANAGEMENT
	default y

endif # SOC_FAMILY_BALLETTO
```

## soc/alif/balletto/Kconfig.soc
```kconfig
# SPDX-FileCopyrightText: Copyright Alif Semiconductor
# SPDX-License-Identifier: Apache-2.0

config SOC_FAMILY_BALLETTO
	bool

config SOC_FAMILY
	default "balletto" if SOC_FAMILY_BALLETTO

rsource "*/Kconfig.soc"
```

## soc/alif/balletto/b1/Kconfig.defconfig
```kconfig
# SPDX-FileCopyrightText: Copyright Alif Semiconductor
# SPDX-License-Identifier: Apache-2.0

if SOC_SERIES_B1

rsource "Kconfig.defconfig.*"

endif # SOC_SERIES_B1
```

## soc/alif/balletto/b1/Kconfig.soc
```kconfig
# SPDX-FileCopyrightText: Copyright Alif Semiconductor
# SPDX-License-Identifier: Apache-2.0

config SOC_SERIES_B1
	bool
	select SOC_FAMILY_BALLETTO

config SOC_SERIES
	default "b1" if SOC_SERIES_B1

config SOC_AB1C1F4M51820PH0
	bool
	select SOC_SERIES_B1
	help
	  Alif Balletto B1 (AB1C1F4M51820PH0). Single Cortex-M55 core in the
	  High Efficiency Real Time Subsystem (RTSS-HE), optimized for power
	  efficiency with a maximum frequency of 160 MHz.

config SOC
	default "ab1c1f4m51820ph0" if SOC_AB1C1F4M51820PH0
```

## soc/alif/ensemble/Kconfig
```kconfig
# Copyright (c) 2025 Alif Semiconductor
# SPDX-License-Identifier: Apache-2.0

if SOC_FAMILY_ENSEMBLE

config SOC_FAMILY_ENSEMBLE_RTSS
	bool
	select ARM
	select ARMV8_M_DSP
	select ARMV8_1_M_MVEI
	select ARMV8_1_M_MVEF
	select CPU_CORTEX_M55
	select CPU_CORTEX_M_HAS_SYSTICK
	select CPU_CORTEX_M_HAS_DWT
	select CPU_CORTEX_M_HAS_VTOR
	select CPU_HAS_ARM_MPU
	select CPU_HAS_FPU
	select SOC_RESET_HOOK
	select XIP

rsource "*/Kconfig"

endif # SOC_FAMILY_ENSEMBLE
```

## soc/alif/ensemble/Kconfig.defconfig
```kconfig
# Copyright (c) 2025 Alif Semiconductor
# SPDX-License-Identifier: Apache-2.0

# Default configurations applied to the whole Ensemble family

if SOC_FAMILY_ENSEMBLE

# Source series Kconfig files first, so SoCs
# can override the defaults given here
rsource "*/Kconfig.defconfig"

config CLOCK_CONTROL
	default y

config CACHE_MANAGEMENT
	default y

endif # SOC_FAMILY_ENSEMBLE
```

## soc/alif/ensemble/Kconfig.soc
```kconfig
# Copyright (c) 2025 Alif Semiconductor
# SPDX-License-Identifier: Apache-2.0

config SOC_FAMILY_ENSEMBLE
	bool

config SOC_FAMILY
	default "ensemble" if SOC_FAMILY_ENSEMBLE

rsource "*/Kconfig.soc"
```

## soc/alif/ensemble/e1c/Kconfig
```kconfig
# SPDX-FileCopyrightText: Copyright Alif Semiconductor
# SPDX-License-Identifier: Apache-2.0

config SOC_AE1C1F4051920PH0_RTSS_HE
	select SOC_FAMILY_ENSEMBLE_RTSS
```

## soc/alif/ensemble/e1c/Kconfig.defconfig
```kconfig
# SPDX-FileCopyrightText: Copyright Alif Semiconductor
# SPDX-License-Identifier: Apache-2.0

if SOC_SERIES_E1C

rsource "Kconfig.defconfig.*"

endif # SOC_SERIES_E1C
```

## soc/alif/ensemble/e1c/Kconfig.soc
```kconfig
# SPDX-FileCopyrightText: Copyright Alif Semiconductor
# SPDX-License-Identifier: Apache-2.0

config SOC_SERIES_E1C
	bool
	select SOC_FAMILY_ENSEMBLE

config SOC_SERIES
	default "e1c" if SOC_SERIES_E1C

config SOC_AE1C1F4051920PH0
	bool
	select SOC_SERIES_E1C
	help
	  Alif Ensemble E1C (AE1C1F4051920PH0)

config SOC_AE1C1F4051920PH0_RTSS_HE
	bool
	select SOC_AE1C1F4051920PH0
	help
	  AE1C1F4051920PH0 High Efficiency Real Time Subsystem (RTSS-HE).
	  Cortex-M55 core optimized for power efficiency with a maximum frequency of 160 MHz.

config SOC
	default "ae1c1f4051920ph0" if SOC_AE1C1F4051920PH0
```

## soc/alif/ensemble/e4/Kconfig.defconfig
```kconfig
# SPDX-FileCopyrightText: Copyright Alif Semiconductor
# SPDX-License-Identifier: Apache-2.0

if SOC_SERIES_E4

rsource "Kconfig.defconfig.*"

endif # SOC_SERIES_E4
```

## soc/alif/ensemble/e4/Kconfig.defconfig.ae402fa0e5597le0_rtss_hp
```kconfig
# SPDX-FileCopyrightText: Copyright Alif Semiconductor
# SPDX-License-Identifier: Apache-2.0

if SOC_AE402FA0E5597LE0_RTSS_HP

config NUM_IRQS
	default 480

config SYS_CLOCK_HW_CYCLES_PER_SEC
	default $(dt_node_int_prop_int,/cpus/cpu@0,clock-frequency)

endif # SOC_AE402FA0E5597LE0_RTSS_HP
```

## soc/alif/ensemble/e4/Kconfig.soc
```kconfig
# SPDX-FileCopyrightText: Copyright Alif Semiconductor
# SPDX-License-Identifier: Apache-2.0

config SOC_SERIES_E4
	bool
	select SOC_FAMILY_ENSEMBLE

config SOC_SERIES
	default "e4" if SOC_SERIES_E4

config SOC_AE402FA0E5597LE0
	bool
	select SOC_SERIES_E4
	help
	  Alif Ensemble E4 (AE402FA0E5597LE0)

config SOC_AE402FA0E5597LE0_RTSS_HE
	bool
	select SOC_AE402FA0E5597LE0
	help
	  AE402FA0E5597LE0 High Efficiency Real Time Subsystem (RTSS-HE).
	  Cortex-M55 core optimized for power efficiency with a maximum frequency of 160 MHz.

config SOC_AE402FA0E5597LE0_RTSS_HP
	bool
	select SOC_AE402FA0E5597LE0
	help
	  AE402FA0E5597LE0 High Performance Real Time Subsystem (RTSS-HP).
	  Cortex-M55 core optimized for compute performance with a maximum frequency of 400 MHz.

config SOC
	default "ae402fa0e5597le0" if SOC_AE402FA0E5597LE0
```

## soc/alif/ensemble/e6/Kconfig
```kconfig
# SPDX-FileCopyrightText: Copyright Alif Semiconductor
# SPDX-License-Identifier: Apache-2.0

config SOC_AE612FA0E5597LS0_RTSS_HE
	select SOC_FAMILY_ENSEMBLE_RTSS

config SOC_AE612FA0E5597LS0_RTSS_HP
	select SOC_FAMILY_ENSEMBLE_RTSS
```

## soc/alif/ensemble/e6/Kconfig.defconfig
```kconfig
# SPDX-FileCopyrightText: Copyright Alif Semiconductor
# SPDX-License-Identifier: Apache-2.0

if SOC_SERIES_E6

rsource "Kconfig.defconfig.*"

endif # SOC_SERIES_E6
```

## soc/alif/ensemble/e8/Kconfig
```kconfig
# Copyright (c) 2025 Alif Semiconductor
# SPDX-License-Identifier: Apache-2.0

config SOC_SERIES_E8_RTSS
	bool
	select ARM
	select ARMV8_M_DSP
	select ARMV8_1_M_MVEI
	select ARMV8_1_M_MVEF
	select CPU_CORTEX_M55
	select CPU_CORTEX_M_HAS_SYSTICK
	select CPU_CORTEX_M_HAS_DWT
	select CPU_CORTEX_M_HAS_VTOR
	select CPU_HAS_ARM_MPU
	select CPU_HAS_FPU
	select SOC_RESET_HOOK
	select XIP

config SOC_AE822FA0E5597LS0_RTSS_HE
	select SOC_SERIES_E8_RTSS

config SOC_AE822FA0E5597LS0_RTSS_HP
	select SOC_SERIES_E8_RTSS
```
