## soc/renode/cortex_r8_virtual/Kconfig
```kconfig
# Copyright (c) 2024 Antmicro <www.antmicro.com>
# SPDX-License-Identifier: Apache-2.0

config SOC_CORTEX_R8_VIRTUAL
	select ARM
	select CPU_CORTEX_R8
	select PLATFORM_SPECIFIC_INIT
	select CPU_HAS_ARM_MPU
	select VFP_DP_D16
```

## soc/renode/cortex_r8_virtual/Kconfig.defconfig
```kconfig
# Copyright (c) 2024 Antmicro <www.antmicro.com>
# SPDX-License-Identifier: Apache-2.0

if SOC_CORTEX_R8_VIRTUAL

config NUM_IRQS
	default 220

config SYS_CLOCK_HW_CYCLES_PER_SEC
	default 5000000

DT_CHOSEN_Z_FLASH := zephyr,flash

config FLASH_SIZE
	default $(dt_chosen_reg_size_int,$(DT_CHOSEN_Z_FLASH),0,K)

config FLASH_BASE_ADDRESS
	default $(dt_chosen_reg_addr_hex,$(DT_CHOSEN_Z_FLASH))

endif # SOC_CORTEX_R8_VIRTUAL
```

## soc/renode/cortex_r8_virtual/Kconfig.soc
```kconfig
# Copyright (c) 2024 Antmicro <www.antmicro.com>
# SPDX-License-Identifier: Apache-2.0

config SOC_CORTEX_R8_VIRTUAL
	bool
	help
	  Cortex R8 Virtual system implementation

config SOC
	default "cortex_r8_virtual" if SOC_CORTEX_R8_VIRTUAL
```

## soc/renode/riscv_virtual/Kconfig
```kconfig
# Copyright (c) 2023 Meta
# SPDX-License-Identifier: Apache-2.0

config SOC_RISCV_VIRTUAL_RENODE
	select RISCV
	select RISCV_PRIVILEGED
	select INCLUDE_RESET_VECTOR
	select RISCV_HAS_PLIC
	select RISCV_SOC_HAS_GP_RELATIVE_ADDRESSING
	imply XIP
```

## soc/renode/riscv_virtual/Kconfig.soc
```kconfig
# Copyright (c) 2023 Meta
# SPDX-License-Identifier: Apache-2.0

config SOC_RISCV_VIRTUAL_RENODE
	bool
	help
	  Renode RISCV32 Virtual system implementation

config SOC
	default "riscv_virtual_renode" if SOC_RISCV_VIRTUAL_RENODE
```

## soc/riscv/Kconfig
```kconfig
# General options of RISC-V SoCs

# Copyright (c) 2021 Jim Shu
# SPDX-License-Identifier: Apache-2.0

config CPU_HAS_CUSTOM_FIXED_SOC_PMP_REGIONS
	bool "Custom fixed SoC PMP region definition"
	depends on RISCV_PMP
	help
	  If enabled, this option signifies that the SoC will
	  define and configure its own fixed PMP regions in the
	  SoC definition. These fixed PMP regions are currently
	  used to set ROM and RAM default access policies and
	  they are programmed at boot time.
```

## soc/riscv/andes_v5/Kconfig
```kconfig
# Copyright (c) 2024 Nordic Semiconductor ASA
# SPDX-License-Identifier: Apache-2.0

config SOC_FAMILY_ANDES_V5
	bool

if SOC_FAMILY_ANDES_V5

config SOC_FAMILY
	string
	default "andes_v5"

source "soc/riscv/andes_v5/*/Kconfig.soc"

endif # SOC_FAMILY_ANDES_V5
```

## soc/riscv/andes_v5/Kconfig.soc
```kconfig
# Copyright (c) 2024 Nordic Semiconductor ASA
# SPDX-License-Identifier: Apache-2.0

source "soc/riscv/andes_v5/*/Kconfig.series"
```

## soc/riscv/andes_v5/ae350/Kconfig.series
```kconfig
# Copyright (c) 2021 Andes Technology Corporation
# SPDX-License-Identifier: Apache-2.0

config SOC_SERIES_ANDES_AE350
	bool "Andes V5 AE350 SoC Series Implementation"
	select RISCV
	select RISCV_PRIVILEGED
	select RISCV_HAS_PLIC
	select SOC_FAMILY_ANDES_V5
	help
	  Enable support for Andes V5 AE350 SoC Series
```

## soc/riscv/andes_v5/hpmicro/Kconfig.defconfig.series
```kconfig
# Copyright (c) 2024 HPMicro
# SPDX-License-Identifier: Apache-2.0

if SOC_SERIES_ANDES_HPMICRO

config SOC_SERIES
	default "hpmicro"

config SYS_CLOCK_HW_CYCLES_PER_SEC
	default 24000000

config SYS_CLOCK_TICKS_PER_SEC
	default 1000

config MAIN_STACK_SIZE
	default 4096

config IDLE_STACK_SIZE
	default 2048

config TEST_EXTRA_STACK_SIZE
	default 2048

config 2ND_LVL_ISR_TBL_OFFSET
	default 12

config 2ND_LVL_INTR_00_OFFSET
	default 11

config MAX_IRQ_PER_AGGREGATOR
	default 112

config NUM_IRQS
	default 128

source "soc/riscv/andes_v5/hpmicro/*/Kconfig.defconfig.series"

endif # SOC_SERIES_ANDES_HPMICRO
```

## soc/riscv/andes_v5/hpmicro/Kconfig.series
```kconfig
# Copyright (c) 2024 HPMicro
# SPDX-License-Identifier: Apache-2.0

config SOC_SERIES_ANDES_HPMICRO
	bool "Andes V5 HPMicro SoC Series Implementation"
	select RISCV
	select RISCV_ISA_RV32I
	select RISCV_ISA_EXT_M
	select RISCV_ISA_EXT_A
	select RISCV_ISA_EXT_ZICSR
	select RISCV_ISA_EXT_ZIFENCEI
	select RISCV_PRIVILEGED
	select SOC_FAMILY_ANDES_V5
	select HAS_HPMICRO_HAL
	select RISCV_HAS_PLIC
	select CPU_HAS_FPU
	select ATOMIC_OPERATIONS_BUILTIN
	select ATOMIC_OPERATIONS_C
	select INCLUDE_RESET_VECTOR
	help
	  Enable support for Andes V5 HPMicro SoC Series

if SOC_SERIES_ANDES_HPMICRO

source "soc/riscv/andes_v5/hpmicro/*/Kconfig.series"

endif # SOC_SERIES_ANDES_HPMICRO
```

## soc/riscv/andes_v5/hpmicro/Kconfig.soc
```kconfig
# Copyright (c) 2024 HPMicro
# SPDX-License-Identifier: Apache-2.0

if SOC_SERIES_ANDES_HPMICRO

source "soc/riscv/andes_v5/hpmicro/*/Kconfig.soc"

endif # SOC_SERIES_ANDES_HPMICRO
```

## soc/riscv/andes_v5/hpmicro/hpm53xx/Kconfig.defconfig.series
```kconfig
# Copyright (c) 2024 HPMicro
# SPDX-License-Identifier: Apache-2.0

if SOC_SERIES_HPM53XX

if SOC_HPM5301 || SOC_HPM5321 || SOC_HPM5331

config SOC
	default "hpm5301"

endif

if SOC_HPM5361

config SOC
	default "hpm5361"

endif

endif # SOC_SERIES_HPM53XX
```

## soc/riscv/andes_v5/hpmicro/hpm53xx/Kconfig.series
```kconfig
# Copyright (c) 2024 HPMicro
# SPDX-License-Identifier: Apache-2.0

config SOC_SERIES_HPM53XX
	bool "HPM53XX Series MCU"
	select RISCV
	help
	  Enable support for HPM53XX MCU series
```

## soc/riscv/andes_v5/hpmicro/hpm53xx/Kconfig.soc
```kconfig
# Copyright (c) 2024 HPMicro
# SPDX-License-Identifier: Apache-2.0

choice
	prompt "HPM53XX MCU Selection"
	depends on SOC_SERIES_HPM53XX

config SOC_HPM5301
	bool "HPM5301"

config SOC_HPM5321
	bool "HPM5321"

config SOC_HPM5331
	bool "HPM5331"

config SOC_HPM5361
	bool "HPM5361"

endchoice
```

## soc/riscv/andes_v5/hpmicro/hpm62xx/Kconfig.defconfig.series
```kconfig
# Copyright (c) 2024 HPMicro
# SPDX-License-Identifier: Apache-2.0

if SOC_SERIES_HPM62XX

config SOC
	default "hpm6280"

endif # SOC_SERIES_HPM62XX
```

## soc/riscv/andes_v5/hpmicro/hpm62xx/Kconfig.series
```kconfig
# Copyright (c) 2024 HPMicro
# SPDX-License-Identifier: Apache-2.0

config SOC_SERIES_HPM62XX
	bool "HPM62XX Series MCU"
	select RISCV
	help
	  Enable support for HPM62XX MCU series
```

## soc/riscv/andes_v5/hpmicro/hpm62xx/Kconfig.soc
```kconfig
# Copyright (c) 2024 HPMicro
# SPDX-License-Identifier: Apache-2.0

choice
	prompt "HPM62XX MCU Selection"
	depends on SOC_SERIES_HPM62XX

config SOC_HPM628X
	bool "HPM628X"

config SOC_HPM626X
	bool "HPM626X"

config SOC_HPM6240
	bool "HPM6240"

config SOC_HPM6220
	bool "HPM6220"

endchoice
```

## soc/riscv/andes_v5/hpmicro/hpm63xx/Kconfig.defconfig.series
```kconfig
# Copyright (c) 2024 HPMicro
# SPDX-License-Identifier: Apache-2.0

if SOC_SERIES_HPM63XX

config SOC
	default "hpm6360"

endif # SOC_SERIES_HPM63XX
```

## soc/riscv/andes_v5/hpmicro/hpm63xx/Kconfig.series
```kconfig
# Copyright (c) 2024 HPMicro
# SPDX-License-Identifier: Apache-2.0

config SOC_SERIES_HPM63XX
	bool "HPM63XX Series MCU"
	select RISCV
	help
	  Enable support for HPM63XX MCU series
```

## soc/riscv/andes_v5/hpmicro/hpm63xx/Kconfig.soc
```kconfig
# Copyright (c) 2024 HPMicro
# SPDX-License-Identifier: Apache-2.0

choice
	prompt "HPM63XX MCU Selection"
	depends on SOC_SERIES_HPM63XX

config SOC_HPM636X
	bool "HPM636X"

config SOC_HPM6350
	bool "HPM6350"

config SOC_HPM6340
	bool "HPM6340"

config SOC_HPM6330
	bool "HPM6330"

config SOC_HPM6320
	bool "HPM6320"

endchoice
```

## soc/riscv/andes_v5/hpmicro/hpm67xx_64xx/Kconfig.defconfig.series
```kconfig
# Copyright (c) 2024 HPMicro
# SPDX-License-Identifier: Apache-2.0

if SOC_SERIES_HPM67XX_64XX

config SOC
	default "hpm6750"

endif # SOC_SERIES_HPM67XX_64XX
```

## soc/riscv/andes_v5/hpmicro/hpm67xx_64xx/Kconfig.series
```kconfig
# Copyright (c) 2024 HPMicro
# SPDX-License-Identifier: Apache-2.0

config SOC_SERIES_HPM67XX_64XX
	bool "HPM67XX or HPM64XX Series MCU"
	select RISCV
	help
	  Enable support for HPM67XX or HPM64XX MCU series
```

## soc/riscv/andes_v5/hpmicro/hpm67xx_64xx/Kconfig.soc
```kconfig
# Copyright (c) 2024 HPMicro
# SPDX-License-Identifier: Apache-2.0

choice
	prompt "HPM67XX or HPM64XX MCU Selection"
	depends on SOC_SERIES_HPM67XX_64XX

config SOC_HPM6730
	bool "HPM6730"

config SOC_HPM675X
	bool "HPM675X"

config SOC_HPM645X
	bool "HPM645X"

config SOC_HPM64G0
	bool "HPM64G0"

endchoice
```

## soc/riscv/andes_v5/hpmicro/hpm68xx/Kconfig.defconfig.series
```kconfig
# Copyright (c) 2024 HPMicro
# SPDX-License-Identifier: Apache-2.0

if SOC_SERIES_HPM68XX

config SOC
	default "hpm6800"

endif # SOC_SERIES_HPM68XX
```
