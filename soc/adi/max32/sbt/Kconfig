## soc/adi/max32/sbt/Kconfig
```kconfig
# Copyright (c) 2026 Analog Devices, Inc.
# SPDX-License-Identifier: Apache-2.0

config SOC_FAMILY_MAX32_SECURE_SOC_SIGNING
	bool "Secure SoC image signing"
	depends on SOC_FAMILY_MAX32_SECURE_BOOT_SUPPORTED
	select HAVE_CUSTOM_LINKER_SCRIPT
	select BUILD_OUTPUT_HEX_GAP_FILL if BUILD_OUTPUT_HEX
	help
	  Select this option to enable image signing for secure SoCs. It is
	  required to set the linker configurations and enable image signing.

if SOC_FAMILY_MAX32_SECURE_SOC_SIGNING

config SOC_FAMILY_MAX32_SECURE_SOC_KEY_PATH
	string "Secure SoC's key path"
	help
	  Path to the private key used to sign the image. This is used by the
	  signing tool to sign the image.

choice SOC_FAMILY_MAX32_SECURE_SOC_SIGNING_ALGO
	prompt "Secure SoC signing algorithm"
	default SOC_FAMILY_MAX32_SECURE_SOC_SIGNING_ALGO_RSA2048
	help
	  Signing algorithm used for secure boot image signing. Set for each
	  SoC in Kconfig.defconfig files.

config SOC_FAMILY_MAX32_SECURE_SOC_SIGNING_ALGO_RSA2048
	bool "Secure SoC signing algorithm RSA2048"
	help
	  RSA2048 is the signing algorithm for this SoC.

config SOC_FAMILY_MAX32_SECURE_SOC_SIGNING_ALGO_ECDSA256
	bool "Secure SoC signing algorithm ECDSA256"
	help
	  ECDSA256 is the signing algorithm for this SoC.

endchoice

config SOC_FAMILY_MAX32_SECURE_SOC_SIGNATURE_SECTION_SIZE
	int
	default 256 if SOC_FAMILY_MAX32_SECURE_SOC_SIGNING_ALGO_RSA2048
	default 64 if SOC_FAMILY_MAX32_SECURE_SOC_SIGNING_ALGO_ECDSA256
	help
	  Size of the signature section reserved during linking. This is determined
	  by the selected signing algorithm.

endif
```

## soc/aifoundry/erbium/Kconfig
```kconfig
# Copyright (c) 2026 AIFoundry
# SPDX-License-Identifier: Apache-2.0

config SOC_ERBIUM
	select RISCV
	select RISCV_PRIVILEGED
	select RISCV_HAS_PLIC
	select INCLUDE_RESET_VECTOR
	select CPU_HAS_DCACHE
	select CPU_HAS_ICACHE
	select ARCH_HAS_CUSTOM_CPU_IDLE
	select ARCH_HAS_CUSTOM_CPU_ATOMIC_IDLE
```

## soc/allwinner/Kconfig.soc
```kconfig
# SPDX-FileCopyrightText: Copyright The Zephyr Project Contributors
# SPDX-License-Identifier: Apache-2.0

config SOC_FAMILY_ALLWINNER
	bool

config SOC_FAMILY
	default "allwinner" if SOC_FAMILY_ALLWINNER

rsource "*/Kconfig.soc"
```

## soc/allwinner/t153/Kconfig.defconfig
```kconfig
# SPDX-FileCopyrightText: Copyright The Zephyr Project Contributors
# SPDX-License-Identifier: Apache-2.0

if SOC_T153_E907

configdefault NUM_IRQS
	default 256

configdefault RISCV_MCAUSE_EXCEPTION_MASK
	default 0xFFF

endif # SOC_T153_E907
```

## soc/allwinner/t153/Kconfig.soc
```kconfig
# SPDX-FileCopyrightText: Copyright The Zephyr Project Contributors
# SPDX-License-Identifier: Apache-2.0

config SOC_T153_E907
	bool

config SOC
	default "t153" if SOC_T153_E907
```

## soc/allwinner/v851s/Kconfig.defconfig
```kconfig
# SPDX-FileCopyrightText: Copyright The Zephyr Project Contributors
# SPDX-License-Identifier: Apache-2.0

if SOC_SERIES_V851S

configdefault SYS_CLOCK_TICKS_PER_SEC
	default 1000

configdefault NUM_IRQS
	default 256

configdefault RISCV_MCAUSE_EXCEPTION_MASK
	default 0xFFF

endif # SOC_SERIES_V851S
```

## soc/allwinner/v851s/Kconfig.soc
```kconfig
# SPDX-FileCopyrightText: Copyright The Zephyr Project Contributors
# SPDX-License-Identifier: Apache-2.0

config SOC_SERIES_V851S
	bool
	select SOC_FAMILY_ALLWINNER
	help
	  Allwinner V851S E907 RISC-V co-processor.

	  The E907 integrates a CLINT and a CLIC (CLIC spec 0.8), not a PLIC.
	  CPU_XUANTIE_E907 selects RISCV_HAS_CLIC, RISCV_VECTORED_MODE,
	  GEN_IRQ_VECTOR_TABLE, RISCV_MACHINE_TIMER and the reset vector, which
	  is exactly the interrupt path used by the BL808 E907 BSP.

config SOC_SERIES
	default "v851s" if SOC_SERIES_V851S

config SOC_V851S_E907
	bool
	select SOC_SERIES_V851S

config SOC
	default "v851s_e907" if SOC_V851S_E907
```

## soc/andestech/ae350/Kconfig
```kconfig
# Copyright (c) 2021 Andes Technology Corporation
# SPDX-License-Identifier: Apache-2.0

config SOC_SERIES_AE350
	select RISCV
	select RISCV_SOC_CONTEXT_SAVE if RISCV_CUSTOM_CSR_ANDES_HWDSP
	select RISCV_SOC_CONTEXT_SAVE if RISCV_CUSTOM_CSR_ANDES_PFT
	select SOC_EARLY_INIT_HOOK if RISCV_CUSTOM_CSR_ANDES_PMA
	select SOC_PER_CORE_INIT_HOOK if RISCV_CUSTOM_CSR_ANDES_PMA
	imply XIP

if SOC_SERIES_AE350

config SOC_AE350
	select DEPRECATED
	select RISCV_PRIVILEGED
	select RISCV_PMP
	select RISCV_SOC_HAS_GP_RELATIVE_ADDRESSING
	select CPU_HAS_DCACHE
	select CPU_HAS_ICACHE
	select CPU_HAS_ANDES_EXECIT
	select CPU_HAS_ANDES_HWDSP
	select CPU_HAS_ANDES_PFT
	select CPU_HAS_ANDES_PMA
	select CPU_HAS_ANDES_HSP

choice SOC_AE350_INTERRUPT_TYPE
	prompt "Base interrupt type"
	default SOC_AE350_INTERRUPT_TYPE_PLIC

config SOC_AE350_INTERRUPT_TYPE_PLIC
	bool "PLIC"
	select RISCV_HAS_PLIC

config SOC_AE350_INTERRUPT_TYPE_CLIC
	bool "CLIC"
	depends on CPU_ANDES_N22 || CPU_ANDES_N225 || CPU_ANDES_D23
	select RISCV_HAS_CLIC
	select CLIC_SMCLICSHV_EXT if RISCV_VECTORED_MODE
	select CLIC_SMCLICCONFIG_EXT
	select LEGACY_CLIC_MEMORYMAP_ACCESS

endchoice

config SOC_ANDES_V5_IOCP
	bool "Andes V5 I/O Coherence Port (IOCP)"
	depends on DCACHE
	depends on CPU_ANDES_A25 || CPU_ANDES_AX25 || CPU_ANDES_A45 || CPU_ANDES_AX45 || \
		CPU_ANDES_A46 || CPU_ANDES_AX46 || CPU_ANDES_AX65
	help
	  Support Andes V5 I/O Coherence Port to handle cache coherency between cache and external
	  non-caching master, such as DMA controller.

endif # SOC_SERIES_AE350
```

## soc/andestech/ae350/Kconfig.soc
```kconfig
# Copyright (c) 2021 Andes Technology Corporation
# SPDX-License-Identifier: Apache-2.0

config SOC_SERIES_AE350
	bool
	select SOC_FAMILY_ANDES_V5
	help
	  Andes V5 AE350 SoC Series Implementation"

config SOC_AE350
	bool
	select SOC_SERIES_AE350
	help
	  Deprecated Kconfig, use SOC_AE350_<core> instead

config SOC_AE350_N22
	bool
	select SOC_SERIES_AE350
	help
	  Andes AE350 SoC with 32-bit AndesCore N22 core

config SOC_AE350_N225
	bool
	select SOC_SERIES_AE350
	help
	  Andes AE350 SoC with 32-bit AndesCore N225 core

config SOC_AE350_D23
	bool
	select SOC_SERIES_AE350
	help
	  Andes AE350 SoC with 32-bit AndesCore D23 core

config SOC_AE350_N25F
	bool
	select SOC_SERIES_AE350
	help
	  Andes AE350 SoC with 32-bit AndesCore N25F core

config SOC_AE350_D25F
	bool
	select SOC_SERIES_AE350
	help
	  Andes AE350 SoC with 32-bit AndesCore D25F core

config SOC_AE350_A25
	bool
	select SOC_SERIES_AE350
	help
	  Andes AE350 SoC with 32-bit AndesCore A25 core

config SOC_AE350_NX25F
	bool
	select SOC_SERIES_AE350
	help
	  Andes AE350 SoC with 64-bit AndesCore NX25F core

config SOC_AE350_AX25
	bool
	select SOC_SERIES_AE350
	help
	  Andes AE350 SoC with 64-bit AndesCore AX25 core

config SOC_AE350_A27
	bool
	select SOC_SERIES_AE350
	help
	  Andes AE350 SoC with 32-bit AndesCore A27 core

config SOC_AE350_AX27
	bool
	select SOC_SERIES_AE350
	help
	  Andes AE350 SoC with 64-bit AndesCore AX27 core

config SOC_AE350_N45
	bool
	select SOC_SERIES_AE350
	help
	  Andes AE350 SoC with 32-bit AndesCore N45 core

config SOC_AE350_D45
	bool
	select SOC_SERIES_AE350
	help
	  Andes AE350 SoC with 32-bit AndesCore D45 core

config SOC_AE350_A45
	bool
	select SOC_SERIES_AE350
	help
	  Andes AE350 SoC with 32-bit AndesCore A45 core

config SOC_AE350_NX45
	bool
	select SOC_SERIES_AE350
	help
	  Andes AE350 SoC with 64-bit AndesCore NX45 core

config SOC_AE350_AX45
	bool
	select SOC_SERIES_AE350
	help
	  Andes AE350 SoC with 64-bit AndesCore AX45 core

config SOC_AE350_A46
	bool
	select SOC_SERIES_AE350
	help
	  Andes AE350 SoC with 32-bit AndesCore A46 core

config SOC_AE350_AX46
	bool
	select SOC_SERIES_AE350
	help
	  Andes AE350 SoC with 64-bit AndesCore AX46 core

config SOC_AE350_AX65
	bool
	select SOC_SERIES_AE350
	help
	  Andes AE350 SoC with 64-bit AndesCore AX65 core

config SOC_SERIES
	default "ae350" if SOC_SERIES_AE350

config SOC
	default "ae350" if SOC_AE350
	default "ae350_n22" if SOC_AE350_N22
	default "ae350_n225" if SOC_AE350_N225
	default "ae350_d23" if SOC_AE350_D23
	default "ae350_n25f" if SOC_AE350_N25F
	default "ae350_d25f" if SOC_AE350_D25F
	default "ae350_a25" if SOC_AE350_A25
	default "ae350_nx25f" if SOC_AE350_NX25F
	default "ae350_ax25" if SOC_AE350_AX25
	default "ae350_a27" if SOC_AE350_A27
	default "ae350_ax27" if SOC_AE350_AX27
	default "ae350_n45" if SOC_AE350_N45
	default "ae350_d45" if SOC_AE350_D45
	default "ae350_a45" if SOC_AE350_A45
	default "ae350_nx45" if SOC_AE350_NX45
	default "ae350_ax45" if SOC_AE350_AX45
	default "ae350_a46" if SOC_AE350_A46
	default "ae350_ax46" if SOC_AE350_AX46
	default "ae350_ax65" if SOC_AE350_AX65
```

## soc/andestech/common/Kconfig.defconfig
```kconfig
# Copyright (c) 2026 Andes Technology Corporation
# SPDX-License-Identifier: Apache-2.0

configdefault PMP_GRANULARITY
	default 4096 if CPU_ANDES_AX65
	default 4 if CPU_ANDES_N22
	default 8

configdefault PMP_NO_TOR
	default y if CPU_ANDES_N22

configdefault NULL_POINTER_EXCEPTION_REGION_SIZE
	default 0x1000 if CPU_ANDES_AX65
```

## soc/arm/fvp_aem/Kconfig
```kconfig
# Copyright (c) 2021 Carlo Caione <ccaione@baylibre.com>
# SPDX-License-Identifier: Apache-2.0

config SOC_V8A
	select ARM64
	select CPU_CORTEX_A53

config SOC_V9A
	select ARM64
	select CPU_CORTEX_A510

config SOC_A320
	select ARM64
	select CPU_CORTEX_A320

config SOC_V8A_AARCH32
	select ARM
	select CPU_CORTEX_A32
```

## soc/arm/mps2/Kconfig.defconfig
```kconfig
# Copyright (c) 2017 Linaro Limited
# SPDX-License-Identifier: Apache-2.0

if SOC_SERIES_MPS2

rsource "Kconfig.defconfig.*"

endif # SOC_SERIES_MPS2
```

## soc/arm/mps3/Kconfig.defconfig.mps3_an524
```kconfig
# Copyright 2026 Arm Limited and/or its affiliates <open-source-office@arm.com>
# SPDX-License-Identifier: Apache-2.0

if SOC_AN524

config NUM_IRQS
	default 128

endif
```

## soc/arm/mps3/Kconfig.soc
```kconfig
# Copyright (c) 2017-2021 Linaro Limited
# Copyright 2024 Arm Limited and/or its affiliates <open-source-office@arm.com>
# SPDX-License-Identifier: Apache-2.0

config SOC_SERIES_MPS3
	bool
	select SOC_FAMILY_ARM
	help
	  Enable support for ARM MPS3 MCU Series

config SOC_SERIES
	default "mps3" if SOC_SERIES_MPS3

config SOC_CORSTONE300
	bool
	select SOC_SERIES_MPS3

config SOC_CORSTONE310
	bool
	select SOC_SERIES_MPS3

config SOC_AN524
	bool
	select SOC_SERIES_MPS3

config SOC_AN524_CPU0
	bool
	select SOC_AN524
	help
	  ARM Cortex-M33 SMM-SSE-200 on V2M-MPS3 (AN524) CPU0

config SOC_AN524_CPU1
	bool
	select SOC_AN524
	help
	  ARM Cortex-M33 SMM-SSE-200 on V2M-MPS3 (AN524) CPU1

config SOC
	default "corstone300" if SOC_CORSTONE300
	default "corstone310" if SOC_CORSTONE310
	default "an524" if SOC_AN524
```

## soc/arm/musca/Kconfig.defconfig
```kconfig
# Copyright (c) 2019 Linaro Limited
# SPDX-License-Identifier: Apache-2.0

config NUM_IRQS
	default 96 if SOC_SERIES_MUSCA
```

## soc/arm/qemu_cortex_a53/Kconfig
```kconfig
# Copyright (c) 2019 Carlo Caione <ccaione@baylibre.com>
# SPDX-License-Identifier: Apache-2.0

config SOC_QEMU_CORTEX_A53
	select ARM64 if QEMU_CORTEX_A53_EXECUTION_STATE_AARCH64
	select CPU_CORTEX_A53 if QEMU_CORTEX_A53_EXECUTION_STATE_AARCH64
	select ARM if QEMU_CORTEX_A53_EXECUTION_STATE_AARCH32
	select CPU_CORTEX_A53_AARCH32 if QEMU_CORTEX_A53_EXECUTION_STATE_AARCH32
	select QEMU_TARGET
```

## soc/arm/qemu_cortex_a53/Kconfig.soc
```kconfig
# Copyright (c) 2019 Carlo Caione <ccaione@baylibre.com>
# SPDX-License-Identifier: Apache-2.0

config QEMU_CORTEX_A53_EXECUTION_STATE_AARCH64
	bool
	default y if !QEMU_CORTEX_A53_EXECUTION_STATE_AARCH32

config QEMU_CORTEX_A53_EXECUTION_STATE_AARCH32
	bool

config SOC_QEMU_CORTEX_A53
	bool
	select SOC_FAMILY_ARM64 if QEMU_CORTEX_A53_EXECUTION_STATE_AARCH64
	select SOC_FAMILY_ARM if QEMU_CORTEX_A53_EXECUTION_STATE_AARCH32

config SOC
	default "qemu_cortex_a53" if SOC_QEMU_CORTEX_A53
```

## soc/arm/qemu_cortex_a7/Kconfig
```kconfig
# Copyright (c) Qualcomm Technologies, Inc. and/or its subsidiaries.
# SPDX-License-Identifier: Apache-2.0

config SOC_QEMU_CORTEX_A7
	select ARM
	select CPU_CORTEX_A7
	select QEMU_TARGET
```

## soc/arm/qemu_cortex_a7/Kconfig.soc
```kconfig
# Copyright (c) Qualcomm Technologies, Inc. and/or its subsidiaries.
# SPDX-License-Identifier: Apache-2.0

config SOC_QEMU_CORTEX_A7
	bool
	select SOC_FAMILY_ARM

config SOC
	default "qemu_cortex_a7" if SOC_QEMU_CORTEX_A7
```

## soc/arm/versatile/Kconfig
```kconfig
# Copyright (c) 2026 Takayuki Goto
# SPDX-License-Identifier: Apache-2.0

config SOC_SERIES_VERSATILE
	select ARM
	select CPU_ARM926EJ_S
```
