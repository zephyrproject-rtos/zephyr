## soc/soc_legacy/riscv/andes_v5/Kconfig.defconfig
```kconfig
# Copyright (c) 2024 Nordic Semiconductor ASA
# SPDX-License-Identifier: Apache-2.0

source "soc/soc_legacy/riscv/andes_v5/*/Kconfig.defconfig.series"
```

## soc/soc_legacy/riscv/common/Kconfig
```kconfig
# Copyright (c) 2024 Nordic Semiconductor ASA
# SPDX-License-Identifier: Apache-2.0
#
source "soc/soc_legacy/riscv/common/riscv-privileged/Kconfig"
```

## soc/soc_legacy/riscv/efinix_sapphire/Kconfig.defconfig
```kconfig
# Copyright (c) 2023 Efinix Inc.
# SPDX-License-Identifier: Apache-2.0

if SOC_EFINIX_SAPPHIRE

config SOC
	default "efinix_sapphire"

config SYS_CLOCK_HW_CYCLES_PER_SEC
	default 100000000

config RISCV_SOC_INTERRUPT_INIT
	bool
	default y

config NUM_IRQS
	int
	default 36

config 2ND_LVL_INTR_00_OFFSET
	default 11

endif # SOC_EFINIX_SAPPHIRE
```

## soc/soc_legacy/riscv/espressif_esp32/Kconfig.defconfig
```kconfig
# Copyright (c) 2023 Espressif Systems (Shanghai) Co., Ltd.
# SPDX-License-Identifier: Apache-2.0

source "soc/soc_legacy/riscv/espressif_esp32/common/Kconfig.defconfig.series"
source "soc/soc_legacy/riscv/espressif_esp32/*/Kconfig.defconfig.series"
```

## soc/soc_legacy/riscv/espressif_esp32/esp32c3/Kconfig.defconfig.series
```kconfig
# Copyright (c) 2023 Espressif Systems (Shanghai) Co., Ltd.
# SPDX-License-Identifier: Apache-2.0

if SOC_SERIES_ESP32C3

config SOC_SERIES
	default "esp32c3"

config NUM_IRQS
	default 62

config ESPTOOLPY_FLASHFREQ_80M
	default y

config FLASH_SIZE
	default $(dt_node_reg_size_int,/soc/flash-controller@60002000/flash@0,0)

config FLASH_BASE_ADDRESS
	default $(dt_node_reg_addr_hex,/soc/flash-controller@60002000/flash@0)

endif # SOC_SERIES_ESP32C3
```

## soc/soc_legacy/riscv/gd_gd32/Kconfig.soc
```kconfig
# Copyright (c) 2024 Nordic Semiconductor ASA
# SPDX-License-Identifier: Apache-2.0

source "soc/soc_legacy/riscv/gd_gd32/*/Kconfig.series"
```

## soc/soc_legacy/riscv/intel_niosv/Kconfig.defconfig
```kconfig
# Copyright (c) 2024 Nordic Semiconductor ASA
# SPDX-License-Identifier: Apache-2.0

source "soc/soc_legacy/riscv/intel_niosv/*/Kconfig.defconfig.series"
```

## soc/soc_legacy/riscv/intel_niosv/niosv/Kconfig.series
```kconfig
# Copyright (C) 2023, Intel Corporation
# SPDX-License-Identifier: Apache-2.0

config SOC_SERIES_NIOSV
	bool "INTEL FPGA NIOSV"
	select RISCV
	select RISCV_PRIVILEGED
	select SOC_FAMILY_INTEL_NIOSV
	help
	  Enable support for the INTEL FPGA NIOSV.
```

## soc/soc_legacy/riscv/ite_ec/it8xxx2/Kconfig.soc
```kconfig
# Copyright (c) 2020 ITE Corporation. All Rights Reserved.
# SPDX-License-Identifier: Apache-2.0

choice
prompt "ITE IT8XXX2 system implementation"
depends on SOC_SERIES_ITE_IT8XXX2

config SOC_IT8XXX2
	bool "ITE IT8XXX2 system implementation"
	select RISCV
	select ATOMIC_OPERATIONS_BUILTIN
	select RISCV_ISA_RV32I
	select RISCV_ISA_EXT_ZICSR
	select RISCV_ISA_EXT_ZIFENCEI
	# Workaround mul instruction bug, see:
	# https://www.ite.com.tw/uploads/product_download/it81202-bx-chip-errata.pdf
	select RISCV_ISA_EXT_M if !(SOC_IT81302_BX || SOC_IT81202_BX)
	select RISCV_ISA_EXT_A
	select RISCV_ISA_EXT_C
	select FLASH
	select FLASH_HAS_PAGE_LAYOUT
	select FLASH_HAS_DRIVER_ENABLED
	select HAS_FLASH_LOAD_OFFSET

endchoice

config SOC_IT8XXX2_REG_SET_V1
	bool
	help
	  This option is selected by a variable of which soc, and will
	  determine the register for the IT81xx2 specification.

config SOC_IT8XXX2_REG_SET_V2
	bool
	help
	  This option is selected by a variable of which soc, and will
	  determine the register for the IT82xx2 specification.

if SOC_IT8XXX2

choice IT8XXX2_SERIES
	prompt "IT8XXX2 Series"
	default SOC_IT81302_BX

config SOC_IT81302_BX
	bool "IT81302 BX version"
	select SOC_IT8XXX2_REG_SET_V1

config SOC_IT81202_BX
	bool "IT81202 BX version"
	select SOC_IT8XXX2_REG_SET_V1

config SOC_IT81302_CX
	bool "IT81302 CX version"
	select SOC_IT8XXX2_REG_SET_V1

config SOC_IT81202_CX
	bool "IT81202 CX version"
	select SOC_IT8XXX2_REG_SET_V1

config SOC_IT82202_AX
	bool "IT82202 AX version"
	select SOC_IT8XXX2_REG_SET_V2
	select SOC_IT8XXX2_EC_BUS_24MHZ if !DT_HAS_ITE_IT82XX2_USB_ENABLED

config SOC_IT82302_AX
	bool "IT82302 AX version"
	select SOC_IT8XXX2_REG_SET_V2
	select SOC_IT8XXX2_EC_BUS_24MHZ if !DT_HAS_ITE_IT82XX2_USB_ENABLED

config SOC_IT82002_AW
	bool "IT82002 AW version"
	select SOC_IT8XXX2_REG_SET_V2
	select SOC_IT8XXX2_EC_BUS_24MHZ if !DT_HAS_ITE_IT82XX2_USB_ENABLED

endchoice

config SOC_IT8XXX2_PLL_FLASH_48M
	bool "Flash frequency is 48MHz"
	default y
	help
	  Change frequency of PLL, CPU, and flash to 48MHz during initialization.

	  Set n to use the default settings.
	  (PLL and CPU run at 48MHz, flash frequency is 16MHz)

config SOC_IT8XXX2_GPIO_GROUP_K_L_DEFAULT_PULL_DOWN
	bool "The pins of GPIO group K and L aren't bonding with pad"
	default y
	help
	  On IT81202 (128-pins package), the pins of GPIO group K and L aren't
	  bonding with pad. So we configure these pins as internal pull-down
	  at default to prevent leakage current due to floating.

config SOC_IT8XXX2_GPIO_H7_DEFAULT_OUTPUT_LOW
	bool "The GPIOH7 isn't bonding with pad and is left floating internally"
	default y
	help
	  On IT81202/IT81302, the GPIOH7 isn't bonding with pad and is left
	  floating internally. We need to enable internal pull-down for the pin
	  to prevent leakage current, but IT81202/IT81302 doesn't have the
	  capability to pull it down. We can only set it as output low,
	  so we enable output low for it at initialization to prevent leakage.

config SOC_IT8XXX2_CPU_IDLE_GATING
	bool
	help
	  This option determines whether the entering CPU idle mode can be
	  gated by individual drivers. When this option is disabled, CPU idle
	  mode is always permitted.

config SOC_IT8XXX2_EC_BUS_24MHZ
	bool "EC bus is 24MHz"
	help
	  Raise EC bus to 24MHz (default is 8MHz).
	  This reduces read/write EC registers latency by 50%.
	  NOTE: There is limitation to enabling this config on it81xx2 series.
	  The clock_frequency of ite,it8xxx2-i2c node (i2c0, i2c1, and i2c2) will
	  be fixed at 400KHz.

choice
	prompt "Clock source for PLL reference clock"

config SOC_IT8XXX2_INT_32K
	bool "Use the +/-2.3% internal clock generator"

config SOC_IT8XXX2_EXT_32K
	bool "Use external 32.768 kHz clock source"

endchoice

config SOC_IT8XXX2_USE_ILM
	bool
	default y
	help
	  If enabled, Instruction Local Memory (ILM) will be configured to execute
	  code placed in the .__ram_code section out of RAM. This consumes RAM in
	  blocks of 4 kilobytes, but performance of code in ILM is much more
	  predictable than executing from Flash directly, and some code (such as code
	  that writes to the internal Flash) must execute out of RAM.

config SOC_IT8XXX2_EXCEPTIONS_IN_RAM
	bool "Place exception handling code in RAM"
	default y
	select SOC_IT8XXX2_USE_ILM
	help
	  Place exception handling (ISR entry/exit and related) code in ILM, which
	  has more reliable performance characteristics than executing directly from
	  Flash. This can significantly improve performance when under I-cache
	  pressure.

config SOC_IT8XXX2_SHA256_HW_ACCELERATE
	bool "HW SHA256 calculation"
	help
	  IT8XXX2 HW support sha256 calculation, and its calculation is faster than FW.
	  We place SHA256 message, hash and key data (total 512bytes) in RAM.
	  If we enable this config, because HW limits, the sha256 data must place in
	  first 4KB of RAM.

DT_CHOSEN_ZEPHYR_FLASH := zephyr,flash

config SOC_IT8XXX2_FLASH_SIZE_BYTES
	hex
	default $(dt_chosen_reg_size_hex,$(DT_CHOSEN_ZEPHYR_FLASH))
	help
	  Total size of writable flash.

config ILM_MAX_SIZE
	int "ILM Size in kB"
	default 60 if SOC_IT81202_CX || SOC_IT81302_CX
	default SRAM_SIZE

endif # SOC_IT8XXX2
```

## soc/soc_legacy/riscv/microchip_miv/Kconfig.soc
```kconfig
# Copyright (c) 2024 Nordic Semiconductor ASA
# SPDX-License-Identifier: Apache-2.0

source "soc/soc_legacy/riscv/microchip_miv/*/Kconfig.series"
```

## soc/soc_legacy/riscv/microchip_miv/polarfire/Kconfig.defconfig.series
```kconfig
# Copyright (c) 2020-2021 Microchip Technology Inc
# SPDX-License-Identifier: Apache-2.0

if SOC_SERIES_POLARFIRE

config SOC_SERIES
	default "polarfire"

# MPFS should be configured so that the mtimer clock is 1MHz independent of the CPU clock...

config SYS_CLOCK_HW_CYCLES_PER_SEC
	default 1000000

config RISCV_SOC_INTERRUPT_INIT
	default y

config RISCV_GP
	default y

config 2ND_LVL_ISR_TBL_OFFSET
	default 13

config 2ND_LVL_INTR_00_OFFSET
	default 11

config MAX_IRQ_PER_AGGREGATOR
	default 186

config NUM_IRQS
	default 186

endif # SOC_SERIES_POLARFIRE
```

## soc/soc_legacy/riscv/nordic_nrf/nrf54h/Kconfig.soc
```kconfig
# Copyright (c) 2024 Nordic Semiconductor ASA
# SPDX-License-Identifier: Apache-2.0

config SOC_NRF54H20
	bool "nRF54H20"
	depends on SOC_SERIES_NRF54HX

if SOC_NRF54H20

choice
	prompt "nRF54Hx MCU Selection"

config SOC_NRF54H20_ENGA_CPUPPR
	bool "nRF54H20 ENGA CPUPPR"
	depends on RISCV_CORE_NORDIC_VPR

endchoice

endif # SOC_NRF54H20
```

## soc/soc_legacy/riscv/opentitan/Kconfig.defconfig
```kconfig
# Copyright (c) 2023 Rivos Inc.
# SPDX-License-Identifier: Apache-2.0

if SOC_OPENTITAN

config SOC
	default "opentitan"

config SYS_CLOCK_HW_CYCLES_PER_SEC
	default 1000000

config RISCV_SOC_INTERRUPT_INIT
	default y

config RISCV_GP
	default y

config 2ND_LVL_ISR_TBL_OFFSET
	default 32

config 2ND_LVL_INTR_00_OFFSET
	default 11

config NUM_IRQS
	default 256

endif # SOC_OPENTITAN
```

## soc/soc_legacy/riscv/sifive_freedom/Kconfig.soc
```kconfig
# Copyright (c) 2024 Nordic Semiconductor ASA
# SPDX-License-Identifier: Apache-2.0

source "soc/soc_legacy/riscv/sifive_freedom/*/Kconfig.series"
```

## soc/soc_legacy/riscv/sifive_freedom/u500/Kconfig.series
```kconfig
# RISCV_SIFIVE_FREEDOM SOC implementation

# Copyright (c) 2017 Jean-Paul Etienne <fractalclone@gmail.com>
# SPDX-License-Identifier: Apache-2.0

config SOC_SERIES_SIFIVE_FREEDOM_U500
	bool "SiFive Freedom U500 SOC implementation"
	select RISCV
	select RISCV_PRIVILEGED
	select RISCV_HAS_PLIC
	select SOC_FAMILY_SIFIVE_FREEDOM
	help
	  Enable support for SiFive Freedom U500 SOC
```

## soc/soc_legacy/riscv/starfive_jh71xx/Kconfig.defconfig
```kconfig
# Copyright (c) 2024 Nordic Semiconductor ASA
# SPDX-License-Identifier: Apache-2.0

source "soc/soc_legacy/riscv/starfive_jh71xx/*/Kconfig.defconfig.series"
```

## soc/soc_legacy/riscv/telink_tlsr/Kconfig.soc
```kconfig
# Copyright (c) 2024 Nordic Semiconductor ASA
# SPDX-License-Identifier: Apache-2.0

source "soc/soc_legacy/riscv/telink_tlsr/*/Kconfig.series"
```

## soc/soc_legacy/riscv/telink_tlsr/tlsr951x/Kconfig.defconfig.tlsr9518
```kconfig
# Copyright (c) 2024 Nordic Semiconductor ASA
# SPDX-License-Identifier: Apache-2.0

config SOC
	default "tlsr9518" if SOC_TELINK_TLSR9518
```

## soc/soc_legacy/riscv/telink_tlsr/tlsr951x/Kconfig.series
```kconfig
# Copyright (c) 2021 Telink Semiconductor
# SPDX-License-Identifier: Apache-2.0

config SOC_SERIES_TELINK_TLSR951X
	bool "Telink TLSR951X"
	select RISCV
	select RISCV_ISA_RV32I
	select RISCV_ISA_EXT_M
	select RISCV_ISA_EXT_A
	select RISCV_ISA_EXT_C
	select RISCV_ISA_EXT_ZICSR
	select RISCV_ISA_EXT_ZIFENCEI
	select RISCV_PRIVILEGED
	select RISCV_HAS_PLIC
	select HAS_TELINK_DRIVERS
	select ATOMIC_OPERATIONS_BUILTIN
	select CPU_HAS_FPU
	select INCLUDE_RESET_VECTOR
	select SOC_FAMILY_TELINK_TLSR
	help
	  Enable support for Telink TLSR951X
```

## soc/soc_legacy/x86/intel_ish/Kconfig.defconfig
```kconfig
# Intel ISH family default configuration options
#
# Copyright (c) 2023 Intel Corporation
#
# SPDX-License-Identifier: Apache-2.0

if SOC_FAMILY_INTEL_ISH

config SYS_CLOCK_HW_CYCLES_PER_SEC
	default 32768 if HPET_TIMER

config SOC_FAMILY
	string
	default "intel_ish"

config X86_VERY_EARLY_CONSOLE
	default n

config SRAM_OFFSET
	hex
	default 0x0

# Target platforms are not PC-compatible
# (e.g. without BIOS, ACPI, CMOS, etc.).
config X86_PC_COMPATIBLE
	default n

endif # SOC_FAMILY_INTEL_ISH

rsource "*/Kconfig.defconfig.series"
```

## soc/soc_legacy/x86/intel_ish/Kconfig.soc
```kconfig
# Intel ISH family selection
#
# Copyright (c) 2023 Intel Corporation
#
# SPDX-License-Identifier: Apache-2.0

rsource "*/Kconfig.series"
rsource "*/Kconfig.soc"
```

## soc/soc_legacy/x86/intel_ish/intel_ish5/Kconfig.defconfig.series
```kconfig
# Copyright (c) 2023 Intel Corporation
#
# SPDX-License-Identifier: Apache-2.0
#

if SOC_SERIES_INTEL_ISH5

config SOC_SERIES
	string
	default "intel_ish5"

config SOC
	string
	default "intel_ish_5_4_1" if SOC_INTEL_ISH_5_4_1
	default "intel_ish_5_6_0" if SOC_INTEL_ISH_5_6_0
	default "intel_ish_5_8_0" if SOC_INTEL_ISH_5_8_0

endif # SOC_SERIES_INTEL_ISH5

rsource "pm/Kconfig.pm"
```

## soc/soc_legacy/x86/intel_ish/intel_ish5/Kconfig.soc
```kconfig
# Copyright (c) 2023 Intel Corporation
#
# SPDX-License-Identifier: Apache-2.0
#

choice
	prompt "Intel ISH5 SoCs"
	depends on SOC_SERIES_INTEL_ISH5

config SOC_INTEL_ISH_5_4_1
	bool "Intel ISH 5.4.1 SoC"

config SOC_INTEL_ISH_5_6_0
	bool "Intel ISH 5.6.0 SoC"

config SOC_INTEL_ISH_5_8_0
	bool "Intel ISH 5.8.0 SoC"

endchoice
```

## soc/soc_legacy/xtensa/espressif_esp32/common/Kconfig.defconfig.series
```kconfig
# Copyright (c) 2023 Espressif Systems (Shanghai) Co., Ltd.
# SPDX-License-Identifier: Apache-2.0

if SOC_FAMILY_ESP32

# Xtensa default options for ESP32 family
config XTENSA_RESET_VECTOR
	default n

config XTENSA_USE_CORE_CRT1
	default n

config GEN_ISR_TABLES
	default y

config GEN_IRQ_VECTOR_TABLE
	default n

config CLOCK_CONTROL
	default y

config SYS_CLOCK_HW_CYCLES_PER_SEC
	default $(dt_node_int_prop_int,/cpus/cpu@0,clock-frequency)

config XTENSA_CCOUNT_HZ
	default SYS_CLOCK_HW_CYCLES_PER_SEC

config MINIMAL_LIBC_OPTIMIZE_STRING_FOR_SIZE
	default n

if BOOTLOADER_MCUBOOT

	config HAS_FLASH_LOAD_OFFSET
		default y
	config MCUBOOT_GENERATE_UNSIGNED_IMAGE
		default y
	config MCUBOOT_GENERATE_CONFIRMED_IMAGE
		default y
	config ROM_START_OFFSET
		default 0x20

endif # BOOTLOADER_MCUBOOT

endif # SOC_FAMILY_ESP32
```

## soc/soc_legacy/xtensa/intel_adsp/Kconfig.soc
```kconfig
# Intel CAVS SoC series selection
#
# Copyright (c) 2020 Intel Corporation
# SPDX-License-Identifier: Apache-2.0

source "soc/soc_legacy/xtensa/intel_adsp/*/Kconfig.series"
```
