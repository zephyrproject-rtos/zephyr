## soc/soc_legacy/xtensa/intel_adsp/ace/Kconfig.defconfig.ace20_lnl
```kconfig
# Copyright (c) 2022 Intel Corporation
# SPDX-License-Identifier: Apache-2.0


if SOC_INTEL_ACE20_LNL

config SOC
	string
	default "intel_ace20_lnl"

config MP_MAX_NUM_CPUS
	default 5

endif
```

## soc/soc_legacy/xtensa/intel_adsp/cavs/Kconfig.soc
```kconfig
# Copyright (c) 2020 Intel Corporation
# SPDX-License-Identifier: Apache-2.0

choice
	prompt "Intel CAVS SoC Selection"
	depends on SOC_SERIES_INTEL_ADSP_CAVS

config SOC_INTEL_CAVS_V25
	bool "Intel Tiger Lake"
	select XTENSA_WAITI_BUG
	select SCHED_IPI_SUPPORTED

endchoice
```

## soc/soc_legacy/xtensa/nxp_adsp/Kconfig.soc
```kconfig
# NXP i.MX8 SoC series selection
#
# Copyright (c) 2021 NXP
# SPDX-License-Identifier: Apache-2.0

source "soc/soc_legacy/xtensa/nxp_adsp/*/Kconfig.series"
```

## soc/soc_legacy/xtensa/nxp_adsp/imx8/Kconfig.defconfig.imx8qm
```kconfig
# Copyright 2023 NXP
# SPDX-License-Identifier: Apache-2.0

if SOC_MIMX8QM_ADSP

config SOC
	default "mimx8qm6"

endif # SOC_MIMX8QM_ADSP
```

## soc/soc_legacy/xtensa/nxp_adsp/imx8m/Kconfig.defconfig.series
```kconfig
# Copyright (c) 2021 NXP
# SPDX-License-Identifier: Apache-2.0

if SOC_SERIES_NXP_IMX8M

config SOC_SERIES
	string
	default "imx8m"

config SOC_TOOLCHAIN_NAME
	string
	default "nxp_imx8m_adsp"

if SOC_MIMX8M_ADSP

config SOC
	string
	default "mimx8ml8"

config SYS_CLOCK_HW_CYCLES_PER_SEC
	default 800000000 if XTENSA_TIMER

config SYS_CLOCK_TICKS_PER_SEC
	default 50000

config DCACHE_LINE_SIZE
	default 128

config DYNAMIC_INTERRUPTS
	default y

config GEN_IRQ_VECTOR_TABLE
	default n

endif # SOC_MIMX8M_ADSP

endif # SOC_SERIES_NXP_IMX8M
```

## soc/soc_legacy/xtensa/nxp_adsp/imx8ulp/Kconfig.defconfig.series
```kconfig
# Copyright (c) 2023 NXP
# SPDX-License-Identifier: Apache-2.0

if SOC_SERIES_NXP_IMX8ULP

config SOC_SERIES
	string
	default "imx8ulp"

config SOC_TOOLCHAIN_NAME
	string
	default "nxp_imx8ulp_adsp"

config SOC
	string
	default "nxp_imx8ulp"

config SYS_CLOCK_HW_CYCLES_PER_SEC
	default 528000000 if XTENSA_TIMER

config SYS_CLOCK_TICKS_PER_SEC
	default 50000

config DCACHE_LINE_SIZE
	default 128

config GEN_IRQ_VECTOR_TABLE
	default n

endif # SOC_SERIES_NXP_IMX8ULP
```

## soc/soc_legacy/xtensa/nxp_adsp/rt5xx/Kconfig.defconfig.series
```kconfig
# Copyright (c) 2023 Google LLC.
# SPDX-License-Identifier: Apache-2.0

if SOC_SERIES_NXP_RT5XX

config SOC_SERIES
	string
	default "rt5xx"

config SOC_TOOLCHAIN_NAME
	string
	default "nxp_rt500_adsp"

config SOC
	string
	default "nxp_rt5xx"

config SOC_PART_NUMBER
	string
	default "MIMXRT595SFFOC_dsp" if SOC_NXP_RT595

config SYS_CLOCK_HW_CYCLES_PER_SEC
	default 198000000

config XTENSA_CCOUNT_HZ
	default SYS_CLOCK_HW_CYCLES_PER_SEC

config SYS_CLOCK_TICKS_PER_SEC
	default 1000

config DYNAMIC_INTERRUPTS
	default n

config CACHE
	default n

config DCACHE
	default n

config CACHE_MANAGEMENT
	default n

config LOG
	default n

endif # SOC_SERIES_NXP_RT5XX
```

## soc/soc_legacy/xtensa/nxp_adsp/rt5xx/Kconfig.soc
```kconfig
# Copyright (c) 2023 Google LLC.
# SPDX-License-Identifier: Apache-2.0

choice
	prompt "NXP RT5xx ADSP SoC Selection"

	config SOC_NXP_RT595
		bool "NXP RT595"
		depends on SOC_SERIES_NXP_RT5XX
endchoice
```

## soc/sophgo/Kconfig
```kconfig
# Copyright (c) 2023-2024 Chen Xingyu <hi@xingrz.me>
# SPDX-License-Identifier: Apache-2.0

if SOC_FAMILY_SOPHGO

rsource "*/Kconfig"

endif # SOC_FAMILY_SOPHGO
```

## soc/sophgo/Kconfig.soc
```kconfig
# Copyright (c) 2023-2024 Chen Xingyu <hi@xingrz.me>
# SPDX-License-Identifier: Apache-2.0

config SOC_FAMILY_SOPHGO
	bool

config SOC_FAMILY
	default "sophgo" if SOC_FAMILY_SOPHGO

rsource "*/Kconfig.soc"
```

## soc/sophgo/cv180x/Kconfig
```kconfig
# Copyright (c) 2023-2024 Chen Xingyu <hi@xingrz.me>
# SPDX-License-Identifier: Apache-2.0

config SOC_SERIES_CV180X
	select 64BIT
	select RISCV
	select RISCV_PRIVILEGED
	select RISCV_ISA_RV64I
	select RISCV_ISA_EXT_M
	select RISCV_ISA_EXT_A
	select RISCV_ISA_EXT_F
	select RISCV_ISA_EXT_D
	select RISCV_ISA_EXT_C
	select RISCV_ISA_EXT_ZICSR
	select RISCV_ISA_EXT_ZIFENCEI
	select INCLUDE_RESET_VECTOR
	select ATOMIC_OPERATIONS_C
```

## soc/sophgo/cv180x/Kconfig.soc
```kconfig
# Copyright (c) 2023-2024 Chen Xingyu <hi@xingrz.me>
# SPDX-License-Identifier: Apache-2.0

config SOC_SERIES_CV180X
	bool
	select SOC_FAMILY_SOPHGO

config SOC_SERIES
	default "cv180x" if SOC_SERIES_CV180X

config SOC_CV1800B
	bool
	select SOC_SERIES_CV180X

config SOC
	default "cv1800b" if SOC_CV1800B
```

## soc/sophgo/cv181x/Kconfig.defconfig
```kconfig
# Copyright (c) 2024 Chen Xingyu <hi@xingrz.me>
# SPDX-License-Identifier: Apache-2.0

if SOC_SERIES_CV181X

config SYS_CLOCK_HW_CYCLES_PER_SEC
	default 25000000

config NUM_IRQS
	int
	default 128

config RISCV_GP
	default y

config RISCV_SOC_INTERRUPT_INIT
	default y

config RISCV_HAS_PLIC
	default y

config 2ND_LVL_INTR_00_OFFSET
	default 11

endif # SOC_SERIES_CV181X
```

## soc/sophgo/cv181x/Kconfig.soc
```kconfig
# Copyright (c) 2024 Chen Xingyu <hi@xingrz.me>
# SPDX-License-Identifier: Apache-2.0

config SOC_SERIES_CV181X
	bool
	select SOC_FAMILY_SOPHGO

config SOC_SERIES
	default "cv181x" if SOC_SERIES_CV181X

config SOC_SG2000
	bool
	select SOC_SERIES_CV181X

config SOC_SG2002
	bool
	select SOC_SERIES_CV181X

config SOC
	default "sg2000" if SOC_SG2000
	default "sg2002" if SOC_SG2002
```

## soc/spacemit/k1/Kconfig
```kconfig
# Copyright (c) 2025 Junhui Liu <junhui.liu@pigmoral.tech>
# SPDX-License-Identifier: Apache-2.0

config SOC_K1_N308
	select RISCV
	select RISCV_PRIVILEGED
	select RISCV_ISA_RV32I
	select RISCV_ISA_EXT_M
	select RISCV_ISA_EXT_A
	select RISCV_ISA_EXT_F
	select RISCV_ISA_EXT_D
	select RISCV_ISA_EXT_C
	select RISCV_ISA_EXT_ZICSR
	select RISCV_ISA_EXT_ZIFENCEI
	select RISCV_HAS_CLIC
	select INCLUDE_RESET_VECTOR
	select ATOMIC_OPERATIONS_C
```

## soc/spacemit/k1/Kconfig.defconfig
```kconfig
# Copyright (c) 2025 Junhui Liu <junhui.liu@pigmoral.tech>
# SPDX-License-Identifier: Apache-2.0

if SOC_SERIES_KEY_STONE

if SOC_K1_N308

config SYS_CLOCK_HW_CYCLES_PER_SEC
	default $(dt_node_int_prop_int,/cpus/cpu@0,clock-frequency)

config RISCV_HART_MASK
	default 0

config RV_BOOT_HART
	default 1

config RISCV_MCAUSE_EXCEPTION_MASK
	default 0xFFF

config NUM_IRQS
	default 80

config RISCV_SOC_INTERRUPT_INIT
	default y

endif # SOC_K1_N308

endif # SOC_SERIES_KEY_STONE
```

## soc/spacemit/k1/Kconfig.soc
```kconfig
# Copyright (c) 2025 Junhui Liu <junhui.liu@pigmoral.tech>
# SPDX-License-Identifier: Apache-2.0

config SOC_SERIES_KEY_STONE
	bool

config SOC_SERIES
	default "key_stone" if SOC_SERIES_KEY_STONE

config SOC_K1
	bool
	select SOC_SERIES_KEY_STONE

config SOC
	default "k1" if SOC_K1

config SOC_K1_N308
	bool
	select SOC_K1
```

## soc/sparc/Kconfig
```kconfig
# Copyright (c) 2019-2020 Cobham Gaisler AB
# SPDX-License-Identifier: Apache-2.0

config SPARC_CASA
	default y

config SOC_SPARC_LEON
	bool
```

## soc/sparc/at697/Kconfig.defconfig
```kconfig
#
# Copyright (c) 2018 ispace, inc.
#
# SPDX-License-Identifier: Apache-2.0
#

if SOC_AT697

config SOC
	default "at697"

endif
```

## soc/sparc/at697/Kconfig.soc
```kconfig
#
# Copyright (c) 2018 ispace, inc.
#
# SPDX-License-Identifier: Apache-2.0
#

config SOC_AT697
	bool "SoC AT697"
	select SPARC
```

## soc/sparc/gr716a/Kconfig.defconfig
```kconfig
# Copyright (c) 2019-2020 Cobham Gaisler AB
# SPDX-License-Identifier: Apache-2.0

if SOC_GR716A

config SOC
	default "gr716a"

config SPARC_NWIN
	default 31

config SYS_CLOCK_HW_CYCLES_PER_SEC
	int
	default 50000000

endif
```

## soc/sparc/gr716a/Kconfig.soc
```kconfig
# Copyright (c) 2019-2020 Cobham Gaisler AB
# SPDX-License-Identifier: Apache-2.0

config SOC_GR716A
	bool "GR716A LEON3 fault-tolerant microcontroller"
	select SPARC
	select SOC_SPARC_LEON
	select CPU_HAS_FPU
```

## soc/sparc/leon3/Kconfig.soc
```kconfig
# Copyright (c) 2019-2020 Cobham Gaisler AB
# SPDX-License-Identifier: Apache-2.0

config SOC_LEON3
	bool "A LEON3 SOC which you can configure"
	select SPARC
	select SOC_SPARC_LEON
```

## soc/spike/Kconfig
```kconfig
# Copyright (c) 2024 Tim-Marek Thomas <thomas@sra.uni-hannover.de>
# SPDX-License-Identifier: Apache-2.0
config SOC_FAMILY_SPIKE_VIRT_RISCV
	select RISCV
	select RISCV_ISA_EXT_M
	select RISCV_ISA_EXT_A
	select RISCV_ISA_EXT_C
	select ATOMIC_OPERATIONS_BUILTIN
	select RISCV_PRIVILEGED
	select RISCV_HAS_PLIC
	select INCLUDE_RESET_VECTOR

if SOC_FAMILY_SPIKE_VIRT_RISCV

rsource "*/Kconfig"

endif # SOC_FAMILY_SPIKE_VIRT_RISCV
```

## soc/spike/Kconfig.soc
```kconfig
# Copyright (c) 2024 Tim-Marek Thomas <thomas@sra.uni-hannover.de>
# SPDX-License-Identifier: Apache-2.0
config SOC_FAMILY_SPIKE_VIRT_RISCV
	bool

config SOC_FAMILY
	default "spike_virt_riscv" if SOC_FAMILY_SPIKE_VIRT_RISCV

rsource "*/Kconfig.soc"
```
