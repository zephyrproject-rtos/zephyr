## soc/soc_legacy/arm/nxp_s32/s32ze/Kconfig.defconfig.s32z27
```kconfig
# Copyright 2022 NXP
# SPDX-License-Identifier: Apache-2.0

if SOC_S32Z27_R52

config SOC
	default "s32z27"

endif # SOC_S32Z27_R52
```

## soc/soc_legacy/arm/renesas_ra/Kconfig.defconfig
```kconfig
# Copyright (c) 2023 TOKITA Hiroshi <tokita.hiroshi@fujitsu.com>
# SPDX-License-Identifier: Apache-2.0

source "soc/soc_legacy/arm/renesas_ra/*/Kconfig.defconfig.series"
```

## soc/soc_legacy/arm/renesas_ra/ra4m1/Kconfig.defconfig.series
```kconfig
# Copyright (c) 2023 TOKITA Hiroshi <tokita.hiroshi@fujitsu.com>
# SPDX-License-Identifier: Apache-2.0

if SOC_SERIES_RA4M1

rsource "Kconfig.defconfig.r7fa4*"

config SOC_SERIES
	default "ra4m1"

config NUM_IRQS
	default 32

endif # SOC_SERIES_RA4M1
```

## soc/soc_legacy/arm/renesas_ra/ra4m1/Kconfig.soc
```kconfig
# Copyright (c) 2023 TOKITA Hiroshi <tokita.hiroshi@fujitsu.com>
# SPDX-License-Identifier: Apache-2.0

choice
	prompt "Renesas RA4M1 SoC Selection"
	depends on SOC_SERIES_RA4M1

config SOC_R7FA4M1AB3CFM
	bool "R7FA4M1AB3CFM"

endchoice
```

## soc/soc_legacy/arm/renesas_rcar/Kconfig.defconfig
```kconfig
# Copyright (c) 2021 IoT.bzh
# SPDX-License-Identifier: Apache-2.0

source "soc/soc_legacy/arm/renesas_rcar/*/Kconfig.defconfig.series"
```

## soc/soc_legacy/arm/renesas_rcar/gen3/Kconfig.soc
```kconfig
# Copyright (c) 2021 IoT.bzh
# SPDX-License-Identifier: Apache-2.0

choice
	prompt "Renesas RCar SoC Selection"
	depends on SOC_SERIES_RCAR_GEN3

config SOC_R8A77951
	bool "R8A77951"

endchoice
```

## soc/soc_legacy/arm/renesas_smartbond/Kconfig.soc
```kconfig
# Copyright (c) 2022 Renesas Electronics Corporation
# SPDX-License-Identifier: Apache-2.0

source "soc/soc_legacy/arm/renesas_smartbond/*/Kconfig.series"
```

## soc/soc_legacy/arm/renesas_smartbond/da1469x/Kconfig.defconfig.da14695
```kconfig
# Copyright (c) 2023 Renesas Electronics Corporation and/or its affiliates
# SPDX-License-Identifier: Apache-2.0

if SOC_DA14695

config SOC
	default "da14695"

endif # SOC_DA14695
```

## soc/soc_legacy/arm/renesas_smartbond/da1469x/Kconfig.defconfig.da14699
```kconfig
# Copyright (c) 2022 Renesas Electronics Corporation
# SPDX-License-Identifier: Apache-2.0

if SOC_DA14699

config SOC
	default "da14699"

endif # SOC_DA14699
```

## soc/soc_legacy/arm/renesas_smartbond/da1469x/Kconfig.soc
```kconfig
# Copyright (c) 2022-2023 Renesas Electronics Corporation and/or its affiliates
# SPDX-License-Identifier: Apache-2.0

choice
	prompt "Renesas SmartBond(tm) DA1469x MCU selection"
	depends on SOC_SERIES_DA1469X

config SOC_DA14699
	bool "DA14699"

config SOC_DA14695
	bool "DA14695"

endchoice
```

## soc/soc_legacy/arm/silabs_exx32/efm32gg11b/Kconfig.series
```kconfig
# EFM32GG11B MCU line
# Copyright (c) 2019 Interay Solutions B.V.
# Copyright (c) 2019 Oane Kingma
# SPDX-License-Identifier: Apache-2.0

config SOC_SERIES_EFM32GG11B
	bool "EFM32GG11B Series MCU"
	select ARM
	select HAS_SILABS_GECKO
	select HAS_SWO
	select CPU_CORTEX_M4
	select CPU_HAS_FPU
	select CPU_HAS_ARM_MPU
	select SOC_FAMILY_EXX32
	select SOC_GECKO_HAS_INDIVIDUAL_PIN_LOCATION
	select SOC_GECKO_HAS_HFRCO_FREQRANGE
	select SOC_GECKO_CMU
	select SOC_GECKO_EMU
	select SOC_GECKO_GPIO
	select SOC_GECKO_TRNG
	select SOC_GECKO_SERIES1
	help
	  Enable support for EFM32 GiantGecko MCU series
```

## soc/soc_legacy/arm/silabs_exx32/efm32gg11b/Kconfig.soc
```kconfig
# EFM32GG11B (Giant Gecko) MCU line
# Copyright (c) 2019 Interay Solutions B.V.
# Copyright (c) 2019 Oane Kingma
# SPDX-License-Identifier: Apache-2.0

config SOC_PART_NUMBER_EFM32GG11B820F2048GL192
	bool
	depends on SOC_SERIES_EFM32GG11B

config SOC_PART_NUMBER_EFM32GG11B820F2048GM64
	bool
	depends on SOC_SERIES_EFM32GG11B
```

## soc/soc_legacy/arm/silabs_exx32/efm32gg12b/Kconfig.defconfig.efm32gg12b
```kconfig
# Silicon Labs EFM32GG12B (Giant Gecko) platform configuration options
# Copyright (c) 2023 Antmicro <www.antmicro.com>
# SPDX-License-Identifier: Apache-2.0

config GPIO_GECKO
	default y
	depends on GPIO || LOG_BACKEND_SWO
```

## soc/soc_legacy/arm/silabs_exx32/efm32hg/Kconfig.soc
```kconfig
# EFM32HG (Happy Gecko) MCU line

# Copyright (c) 2018 Marcio Montenegro
# SPDX-License-Identifier: Apache-2.0

config SOC_PART_NUMBER_EFM32HG322F64
	bool
	depends on SOC_SERIES_EFM32HG
```

## soc/soc_legacy/arm/silabs_exx32/efm32jg12b/Kconfig.defconfig.series
```kconfig
# EFM32JG12B series configuration options

# Copyright (c) 2019 Lemonbeat GmbH
# SPDX-License-Identifier: Apache-2.0

if SOC_SERIES_EFM32JG12B

config SOC_SERIES
	default "efm32jg12b"

config SOC_PART_NUMBER
	default "EFM32JG12B500F1024GL125" if SOC_PART_NUMBER_EFM32JG12B500F1024GL125

config NUM_IRQS
	# must be >= the highest interrupt number used
	default 50

endif # SOC_SERIES_EFM32JG12B
```

## soc/soc_legacy/arm/silabs_exx32/efm32pg12b/Kconfig.defconfig.series
```kconfig
# EFM32PG12B series configuration options

# Copyright (c) 2018 Christian Taedcke
# SPDX-License-Identifier: Apache-2.0

if SOC_SERIES_EFM32PG12B

config SOC_SERIES
	default "efm32pg12b"

config SOC_PART_NUMBER
	default "EFM32PG12B500F1024GL125" if SOC_PART_NUMBER_EFM32PG12B500F1024GL125

config NUM_IRQS
	# must be >= the highest interrupt number used
	default 50

endif # SOC_SERIES_EFM32PG12B
```

## soc/soc_legacy/arm/silabs_exx32/efm32pg12b/Kconfig.soc
```kconfig
# EFM32PG12B (Pearl Gecko) MCU line

# Copyright (c) 2018 Christian Taedcke
# SPDX-License-Identifier: Apache-2.0

config SOC_PART_NUMBER_EFM32PG12B500F1024GL125
	bool
	depends on SOC_SERIES_EFM32PG12B
```

## soc/soc_legacy/arm/silabs_exx32/efm32wg/Kconfig.soc
```kconfig
# EFM32WG (Wonder Gecko) MCU line

# Copyright (c) 2017 Christian Taedcke
# SPDX-License-Identifier: Apache-2.0

config SOC_PART_NUMBER_EFM32WG990F256
	bool
	depends on SOC_SERIES_EFM32WG
```

## soc/soc_legacy/arm/silabs_exx32/efr32fg13p/Kconfig.defconfig.series
```kconfig
# EFR32FG13P series configuration options

# Copyright (c) 2018 Christian Taedcke
# SPDX-License-Identifier: Apache-2.0

if SOC_SERIES_EFR32FG13P

config SOC_SERIES
	default "efr32fg13p"

config SOC_PART_NUMBER
	default "EFR32FG13P233F512GM48" if SOC_PART_NUMBER_EFR32FG13P233F512GM48

config NUM_IRQS
	# must be >= the highest interrupt number used
	default 45

endif # SOC_SERIES_EFR32FG13P
```

## soc/soc_legacy/arm/silabs_exx32/efr32mg21/Kconfig.soc
```kconfig
# Silicon Labs EFR32MG21 (Mighty Gecko) MCU line

# Copyright (c) 2020 TriaGnoSys GmbH
# SPDX-License-Identifier: Apache-2.0

config SOC_PART_NUMBER_EFR32MG21A020F1024IM32
	bool
	depends on SOC_SERIES_EFR32MG21
```

## soc/soc_legacy/arm/st_stm32/Kconfig.defconfig
```kconfig
# SPDX-License-Identifier: Apache-2.0

source "soc/soc_legacy/arm/st_stm32/*/Kconfig.defconfig.series"
```

## soc/soc_legacy/arm/st_stm32/stm32c0/Kconfig.soc
```kconfig
# STMicroelectronics STM32C0 MCU line

# Copyright (c) 2023 Benjamin Björnsson <benjamin.bjornsson@gmail.com>
# SPDX-License-Identifier: Apache-2.0

choice
	prompt "STM32C0x MCU Selection"
	depends on SOC_SERIES_STM32C0X

config SOC_STM32C031XX
	bool "STM32C031XX"

endchoice
```

## soc/soc_legacy/arm/st_stm32/stm32f3/Kconfig.defconfig.stm32f302xc
```kconfig
# ST Microelectronics STM32F302XC MCU

# Copyright (c) 2022, SECO Spa
# SPDX-License-Identifier: Apache-2.0

if SOC_STM32F302XC

config SOC
	default "stm32f302xc"

config NUM_IRQS
	default 82

endif # SOC_STM32F302XC
```

## soc/soc_legacy/arm/st_stm32/stm32f3/Kconfig.defconfig.stm32f303x8
```kconfig
# ST Microelectronics STM32F303x8 MCU

# Copyright (c) 2020 Sebastian Schwabe <sebastian.schwabe@mailbox.tu-dresden.de>
#                    Fabian Paschke <fabian.paschke@eas.iis.fraunhofer.de>
# SPDX-License-Identifier: Apache-2.0

if SOC_STM32F303X8

config SOC
	default "stm32f303x8"

config NUM_IRQS
	default 82

endif # SOC_STM32F303X8
```

## soc/soc_legacy/arm/st_stm32/stm32f3/Kconfig.defconfig.stm32f373xc
```kconfig
# ST Microelectronics STM32F373XC MCU

# Copyright (c) 2016 RnDity Sp. z o.o.
# SPDX-License-Identifier: Apache-2.0

if SOC_STM32F373XC

config SOC
	default "stm32f373xc"

config NUM_IRQS
	default 82

endif # SOC_STM32F373XC
```
