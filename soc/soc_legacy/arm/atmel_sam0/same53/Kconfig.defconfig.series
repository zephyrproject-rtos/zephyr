## soc/soc_legacy/arm/infineon_cat1/psoc6/Kconfig.soc.psoc6_04
```kconfig
# Copyright (c) 2022 Cypress Semiconductor Corporation (an Infineon company) or
# an affiliate of Cypress Semiconductor Corporation
# SPDX-License-Identifier: Apache-2.0

# Infineon PSoC6_04 series MCUs

config SOC_CY8C6244AZI_S4D92
	bool "CY8C6244AZI_S4D92"
	select SOC_DIE_PSOC6_04
	select SOC_PACKAGE_PSOC6_04_64_TQFP
	depends on SOC_SERIES_PSOC_62

config SOC_CY8C6244LQI_S4D92
	bool "CY8C6244LQI_S4D92"
	select SOC_DIE_PSOC6_04
	select SOC_PACKAGE_PSOC6_04_68_QFN
	depends on SOC_SERIES_PSOC_62

config SOC_CY8C6244AZI_S4D93
	bool "CY8C6244AZI_S4D93"
	select SOC_DIE_PSOC6_04
	select SOC_PACKAGE_PSOC6_04_80_TQFP
	depends on SOC_SERIES_PSOC_62

config SOC_CY8C6244AZI_S4D82
	bool "CY8C6244AZI_S4D82"
	select SOC_DIE_PSOC6_04
	select SOC_PACKAGE_PSOC6_04_64_TQFP
	depends on SOC_SERIES_PSOC_62

config SOC_CY8C6244LQI_S4D82
	bool "CY8C6244LQI_S4D82"
	select SOC_DIE_PSOC6_04
	select SOC_PACKAGE_PSOC6_04_68_QFN
	depends on SOC_SERIES_PSOC_62

config SOC_CY8C6244AZI_S4D83
	bool "CY8C6244AZI_S4D83"
	select SOC_DIE_PSOC6_04
	select SOC_PACKAGE_PSOC6_04_80_TQFP
	depends on SOC_SERIES_PSOC_62

config SOC_CY8C6244AZI_S4D62
	bool "CY8C6244AZI_S4D62"
	select SOC_DIE_PSOC6_04
	select SOC_PACKAGE_PSOC6_04_64_TQFP
	depends on SOC_SERIES_PSOC_62

config SOC_CY8C6244LQI_S4D62
	bool "CY8C6244LQI_S4D62"
	select SOC_DIE_PSOC6_04
	select SOC_PACKAGE_PSOC6_04_68_QFN
	depends on SOC_SERIES_PSOC_62

config SOC_CY8C6244AZI_S4D12
	bool "CY8C6244AZI_S4D12"
	select SOC_DIE_PSOC6_04
	select SOC_PACKAGE_PSOC6_04_64_TQFP
	depends on SOC_SERIES_PSOC_62

config SOC_CY8C6244LQI_S4D12
	bool "CY8C6244LQI_S4D12"
	select SOC_DIE_PSOC6_04
	select SOC_PACKAGE_PSOC6_04_68_QFN
	depends on SOC_SERIES_PSOC_62

config SOC_CY8C6144AZI_S4F92
	bool "CY8C6144AZI_S4F92"
	select SOC_DIE_PSOC6_04
	select SOC_PACKAGE_PSOC6_04_64_TQFP
	depends on SOC_SERIES_PSOC_61

config SOC_CY8C6144LQI_S4F92
	bool "CY8C6144LQI_S4F92"
	select SOC_DIE_PSOC6_04
	select SOC_PACKAGE_PSOC6_04_68_QFN
	depends on SOC_SERIES_PSOC_61

config SOC_CY8C6144AZI_S4F93
	bool "CY8C6144AZI_S4F93"
	select SOC_DIE_PSOC6_04
	select SOC_PACKAGE_PSOC6_04_80_TQFP
	depends on SOC_SERIES_PSOC_61

config SOC_CY8C6144AZI_S4F82
	bool "CY8C6144AZI_S4F82"
	select SOC_DIE_PSOC6_04
	select SOC_PACKAGE_PSOC6_04_64_TQFP
	depends on SOC_SERIES_PSOC_61

config SOC_CY8C6144LQI_S4F82
	bool "CY8C6144LQI_S4F82"
	select SOC_DIE_PSOC6_04
	select SOC_PACKAGE_PSOC6_04_68_QFN
	depends on SOC_SERIES_PSOC_61

config SOC_CY8C6144AZI_S4F83
	bool "CY8C6144AZI_S4F83"
	select SOC_DIE_PSOC6_04
	select SOC_PACKAGE_PSOC6_04_80_TQFP
	depends on SOC_SERIES_PSOC_61

config SOC_CY8C6144AZI_S4F62
	bool "CY8C6144AZI_S4F62"
	select SOC_DIE_PSOC6_04
	select SOC_PACKAGE_PSOC6_04_64_TQFP
	depends on SOC_SERIES_PSOC_61

config SOC_CY8C6144LQI_S4F62
	bool "CY8C6144LQI_S4F62"
	select SOC_DIE_PSOC6_04
	select SOC_PACKAGE_PSOC6_04_68_QFN
	depends on SOC_SERIES_PSOC_61

config SOC_CY8C6144AZI_S4F12
	bool "CY8C6144AZI_S4F12"
	select SOC_DIE_PSOC6_04
	select SOC_PACKAGE_PSOC6_04_64_TQFP
	depends on SOC_SERIES_PSOC_61

config SOC_CY8C6144LQI_S4F12
	bool "CY8C6144LQI_S4F12"
	select SOC_DIE_PSOC6_04
	select SOC_PACKAGE_PSOC6_04_68_QFN
	depends on SOC_SERIES_PSOC_61
```

## soc/soc_legacy/arm/intel_socfpga_std/Kconfig.defconfig
```kconfig
# Copyright (c) 2022 Intel Corporation
# SPDX-License-Identifier: Apache-2.0
# Description:
# Adding support for Cyclone V SoC FPGA

source "soc/soc_legacy/arm/intel_socfpga_std/*/Kconfig.defconfig.series"
```

## soc/soc_legacy/arm/intel_socfpga_std/Kconfig.soc
```kconfig
# Copyright (c) 2021 Intel Corporation
# SPDX-License-Identifier: Apache-2.0
# Description:
# Adding support for Cyclone V SoC FPGA

source "soc/soc_legacy/arm/intel_socfpga_std/*/Kconfig.series"
```

## soc/soc_legacy/arm/microchip_mec/Kconfig.defconfig
```kconfig
# SPDX-License-Identifier: Apache-2.0

source "soc/soc_legacy/arm/microchip_mec/*/Kconfig.defconfig.series"
```

## soc/soc_legacy/arm/microchip_mec/Kconfig.soc
```kconfig
# Microchip MEC172x, MEC1501 MCU line

# Copyright (c) 2018 Intel Corporation
# SPDX-License-Identifier: Apache-2.0

source "soc/soc_legacy/arm/microchip_mec/*/Kconfig.series"
```

## soc/soc_legacy/arm/microchip_mec/mec172x/Kconfig.defconfig.mec172xnsz
```kconfig
# Microchip MEC172XNSZ MCU

# Copyright (c) 2021 Microchip Technology Inc.
# SPDX-License-Identifier: Apache-2.0

if SOC_MEC172X_NSZ

config SOC
	default "mec172xnsz"

config GPIO
	default y

endif # SOC_MEC172X_NSZ
```

## soc/soc_legacy/arm/nordic_nrf/nrf52/Kconfig.defconfig.nrf52832_QFAB
```kconfig
# Nordic Semiconductor nRF52832 MCU

# Copyright (c) 2019 Nordic Semiconductor ASA
# SPDX-License-Identifier: Apache-2.0

if SOC_NRF52832_QFAB

config SOC
	default "nRF52832_QFAB"

config NUM_IRQS
	default 39

config NRF52_ANOMALY_132_WORKAROUND
	bool
	default y

endif # SOC_NRF52832_QFAB
```

## soc/soc_legacy/arm/nordic_nrf/nrf52/Kconfig.defconfig.nrf52833_QDAA
```kconfig
# Nordic Semiconductor nRF52833 MCU

# Copyright (c) 2023 Nordic Semiconductor ASA
# SPDX-License-Identifier: Apache-2.0

if SOC_NRF52833_QDAA

config SOC
	string
	default "nRF52833_QDAA"

config NUM_IRQS
	int
	default 48

endif # SOC_NRF52833_QDAA
```

## soc/soc_legacy/arm/nordic_nrf/nrf54h/Kconfig.defconfig.series
```kconfig
# Nordic Semiconductor nRF54H MCU line

# Copyright (c) 2024 Nordic Semiconductor ASA
# SPDX-License-Identifier: Apache-2.0

if SOC_SERIES_NRF54HX

rsource "Kconfig.defconfig.nrf54h*"

config SOC_SERIES
	default "nrf54h"

config CACHE_NRF_CACHE
	default y if EXTERNAL_CACHE

endif # SOC_SERIES_NRF54HX
```

## soc/soc_legacy/arm/nordic_nrf/nrf54l/Kconfig.defconfig.series
```kconfig
# Nordic Semiconductor nRF54L MCU line

# Copyright (c) 2024 Nordic Semiconductor ASA
# SPDX-License-Identifier: Apache-2.0

if SOC_SERIES_NRF54LX

rsource "Kconfig.defconfig.nrf54l*"

config SOC_SERIES
	default "nrf54l"

config CORTEX_M_SYSTICK
	default !NRF_GRTC_TIMER

config CACHE_NRF_CACHE
	default y if EXTERNAL_CACHE

endif # SOC_SERIES_NRF54LX
```

## soc/soc_legacy/arm/nordic_nrf/nrf91/Kconfig.defconfig.nrf9131_LACA
```kconfig
# Nordic Semiconductor nRF9131 MCU

# Copyright (c) 2023 Nordic Semiconductor ASA
# SPDX-License-Identifier: Apache-2.0

if SOC_NRF9131_LACA

config SOC
	default "nRF9131_LACA"

config NUM_IRQS
	default 65

endif # SOC_NRF9131_LACA
```

## soc/soc_legacy/arm/nuvoton_npcx/Kconfig.defconfig
```kconfig
# SPDX-License-Identifier: Apache-2.0

# Copyright (c) 2020 Nuvoton Technology Corporation.
# SPDX-License-Identifier: Apache-2.0

source "soc/soc_legacy/arm/nuvoton_npcx/*/Kconfig.defconfig.series"
```

## soc/soc_legacy/arm/nuvoton_npcx/Kconfig.soc
```kconfig
# Nuvoton Cortex-M4 Embedded Controller

# Copyright (c) 2020 Nuvoton Technology Corporation.
# SPDX-License-Identifier: Apache-2.0

source "soc/soc_legacy/arm/nuvoton_npcx/*/Kconfig.series"
```

## soc/soc_legacy/arm/nuvoton_npcx/npcx4/Kconfig.soc
```kconfig
# Nuvoton NPCX4 EC series

# Copyright (c) 2023 Nuvoton Technology Corporation.
# SPDX-License-Identifier: Apache-2.0

choice
	prompt "NPCX4 Selection"
	depends on SOC_SERIES_NPCX4

config SOC_NPCX4M3F
	bool "NPCX4M3F"

config SOC_NPCX4M8F
	bool "NPCX4M8F"

endchoice
```

## soc/soc_legacy/arm/nuvoton_npcx/npcx7/Kconfig.defconfig.npcx7m6fc
```kconfig
# Nuvoton Cortex-M4 Embedded Controller

# Copyright (c) 2021 Nuvoton Technology Corporation.
# SPDX-License-Identifier: Apache-2.0

if SOC_NPCX7M6FC

config SOC
	default "npcx7m6fc"

endif # SOC_NPCX7M6FC
```

## soc/soc_legacy/arm/nuvoton_npcx/npcx7/Kconfig.series
```kconfig
# Nuvoton Cortex-M4 Embedded Controller NPCX7 series

# Copyright (c) 2020 Nuvoton Technology Corporation.
# SPDX-License-Identifier: Apache-2.0

config SOC_SERIES_NPCX7
	bool "Nuvoton NPCX7 Series"
	select ARM
	select CPU_CORTEX_M4
	select CPU_CORTEX_M_HAS_DWT
	select CPU_HAS_FPU
	select CPU_HAS_ARM_MPU
	select SOC_FAMILY_NPCX
	select CPU_HAS_CUSTOM_FIXED_SOC_MPU_REGIONS
	select HAS_PM
	help
	  Enable support for Nuvoton NPCX7 series
```
