## soc/soc_legacy/arm/atmel_sam0/same53/Kconfig.defconfig.series
```kconfig
# Atmel SAME53 MCU series configuration options

# Copyright (c) 2019 ML!PA Consulting GmbH
# SPDX-License-Identifier: Apache-2.0

if SOC_SERIES_SAME53

config SOC_SERIES
	string
	default "same53"

config SOC_PART_NUMBER
	string
	default "same53j18a" if SOC_PART_NUMBER_SAME53J18A
	default "same53j19a" if SOC_PART_NUMBER_SAME53J19A
	default "same53j20a" if SOC_PART_NUMBER_SAME53J20A
	default "same53n19a" if SOC_PART_NUMBER_SAME53N19A
	default "same53n20a" if SOC_PART_NUMBER_SAME53N20A

config NUM_IRQS
	int
	default 137

config ROM_START_OFFSET
	default 0x400 if BOOTLOADER_MCUBOOT

config SYS_CLOCK_HW_CYCLES_PER_SEC
	int
	default 120000000

endif # SOC_SERIES_SAME53
```

## soc/soc_legacy/arm/atmel_sam0/same53/Kconfig.series
```kconfig
# Atmel SAME53 MCU series

# Copyright (c) 2019 ML!PA Consulting GmbH
# Copyright (c) 2023 Gerson Fernando Budke <nandojve@gmail.com>
# SPDX-License-Identifier: Apache-2.0

config SOC_SERIES_SAME53
	bool "Atmel SAME53 MCU"
	select ARM
	select CPU_CORTEX_M4
	select CPU_CORTEX_M_HAS_DWT
	select CPU_HAS_ARM_MPU
	select CPU_HAS_FPU
	select SOC_FAMILY_SAM0
	select PLATFORM_SPECIFIC_INIT
	select ASF
	help
	  Enable support for Atmel SAME53 Cortex-M4F microcontrollers.
```

## soc/soc_legacy/arm/atmel_sam0/same53/Kconfig.soc
```kconfig
# Atmel SAME53 MCU series

# Copyright (c) 2019 ML!PA Consulting GmbH
# SPDX-License-Identifier: Apache-2.0

choice
	prompt "Atmel SAME53 MCU Selection"
	depends on SOC_SERIES_SAME53

config SOC_PART_NUMBER_SAME53J18A
	bool "SAME53J18A"

config SOC_PART_NUMBER_SAME53J19A
	bool "SAME53J19A"

config SOC_PART_NUMBER_SAME53J20A
	bool "SAME53J20A"

config SOC_PART_NUMBER_SAME53N19A
	bool "SAME53N19A"

config SOC_PART_NUMBER_SAME53N20A
	bool "SAME53N20A"

endchoice
```

## soc/soc_legacy/arm/atmel_sam0/saml21/Kconfig.soc
```kconfig
# Atmel SAML MCU series

# Copyright (c) 2021 Argentum Systems Ltd.
# SPDX-License-Identifier: Apache-2.0

choice
	prompt "Atmel SAML21 MCU Selection"
	depends on SOC_SERIES_SAML21

config SOC_PART_NUMBER_SAML21E15B
	bool "SAML21E15B"

config SOC_PART_NUMBER_SAML21E16B
	bool "SAML21E16B"

config SOC_PART_NUMBER_SAML21E17B
	bool "SAML21E17B"

config SOC_PART_NUMBER_SAML21E18B
	bool "SAML21E18B"

config SOC_PART_NUMBER_SAML21G16B
	bool "SAML21G16B"

config SOC_PART_NUMBER_SAML21G17B
	bool "SAML21G17B"

config SOC_PART_NUMBER_SAML21G18B
	bool "SAML21G18B"

config SOC_PART_NUMBER_SAML21J16B
	bool "SAML21J16B"

config SOC_PART_NUMBER_SAML21J17B
	bool "SAML21J17B"

config SOC_PART_NUMBER_SAML21J17BU
	bool "SAML21J17BU"

config SOC_PART_NUMBER_SAML21J18B
	bool "SAML21J18B"

config SOC_PART_NUMBER_SAML21J18BU
	bool "SAML21J18BU"

endchoice
```

## soc/soc_legacy/arm/atmel_sam0/samr34/Kconfig.series
```kconfig
# Atmel SAMR34 MCU series

# Copyright (c) 2021 Argentum Systems Ltd.
# Copyright (c) 2023 Gerson Fernando Budke <nandojve@gmail.com>
# SPDX-License-Identifier: Apache-2.0

config SOC_SERIES_SAMR34
	bool "Atmel SAMR34 MCU"
	select ARM
	select CPU_CORTEX_M0PLUS
	select CPU_CORTEX_M_HAS_SYSTICK
	select CPU_CORTEX_M_HAS_VTOR
	select SOC_FAMILY_SAM0
	select PLATFORM_SPECIFIC_INIT
	select ASF
	help
	  Enable support for Atmel SAMR34 Cortex-M0+ microcontrollers.
```

## soc/soc_legacy/arm/cypress/Kconfig.soc
```kconfig
# Copyright (c) 2018, Cypress
# SPDX-License-Identifier: Apache-2.0

source "soc/soc_legacy/arm/cypress/*/Kconfig.series"
```

## soc/soc_legacy/arm/cypress/psoc6/Kconfig.defconfig.psoc6_m0
```kconfig
# Cypress PSoC6 CM0 platform configuration options

# Copyright (c) 2018, Cypress
# SPDX-License-Identifier: Apache-2.0

if SOC_PSOC6_M0

config SOC
	default "psoc6_m0"

config NUM_IRQS
	default 32

endif # SOC_PSOC6_M0
```

## soc/soc_legacy/arm/infineon_cat1/psoc6/Kconfig.series
```kconfig
# Copyright (c) 2021 Cypress Semiconductor Corporation (an Infineon company) or
# an affiliate of Cypress Semiconductor Corporation
# SPDX-License-Identifier: Apache-2.0

# Cypress PSoC™ 6 MCU lines
config SOC_SERIES_PSOC_60
	bool "Infineon PSoC™ 60 series MCU(Value Line)"
	select SOC_FAMILY_INFINEON_CAT1
	help
	  Enable support for Infineon PSoC™ 60 MCU series

config SOC_SERIES_PSOC_61
	bool "Infineon PSoC™ 61 series MCU (Programmable Line)"
	select SOC_FAMILY_INFINEON_CAT1
	help
	  Enable support for Infineon PSoC™ 61 MCU series

config SOC_SERIES_PSOC_62
	bool "Infineon PSoC™ 62 series MCU (Performance Line)"
	select SOC_FAMILY_INFINEON_CAT1
	help
	  Enable support for Infineon PSoC™ 62 MCU series

config SOC_SERIES_PSOC_63
	bool "Infineon PSoC™ 63 series MCU (Connectivity Line)"
	select SOC_FAMILY_INFINEON_CAT1
	help
	  Enable support for Infineon PSoC™ 63 MCU series

config SOC_SERIES_PSOC_64
	bool "Infineon PSoC™ 64 series MCU (Security Line)"
	select SOC_FAMILY_INFINEON_CAT1
	help
	  Enable support for Infineon PSoC™ 64 MCU series
```

## soc/soc_legacy/arm/infineon_cat1/psoc6/Kconfig.soc.psoc6_01
```kconfig
# Copyright (c) 2022 Cypress Semiconductor Corporation (an Infineon company) or
# an affiliate of Cypress Semiconductor Corporation
# SPDX-License-Identifier: Apache-2.0

# Infineon PSoC6_01 series MCUs

config SOC_CY8C6036BZI_F04
	bool "CY8C6036BZI_F04"
	select SOC_DIE_PSOC6_01
	select SOC_PACKAGE_PSOC6_01_124_BGA
	depends on SOC_SERIES_PSOC_60

config SOC_CY8C6016BZI_F04
	bool "CY8C6016BZI_F04"
	select SOC_DIE_PSOC6_01
	select SOC_PACKAGE_PSOC6_01_124_BGA
	depends on SOC_SERIES_PSOC_60

config SOC_CY8C6116BZI_F54
	bool "CY8C6116BZI_F54"
	select SOC_DIE_PSOC6_01
	select SOC_PACKAGE_PSOC6_01_124_BGA
	depends on SOC_SERIES_PSOC_61

config SOC_CY8C6136BZI_F14
	bool "CY8C6136BZI_F14"
	select SOC_DIE_PSOC6_01
	select SOC_PACKAGE_PSOC6_01_124_BGA
	depends on SOC_SERIES_PSOC_61

config SOC_CY8C6136BZI_F34
	bool "CY8C6136BZI_F34"
	select SOC_DIE_PSOC6_01
	select SOC_PACKAGE_PSOC6_01_124_BGA
	depends on SOC_SERIES_PSOC_61

config SOC_CY8C6137BZI_F14
	bool "CY8C6137BZI_F14"
	select SOC_DIE_PSOC6_01
	select SOC_PACKAGE_PSOC6_01_124_BGA
	depends on SOC_SERIES_PSOC_61

config SOC_CY8C6137BZI_F34
	bool "CY8C6137BZI_F34"
	select SOC_DIE_PSOC6_01
	select SOC_PACKAGE_PSOC6_01_124_BGA
	depends on SOC_SERIES_PSOC_61

config SOC_CY8C6137BZI_F54
	bool "CY8C6137BZI_F54"
	select SOC_DIE_PSOC6_01
	select SOC_PACKAGE_PSOC6_01_124_BGA
	depends on SOC_SERIES_PSOC_61

config SOC_CY8C6117BZI_F34
	bool "CY8C6117BZI_F34"
	select SOC_DIE_PSOC6_01
	select SOC_PACKAGE_PSOC6_01_124_BGA
	depends on SOC_SERIES_PSOC_61

config SOC_CY8C6246BZI_D04
	bool "CY8C6246BZI_D04"
	select SOC_DIE_PSOC6_01
	select SOC_PACKAGE_PSOC6_01_124_BGA
	depends on SOC_SERIES_PSOC_62

config SOC_CY8C6247BZI_D44
	bool "CY8C6247BZI_D44"
	select SOC_DIE_PSOC6_01
	select SOC_PACKAGE_PSOC6_01_124_BGA
	depends on SOC_SERIES_PSOC_62

config SOC_CY8C6247BZI_D34
	bool "CY8C6247BZI_D34"
	select SOC_DIE_PSOC6_01
	select SOC_PACKAGE_PSOC6_01_124_BGA
	depends on SOC_SERIES_PSOC_62

config SOC_CY8C6247BZI_D54
	bool "CY8C6247BZI_D54"
	select SOC_DIE_PSOC6_01
	select SOC_PACKAGE_PSOC6_01_124_BGA
	depends on SOC_SERIES_PSOC_62

config SOC_CY8C6336BZI_BLF03
	bool "CY8C6336BZI_BLF03"
	select SOC_DIE_PSOC6_01
	select SOC_PACKAGE_PSOC6_01_116_BGA_BLE
	depends on SOC_SERIES_PSOC_63

config SOC_CY8C6316BZI_BLF03
	bool "CY8C6316BZI_BLF03"
	select SOC_DIE_PSOC6_01
	select SOC_PACKAGE_PSOC6_01_116_BGA_BLE
	depends on SOC_SERIES_PSOC_63

config SOC_CY8C6316BZI_BLF53
	bool "CY8C6316BZI_BLF53"
	select SOC_DIE_PSOC6_01
	select SOC_PACKAGE_PSOC6_01_116_BGA_BLE
	depends on SOC_SERIES_PSOC_63

config SOC_CY8C6336BZI_BLD13
	bool "CY8C6336BZI_BLD13"
	select SOC_DIE_PSOC6_01
	select SOC_PACKAGE_PSOC6_01_116_BGA_BLE
	depends on SOC_SERIES_PSOC_63

config SOC_CY8C6347BZI_BLD43
	bool "CY8C6347BZI_BLD43"
	select SOC_DIE_PSOC6_01
	select SOC_PACKAGE_PSOC6_01_116_BGA_BLE
	depends on SOC_SERIES_PSOC_63

config SOC_CY8C6347BZI_BLD33
	bool "CY8C6347BZI_BLD33"
	select SOC_DIE_PSOC6_01
	select SOC_PACKAGE_PSOC6_01_116_BGA_BLE
	depends on SOC_SERIES_PSOC_63

config SOC_CY8C6347BZI_BLD53
	bool "CY8C6347BZI_BLD53"
	select SOC_DIE_PSOC6_01
	select SOC_PACKAGE_PSOC6_01_116_BGA_BLE
	depends on SOC_SERIES_PSOC_63

config SOC_CY8C6347FMI_BLD13
	bool "CY8C6347FMI_BLD13"
	select SOC_DIE_PSOC6_01
	select SOC_PACKAGE_PSOC6_01_104_M_CSP_BLE
	depends on SOC_SERIES_PSOC_63

config SOC_CY8C6347FMI_BLD43
	bool "CY8C6347FMI_BLD43"
	select SOC_DIE_PSOC6_01
	select SOC_PACKAGE_PSOC6_01_104_M_CSP_BLE
	depends on SOC_SERIES_PSOC_63

config SOC_CY8C6347FMI_BLD33
	bool "CY8C6347FMI_BLD33"
	select SOC_DIE_PSOC6_01
	select SOC_PACKAGE_PSOC6_01_104_M_CSP_BLE
	depends on SOC_SERIES_PSOC_63

config SOC_CY8C6347FMI_BLD53
	bool "CY8C6347FMI_BLD53"
	select SOC_DIE_PSOC6_01
	select SOC_PACKAGE_PSOC6_01_104_M_CSP_BLE
	depends on SOC_SERIES_PSOC_63

config SOC_CY8C6137FDI_F02
	bool "CY8C6137FDI_F02"
	select SOC_DIE_PSOC6_01
	select SOC_PACKAGE_PSOC6_01_80_WLCSP
	depends on SOC_SERIES_PSOC_61

config SOC_CY8C6117FDI_F02
	bool "CY8C6117FDI_F02"
	select SOC_DIE_PSOC6_01
	select SOC_PACKAGE_PSOC6_01_80_WLCSP
	depends on SOC_SERIES_PSOC_61

config SOC_CY8C6247FDI_D02
	bool "CY8C6247FDI_D02"
	select SOC_DIE_PSOC6_01
	select SOC_PACKAGE_PSOC6_01_80_WLCSP
	depends on SOC_SERIES_PSOC_62

config SOC_CY8C6247FDI_D32
	bool "CY8C6247FDI_D32"
	select SOC_DIE_PSOC6_01
	select SOC_PACKAGE_PSOC6_01_80_WLCSP
	depends on SOC_SERIES_PSOC_62

config SOC_CY8C6336BZI_BUD13
	bool "CY8C6336BZI_BUD13"
	select SOC_DIE_PSOC6_01
	select SOC_PACKAGE_PSOC6_01_116_BGA_USB
	depends on SOC_SERIES_PSOC_63

config SOC_CY8C6347BZI_BUD43
	bool "CY8C6347BZI_BUD43"
	select SOC_DIE_PSOC6_01
	select SOC_PACKAGE_PSOC6_01_116_BGA_USB
	depends on SOC_SERIES_PSOC_63

config SOC_CY8C6347BZI_BUD33
	bool "CY8C6347BZI_BUD33"
	select SOC_DIE_PSOC6_01
	select SOC_PACKAGE_PSOC6_01_116_BGA_USB
	depends on SOC_SERIES_PSOC_63

config SOC_CY8C6347BZI_BUD53
	bool "CY8C6347BZI_BUD53"
	select SOC_DIE_PSOC6_01
	select SOC_PACKAGE_PSOC6_01_116_BGA_USB
	depends on SOC_SERIES_PSOC_63

config SOC_CY8C6337BZI_BLF13
	bool "CY8C6337BZI_BLF13"
	select SOC_DIE_PSOC6_01
	select SOC_PACKAGE_PSOC6_01_116_BGA_BLE
	depends on SOC_SERIES_PSOC_63

config SOC_CY8C6136FDI_F42
	bool "CY8C6136FDI_F42"
	select SOC_DIE_PSOC6_01
	select SOC_PACKAGE_PSOC6_01_80_WLCSP
	depends on SOC_SERIES_PSOC_61

config SOC_CY8C6247FDI_D52
	bool "CY8C6247FDI_D52"
	select SOC_DIE_PSOC6_01
	select SOC_PACKAGE_PSOC6_01_80_WLCSP
	depends on SOC_SERIES_PSOC_62

config SOC_CY8C6136FTI_F42
	bool "CY8C6136FTI_F42"
	select SOC_DIE_PSOC6_01
	select SOC_PACKAGE_PSOC6_01_80_WLCSP
	depends on SOC_SERIES_PSOC_61

config SOC_CY8C6247FTI_D52
	bool "CY8C6247FTI_D52"
	select SOC_DIE_PSOC6_01
	select SOC_PACKAGE_PSOC6_01_80_WLCSP
	depends on SOC_SERIES_PSOC_62

config SOC_CY8C6247BZI_AUD54
	bool "CY8C6247BZI_AUD54"
	select SOC_DIE_PSOC6_01
	select SOC_PACKAGE_PSOC6_01_124_BGA
	depends on SOC_SERIES_PSOC_62

config SOC_CY8C6336BZI_BLF04
	bool "CY8C6336BZI_BLF04"
	select SOC_DIE_PSOC6_01
	select SOC_PACKAGE_PSOC6_01_124_BGA_SIP
	depends on SOC_SERIES_PSOC_63

config SOC_CY8C6316BZI_BLF04
	bool "CY8C6316BZI_BLF04"
	select SOC_DIE_PSOC6_01
	select SOC_PACKAGE_PSOC6_01_124_BGA_SIP
	depends on SOC_SERIES_PSOC_63

config SOC_CY8C6316BZI_BLF54
	bool "CY8C6316BZI_BLF54"
	select SOC_DIE_PSOC6_01
	select SOC_PACKAGE_PSOC6_01_124_BGA_SIP
	depends on SOC_SERIES_PSOC_63

config SOC_CY8C6336BZI_BLD14
	bool "CY8C6336BZI_BLD14"
	select SOC_DIE_PSOC6_01
	select SOC_PACKAGE_PSOC6_01_124_BGA_SIP
	depends on SOC_SERIES_PSOC_63

config SOC_CY8C6347BZI_BLD44
	bool "CY8C6347BZI_BLD44"
	select SOC_DIE_PSOC6_01
	select SOC_PACKAGE_PSOC6_01_124_BGA_SIP
	depends on SOC_SERIES_PSOC_63

config SOC_CY8C6347BZI_BLD34
	bool "CY8C6347BZI_BLD34"
	select SOC_DIE_PSOC6_01
	select SOC_PACKAGE_PSOC6_01_124_BGA_SIP
	depends on SOC_SERIES_PSOC_63

config SOC_CY8C6347BZI_BLD54
	bool "CY8C6347BZI_BLD54"
	select SOC_DIE_PSOC6_01
	select SOC_PACKAGE_PSOC6_01_124_BGA_SIP
	depends on SOC_SERIES_PSOC_63

config SOC_CY8C6247BFI_D54
	bool "CY8C6247BFI_D54"
	select SOC_DIE_PSOC6_01
	select SOC_PACKAGE_PSOC6_01_124_BGA
	depends on SOC_SERIES_PSOC_62

config SOC_CYBLE_416045_02
	bool "CYBLE_416045_02"
	select SOC_DIE_PSOC6_01
	select SOC_PACKAGE_PSOC6_01_116_BGA_BLE
	depends on SOC_SERIES_PSOC_63

config SOC_CY8C6347FMI_BUD53
	bool "CY8C6347FMI_BUD53"
	select SOC_DIE_PSOC6_01
	select SOC_PACKAGE_PSOC6_01_104_M_CSP_BLE_USB
	depends on SOC_SERIES_PSOC_63

config SOC_CY8C6347FMI_BUD13
	bool "CY8C6347FMI_BUD13"
	select SOC_DIE_PSOC6_01
	select SOC_PACKAGE_PSOC6_01_104_M_CSP_BLE_USB
	depends on SOC_SERIES_PSOC_63

config SOC_CY8C6347FMI_BUD43
	bool "CY8C6347FMI_BUD43"
	select SOC_DIE_PSOC6_01
	select SOC_PACKAGE_PSOC6_01_104_M_CSP_BLE_USB
	depends on SOC_SERIES_PSOC_63

config SOC_CY8C6347FMI_BUD33
	bool "CY8C6347FMI_BUD33"
	select SOC_DIE_PSOC6_01
	select SOC_PACKAGE_PSOC6_01_104_M_CSP_BLE_USB
	depends on SOC_SERIES_PSOC_63

config SOC_CY8C6137WI_F54
	bool "CY8C6137WI_F54"
	select SOC_DIE_PSOC6_01
	select SOC_PACKAGE_PSOC6_01_124_BGA
	depends on SOC_SERIES_PSOC_61

config SOC_CY8C6117WI_F34
	bool "CY8C6117WI_F34"
	select SOC_DIE_PSOC6_01
	select SOC_PACKAGE_PSOC6_01_124_BGA
	depends on SOC_SERIES_PSOC_61

config SOC_CY8C6247WI_D54
	bool "CY8C6247WI_D54"
	select SOC_DIE_PSOC6_01
	select SOC_PACKAGE_PSOC6_01_124_BGA
	depends on SOC_SERIES_PSOC_62

config SOC_CY8C6336LQI_BLF02
	bool "CY8C6336LQI_BLF02"
	select SOC_DIE_PSOC6_01
	select SOC_PACKAGE_PSOC6_01_68_QFN_BLE
	depends on SOC_SERIES_PSOC_63

config SOC_CY8C6336LQI_BLF42
	bool "CY8C6336LQI_BLF42"
	select SOC_DIE_PSOC6_01
	select SOC_PACKAGE_PSOC6_01_68_QFN_BLE
	depends on SOC_SERIES_PSOC_63

config SOC_CY8C6347LQI_BLD52
	bool "CY8C6347LQI_BLD52"
	select SOC_DIE_PSOC6_01
	select SOC_PACKAGE_PSOC6_01_68_QFN_BLE
	depends on SOC_SERIES_PSOC_63

config SOC_CYB06447BZI_BLD54
	bool "CYB06447BZI_BLD54"
	select SOC_DIE_PSOC6_01
	select SOC_PACKAGE_PSOC6_01_124_BGA_SIP
	depends on SOC_SERIES_PSOC_64

config SOC_CYB06447BZI_BLD53
	bool "CYB06447BZI_BLD53"
	select SOC_DIE_PSOC6_01
	select SOC_PACKAGE_PSOC6_01_116_BGA_BLE
	depends on SOC_SERIES_PSOC_64

config SOC_CYB06447BZI_D54
	bool "CYB06447BZI_D54"
	select SOC_DIE_PSOC6_01
	select SOC_PACKAGE_PSOC6_01_124_BGA
	depends on SOC_SERIES_PSOC_64
```
