## soc/soc_legacy/arm/nuvoton_npcx/npcx7/Kconfig.soc
```kconfig
# Nuvoton NPCX7 EC series

# Copyright (c) 2020 Nuvoton Technology Corporation.
# SPDX-License-Identifier: Apache-2.0

choice
	prompt "NPCX7 Selection"
	depends on SOC_SERIES_NPCX7

config SOC_NPCX7M6FB
	bool "NPCX7M6FB"

config SOC_NPCX7M6FC
	bool "NPCX7M6FC"

config SOC_NPCX7M7FC
	bool "NPCX7M7FC"

endchoice
```

## soc/soc_legacy/arm/nuvoton_npcx/npcx9/Kconfig.defconfig.npcx9m6f
```kconfig
# Nuvoton Cortex-M4 Embedded Controller

# Copyright (c) 2021 Nuvoton Technology Corporation.
# SPDX-License-Identifier: Apache-2.0

if SOC_NPCX9M6F

config SOC
	default "npcx9m6f"

endif # SOC_NPCX9M6F
```

## soc/soc_legacy/arm/nuvoton_numaker/Kconfig.defconfig
```kconfig
# Copyright (c) 2023 Nuvoton Technology Corporation.
#
# SPDX-License-Identifier: Apache-2.0

source "soc/soc_legacy/arm/nuvoton_numaker/*/Kconfig.defconfig.series"

if SOC_FAMILY_NUMAKER

config RESET
	default y

endif
```

## soc/soc_legacy/arm/nuvoton_numaker/Kconfig.soc
```kconfig
# Copyright (c) 2023 Nuvoton Technology Corporation.
#
# SPDX-License-Identifier: Apache-2.0

source "soc/soc_legacy/arm/nuvoton_numaker/*/Kconfig.series"
```

## soc/soc_legacy/arm/nuvoton_numicro/m48x/Kconfig.soc
```kconfig
# SPDX-License-Identifier: Apache-2.0
#
# Copyright (c) 2020 Linumiz
# Author: Saravanan Sekar <saravanan@linumiz.com>

choice
	prompt "NUVOTON M48X MCU Selection"
	depends on SOC_SERIES_M48X

config SOC_M487
	bool "M487"
	select HAS_NUMICRO_HAL

endchoice
```

## soc/soc_legacy/arm/nxp_imx/Kconfig.soc
```kconfig
# Copyright (c) 2017, NXP
# SPDX-License-Identifier: Apache-2.0

source "soc/soc_legacy/arm/nxp_imx/*/Kconfig.series"
```

## soc/soc_legacy/arm/nxp_imx/mcimx6x_m4/Kconfig.defconfig.mcimx6x_m4
```kconfig
# i.MX 6SoloX

# Copyright (c) 2018, NXP
# SPDX-License-Identifier: Apache-2.0

if SOC_MCIMX6X_M4

config SOC
	default "mcimx6x"

config FPU
	default y

endif # SOC_MCIMX6X_M4
```

## soc/soc_legacy/arm/nxp_imx/rt/Kconfig.defconfig.mimxrt1064
```kconfig
# i.MX RT1064

# Copyright (c) 2018, NXP
# SPDX-License-Identifier: Apache-2.0

if SOC_MIMXRT1064

config SOC
	default "mimxrt1064"

config NUM_IRQS
	default 160

config GPIO
	default y

endif # SOC_MIMXRT1064
```

## soc/soc_legacy/arm/nxp_imx/rt/Kconfig.defconfig.mimxrt1176_cm4
```kconfig
# i.MX RT1170 CM4

# Copyright (c) 2021, NXP
# SPDX-License-Identifier: Apache-2.0

if SOC_MIMXRT1176_CM4

config SOC
	default "mimxrt1176_cm4"

config NUM_IRQS
	default 218

config GPIO
	default y

config SYS_CLOCK_HW_CYCLES_PER_SEC
	default 400000000 if CORTEX_M_SYSTICK

endif # SOC_MIMXRT1170_CM4
```

## soc/soc_legacy/arm/nxp_imx/rt/Kconfig.series
```kconfig
# iMX RT series

# Copyright (c) 2017-2021,2023 NXP
# SPDX-License-Identifier: Apache-2.0

config SOC_SERIES_IMX_RT
	bool "i.MX RT Series"
	select ARM
	select SOC_FAMILY_IMX
	select CLOCK_CONTROL
	select HAS_PM
	select CPU_HAS_CUSTOM_FIXED_SOC_MPU_REGIONS
	help
	  Enable support for i.MX RT MCU series
```

## soc/soc_legacy/arm/nxp_kinetis/Kconfig.soc
```kconfig
# Copyright (c) 2016 Intel Corporation
# SPDX-License-Identifier: Apache-2.0

source "soc/soc_legacy/arm/nxp_kinetis/*/Kconfig.series"
```

## soc/soc_legacy/arm/nxp_kinetis/k2x/Kconfig.defconfig.mk22fx12
```kconfig
# Copyright 2023 Daniel DeGrasse
# SPDX-License-Identifier: Apache-2.0

# Kinetis MK22FX12 configuration options

if SOC_MK22F12

config SOC
	default "mk22f12"

config NUM_IRQS
	default 81

config CPU_HAS_CUSTOM_FIXED_SOC_MPU_REGIONS
	default y

endif # SOC_MK22F12
```

## soc/soc_legacy/arm/nxp_kinetis/k6x/Kconfig.soc
```kconfig
# Kinetis K6X MCU line

# Copyright (c) 2016 Open-RnD Sp. z o.o.
# SPDX-License-Identifier: Apache-2.0

choice
	prompt "Kinetis K6x MCU Selection"
	depends on SOC_SERIES_KINETIS_K6X

config SOC_MK64F12
	bool "SOC_MK64F12"
	select HAS_MCUX
	select HAS_MCUX_ADC16
	select HAS_MCUX_ENET
	select HAS_MCUX_FLEXCAN
	select HAS_MCUX_FTFX
	select HAS_MCUX_FTM
	select HAS_MCUX_RNGA
	select HAS_MCUX_SIM
	select HAS_OSC
	select HAS_MCG
	select CPU_HAS_FPU
	select HAS_MCUX_RTC
	select HAS_MCUX_DAC
	select HAS_MCUX_EDMA
	select HAS_MCUX_RCM

config SOC_MK66F18
	bool "SOC_MK66F18"
	select HAS_MCUX
	select HAS_MCUX_ADC16
	select HAS_MCUX_ENET
	select HAS_MCUX_FLEXCAN
	select HAS_MCUX_FTFX
	select HAS_MCUX_FTM
	select HAS_MCUX_RNGA
	select HAS_MCUX_SIM
	select HAS_OSC
	select HAS_MCG
	select CPU_HAS_FPU
	select HAS_MCUX_RTC
	select HAS_MCUX_DAC
	select HAS_MCUX_EDMA
	select HAS_MCUX_RCM
	select HAS_MCUX_LPUART

endchoice

if SOC_SERIES_KINETIS_K6X

config SOC_PART_NUMBER_MK64FN1M0CAJ12
	bool

config SOC_PART_NUMBER_MK64FN1M0VDC12
	bool

config SOC_PART_NUMBER_MK64FN1M0VLL12
	bool

config SOC_PART_NUMBER_MK64FN1M0VLQ12
	bool

config SOC_PART_NUMBER_MK64FN1M0VMD12
	bool

config SOC_PART_NUMBER_MK64FX512VDC12
	bool

config SOC_PART_NUMBER_MK64FX512VLL12
	bool

config SOC_PART_NUMBER_MK64FX512VLQ12
	bool

config SOC_PART_NUMBER_MK64FX512VMD12
	bool

config SOC_PART_NUMBER_MK66FN2M0VMD18
	bool

config SOC_PART_NUMBER_MK66FN2M0VLQ18
	bool

config SOC_PART_NUMBER_KINETIS_K6X
	string
	default "MK64FN1M0CAJ12" if SOC_PART_NUMBER_MK64FN1M0CAJ12
	default "MK64FN1M0VDC12" if SOC_PART_NUMBER_MK64FN1M0VDC12
	default "MK64FN1M0VLL12" if SOC_PART_NUMBER_MK64FN1M0VLL12
	default "MK64FN1M0VLQ12" if SOC_PART_NUMBER_MK64FN1M0VLQ12
	default "MK64FN1M0VMD12" if SOC_PART_NUMBER_MK64FN1M0VMD12
	default "MK64FX512VDC12" if SOC_PART_NUMBER_MK64FX512VDC12
	default "MK64FX512VLL12" if SOC_PART_NUMBER_MK64FX512VLL12
	default "MK64FX512VLQ12" if SOC_PART_NUMBER_MK64FX512VLQ12
	default "MK64FX512VMD12" if SOC_PART_NUMBER_MK64FX512VMD12
	default "MK66FN2M0VMD18" if SOC_PART_NUMBER_MK66FN2M0VMD18
	default "MK66FN2M0VLQ18" if SOC_PART_NUMBER_MK66FN2M0VLQ18

	help
	  This string holds the full part number of the SoC. It is a hidden option
	  that you should not set directly. The part number selection choice defines
	  the default value for this string.

config K6X_HSRUN
	bool "High Speed RUN mode"
	depends on SOC_MK66F18
	default y
	help
	  This options enables support for High Speed RUN mode on K66F SoC.

endif # SOC_SERIES_KINETIS_K6X
```

## soc/soc_legacy/arm/nxp_kinetis/ke1xf/Kconfig.defconfig.mke16f16
```kconfig
# Kinetis KE16F16 configuration options

# Copyright (c) 2019 Vestas Wind Systems A/S
# SPDX-License-Identifier: Apache-2.0

if SOC_MKE16F16

config SOC
	default "mke16f16"

endif # SOC_MKE16F16
```

## soc/soc_legacy/arm/nxp_kinetis/kv5x/Kconfig.defconfig.mkv58f24
```kconfig
# Kinetis KV58F24 configuration options

# Copyright (c) 2019 SEAL AG
# SPDX-License-Identifier: Apache-2.0

config SOC
	default "mkv58f24"
	depends on SOC_MKV58F24
```

## soc/soc_legacy/arm/nxp_kinetis/kwx/Kconfig.defconfig.series
```kconfig
# Kinetis KWx series configuration options

# Copyright (c) 2017, NXP
# SPDX-License-Identifier: Apache-2.0

if SOC_SERIES_KINETIS_KWX

config SOC_SERIES
	default "kwx"

source "soc/soc_legacy/arm/nxp_kinetis/kwx/Kconfig.defconfig.mk*"

endif # SOC_SERIES_KINETIS_KWX
```

## soc/soc_legacy/arm/nxp_lpc/Kconfig.defconfig
```kconfig
# Copyright (c) 2017, NXP
# SPDX-License-Identifier: Apache-2.0

source "soc/soc_legacy/arm/nxp_lpc/*/Kconfig.defconfig.series"

config SERIAL_INIT_PRIORITY
	default 55
	depends on SERIAL
```

## soc/soc_legacy/arm/nxp_lpc/Kconfig.soc
```kconfig
# Copyright (c) 2017, NXP
# SPDX-License-Identifier: Apache-2.0

source "soc/soc_legacy/arm/nxp_lpc/*/Kconfig.series"
```

## soc/soc_legacy/arm/nxp_lpc/lpc11u6x/Kconfig.defconfig.lpc11u66
```kconfig
# NXP LPC11U66 platform configuration options

# Copyright (c) 2020, Seagate
# SPDX-License-Identifier: Apache-2.0

if SOC_LPC11U66

config SOC
	default "lpc11u66"

endif # SOC_LPC11U66
```

## soc/soc_legacy/arm/nxp_lpc/lpc11u6x/Kconfig.defconfig.lpc11u67
```kconfig
# NXP LPC11U67 platform configuration options

# Copyright (c) 2020, Seagate
# SPDX-License-Identifier: Apache-2.0

if SOC_LPC11U67

config SOC
	default "lpc11u67"

endif # SOC_LPC11U67
```

## soc/soc_legacy/arm/nxp_lpc/lpc51u68/Kconfig.soc
```kconfig
# LPC LPC51U68 MCU line

# Copyright (c) 2021 metraTec GmbH
# SPDX-License Identifier: Apache-2.0

config SOC_LPC51U68
	bool "SOC_LPC51U68"
	depends on SOC_SERIES_LPC51U68
	select CLOCK_CONTROL

if SOC_SERIES_LPC51U68

config SOC_PART_NUMBER_LPC51U68JBD48
	bool
config SOC_PART_NUMBER_LPC51U68JBD64
	bool

config SOC_PART_NUMBER_LPC51U68
	string
	default "LPC51U68JBD48" if SOC_PART_NUMBER_LPC51U68JBD48
	default "LPC51U68JBD64" if SOC_PART_NUMBER_LPC51U68JBD64
	help
	  This string holds the full part number of the SoC. It is a hidden
	  option that you should not set directly. The part number selection
	  choice defines the default value for this string.

endif # SOC_SERIES_LPC51U68
```

## soc/soc_legacy/arm/nxp_lpc/lpc55xxx/Kconfig.defconfig.lpc55S28
```kconfig
# NXP LPC55S28 platform configuration options

# Copyright (c) 2020 Lemonbeat GmbH
# SPDX-License-Identifier: Apache-2.0

if SOC_LPC55S28

config SOC
	default "lpc55S28"

choice USB_MCUX_CONTROLLER_TYPE
	default USB_DC_NXP_LPCIP3511
endchoice

endif # SOC_LPC55S28
```

## soc/soc_legacy/arm/nxp_s32/Kconfig.defconfig
```kconfig
# Copyright 2022 NXP
# SPDX-License-Identifier: Apache-2.0

source "soc/soc_legacy/arm/nxp_s32/*/Kconfig.defconfig.series"
```

## soc/soc_legacy/arm/nxp_s32/s32k1/Kconfig.defconfig.s32k146
```kconfig
# NXP S32K146

# Copyright 2023 NXP
# SPDX-License-Identifier: Apache-2.0

if SOC_S32K146

config SOC
	default "s32k146"

config FPU
	default y

endif # SOC_S32K146
```
