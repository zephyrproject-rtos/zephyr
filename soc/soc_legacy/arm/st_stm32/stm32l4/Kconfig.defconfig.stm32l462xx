## soc/soc_legacy/arm/st_stm32/stm32l4/Kconfig.defconfig.stm32l462xx
```kconfig
# ST Microelectronics STM32L462XX MCU

# Copyright (c) 2020 Giancarlo Stasi
# SPDX-License-Identifier: Apache-2.0

if SOC_STM32L462XX

config SOC
	default "stm32l462xx"

config NUM_IRQS
	default 85

endif # SOC_STM32L462XX
```

## soc/soc_legacy/arm/st_stm32/stm32l4/Kconfig.defconfig.stm32l471xx
```kconfig
# ST Microelectronics STM32L476RG MCU

# Copyright (c) 2018 Allterco Robotics
# SPDX-License-Identifier: Apache-2.0

if SOC_STM32L471XX

config SOC
	default "stm32l471xx"

config NUM_IRQS
	default 82

endif # SOC_STM32L471XX
```

## soc/soc_legacy/arm/st_stm32/stm32l4/Kconfig.defconfig.stm32l486xx
```kconfig
# ST Microelectronics STM32L486xx MCU

# Copyright (c) 2016 Open-RnD Sp. z o.o.
# Copyright (c) 2016 BayLibre, SAS
# Copyright (c) 2022 Tomislav Milkovic
# SPDX-License-Identifier: Apache-2.0

if SOC_STM32L486XX

config SOC
	default "stm32l486xx"

config NUM_IRQS
	default 82

endif # SOC_STM32L486XX
```

## soc/soc_legacy/arm/st_stm32/stm32l4/Kconfig.defconfig.stm32l4r5xx
```kconfig
# ST Microelectronics STM32L4R5xx MCU

# Copyright (c) 2018 Pushpal Sidhu
# SPDX-License-Identifier: Apache-2.0

if SOC_STM32L4R5XX

config SOC
	default "stm32l4r5xx"

config NUM_IRQS
	default 95

endif # SOC_STM32L4R5XX
```

## soc/soc_legacy/arm/st_stm32/stm32l5/Kconfig.defconfig.stm32l552xx
```kconfig
# ST Microelectronics STM32L552XX MCU

# Copyright (c) 2020 Linaro Limited
# SPDX-License-Identifier: Apache-2.0

if SOC_STM32L552XX

config SOC
	default "stm32l552xx"

config NUM_IRQS
	default 108

endif # SOC_STM32L552XX
```

## soc/soc_legacy/arm/st_stm32/stm32l5/Kconfig.defconfig.stm32l562xx
```kconfig
# ST Microelectronics STM32L562XX MCU

# Copyright (c) 2020 Yestin Sun
# SPDX-License-Identifier: Apache-2.0

if SOC_STM32L562XX

config SOC
	default "stm32l562xx"

config NUM_IRQS
	default 109

endif # SOC_STM32L562XX
```

## soc/soc_legacy/arm/st_stm32/stm32l5/Kconfig.soc
```kconfig
# ST Microelectronics STM32L5 MCU line

# Copyright (c) 2020 Linaro Limited
# SPDX-License-Identifier: Apache-2.0

choice
prompt "STM32L5x MCU Selection"
depends on SOC_SERIES_STM32L5X

config SOC_STM32L552XX
	bool "STM32L552XX"

config SOC_STM32L562XX
	bool "STM32L562XX"

endchoice
```

## soc/soc_legacy/arm/st_stm32/stm32mp1/Kconfig.soc
```kconfig
# ST Microelectronics STM32MP1 MPU line

# Copyright (c) 2019 STMicroelectronics
# SPDX-License-Identifier: Apache-2.0

choice
	prompt "STM32MP1 MPU Selection"
	depends on SOC_SERIES_STM32MP1X

config SOC_STM32MP15_M4
	bool "STM32MP15_M4"

endchoice
```

## soc/soc_legacy/arm/st_stm32/stm32u5/Kconfig.defconfig.stm32u575xx
```kconfig
# ST Microelectronics STM32U575XX MCU

# Copyright (c) 2021 Linaro Limited
# SPDX-License-Identifier: Apache-2.0

if SOC_STM32U575XX

config SOC
	default "stm32u575xx"

config NUM_IRQS
	default 125

endif # SOC_STM32U575XX
```

## soc/soc_legacy/arm/st_stm32/stm32u5/Kconfig.defconfig.stm32u595xx
```kconfig
# STMicroelectronics STM32U595XX MCU

# Copyright (c) 2023 PSICONTROL nv
# SPDX-License-Identifier: Apache-2.0

if SOC_STM32U595XX

config SOC
	default "stm32u595xx"

config NUM_IRQS
	default 132

endif # SOC_STM32U595XX
```

## soc/soc_legacy/arm/st_stm32/stm32u5/Kconfig.defconfig.stm32u5a5xx
```kconfig
# STMicroelectronics STM32U5A5XX MCU

# Copyright (c) 2023 STMicroelectronics
# SPDX-License-Identifier: Apache-2.0

if SOC_STM32U5A5XX

config SOC
	default "stm32u5a5xx"

config NUM_IRQS
	default 139

endif # SOC_STM32U5A5XX
```

## soc/soc_legacy/arm/st_stm32/stm32u5/Kconfig.defconfig.stm32u5a9xx
```kconfig
# STMicroelectronics STM32U5A9XX MCU

# Copyright (c) 2023 STMicroelectronics
# SPDX-License-Identifier: Apache-2.0

if SOC_STM32U5A9XX

config SOC
	default "stm32u5a9xx"

config NUM_IRQS
	default 139

endif # SOC_STM32U5A9XX
```

## soc/soc_legacy/arm/st_stm32/stm32wba/Kconfig.defconfig.stm32wba52xx
```kconfig
# ST Microelectronics STM32WBA52XX MCU

# Copyright (c) 2023 STMicroelectronics
# SPDX-License-Identifier: Apache-2.0

if SOC_STM32WBA52XX

config SOC
	default "stm32wba52xx"

config NUM_IRQS
	default 70

endif # SOC_STM32WBA52XX
```

## soc/soc_legacy/arm/st_stm32/stm32wl/Kconfig.defconfig.stm32wle5xx
```kconfig
# STMicroelectronics STM32WLE5 MCU

# Copyright (c) 2021 Thomas Stranger
# SPDX-License-Identifier: Apache-2.0

if SOC_STM32WLE5XX

config SOC
	default "stm32wle5xx"

config NUM_IRQS
	default 62

endif # SOC_STM32WLE5XX
```

## soc/soc_legacy/arm/ti_lm3s6965/Kconfig
```kconfig
# TI LM3S6965 platform configuration options

# Copyright (c) 2014-2015 Wind River Systems, Inc.
# SPDX-License-Identifier: Apache-2.0

config SOC_TI_LM3S6965_QEMU
	def_bool y
	depends on SOC_TI_LM3S6965
	# Platform has only been tested on QEMU, not on real hardware, so always
	# assume it is used for a QEMU target.
```

## soc/soc_legacy/arm/ti_simplelink/Kconfig.soc
```kconfig
# Texas Instruments SimpleLink Family

# SPDX-License-Identifier: Apache-2.0

source "soc/soc_legacy/arm/ti_simplelink/*/Kconfig.series"
```

## soc/soc_legacy/arm/ti_simplelink/cc32xx/Kconfig.soc
```kconfig
# Texas Instruments CC32XX

# SPDX-License-Identifier: Apache-2.0

choice
	prompt "TI SimpleLink MCU Selection"
	depends on SOC_SERIES_CC32XX

config SOC_CC3220SF
	bool "CC3220SF"
	select HAS_CC3220SDK

config SOC_CC3235SF
	bool "CC3235SF"
	select HAS_CC3220SDK

endchoice

config CC3220SF_DEBUG
	bool "Prepend debug header, disabling flash verification" if XIP
	default XIP
	depends on SOC_CC3220SF

config CC3235SF_DEBUG
	bool "Prepend debug header, disabling flash verification" if XIP
	default XIP
	depends on SOC_CC3235SF
```

## soc/soc_legacy/arm/xilinx_zynq7000/Kconfig.soc
```kconfig
#
# Copyright (c) 2021 Weidmueller Interface GmbH & Co. KG
# SPDX-License-Identifier: Apache-2.0
#

source "soc/soc_legacy/arm/xilinx_zynq7000/*/Kconfig.series"
```

## soc/soc_legacy/arm64/Kconfig
```kconfig
# General options signifying CPU capabilities of ARM64 SoCs

# Copyright (c) 2018 Nordic Semiconductor ASA.
# SPDX-License-Identifier: Apache-2.0

config SOC_PART_NUMBER
	string
	help
	  This string holds the full part number of the SoC. It is a hidden option
	  that you should not set directly. The part number selection choice defines
	  the default value for this string.
```

## soc/soc_legacy/arm64/intel_socfpga/Kconfig.soc
```kconfig
# Copyright (c) 2021 Intel Corporation
# SPDX-License-Identifier: Apache-2.0

source "soc/soc_legacy/arm64/intel_socfpga/*/Kconfig.series"
```

## soc/soc_legacy/arm64/nxp_imx/Kconfig.soc
```kconfig
# Copyright (c) 2017, NXP
# SPDX-License-Identifier: Apache-2.0

source "soc/soc_legacy/arm64/nxp_imx/*/Kconfig.series"
```

## soc/soc_legacy/arm64/nxp_layerscape/Kconfig.soc
```kconfig
#
# Copyright 2021 NXP
#
# SPDX-License-Identifier: Apache-2.0
#

source "soc/soc_legacy/arm64/nxp_layerscape/*/Kconfig.series"
```

## soc/soc_legacy/arm64/renesas_rcar/Kconfig.defconfig
```kconfig
# Copyright (c) 2023 EPAM Systems
# SPDX-License-Identifier: Apache-2.0

source "soc/soc_legacy/arm64/renesas_rcar/*/Kconfig.defconfig.series"
```

## soc/soc_legacy/arm64/renesas_rcar/gen3/Kconfig.defconfig.series
```kconfig
# Renesas R-Car Gen3 SoC line

# Copyright (c) 2023 EPAM Systems
# SPDX-License-Identifier: Apache-2.0

if SOC_SERIES_RCAR_GEN3

config SOC_SERIES
	default "gen3"

config NUM_IRQS
	int
	default 240

config PINCTRL
	default y

endif # SOC_SERIES_RCAR_GEN3
```

## soc/soc_legacy/posix/inf_clock/Kconfig.defconfig
```kconfig
# Copyright (c) 2017 Intel Corporation
# SPDX-License-Identifier: Apache-2.0

config SOC
	default "inf_clock"
	depends on SOC_POSIX
```
