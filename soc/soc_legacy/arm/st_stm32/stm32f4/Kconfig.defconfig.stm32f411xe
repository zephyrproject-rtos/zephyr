## soc/soc_legacy/arm/st_stm32/stm32f4/Kconfig.defconfig.stm32f411xe
```kconfig
# ST STM32F411CE MCU configuration options

# Copyright (c) 2016 Linaro Limited.
# SPDX-License-Identifier: Apache-2.0

if SOC_STM32F411XE

config SOC
	default "stm32f411xe"

config NUM_IRQS
	default 86

endif # SOC_STM32F411XE
```

## soc/soc_legacy/arm/st_stm32/stm32f4/Kconfig.defconfig.stm32f412rx
```kconfig
# ST STM32F412Rx MCU configuration options

# Copyright (c) 2022, STMicroelectronics
# SPDX-License-Identifier: Apache-2.0

if SOC_STM32F412RX

config SOC
	default "stm32f412rx"

config NUM_IRQS
	default 97

endif # SOC_STM32F412RX
```

## soc/soc_legacy/arm/st_stm32/stm32f4/Kconfig.defconfig.stm32f437xx
```kconfig
# ST STM32F437XX MCU configuration options

# Copyright (c) 2019, Markus Fuchs <markus.fuchs@de.sauter-bc.com>
# SPDX-License-Identifier: Apache-2.0

if SOC_STM32F437XX

config SOC
	default "stm32f437xx"

config NUM_IRQS
	default 91

endif # SOC_STM32F437XX
```

## soc/soc_legacy/arm/st_stm32/stm32f4/Kconfig.defconfig.stm32f446xx
```kconfig
# ST STM32F446XE MCU configuration options

# Copyright (c) 2018 Philemon Jaermann.
# SPDX-License-Identifier: Apache-2.0

if SOC_STM32F446XX

config SOC
	default "stm32f446xx"

config NUM_IRQS
	default 97

endif # SOC_STM32F446XX
```

## soc/soc_legacy/arm/st_stm32/stm32f7/Kconfig.defconfig.stm32f745xx
```kconfig
# ST STM32F745XX MCU configuration options

# Copyright (c) 2020 Kwon Tae-young <tykwon@m2i.co.kr>
# SPDX-License-Identifier: Apache-2.0

if SOC_STM32F745XX

config SOC
	default "stm32f745xx"

config NUM_IRQS
	default 98

endif # SOC_STM32F745XX
```

## soc/soc_legacy/arm/st_stm32/stm32f7/Kconfig.defconfig.stm32f750xx
```kconfig
# ST STM32F750XX MCU configuration options

# Copyright (c) 2022, Rtone.
# SPDX-License-Identifier: Apache-2.0

if SOC_STM32F750XX

config SOC
	default "stm32f750xx"

config NUM_IRQS
	default 98

endif # SOC_STM32F750XX
```

## soc/soc_legacy/arm/st_stm32/stm32f7/Kconfig.defconfig.stm32f765xx
```kconfig
# ST STM32F765XX MCU configuration options

# Copyright (c) 2023 Rahul Arasikere
# SPDX-License-Identifier: Apache-2.0

if SOC_STM32F765XX

config SOC
	default "stm32f765xx"

config NUM_IRQS
	default 110

endif # SOC_STM32F765XX
```

## soc/soc_legacy/arm/st_stm32/stm32f7/Kconfig.defconfig.stm32f769xx
```kconfig
# ST STM32F769XI MCU configuration options

# Copyright (c) 2018  Yong Jin
# SPDX-License-Identifier: Apache-2.0

if SOC_STM32F769XX

config SOC
	default "stm32f769xx"

config NUM_IRQS
	default 110

endif # SOC_STM32F769XX
```

## soc/soc_legacy/arm/st_stm32/stm32g0/Kconfig.defconfig.stm32g031xx
```kconfig
# STMicroelectronics STM32G031xx MCU

# Copyright (c) 2019 SEAL AG
# SPDX-License-Identifier: Apache-2.0

if SOC_STM32G031XX

config SOC
	default "stm32g031xx"

config NUM_IRQS
	default 30

endif # SOC_STM32G031XX
```

## soc/soc_legacy/arm/st_stm32/stm32g0/Kconfig.defconfig.stm32g041xx
```kconfig
# STMicroelectronics STM32G041xx MCU

# Copyright (c) 2021 Thomas Stranger
# SPDX-License-Identifier: Apache-2.0

if SOC_STM32G041XX

config SOC
	default "stm32g041xx"

config NUM_IRQS
	default 32

endif # SOC_STM32G041XX
```

## soc/soc_legacy/arm/st_stm32/stm32g0/Kconfig.defconfig.stm32g050xx
```kconfig
# STMicroelectronics STM32G050xx MCU

# Copyright (c) 2020 Thomas Stranger
# SPDX-License-Identifier: Apache-2.0

if SOC_STM32G050XX

config SOC
	default "stm32g050xx"

config NUM_IRQS
	default 29

endif # SOC_STM32G050XX
```

## soc/soc_legacy/arm/st_stm32/stm32g0/Kconfig.soc
```kconfig
# STMicroelectronics STM32G0 MCU line

# Copyright (c) 2019 Philippe Retornaz <philippe@shapescale.com>
# Copyright (c) 2019 STMicroelectronics
# Copyright (c) 2020 Thomas Stranger
# SPDX-License-Identifier: Apache-2.0

choice
	prompt "STM32G0x MCU Selection"
	depends on SOC_SERIES_STM32G0X

config SOC_STM32G030XX
	bool "STM32G030XX"

config SOC_STM32G031XX
	bool "STM32G031XX"

config SOC_STM32G041XX
	bool "STM32G041XX"

config SOC_STM32G050XX
	bool "STM32G050XX"

config SOC_STM32G051XX
	bool "STM32G051XX"

config SOC_STM32G061XX
	bool "STM32G061XX"

config SOC_STM32G070XX
	bool "STM32G070XX"

config SOC_STM32G071XX
	bool "STM32G071XX"

config SOC_STM32G081XX
	bool "STM32G081XX"

config SOC_STM32G0B0XX
	bool "STM32G0B0XX"

config SOC_STM32G0B1XX
	bool "STM32G0B1XX"

config SOC_STM32G0C1XX
	bool "STM32G0C1XX"

endchoice
```

## soc/soc_legacy/arm/st_stm32/stm32g4/Kconfig.defconfig.stm32g431rb
```kconfig
# STMicroelectronics STM32G431RB MCU

# Copyright (c) 2019 Richard Osterloh <richard.osterloh@gmail.com>
# SPDX-License-Identifier: Apache-2.0

if SOC_STM32G431XX

config SOC
	default "stm32g431xx"

config NUM_IRQS
	default 102

endif # SOC_STM32G431XX
```

## soc/soc_legacy/arm/st_stm32/stm32h5/Kconfig.series
```kconfig
# ST Microelectronics STM32H5 MCU series

# Copyright (c) 2023 STMicroelectronics
# SPDX-License-Identifier: Apache-2.0

config SOC_SERIES_STM32H5X
	bool "STM32H5x Series MCU"
	select ARM
	select CPU_CORTEX_M33
	select SOC_FAMILY_STM32
	select ARM_TRUSTZONE_M if !SOC_STM32H503XX
	select CPU_HAS_ARM_SAU if !SOC_STM32H503XX
	select CPU_HAS_ARM_MPU
	select CPU_HAS_FPU
	select ARMV8_M_DSP
	select CPU_CORTEX_M_HAS_DWT
	select HAS_STM32CUBE
	select HAS_SWO
	help
	  Enable support for STM32H5 MCU series
```

## soc/soc_legacy/arm/st_stm32/stm32h5/Kconfig.soc
```kconfig
# ST Microelectronics STM32H5 MCU line

# Copyright (c) 2023 STMicroelectronics
# SPDX-License-Identifier: Apache-2.0

choice
prompt "STM32H5x MCU Selection"
depends on SOC_SERIES_STM32H5X

config SOC_STM32H503XX
	bool "STM32H503XX"

config SOC_STM32H562XX
	bool "STM32H562XX"

config SOC_STM32H563XX
	bool "STM32H563XX"

config SOC_STM32H573XX
	bool "STM32H573XX"

endchoice
```

## soc/soc_legacy/arm/st_stm32/stm32h7/Kconfig.defconfig.stm32h730xx
```kconfig
# ST STM32H730X MCU configuration options

# Copyright (c) 2022 Georgij Cernysiov <geo.cgv@gmail.com>
# Copyright (c) 2023 Chen Xingyu <hi@xingrz.me>
# SPDX-License-Identifier: Apache-2.0

if SOC_STM32H730XX || SOC_STM32H730XXQ

config SOC
	default "stm32h730xxQ" if SOC_STM32H730XXQ
	default "stm32h730xx" if SOC_STM32H730XX

config NUM_IRQS
	default 163

endif # SOC_STM32H730XX || SOC_STM32H730XXQ
```

## soc/soc_legacy/arm/st_stm32/stm32h7/Kconfig.defconfig.stm32h750xx
```kconfig
# ST STM32H750XX MCU configuration options

# Copyright (c) 2020 Teslabs Engineering S.L.
# SPDX-License-Identifier: Apache-2.0

if SOC_STM32H750XX

config SOC
	default "stm32h750xx"

config NUM_IRQS
	default 150

endif # SOC_STM32H750XX
```

## soc/soc_legacy/arm/st_stm32/stm32h7/Kconfig.defconfig.stm32h753xx
```kconfig
# ST STM32H753X MCU configuration options

# Copyright (c) 2020 Petri Oksanen <petri@iote.ai>
# SPDX-License-Identifier: Apache-2.0

if SOC_STM32H753XX

config SOC
	default "stm32h753xx"

config NUM_IRQS
	default 150

endif # SOC_STM32H753XX
```

## soc/soc_legacy/arm/st_stm32/stm32h7/Kconfig.defconfig.stm32h7a3xx
```kconfig
# ST STM32H7A3X MCU configuration options

# Copyright (c) 2021 Electrolance Solutions
# SPDX-License-Identifier: Apache-2.0

if SOC_STM32H7A3XX || SOC_STM32H7A3XXQ

config SOC
	default "stm32h7a3xxQ" if SOC_STM32H7A3XXQ
	default "stm32h7a3xx" if SOC_STM32H7A3XX

config NUM_IRQS
	default 155

endif # SOC_STM32H7A3XX || SOC_STM32H7A3XXQ
```

## soc/soc_legacy/arm/st_stm32/stm32l1/Kconfig.defconfig.stm32l151xc
```kconfig
# ST Microelectronics STM32L151XC MCU

# Copyright (c) 2020 Abel Sensors
# SPDX-License-Identifier: Apache-2.0

if SOC_STM32L151XC

config SOC
	default "stm32l151xc"

# Based on stm32cube number of interrupts+1, not datasheet
config NUM_IRQS
	default 57

endif # SOC_STM32L151XC
```

## soc/soc_legacy/arm/st_stm32/stm32l1/Kconfig.defconfig.stm32l152xc
```kconfig
# ST Microelectronics STM32L152XC MCU

# Copyright (c) 2020 Abel Sensors
# SPDX-License-Identifier: Apache-2.0

if SOC_STM32L152XC

config SOC
	string
	default "stm32l152xc"

config NUM_IRQS
	int
	default 57

endif # SOC_STM32L152XC
```

## soc/soc_legacy/arm/st_stm32/stm32l1/Kconfig.soc
```kconfig
# ST Microelectronics STM32L1 MCU line

# Copyright (c) 2019 Linaro Ltd.
# SPDX-License-Identifier: Apache-2.0

choice
	prompt "STM32L1x MCU Selection"
	depends on SOC_SERIES_STM32L1X

config SOC_STM32L151X8A
	bool "STM32L151X8A"

config SOC_STM32L151XB
	bool "STM32L151XB"

config SOC_STM32L151XBA
	bool "STM32L151XBA"

config SOC_STM32L151XC
	bool "STM32L151XC"

config SOC_STM32L152XC
	bool "STM32L152XC"

config SOC_STM32L152XE
	bool "STM32L152XE"

endchoice
```

## soc/soc_legacy/arm/st_stm32/stm32l4/Kconfig.defconfig.stm32l432xx
```kconfig
# ST Microelectronics STM32L432XX MCU

# Copyright (c) 2016 Open-RnD Sp. z o.o.
# Copyright (c) 2016 BayLibre, SAS
# SPDX-License-Identifier: Apache-2.0

if SOC_STM32L432XX

config SOC
	default "stm32l432xx"

config NUM_IRQS
	default 83

endif # SOC_STM32L432XX
```

## soc/soc_legacy/arm/st_stm32/stm32l4/Kconfig.defconfig.stm32l433xx
```kconfig
# ST Microelectronics STM32L433XX MCU

# Copyright (c) 2018 David Lamparter
# SPDX-License-Identifier: Apache-2.0

if SOC_STM32L433XX

config SOC
	default "stm32l433xx"

config NUM_IRQS
	default 83

endif # SOC_STM32L433XX
```

## soc/soc_legacy/arm/st_stm32/stm32l4/Kconfig.defconfig.stm32l452xx
```kconfig
# ST Microelectronics STM32L452XX MCU

# Copyright (c) 2018 Georgij Cernysiov
# SPDX-License-Identifier: Apache-2.0

if SOC_STM32L452XX

config SOC
	default "stm32l452xx"

config NUM_IRQS
	default 85

endif # SOC_STM32L452XX
```
