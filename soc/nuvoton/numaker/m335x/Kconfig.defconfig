## soc/nuvoton/numaker/m335x/Kconfig.defconfig
```kconfig
# Copyright (c) 2026 Nuvoton Technology Corporation.
#
# SPDX-License-Identifier: Apache-2.0

if SOC_SERIES_M335X

rsource "Kconfig.defconfig.m335*"

config SYS_CLOCK_HW_CYCLES_PER_SEC
	default $(dt_node_int_prop_int,/system-clock,clock-frequency)

endif # SOC_SERIES_M335X
```

## soc/nuvoton/numaker/m335x/Kconfig.defconfig.m335xxx
```kconfig
# Copyright (c) 2026 Nuvoton Technology Corporation.
#
# SPDX-License-Identifier: Apache-2.0

if SOC_M335XXX

config NUM_IRQS
	default 139

endif # SOC_M335XXX
```

## soc/nuvoton/numaker/m335x/Kconfig.soc
```kconfig
# Copyright (c) 2026 Nuvoton Technology Corporation.
#
# SPDX-License-Identifier: Apache-2.0

config SOC_SERIES_M335X
	bool
	select SOC_FAMILY_NUMAKER
	help
	  Enable support for Nuvoton M335X MCU series

config SOC_M335XXX
	bool
	select SOC_SERIES_M335X

config SOC_SERIES
	default "m335x" if SOC_SERIES_M335X

config SOC
	default "m335xxx" if SOC_M335XXX
```

## soc/nuvoton/numaker/m46x/Kconfig
```kconfig
# Copyright (c) 2023 Nuvoton Technology Corporation.
#
# SPDX-License-Identifier: Apache-2.0

config SOC_SERIES_M46X
	select ARM
	select CPU_CORTEX_M4
	select CPU_CORTEX_M_HAS_DWT
	select CPU_HAS_FPU
	select CPU_HAS_ARM_MPU
	select CORTEX_M_SYSTICK if SYS_CLOCK_EXISTS
	select HAS_POWEROFF

config SOC_M467
	select HAS_NUMAKER_HAL
```

## soc/nuvoton/numaker/m46x/Kconfig.defconfig
```kconfig
# Copyright (c) 2023 Nuvoton Technology Corporation.
#
# SPDX-License-Identifier: Apache-2.0

if SOC_SERIES_M46X

rsource "Kconfig.defconfig.m46*"

endif # SOC_SERIES_M46X
```

## soc/nuvoton/numaker/m46x/Kconfig.soc
```kconfig
# Copyright (c) 2023 Nuvoton Technology Corporation.
#
# SPDX-License-Identifier: Apache-2.0

config SOC_SERIES_M46X
	bool
	select SOC_FAMILY_NUMAKER
	help
	  Enable support for Nuvoton M46X MCU series

config SOC_M467
	bool
	select SOC_SERIES_M46X

config SOC_SERIES
	default "m46x" if SOC_SERIES_M46X

config SOC
	default "m467" if SOC_M467
```

## soc/nuvoton/numaker/m55m1x/Kconfig
```kconfig
# Copyright (c) 2025 Nuvoton Technology Corporation.
#
# SPDX-License-Identifier: Apache-2.0

config SOC_SERIES_M55M1X
	select ARM
	select CPU_CORTEX_M55
	select CPU_CORTEX_M_HAS_SYSTICK
	select CPU_CORTEX_M_HAS_VTOR
	select CPU_HAS_ARM_MPU
	select CPU_HAS_FPU
	select ARMV8_M_DSP
	select ARMV8_1_M_MVEI
	select ARMV8_1_M_MVEF
	select CPU_CORTEX_M_HAS_DWT
	select ARMV8_1_M_PMU
	select SOC_EARLY_INIT_HOOK
	select CPU_HAS_CUSTOM_FIXED_SOC_MPU_REGIONS
	select HAS_POWEROFF
	select ARM_MPU

config ARMV8_1_M_PMU_EVENTCNT
	int
	default 8 if SOC_SERIES_M55M1X

config SOC_M55M1XXX
	select HAS_NUMAKER_HAL
```

## soc/nuvoton/numaker/m55m1x/Kconfig.defconfig
```kconfig
# Copyright (c) 2025 Nuvoton Technology Corporation.
#
# SPDX-License-Identifier: Apache-2.0

if SOC_SERIES_M55M1X

rsource "Kconfig.defconfig.m55m1*"

DT_NUMAKER_CPU_CLOCK_PATH := $(dt_nodelabel_path,sysclk)
DT_NUMAKER_CPU_CLOCK_FREQ := $(dt_node_int_prop_int,$(DT_NUMAKER_CPU_CLOCK_PATH),clock-frequency)

config SYS_CLOCK_HW_CYCLES_PER_SEC
	default $(DT_NUMAKER_CPU_CLOCK_FREQ)

endif # SOC_SERIES_M55M1X
```

## soc/nuvoton/numaker/m55m1x/Kconfig.defconfig.m55m1xxx
```kconfig
# Copyright (c) 2025 Nuvoton Technology Corporation.
#
# SPDX-License-Identifier: Apache-2.0

if SOC_M55M1XXX

config NUM_IRQS
	default 161

endif # SOC_M55M1XXX
```

## soc/nuvoton/numaker/m55m1x/Kconfig.soc
```kconfig
# Copyright (c) 2025 Nuvoton Technology Corporation.
#
# SPDX-License-Identifier: Apache-2.0

config SOC_SERIES_M55M1X
	bool
	select SOC_FAMILY_NUMAKER
	help
	  Enable support for Nuvoton M55M1X MCU series

config SOC_M55M1XXX
	bool
	select SOC_SERIES_M55M1X

config SOC_SERIES
	default "m55m1x" if SOC_SERIES_M55M1X

config SOC
	default "m55m1xxx" if SOC_M55M1XXX
```

## soc/nuvoton/numicro/Kconfig
```kconfig
# SPDX-License-Identifier: Apache-2.0
#
# Copyright (c) 2020 Linumiz
# Author: Saravanan Sekar <saravanan@linumiz.com>

config SOC_FAMILY_NUMICRO
	select SOC_RESET_HOOK

if SOC_FAMILY_NUMICRO

rsource "*/Kconfig"

endif # SOC_FAMILY_NUMICRO
```

## soc/nuvoton/numicro/Kconfig.defconfig
```kconfig
# SPDX-License-Identifier: Apache-2.0
#
# Copyright (c) 2020 Linumiz
# Author: Saravanan Sekar <saravanan@linumiz.com>

if SOC_FAMILY_NUMICRO

rsource "*/Kconfig.defconfig"

endif # SOC_FAMILY_NUMICRO
```

## soc/nuvoton/numicro/Kconfig.soc
```kconfig
# SPDX-License-Identifier: Apache-2.0
#
# Copyright (c) 2020 Linumiz
# Author: Saravanan Sekar <saravanan@linumiz.com>

config SOC_FAMILY_NUMICRO
	bool

config SOC_FAMILY
	default "numicro" if SOC_FAMILY_NUMICRO

rsource "*/Kconfig.soc"
```

## soc/nuvoton/numicro/m48x/Kconfig
```kconfig
# SPDX-License-Identifier: Apache-2.0
#
# Copyright (c) 2020 Linumiz
# Author: Saravanan Sekar <saravanan@linumiz.com>

config SOC_SERIES_M48X
	select ARM
	select CPU_CORTEX_M4
	select CPU_CORTEX_M_HAS_DWT
	select CPU_HAS_FPU
	select CPU_HAS_ARM_MPU

config SOC_M487
	select HAS_NUMICRO_HAL
```

## soc/nuvoton/numicro/m48x/Kconfig.defconfig
```kconfig
# SPDX-License-Identifier: Apache-2.0
#
# Copyright (c) 2020 Linumiz
# Author: Saravanan Sekar <saravanan@linumiz.com>

if SOC_SERIES_M48X

rsource "Kconfig.defconfig.m48*"

endif # SOC_SERIES_M48X
```

## soc/nuvoton/numicro/m48x/Kconfig.soc
```kconfig
# SPDX-License-Identifier: Apache-2.0
#
# Copyright (c) 2020 Linumiz
# Author: Saravanan Sekar <saravanan@linumiz.com>

config SOC_SERIES_M48X
	bool
	select SOC_FAMILY_NUMICRO
	help
	  Enable support for NUVOTON M48X MCU series

config SOC_M487
	bool
	select SOC_SERIES_M48X

config SOC_SERIES
	default "m48x" if SOC_SERIES_M48X

config SOC
	default "m487" if SOC_M487
```

## soc/nxp/common/Kconfig.defconfig.nvic
```kconfig
# Copyright 2026 NXP
# SPDX-License-Identifier: Apache-2.0

# Compute NUM_IRQS automatically from the Arm v6/7/8-M NVIC devicetree
# node. dt_highest_controller_irq_number() returns the zero-based IRQn;
# increment it to obtain the table size (= max IRQn + 1).
#
# Only rsource this snippet from a Cortex-M Kconfig.defconfig: the
# "nvic" label is provided by dts/arm/armv{6,7,8,8.1}-m.dtsi, so if
# the snippet is sourced on a non-Cortex-M target the label resolves
# to an empty path and the build will fail loudly instead of silently
# defaulting NUM_IRQS to 0.
DT_NVIC_PATH := $(dt_nodelabel_path,nvic)
DT_NVIC_MAX_IRQN := $(dt_highest_controller_irq_number,$(DT_NVIC_PATH),irq)

configdefault NUM_IRQS
	default $(inc,$(DT_NVIC_MAX_IRQN))
```

## soc/nxp/common/Kconfig.flexspi_xip
```kconfig
# Copyright 2024 NXP
# SPDX-License-Identifier: Apache-2.0

DT_CHOSEN_Z_FLASH := zephyr,flash
DT_COMPAT_FLEXSPI := nxp,imx-flexspi

DT_CHOSEN_FLASH_NODE := $(dt_chosen_path,$(DT_CHOSEN_Z_FLASH))
DT_CHOSEN_FLASH_PARENT := $(dt_node_parent,$(DT_CHOSEN_FLASH_NODE))

DT_FLASH_PARENT_IS_FLEXSPI := $(dt_node_has_compat,$(DT_CHOSEN_FLASH_PARENT),$(DT_COMPAT_FLEXSPI))
DT_FLASH_HAS_SIZE_PROP := $(dt_node_has_prop,$(DT_CHOSEN_FLASH_NODE),size)

config FLASH_BASE_ADDRESS
	default $(dt_node_reg_addr_hex,$(DT_CHOSEN_FLASH_PARENT),1) \
		if $(DT_FLASH_PARENT_IS_FLEXSPI)
	default $(dt_chosen_reg_addr_hex,$(DT_CHOSEN_Z_FLASH))

config FLASH_SIZE
	default $(dt_node_int_prop_int,$(DT_CHOSEN_FLASH_NODE),size,Kb) \
		if $(DT_FLASH_HAS_SIZE_PROP)
	default $(dt_chosen_reg_size_int,$(DT_CHOSEN_Z_FLASH),0,K)

config FLASH_MCUX_FLEXSPI_XIP
	bool
	default $(DT_FLASH_PARENT_IS_FLEXSPI)
	select XIP
	help
	  Allows REfor the soc to safely initialize the clocks for the
	  FlexSpi when planning to execute code in FlexSpi Memory.

if FLASH_MCUX_FLEXSPI_XIP && MEMC_MCUX_FLEXSPI

config CODE_DATA_RELOCATION_SRAM
	default y if !CPU_CORTEX_M7

config CODE_DATA_RELOCATION
	default y if CPU_CORTEX_M7

config FLASH_MCUX_FLEXSPI_XIP_MEM
	string
	prompt "Flexspi drivers memory location"
	default "RAM"
	help
	  Select the location to run the FlexSPI drivers when using
	  the flash API.

endif
```

## soc/nxp/common/Kconfig.peripherals
```kconfig
# NXP Semiconductors MCU peripherals list.

# Copyright 2025 NXP
# SPDX-License-Identifier: Apache-2.0

config MCUX_HW_HAS_LPTMR0
	def_bool $(dt_nodelabel_enabled_with_compat,lptmr0,$(DT_COMPAT_NXP_LPTMR))

config MCUX_HW_HAS_LPTMR1
	def_bool $(dt_nodelabel_enabled_with_compat,lptmr1,$(DT_COMPAT_NXP_LPTMR))

config MCUX_HW_HAS_LPTMR2
	def_bool $(dt_nodelabel_enabled_with_compat,lptmr2,$(DT_COMPAT_NXP_LPTMR))

config MCUX_HW_HAS_LPTMR3
	def_bool $(dt_nodelabel_enabled_with_compat,lptmr3,$(DT_COMPAT_NXP_LPTMR))
```

## soc/nxp/common/Kconfig.rom_loader
```kconfig
# Copyright 2024 NXP
# SPDX-License-Identifier: Apache-2.0

config NXP_FLEXSPI_ROM_RAMLOADER
	bool "Create output image that NXP ROM can load from FlexSPI to ram"
	select BUILD_OUTPUT_HEX
	depends on !FLASH_MCUX_FLEXSPI_XIP
	help
	  Builds an output image that the BootROM can load from the
	  FlexSPI boot device into RAM region. The image will be loaded
	  from FLEXSPI into the region specified by `zephyr,flash` node.

if NXP_FLEXSPI_ROM_RAMLOADER

FLASH_CHOSEN := zephyr,flash
FLASH_BASE := $(dt_chosen_reg_addr_hex,$(FLASH_CHOSEN))
FLEXSPI_BASE := $(dt_nodelabel_reg_addr_hex,flexspi,1)
config BUILD_OUTPUT_ADJUST_LMA
	default "$(FLEXSPI_BASE) - $(FLASH_BASE)"

endif # NXP_FLEXSPI_ROM_RAMLOADER
```

## soc/nxp/common/Kconfig.xspi_xip
```kconfig
# Copyright 2024 NXP
# SPDX-License-Identifier: Apache-2.0

DT_CHOSEN_Z_FLASH := zephyr,flash
DT_COMPAT_XSPI := nxp,xspi

DT_CHOSEN_FLASH_NODE := $(dt_chosen_path,$(DT_CHOSEN_Z_FLASH))
DT_CHOSEN_FLASH_PARENT := $(dt_node_parent,$(DT_CHOSEN_FLASH_NODE))

DT_FLASH_PARENT_IS_XSPI := $(dt_node_has_compat,$(DT_CHOSEN_FLASH_PARENT),$(DT_COMPAT_XSPI))
DT_FLASH_HAS_SIZE_PROP := $(dt_node_has_prop,$(DT_CHOSEN_FLASH_NODE),size)

config FLASH_BASE_ADDRESS
	default $(dt_node_reg_addr_hex,$(DT_CHOSEN_FLASH_PARENT),1) \
		if $(DT_FLASH_PARENT_IS_XSPI)
	default $(dt_chosen_reg_addr_hex,$(DT_CHOSEN_Z_FLASH))

config FLASH_SIZE
	default $(dt_node_int_prop_int,$(DT_CHOSEN_FLASH_NODE),size,Kb)

config FLASH_MCUX_XSPI_XIP
	bool
	default $(DT_FLASH_PARENT_IS_XSPI)
	select XIP
	help
	  Allows the soc to safely initialize the clocks for the
	  XSpi when planning to execute code in XSpi Memory.

if FLASH_MCUX_XSPI_XIP

config CODE_DATA_RELOCATION_SRAM
	default y

config FLASH_MCUX_XSPI_XIP_MEM
	string
	prompt "Xspi drivers memory location"
	default "RAM"
	help
	  Select the location to run the XSPI drivers when using
	  the flash API.

endif
```

## soc/nxp/imx/Kconfig
```kconfig
# Copyright 2024 NXP
# SPDX-License-Identifier: Apache-2.0

config SOC_FAMILY_NXP_IMX
	select HAS_SEGGER_RTT if ZEPHYR_SEGGER_MODULE

if SOC_FAMILY_NXP_IMX

# Source series Kconfig files first, so SOCs
# can override the defaults given here
rsource "*/Kconfig"

endif # SOC_FAMILY_NXP_IMX
```

## soc/nxp/imx/Kconfig.defconfig
```kconfig
# Copyright 2024 NXP
# SPDX-License-Identifier: Apache-2.0

if SOC_FAMILY_NXP_IMX

# Source series Kconfig files first, so SoCs
# can override the defaults given here
rsource "*/Kconfig.defconfig"

endif # SOC_FAMILY_NXP_IMX
```

## soc/nxp/imx/Kconfig.soc
```kconfig
# Copyright 2024 NXP
# SPDX-License-Identifier: Apache-2.0

config SOC_FAMILY_NXP_IMX
	bool

config SOC_FAMILY
	default "nxp_imx" if SOC_FAMILY_NXP_IMX

rsource "*/Kconfig.soc"
```

## soc/nxp/imx/imx6sx/Kconfig
```kconfig
# Copyright 2024 NXP
# SPDX-License-Identifier: Apache-2.0

config SOC_SERIES_IMX6SX
	select ARM
	select CPU_CORTEX_M4
	select CPU_CORTEX_M_HAS_DWT
	select HAS_IMX_HAL
	select CPU_HAS_FPU
	select CPU_HAS_ARM_MPU
	select CLOCK_CONTROL
	select SOC_EARLY_INIT_HOOK

config SOC_MCIMX6X_M4
	select HAS_IMX_HAL
	select HAS_IMX_GPIO
	select HAS_IMX_EPIT
	select HAS_IMX_I2C
	select HAS_IMX_IOMUXC
```
