## soc/nuvoton/npcx/npck3/Kconfig
```kconfig
# Nuvoton NPCK3 EC series

# Copyright (c) 2025 Nuvoton Technology Corporation.
# SPDX-License-Identifier: Apache-2.0

config SOC_SERIES_NPCK3
	select ARM
	select CPU_CORTEX_M4
	select CPU_CORTEX_M_HAS_DWT
	select CPU_HAS_FPU
	select CPU_HAS_ARM_MPU
	select HAS_PM
	select PM_STATE_SET_IRQ_UNLOCKED
	select HAS_SWO
	select SOC_EARLY_INIT_HOOK

if SOC_SERIES_NPCK3

config SOC_NPCK_EPURST_DISABLE
	bool "Disable all External Power-Up Reset Inputs"
	default y
	help
	  Disable all External Power-Up Reset Inputs during initialization. All
	  signals such as EXT_PURST# are disabled by default. The users can
	  enable it if needed.

config SOC_NPCK_DEBUG_DISABLE
	bool "Disable all K3 debug interfaces"
	help
	  Disable all K3 debug interface during initialization.

config SOC_NPCK_EPURST_DEBOUNCE_TIME_SEC
	int "Debounce time of the EXT_PURST"
	default 10
	help
	  This option specifies the debounce time for EXT_PURST. The unit is seconds,
	  and the valid value is from 1 to 31.

endif # SOC_SERIES_NPCK3
```

## soc/nuvoton/npcx/npck6/Kconfig
```kconfig
# Nuvoton NPCK6 EC series

# Copyright (c) 2026 Nuvoton Technology Corporation.
# SPDX-License-Identifier: Apache-2.0

config SOC_SERIES_NPCK6
	select ARM
	select CPU_CORTEX_M33
	select CPU_CORTEX_M_HAS_DWT
	select CPU_HAS_ARM_SAU
	select CPU_HAS_ARM_MPU
	select CPU_HAS_FPU
	select HAS_PM
	select PM_STATE_SET_IRQ_UNLOCKED
	select HAS_SWO
	select SOC_EARLY_INIT_HOOK

if SOC_SERIES_NPCK6

config SOC_NPCK_EPURST_DISABLE
	bool "Disable all External Power-Up Reset Inputs"
	default y
	help
	  Disable all External Power-Up Reset Inputs during initialization. All
	  signals such as EXT_PURST# are disabled by default. The users can
	  enable it if needed.

config SOC_NPCK_DEBUG_DISABLE
	bool "Disable all K6 debug interfaces"
	help
	  Disable all K6 debug interface during initialization.

config NPCK_EPURST_DEBOUNCE_TIME_SEC
	int "Debounce time of the EXT_PURST"
	default 10
	help
	  This option specifices the debounce time for EXT_PURST. The unit is seconds,
	  and the valid value is from 1 to 31.

endif # SOC_SERIES_NPCK6
```

## soc/nuvoton/npcx/npck6/Kconfig.defconfig
```kconfig
# Nuvoton Cortex-M33 Embedded Controller

# Copyright (c) 2026 Nuvoton Technology Corporation.
# SPDX-License-Identifier: Apache-2.0

if SOC_SERIES_NPCK6

config NUM_IRQS
	default 83

config CORTEX_M_SYSTICK
	default !NPCX_ITIM_TIMER

config ESPI_TAF_NPCX
	default y
	depends on ESPI_TAF

config SYS_CLOCK_TICKS_PER_SEC
	default 1000

endif # SOC_SERIES_NPCK6
```

## soc/nuvoton/npcx/npck6/Kconfig.soc
```kconfig
# Nuvoton NPCK6 EC series

# Copyright (c) 2026 Nuvoton Technology Corporation.
# SPDX-License-Identifier: Apache-2.0

config SOC_SERIES_NPCK6
	bool
	select SOC_FAMILY_NPCX
	select NPCX_SOC_VARIANT_NPCKN
	help
	  Enable support for Nuvoton NPCK6 series

config SOC_NPCK6M9K
	bool
	select SOC_SERIES_NPCK6
	help
	  NPCK6M9K

config SOC_SERIES
	default "npck6" if SOC_SERIES_NPCK6

config SOC
	default "npck6m9k" if SOC_NPCK6M9K
```

## soc/nuvoton/npcx/npcm4/Kconfig.soc
```kconfig
# Copyright (c) 2024 Nuvoton Technology Corporation.
#
# SPDX-License-Identifier: Apache-2.0

config SOC_SERIES_NPCM4
	bool
	select NPCX_SOC_VARIANT_NPCMN
	help
	  Enable support for Nuvoton NPCM4 series

config SOC_NPCM400
	bool
	select SOC_SERIES_NPCM4

config SOC_SERIES
	default "npcm4" if SOC_SERIES_NPCM4

config SOC
	default "npcm400" if SOC_NPCM400
```

## soc/nuvoton/numicro/m48x/Kconfig.defconfig.m483
```kconfig
# Copyright The Zephyr Project Contributors
# SPDX-License-Identifier: Apache-2.0

if SOC_M483

config NUM_IRQS
	default 108

endif # SOC_M483
```

## soc/nxp/common/Kconfig.nbu
```kconfig
# Copyright 2024, 2026 NXP
# SPDX-License-Identifier: Apache-2.0

config NXP_NBU
	bool
	default y if BT || IEEE802154 || NXP_IEEE802154_MAC
	depends on DT_HAS_NXP_NBU_ENABLED
	select NVMEM if $(dt_compat_any_has_prop,$(DT_COMPAT_NXP_NBU),nvmem-cells)
	help
	  NXP Narrow Band Unit interrupt initialization.

config NXP_NBU_IFR_TRIM_INIT_PRIORITY
	int "NBU XTAL32M factory trim init priority"
	default 51
	depends on NXP_NBU
	help
	  POST_KERNEL initialization priority of the step which applies the
	  factory 32 MHz crystal trim read from non-volatile memory. It must be
	  higher than the priority of the driver providing the NVMEM cell, for
	  instance FLASH_INIT_PRIORITY.
```

## soc/nxp/imx/imx7d/Kconfig.defconfig.mcimx7d_m4
```kconfig
# iMX7 M4 core series

# Copyright 2017,2024 NXP
# SPDX-License-Identifier: Apache-2.0

if SOC_MCIMX7D_M4

config GPIO
	default y

endif # SOC_MCIMX7D_M4
```

## soc/nxp/imx/imx8m/Kconfig
```kconfig
# Copyright 2024 NXP
# SPDX-License-Identifier: Apache-2.0

config SOC_MIMX8MM6_A53
	select ARM64
	select CPU_CORTEX_A53
	select ARM_ARCH_TIMER if SYS_CLOCK_EXISTS
	select HAS_MCUX if CLOCK_CONTROL
	select HAS_MCUX_RDC
	select HAS_MCUX_CACHE
	select SOC_PREP_HOOK

config SOC_MIMX8MM6_M4
	select ARM
	select CPU_CORTEX_M4
	select CPU_HAS_FPU
	select CPU_HAS_ARM_MPU
	select HAS_MCUX
	select HAS_MCUX_RDC
	select SOC_EARLY_INIT_HOOK

config SOC_MIMX8ML8_A53
	select ARM64
	select CPU_CORTEX_A53
	select ARM_ARCH_TIMER if SYS_CLOCK_EXISTS
	select HAS_MCUX if CLOCK_CONTROL
	select HAS_MCUX_RDC
	select HAS_MCUX_CACHE
	select SOC_PREP_HOOK

config SOC_MIMX8MN6_A53
	select ARM64
	select CPU_CORTEX_A53
	select ARM_ARCH_TIMER if SYS_CLOCK_EXISTS
	select HAS_MCUX if CLOCK_CONTROL
	select HAS_MCUX_RDC
	select HAS_MCUX_CACHE
	select SOC_PREP_HOOK

config SOC_MIMX8ML8_ADSP
	select XTENSA
	select XTENSA_HAL if ("$(ZEPHYR_TOOLCHAIN_VARIANT)" != "xcc" && "$(ZEPHYR_TOOLCHAIN_VARIANT)" != "xt-clang")
	select XTENSA_RESET_VECTOR
	select XTENSA_USE_CORE_CRT1
	select ATOMIC_OPERATIONS_BUILTIN
	select GEN_ISR_TABLES
	select XTENSA_SMALL_VECTOR_TABLE_ENTRY
	select HAS_MCUX if CLOCK_CONTROL
	select PINCTRL_IMX if PINCTRL
	select CPU_HAS_DCACHE

config SOC_MIMX8ML8_M7
	select ARM
	select CPU_CORTEX_M7
	select CPU_HAS_FPU
	select CPU_HAS_ICACHE
	select CPU_HAS_DCACHE
	select SOC_IMX8M_M7_INIT_VIDEO_PLL
	select HAS_MCUX
	select HAS_MCUX_RDC
	select CPU_HAS_ARM_MPU
	select CPU_HAS_CUSTOM_FIXED_SOC_MPU_REGIONS
	select ARM_MPU
	select SOC_EARLY_INIT_HOOK

config SOC_MIMX8MN6_M7
	select ARM
	select CPU_CORTEX_M7
	select CPU_HAS_FPU
	select CPU_HAS_ICACHE
	select CPU_HAS_DCACHE
	select SOC_IMX8M_M7_INIT_VIDEO_PLL
	select HAS_MCUX
	select HAS_MCUX_RDC
	select CPU_HAS_ARM_MPU
	select CPU_HAS_CUSTOM_FIXED_SOC_MPU_REGIONS
	select ARM_MPU
	select SOC_EARLY_INIT_HOOK

config SOC_MIMX8MQ6_M4
	select ARM
	select CPU_CORTEX_M4
	select CPU_HAS_FPU
	select CPU_HAS_ARM_MPU
	select HAS_MCUX
	select HAS_MCUX_RDC

config MCUX_CORE_SUFFIX
	default "_ca53" if SOC_MIMX8MM6_A53 || SOC_MIMX8MN6_A53 || SOC_MIMX8ML8_A53
	default "_dsp" if SOC_MIMX8ML8_ADSP
	default "_cm4" if SOC_MIMX8MM6_M4
	default "_cm7" if SOC_MIMX8ML8_M7
	default "_cm4" if SOC_MIMX8MQ6_M4

if SOC_MIMX8ML8_M7 || SOC_MIMX8MN6_M7

choice SOC_IMX8M_M7_CODE_LOCATION
	prompt "Code location selection"
	default SOC_IMX8M_M7_CODE_ITCM if CODE_ITCM
	default SOC_IMX8M_M7_CODE_DDR if CODE_DDR

config SOC_IMX8M_M7_CODE_ITCM
	bool "Link code into internal instruction tightly coupled memory (ITCM)"

config SOC_IMX8M_M7_CODE_DDR
	bool "Link code into DDR memory"
	depends on SOC_MIMX8ML8_M7

endchoice

config CODE_ITCM
	bool "Link code into ITCM [DEPRECATED]"
	select DEPRECATED
	help
	  This option is deprecated. Select SOC_IMX8M_M7_CODE_ITCM instead.

config CODE_DDR
	bool "Link code into DDR memory [DEPRECATED]"
	select DEPRECATED
	depends on SOC_MIMX8ML8_M7
	help
	  This option is deprecated. Select SOC_IMX8M_M7_CODE_DDR instead.

config SOC_IMX8M_M7_INIT_VIDEO_PLL
	bool "Initialize Video PLL"

config INIT_VIDEO_PLL
	bool "Initialize Video PLL [DEPRECATED]"
	select DEPRECATED
	select SOC_IMX8M_M7_INIT_VIDEO_PLL
	help
	  This option is deprecated. Select SOC_IMX8M_M7_INIT_VIDEO_PLL instead.

endif # SOC_MIMX8ML8_M7 || SOC_MIMX8MN6_M7
```

## soc/nxp/imx/imx8m/Kconfig.defconfig.mimx8mn6_m7
```kconfig
# MIMX8MN6 SoC defconfig

# Copyright 2024 NXP
# Copyright (c) 2026 Televic NV
# SPDX-License-Identifier: Apache-2.0

if SOC_MIMX8MN6_M7

configdefault MCUX_CORE_SUFFIX
	default "_cm7"

config GPIO
	default y

config IPM_IMX
	default y
	depends on IPM

config NUM_IRQS
	# must be >= the highest interrupt number used
	default 128

endif # SOC_MIMX8MN6_M7
```

## soc/nxp/imxrt/Kconfig.sysbuild
```kconfig
# Copyright 2024 Daniel DeGrasse <daniel@degrasse.com>
# Copyright 2026 NXP
# SPDX-License-Identifier: Apache-2.0

config SECOND_CORE_MCUX_LAUNCHER
	bool "Load minimal application to primary core to boot secondary one"
	default y if (SOC_MIMXRT1176_CM4 || SOC_MIMXRT1166_CM4)
	depends on SOC_SERIES_IMXRT11XX
	help
	  Load a minimal application to the primary core to boot the secondary
	  one. The primary core will be loaded with the samples/basic/minimal
	  application, and the appropriate configuration will be set to
	  boot the secondary core during startup.

menuconfig SOC_SERIES_IMXRT_BUILD_AMP_DSP
	bool "Build a HiFi4 DSP remote image"
	depends on SOC_SERIES_IMXRT6XX || SOC_SERIES_IMXRT7XX
	help
	  Build the DSP application found in the directory named by
	  SOC_SERIES_IMXRT_BUILD_AMP_DSP_REMOTE_DIR (relative to the primary
	  application source directory) as a decoupled remote image for the DSP
	  domain.

if SOC_SERIES_IMXRT_BUILD_AMP_DSP

config SOC_SERIES_IMXRT_BUILD_AMP_DSP_REMOTE_DIR
	string "HiFi4 DSP remote application directory"
	default "remote"
	help
	  Location of the DSP (HiFi4) remote application, relative to the primary
	  application's source directory (APP_DIR). Defaults to the conventional
	  "remote" subdirectory. An absolute path is also accepted.

endif # SOC_SERIES_IMXRT_BUILD_AMP_DSP
```

## soc/nxp/imxrt/imxrt11xx/Kconfig.soc
```kconfig
# Copyright 2024 NXP
# SPDX-License-Identifier: Apache-2.0

config SOC_SERIES_IMXRT11XX
	bool
	select SOC_FAMILY_NXP_IMXRT

config SOC_SERIES
	default "imxrt11xx" if SOC_SERIES_IMXRT11XX

config SOC_IMXRT11XX_SINGLE_CORE
	bool
	help
	  Selected by i.MX RT11xx SoCs integrating a single Cortex-M7 core.

config SOC_MIMXRT1151
	bool
	select SOC_SERIES_IMXRT11XX
	select SOC_IMXRT11XX_SINGLE_CORE

config SOC_MIMXRT1152
	bool
	select SOC_SERIES_IMXRT11XX
	select SOC_IMXRT11XX_SINGLE_CORE

config SOC_MIMXRT1166
	bool
	select SOC_SERIES_IMXRT11XX

config SOC_MIMXRT1176
	bool
	select SOC_SERIES_IMXRT11XX

config SOC_MIMXRT1166_CM4
	bool
	select SOC_MIMXRT1166

config SOC_MIMXRT1166_CM7
	bool
	select SOC_MIMXRT1166

config SOC_MIMXRT1176_CM4
	bool
	select SOC_MIMXRT1176

config SOC_MIMXRT1176_CM7
	bool
	select SOC_MIMXRT1176

config SOC
	default "mimxrt1151" if SOC_MIMXRT1151
	default "mimxrt1152" if SOC_MIMXRT1152
	default "mimxrt1166" if SOC_MIMXRT1166
	default "mimxrt1176" if SOC_MIMXRT1176

config SOC_PART_NUMBER_MIMXRT1151DHM8B
	bool
	select SOC_MIMXRT1151

config SOC_PART_NUMBER_MIMXRT1151DVM8B
	bool
	select SOC_MIMXRT1151

config SOC_PART_NUMBER_MIMXRT1151XHM8B
	bool
	select SOC_MIMXRT1151

config SOC_PART_NUMBER_MIMXRT1151XVM8B
	bool
	select SOC_MIMXRT1151

config SOC_PART_NUMBER_MIMXRT1152AHM6B
	bool
	select SOC_MIMXRT1152

config SOC_PART_NUMBER_MIMXRT1152AVM6B
	bool
	select SOC_MIMXRT1152

config SOC_PART_NUMBER_MIMXRT1152DHM8B
	bool
	select SOC_MIMXRT1152

config SOC_PART_NUMBER_MIMXRT1152DVM8B
	bool
	select SOC_MIMXRT1152

config SOC_PART_NUMBER_MIMXRT1152XHM8B
	bool
	select SOC_MIMXRT1152

config SOC_PART_NUMBER_MIMXRT1152XVM8B
	bool
	select SOC_MIMXRT1152

config SOC_PART_NUMBER_MIMXRT1166DVM6A
	bool

config SOC_PART_NUMBER_MIMXRT1176AVM8A
	bool

config SOC_PART_NUMBER_MIMXRT1176CVM8A
	bool

config SOC_PART_NUMBER_MIMXRT1176DVMAA
	bool

config SOC_PART_NUMBER_MIMXRT1175AVM8A
	bool

config SOC_PART_NUMBER_MIMXRT1175CVM8A
	bool

config SOC_PART_NUMBER_MIMXRT1175DVMAA
	bool

config SOC_PART_NUMBER_MIMXRT1173CVM8A
	bool

config SOC_PART_NUMBER_MIMXRT1172AVM8A
	bool

config SOC_PART_NUMBER_MIMXRT1172CVM8A
	bool

config SOC_PART_NUMBER_MIMXRT1172DVMAA
	bool

config SOC_PART_NUMBER_MIMXRT1171AVM8A
	bool

config SOC_PART_NUMBER_MIMXRT1171CVM8A
	bool

config SOC_PART_NUMBER_MIMXRT1171DVMAA
	bool

config SOC_PART_NUMBER
	default "MIMXRT1151DHM8B" if SOC_PART_NUMBER_MIMXRT1151DHM8B
	default "MIMXRT1151DVM8B" if SOC_PART_NUMBER_MIMXRT1151DVM8B
	default "MIMXRT1151XHM8B" if SOC_PART_NUMBER_MIMXRT1151XHM8B
	default "MIMXRT1151XVM8B" if SOC_PART_NUMBER_MIMXRT1151XVM8B
	default "MIMXRT1152AHM6B" if SOC_PART_NUMBER_MIMXRT1152AHM6B
	default "MIMXRT1152AVM6B" if SOC_PART_NUMBER_MIMXRT1152AVM6B
	default "MIMXRT1152DHM8B" if SOC_PART_NUMBER_MIMXRT1152DHM8B
	default "MIMXRT1152DVM8B" if SOC_PART_NUMBER_MIMXRT1152DVM8B
	default "MIMXRT1152XHM8B" if SOC_PART_NUMBER_MIMXRT1152XHM8B
	default "MIMXRT1152XVM8B" if SOC_PART_NUMBER_MIMXRT1152XVM8B
	default "MIMXRT1176AVM8A" if SOC_PART_NUMBER_MIMXRT1176AVM8A
	default "MIMXRT1176CVM8A" if SOC_PART_NUMBER_MIMXRT1176CVM8A
	default "MIMXRT1176DVMAA" if SOC_PART_NUMBER_MIMXRT1176DVMAA
	default "MIMXRT1166DVM6A" if SOC_PART_NUMBER_MIMXRT1166DVM6A
	default "MIMXRT1175AVM8A" if SOC_PART_NUMBER_MIMXRT1175AVM8A
	default "MIMXRT1175CVM8A" if SOC_PART_NUMBER_MIMXRT1175CVM8A
	default "MIMXRT1175DVMAA" if SOC_PART_NUMBER_MIMXRT1175DVMAA
	default "MIMXRT1173CVM8A" if SOC_PART_NUMBER_MIMXRT1173CVM8A
	default "MIMXRT1172AVM8A" if SOC_PART_NUMBER_MIMXRT1172AVM8A
	default "MIMXRT1172CVM8A" if SOC_PART_NUMBER_MIMXRT1172CVM8A
	default "MIMXRT1172DVMAA" if SOC_PART_NUMBER_MIMXRT1172DVMAA
	default "MIMXRT1171AVM8A" if SOC_PART_NUMBER_MIMXRT1171AVM8A
	default "MIMXRT1171CVM8A" if SOC_PART_NUMBER_MIMXRT1171CVM8A
	default "MIMXRT1171DVMAA" if SOC_PART_NUMBER_MIMXRT1171DVMAA
```

## soc/nxp/lpc/lpc54xxx/Kconfig
```kconfig
# LPC LPC54XXX MCU line

# Copyright 2017, 2024 NXP
# SPDX-License-Identifier: Apache-2.0

config SOC_SERIES_LPC54XXX
	select ARM
	select HAS_MCUX
	select CPU_CORTEX_M_HAS_SYSTICK
	select SOC_RESET_HOOK

if SOC_SERIES_LPC54XXX

config SOC_SERIES_LPC54XXX_SRAM_CLOCKS
	bool "Clock LPC54XXX SRAM banks"
	default y
	help
	  SRAM banks are disabled out of reset. By default, CMSIS SystemInit
	  will enable the clock to these RAM banks. Disable this Kconfig to
	  leave these ram banks untouched out of reset.

rsource "*/Kconfig"

endif # SOC_SERIES_LPC54XXX
```

## soc/nxp/lpc/lpc54xxx/Kconfig.defconfig
```kconfig
# NXP LPC54XXX platform configuration options

# Copyright 2017, 2024 NXP
# SPDX-License-Identifier: Apache-2.0

if SOC_SERIES_LPC54XXX

rsource "*/Kconfig.defconfig"

endif # SOC_SERIES_LPC54XXX
```

## soc/nxp/lpc/lpc54xxx/Kconfig.soc
```kconfig
# LPC LPC54XXX MCU line

# Copyright (c) 2017, 2024 NXP
# SPDX-License-Identifier: Apache-2.0

config SOC_SERIES_LPC54XXX
	bool
	select SOC_FAMILY_LPC

config SOC_SERIES
	default "lpc54xxx" if SOC_SERIES_LPC54XXX

rsource "*/Kconfig.soc"
```
