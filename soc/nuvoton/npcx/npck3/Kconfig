## soc/nxp/lpc/lpc54xxx/lpc5411x/Kconfig
```kconfig
# LPC LPC5411X MCU line

# Copyright 2017, 2024 NXP
# SPDX-License-Identifier: Apache-2.0

config SOC_LPC54114_M4
	select CPU_CORTEX_M4
	select CPU_CORTEX_M_HAS_DWT
	select CPU_HAS_ARM_MPU
	select CPU_HAS_CUSTOM_FIXED_SOC_MPU_REGIONS
	select CPU_HAS_FPU
	select SOC_RESET_HOOK
	select CLOCK_CONTROL

config SOC_LPC54114_M0
	select CPU_CORTEX_M0PLUS
	select CPU_CORTEX_M_HAS_VTOR
	select CLOCK_CONTROL

config MCUX_CORE_SUFFIX
	default "_cm4" if SOC_LPC54114_M4
	default "_cm0plus" if SOC_LPC54114_M0

if SOC_LPC54114

config SECOND_CORE_MCUX
	bool "LPC54114 Cortex-M0 second core"
	help
	  Driver for second core startup

config SECOND_CORE_BOOT_ADDRESS_MCUX
	depends on SECOND_CORE_MCUX
	hex "Address the second core will boot at"
	default 0x20010000
	help
	  This is the address the second core will boot from. Additionally this
	  address is where we will copy the SECOND_IMAGE to. We default this to
	  the base of SRAM1.

# Workaround for not being able to have commas in macro arguments
DT_CHOSEN_Z_CODE_CPU1_PARTITION := zephyr,code-cpu1-partition

# Move the LMA address of second core into flash
config BUILD_OUTPUT_ADJUST_LMA
	depends on SECOND_CORE_MCUX && SOC_LPC54114_M0
	default "-0x20010000+$(dt_chosen_reg_addr_hex,$(DT_CHOSEN_Z_CODE_CPU1_PARTITION))"

config BUILD_OUTPUT_INFO_HEADER
	default y
	depends on SECOND_CORE_MCUX && SOC_LPC54114_M0

endif # SOC_LPC54114
```

## soc/nxp/lpc/lpc54xxx/lpc546xx/Kconfig
```kconfig
# LPC LPC546XX MCU line

# Copyright 2017, 2024 NXP
# SPDX-License-Identifier: Apache-2.0

config SOC_LPC54628
	select CPU_CORTEX_M4
	select CPU_CORTEX_M_HAS_DWT
	select CPU_HAS_ARM_MPU
	select CPU_HAS_CUSTOM_FIXED_SOC_MPU_REGIONS
	select CPU_HAS_FPU
	select CLOCK_CONTROL

config MCUX_CORE_SUFFIX
	default "_cm4" if SOC_LPC54628
```

## soc/nxp/lpc/lpc54xxx/lpc546xx/Kconfig.defconfig
```kconfig
# NXP LPC546XX platform configuration options

# Copyright 2017, 2024 NXP
# SPDX-License-Identifier: Apache-2.0

if SOC_LPC54628

config NUM_IRQS
	# must be >= the highest interrupt number used
	default 57

config SYS_CLOCK_HW_CYCLES_PER_SEC
	default $(dt_node_int_prop_int,/cpus/cpu@0,clock-frequency)

endif # SOC_LPC54628
```

## soc/nxp/lpc/lpc54xxx/lpc546xx/Kconfig.soc
```kconfig
# LPC LPC546XX MCU line

# Copyright (c) 2017, 2024 NXP
# SPDX-License-Identifier: Apache-2.0

config SOC_LPC54628
	bool
	select SOC_SERIES_LPC54XXX

config SOC
	default "lpc54628" if SOC_LPC54628

config SOC_PART_NUMBER_LPC54628J512ET180
	bool

config SOC_PART_NUMBER
	default "LPC54628J512ET180" if SOC_PART_NUMBER_LPC54628J512ET180
```

## soc/nxp/lpc/lpc84x/Kconfig
```kconfig
# Copyright (c) 2026 Aerlync Labs Inc.
# SPDX-License-Identifier: Apache-2.0

config SOC_SERIES_LPC84X
	select ARM
	select CPU_CORTEX_M0PLUS
	select CPU_CORTEX_M_HAS_SYSTICK
	select CPU_CORTEX_M_HAS_VTOR
	select CLOCK_CONTROL
	select HAS_MCUX

if SOC_SERIES_LPC84X

config LPC84X_ON_ENTER_CPU_IDLE_HOOK
	bool "CPU idle hook enable"
	default y if !PM
	imply ARM_ON_ENTER_CPU_IDLE_HOOK
	depends on ARM
	help
	  Enables a hook (z_arm_on_enter_cpu_idle()) that is called when
	  the CPU is made idle (by k_cpu_idle() or k_cpu_atomic_idle()).
	  If needed, this hook can be used to prevent the CPU from actually
	  entering sleep by skipping the WFE/WFI instruction.

endif # SOC_SERIES_LPC84X
```
