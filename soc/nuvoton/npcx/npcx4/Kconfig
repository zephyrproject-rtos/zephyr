## soc/nuvoton/npcx/npcx4/Kconfig
```kconfig
# Nuvoton NPCX4 EC series

# Copyright (c) 2023 Nuvoton Technology Corporation.
# SPDX-License-Identifier: Apache-2.0

config SOC_SERIES_NPCX4
	select ARM
	select CPU_CORTEX_M4
	select CPU_CORTEX_M_HAS_DWT
	select CPU_HAS_FPU
	select CPU_HAS_ARM_MPU
	select HAS_PM
```

## soc/nuvoton/npcx/npcx4/Kconfig.defconfig
```kconfig
# Nuvoton Cortex-M4 Embedded Controller

# Copyright (c) 2023 Nuvoton Technology Corporation.
# SPDX-License-Identifier: Apache-2.0

if SOC_SERIES_NPCX4

config NUM_IRQS
	default 86

config CORTEX_M_SYSTICK
	default !NPCX_ITIM_TIMER

config ESPI_TAF_NPCX
	default y
	depends on ESPI_TAF

config SYS_CLOCK_HW_CYCLES_PER_SEC
	default $(dt_nodelabel_int_prop,itims,clock-frequency)

endif # SOC_SERIES_NPCX4
```

## soc/nuvoton/npcx/npcx4/Kconfig.soc
```kconfig
# Nuvoton NPCX4 EC series

# Copyright (c) 2023 Nuvoton Technology Corporation.
# SPDX-License-Identifier: Apache-2.0

config SOC_SERIES_NPCX4
	bool
	select SOC_FAMILY_NPCX
	help
	  Enable support for Nuvoton NPCX4 series

config SOC_NPCX4M3F
	bool
	select SOC_SERIES_NPCX4
	help
	  NPCX4M3F

config SOC_NPCX4M8F
	bool
	select SOC_SERIES_NPCX4
	help
	  NPCX4M8F

config SOC_SERIES
	default "npcx4" if SOC_SERIES_NPCX4

config SOC
	default "npcx4m3f" if SOC_NPCX4M3F
	default "npcx4m8f" if SOC_NPCX4M8F
```

## soc/nuvoton/npcx/npcx7/Kconfig
```kconfig
# Nuvoton Cortex-M4 Embedded Controller NPCX7 series

# Copyright (c) 2020 Nuvoton Technology Corporation.
# SPDX-License-Identifier: Apache-2.0

config SOC_SERIES_NPCX7
	select ARM
	select CPU_CORTEX_M4
	select CPU_CORTEX_M_HAS_DWT
	select CPU_HAS_FPU
	select CPU_HAS_ARM_MPU
	select CPU_HAS_CUSTOM_FIXED_SOC_MPU_REGIONS
	select HAS_PM
	select SOC_EARLY_INIT_HOOK
```

## soc/nuvoton/npcx/npcx7/Kconfig.defconfig
```kconfig
# Nuvoton Cortex-M4 Embedded Controller

# Copyright (c) 2020 Nuvoton Technology Corporation.
# SPDX-License-Identifier: Apache-2.0

if SOC_SERIES_NPCX7

config NUM_IRQS
	default 64

config CORTEX_M_SYSTICK
	default !NPCX_ITIM_TIMER

endif # SOC_SERIES_NPCX7
```

## soc/nuvoton/npcx/npcx7/Kconfig.soc
```kconfig
# Nuvoton Cortex-M4 Embedded Controller NPCX7 series

# Copyright (c) 2020 Nuvoton Technology Corporation.
# SPDX-License-Identifier: Apache-2.0

config SOC_SERIES_NPCX7
	bool
	select NPCX_SOC_VARIANT_NPCXN
	help
	  Enable support for Nuvoton NPCX7 series

config SOC_NPCX7M6FB
	bool
	select SOC_SERIES_NPCX7
	help
	  NPCX7M6FB

config SOC_NPCX7M6FC
	bool
	select SOC_SERIES_NPCX7
	help
	  NPCX7M6FC

config SOC_NPCX7M7FC
	bool
	select SOC_SERIES_NPCX7
	help
	  NPCX7M7FC

config SOC_SERIES
	default "npcx7" if SOC_SERIES_NPCX7

config SOC
	default "npcx7m6fb" if SOC_NPCX7M6FB
	default "npcx7m6fc" if SOC_NPCX7M6FC
	default "npcx7m7fc" if SOC_NPCX7M7FC
```

## soc/nuvoton/npcx/npcx9/Kconfig
```kconfig
# Nuvoton Cortex-M4 Embedded Controller NPCX9 series

# Copyright (c) 2021 Nuvoton Technology Corporation.
# SPDX-License-Identifier: Apache-2.0

config SOC_SERIES_NPCX9
	select ARM
	select CPU_CORTEX_M4
	select CPU_CORTEX_M_HAS_DWT
	select CPU_HAS_FPU
	select CPU_HAS_ARM_MPU
	select SOC_FAMILY_NPCX
	select HAS_PM
	select SOC_EARLY_INIT_HOOK

config NPCX_VCC1_RST_HANG_WORKAROUND
	bool
	depends on SOC_NPCX9M7FB
	default y
	help
	  Workaround the issue "Possible Hang-Up After VCC1_RST Reset"
	  in the npcx9m7fb SoC errata.
```

## soc/nuvoton/npcx/npcx9/Kconfig.defconfig
```kconfig
# Nuvoton Cortex-M4 Embedded Controller

# Copyright (c) 2021 Nuvoton Technology Corporation.
# SPDX-License-Identifier: Apache-2.0

if SOC_SERIES_NPCX9

config NUM_IRQS
	default 64

config CORTEX_M_SYSTICK
	default !NPCX_ITIM_TIMER

config SYS_CLOCK_HW_CYCLES_PER_SEC
	default $(dt_nodelabel_int_prop,itims,clock-frequency)

endif # SOC_SERIES_NPCX9
```

## soc/nuvoton/npcx/npcx9/Kconfig.soc
```kconfig
# Nuvoton Cortex-M4 Embedded Controller NPCX9 series

# Copyright (c) 2021 Nuvoton Technology Corporation.
# SPDX-License-Identifier: Apache-2.0

config SOC_SERIES_NPCX9
	bool
	select NPCX_SOC_VARIANT_NPCXN
	help
	  Enable support for Nuvoton NPCX9 series

config SOC_NPCX9M3F
	bool
	select SOC_SERIES_NPCX9
	help
	  NPCX9M3F

config SOC_NPCX9M6F
	bool
	select SOC_SERIES_NPCX9
	help
	  NPCX9M6F

config SOC_NPCX9M7F
	bool
	select SOC_SERIES_NPCX9
	help
	  NPCX9M7F

config SOC_NPCX9M7FB
	bool
	select SOC_SERIES_NPCX9
	help
	  NPCX9M7FB

config SOC_NPCX9MFP
	bool
	select SOC_SERIES_NPCX9
	help
	  NPCX9MFP

config SOC_SERIES
	default "npcx9" if SOC_SERIES_NPCX9

config SOC
	default "npcx9m3f" if SOC_NPCX9M3F
	default "npcx9m6f" if SOC_NPCX9M6F
	default "npcx9m7f" if SOC_NPCX9M7F
	default "npcx9m7fb" if SOC_NPCX9M7FB
	default "npcx9mfp" if SOC_NPCX9MFP
```

## soc/nuvoton/numaker/Kconfig
```kconfig
# Copyright (c) 2023 Nuvoton Technology Corporation.
#
# SPDX-License-Identifier: Apache-2.0

config SOC_FAMILY_NUMAKER
	select PLATFORM_SPECIFIC_INIT

if SOC_FAMILY_NUMAKER

rsource "*/Kconfig"

endif # SOC_FAMILY_NUMAKER
```

## soc/nuvoton/numaker/Kconfig.defconfig
```kconfig
# Copyright (c) 2023 Nuvoton Technology Corporation.
#
# SPDX-License-Identifier: Apache-2.0

if SOC_FAMILY_NUMAKER

rsource "*/Kconfig.defconfig"

config RESET
	default y

endif
```

## soc/nuvoton/numaker/Kconfig.soc
```kconfig
# Copyright (c) 2023 Nuvoton Technology Corporation.
#
# SPDX-License-Identifier: Apache-2.0

config SOC_FAMILY_NUMAKER
	bool

config SOC_FAMILY
	default "numaker" if SOC_FAMILY_NUMAKER

rsource "*/Kconfig.soc"
```

## soc/nuvoton/numaker/m031x/Kconfig
```kconfig
# Copyright (c) 2026 Nuvoton Technology Corporation.
#
# SPDX-License-Identifier: Apache-2.0

config SOC_SERIES_M031X
	select ARM
	select CPU_CORTEX_M0
	select CPU_CORTEX_M_HAS_SYSTICK
	select HAS_POWEROFF
	select INIT_ARCH_HW_AT_BOOT

config SOC_M031XXX
	select HAS_NUMAKER_HAL
```

## soc/nuvoton/numaker/m031x/Kconfig.defconfig
```kconfig
# Copyright (c) 2026 Nuvoton Technology Corporation.
#
# SPDX-License-Identifier: Apache-2.0

if SOC_SERIES_M031X

rsource "Kconfig.defconfig.m031*"

config SYS_CLOCK_HW_CYCLES_PER_SEC
	default $(dt_node_int_prop_int,/system-clock,clock-frequency)

endif # SOC_SERIES_M031X
```

## soc/nuvoton/numaker/m031x/Kconfig.defconfig.m031xxx
```kconfig
# Copyright (c) 2026 Nuvoton Technology Corporation.
#
# SPDX-License-Identifier: Apache-2.0

if SOC_M031XXX

config NUM_IRQS
	default 31

endif # SOC_M031XXX
```

## soc/nuvoton/numaker/m031x/Kconfig.soc
```kconfig
# Copyright (c) 2026 Nuvoton Technology Corporation.
#
# SPDX-License-Identifier: Apache-2.0

config SOC_SERIES_M031X
	bool
	select SOC_FAMILY_NUMAKER
	help
	  Enable support for Nuvoton M031X MCU series

config SOC_M031XXX
	bool
	select SOC_SERIES_M031X

config SOC_SERIES
	default "m031x" if SOC_SERIES_M031X

config SOC
	default "m031xxx" if SOC_M031XXX
```

## soc/nuvoton/numaker/m2l31x/Kconfig
```kconfig
# Copyright (c) 2024 Nuvoton Technology Corporation.
#
# SPDX-License-Identifier: Apache-2.0

config SOC_SERIES_M2L31X
	select ARM
	select CPU_CORTEX_M23
	select CPU_CORTEX_M_HAS_SYSTICK
	select CPU_CORTEX_M_HAS_DWT
	select CPU_CORTEX_M_HAS_VTOR
	select CPU_HAS_ARM_MPU

config SOC_M2L31XXX
	select HAS_NUMAKER_HAL
```

## soc/nuvoton/numaker/m2l31x/Kconfig.defconfig
```kconfig
# Copyright (c) 2024 Nuvoton Technology Corporation.
#
# SPDX-License-Identifier: Apache-2.0

if SOC_SERIES_M2L31X

rsource "Kconfig.defconfig.m2l31*"

endif # SOC_SERIES_M2L31X
```

## soc/nuvoton/numaker/m2l31x/Kconfig.defconfig.m2l31xxx
```kconfig
# Copyright (c) 2024 Nuvoton Technology Corporation.
#
# SPDX-License-Identifier: Apache-2.0

if SOC_M2L31XXX

config NUM_IRQS
	default 143

endif # SOC_M2L31XXX
```

## soc/nuvoton/numaker/m2l31x/Kconfig.soc
```kconfig
# Copyright (c) 2024 Nuvoton Technology Corporation.
#
# SPDX-License-Identifier: Apache-2.0

config SOC_SERIES_M2L31X
	bool
	select SOC_FAMILY_NUMAKER
	help
	  Enable support for Nuvoton M2L31X MCU series

config SOC_M2L31XXX
	bool
	select SOC_SERIES_M2L31X

config SOC_SERIES
	default "m2l31x" if SOC_SERIES_M2L31X

config SOC
	default "m2l31xxx" if SOC_M2L31XXX
```

## soc/nuvoton/numaker/m333x/Kconfig
```kconfig
# Copyright (c) 2025 Nuvoton Technology Corporation.
#
# SPDX-License-Identifier: Apache-2.0

config SOC_SERIES_M333X
	select ARM
	select CPU_CORTEX_M33
	select CPU_CORTEX_M_HAS_DWT
	select CPU_HAS_FPU
	select CPU_CORTEX_M_HAS_SYSTICK
	select CPU_CORTEX_M_HAS_VTOR
	select CPU_HAS_ARM_MPU
	select ARMV8_M_DSP
	select HAS_POWEROFF
	select ARM_MPU

config SOC_M333XXX
	select HAS_NUMAKER_HAL
```

## soc/nuvoton/numaker/m333x/Kconfig.defconfig
```kconfig
# Copyright (c) 2025 Nuvoton Technology Corporation.
#
# SPDX-License-Identifier: Apache-2.0

if SOC_SERIES_M333X

rsource "Kconfig.defconfig.m333*"

config SYS_CLOCK_HW_CYCLES_PER_SEC
	default $(dt_node_int_prop_int,/system-clock,clock-frequency)

endif # SOC_SERIES_M333X
```

## soc/nuvoton/numaker/m333x/Kconfig.defconfig.m333xxx
```kconfig
# Copyright (c) 2025 Nuvoton Technology Corporation.
#
# SPDX-License-Identifier: Apache-2.0

if SOC_M333XXX

config NUM_IRQS
	default 142

endif # SOC_M333XXX
```

## soc/nuvoton/numaker/m333x/Kconfig.soc
```kconfig
# Copyright (c) 2025 Nuvoton Technology Corporation.
#
# SPDX-License-Identifier: Apache-2.0

config SOC_SERIES_M333X
	bool
	select SOC_FAMILY_NUMAKER
	help
	  Enable support for Nuvoton M333X MCU series

config SOC_M333XXX
	bool
	select SOC_SERIES_M333X

config SOC_SERIES
	default "m333x" if SOC_SERIES_M333X

config SOC
	default "m333xxx" if SOC_M333XXX
```

## soc/nuvoton/numaker/m335x/Kconfig
```kconfig
# Copyright (c) 2026 Nuvoton Technology Corporation.
#
# SPDX-License-Identifier: Apache-2.0

config SOC_SERIES_M335X
	select ARM
	select CPU_CORTEX_M33
	select CPU_CORTEX_M_HAS_DWT
	select CPU_HAS_FPU
	select CPU_CORTEX_M_HAS_SYSTICK
	select CPU_CORTEX_M_HAS_VTOR
	select CPU_HAS_ARM_MPU
	select ARMV8_M_DSP
	select HAS_POWEROFF
	select ARM_MPU
	select INIT_ARCH_HW_AT_BOOT

config SOC_M335XXX
	select HAS_NUMAKER_HAL
```
