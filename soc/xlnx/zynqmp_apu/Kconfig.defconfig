## soc/xlnx/zynqmp_apu/Kconfig.defconfig
```kconfig
# SPDX-License-Identifier: Apache-2.0

if SOC_XILINX_ZYNQMP

if SOC_XILINX_ZYNQMP_APU

config NUM_IRQS
	# must be >= the highest interrupt number used
	# - include the UART interrupts
	default 220

config SYS_CLOCK_EXISTS
       bool
       default y

config SYS_CLOCK_HW_CYCLES_PER_SEC
	int
	default 100000000

endif # SOC_XILINX_ZYNQMP_APU

endif # SOC_XILINX_ZYNQMP
```

## soc/xlnx/zynqmp_apu/Kconfig.soc
```kconfig
# SPDX-License-Identifier: Apache-2.0

config SOC_XILINX_ZYNQMP
	bool

config SOC_XILINX_ZYNQMP_APU
	bool
	select SOC_XILINX_ZYNQMP
	help
	  Xilinx ZynqMP APU

config SOC_FAMILY
	default "xilinx_zynqmp" if SOC_XILINX_ZYNQMP

config SOC
	default "zynqmp_apu" if SOC_XILINX_ZYNQMP_APU
```

## soc/xtensa/D_108mini/Kconfig.soc
```kconfig
# Copyright (c) 2017 Intel Corporation
# SPDX-License-Identifier: Apache-2.0

config SOC_D_108MINI
	bool "D_108mini core"
```

## soc/xtensa/D_233L/Kconfig.soc
```kconfig
# Copyright (c) 2017 Intel Corporation
# SPDX-License-Identifier: Apache-2.0

config SOC_D_233L
	bool "D_233L core"
```

## soc/xtensa/XRC_FUSION_AON_ALL_LM/Kconfig.soc
```kconfig
# Copyright (c) 2017 Intel Corporation
# SPDX-License-Identifier: Apache-2.0

config SOC_XRC_FUSION_AON_ALL_LM
	bool "XRC_FUSION_AON_ALL_LM core"
```

## soc/xtensa/dc233c/Kconfig.defconfig
```kconfig
# Copyright (c) 2016 Open-RnD Sp. z o.o.
# Copyright (c) 2016 Cadence Design Systems, Inc.
# Copyright (c) 2023 Intel Corporation
#
# SPDX-License-Identifier: Apache-2.0

if SOC_XTENSA_DC233C

config SOC
	default "dc233c"

config SOC_TOOLCHAIN_NAME
	string
	default "dc233c"

config XTENSA_MMU_NUM_L2_TABLES
	int
	default 48 if XTENSA_MMU

# Both SRAM_OFFSET and KERNEL_VM_OFFSET are set at 1MB.
# This is to allow VECBASE to be mapped permanently
# via TLB way 4 (which covers 1MB).
config SRAM_OFFSET
	hex
	default 0x100000

config KERNEL_VM_OFFSET
	hex
	default 0x100000

endif
```

## soc/xtensa/dc233c/Kconfig.soc
```kconfig
# Copyright (c) 2017, 2023 Intel Corporation
#
# SPDX-License-Identifier: Apache-2.0

config SOC_XTENSA_DC233C
	bool "Xtensa dc233c core"
	select XTENSA
	select XTENSA_HAL
	select ARCH_HAS_THREAD_LOCAL_STORAGE
	select CPU_HAS_MMU
	select ARCH_HAS_RESERVED_PAGE_FRAMES if XTENSA_MMU
```

## soc/xtensa/esp32/Kconfig.defconfig
```kconfig
# ESP32 board configuration

# Copyright (c) 2017 Intel Corporation
# SPDX-License-Identifier: Apache-2.0

if SOC_ESP32

if BOOTLOADER_MCUBOOT
	config HAS_FLASH_LOAD_OFFSET
		default y

	config MCUBOOT_GENERATE_UNSIGNED_IMAGE
		default y

	config MCUBOOT_GENERATE_CONFIRMED_IMAGE
		default y

	config ROM_START_OFFSET
		default 0x20

	config HAS_DYNAMIC_DEVICE_HANDLES
		default y
endif

config SOC
	default "esp32"

config SOC_TOOLCHAIN_NAME
	string
	default "espressif_esp32"

if SMP

config SCHED_IPI_SUPPORTED
	default y

config SCHED_CPU_MASK
	default y

config MP_NUM_CPUS
	default 2

endif

config MINIMAL_LIBC_OPTIMIZE_STRING_FOR_SIZE
	default n

if GDBSTUB

# ESP32 GDB expects 420 bytes G-packet.
# So double for hexadecimal digits.
config GDBSTUB_BUF_SZ
	default 840 if GDBSTUB

endif

endif
```
