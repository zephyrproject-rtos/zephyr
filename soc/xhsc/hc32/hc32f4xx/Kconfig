## soc/xhsc/hc32/hc32f4xx/Kconfig
```kconfig
# Copyright (c) 2026 Liu Changjie <liucj1228@outlook.com>
# SPDX-License-Identifier: Apache-2.0

config SOC_SERIES_HC32F4XX
	select ARM
	select CPU_CORTEX_M4
	select CPU_CORTEX_M_HAS_SYSTICK
	select CPU_CORTEX_M_HAS_VTOR
	select CPU_HAS_ARM_MPU
	select CPU_HAS_FPU
	select SOC_EARLY_INIT_HOOK
```

## soc/xhsc/hc32/hc32f4xx/Kconfig.defconfig
```kconfig
# Copyright (c) 2026 Liu Changjie <liucj1228@outlook.com>
# SPDX-License-Identifier: Apache-2.0

if SOC_SERIES_HC32F4XX

rsource "Kconfig.defconfig.*"

endif # SOC_SERIES_HC32F4XX
```

## soc/xhsc/hc32/hc32f4xx/Kconfig.defconfig.hc32f4a0
```kconfig
# Copyright (c) 2026 Liu Changjie <liucj1228@outlook.com>
# SPDX-License-Identifier: Apache-2.0

if SOC_HC32F4A0

config NUM_IRQS
	default 143

config SYS_CLOCK_HW_CYCLES_PER_SEC
	default $(dt_node_int_prop_int,/cpus/cpu@0,clock-frequency)

endif # SOC_HC32F4A0
```

## soc/xhsc/hc32/hc32f4xx/Kconfig.soc
```kconfig
# Copyright (C) 2024-2025, Xiaohua Semiconductor Co., Ltd.
# SPDX-License-Identifier: Apache-2.0

config SOC_SERIES_HC32F4XX
	bool
	select SOC_FAMILY_XHSC_HC32
	help
	  Enable support for XHSC HC32F4XX MCU series

config SOC_SERIES
	default "hc32f4xx" if SOC_SERIES_HC32F4XX

config SOC_HC32F460
	bool
	select SOC_SERIES_HC32F4XX
	select SOC_RESET_HOOK
	#SOC_RESET_HOOK uesed for set sram3 R/W cycles = 2

config SOC_HC32F4A0
	bool
	select SOC_SERIES_HC32F4XX
	select SOC_RESET_HOOK

config SOC
	default "hc32f460" if SOC_HC32F460
	default "hc32f4a0" if SOC_HC32F4A0
```

## soc/xlnx/mbv32/Kconfig.soc
```kconfig
#
# Copyright (c) 2026 Advanced Micro Devices, Inc.
#
# SPDX-License-Identifier: Apache-2.0
#

config SOC_MBV32
	bool

config SOC
	default "mbv32" if SOC_MBV32
```

## soc/xlnx/versal/Kconfig
```kconfig
#
# Copyright (c) 2025 Space Cubics Inc.
#
# SPDX-License-Identifier: Apache-2.0
#

config SOC_VERSAL_RPU
	select ARM
	select CPU_CORTEX_R5
	select CPU_HAS_ARM_MPU
	select SOC_EARLY_INIT_HOOK
	select CPU_HAS_DCLS
	select VFP_DP_D16
	select SOC_RESET_HOOK
	select ARM_MPU

# Split TCM/OCM memory map: vectors and boot stub in rom_start @ 0x0, image
# linked in on-chip memory (OCM). Requires a TCM boot stub before any OCM
# access; selected when rom_start relocation is enabled and SRAM is in OCM.
config SOC_VERSAL_RPU_OCM_BOOT
	bool
	default y if ROMSTART_RELOCATION_ROM && \
		($(dt_chosen_reg_addr_hex,$(DT_CHOSEN_Z_SRAM)) >= 0xFF000000)
	select ARM_MPU_SKIP_ARCH_INIT

if SOC_VERSAL_RPU_OCM_BOOT

config KERNEL_ENTRY
	default "versal_rpu_ocm_boot"

config ROM_START_OFFSET
	default 0

endif # SOC_VERSAL_RPU_OCM_BOOT

config SOC_VERSAL_APU
	select ARM64
	select ARM_ARCH_TIMER
	select CPU_CORTEX_A72
	select CPU_HAS_MMU
```

## soc/xlnx/versal/Kconfig.defconfig
```kconfig
#
# Copyright (c) 2025 Space Cubics Inc.
#
# SPDX-License-Identifier: Apache-2.0
#

if SOC_AMD_VERSAL

if SOC_VERSAL_RPU

config NUM_IRQS
	# must be >= the highest interrupt number used
	# - include the UART interrupts
	default 256

config SYS_CLOCK_HW_CYCLES_PER_SEC
	default $(dt_nodelabel_int_prop,ttc0,clock-frequency)

endif # SOC_VERSAL_RPU

if SOC_VERSAL_APU

config CACHE_MANAGEMENT
	default y

config ARM_ARCH_TIMER
	default y

config NUM_IRQS
	# must be >= the highest interrupt number used
	default 256

config SYS_CLOCK_HW_CYCLES_PER_SEC
	default $(dt_node_int_prop_int,/cpus/cpu@0,clock-frequency)

endif # SOC_VERSAL_APU

endif # SOC_AMD_VERSAL
```

## soc/xlnx/versal/Kconfig.soc
```kconfig
#
# Copyright (c) 2025 Space Cubics Inc.
#
# SPDX-License-Identifier: Apache-2.0
#

config SOC_AMD_VERSAL
	bool

config SOC_VERSAL_RPU
	bool
	select SOC_AMD_VERSAL
	help
	  AMD Versal RPU

config SOC_VERSAL_APU
	bool
	select SOC_AMD_VERSAL
	help
	  AMD Versal APU

config SOC_FAMILY
	default "amd_versal" if SOC_AMD_VERSAL

config SOC
	default "versal_rpu" if SOC_VERSAL_RPU
	default "versal_apu" if SOC_VERSAL_APU
```

## soc/xlnx/versal2/Kconfig.defconfig
```kconfig
#
# Copyright (c) 2025 Advanced Micro Devices, Inc.
#
# SPDX-License-Identifier: Apache-2.0
#

if SOC_AMD_VERSAL2

if SOC_AMD_VERSAL2_RPU

config NUM_IRQS
	# must be >= the highest interrupt number used
	# - include the UART interrupts
	default 256

config SYS_CLOCK_HW_CYCLES_PER_SEC
	default $(dt_node_int_prop_int,/cpus/cpu@0,clock-frequency)

endif # SOC_AMD_VERSAL2_RPU

endif # SOC_VERSAL2_AMD
```

## soc/xlnx/versal2/Kconfig.soc
```kconfig
#
# Copyright (c) 2025 Advanced Micro Devices, Inc.
#
# SPDX-License-Identifier: Apache-2.0
#

config SOC_AMD_VERSAL2
	bool

config SOC_AMD_VERSAL2_RPU
	bool
	select SOC_AMD_VERSAL2
	help
	  AMD Versal Gen 2 RPU

config SOC_FAMILY
	default "amd_versal2" if SOC_AMD_VERSAL2

config SOC
	default "amd_versal2_rpu" if SOC_AMD_VERSAL2_RPU
```

## soc/xlnx/versalnet/Kconfig
```kconfig
#
# Copyright (c) 2025 Advanced Micro Devices, Inc.
#
# SPDX-License-Identifier: Apache-2.0
#

config SOC_AMD_VERSALNET_RPU
	select ARM
	select ARM_ARCH_TIMER
	select CPU_CORTEX_R52
	select SOC_EARLY_INIT_HOOK
	select CPU_HAS_DCLS
	select GIC_SINGLE_SECURITY_STATE
	select CPU_HAS_ARM_MPU
	select ARM_MPU

config SOC_AMD_VERSALNET_APU
	select ARM64
	select ARM_ARCH_TIMER
	select CPU_CORTEX_A78
	select CPU_HAS_MMU
```

## soc/xlnx/versalnet/Kconfig.defconfig
```kconfig
#
# Copyright (c) 2025 Advanced Micro Devices, Inc.
#
# SPDX-License-Identifier: Apache-2.0
#

if SOC_AMD_VERSALNET

configdefault CACHE_MANAGEMENT
	default y

if SOC_AMD_VERSALNET_RPU

config NUM_IRQS
	# must be >= the highest interrupt number used
	# - include the UART interrupts
	default 256

config SYS_CLOCK_HW_CYCLES_PER_SEC
	default $(dt_node_int_prop_int,/cpus/cpu@0,clock-frequency)

endif # SOC_AMD_VERSALNET_RPU

if SOC_AMD_VERSALNET_APU

configdefault DCACHE_LINE_SIZE
	default 64

configdefault ICACHE_LINE_SIZE
	default 64

config NUM_IRQS
	# must be >= the highest interrupt number used
	# - include the UART interrupts
	default 256

config SYS_CLOCK_HW_CYCLES_PER_SEC
	default $(dt_node_int_prop_int,/cpus/cpu@0,clock-frequency)

endif # SOC_AMD_VERSALNET_APU
endif # SOC_AMD_VERSALNET
```

## soc/xlnx/versalnet/Kconfig.soc
```kconfig
#
# Copyright (c) 2025 Advanced Micro Devices, Inc.
#
# SPDX-License-Identifier: Apache-2.0
#

config SOC_AMD_VERSALNET
	bool

config SOC_AMD_VERSALNET_RPU
	bool
	select SOC_AMD_VERSALNET
	help
	  AMD Versal NET SoC RPU

config SOC_AMD_VERSALNET_APU
	bool
	select SOC_AMD_VERSALNET
	help
	  AMD Versal NET SoC APU

config SOC_FAMILY
	default "amd_versalnet" if SOC_AMD_VERSALNET

config SOC
	default "amd_versalnet_rpu" if SOC_AMD_VERSALNET_RPU
	default "amd_versalnet_apu" if SOC_AMD_VERSALNET_APU
```

## soc/xlnx/zynq7000/Kconfig
```kconfig
#
# Copyright (c) 2021 Weidmueller Interface GmbH & Co. KG
# SPDX-License-Identifier: Apache-2.0
#

if SOC_FAMILY_XILINX_ZYNQ7000

# The PL310 (L2C-310) outer cache is provided by the Cortex-A/R arch driver
# (CONFIG_ARM_PL310), probed from the arm,pl310-cache devicetree node; see
# arch/arm/core/cortex_a_r/pl310.c.

rsource "*/Kconfig"

endif # SOC_FAMILY_XILINX_ZYNQ7000
```

## soc/xlnx/zynq7000/Kconfig.defconfig
```kconfig
#
# Copyright (c) 2021 Weidmueller Interface GmbH & Co. KG
# SPDX-License-Identifier: Apache-2.0
#

if SOC_FAMILY_XILINX_ZYNQ7000

rsource "*/Kconfig.defconfig"

config NUM_IRQS
	# must be >= the highest interrupt number used
	default 96

# Workaround for not being able to have commas in macro arguments
DT_CHOSEN_Z_FLASH := zephyr,flash

config FLASH_SIZE
	default $(dt_chosen_reg_size_int,$(DT_CHOSEN_Z_FLASH),0,K)

config FLASH_BASE_ADDRESS
	default $(dt_chosen_reg_addr_hex,$(DT_CHOSEN_Z_FLASH))

config SOC_RESET_HOOK
	default y

if I2C_CADENCE

config I2C_CADENCE_BROKEN_HOLD_BIT
	default y if $(dt_nodelabel_enabled,i2c0) || $(dt_nodelabel_enabled,i2c1)

endif # I2C_CADENCE

endif # SOC_FAMILY_XILINX_ZYNQ7000
```

## soc/xlnx/zynq7000/Kconfig.soc
```kconfig
#
# Copyright (c) 2021 Weidmueller Interface GmbH & Co. KG
# SPDX-License-Identifier: Apache-2.0
#

config SOC_FAMILY_XILINX_ZYNQ7000
	bool

config SOC_FAMILY
	default "xilinx_zynq7000" if SOC_FAMILY_XILINX_ZYNQ7000

rsource "*/Kconfig.soc"
```

## soc/xlnx/zynq7000/xc7zxxx/Kconfig.defconfig
```kconfig
#
# Copyright (c) 2021 Weidmueller Interface GmbH & Co. KG
# SPDX-License-Identifier: Apache-2.0
#

if SOC_SERIES_XC7ZXXX

# Zephyr does not support SMP on aarch32 yet, so we default to 1 CPU core
config MP_MAX_NUM_CPUS
	default 1

endif # SOC_SERIES_XC7ZXXX
```

## soc/xlnx/zynq7000/xc7zxxx/Kconfig.soc
```kconfig
#
# Copyright (c) 2021 Weidmueller Interface GmbH & Co. KG
# SPDX-License-Identifier: Apache-2.0
#
# Device data: comp.
# https://www.xilinx.com/products/silicon-devices/soc/zynq-7000.html#productTable
#

config SOC_SERIES_XC7ZXXX
	bool
	select SOC_FAMILY_XILINX_ZYNQ7000
	help
	  Enable support for the Xilinx Zynq-7000 (XC7Zxxx)
	  SoC series (dual core ARM Cortex-A9).

config SOC_XILINX_XC7Z010
	bool
	select SOC_SERIES_XC7ZXXX
	help
	  2 ARM Cortex-A9 cores up to 866 MHz, Artix-7 programmable logic,
	  28k logic cells, 2.1Mb block RAM, 800 DSP slices, up to 100 I/O pins.

config SOC_XILINX_XC7Z015
	bool
	select SOC_SERIES_XC7ZXXX
	help
	  2 ARM Cortex-A9 cores up to 866 MHz, Artix-7 programmable logic,
	  74k logic cells, 3.3Mb block RAM, 160 DSP slices, up to 150 I/O pins,
	  up to 4 transceivers.

config SOC_XILINX_XC7Z020
	bool
	select SOC_SERIES_XC7ZXXX
	help
	  2 ARM Cortex-A9 cores up to 866 MHz, Artix-7 programmable logic,
	  85k logic cells, 4.9Mb block RAM, 220 DSP slices, up to 200 I/O pins.

config SOC_XILINX_XC7Z030
	bool
	select SOC_SERIES_XC7ZXXX
	help
	  2 ARM Cortex-A9 cores up to 1 GHz, Kintex-7 programmable logic,
	  125k logic cells, 9.3Mb block RAM, 400 DSP slices, up to 250 I/O pins,
	  up to 4 transceivers.

config SOC_XILINX_XC7Z035
	bool
	select SOC_SERIES_XC7ZXXX
	help
	  2 ARM Cortex-A9 cores up to 1 GHz, Kintex-7 programmable logic,
	  275k logic cells, 17.6Mb block RAM, 900 DSP slices, up to 362 I/O pins,
	  up to 16 transceivers.

config SOC_XILINX_XC7Z045
	bool
	select SOC_SERIES_XC7ZXXX
	help
	  2 ARM Cortex-A9 cores up to 1 GHz, Kintex-7 programmable logic,
	  350k logic cells, 19.1Mb block RAM, 900 DSP slices, up to 362 I/O pins,
	  up to 16 transceivers.

config SOC_XILINX_XC7Z100
	bool
	select SOC_SERIES_XC7ZXXX
	help
	  2 ARM Cortex-A9 cores up to 1 GHz, Kintex-7 programmable logic,
	  444k logic cells, 26.5Mb block RAM, 2020 DSP slices, up to 400 I/O pins,
	  up to 16 transceivers.

config SOC_SERIES
	default "xc7zxxx" if SOC_SERIES_XC7ZXXX

config SOC
	default "xc7z010" if SOC_XILINX_XC7Z010
	default "xc7z015" if SOC_XILINX_XC7Z015
	default "xc7z020" if SOC_XILINX_XC7Z020
	default "xc7z030" if SOC_XILINX_XC7Z030
	default "xc7z035" if SOC_XILINX_XC7Z035
	default "xc7z045" if SOC_XILINX_XC7Z045
	default "xc7z100" if SOC_XILINX_XC7Z100
```

## soc/xlnx/zynq7000/xc7zxxxs/Kconfig
```kconfig
#
# Copyright (c) 2021 Weidmueller Interface GmbH & Co. KG
# SPDX-License-Identifier: Apache-2.0
#
# Device data: comp.
# https://www.xilinx.com/products/silicon-devices/soc/zynq-7000.html#productTable
#

config SOC_SERIES_XC7ZXXXS
	select ARM
	select CPU_CORTEX_A9
	select SYSCON
	select ARM_ARCH_TIMER_ERRATUM_740657 if ARM_ARCH_TIMER
```

## soc/xlnx/zynq7000/xc7zxxxs/Kconfig.defconfig
```kconfig
#
# Copyright (c) 2021 Weidmueller Interface GmbH & Co. KG
# SPDX-License-Identifier: Apache-2.0
#

if SOC_SERIES_XC7ZXXXS

config MP_MAX_NUM_CPUS
	default 1

endif # SOC_SERIES_XC7ZXXXS
```

## soc/xlnx/zynq7000/xc7zxxxs/Kconfig.soc
```kconfig
#
# Copyright (c) 2021 Weidmueller Interface GmbH & Co. KG
# SPDX-License-Identifier: Apache-2.0
#
# Device data: comp.
# https://www.xilinx.com/products/silicon-devices/soc/zynq-7000.html#productTable
#

config SOC_SERIES_XC7ZXXXS
	bool
	select SOC_FAMILY_XILINX_ZYNQ7000
	help
	  Enable support for the Xilinx Zynq-7000S (XC7ZxxxS)
	  SoC series (single core ARM Cortex-A9).

config SOC_XILINX_XC7Z007S
	bool
	select SOC_SERIES_XC7ZXXXS
	help
	  1 ARM Cortex-A9 core up to 766 MHz, Artix-7 programmable logic,
	  23k logic cells, 1.8 Mb block RAM, 60 DSP slices, up to 100 I/O pins.

config SOC_XILINX_XC7Z012S
	bool
	select SOC_SERIES_XC7ZXXXS
	help
	  1 ARM Cortex-A9 core up to 766 MHz, Artix-7 programmable logic,
	  55k logic cells, 2.5Mb block RAM, 120 DSP slices, up to 150 I/O pins,
	  up to 4 transceivers.

config SOC_XILINX_XC7Z014S
	bool
	select SOC_SERIES_XC7ZXXXS
	help
	  1 ARM Cortex-A9 core up to 766 MHz, Artix-7 programmable logic,
	  65k logic cells, 3.8Mb block RAM, 170 DSP slices, up to 200 I/O pins.

config SOC_SERIES
	default "xc7zxxxs" if SOC_SERIES_XC7ZXXXS

config SOC
	default "xc7z007s" if SOC_XILINX_XC7Z007S
	default "xc7z012s" if SOC_XILINX_XC7Z012S
	default "xc7z014s" if SOC_XILINX_XC7Z014S
```

## soc/xlnx/zynqmp/Kconfig
```kconfig
# Copyright (c) 2019 Lexmark International, Inc.
# Copyright (c) 2019 Stephanos Ioannidis <root@stephanos.io>
# SPDX-License-Identifier: Apache-2.0

config SOC_XILINX_ZYNQMP_RPU
	select ARM
	select CPU_CORTEX_R5
	select SOC_RESET_HOOK
	select SOC_EARLY_INIT_HOOK
	select CPU_HAS_ARM_MPU
	select ARM_MPU
	select VFP_DP_D16

config SOC_XILINX_ZYNQMP_APU
    bool
    select ARM64
    select ARM_ARCH_TIMER
    select CPU_CORTEX_A53
```

## soc/xlnx/zynqmp/Kconfig.defconfig
```kconfig
# Copyright (c) 2019 Lexmark International, Inc.
# Copyright (c) 2019 Stephanos Ioannidis <root@stephanos.io>
# SPDX-License-Identifier: Apache-2.0

if SOC_XILINX_ZYNQMP

if SOC_XILINX_ZYNQMP_RPU

config NUM_IRQS
	# must be >= the highest interrupt number used
	# - include the UART interrupts
	default 220

config SYS_CLOCK_HW_CYCLES_PER_SEC
	default $(dt_nodelabel_int_prop,ttc0,clock-frequency)

endif # SOC_XILINX_ZYNQMP_RPU

endif # SOC_XILINX_ZYNQMP
```

## soc/xlnx/zynqmp/Kconfig.soc
```kconfig
# Copyright (c) 2019 Lexmark International, Inc.
# Copyright (c) 2019 Stephanos Ioannidis <root@stephanos.io>
# SPDX-License-Identifier: Apache-2.0

config SOC_XILINX_ZYNQMP
	bool

config SOC_XILINX_ZYNQMP_RPU
	bool
	select SOC_XILINX_ZYNQMP
	help
	  Xilinx ZynqMP RPU

config SOC_FAMILY
	default "xilinx_zynqmp" if SOC_XILINX_ZYNQMP

config SOC
	default "zynqmp_rpu" if SOC_XILINX_ZYNQMP_RPU
```

## soc/xlnx/zynqmp_apu/Kconfig
```kconfig
# Copyright (c) 2019 Lexmark International, Inc.
# Copyright (c) 2019 Stephanos Ioannidis <root@stephanos.io>
# SPDX-License-Identifier: Apache-2.0

config SOC_XILINX_ZYNQMP_APU
    bool
    select ARM64
    select CPU_CORTEX_A53
    select GIC
    select GIC_V2
    select ARM_ARCH_TIMER if SYS_CLOCK_EXISTS
```
