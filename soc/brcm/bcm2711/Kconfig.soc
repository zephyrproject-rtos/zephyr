## soc/brcm/bcm2711/Kconfig.soc
```kconfig
# Copyright 2023 honglin leng <a909204013@gmail.com>
# SPDX-License-Identifier: Apache-2.0

config SOC_BCM2711
	bool

config SOC
	default "bcm2711" if SOC_BCM2711
```

## soc/brcm/bcm2712/Kconfig
```kconfig
# Copyright 2024 Junho Lee <junho@tsnlab.com>
# SPDX-License-Identifier: Apache-2.0

config SOC_BCM2712
	select ARM64
	select CPU_CORTEX_A76
	select ARM_ARCH_TIMER if SYS_CLOCK_EXISTS
```

## soc/brcm/bcm2712/Kconfig.defconfig
```kconfig
# Copyright 2024 Junho Lee <junho@tsnlab.com>
# SPDX-License-Identifier: Apache-2.0

if SOC_BCM2712

config NUM_IRQS
	default 280

config SYS_CLOCK_HW_CYCLES_PER_SEC
	default 54000000

endif
```

## soc/brcm/bcm2712/Kconfig.soc
```kconfig
# Copyright 2024 Junho Lee <junho@tsnlab.com>
# SPDX-License-Identifier: Apache-2.0

config SOC_BCM2712
	bool

config SOC
	default "bcm2712" if SOC_BCM2712
```

## soc/brcm/bcm2835/Kconfig
```kconfig
# Copyright (c) 2026 Jonathan Elliot Peace <jep@alphabetiq.com>
# SPDX-License-Identifier: Apache-2.0

config SOC_BCM2835
	select ARM
	select CPU_ARM1176JZF_S
	select ARM_CUSTOM_INTERRUPT_CONTROLLER
	select KERNEL_DIRECT_MAP if MMU
```

## soc/brcm/bcm2835/Kconfig.defconfig
```kconfig
# Copyright (c) 2026 Jonathan Elliot Peace <jep@alphabetiq.com>
# SPDX-License-Identifier: Apache-2.0

if SOC_BCM2835

config NUM_IRQS
	# Flat IRQ space for the BCM2835 ARMC peripheral controller:
	# 32..127 (banks basic/1/2). The 0..31 range is unused on BCM2835
	# (no BCM2836 ARM-local intc).
	default 128

config SYS_CLOCK_HW_CYCLES_PER_SEC
	# BCM2835 free-running system timer ticks at 1 MHz.
	default 1000000 if SYS_CLOCK_EXISTS

endif
```

## soc/brcm/bcm2835/Kconfig.soc
```kconfig
# Copyright (c) 2026 Jonathan Elliot Peace <jep@alphabetiq.com>
# SPDX-License-Identifier: Apache-2.0

config SOC_BCM2835
	bool

config SOC
	default "bcm2835" if SOC_BCM2835
```

## soc/brcm/bcmvk/Kconfig.soc
```kconfig
# SPDX-License-Identifier: Apache-2.0
#
# Copyright 2020 Broadcom.
#

config SOC_FAMILY_BCMVK
	bool

config SOC_FAMILY
	default "bcmvk" if SOC_FAMILY_BCMVK

rsource "*/Kconfig.soc"
```

## soc/brcm/bcmvk/valkyrie/Kconfig
```kconfig
# SPDX-License-Identifier: Apache-2.0
#
# Copyright 2020 Broadcom.
#

config SOC_SERIES_VALKYRIE
	select ARM
	select CPU_CORTEX_M7
	select CPU_CORTEX_M_HAS_SYSTICK
	select CPU_HAS_ARM_MPU
```

## soc/brcm/bcmvk/valkyrie/Kconfig.soc
```kconfig
# SPDX-License-Identifier: Apache-2.0
#
# Copyright 2020 Broadcom.
#

config SOC_SERIES_VALKYRIE
	bool
	select SOC_FAMILY_BCMVK
	help
	  Enable support for Broadcom Valkyrie Series

config SOC_BCM58400
	bool
	select SOC_SERIES_VALKYRIE
	help
	  Broadcom BCM58400

config SOC_SERIES
	default "valkyrie" if SOC_SERIES_VALKYRIE

config SOC
	default "bcm58400" if SOC_BCM58400
```

## soc/brcm/bcmvk/viper/Kconfig
```kconfig
# Copyright 2020 Broadcom
# SPDX-License-Identifier: Apache-2.0

config SOC_BCM58402_M7
	select ARM
	select CPU_CORTEX_M7
	select CPU_CORTEX_M_HAS_SYSTICK
	select CPU_HAS_ARM_MPU
	select SOC_EARLY_INIT_HOOK

config SOC_BCM58402_A72
	select ARM64
	select CPU_CORTEX_A72
	select ARM_ARCH_TIMER if SYS_CLOCK_EXISTS
	select SOC_EARLY_INIT_HOOK
```

## soc/brcm/bcmvk/viper/Kconfig.defconfig
```kconfig
# Copyright 2020 Broadcom
# SPDX-License-Identifier: Apache-2.0

if SOC_SERIES_VIPER

rsource "Kconfig.defconfig.viper*"

endif # SOC_SERIES_VIPER
```

## soc/brcm/bcmvk/viper/Kconfig.soc
```kconfig
# Copyright 2020 Broadcom
# SPDX-License-Identifier: Apache-2.0

config SOC_SERIES_VIPER
	bool
	select SOC_FAMILY_BCMVK

config SOC_BCM58402_M7
	bool
	select SOC_SERIES_VIPER

config SOC_BCM58402_A72
	bool
	select SOC_SERIES_VIPER

config SOC_SERIES
	default "viper" if SOC_SERIES_VIPER

config SOC
	default "bcm58402" if SOC_BCM58402_M7 || SOC_BCM58402_A72
```

## soc/brcm/common/Kconfig
```kconfig
# Copyright 2025 Yoan Dumas
# SPDX-License-Identifier: Apache-2.0

if SOC_BCM2711

config BCM2711_VC_IF
	bool "Broadcom BCM2711 Video Core IV interface"
	default y if MBOX_BCM2711
	help
	  Video Core IV interface on top of the ARM to VC mailbox.

endif # SOC_BCM2711
```

## soc/broadcom/bcm_vk/Kconfig.defconfig
```kconfig
# SPDX-License-Identifier: Apache-2.0
#
# Copyright 2020 Broadcom.
#

rsource "*/Kconfig.defconfig"
```

## soc/broadcom/bcm_vk/Kconfig.soc
```kconfig
# SPDX-License-Identifier: Apache-2.0
#
# Copyright 2020 Broadcom.
#

config SOC_FAMILY_BCMVK
	bool

config SOC_FAMILY
	string
	default "bcm_vk" if SOC_FAMILY_BCMVK

rsource "*/Kconfig.soc"
```

## soc/broadcom/bcm_vk/viper/Kconfig.soc
```kconfig
# Copyright 2020 Broadcom
# SPDX-License-Identifier: Apache-2.0

config SOC_SERIES_VIPER
	bool
	select SOC_FAMILY_BCMVK
	help
	  Enable support for Broadcom Viper Series.

config SOC_BCM58402_M7
	bool
	select SOC_SERIES_VIPER
	help
	  Broadcom BCM58402 M7

config SOC_BCM58402_A72
	bool
	select SOC_SERIES_VIPER
	help
	  Broadcom BCM58402 A72

config SOC_SERIES
	default "viper" if SOC_SERIES_VIPER

config SOC
	default "bcm58402" if SOC_BCM58402_M7 || SOC_BCM58402_A72
```

## soc/canaan/Kconfig
```kconfig
# Copyright (c) 2024 Junhui Liu <liujh2818@outlook.com>
# SPDX-License-Identifier: Apache-2.0

if SOC_FAMILY_CANAAN

rsource "*/Kconfig"

endif # SOC_FAMILY_CANAAN
```

## soc/canaan/Kconfig.soc
```kconfig
# Copyright (c) 2024 Junhui Liu <liujh2818@outlook.com>
# SPDX-License-Identifier: Apache-2.0

config SOC_FAMILY_CANAAN
	bool

config SOC_FAMILY
	default "canaan" if SOC_FAMILY_CANAAN

rsource "*/Kconfig.soc"
```

## soc/canaan/k230/Kconfig
```kconfig
# Copyright (c) 2024 Junhui Liu <liujh2818@outlook.com>
# SPDX-License-Identifier: Apache-2.0

config SOC_SERIES_CANAAN_K230
	select RISCV
	select RISCV_PRIVILEGED
	select RISCV_HAS_PLIC
	select RISCV_ISA_RV64I
	select RISCV_ISA_EXT_G
	select RISCV_ISA_EXT_C

	select INCLUDE_RESET_VECTOR
	select ATOMIC_OPERATIONS_C
	select 64BIT
```

## soc/canaan/k230/Kconfig.soc
```kconfig
# Copyright (c) 2024 Junhui Liu <liujh2818@outlook.com>
# SPDX-License-Identifier: Apache-2.0

config SOC_SERIES_CANAAN_K230
	bool
	select SOC_FAMILY_CANAAN

config SOC_CANAAN_K230
	bool
	select SOC_SERIES_CANAAN_K230

config SOC_SERIES
	default "k230" if SOC_SERIES_CANAAN_K230

config SOC
	default "k230" if SOC_CANAAN_K230
```

## soc/cdac/Kconfig
```kconfig
# Copyright (c) 2026 Anuj Deshpande
# SPDX-License-Identifier: Apache-2.0

rsource "*/Kconfig"
```

## soc/cdac/Kconfig.soc
```kconfig
# Copyright (c) 2026 Anuj Deshpande
# SPDX-License-Identifier: Apache-2.0

config SOC_FAMILY_CDAC
	bool

config SOC_FAMILY
	default "cdac" if SOC_FAMILY_CDAC

rsource "*/Kconfig.soc"
```

## soc/cdac/thejas32/Kconfig
```kconfig
# Copyright (c) 2026 Anuj Deshpande
# SPDX-License-Identifier: Apache-2.0

config SOC_THEJAS32
	select RISCV
	select INCLUDE_RESET_VECTOR
	select RISCV_SOC_INTERRUPT_INIT
	select ATOMIC_OPERATIONS_C
	help
	  Enable support for the C-DAC THEJAS32 SoC.

	  THEJAS32 is built around the VEGA ET1031, a 32-bit (RV32IM) single-core,
	  in-order, 3-stage pipeline RISC-V processor designed by C-DAC as part of
	  India's Digital India RISC-V (DIR-V) programme. The image is loaded into
	  and executed from internal SRAM, so execute-in-place (XIP) is not used.

	  The SoC follows the RISC-V privileged specification for trap handling but
	  uses a custom (non-PLIC) interrupt controller, so it provides its own
	  interrupt management instead of selecting RISCV_PRIVILEGED.
```

## soc/cdac/thejas32/Kconfig.soc
```kconfig
# Copyright (c) 2026 Anuj Deshpande
# SPDX-License-Identifier: Apache-2.0

config SOC_THEJAS32
	bool
	select SOC_FAMILY_CDAC
	help
	  C-DAC THEJAS32 SoC, based on the VEGA ET1031 32-bit RISC-V core.

config SOC
	default "thejas32" if SOC_THEJAS32
```
