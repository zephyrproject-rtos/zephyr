## soc/renesas/ra/ra4m1_arduino/Kconfig.soc
```kconfig
# Copyright (c) 2023 TOKITA Hiroshi <tokita.hiroshi@fujitsu.com>
# SPDX-License-Identifier: Apache-2.0

config SOC_SERIES_RA4M1_ARDUINO
	bool
	select SOC_FAMILY_RENESAS_RA
	help
	  Renesas RA4M1

config SOC_R7FA4M1AB3CFM
	bool
	select SOC_SERIES_RA4M1_ARDUINO
	help
	  R7FA4M1AB3CFM

config SOC_SERIES
	default "ra4m1_arduino" if SOC_SERIES_RA4M1_ARDUINO

config SOC
	default "r7fa4m1ab3cfm" if SOC_R7FA4M1AB3CFM
```

## soc/renesas/ra/ra4m2/Kconfig
```kconfig
# Copyright (c) 2024 Renesas Electronics Corporation
# SPDX-License-Identifier: Apache-2.0

config SOC_SERIES_RA4M2
	select ARM
	select CPU_HAS_ARM_MPU
	select CPU_CORTEX_M33
	select HAS_RENESAS_RA_FSP
	select CPU_CORTEX_M_HAS_DWT
	select CLOCK_CONTROL_RENESAS_RA_CGC if CLOCK_CONTROL
	select ARMV8_M_DSP
	select CPU_HAS_FPU
	select FPU
	select HAS_SWO
	select XIP
	select SOC_EARLY_INIT_HOOK
	select GPIO_RA_HAS_VBTICTLR

if SOC_SERIES_RA4M2

config RENESAS_PN_PACKAGE_TYPE
	int
	range 1 4
	default 3 if SOC_R7FA4M2AD3CFP
	help
	  Package type:
	  1 -> FL: LQFP 48 pins
	  2 -> FM: LQFP 64 pins
	  3 -> FP: LQFP 100 pins
	  4 -> NE: QFN 48 pins

endif # SOC_SERIES_RA4M2
```

## soc/renesas/ra/ra4m2/Kconfig.defconfig
```kconfig
# Copyright (c) 2024 Renesas Electronics Corporation
# SPDX-License-Identifier: Apache-2.0

if SOC_SERIES_RA4M2

config NUM_IRQS
	default 96

endif # SOC_SERIES_RA4M2
```

## soc/renesas/ra/ra4m2/Kconfig.soc
```kconfig
# Copyright (c) 2024 Renesas Electronics Corporation
# SPDX-License-Identifier: Apache-2.0

config SOC_SERIES_RA4M2
	bool
	select SOC_FAMILY_RENESAS_RA
	help
	  Renesas RA4M2 series

config SOC_R7FA4M2AD3CFP
	bool
	select SOC_SERIES_RA4M2
	help
	  R7FA4M2AD3CFP

config SOC_SERIES
	default "ra4m2" if SOC_SERIES_RA4M2

config SOC
	default "r7fa4m2ad3cfp" if SOC_R7FA4M2AD3CFP
```

## soc/renesas/ra/ra4m3/Kconfig
```kconfig
# Copyright (c) 2024 Renesas Electronics Corporation
# SPDX-License-Identifier: Apache-2.0

config SOC_SERIES_RA4M3
	select ARM
	select CPU_HAS_ARM_MPU
	select CPU_CORTEX_M33
	select HAS_RENESAS_RA_FSP
	select CLOCK_CONTROL_RENESAS_RA_CGC if CLOCK_CONTROL
	select CPU_CORTEX_M_HAS_DWT
	select ARMV8_M_DSP
	select CPU_HAS_FPU
	select FPU
	select HAS_SWO
	select XIP
	select SOC_EARLY_INIT_HOOK
	select GPIO_RA_HAS_VBTICTLR

if SOC_SERIES_RA4M3

config RENESAS_PN_PACKAGE_TYPE
	int
	range 1 5
	default 3 if SOC_R7FA4M3AF3CFB
	help
	  Package type:
	  1 -> BM: FBGA 144 pins
	  2 -> BQ: FBGA 64 pins
	  3 -> FB: LQFP 144 pins
	  4 -> FM: LQFP 64 pins
	  5 -> FP: LQFP 100 pins

endif # SOC_SERIES_RA4M3
```

## soc/renesas/ra/ra4m3/Kconfig.defconfig
```kconfig
# Copyright (c) 2024 Piotr Rak
# SPDX-License-Identifier: Apache-2.0

if SOC_SERIES_RA4M3

# Ref: Renesas RA4M3 Group: UM: Hardware (R01UH0893EJ0140 Rev.1.40)
#  - 13.1 Interrupt Controller Unit (ICU) - Overview
#    - Table 13.1 ICU - Interrupt sources for NVIC (96)
config NUM_IRQS
	default 96

endif # SOC_SERIES_RA4M3
```

## soc/renesas/ra/ra4m3/Kconfig.soc
```kconfig
# Copyright (c) 2024 Renesas Electronics Corporation
# SPDX-License-Identifier: Apache-2.0

config SOC_SERIES_RA4M3
	bool
	select SOC_FAMILY_RENESAS_RA
	help
	  Renesas RA4M3 series

config SOC_R7FA4M3AF3CFB
	bool
	select SOC_SERIES_RA4M3
	help
	  R7FA4M3AF3CFB

config SOC_SERIES
	default "ra4m3" if SOC_SERIES_RA4M3

config SOC
	default "r7fa4m3af3cfb" if SOC_R7FA4M3AF3CFB
```

## soc/renesas/ra/ra4t1/Kconfig
```kconfig
# Copyright (c) 2025 Renesas Electronics Corporation
# SPDX-License-Identifier: Apache-2.0

config SOC_SERIES_RA4T1
	select ARM
	select CPU_HAS_ARM_MPU
	select CPU_CORTEX_M33
	select HAS_RENESAS_RA_FSP
	select CLOCK_CONTROL_RENESAS_RA_CGC if CLOCK_CONTROL
	select CPU_CORTEX_M_HAS_DWT
	select ARMV8_M_DSP
	select CPU_HAS_FPU
	select FPU
	select XIP

if SOC_SERIES_RA4T1

config RENESAS_PN_PACKAGE_TYPE
	int
	range 1 5
	default 1 if SOC_R7FA4T1BB3CFM || SOC_R7FA4T1B93CFM
	default 2 if SOC_R7FA4T1BB3CFL || SOC_R7FA4T1B93CFL
	default 3 if SOC_R7FA4T1BB3CFJ || SOC_R7FA4T1B93CFJ
	default 4 if SOC_R7FA4T1BB3CNE || SOC_R7FA4T1B93CNE
	default 5 if SOC_R7FA4T1BB3CNH || SOC_R7FA4T1B93CNH
	help
	  Package type:
	  1 -> FM: LQFP 64 pins
	  2 -> FL: LQFP 48 pins
	  3 -> FJ: LQFP 32 pins
	  4 -> NE: QFN 48 pins
	  5 -> NH: QFN 32 pins

endif # SOC_SERIES_RA4T1
```

## soc/renesas/ra/ra4t1/Kconfig.soc
```kconfig
# Copyright (c) 2025 Renesas Electronics Corporation
# SPDX-License-Identifier: Apache-2.0

config SOC_SERIES_RA4T1
	bool
	select SOC_FAMILY_RENESAS_RA
	help
	  Renesas RA4T1 series

config SOC_R7FA4T1BB3CFM
	bool
	select SOC_SERIES_RA4T1

config SOC_R7FA4T1BB3CFL
	bool
	select SOC_SERIES_RA4T1

config SOC_R7FA4T1BB3CFJ
	bool
	select SOC_SERIES_RA4T1

config SOC_R7FA4T1BB3CNE
	bool
	select SOC_SERIES_RA4T1

config SOC_R7FA4T1BB3CNH
	bool
	select SOC_SERIES_RA4T1

config SOC_R7FA4T1B93CFM
	bool
	select SOC_SERIES_RA4T1

config SOC_R7FA4T1B93CFL
	bool
	select SOC_SERIES_RA4T1

config SOC_R7FA4T1B93CFJ
	bool
	select SOC_SERIES_RA4T1

config SOC_R7FA4T1B93CNE
	bool
	select SOC_SERIES_RA4T1

config SOC_R7FA4T1B93CNH
	bool
	select SOC_SERIES_RA4T1

config SOC_SERIES
	default "ra4t1" if SOC_SERIES_RA4T1

config SOC
	default "r7fa4t1bb3cfm" if SOC_R7FA4T1BB3CFM
	default "r7fa4t1bb3cfl" if SOC_R7FA4T1BB3CFL
	default "r7fa4t1bb3cfj" if SOC_R7FA4T1BB3CFJ
	default "r7fa4t1bb3cne" if SOC_R7FA4T1BB3CNE
	default "r7fa4t1bb3cnh" if SOC_R7FA4T1BB3CNH
	default "r7fa4t1b93cfm" if SOC_R7FA4T1B93CFM
	default "r7fa4t1b93cfl" if SOC_R7FA4T1B93CFL
	default "r7fa4t1b93cfj" if SOC_R7FA4T1B93CFJ
	default "r7fa4t1b93cne" if SOC_R7FA4T1B93CNE
	default "r7fa4t1b93cnh" if SOC_R7FA4T1B93CNH
```

## soc/renesas/ra/ra4w1/Kconfig.defconfig
```kconfig
# Copyright (c) 2024 Renesas Electronics Corporation
# SPDX-License-Identifier: Apache-2.0

if SOC_SERIES_RA4W1

config NUM_IRQS
	default 32

config PINCTRL
	default y

endif # SOC_SERIES_RA4W1
```

## soc/renesas/ra/ra4w1/Kconfig.soc
```kconfig
# Copyright (c) 2024 Renesas Electronics Corporation
# SPDX-License-Identifier: Apache-2.0

config SOC_SERIES_RA4W1
	bool
	select SOC_FAMILY_RENESAS_RA
	help
	  Renesas RA4W1 series

config SOC_R7FA4W1AD2CNG
	bool
	select SOC_SERIES_RA4W1
	help
	  R7FA4W1AD2CNG

config SOC_SERIES
	default "ra4w1" if SOC_SERIES_RA4W1

config SOC
	default "r7fa4w1ad2cng" if SOC_R7FA4W1AD2CNG
```

## soc/renesas/ra/ra6e1/Kconfig.soc
```kconfig
# Copyright (c) 2024 Renesas Electronics Corporation
# SPDX-License-Identifier: Apache-2.0

config SOC_SERIES_RA6E1
	bool
	select SOC_FAMILY_RENESAS_RA
	help
	  Renesas RA6E1 series

config SOC_R7FA6E10F2CFP
	bool
	select SOC_SERIES_RA6E1
	help
	  R7FA6E10F2CFP

config SOC_SERIES
	default "ra6e1" if SOC_SERIES_RA6E1

config SOC
	default "r7fa6e10f2cfp" if SOC_R7FA6E10F2CFP
```

## soc/renesas/ra/ra6e2/Kconfig.soc
```kconfig
# Copyright (c) 2024 Renesas Electronics Corporation
# SPDX-License-Identifier: Apache-2.0

config SOC_SERIES_RA6E2
	bool
	select SOC_FAMILY_RENESAS_RA
	help
	  Renesas RA6E2 series

config SOC_R7FA6E2BB3CFM
	bool
	select SOC_SERIES_RA6E2
	help
	  R7FA6E2BB3CFM

config SOC_SERIES
	default "ra6e2" if SOC_SERIES_RA6E2

config SOC
	default "r7fa6e2bb3cfm" if SOC_R7FA6E2BB3CFM
```

## soc/renesas/ra/ra6m1/Kconfig
```kconfig
# Copyright (c) 2024 Renesas Electronics Corporation
# SPDX-License-Identifier: Apache-2.0

config SOC_SERIES_RA6M1
	select ARM
	select CPU_CORTEX_M4
	select CPU_HAS_ARM_MPU
	select HAS_RENESAS_RA_FSP
	select CLOCK_CONTROL_RENESAS_RA_CGC if CLOCK_CONTROL
	select CPU_CORTEX_M_HAS_DWT
	select CPU_HAS_FPU
	select FPU
	select HAS_SWO
	select XIP
	select SOC_EARLY_INIT_HOOK
	select GPIO_RA_HAS_VBTICTLR

if SOC_SERIES_RA6M1

config RENESAS_PN_PACKAGE_TYPE
	int
	range 1 4
	default 1 if SOC_R7FA6M1AD3CFP
	help
	  Package type:
	  1 -> FP: LQFP 100 pins
	  2 -> FM: LQFP 64 pins
	  3 -> LJ: LGA 100 pins
	  4 -> NB: QFN 64 pins

endif # SOC_SERIES_RA6M1
```

## soc/renesas/ra/ra6m1/Kconfig.defconfig
```kconfig
# Copyright (c) 2024 Renesas Electronics Corporation
# SPDX-License-Identifier: Apache-2.0

if SOC_SERIES_RA6M1

config NUM_IRQS
	default 96

config PINCTRL
	default y

endif # SOC_SERIES_RA6M1
```

## soc/renesas/ra/ra6m1/Kconfig.soc
```kconfig
# Copyright (c) 2024 Renesas Electronics Corporation
# SPDX-License-Identifier: Apache-2.0

config SOC_SERIES_RA6M1
	bool
	select SOC_FAMILY_RENESAS_RA
	help
	  Renesas RA6M1 series

config SOC_R7FA6M1AD3CFP
	bool
	select SOC_SERIES_RA6M1
	help
	  R7FA6M1AD3CFP

config SOC_SERIES
	default "ra6m1" if SOC_SERIES_RA6M1

config SOC
	default "r7fa6m1ad3cfp" if SOC_R7FA6M1AD3CFP
```

## soc/renesas/ra/ra6m2/Kconfig
```kconfig
# Copyright (c) 2024 Renesas Electronics Corporation
# SPDX-License-Identifier: Apache-2.0

config SOC_SERIES_RA6M2
	select ARM
	select CPU_CORTEX_M4
	select CPU_HAS_ARM_MPU
	select HAS_RENESAS_RA_FSP
	select CLOCK_CONTROL_RENESAS_RA_CGC if CLOCK_CONTROL
	select CPU_CORTEX_M_HAS_DWT
	select CPU_HAS_FPU
	select FPU
	select HAS_SWO
	select XIP
	select SOC_EARLY_INIT_HOOK
	select GPIO_RA_HAS_VBTICTLR

if SOC_SERIES_RA6M2

config RENESAS_PN_PACKAGE_TYPE
	int
	range 1 3
	default 1 if SOC_R7FA6M2AF3CFB
	help
	  Package type:
	  1 -> FB: LQFP 144 pins
	  2 -> FP: LQFP 100 pins
	  3 -> LK: LGA 145 pins

endif # SOC_SERIES_RA6M2
```

## soc/renesas/ra/ra6m2/Kconfig.defconfig
```kconfig
# Copyright (c) 2024 Renesas Electronics Corporation
# SPDX-License-Identifier: Apache-2.0

if SOC_SERIES_RA6M2

config NUM_IRQS
	default 96

# Set to the minimal size of data which can be written.
config FLASH_FILL_BUFFER_SIZE
	default 128

endif # SOC_SERIES_RA6M2
```

## soc/renesas/ra/ra6m2/Kconfig.soc
```kconfig
# Copyright (c) 2024 Renesas Electronics Corporation
# SPDX-License-Identifier: Apache-2.0

config SOC_SERIES_RA6M2
	bool
	select SOC_FAMILY_RENESAS_RA
	help
	  Renesas RA6M2 series

config SOC_R7FA6M2AF3CFB
	bool
	select SOC_SERIES_RA6M2
	help
	  R7FA6M2AF3CFB

config SOC_SERIES
	default "ra6m2" if SOC_SERIES_RA6M2

config SOC
	default "r7fa6m2af3cfb" if SOC_R7FA6M2AF3CFB
```

## soc/renesas/ra/ra6m3/Kconfig
```kconfig
# Copyright (c) 2024 Renesas Electronics Corporation
# SPDX-License-Identifier: Apache-2.0

config SOC_SERIES_RA6M3
	select ARM
	select CPU_CORTEX_M4
	select CPU_HAS_ARM_MPU
	select HAS_RENESAS_RA_FSP
	select CLOCK_CONTROL_RENESAS_RA_CGC if CLOCK_CONTROL
	select CPU_CORTEX_M_HAS_DWT
	select CPU_HAS_FPU
	select FPU
	select HAS_SWO
	select XIP
	select SOC_EARLY_INIT_HOOK
	select GPIO_RA_HAS_VBTICTLR

if SOC_SERIES_RA6M3

config RENESAS_PN_PACKAGE_TYPE
	int
	range 1 5
	default 2 if SOC_R7FA6M3AH3CFC
	help
	  Package type:
	  1 -> BG: BGA 176 pins
	  2 -> FC: LQFP 176 pins
	  3 -> FB: LQFP 144 pins
	  4 -> FP: LQFP 100 pins
	  5 -> LK: LGA 145 pins

endif # SOC_SERIES_RA6M3
```

## soc/renesas/ra/ra6m3/Kconfig.soc
```kconfig
# Copyright (c) 2024 Renesas Electronics Corporation
# SPDX-License-Identifier: Apache-2.0

config SOC_SERIES_RA6M3
	bool
	select SOC_FAMILY_RENESAS_RA
	help
	  Renesas RA6M3 series

config SOC_R7FA6M3AH3CFC
	bool
	select SOC_SERIES_RA6M3
	help
	  R7FA6M3AH3CFC

config SOC_SERIES
	default "ra6m3" if SOC_SERIES_RA6M3

config SOC
	default "r7fa6m3ah3cfc" if SOC_R7FA6M3AH3CFC
```

## soc/renesas/ra/ra6m4/Kconfig
```kconfig
# Copyright (c) 2024 Renesas Electronics Corporation
# SPDX-License-Identifier: Apache-2.0

config SOC_SERIES_RA6M4
	select ARM
	select CPU_CORTEX_M33
	select CPU_HAS_ARM_MPU
	select CPU_HAS_RENESAS_RA_IDAU
	select HAS_RENESAS_RA_FSP
	select CLOCK_CONTROL_RENESAS_RA_CGC if CLOCK_CONTROL
	select CPU_CORTEX_M_HAS_DWT
	select CPU_HAS_FPU
	select ARMV8_M_DSP
	select FPU
	select HAS_SWO
	select XIP
	select GPIO_RA_HAS_VBTICTLR
	select OUTPUT_RPD if ETH_RENESAS_RA

if SOC_SERIES_RA6M4

config RENESAS_PN_PACKAGE_TYPE
	int
	range 1 5
	default 3 if SOC_R7FA6M4AF3CFB
	help
	  Package type:
	  1 -> BM: FBGA 144 pins
	  2 -> BQ: FBGA 64 pins
	  3 -> FB: LQFP 144 pins
	  4 -> FM: LQFP 64 pins
	  5 -> FP: LQFP 100 pins

endif # SOC_SERIES_RA6M4
```

## soc/renesas/ra/ra6m4/Kconfig.soc
```kconfig
# Copyright (c) 2024 Renesas Electronics Corporation
# SPDX-License-Identifier: Apache-2.0

config SOC_SERIES_RA6M4
	bool
	select SOC_FAMILY_RENESAS_RA
	help
	  Renesas RA6M4 series

config SOC_R7FA6M4AF3CFB
	bool
	select SOC_SERIES_RA6M4
	help
	  R7FA6M4AF3CFB

config SOC_SERIES
	default "ra6m4" if SOC_SERIES_RA6M4

config SOC
	default "r7fa6m4af3cfb" if SOC_R7FA6M4AF3CFB
```

## soc/renesas/ra/ra6m5/Kconfig
```kconfig
# Copyright (c) 2024 Renesas Electronics Corporation
# SPDX-License-Identifier: Apache-2.0

config SOC_SERIES_RA6M5
	select ARM
	select CPU_CORTEX_M33
	select CPU_HAS_ARM_MPU
	select CPU_HAS_RENESAS_RA_IDAU
	select HAS_RENESAS_RA_FSP
	select CLOCK_CONTROL_RENESAS_RA_CGC if CLOCK_CONTROL
	select CPU_CORTEX_M_HAS_DWT
	select CPU_HAS_FPU
	select ARMV8_M_DSP
	select FPU
	select HAS_SWO
	select XIP
	select GPIO_RA_HAS_VBTICTLR
	select OUTPUT_RPD if ETH_RENESAS_RA

if SOC_SERIES_RA6M5

config RENESAS_PN_PACKAGE_TYPE
	int
	range 1 5
	default 4 if SOC_R7FA6M5BH3CFC
	help
	  Package type:
	  1 -> BG: FBGA 176 pins
	  2 -> BM: FBGA 144 pins
	  3 -> FB: LQFP 144 pins
	  4 -> FC: LQFP 176 pins
	  5 -> FP: LQFP 100 pins

config RENESAS_PN_FEATURE_SET
	hex
	default 0x42 if SOC_R7FA6M5BH3CFC
	help
	  Feature set (Convert the feature set character into its ASCII hex value):
	  - A (0x41): Supporting only Classical CAN (Not supporting Flexible Data rate)
	  - B (0x42): Supporting Classical CAN with Flexible Data rate

endif # SOC_SERIES_RA6M5
```

## soc/renesas/ra/ra6m5/Kconfig.defconfig
```kconfig
# Copyright (c) 2024 Renesas Electronics Corporation
# SPDX-License-Identifier: Apache-2.0

if SOC_SERIES_RA6M5

config NUM_IRQS
	default 96

DT_ICLK_PATH := $(dt_nodelabel_path,iclk)

config SYS_CLOCK_HW_CYCLES_PER_SEC
	default $(dt_node_int_prop_int,$(DT_ICLK_PATH),clock-frequency)

config BUILD_OUTPUT_HEX
	default y

config CLOCK_CONTROL
	default y

# Set to the minimal size of data which can be written.
config FLASH_FILL_BUFFER_SIZE
	default 128

endif # SOC_SERIES_RA6M5
```
