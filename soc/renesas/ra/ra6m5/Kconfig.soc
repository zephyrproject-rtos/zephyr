## soc/renesas/ra/ra6m5/Kconfig.soc
```kconfig
# Copyright (c) 2024 Renesas Electronics Corporation
# SPDX-License-Identifier: Apache-2.0

config SOC_SERIES_RA6M5
	bool
	select SOC_FAMILY_RENESAS_RA
	help
	  Renesas RA6M5 series

config SOC_R7FA6M5BH3CFC
	bool
	select SOC_SERIES_RA6M5
	help
	  R7FA6M5BH3CFC

config SOC_SERIES
	default "ra6m5" if SOC_SERIES_RA6M5

config SOC
	default "r7fa6m5bh3cfc" if SOC_R7FA6M5BH3CFC
```

## soc/renesas/ra/ra8d1/Kconfig
```kconfig
# Copyright (c) 2024 Renesas Electronics Corporation
# SPDX-License-Identifier: Apache-2.0

config SOC_SERIES_RA8D1
	select ARM
	select CPU_CORTEX_M85
	select CPU_HAS_ARM_MPU
	select CPU_HAS_FPU
	select CPU_HAS_ARM_SAU
	select ARMV8_M_DSP
	select FPU
	select HAS_SWO
	select XIP
	select CLOCK_CONTROL_RENESAS_RA_CGC if CLOCK_CONTROL
	select HAS_RENESAS_RA_FSP
	select SOC_EARLY_INIT_HOOK
	select GPIO_RA_HAS_VBTICTLR
	select HAS_PM

if SOC_SERIES_RA8D1

config RENESAS_PN_PACKAGE_TYPE
	int
	range 1 2
	default 1 if SOC_R7FA8D1BHECBD
	help
	  Package type:
	  1 -> BD: FBGA 224 pins
	  2 -> FC: LQFP 176 pins

config RENESAS_PN_FEATURE_SET
	hex
	default 0x42 if SOC_R7FA8D1BHECBD
	help
	  Feature set (Convert the feature set character into its ASCII hex value):
	  - A (0x41): MIPI DSI is not available
	  - B (0x42): MIPI DSI is available

endif # SOC_SERIES_RA8D1
```

## soc/renesas/ra/ra8d1/Kconfig.defconfig
```kconfig
# Copyright (c) 2024 Renesas Electronics Corporation
# SPDX-License-Identifier: Apache-2.0

if SOC_SERIES_RA8D1

config NUM_IRQS
	default 96

config PINCTRL
	default y

config SYS_CLOCK_TICKS_PER_SEC
	default 4096 if ULPT_RENESAS_RA

config CORTEX_M_SYSTICK
	default n if ULPT_RENESAS_RA

endif # SOC_SERIES_RA8D1
```

## soc/renesas/ra/ra8d1/Kconfig.soc
```kconfig
# Copyright (c) 2024 Renesas Electronics Corporation
# SPDX-License-Identifier: Apache-2.0


config SOC_SERIES_RA8D1
	bool
	select SOC_FAMILY_RENESAS_RA
	help
	  Renesas RA8D1 series

config SOC_SERIES
	default "ra8d1" if SOC_SERIES_RA8D1

config SOC_R7FA8D1BHECBD
	bool
	select SOC_SERIES_RA8D1
	help
	  R7FA8D1BHECBD

config SOC
	default "r7fa8d1bhecbd" if SOC_R7FA8D1BHECBD
```

## soc/renesas/ra/ra8d2/Kconfig.soc
```kconfig
# Copyright (c) 2025 Renesas Electronics Corporation
# SPDX-License-Identifier: Apache-2.0

config SOC_SERIES_RA8D2
	bool
	select SOC_FAMILY_RENESAS_RA
	help
	  Renesas RA8D2 series

config SOC_R7KA8D2KFLCAC
	bool
	select SOC_SERIES_RA8D2
	help
	  R7KA8D2KFLCAC

config SOC_R7KA8D2KFLCAC_CM85
	bool
	select SOC_R7KA8D2KFLCAC

config SOC_R7KA8D2KFLCAC_CM33
	bool
	select SOC_R7KA8D2KFLCAC

config SOC_SERIES
	default "ra8d2" if SOC_SERIES_RA8D2

config SOC
	default "r7ka8d2kflcac" if SOC_R7KA8D2KFLCAC
```

## soc/renesas/ra/ra8e1/Kconfig
```kconfig
# Copyright (c) 2026 Renesas Electronics Corporation
# SPDX-License-Identifier: Apache-2.0

config SOC_SERIES_RA8E1
	select ARM
	select CPU_CORTEX_M85
	select CPU_HAS_ARM_MPU
	select CPU_HAS_FPU
	select CPU_HAS_ARM_SAU
	select ARMV8_M_DSP
	select FPU
	select HAS_SWO
	select XIP
	select CLOCK_CONTROL_RENESAS_RA_CGC if CLOCK_CONTROL
	select HAS_RENESAS_RA_FSP
	select CPU_CORTEX_M_HAS_DWT
	select GPIO_RA_HAS_VBTICTLR
	select HAS_PM

if SOC_SERIES_RA8E1

config RENESAS_PN_PACKAGE_TYPE
	int
	range 1 2
	default 1 if SOC_R7FA8E1AFDCFB
	help
	  Package type:
	  1 -> FB: LQFP 144 pins
	  2 -> FP: LQFP 100 pins

endif # SOC_SERIES_RA8E1
```

## soc/renesas/ra/ra8e1/Kconfig.soc
```kconfig
# Copyright (c) 2026 Renesas Electronics Corporation
# SPDX-License-Identifier: Apache-2.0

config SOC_SERIES_RA8E1
	bool
	select SOC_FAMILY_RENESAS_RA
	help
	  Renesas RA8E1 series

config SOC_R7FA8E1AFDCFB
	bool
	select SOC_SERIES_RA8E1
	help
	  R7FA8E1AFDCFB

config SOC_R7FA8E1AFDCFP
	bool
	select SOC_SERIES_RA8E1
	help
	  R7FA8E1AFDCFP

config SOC_SERIES
	default "ra8e1" if SOC_SERIES_RA8E1

config SOC
	default "r7fa8e1afdcfb" if SOC_R7FA8E1AFDCFB
	default "r7fa8e1afdcfp" if SOC_R7FA8E1AFDCFP
```

## soc/renesas/ra/ra8m1/Kconfig
```kconfig
# Copyright (c) 2024 Renesas Electronics Corporation
# SPDX-License-Identifier: Apache-2.0

config SOC_SERIES_RA8M1
	select ARM
	select CPU_CORTEX_M85
	select CPU_HAS_ARM_MPU
	select CPU_HAS_FPU
	select CPU_HAS_ARM_SAU
	select ARMV8_M_DSP
	select FPU
	select HAS_SWO
	select XIP
	select CLOCK_CONTROL_RENESAS_RA_CGC if CLOCK_CONTROL
	select HAS_RENESAS_RA_FSP
	select GPIO_RA_HAS_VBTICTLR
	select HAS_PM
	help
	  Enable support for Renesas RA8M1 MCU series

if SOC_SERIES_RA8M1

config RENESAS_PN_PACKAGE_TYPE
	int
	range 1 4
	default 1 if SOC_R7FA8M1AHECBD
	help
	  Package type:
	  1 -> BD: FBGA 224 pins
	  2 -> FC: LQFP 176 pins
	  3 -> FB: LQFP 144 pins
	  4 -> FP: LQFP 100 pins

endif # SOC_SERIES_RA8M1
```

## soc/renesas/ra/ra8m1/Kconfig.defconfig
```kconfig
# Copyright (c) 2024 Renesas Electronics Corporation
# SPDX-License-Identifier: Apache-2.0

if SOC_SERIES_RA8M1

config NUM_IRQS
	default 96

config PINCTRL
	default y

# Set to the minimal size of data which can be written.
config FLASH_FILL_BUFFER_SIZE
	default 128

endif # SOC_SERIES_RA8M1
```

## soc/renesas/ra/ra8m1/Kconfig.soc
```kconfig
# Copyright (c) 2024 Renesas Electronics Corporation
# SPDX-License-Identifier: Apache-2.0


config SOC_SERIES_RA8M1
	bool
	select SOC_FAMILY_RENESAS_RA
	help
	  Renesas RA8M1 series

config SOC_R7FA8M1AHECBD
	bool
	select SOC_SERIES_RA8M1
	help
	  R7FA8M1AHECBD

config SOC_SERIES
	default "ra8m1" if SOC_SERIES_RA8M1

config SOC
	default "r7fa8m1ahecbd" if SOC_R7FA8M1AHECBD
```

## soc/renesas/ra/ra8m2/Kconfig
```kconfig
# Copyright (c) 2025 Renesas Electronics Corporation
# SPDX-License-Identifier: Apache-2.0

config SOC_SERIES_RA8M2
	select ARM
	select CPU_HAS_ARM_SAU
	select CPU_HAS_ARM_MPU
	select CPU_HAS_FPU
	select FPU
	select CPU_CORTEX_M_HAS_DWT
	select ARMV8_M_DSP
	select HAS_SWO
	select XIP
	select CLOCK_CONTROL_RENESAS_RA_CGC if CLOCK_CONTROL
	select HAS_RENESAS_RA_FSP
	select HAS_PM

config SOC_R7KA8M2JFLCAC_CM85
	select CPU_CORTEX_M85
	select GPIO_RA_HAS_VBTICTLR

config SOC_R7KA8M2JFLCAC_CM33
	select CPU_CORTEX_M33
	select SOC_RA_SECOND_CORE_BUILD

if SOC_SERIES_RA8M2

config RENESAS_PN_ROM_SIZE
	hex
	default 0x100000 if SOC_R7KA8M2JFLCAC
	help
	  Code MRAM and Flash size

config RENESAS_PN_PACKAGE_TYPE
	int
	range 1 4
	default 2 if SOC_R7KA8M2JFLCAC
	help
	  Package type:
	  1 -> AB: LFBGA 224 pins
	  2 -> AC: LFBGA 289 pins
	  3 -> AJ: LFBGA 303 pins
	  4 -> HC: HLQFP 176 pins

config RENESAS_PN_FEATURE_SET
	hex
	default 0x4a if SOC_R7KA8M2JFLCAC
	help
	  Feature set (Convert the feature set character into its ASCII hex value):
	  - A (0x41): Single Core (CM85 only)
	  - J (0x4a): Dual Core

config RENESAS_PN_NUMBER_OF_CORES
	int
	range 1 2
	default 2 if SOC_R7KA8M2JFLCAC
	help
	  Number of SoC cores

endif # SOC_SERIES_RA8M2
```

## soc/renesas/ra/ra8m2/Kconfig.defconfig
```kconfig
# Copyright (c) 2025 Renesas Electronics Corporation
# SPDX-License-Identifier: Apache-2.0

if SOC_SERIES_RA8M2

config NUM_IRQS
	default 96

DT_CPUCLK0_PATH := $(dt_nodelabel_path,cpuclk0)
DT_CPUCLK1_PATH := $(dt_nodelabel_path,cpuclk1)

config SYS_CLOCK_HW_CYCLES_PER_SEC
	default $(dt_node_int_prop_int,$(DT_CPUCLK0_PATH),clock-frequency) if SOC_R7KA8M2JFLCAC_CM85
	default $(dt_node_int_prop_int,$(DT_CPUCLK1_PATH),clock-frequency) if SOC_R7KA8M2JFLCAC_CM33

config PM_STATS
	default n if PM

config BUILD_OUTPUT_HEX
	default y

config CLOCK_CONTROL
	default y

config DCACHE
	default n

config CACHE_MANAGEMENT
	default n

endif # SOC_SERIES_RA8M2
```

## soc/renesas/ra/ra8m2/Kconfig.soc
```kconfig
# Copyright (c) 2025 Renesas Electronics Corporation
# SPDX-License-Identifier: Apache-2.0

config SOC_SERIES_RA8M2
	bool
	select SOC_FAMILY_RENESAS_RA
	help
	  Renesas RA8M2 series

config SOC_R7KA8M2JFLCAC
	bool
	select SOC_SERIES_RA8M2
	help
	  R7KA8M2JFLCAC

config SOC_R7KA8M2JFLCAC_CM85
	bool
	select SOC_R7KA8M2JFLCAC

config SOC_R7KA8M2JFLCAC_CM33
	bool
	select SOC_R7KA8M2JFLCAC

config SOC_SERIES
	default "ra8m2" if SOC_SERIES_RA8M2

config SOC
	default "r7ka8m2jflcac" if SOC_R7KA8M2JFLCAC
```

## soc/renesas/ra/ra8p1/Kconfig
```kconfig
# Copyright (c) 2025 Renesas Electronics Corporation
# SPDX-License-Identifier: Apache-2.0

config SOC_SERIES_RA8P1
	select ARM
	select CPU_HAS_ARM_SAU
	select CPU_HAS_ARM_MPU
	select CPU_HAS_FPU
	select FPU
	select CPU_CORTEX_M_HAS_SYSTICK
	select CPU_CORTEX_M_HAS_DWT
	select ARMV8_M_DSP
	select HAS_SWO
	select XIP
	select CLOCK_CONTROL_RENESAS_RA_CGC if CLOCK_CONTROL
	select HAS_RENESAS_RA_FSP
	select SOC_EARLY_INIT_HOOK
	select HAS_PM

config SOC_R7KA8P1KFLCAC_CM85
	select CPU_CORTEX_M85
	select GPIO_RA_HAS_VBTICTLR

config SOC_R7KA8P1KFLCAC_CM33
	select CPU_CORTEX_M33
	select SOC_RA_SECOND_CORE_BUILD
```

## soc/renesas/ra/ra8p1/Kconfig.defconfig
```kconfig
# Copyright (c) 2025 Renesas Electronics Corporation
# SPDX-License-Identifier: Apache-2.0

if SOC_SERIES_RA8P1

config NUM_IRQS
	default 96

DT_CPUCLK0_PATH := $(dt_nodelabel_path,cpuclk0)
DT_CPUCLK1_PATH := $(dt_nodelabel_path,cpuclk1)

config SYS_CLOCK_HW_CYCLES_PER_SEC
	default $(dt_node_int_prop_int,$(DT_CPUCLK0_PATH),clock-frequency) if SOC_R7KA8P1KFLCAC_CM85
	default $(dt_node_int_prop_int,$(DT_CPUCLK1_PATH),clock-frequency) if SOC_R7KA8P1KFLCAC_CM33

config PM_STATS
	default n if PM

config BUILD_OUTPUT_HEX
	default y

config CLOCK_CONTROL
	default y

config DCACHE
	default n

config CACHE_MANAGEMENT
	default n

if ETHOS_U

choice ETHOS_U_NPU_CONFIG
	default ETHOS_U55_256
endchoice

endif # ETHOS_U

endif # SOC_SERIES_RA8P1
```

## soc/renesas/ra/ra8p1/Kconfig.soc
```kconfig
# Copyright (c) 2025 Renesas Electronics Corporation
# SPDX-License-Identifier: Apache-2.0

config SOC_SERIES_RA8P1
	bool
	select SOC_FAMILY_RENESAS_RA
	help
	  Renesas RA8P1 series

config SOC_R7KA8P1KFLCAC
	bool
	select SOC_SERIES_RA8P1
	help
	  R7KA8P1KFLCAC

config SOC_R7KA8P1KFLCAC_CM85
	bool
	select SOC_R7KA8P1KFLCAC

config SOC_R7KA8P1KFLCAC_CM33
	bool
	select SOC_R7KA8P1KFLCAC

config SOC_SERIES
	default "ra8p1" if SOC_SERIES_RA8P1

config SOC
	default "r7ka8p1kflcac" if SOC_R7KA8P1KFLCAC
```

## soc/renesas/ra/ra8p1/Kconfig.sysbuild
```kconfig
# Copyright (c) 2026 Renesas Electronics Corporation
# SPDX-License-Identifier: Apache-2.0

config HAS_RA_SECOND_CORE_LAUNCHER_IMAGE
	default y if SOC_R7KA8P1KFLCAC_CM33

config RA_SECOND_CORE_LAUNCHER_NAME
	default "cm85"
```

## soc/renesas/ra/ra8t1/Kconfig
```kconfig
# Copyright (c) 2024 Renesas Electronics Corporation
# SPDX-License-Identifier: Apache-2.0

config SOC_SERIES_RA8T1
	select ARM
	select CPU_CORTEX_M85
	select CPU_HAS_ARM_MPU
	select CPU_HAS_FPU
	select CPU_HAS_ARM_SAU
	select ARMV8_M_DSP
	select FPU
	select HAS_SWO
	select XIP
	select CLOCK_CONTROL_RENESAS_RA_CGC if CLOCK_CONTROL
	select HAS_RENESAS_RA_FSP
```

## soc/renesas/ra/ra8t1/Kconfig.defconfig
```kconfig
# Copyright (c) 2024 Renesas Electronics Corporation
# SPDX-License-Identifier: Apache-2.0

if SOC_SERIES_RA8T1

config NUM_IRQS
	default 96

config BUILD_OUTPUT_HEX
	default y

config CLOCK_CONTROL
	default y

# Set to the minimal size of data which can be written.
config FLASH_FILL_BUFFER_SIZE
	default 128

config CORTEX_M_SYSTICK
	default n if RENESAS_RA_ULPT_TIMER

DT_ICLK_PATH := $(dt_nodelabel_path,cpuclk)
DT_LOCO_PATH := $(dt_nodelabel_path,loco)

config SYS_CLOCK_HW_CYCLES_PER_SEC
	default $(dt_node_int_prop_int,$(DT_ICLK_PATH),clock-frequency) if CORTEX_M_SYSTICK
	default $(dt_node_int_prop_int,$(DT_LOCO_PATH),clock-frequency) if RENESAS_RA_ULPT_TIMER

config SYS_CLOCK_TICKS_PER_SEC
	default 4096 if RENESAS_RA_ULPT_TIMER

config PM_DEVICE
	default y if PM

endif # SOC_SERIES_RA8T1
```

## soc/renesas/ra/ra8t1/Kconfig.soc
```kconfig
# Copyright (c) 2024 Renesas Electronics Corporation
# SPDX-License-Identifier: Apache-2.0


config SOC_SERIES_RA8T1
	bool
	select SOC_FAMILY_RENESAS_RA
	help
	  Renesas RA8T1 series

config SOC_SERIES
	default "ra8t1" if SOC_SERIES_RA8T1

config SOC_R7FA8T1AHECBD
	bool
	select SOC_SERIES_RA8T1
	help
	  R7FA8T1AHECBD

config SOC
	default "r7fa8t1ahecbd" if SOC_R7FA8T1AHECBD
```

## soc/renesas/ra/ra8t2/Kconfig
```kconfig
# Copyright (c) 2025 Renesas Electronics Corporation
# SPDX-License-Identifier: Apache-2.0

config SOC_SERIES_RA8T2
	select ARM
	select CPU_HAS_ARM_SAU
	select CPU_HAS_ARM_MPU
	select CPU_HAS_FPU
	select FPU
	select CPU_CORTEX_M_HAS_DWT
	select ARMV8_M_DSP
	select HAS_SWO
	select XIP
	select CLOCK_CONTROL_RENESAS_RA_CGC if CLOCK_CONTROL
	select HAS_RENESAS_RA_FSP
	select SOC_EARLY_INIT_HOOK
	select HAS_PM

config SOC_R7KA8T2LFLCAC_CM85
	select CPU_CORTEX_M85
	select GPIO_RA_HAS_VBTICTLR

config SOC_R7KA8T2LFLCAC_CM33
	select CPU_CORTEX_M33
	select SOC_RA_SECOND_CORE_BUILD

if SOC_SERIES_RA8T2

config RENESAS_PN_ROM_SIZE
	hex
	default 0x100000 if SOC_R7KA8T2LFLCAC
	help
	  Code MRAM and Flash size

config RENESAS_PN_PACKAGE_TYPE
	int
	range 1 4
	default 2 if SOC_R7KA8T2LFLCAC
	help
	  Package type:
	  1 -> AB: LFBGA 224 pins
	  2 -> AC: LFBGA 289 pins
	  3 -> AJ: LFBGA 303 pins
	  4 -> HC: HLQFP 176 pins

config RENESAS_PN_FEATURE_SET
	hex
	default 0x4c if SOC_R7KA8T2LFLCAC
	help
	  Feature set (Convert the feature set character into its ASCII hex value):
	  - A (0x41): Single Core (CM85 only), EtherCAT slave controller is not available
	  - C (0x43): Single Core (CM85 only), EtherCAT slave controller is available
	  - L (0x4c): Dual Core, EtherCAT slave controller is available

config RENESAS_PN_NUMBER_OF_CORES
	int
	range 1 2
	default 2 if SOC_R7KA8T2LFLCAC
	help
	  Number of SoC cores

endif # SOC_SERIES_RA8T2
```

## soc/renesas/ra/ra8t2/Kconfig.defconfig
```kconfig
# Copyright (c) 2025 Renesas Electronics Corporation
# SPDX-License-Identifier: Apache-2.0

if SOC_SERIES_RA8T2

config NUM_IRQS
	default 96

DT_CPUCLK0_PATH := $(dt_nodelabel_path,cpuclk0)
DT_CPUCLK1_PATH := $(dt_nodelabel_path,cpuclk1)
DT_LOCO_PATH := $(dt_nodelabel_path,loco)

config SYS_CLOCK_HW_CYCLES_PER_SEC
	default $(dt_node_int_prop_int,$(DT_CPUCLK0_PATH),clock-frequency) if SOC_R7KA8T2LFECAC_CM85 && CORTEX_M_SYSTICK
	default $(dt_node_int_prop_int,$(DT_CPUCLK1_PATH),clock-frequency) if SOC_R7KA8T2LFECAC_CM33 && CORTEX_M_SYSTICK
	default $(dt_node_int_prop_int,$(DT_LOCO_PATH),clock-frequency) if RENESAS_RA_ULPT_TIMER

config CORTEX_M_SYSTICK
	default n if RENESAS_RA_ULPT_TIMER

config SYS_CLOCK_TICKS_PER_SEC
	default 4096 if RENESAS_RA_ULPT_TIMER

config PM_DEVICE
	default y if PM

config PM_STATS
	default n if PM

config BUILD_OUTPUT_HEX
	default y

config CLOCK_CONTROL
	default y

config DCACHE
	default n

config CACHE_MANAGEMENT
	default n

endif # SOC_SERIES_RA8T2
```

## soc/renesas/ra/ra8t2/Kconfig.soc
```kconfig
# Copyright (c) 2025 Renesas Electronics Corporation
# SPDX-License-Identifier: Apache-2.0

config SOC_SERIES_RA8T2
	bool
	select SOC_FAMILY_RENESAS_RA
	help
	  Renesas RA8T2 series

config SOC_R7KA8T2LFECAC
	bool
	select SOC_SERIES_RA8T2
	help
	  R7KA8T2LFECAC

config SOC_R7KA8T2LFECAC_CM85
	bool
	select SOC_R7KA8T2LFECAC

config SOC_R7KA8T2LFECAC_CM33
	bool
	select SOC_R7KA8T2LFECAC

config SOC_SERIES
	default "ra8t2" if SOC_SERIES_RA8T2

config SOC
	default "r7ka8t2lfecac" if SOC_R7KA8T2LFECAC
```

## soc/renesas/rcar/Kconfig
```kconfig
# Renesas R-Car SoC line
# Copyright (c) 2021 IoT.bzh
# SPDX-License-Identifier: Apache-2.0

if SOC_FAMILY_RENESAS_RCAR

rsource "*/Kconfig"

endif # SOC_FAMILY_RENESAS_RCAR
```

## soc/renesas/rcar/Kconfig.defconfig
```kconfig
# Copyright (c) 2021 IoT.bzh
# SPDX-License-Identifier: Apache-2.0

if SOC_FAMILY_RENESAS_RCAR

rsource "*/Kconfig.defconfig"

endif # SOC_FAMILY_RENESAS_RCAR
```
