## soc/renesas/ra/Kconfig.sysbuild
```kconfig
# Copyright (c) 2026 Renesas Electronics Corporation
# SPDX-License-Identifier: Apache-2.0

config RA_SECOND_CORE_LAUNCHER
	bool "Start second core launcher"
	default y
	depends on HAS_RA_SECOND_CORE_LAUNCHER_IMAGE
	help
	  Include a minimal launcher image built for the first core that
	  enables CONFIG_SOC_RA_ENABLE_START_SECOND_CORE so that the
	  startup image will start the second core.

config HAS_RA_SECOND_CORE_LAUNCHER_IMAGE
	bool

if RA_SECOND_CORE_LAUNCHER

config RA_SECOND_CORE_LAUNCHER_NAME
	string "Launcher core name"
	help
	  Specify the core name to use when building the launcher image.

endif # RA_SECOND_CORE_LAUNCHER

rsource "*/Kconfig.sysbuild"
```

## soc/renesas/ra/ra0e1/Kconfig
```kconfig
# Copyright (c) 2026 Renesas Electronics Corporation
# SPDX-License-Identifier: Apache-2.0

config SOC_SERIES_RA0E1
	select ARM
	select CPU_CORTEX_M23
	select CPU_CORTEX_M_HAS_VTOR
	select CPU_CORTEX_M_HAS_SYSTICK
	select XIP
	select HAS_RENESAS_RA_FSP
	select SOC_EARLY_INIT_HOOK

if SOC_SERIES_RA0E1

config RENESAS_PN_PACKAGE_TYPE
	int
	range 1 6
	default 1 if SOC_R7FA0E1073CFJ || SOC_R7FA0E1053CFJ
	default 2 if SOC_R7FA0E1073CNH || SOC_R7FA0E1053CNH
	default 3 if SOC_R7FA0E1073CNK || SOC_R7FA0E1053CNK
	default 4 if SOC_R7FA0E1073CSC || SOC_R7FA0E1053CSC
	default 5 if SOC_R7FA0E1073CSD
	default 6 if SOC_R7FA0E1073CNL || SOC_R7FA0E1053CNL
	help
	  Package type:
	  1 -> FJ: LQFP 32 pins
	  2 -> NH: HWQFN 32 pins
	  3 -> NK: HWQFN 24 pins
	  4 -> SC: LSSOP 20 pins
	  5 -> SD: TSSOP 20 pins
	  6 -> NL: HWQFN 16 pins

endif # SOC_SERIES_RA0E1
```

## soc/renesas/ra/ra0e1/Kconfig.soc
```kconfig
# Copyright (c) 2026 Renesas Electronics Corporation
# SPDX-License-Identifier: Apache-2.0

config SOC_SERIES_RA0E1
	bool
	select SOC_FAMILY_RENESAS_RA
	help
	  Renesas RA0E1 series

config SOC_R7FA0E1073CFJ
	bool
	select SOC_SERIES_RA0E1

config SOC_R7FA0E1073CNH
	bool
	select SOC_SERIES_RA0E1

config SOC_R7FA0E1073CNK
	bool
	select SOC_SERIES_RA0E1

config SOC_R7FA0E1073CSC
	bool
	select SOC_SERIES_RA0E1

config SOC_R7FA0E1073CSD
	bool
	select SOC_SERIES_RA0E1

config SOC_R7FA0E1073CNL
	bool
	select SOC_SERIES_RA0E1

config SOC_R7FA0E1053CFJ
	bool
	select SOC_SERIES_RA0E1

config SOC_R7FA0E1053CNH
	bool
	select SOC_SERIES_RA0E1

config SOC_R7FA0E1053CNK
	bool
	select SOC_SERIES_RA0E1

config SOC_R7FA0E1053CSC
	bool
	select SOC_SERIES_RA0E1

config SOC_R7FA0E1053CNL
	bool
	select SOC_SERIES_RA0E1

config SOC_SERIES
	default "ra0e1" if SOC_SERIES_RA0E1

config SOC
	default "r7fa0e1073cfj" if SOC_R7FA0E1073CFJ
	default "r7fa0e1073cnh" if SOC_R7FA0E1073CNH
	default "r7fa0e1073cnk" if SOC_R7FA0E1073CNK
	default "r7fa0e1073csc" if SOC_R7FA0E1073CSC
	default "r7fa0e1073csd" if SOC_R7FA0E1073CSD
	default "r7fa0e1073cnl" if SOC_R7FA0E1073CNL
	default "r7fa0e1053cfj" if SOC_R7FA0E1053CFJ
	default "r7fa0e1053cnh" if SOC_R7FA0E1053CNH
	default "r7fa0e1053cnk" if SOC_R7FA0E1053CNK
	default "r7fa0e1053csc" if SOC_R7FA0E1053CSC
	default "r7fa0e1053cnl" if SOC_R7FA0E1053CNL
```

## soc/renesas/ra/ra2/Kconfig
```kconfig
# Copyright (c) 2024 MUNIC SA
# SPDX-License-Identifier: Apache-2.0

config SOC_SERIES_RA2
	bool
	select ARM
	select CPU_CORTEX_M23
	select CPU_HAS_ARM_MPU
	select CPU_CORTEX_M_HAS_SYSTICK
	select HAS_PM
	select PLATFORM_SPECIFIC_INIT
	select CLOCK_CONTROL
	help
	  Enable support for Renesas RA2 MCU series
```

## soc/renesas/ra/ra2/Kconfig.defconfig
```kconfig
# Copyright (c) 2024 MUNIC SA
# SPDX-License-Identifier: Apache-2.0

if SOC_SERIES_RA2

config SOC_SERIES
	default "ra2"

config NUM_IRQS
	default 32

endif # SOC_SERIES_RA2
```

## soc/renesas/ra/ra2/Kconfig.soc
```kconfig
# Copyright (c) 2024 MUNIC SA
# SPDX-License-Identifier: Apache-2.0

config SOC_SERIES_RA2
	bool
	select SOC_FAMILY_RENESAS_RA
	help
	  Renesas RA2 series

config SOC_R7FA2L1A9
	bool
	select SOC_SERIES_RA2
	help
	  R7FA2L1A9

config SOC_R7FA2L1AB
	bool
	select SOC_SERIES_RA2
	help
	  R7FA2L1AB

config SOC_SERIES
	default "ra2" if SOC_SERIES_RA2

config SOC
	default "r7fa2l1a9" if SOC_R7FA2L1A9
	default "r7fa2l1ab" if SOC_R7FA2L1AB
```

## soc/renesas/ra/ra2a1/Kconfig
```kconfig
# Copyright (c) 2024 TOKITA Hiroshi
# SPDX-License-Identifier: Apache-2.0

config SOC_SERIES_RA2A1
	select ARM
	select CPU_CORTEX_M23
	select CPU_HAS_ARM_MPU
	select CPU_CORTEX_M_HAS_VTOR
	select CPU_CORTEX_M_HAS_SYSTICK
	select HAS_SWO
	select XIP
	select HAS_RENESAS_RA_FSP
	select SOC_EARLY_INIT_HOOK

if SOC_SERIES_RA2A1

config RENESAS_PN_PACKAGE_TYPE
	int
	range 1 5
	default 1 if SOC_R7FA2A1AB3CFM
	help
	  Package type:
	  1 -> FM: LQFP 64 pins
	  2 -> FJ: LQFP 32 pins
	  3 -> BT: BGA 36 pins
	  4 -> NE: QFN 48 pins
	  5 -> NF: QFN 40 pins

endif # SOC_SERIES_RA2A1
```

## soc/renesas/ra/ra2a1/Kconfig.defconfig
```kconfig
# Copyright (c) 2024 TOKITA Hiroshi
# SPDX-License-Identifier: Apache-2.0

if SOC_SERIES_RA2A1

config NUM_IRQS
	default 32

config PINCTRL
	default y

endif # SOC_SERIES_RA2A1
```

## soc/renesas/ra/ra2a1/Kconfig.soc
```kconfig
# Copyright (c) 2024 TOKITA Hiroshi
# SPDX-License-Identifier: Apache-2.0

config SOC_SERIES_RA2A1
	bool
	select SOC_FAMILY_RENESAS_RA
	help
	  Renesas RA2A1 series

config SOC_R7FA2A1AB3CFM
	bool
	select SOC_SERIES_RA2A1
	help
	  R7FA2A1AB3CFM

config SOC_SERIES
	default "ra2a1" if SOC_SERIES_RA2A1

config SOC
	default "r7fa2a1ab3cfm" if SOC_R7FA2A1AB3CFM
```

## soc/renesas/ra/ra2l1/Kconfig
```kconfig
# Copyright (c) 2024 MUNIC SA
# Copyright (c) 2024 Renesas Electronics Corporation
# SPDX-License-Identifier: Apache-2.0

config SOC_SERIES_RA2L1
	select ARM
	select CPU_CORTEX_M23
	select CPU_HAS_ARM_MPU
	select HAS_RENESAS_RA_FSP
	select CPU_CORTEX_M_HAS_VTOR
	select CPU_CORTEX_M_HAS_SYSTICK
	select CLOCK_CONTROL_RENESAS_RA_CGC if CLOCK_CONTROL
	select HAS_SWO

if SOC_SERIES_RA2L1

config RENESAS_PN_PACKAGE_TYPE
	int
	range 1 5
	default 1 if SOC_R7FA2L1ABXXFP || SOC_R7FA2L1A9XXFP
	default 2 if SOC_R7FA2L1ABXXFN || SOC_R7FA2L1A9XXFN
	default 3 if SOC_R7FA2L1ABXXFM || SOC_R7FA2L1A9XXFM
	default 4 if SOC_R7FA2L1ABXXFL || SOC_R7FA2L1A9XXFL
	default 5 if SOC_R7FA2L1ABXXNE || SOC_R7FA2L1A9XXNE
	help
	  Package type:
	  1 -> FP: LQFP 100 pins
	  2 -> FN: LQFP 80 pins
	  3 -> FM: LQFP 64 pins
	  4 -> FL: LQFP 48 pins
	  5 -> NE: HWQFN 48 pins

endif # SOC_SERIES_RA2L1
```

## soc/renesas/ra/ra2l1/Kconfig.defconfig
```kconfig
# Copyright (c) 2024 MUNIC SA
# SPDX-License-Identifier: Apache-2.0

if SOC_SERIES_RA2L1

config NUM_IRQS
	default 32

DT_ICLK_PATH := $(dt_nodelabel_path,iclk)

config SYS_CLOCK_HW_CYCLES_PER_SEC
	default $(dt_node_int_prop_int,$(DT_ICLK_PATH),clock-frequency)

config BUILD_OUTPUT_HEX
	default y

config CLOCK_CONTROL
	default y

endif # SOC_SERIES_RA2L1
```

## soc/renesas/ra/ra2l1/Kconfig.soc
```kconfig
# Copyright (c) 2024 MUNIC SA
# SPDX-License-Identifier: Apache-2.0

config SOC_SERIES_RA2L1
	bool
	select SOC_FAMILY_RENESAS_RA

config SOC_R7FA2L1A9XXFP
	bool
	select SOC_SERIES_RA2L1

config SOC_R7FA2L1A9XXFN
	bool
	select SOC_SERIES_RA2L1

config SOC_R7FA2L1A9XXFM
	bool
	select SOC_SERIES_RA2L1

config SOC_R7FA2L1A9XXFL
	bool
	select SOC_SERIES_RA2L1

config SOC_R7FA2L1A9XXNE
	bool
	select SOC_SERIES_RA2L1

config SOC_R7FA2L1ABXXFP
	bool
	select SOC_SERIES_RA2L1

config SOC_R7FA2L1ABXXFN
	bool
	select SOC_SERIES_RA2L1

config SOC_R7FA2L1ABXXFM
	bool
	select SOC_SERIES_RA2L1

config SOC_R7FA2L1ABXXFL
	bool
	select SOC_SERIES_RA2L1

config SOC_R7FA2L1ABXXNE
	bool
	select SOC_SERIES_RA2L1

config SOC_SERIES
	default "ra2l1" if SOC_SERIES_RA2L1

config SOC
	default "r7fa2l1a9xxfp" if SOC_R7FA2L1A9XXFP
	default "r7fa2l1a9xxfn" if SOC_R7FA2L1A9XXFN
	default "r7fa2l1a9xxfm" if SOC_R7FA2L1A9XXFM
	default "r7fa2l1a9xxfl" if SOC_R7FA2L1A9XXFL
	default "r7fa2l1a9xxne" if SOC_R7FA2L1A9XXNE
	default "r7fa2l1abxxfp" if SOC_R7FA2L1ABXXFP
	default "r7fa2l1abxxfn" if SOC_R7FA2L1ABXXFN
	default "r7fa2l1abxxfm" if SOC_R7FA2L1ABXXFM
	default "r7fa2l1abxxfl" if SOC_R7FA2L1ABXXFL
	default "r7fa2l1abxxne" if SOC_R7FA2L1ABXXNE
```

## soc/renesas/ra/ra4c1/Kconfig
```kconfig
# Copyright (c) 2025 Renesas Electronics Corporation
# SPDX-License-Identifier: Apache-2.0

config SOC_SERIES_RA4C1
	select ARM
	select CPU_HAS_ARM_MPU
	select CPU_CORTEX_M33
	select HAS_RENESAS_RA_FSP
	select CPU_CORTEX_M_HAS_DWT
	select CLOCK_CONTROL_RENESAS_RA_CGC if CLOCK_CONTROL
	select ARMV8_M_DSP
	select CPU_HAS_FPU
	select FPU
	select HAS_SWO
	select XIP
	select SOC_EARLY_INIT_HOOK

if SOC_SERIES_RA4C1

config RENESAS_PN_PACKAGE_TYPE
	int
	range 1 2
	default 2 if SOC_R7FA4C1BD3CFP
	help
	  Package type:
	  1 -> FM: LQFP 64 pins
	  2 -> FP: LQFP 100 pins

endif # SOC_SERIES_RA4C1
```

## soc/renesas/ra/ra4c1/Kconfig.defconfig
```kconfig
# Copyright (c) 2025 Renesas Electronics Corporation
# SPDX-License-Identifier: Apache-2.0

if SOC_SERIES_RA4C1

config NUM_IRQS
	default 64

DT_ICLK_PATH := $(dt_nodelabel_path,iclk)

config SYS_CLOCK_HW_CYCLES_PER_SEC
	default $(dt_node_int_prop_int,$(DT_ICLK_PATH),clock-frequency)

config BUILD_OUTPUT_HEX
	default y

config CLOCK_CONTROL
	default y

endif # SOC_SERIES_RA4C1
```

## soc/renesas/ra/ra4c1/Kconfig.soc
```kconfig
# Copyright (c) 2025 Renesas Electronics Corporation
# SPDX-License-Identifier: Apache-2.0

config SOC_SERIES_RA4C1
	bool
	select SOC_FAMILY_RENESAS_RA
	help
	  Renesas RA4C1 series

config SOC_R7FA4C1BD3CFP
	bool
	select SOC_SERIES_RA4C1
	help
	  R7FA4C1BD3CFP

config SOC_SERIES
	default "ra4c1" if SOC_SERIES_RA4C1

config SOC
	default "r7fa4c1bd3cfp" if SOC_R7FA4C1BD3CFP
```

## soc/renesas/ra/ra4e1/Kconfig
```kconfig
# Copyright (c) 2025 Renesas Electronics Corporation
# SPDX-License-Identifier: Apache-2.0

config SOC_SERIES_RA4E1
	select ARM
	select CPU_HAS_ARM_MPU
	select CPU_CORTEX_M33
	select HAS_RENESAS_RA_FSP
	select CLOCK_CONTROL_RENESAS_RA_CGC if CLOCK_CONTROL
	select CPU_CORTEX_M_HAS_DWT
	select ARMV8_M_DSP
	select CPU_HAS_FPU
	select FPU
	select HAS_SWO
	select XIP
	select GPIO_RA_HAS_VBTICTLR

if SOC_SERIES_RA4E1

config RENESAS_PN_PACKAGE_TYPE
	int
	range 1 2
	default 1 if SOC_R7FA4E10D2CFM
	default 2 if SOC_R7FA4E10D2CNE
	help
	  Package type:
	  1 -> FM: LQFP 64 pins
	  2 -> NE: QFN 48 pins

endif # SOC_SERIES_RA4E1
```

## soc/renesas/ra/ra4e1/Kconfig.soc
```kconfig
# Copyright (c) 2025 Renesas Electronics Corporation
# SPDX-License-Identifier: Apache-2.0

config SOC_SERIES_RA4E1
	bool
	select SOC_FAMILY_RENESAS_RA
	help
	  Renesas RA4E1 series

config SOC_R7FA4E10D2CFM
	bool
	select SOC_SERIES_RA4E1
	help
	  R7FA4E10D2CFM

config SOC_R7FA4E10D2CNE
	bool
	select SOC_SERIES_RA4E1
	help
	  R7FA4E10D2CNE

config SOC_SERIES
	default "ra4e1" if SOC_SERIES_RA4E1

config SOC
	default "r7fa4e10d2cfm" if SOC_R7FA4E10D2CFM
	default "r7fa4e10d2cne" if SOC_R7FA4E10D2CNE
```

## soc/renesas/ra/ra4e2/Kconfig
```kconfig
# Copyright (c) 2024 Renesas Electronics Corporation
# SPDX-License-Identifier: Apache-2.0

config SOC_SERIES_RA4E2
	select ARM
	select CPU_HAS_ARM_MPU
	select CPU_CORTEX_M33
	select HAS_RENESAS_RA_FSP
	select CLOCK_CONTROL_RENESAS_RA_CGC if CLOCK_CONTROL
	select CPU_CORTEX_M_HAS_DWT
	select ARMV8_M_DSP
	select CPU_HAS_FPU
	select FPU
	select HAS_SWO
	select XIP

if SOC_SERIES_RA4E2

config RENESAS_PN_PACKAGE_TYPE
	int
	range 1 5
	default 1 if SOC_R7FA4E2B93CFM
	help
	  Package type:
	  1 -> FM: LQFP 64 pins
	  2 -> NE: QFN 48 pins
	  3 -> NH: QFN 32 pins
	  4 -> BB: BGA 64 pins
	  5 -> BC: BGA 36 pins

endif # SOC_SERIES_RA4E2
```

## soc/renesas/ra/ra4e2/Kconfig.defconfig
```kconfig
# Copyright (c) 2024 Renesas Electronics Corporation
# SPDX-License-Identifier: Apache-2.0

if SOC_SERIES_RA4E2

config NUM_IRQS
	default 96

# Set to the minimal size of data which can be written.
config FLASH_FILL_BUFFER_SIZE
	default 128

endif # SOC_SERIES_RA4E2
```

## soc/renesas/ra/ra4e2/Kconfig.soc
```kconfig
# Copyright (c) 2024 Renesas Electronics Corporation
# SPDX-License-Identifier: Apache-2.0

config SOC_SERIES_RA4E2
	bool
	select SOC_FAMILY_RENESAS_RA
	help
	  Renesas RA4E2 series

config SOC_R7FA4E2B93CFM
	bool
	select SOC_SERIES_RA4E2
	help
	  R7FA4E2B93CFM

config SOC_SERIES
	default "ra4e2" if SOC_SERIES_RA4E2

config SOC
	default "r7fa4e2b93cfm" if SOC_R7FA4E2B93CFM
```

## soc/renesas/ra/ra4l1/Kconfig
```kconfig
# Copyright (c) 2025 Renesas Electronics Corporation
# SPDX-License-Identifier: Apache-2.0

config SOC_SERIES_RA4L1
	select ARM
	select CPU_CORTEX_M33
	select CPU_HAS_ARM_MPU
	select CPU_CORTEX_M_HAS_DWT
	select CPU_HAS_FPU
	select FPU
	select ARMV8_M_DSP
	select HAS_SWO
	select HAS_RENESAS_RA_FSP
	select CLOCK_CONTROL_RENESAS_RA_CGC if CLOCK_CONTROL
	select XIP

if SOC_SERIES_RA4L1

config RENESAS_PN_PACKAGE_TYPE
	int
	range 1 7
	default 3 if SOC_R7FA4L1BD4CFP
	help
	  Package type:
	  1 -> FL: LQFP 48 pins
	  2 -> FM: LQFP 64 pins
	  3 -> FP: LQFP 100 pins
	  4 -> NE: QFN 48 Pins
	  5 -> AH: BGA 64 pins
	  6 -> AG: BGA 100 pins
	  7 -> DB: WLCSP 72 pins

endif # SOC_SERIES_RA4L1
```

## soc/renesas/ra/ra4l1/Kconfig.soc
```kconfig
# Copyright (c) 2025 Renesas Electronics Corporation
# SPDX-License-Identifier: Apache-2.0

config SOC_SERIES_RA4L1
	bool
	select SOC_FAMILY_RENESAS_RA
	help
	  Renesas RA4L1 series

config SOC_R7FA4L1BD4CFP
	bool
	select SOC_SERIES_RA4L1
	help
	  R7FA4L1BD4CFP

config SOC_SERIES
	default "ra4l1" if SOC_SERIES_RA4L1

config SOC
	default "r7fa4l1bd4cfp" if SOC_R7FA4L1BD4CFP
```

## soc/renesas/ra/ra4m1/Kconfig
```kconfig
# Copyright (c) 2023 TOKITA Hiroshi <tokita.hiroshi@fujitsu.com>
# SPDX-License-Identifier: Apache-2.0

config SOC_SERIES_RA4M1
	select ARM
	select CPU_CORTEX_M4
	select CPU_HAS_ARM_MPU
	select HAS_RENESAS_RA_FSP
	select CLOCK_CONTROL_RENESAS_RA_CGC if CLOCK_CONTROL
	select CPU_CORTEX_M_HAS_DWT
	select CPU_HAS_FPU
	select FPU
	select HAS_SWO
	select XIP
	select SOC_EARLY_INIT_HOOK
	select GPIO_RA_HAS_VBTICTLR

if SOC_SERIES_RA4M1

config SOC_OPTION_SETTING_MEMORY
	bool "Option Setting Memory"
	default y

config RENESAS_PN_PACKAGE_TYPE
	int
	range 1 7
	default 1 if SOC_R7FA4M1AB3CFP
	default 2 if SOC_R7FA4M1AB3CFM
	default 6 if SOC_R7FA4M1AB3CNE
	help
	  Package type:
	  1 -> FP: LQFP 100 pins
	  2 -> FM: LQFP 64 pins
	  3 -> FL: LQFP 48 pins
	  4 -> LJ: LGA 100 pins
	  5 -> NB: QFN 64 pins
	  6 -> NE: QFN 48 pins
	  7 -> NF: QFN 40 pins

endif
```

## soc/renesas/ra/ra4m1/Kconfig.defconfig
```kconfig
# Copyright (c) 2023 TOKITA Hiroshi <tokita.hiroshi@fujitsu.com>
# SPDX-License-Identifier: Apache-2.0

if SOC_SERIES_RA4M1

config NUM_IRQS
	default 32

DT_ICLK_PATH := $(dt_nodelabel_path,iclk)

config SYS_CLOCK_HW_CYCLES_PER_SEC
	default $(dt_node_int_prop_int,$(DT_ICLK_PATH),clock-frequency)

config BUILD_OUTPUT_HEX
	default y

config CLOCK_CONTROL
	default y

endif # SOC_SERIES_RA4M1
```

## soc/renesas/ra/ra4m1/Kconfig.soc
```kconfig
# Copyright (c) 2023 TOKITA Hiroshi <tokita.hiroshi@fujitsu.com>
# SPDX-License-Identifier: Apache-2.0

config SOC_SERIES_RA4M1
	bool
	select SOC_FAMILY_RENESAS_RA
	help
	  Renesas RA4M1 series

config SOC_R7FA4M1AB3CFM
	bool
	select SOC_SERIES_RA4M1
	help
	  R7FA4M1AB3CFM

config SOC_R7FA4M1AB3CFP
	bool
	select SOC_SERIES_RA4M1
	help
	  R7FA4M1AB3CFP

config SOC_SERIES
	default "ra4m1" if SOC_SERIES_RA4M1

config SOC
	default "r7fa4m1ab3cfm" if SOC_R7FA4M1AB3CFM
	default "r7fa4m1ab3cfp" if SOC_R7FA4M1AB3CFP
```
