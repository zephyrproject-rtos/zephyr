## soc/renesas/rx/rx14t/Kconfig.soc
```kconfig
# Copyright (c) 2026 Renesas Electronics Corporation
# SPDX-License-Identifier: Apache-2.0

config SOC_SERIES_RX14T
	bool
	select SOC_FAMILY_RENESAS_RX
	help
	  Renesas RX14T series

config SOC_R5F514T5AMFM
	bool
	select SOC_SERIES_RX14T
	help
	  SOC_R5F514T5AMFM

config SOC_SERIES
	default "rx14t" if SOC_SERIES_RX14T

config SOC
	default "r5f514t5amfm" if SOC_R5F514T5AMFM
```

## soc/renesas/rx/rx261/Kconfig
```kconfig
# Copyright (c) 2025 Renesas Electronics Corporation
# SPDX-License-Identifier: Apache-2.0

config SOC_SERIES_RX261
	select RX
	select CPU_RXV3
	select XIP
	select CLOCK_CONTROL_RENESAS_RX_CGC if CLOCK_CONTROL
	select HAS_RENESAS_RX_RDP
	select CLOCK_CONTROL
```

## soc/renesas/rx/rx261/Kconfig.defconfig
```kconfig
# Copyright (c) 2025 Renesas Electronics Corporation
# SPDX-License-Identifier: Apache-2.0

if SOC_SERIES_RX261

DT_CMT_PATH := $(dt_nodelabel_path,cmt)

config SYS_CLOCK_HW_CYCLES_PER_SEC
	default $(dt_node_int_prop_int,$(DT_CMT_PATH),clock-frequency)

# SYS_CLOCK_TICKS_PER_SEC is set to 100 if PCLKB is 48MHz or less.
# (PCLKB = SYS_CLOCK_HW_CYCLES_PER_SEC * 8)
config SYS_CLOCK_TICKS_PER_SEC
	default 100 if SYS_CLOCK_HW_CYCLES_PER_SEC <= 6000000
	default 1000

config INITIALIZATION_STACK_SIZE
	default 512

config BUILD_OUTPUT_HEX
	default y

endif # SOC_SERIES_RX261
```

## soc/renesas/rx/rx261/Kconfig.soc
```kconfig
# Copyright (c) 2025 Renesas Electronics Corporation
# SPDX-License-Identifier: Apache-2.0

config SOC_SERIES_RX261
	bool
	select SOC_FAMILY_RENESAS_RX
	help
	  Renesas RX261 series

config SOC_R5F52618BGFP
	bool
	select SOC_SERIES_RX261
	help
	  R5F52618BGFP microcontroller SoC

config SOC_SERIES
	default "rx261" if SOC_SERIES_RX261

config SOC
	default "r5f52618bgfp" if SOC_R5F52618BGFP
```

## soc/renesas/rx/rx26t/Kconfig.defconfig
```kconfig
# Copyright (c) 2025 Renesas Electronics Corporation
# SPDX-License-Identifier: Apache-2.0

if SOC_SERIES_RX26T

# Set the PCLKB/8 frequency to SYS_CLOCK_HW_CYCLES_PER_SEC.
# Because the CMT of Systick Timer divides the source clock of PCLKB by 8-divider.
config SYS_CLOCK_HW_CYCLES_PER_SEC
	default 7500000

# SYS_CLOCK_TICKS_PER_SEC is set to 100 if PCLKB is 48MHz or less.
# (PCLKB = SYS_CLOCK_HW_CYCLES_PER_SEC * 8)
config SYS_CLOCK_TICKS_PER_SEC
	default 100 if SYS_CLOCK_HW_CYCLES_PER_SEC <= 6000000
	default 1000

config INITIALIZATION_STACK_SIZE
	default 512

# Enable hex file generation
config BUILD_OUTPUT_HEX
	default y

endif # SOC_SERIES_RX26T
```

## soc/renesas/rx/rx26t/Kconfig.soc
```kconfig
# Copyright (c) 2025 Renesas Electronics Corporation
# SPDX-License-Identifier: Apache-2.0

config SOC_SERIES_RX26T
	bool
	select SOC_FAMILY_RENESAS_RX
	help
	  Renesas RX26T series

config SOC_R5F526TFDDFP
	bool
	select SOC_SERIES_RX26T
	help
	  SOC_R5F526TFDDFP

config SOC_SERIES
	default "rx26t" if SOC_SERIES_RX26T

config SOC
	default "r5f526tfddfp" if SOC_R5F526TFDDFP
```

## soc/renesas/rx/rx62n/Kconfig
```kconfig
# Copyright (c) 2024 Renesas Electronics Corporation
# SPDX-License-Identifier: Apache-2.0

config SOC_SERIES_RX62N
	select RX
	select CPU_RXV1
	select XIP
	select CLOCK_CONTROL
```

## soc/renesas/rx/rx62n/Kconfig.defconfig
```kconfig
# Copyright (c) 2024 Renesas Electronics Corporation
# SPDX-License-Identifier: Apache-2.0

if SOC_SERIES_RX62N

config INITIALIZATION_STACK_SIZE
	default 512

endif # SOC_SERIES_RX62N
```

## soc/renesas/rx/rx62n/Kconfig.soc
```kconfig
# Copyright (c) 2024 Renesas Electronics Corporation
# SPDX-License-Identifier: Apache-2.0

config SOC_SERIES_RX62N
	bool
	select SOC_FAMILY_RENESAS_RX
	help
	  Renesas RX62N series

config SOC_R5F562N8
	bool
	select SOC_SERIES_RX62N
	help
	  R5F562N8

config SOC_SERIES
	default "rx62n" if SOC_SERIES_RX62N

config SOC
	default "r5f562n8" if SOC_R5F562N8
```

## soc/renesas/rz/Kconfig.soc
```kconfig
# Copyright (c) 2024 Renesas Electronics Corporation
# SPDX-License-Identifier: Apache-2.0

config SOC_FAMILY_RENESAS_RZ
	bool

config SOC_FAMILY
	default "renesas_rz" if SOC_FAMILY_RENESAS_RZ

rsource "*/Kconfig.soc"
```

## soc/renesas/rz/rza2m/Kconfig
```kconfig
# Copyright (c) 2025 Renesas Electronics Corporation
# SPDX-License-Identifier: Apache-2.0

config SOC_SERIES_RZA2M
	select ARM
	select CPU_CORTEX_A9
```

## soc/renesas/rz/rza2m/Kconfig.defconfig
```kconfig
# Copyright (c) 2025 Renesas Electronics Corporation
# SPDX-License-Identifier: Apache-2.0

if SOC_SERIES_RZA2M

config SYS_CLOCK_HW_CYCLES_PER_SEC
	default $(dt_node_int_prop_int,/soc/cpg/p1clk,clock-frequency)

config NUM_IRQS
	default 512

config FLASH_SIZE
	default $(dt_chosen_reg_size_int,$(DT_CHOSEN_Z_FLASH),0,K)

config FLASH_BASE_ADDRESS
	default $(dt_chosen_reg_addr_hex,$(DT_CHOSEN_Z_FLASH))

DT_CHOSEN_IMAGE_ZEPHYR = zephyr,code-partition
DT_CHOSEN_Z_SRAM = zephyr,sram

config BUILD_OUTPUT_ADJUST_LMA
	default "($(dt_chosen_partition_addr_hex,$(DT_CHOSEN_IMAGE_ZEPHYR)) - \
	$(dt_chosen_reg_addr_hex,$(DT_CHOSEN_Z_SRAM)))"

config BUILD_OUTPUT_ADJUST_LMA_SECTIONS
	default "*;!.loader"

endif # SOC_SERIES_RZA2M
```

## soc/renesas/rz/rza2m/Kconfig.soc
```kconfig
# Copyright (c) 2025 Renesas Electronics Corporation
# SPDX-License-Identifier: Apache-2.0

config SOC_SERIES_RZA2M
	bool
	select SOC_FAMILY_RENESAS_RZ
	help
	  Renesas RZ/A2M series

config SOC_SERIES
	default "rza2m" if SOC_SERIES_RZA2M

config SOC_R7S921053VCBG
	bool
	select SOC_SERIES_RZA2M
	help
	  R7S921053VCBG

config SOC_R7S921053VCBG_CA9
	bool
	select SOC_R7S921053VCBG

config SOC
	default "r7s921053vcbg" if SOC_R7S921053VCBG
```

## soc/renesas/rz/rza3m/Kconfig.soc
```kconfig
# Copyright (c) 2025 Renesas Electronics Corporation
# SPDX-License-Identifier: Apache-2.0

config SOC_SERIES_RZA3M
	bool
	select SOC_FAMILY_RENESAS_RZ
	help
	  Renesas RZ/A3M series

config SOC_SERIES
	default "rza3m" if SOC_SERIES_RZA3M

config SOC_R9A07G066M04GBG
	bool
	select SOC_SERIES_RZA3M
	help
	  R9A07G066M04GBG

config SOC
	default "r9a07g066m04gbg" if SOC_R9A07G066M04GBG
```

## soc/renesas/rz/rza3ul/Kconfig
```kconfig
# Copyright (c) 2025 Renesas Electronics Corporation
# SPDX-License-Identifier: Apache-2.0

config SOC_SERIES_RZA3UL
	select ARM64
	select CPU_CORTEX_A55
	select ARM_ARCH_TIMER if !RZ_OS_TIMER
	select HAS_RENESAS_RZ_FSP
	select SOC_EARLY_INIT_HOOK
```

## soc/renesas/rz/rza3ul/Kconfig.soc
```kconfig
# Copyright (c) 2025 Renesas Electronics Corporation
# SPDX-License-Identifier: Apache-2.0

config SOC_SERIES_RZA3UL
	bool
	select SOC_FAMILY_RENESAS_RZ
	help
	  Renesas RZ/A3UL series

config SOC_SERIES
	default "rza3ul" if SOC_SERIES_RZA3UL

config SOC_R9A07G063U02GBG
	bool
	select SOC_SERIES_RZA3UL
	help
	  R9A07G063U02GBG

config SOC
	default "r9a07g063u02gbg" if SOC_R9A07G063U02GBG
```

## soc/renesas/rz/rzg2l/Kconfig
```kconfig
# Copyright (c) 2025 Renesas Electronics Corporation
# SPDX-License-Identifier: Apache-2.0

config SOC_SERIES_RZG2L
	select ARM
	select CPU_CORTEX_M33
	select CPU_HAS_ARM_MPU
	select HAS_RENESAS_RZ_FSP
	select CPU_CORTEX_M_HAS_DWT
	select SOC_EARLY_INIT_HOOK
```

## soc/renesas/rz/rzg2l/Kconfig.soc
```kconfig
# Copyright (c) 2025 Renesas Electronics Corporation
# SPDX-License-Identifier: Apache-2.0

config SOC_SERIES_RZG2L
	bool
	select SOC_FAMILY_RENESAS_RZ
	help
	  Renesas RZ/G2L series

config SOC_SERIES
	default "rzg2l" if SOC_SERIES_RZG2L

config SOC_R9A07G044L23GBG
	bool
	select SOC_SERIES_RZG2L
	help
	  R9A07G044L23GBG

config SOC_R9A07G044L23GBG_CM33
	bool
	select SOC_R9A07G044L23GBG

config SOC
	default "r9a07g044l23gbg" if SOC_R9A07G044L23GBG
```

## soc/renesas/rz/rzg2ul/Kconfig.soc
```kconfig
# Copyright (c) 2025 Renesas Electronics Corporation
# SPDX-License-Identifier: Apache-2.0

config SOC_SERIES_RZG2UL
	bool
	select SOC_FAMILY_RENESAS_RZ
	help
	  Renesas RZ/G2UL series

config SOC_SERIES
	default "rzg2ul" if SOC_SERIES_RZG2UL

config SOC_R9A07G043U11GBG
	bool
	select SOC_SERIES_RZG2UL
	help
	  R9A07G043U11GBG

config SOC_R9A07G043U11GBG_CM33
	bool
	select SOC_R9A07G043U11GBG

config SOC
	default "r9a07g043u11gbg" if SOC_R9A07G043U11GBG
```

## soc/renesas/rz/rzg3e/Kconfig.soc
```kconfig
# Copyright (c) 2025 Renesas Electronics Corporation
# SPDX-License-Identifier: Apache-2.0

config SOC_SERIES_RZG3E
	bool
	select SOC_FAMILY_RENESAS_RZ
	help
	  Renesas RZ/G3E series

config SOC_SERIES
	default "rzg3e" if SOC_SERIES_RZG3E

config SOC_R9A09G047A57GBG
	bool
	select SOC_SERIES_RZG3E
	help
	  R9A09G047A57GBG

config SOC_R9A09G047A57GBG_CM33
	bool
	select SOC_R9A09G047A57GBG

config SOC
	default "r9a09g047a57gbg" if SOC_R9A09G047A57GBG
```

## soc/renesas/rz/rzg3s/Kconfig
```kconfig
# Copyright (c) 2024 EPAM Systems
# Copyright (c) 2024 Renesas Electronics Corporation
# SPDX-License-Identifier: Apache-2.0

config SOC_SERIES_RZG3S
	select ARM
	select CPU_CORTEX_M33
	select CPU_HAS_ARM_MPU
	select HAS_RENESAS_RZ_FSP
	select CPU_CORTEX_M_HAS_DWT
	select SOC_EARLY_INIT_HOOK
```

## soc/renesas/rz/rzg3s/Kconfig.soc
```kconfig
# Copyright (c) 2024 Renesas Electronics Corporation
# SPDX-License-Identifier: Apache-2.0

config SOC_SERIES_RZG3S
	bool
	select SOC_FAMILY_RENESAS_RZ
	help
	  Renesas RZ/G3S series

config SOC_SERIES
	default "rzg3s" if SOC_SERIES_RZG3S

config SOC_R9A08G045S33GBG
	bool
	select SOC_SERIES_RZG3S
	help
	  R9A08G045S33GBG

config SOC_R9A08G045S33GBG_CM33
	bool
	select SOC_R9A08G045S33GBG

config SOC
	default "r9a08g045s33gbg" if SOC_R9A08G045S33GBG
```

## soc/renesas/rz/rzn2h/Kconfig.soc
```kconfig
# Copyright (c) 2026 Renesas Electronics Corporation
# SPDX-License-Identifier: Apache-2.0

config SOC_SERIES_RZN2H
	bool
	select SOC_FAMILY_RENESAS_RZ
	help
	  Renesas RZ/N2H series

config SOC_SERIES
	default "rzn2h" if SOC_SERIES_RZN2H

config SOC_R9A09G087M44GBG
	bool
	select SOC_SERIES_RZN2H
	help
	  R9A09G087M44GBG

config SOC_R9A09G087M44GBG_CR52_0
	bool
	select SOC_R9A09G087M44GBG

config SOC
	default "r9a09g087m44gbg" if SOC_R9A09G087M44GBG
```

## soc/renesas/rz/rzn2l/Kconfig.defconfig
```kconfig
# Copyright (c) 2025 Renesas Electronics Corporation
# SPDX-License-Identifier: Apache-2.0

if SOC_SERIES_RZN2L

config NUM_IRQS
	default 480

config SYS_CLOCK_HW_CYCLES_PER_SEC
	default 25000000

config FPU
	default y

DT_CHOSEN_IMAGE_ZEPHYR = zephyr,code-partition

config BUILD_OUTPUT_ADJUST_LMA
	default "($(dt_chosen_reg_addr_hex,$(DT_CHOSEN_IMAGE_ZEPHYR)) + \
	$(dt_chosen_reg_addr_hex,$(DT_CHOSEN_Z_FLASH)))"

config BUILD_OUTPUT_ADJUST_LMA_SECTIONS
	default "*;!.loader"

endif # SOC_SERIES_RZN2L
```

## soc/renesas/rz/rzn2l/Kconfig.soc
```kconfig
# Copyright (c) 2025 Renesas Electronics Corporation
# SPDX-License-Identifier: Apache-2.0

config SOC_SERIES_RZN2L
	bool
	select SOC_FAMILY_RENESAS_RZ
	help
	  Renesas RZ/N2L series

config SOC_SERIES
	default "rzn2l" if SOC_SERIES_RZN2L

config SOC_R9A07G084M04GBG
	bool
	select SOC_SERIES_RZN2L
	help
	  R9A07G084M04GBG

config SOC
	default "r9a07g084m04gbg" if SOC_R9A07G084M04GBG
```
