## soc/renesas/rz/Kconfig
```kconfig
# Copyright (c) 2024-2026 Renesas Electronics Corporation
# SPDX-License-Identifier: Apache-2.0

config SOC_FAMILY_RENESAS_RZ
	select HAS_SEGGER_RTT if ZEPHYR_SEGGER_MODULE

if SOC_FAMILY_RENESAS_RZ

config SOC_FAMILY_RENESAS_RZ_TCM_LOADER
	bool
	help
	  The image of the primary core (CPU0) is linked by
	  soc/renesas/rz/scripts/linker.ld and booted from flash by the boot
	  ROM and the loader program.

config SOC_FAMILY_RENESAS_RZ_LOADER_DELAY
	int "Loader program delay loop iterations"
	depends on SOC_FAMILY_RENESAS_RZ_TCM_LOADER
	default 0
	help
	  Number of iterations of a delay loop the loader program runs before
	  copying the image, to leave time to attach a debugger. 0 disables
	  the delay. 50000000 has been tested and leaves enough time to attach
	  a debugger.

rsource "*/Kconfig"

endif # SOC_FAMILY_RENESAS_RZ
```

## soc/renesas/rz/rza3ul/Kconfig.defconfig
```kconfig
# Copyright (c) 2025 Renesas Electronics Corporation
# SPDX-License-Identifier: Apache-2.0

if SOC_SERIES_RZA3UL

config SYS_CLOCK_EXISTS
	default y

config NUM_IRQS
	default 512

config SYS_CLOCK_HW_CYCLES_PER_SEC
	default	$(dt_node_int_prop_int,/osc,clock-frequency)

config FLASH_SIZE
	default $(dt_chosen_reg_size_int,$(DT_CHOSEN_Z_FLASH),0,K)

config FLASH_BASE_ADDRESS
	default $(dt_chosen_reg_addr_hex,$(DT_CHOSEN_Z_FLASH))

config FLASH_LOAD_OFFSET
	default $(sub_hex, $(dt_nodelabel_reg_addr_hex,header), \
	$(dt_chosen_reg_addr_hex,$(DT_CHOSEN_Z_FLASH)))

config BUILD_OUTPUT_ADJUST_LMA
	default "$(sub_hex, $(dt_chosen_reg_addr_hex,$(DT_CHOSEN_Z_CODE_PARTITION)), \
	$(dt_chosen_reg_addr_hex,$(DT_CHOSEN_Z_SRAM)))"

config BUILD_OUTPUT_ADJUST_LMA_SECTIONS
	default "*;!.header"

endif # SOC_SERIES_RZA3UL
```

## soc/renesas/rz/rzt2l/Kconfig.defconfig
```kconfig
# Copyright (c) 2025-2026 Renesas Electronics Corporation
# SPDX-License-Identifier: Apache-2.0

if SOC_SERIES_RZT2L

config NUM_IRQS
	default 480

config FPU
	default y

configdefault ARM_MPU
	default y

# Workaround for not being able to have commas in macro arguments
DT_CHOSEN_Z_FLASH := zephyr,flash

config FLASH_SIZE
	default $(dt_chosen_reg_size_int,$(DT_CHOSEN_Z_FLASH),0,K)

config FLASH_BASE_ADDRESS
	default $(dt_chosen_reg_addr_hex,$(DT_CHOSEN_Z_FLASH))

endif # SOC_SERIES_RZT2L
```

## soc/rockchip/rk35/rk3568/Kconfig.defconfig.rk3568
```kconfig
# Copyright 2022 HNU-ESNL
# Copyright 2022 openEuler SIG-Zephyr
# SPDX-License-Identifier: Apache-2.0

if SOC_RK3568

config FLASH_SIZE
	default 0

config FLASH_BASE_ADDRESS
	default 0

config NUM_IRQS
	default 240

endif
```

## soc/silabs/Kconfig.defconfig
```kconfig
# SPDX-License-Identifier: Apache-2.0
# Copyright (c) 2017 Christian Taedcke
# Copyright (c) 2026 Silicon Laboratories Inc.

rsource "*/Kconfig.defconfig"

if SOC_FAMILY_SILABS_S2 || SOC_FAMILY_SILABS_S3

configdefault SILABS_SISDK_RAIL_MULTIPROTOCOL
	default y if BT_SILABS_EFR32 && IEEE802154_SILABS_EFR32

if NET_L2_PHY_IEEE802154

configdefault NET_PKT_RX_COUNT
	default 16

configdefault NET_PKT_TX_COUNT
	default 16

configdefault NET_BUF_RX_COUNT
	default 64

configdefault NET_BUF_TX_COUNT
	default 64

endif

if OPENTHREAD

choice OPENTHREAD_IMPLEMENTATION
	default OPENTHREAD_SOURCES
endchoice

choice OPENTHREAD_STACK_VERSION
	default OPENTHREAD_THREAD_VERSION_1_4
endchoice

configdefault OPENTHREAD_MANUAL_START
	default y

configdefault OPENTHREAD_RADIO_WORKQUEUE_STACK_SIZE
	default 2048

configdefault OPENTHREAD_MAC_SOFTWARE_CSMA_BACKOFF_ENABLE
	default n

configdefault OPENTHREAD_MIN_RECEIVE_ON_AFTER
	default 0

configdefault OPENTHREAD_MAC_SOFTWARE_TX_SECURITY_ENABLE
	default n

configdefault OPENTHREAD_IP6_MAX_EXT_MCAST_ADDRS
	default 4

configdefault OPENTHREAD_DNS_CLIENT
	default y

configdefault OPENTHREAD_DUA
	default y

configdefault OPENTHREAD_EXTERNAL_HEAP
	default y

configdefault OPENTHREAD_LINK_METRICS_INITIATOR
	default y

configdefault OPENTHREAD_LINK_METRICS_SUBJECT
	default y

configdefault OPENTHREAD_MAC_BEACON_PAYLOAD_PARSING
	default y

configdefault OPENTHREAD_MLR
	default y

configdefault OPENTHREAD_MULTIPLE_INSTANCE_NUM
	default 2

configdefault OPENTHREAD_NETDIAG_CLIENT
	default y

configdefault OPENTHREAD_PING_SENDER
	default y

configdefault OPENTHREAD_SLAAC
	default y

configdefault OPENTHREAD_SRP_CLIENT
	default y

configdefault OPENTHREAD_UPTIME
	default y if OPENTHREAD_FTD || OPENTHREAD_MTD

configdefault OPENTHREAD_CSL_AUTO_SYNC
	default y

configdefault NET_PKT_TIMESTAMP
	default y

configdefault NET_PKT_TXTIME
	default y

configdefault OPENTHREAD_CSL_RECEIVE_TIME_AHEAD
	default 1000 if SILABS_SISDK_RAIL_MULTIPROTOCOL
	default 600

configdefault OPENTHREAD_PLATFORM_CSL_UNCERT
	default 175 if OPENTHREAD_REFERENCE_DEVICE
	default 20 if OPENTHREAD_FTD
	default 12

if OPENTHREAD_COMMISSIONER

configdefault MBEDTLS_HEAP_SIZE
	default 16384

endif

endif

endif

if SOC_FAMILY_SILABS_S0 || SOC_FAMILY_SILABS_S1

config SILABS_GECKO_EMU
	default y
	select SILABS_GECKO_CORE
	depends on PM

config CORTEX_M_SYSTICK
	default n if GECKO_BURTC_TIMER

endif

if SOC_FAMILY_SILABS_S2 || SOC_FAMILY_SILABS_S3

configdefault TF_PSA_CRYPTO_DISPATCH_DIR
	default "${ZEPHYR_HAL_SILABS_MODULE_DIR}/simplicity_sdk/util/third_party/mbedtls/dispatch" \
		if SILABS_SISDK_PSA_CRYPTO

configdefault TF_PSA_CRYPTO_DRIVER_CONFIG_FILE
	default "sl_psa_crypto_config_zephyr.h" if SILABS_SISDK_PSA_CRYPTO

endif
```

## soc/silabs/silabs_s2/Kconfig
```kconfig
# Copyright (c) 2024 GARDENA GmbH
# SPDX-License-Identifier: Apache-2.0

if SOC_FAMILY_SILABS_S2

config SOC_FAMILY_SILABS_S2
	select HAS_SEGGER_RTT if ZEPHYR_SEGGER_MODULE
	select BUILD_OUTPUT_HEX
	select SOC_PREP_HOOK
	select SOC_EARLY_INIT_HOOK
	select HAS_SILABS_SISDK
	select PM_STATE_SET_IRQ_UNLOCKED

config CRYPTO_ACC_GECKO_TRNG
	bool
	help
	  Enable Entropy driver based on the CRYPTO_ACC module for Silicon Labs
	  Gecko chips.

rsource "*/Kconfig"

config ARM_SECURE_FIRMWARE
	default y

config SILABS_DEVICE_IS_MODULE
	bool
	default n

endif
```

## soc/silabs/silabs_s3/Kconfig
```kconfig
# Copyright (c) 2026 Silicon Laboratories Inc.
# SPDX-License-Identifier: Apache-2.0

if SOC_FAMILY_SILABS_S3

config SOC_FAMILY_SILABS_S3
	select HAS_SEGGER_RTT if ZEPHYR_SEGGER_MODULE
	select BUILD_OUTPUT_HEX
	select SOC_PREP_HOOK
	select SOC_EARLY_INIT_HOOK
	select HAS_SILABS_SISDK
	select PM_STATE_SET_IRQ_UNLOCKED

rsource "*/Kconfig"

endif
```

## soc/silabs/silabs_s3/Kconfig.soc
```kconfig
# Copyright (c) 2026 Silicon Laboratories Inc.
# SPDX-License-Identifier: Apache-2.0

config SOC_FAMILY_SILABS_S3
	bool

rsource "*/Kconfig.soc"
```

## soc/silabs/silabs_s3/six301/Kconfig.defconfig
```kconfig
# Copyright (c) 2025 Silicon Laboratories Inc.
# SPDX-License-Identifier: Apache-2.0

if SOC_SILABS_SIX301

config NUM_IRQS
	# must be >= the highest interrupt number used
	default 90

config PM
	default n
	select UART_INTERRUPT_DRIVEN if SERIAL_SUPPORT_INTERRUPT

choice PM_POLICY
	default PM_POLICY_DEFAULT
	depends on PM
endchoice

endif
```

## soc/silabs/silabs_s3/six301/Kconfig.soc
```kconfig
# Copyright (c) 2025 Silicon Laboratories Inc.
# SPDX-License-Identifier: Apache-2.0

config SOC_SILABS_SIX301
	bool
	select SOC_FAMILY_SILABS_S3
	help
	  Silicon Labs Six301 SoC and modules

config SOC_SERIES_SIBG301
	bool
	select SOC_SILABS_SIX301
	help
	  Silicon Labs SiBG301 Soc

config SOC_SERIES_SIMG301
	bool
	select SOC_SILABS_SIX301
	help
	  Silicon Labs SiMG301 SoC

config SOC_SIBG301M104LGH
	bool
	select SOC_SERIES_SIBG301

config SOC_SIBG301M104LGL
	bool
	select SOC_SERIES_SIBG301

config SOC_SIBG301M104LIH
	bool
	select SOC_SERIES_SIBG301

config SOC_SIBG301M104LIL
	bool
	select SOC_SERIES_SIBG301

config SOC_SIBG301M104XIL
	bool
	select SOC_SERIES_SIBG301

config SOC_SIBG301M114KGH
	bool
	select SOC_SERIES_SIBG301

config SOC_SIBG301M114KIH
	bool
	select SOC_SERIES_SIBG301

config SOC_SIMG301M103LIH
	bool
	select SOC_SERIES_SIMG301

config SOC_SIMG301M103WIH
	bool
	select SOC_SERIES_SIMG301

config SOC_SIMG301M104LGH
	bool
	select SOC_SERIES_SIMG301

config SOC_SIMG301M104LGL
	bool
	select SOC_SERIES_SIMG301

config SOC_SIMG301M104LIH
	bool
	select SOC_SERIES_SIMG301

config SOC_SIMG301M104LIL
	bool
	select SOC_SERIES_SIMG301

config SOC_SIMG301M104XIL
	bool
	select SOC_SERIES_SIMG301

config SOC_SIMG301M113WIH
	bool
	select SOC_SERIES_SIMG301

config SOC_SIMG301M114KGH
	bool
	select SOC_SERIES_SIMG301

config SOC_SIMG301M114KIH
	bool
	select SOC_SERIES_SIMG301

config SOC_SIMG301M114LGH
	bool
	select SOC_SERIES_SIMG301

config SOC_SIMG301M114LIH
	bool
	select SOC_SERIES_SIMG301

config SOC_SERIES
	default "sibg301" if SOC_SERIES_SIBG301
	default "simg301" if SOC_SERIES_SIMG301

config SOC
	default "sibg301m104lgh" if SOC_SIBG301M104LGH
	default "sibg301m104lgl" if SOC_SIBG301M104LGL
	default "sibg301m104lih" if SOC_SIBG301M104LIH
	default "sibg301m104lil" if SOC_SIBG301M104LIL
	default "sibg301m104xil" if SOC_SIBG301M104XIL
	default "sibg301m114kgh" if SOC_SIBG301M114KGH
	default "sibg301m114kih" if SOC_SIBG301M114KIH
	default "simg301m103lih" if SOC_SIMG301M103LIH
	default "simg301m103wih" if SOC_SIMG301M103WIH
	default "simg301m104lgh" if SOC_SIMG301M104LGH
	default "simg301m104lgl" if SOC_SIMG301M104LGL
	default "simg301m104lih" if SOC_SIMG301M104LIH
	default "simg301m104lil" if SOC_SIMG301M104LIL
	default "simg301m104xil" if SOC_SIMG301M104XIL
	default "simg301m113wih" if SOC_SIMG301M113WIH
	default "simg301m114kgh" if SOC_SIMG301M114KGH
	default "simg301m114kih" if SOC_SIMG301M114KIH
	default "simg301m114lgh" if SOC_SIMG301M114LGH
	default "simg301m114lih" if SOC_SIMG301M114LIH
```

## soc/silabs/silabs_siwx91x/siwg917/Kconfig.defconfig
```kconfig
# Copyright (c) 2024 Silicon Laboratories Inc.
# SPDX-License-Identifier: Apache-2.0

if SOC_SERIES_SIWG917

config NUM_IRQS
	default 99

# initialize wuc before gpio
config WUC_INIT_PRIORITY
	default 39

endif
```

## soc/st/stm32/stm32c5x/Kconfig
```kconfig
# STMicroelectronics STM32C5 MCU series

# Copyright (c) 2026 STMicroelectronics
# SPDX-License-Identifier: Apache-2.0

config SOC_SERIES_STM32C5X
	# Architecture options & CPU model selection
	select ARM
	select ARMV8_M_DSP
	select CPU_CORTEX_M33
	# Hardware options
	select CPU_CORTEX_M_HAS_DWT
	select CPU_HAS_ARM_MPU
	select CPU_HAS_FPU
	select CPU_HAS_ICACHE
	select HAS_SWO
	# Software options
	select HAS_PM
	select HAS_POWEROFF
	select SOC_EARLY_INIT_HOOK
	# STM32-specific options
	select HAS_STM32CUBE
	select STM32_HAL2
	select HAS_STM32_UNCACHED_ACCESS_ONLY_OTP
```

## soc/st/stm32/stm32f0x/Kconfig
```kconfig
# ST Microelectronics STM32F0 MCU series

# Copyright (c) 2017 RnDity Sp. z o.o.
# SPDX-License-Identifier: Apache-2.0

config SOC_SERIES_STM32F0X
	# Architecture options & CPU model selection
	select ARM
	select CPU_CORTEX_M0
	# Hardware options
	select CPU_CORTEX_M_HAS_SYSTICK
	select CPU_CORTEX_M0_HAS_VECTOR_TABLE_REMAP
	# Software options
	select SOC_EARLY_INIT_HOOK
	# STM32-specific options
	select HAS_STM32CUBE
	select HAS_STM32_FLASH_PREFETCH
```

## soc/st/stm32/stm32f7x/Kconfig
```kconfig
# ST Microelectronics STM32F7 MCU series

# Copyright (c) 2018 Yurii Hamann
# SPDX-License-Identifier: Apache-2.0

config SOC_SERIES_STM32F7X
	# Architecture options & CPU model selection
	select ARM
	select CPU_CORTEX_M7
	# Hardware options
	select CPU_CORTEX_M_HAS_DWT
	select CPU_HAS_ARM_MPU
	select CPU_HAS_DCACHE
	select CPU_HAS_FPU
	select CPU_HAS_ICACHE
	select HAS_SWO
	# Software options
	select SOC_EARLY_INIT_HOOK
	# STM32-specific options
	select HAS_STM32CUBE
	select HAS_STM32_FLASH_PREFETCH
```

## soc/st/stm32/stm32f7x/Kconfig.defconfig
```kconfig
# ST Microelectronics STM32F7 MCU line

# Copyright (c) 2018 Yurii Hamann
# SPDX-License-Identifier: Apache-2.0

# Kconfig symbols common to STM32F7 series

if SOC_SERIES_STM32F7X

rsource "Kconfig.defconfig.stm32f7*"

configdefault SHARED_INTERRUPTS
	default y if $(dt_nodelabel_enabled,timers1) && $(dt_nodelabel_enabled,timers9)
	default y if $(dt_nodelabel_enabled,timers1) && $(dt_nodelabel_enabled,timers10)
	default y if $(dt_nodelabel_enabled,timers1) && $(dt_nodelabel_enabled,timers11)
	default y if $(dt_nodelabel_enabled,timers8) && $(dt_nodelabel_enabled,timers12)
	default y if $(dt_nodelabel_enabled,timers8) && $(dt_nodelabel_enabled,timers13)
	default y if $(dt_nodelabel_enabled,timers8) && $(dt_nodelabel_enabled,timers14)

config BUILD_OUTPUT_UF2_FAMILY_ID
	default "0x53b80f00"

configdefault LV_Z_DRAW_DMA2D_HAL_INCLUDE
	default "stm32f7xx.h" if LVGL && LV_Z_DRAW_DMA2D

endif # SOC_SERIES_STM32F7X
```

## soc/st/stm32/stm32f7x/Kconfig.defconfig.stm32f730xx
```kconfig
# ST STM32F730XX MCU configuration options

# Copyright (c) 2026 Eve Redero
# SPDX-License-Identifier: Apache-2.0

if SOC_STM32F730XX

config NUM_IRQS
	default 104

endif # SOC_STM32F730XX
```

## soc/st/stm32/stm32g0x/Kconfig
```kconfig
# STMicroelectronics STM32G0 MCU series

# Copyright (c) 2019 Philippe Retornaz <philippe@shapescale.com>
# Copyright (c) 2019 STMicroelectronics
# SPDX-License-Identifier: Apache-2.0

config SOC_SERIES_STM32G0X
	# Architecture options & CPU model selection
	select ARM
	select CPU_CORTEX_M0PLUS
	# Hardware options
	select CPU_CORTEX_M_HAS_SYSTICK
	select CPU_CORTEX_M_HAS_VTOR
	select CPU_HAS_ARM_MPU
	# Software options
	select HAS_PM
	select HAS_POWEROFF
	select PM_STATE_SET_IRQ_UNLOCKED
	select SOC_EARLY_INIT_HOOK
	# STM32-specific options
	select HAS_STM32CUBE
	select HAS_STM32_FLASH_PREFETCH
```

## soc/st/stm32/stm32g5x/Kconfig
```kconfig
# STMicroelectronics STM32G5 MCU series

# Copyright (c) 2026 STMicroelectronics
# SPDX-License-Identifier: Apache-2.0

config SOC_SERIES_STM32G5X
	select ARM
	select ARM_TRUSTZONE_M
	select CPU_CORTEX_M33
	select CPU_CORTEX_M_HAS_DWT
	select CPU_HAS_ARM_SAU
	select CPU_HAS_ARM_MPU
	select CPU_HAS_FPU
	select ARMV8_M_DSP
	select HAS_STM32CUBE
	select STM32_HAL2
	select HAS_STM32_FLASH_PREFETCH
	select HAS_PM
	select HAS_SWO
	select SOC_EARLY_INIT_HOOK
```

## soc/st/stm32/stm32g5x/Kconfig.defconfig
```kconfig
# STMicroelectronics STM32G5 MCU line

# Copyright (c) 2026 STMicroelectronics
# SPDX-License-Identifier: Apache-2.0

if SOC_SERIES_STM32G5X

configdefault ROM_START_OFFSET
	default 0x400 if BOOTLOADER_MCUBOOT

configdefault ICACHE
	default y

configdefault CACHE_MANAGEMENT
	default y

choice CACHE_TYPE
	default EXTERNAL_CACHE
endchoice

endif # SOC_SERIES_STM32G5X
```
