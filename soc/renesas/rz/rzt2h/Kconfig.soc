## soc/renesas/rz/rzt2h/Kconfig.soc
```kconfig
# Copyright (c) 2026 Renesas Electronics Corporation
# SPDX-License-Identifier: Apache-2.0

config SOC_SERIES_RZT2H
	bool
	select SOC_FAMILY_RENESAS_RZ
	help
	  Renesas RZ/T2H series

config SOC_SERIES
	default "rzt2h" if SOC_SERIES_RZT2H

config SOC_R9A09G077M44GBG
	bool
	select SOC_SERIES_RZT2H
	help
	  R9A09G077M44GBG

config SOC
	default "r9a09g077m44gbg" if SOC_R9A09G077M44GBG
```

## soc/renesas/rz/rzt2l/Kconfig
```kconfig
# Copyright (c) 2025 Renesas Electronics Corporation
# SPDX-License-Identifier: Apache-2.0

config SOC_SERIES_RZT2L
	select ARM
	select CPU_CORTEX_R52
	select CPU_HAS_ARM_MPU
	select GIC_SINGLE_SECURITY_STATE
	select ARM_ARCH_TIMER
	select HAS_RENESAS_RZ_FSP
	select SOC_RESET_HOOK
	select SOC_EARLY_INIT_HOOK
	select ARM_CUSTOM_INTERRUPT_CONTROLLER
```

## soc/renesas/rz/rzt2l/Kconfig.soc
```kconfig
# Copyright (c) 2025 Renesas Electronics Corporation
# SPDX-License-Identifier: Apache-2.0

config SOC_SERIES_RZT2L
	bool
	select SOC_FAMILY_RENESAS_RZ
	help
	  Renesas RZ/T2L series

config SOC_SERIES
	default "rzt2l" if SOC_SERIES_RZT2L

config SOC_R9A07G074M04GBG
	bool
	select SOC_SERIES_RZT2L
	help
	  R9A07G074M04GBG

config SOC
	default "r9a07g074m04gbg" if SOC_R9A07G074M04GBG
```

## soc/renesas/rz/rzt2m/Kconfig.soc
```kconfig
# Copyright (c) 2023 Antmicro <www.antmicro.com>
# Copyright (c) 2025 Renesas Electronics Corporation
# SPDX-License-Identifier: Apache-2.0

config SOC_SERIES_RZT2M
	bool
	select SOC_FAMILY_RENESAS_RZ
	help
	  Renesas RZ/T2M series

config SOC_SERIES
	default "rzt2m" if SOC_SERIES_RZT2M

config SOC_R9A07G075M24GBG
	bool
	select SOC_SERIES_RZT2M
	help
	  R9A07G075M24GBG

config SOC_R9A07G075M24GBG_CR520
	bool
	select SOC_R9A07G075M24GBG

config SOC
	default "r9a07g075m24gbg" if SOC_R9A07G075M24GBG
```

## soc/renesas/rz/rzv2h/Kconfig
```kconfig
# Copyright (c) 2025 Renesas Electronics Corporation
# SPDX-License-Identifier: Apache-2.0

config SOC_R9A09G057H44GBG_CM33
	select ARM
	select CPU_CORTEX_M33
	select CPU_HAS_ARM_MPU
	select HAS_RENESAS_RZ_FSP
	select CPU_CORTEX_M_HAS_DWT
	select SOC_EARLY_INIT_HOOK
	select CPU_HAS_FPU
	select ARMV8_M_DSP

config SOC_R9A09G057H44GBG_CR8
	select ARM
	select CPU_CORTEX_R8
	select CPU_HAS_ARM_MPU
	select CPU_HAS_FPU
	select ARM_ARCH_TIMER
	select ARM_CUSTOM_INTERRUPT_CONTROLLER
	select HAS_RENESAS_RZ_FSP
	select VFP_DP_D16
	select SOC_EARLY_INIT_HOOK
	select CPU_HAS_ICACHE
	select CPU_HAS_DCACHE
```

## soc/renesas/rz/rzv2h/Kconfig.defconfig
```kconfig
# Copyright (c) 2025 Renesas Electronics Corporation
# SPDX-License-Identifier: Apache-2.0

if SOC_SERIES_RZV2H

rsource "Kconfig.defconfig.*"

endif # SOC_SERIES_RZV2H
```

## soc/renesas/rz/rzv2h/Kconfig.defconfig.rzv2h_cm33
```kconfig
# Copyright (c) 2025 Renesas Electronics Corporation
# SPDX-License-Identifier: Apache-2.0

if SOC_R9A09G057H44GBG_CM33

config NUM_IRQS
	default 480

config SYS_CLOCK_HW_CYCLES_PER_SEC
	default	$(dt_node_int_prop_int,/cpus/cpu@0,clock-frequency)

config SYS_CLOCK_EXISTS
	default y

config INIT_ARCH_HW_AT_BOOT
	default y

endif # SOC_R9A09G057H44GBG_CM33
```

## soc/renesas/rz/rzv2h/Kconfig.defconfig.rzv2h_cr8
```kconfig
# Copyright (c) 2025 Renesas Electronics Corporation
# SPDX-License-Identifier: Apache-2.0

if SOC_R9A09G057H44GBG_CR8

config NUM_IRQS
	default 512

config FPU
	default y

config SYS_CLOCK_HW_CYCLES_PER_SEC
	default $(div,$(dt_node_int_prop_int,/cpus/cpu@0,clock-frequency),4)

config SYS_CLOCK_EXISTS
	default y

endif # SOC_R9A09G057H44GBG_CR8
```

## soc/renesas/rz/rzv2h/Kconfig.soc
```kconfig
# Copyright (c) 2025 Renesas Electronics Corporation
# SPDX-License-Identifier: Apache-2.0

config SOC_SERIES_RZV2H
	bool
	select SOC_FAMILY_RENESAS_RZ
	help
	  Renesas RZ/V2H series

config SOC_SERIES
	default "rzv2h" if SOC_SERIES_RZV2H

config SOC_R9A09G057H44GBG
	bool
	select SOC_SERIES_RZV2H
	help
	  R9A09G057H44GBG

config SOC_R9A09G057H44GBG_CM33
	bool
	select SOC_R9A09G057H44GBG
	help
	  RZ/V2H CM33

config SOC
	default "r9a09g057h44gbg" if SOC_R9A09G057H44GBG
```

## soc/renesas/rz/rzv2l/Kconfig.defconfig
```kconfig
# Copyright (c) 2025 Renesas Electronics Corporation
# SPDX-License-Identifier: Apache-2.0

if SOC_SERIES_RZV2L

config NUM_IRQS
	default 480

config SYS_CLOCK_HW_CYCLES_PER_SEC
	default	$(dt_node_int_prop_int,/cpus/cpu@0,clock-frequency)

config FLASH_SIZE
	default $(dt_chosen_reg_size_int,$(DT_CHOSEN_Z_FLASH),0,K)

config FLASH_BASE_ADDRESS
	default $(dt_chosen_reg_addr_hex,$(DT_CHOSEN_Z_FLASH))

config SYS_CLOCK_EXISTS
	default y

config INIT_ARCH_HW_AT_BOOT
	default y

config BUILD_OUTPUT_S19
	default y

endif # SOC_SERIES_RZV2L
```

## soc/renesas/rz/rzv2l/Kconfig.soc
```kconfig
# Copyright (c) 2025 Renesas Electronics Corporation
# SPDX-License-Identifier: Apache-2.0

config SOC_SERIES_RZV2L
	bool
	select SOC_FAMILY_RENESAS_RZ
	help
	  Renesas RZ/V2L series

config SOC_SERIES
	default "rzv2l" if SOC_SERIES_RZV2L

config SOC_R9A07G054L23GBG
	bool
	select SOC_SERIES_RZV2L
	help
	  R9A07G054L23GBG

config SOC_R9A07G054L23GBG_CM33
	bool
	select SOC_R9A07G054L23GBG

config SOC
	default "r9a07g054l23gbg" if SOC_R9A07G054L23GBG
```

## soc/renesas/rz/rzv2n/Kconfig
```kconfig
# Copyright (c) 2025 Renesas Electronics Corporation
# SPDX-License-Identifier: Apache-2.0

config SOC_SERIES_RZV2N
	select ARM
	select CPU_CORTEX_M33
	select CPU_HAS_ARM_MPU
	select HAS_RENESAS_RZ_FSP
	select CPU_CORTEX_M_HAS_DWT
	select SOC_EARLY_INIT_HOOK
	select CPU_HAS_FPU
	select ARMV8_M_DSP
```

## soc/renesas/rz/rzv2n/Kconfig.soc
```kconfig
# Copyright (c) 2025 Renesas Electronics Corporation
# SPDX-License-Identifier: Apache-2.0

config SOC_SERIES_RZV2N
	bool
	select SOC_FAMILY_RENESAS_RZ
	help
	  Renesas RZ/V2N series

config SOC_SERIES
	default "rzv2n" if SOC_SERIES_RZV2N

config SOC_R9A09G056N48GBG
	bool
	select SOC_SERIES_RZV2N
	help
	  R9A09G056N48GBG

config SOC_R9A09G056N48GBG_CM33
	bool
	select SOC_R9A09G056N48GBG

config SOC
	default "r9a09g056n48gbg" if SOC_R9A09G056N48GBG
```

## soc/renesas/rzt2m/Kconfig
```kconfig
# Copyright (c) 2023 Antmicro <www.antmicro.com>
# SPDX-License-Identifier: Apache-2.0

config SOC_RENESAS_RZT2M
	select ARM
	select CPU_CORTEX_R52
	select CPU_HAS_ARM_MPU
	select GIC_SINGLE_SECURITY_STATE
	select ARM_ARCH_TIMER
	select SYSCON
```

## soc/renesas/rzt2m/Kconfig.soc
```kconfig
# Copyright (c) 2023 Antmicro <www.antmicro.com>
# SPDX-License-Identifier: Apache-2.0

config SOC_RENESAS_RZT2M
	bool

config SOC_PART_NUMBER_R9A07G075
	bool

config SOC
	default "renesas_rzt2m" if SOC_RENESAS_RZT2M

config SOC_PART_NUMBER
	default "R9A07G075" if SOC_PART_NUMBER_R9A07G075
```

## soc/renesas/smartbond/Kconfig.defconfig
```kconfig
# Copyright (c) 2022 Renesas Electronics Corporation
# SPDX-License-Identifier: Apache-2.0

if SOC_FAMILY_RENESAS_SMARTBOND

rsource "*/Kconfig.defconfig"

endif # SOC_FAMILY_RENESAS_SMARTBOND
```

## soc/renesas/smartbond/Kconfig.soc
```kconfig
# Copyright (c) 2022 Renesas Electronics Corporation
# SPDX-License-Identifier: Apache-2.0

config SOC_FAMILY_RENESAS_SMARTBOND
	bool

config SOC_FAMILY
	default "renesas_smartbond" if SOC_FAMILY_RENESAS_SMARTBOND

rsource "*/Kconfig.soc"
```

## soc/renesas/smartbond/da1469x/Kconfig
```kconfig
# Copyright (c) 2022 Renesas Electronics Corporation
# SPDX-License-Identifier: Apache-2.0

config SOC_SERIES_DA1469X
	select ARM
	select CPU_CORTEX_M33
	select CPU_HAS_FPU
	select CPU_HAS_ARM_MPU
	select CPU_CORTEX_M_HAS_SYSTICK
	select ARMV8_M_DSP
	select HAS_SEGGER_RTT if ZEPHYR_SEGGER_MODULE
	select HAS_PM
	select CLOCK_CONTROL
	select CLOCK_CONTROL_SMARTBOND
	select SOC_RESET_HOOK
	select PM_DEVICE if PM
	select SOC_EARLY_INIT_HOOK
	imply TIMER_READS_ITS_FREQUENCY_AT_RUNTIME
```

## soc/renesas/smartbond/da1469x/Kconfig.defconfig
```kconfig
# Copyright (c) 2022 Renesas Electronics Corporation
# SPDX-License-Identifier: Apache-2.0

if SOC_SERIES_DA1469X

config SMARTBOND_TIMER
	default y if PM && !$(dt_nodelabel_enabled,timer2)

config CORTEX_M_SYSTICK
	default n if SMARTBOND_TIMER

config NUM_IRQS
	default 40

DT_LPCLK_PATH := $(dt_nodelabel_path,lp_clk)
DT_CLOCK_SRC_PATH := $(dt_node_ph_prop_path,$(DT_LPCLK_PATH),clock-src)

config SYS_CLOCK_HW_CYCLES_PER_SEC
	default $(dt_node_int_prop_int,/cpus/cpu@0,clock-frequency) if CORTEX_M_SYSTICK
	default $(dt_node_int_prop_int,$(DT_CLOCK_SRC_PATH),clock-frequency) if SMARTBOND_TIMER

config SYS_CLOCK_TICKS_PER_SEC
	default $(dt_node_int_prop_int,$(DT_CLOCK_SRC_PATH),clock-frequency) if SMARTBOND_TIMER

config SRAM_VECTOR_TABLE
	default y

config USE_DT_CODE_PARTITION
	default y if MCUBOOT

config FLASH_BASE_ADDRESS
	default $(dt_chosen_reg_addr_hex,$(DT_CHOSEN_Z_FLASH))

config FLASH_LOAD_OFFSET
	default 0x2400 if !USE_DT_CODE_PARTITION

# Enable sleep and voltage rails manager so that
# the device consumes the lowest possible current
config PM
	default y

config PM_DEVICE
	default y

config REGULATOR
	default y

config PM_DEVICE_RUNTIME_EXCLUSIVE
	default n if PM_DEVICE_RUNTIME

endif # SOC_SERIES_DA1469X
```

## soc/renesas/smartbond/da1469x/Kconfig.soc
```kconfig
# Copyright (c) 2022 Renesas Electronics Corporation
# SPDX-License-Identifier: Apache-2.0

config SOC_SERIES_DA1469X
	bool
	select SOC_FAMILY_RENESAS_SMARTBOND

config SOC_DA14695
	bool
	select SOC_SERIES_DA1469X

config SOC_DA14699
	bool
	select SOC_SERIES_DA1469X

config SOC_SERIES
	default "da1469x" if SOC_SERIES_DA1469X

config SOC
	default "da14695" if SOC_DA14695
	default "da14699" if SOC_DA14699
```

## soc/renesas_ra/Kconfig
```kconfig
# Copyright (c) 2023 TOKITA Hiroshi <tokita.hiroshi@fujitsu.com>
# SPDX-License-Identifier: Apache-2.0

config SOC_FAMILY_RENESAS_RA
	select BUILD_OUTPUT_HEX

rsource "*/Kconfig"
```

## soc/renesas_ra/Kconfig.defconfig
```kconfig
# Copyright (c) 2023 TOKITA Hiroshi <tokita.hiroshi@fujitsu.com>
# SPDX-License-Identifier: Apache-2.0

if SOC_FAMILY_RENESAS_RA

rsource "*/Kconfig.defconfig.series"

config PINCTRL
	default y

config CLOCK_CONTROL
	default y

endif # SOC_FAMILY_RENESAS_RA
```

## soc/renesas_rzt2m/Kconfig
```kconfig
# Copyright (c) 2023 Antmicro <www.antmicro.com>
# SPDX-License-Identifier: Apache-2.0

config SOC_RENESAS_RZT2M
	select ARM
	select CPU_CORTEX_R52
	select CPU_HAS_ARM_MPU
	select GIC_V3
	select GIC_SINGLE_SECURITY_STATE
	select ARM_ARCH_TIMER
	select SYSCON

if SOC_RENESAS_RZT2M

config SOC_PART_NUMBER_R9A07G075
	bool

config SOC_PART_NUMBER
	default SOC_PART_NUMBER_R9A07G075

endif # SOC_RENESAS_RZT2M
```

## soc/renesas_rzt2m/Kconfig.defconfig
```kconfig
# Copyright (c) 2023 Antmicro <www.antmicro.com>
# SPDX-License-Identifier: Apache-2.0

if SOC_RENESAS_RZT2M

config NUM_IRQS
	default 994

config SYS_CLOCK_HW_CYCLES_PER_SEC
	default 20000000

config FPU
	default y

config FLASH_SIZE
	default 0

config FLASH_BASE_ADDRESS
	default 0

endif # SOC_RENESAS_RZT2M
```

## soc/renesas_rzt2m/Kconfig.soc
```kconfig
# Copyright (c) 2023 Antmicro <www.antmicro.com>
# SPDX-License-Identifier: Apache-2.0

config SOC_RENESAS_RZT2M
	bool

config SOC
	default "renesas_rzt2m"
	depends on SOC_RENESAS_RZT2M
```
