## soc/renesas/rcar/Kconfig.soc
```kconfig
# Renesas R-Car SoC line
# Copyright (c) 2021 IoT.bzh
# SPDX-License-Identifier: Apache-2.0

config SOC_FAMILY_RENESAS_RCAR
	bool

config SOC_FAMILY
	default "renesas_rcar" if SOC_FAMILY_RENESAS_RCAR

rsource "*/Kconfig.soc"
```

## soc/renesas/rcar/rcar_gen3/Kconfig
```kconfig
# Copyright (c) 2021 IoT.bzh
# SPDX-License-Identifier: Apache-2.0

config SOC_SERIES_RCAR_GEN3
	select CLOCK_CONTROL_RCAR_CPG_MSSR if CLOCK_CONTROL

config SOC_R8A77951_R7
	select ARM
	select CPU_CORTEX_R7
	select PLATFORM_SPECIFIC_INIT
	select CPU_HAS_DCLS

config SOC_R8A77951_A57
	select ARM64
	select CPU_CORTEX_A57
	select ARM_ARCH_TIMER if SYS_CLOCK_EXISTS

config SOC_R8A77961
	select ARM64
	select CPU_CORTEX_A57
	select ARM_ARCH_TIMER if SYS_CLOCK_EXISTS
```

## soc/renesas/rcar/rcar_gen3/Kconfig.defconfig
```kconfig
# Renesas R-Car Gen3 SoC line

# Copyright (c) 2021 IoT.bzh
# SPDX-License-Identifier: Apache-2.0

if SOC_SERIES_RCAR_GEN3

config NUM_IRQS
	default 512

endif # SOC_SERIES_RCAR_GEN3
```

## soc/renesas/rcar/rcar_gen3/Kconfig.soc
```kconfig
# Copyright (c) 2021 IoT.bzh
# SPDX-License-Identifier: Apache-2.0

config SOC_SERIES_RCAR_GEN3
	bool
	select SOC_FAMILY_RENESAS_RCAR

config SOC_R8A77951_R7
	bool
	select SOC_SERIES_RCAR_GEN3
	help
	  R8A77951 R7

config SOC_R8A77951_A57
	bool
	select SOC_SERIES_RCAR_GEN3
	help
	  R8A77951 A57

config SOC_R8A77961
	bool
	select SOC_SERIES_RCAR_GEN3
	help
	  R8A77961

config SOC_SERIES
	default "rcar_gen3" if SOC_SERIES_RCAR_GEN3

config SOC
	default "r8a77951" if SOC_R8A77951_R7 || SOC_R8A77951_A57
	default "r8a77961" if SOC_R8A77961
```

## soc/renesas/rcar/rcar_gen4/Kconfig
```kconfig
# Copyright (c) 2023 IoT.bzh
# SPDX-License-Identifier: Apache-2.0

config SOC_R8A779F0_R52
	select ARM
	select CPU_CORTEX_R52
	select GIC_SINGLE_SECURITY_STATE
	select CLOCK_CONTROL_RCAR_CPG_MSSR if CLOCK_CONTROL
	select ARM_ARCH_TIMER

config SOC_R8A779F0_A55
	select ARM64
	select CPU_CORTEX_A55
	select CLOCK_CONTROL_RCAR_CPG_MSSR if CLOCK_CONTROL
	select ARM_ARCH_TIMER
```

## soc/renesas/rcar/rcar_gen4/Kconfig.defconfig
```kconfig
# Renesas R-Car Gen4 SoC line

# Copyright (c) 2023 IoT.bzh
# SPDX-License-Identifier: Apache-2.0

if SOC_SERIES_RCAR_GEN4

rsource "Kconfig.defconfig.r8a779*"

endif # SOC_SERIES_RCAR_GEN4
```

## soc/renesas/rcar/rcar_gen4/Kconfig.defconfig.r8a779f0
```kconfig
# Copyright (c) 2023 IoT.bzh
# Copyright (c) 2025 Renesas Electronics Corporation
# SPDX-License-Identifier: Apache-2.0

if SOC_R8A779F0_R52 || SOC_R8A779F0_A55

config NUM_IRQS
	default 1216 #960 SPI + 256 LPI

endif # SOC_R8A779F0_R52 || SOC_R8A779F0_A55
```

## soc/renesas/rcar/rcar_gen4/Kconfig.defconfig.r8a779g0
```kconfig
# Copyright (c) 2023 IoT.bzh
# Copyright (c) 2025 Renesas Electronics Corporation
# SPDX-License-Identifier: Apache-2.0

if SOC_R8A779G0_R52

config NUM_IRQS
	default 991

# Arm Generic Timer frequency (Hz)
config SYS_CLOCK_HW_CYCLES_PER_SEC
	default $(dt_node_int_prop_int,/timer,clock-frequency)

# Clock Pulse Generator
config CLOCK_CONTROL
	default y

endif # SOC_R8A779G0_R52
```

## soc/renesas/rcar/rcar_gen4/Kconfig.soc
```kconfig
# Copyright (c) 2023 IoT.bzh
# SPDX-License-Identifier: Apache-2.0

config SOC_SERIES_RCAR_GEN4
	bool
	select SOC_FAMILY_RENESAS_RCAR

config SOC_R8A779F0_R52
	bool
	select SOC_SERIES_RCAR_GEN4
	help
	  r8a779f0 r52

config SOC_R8A779F0_A55
	bool
	select SOC_SERIES_RCAR_GEN4
	help
	  r8a779f0 a55

config SOC_SERIES
	default "rcar_gen4" if SOC_SERIES_RCAR_GEN4

config SOC
	default "r8a779f0" if SOC_R8A779F0_R52 || SOC_R8A779F0_A55
```

## soc/renesas/rcar/rcar_gen5/Kconfig
```kconfig
# Copyright (c) 2026 BayLibre, SAS
# SPDX-License-Identifier: Apache-2.0

config SOC_R8A78000_R52
	select ARM
	select CPU_CORTEX_R52
	select GIC_SINGLE_SECURITY_STATE
	select CLOCK_CONTROL_ARM_SCMI if CLOCK_CONTROL
	select ARM_ARCH_TIMER
```

## soc/renesas/rcar/rcar_gen5/Kconfig.defconfig
```kconfig
# Renesas R-Car Gen5 SoC line

# Copyright (c) 2026 BayLibre, SAS
# SPDX-License-Identifier: Apache-2.0

if SOC_SERIES_RCAR_GEN5

rsource "Kconfig.defconfig.r8a780*"

endif # SOC_SERIES_RCAR_GEN5
```

## soc/renesas/rcar/rcar_gen5/Kconfig.defconfig.r8a78000
```kconfig
# Copyright (c) 2026 BayLibre, SAS
# SPDX-License-Identifier: Apache-2.0

if SOC_SERIES_RCAR_GEN5

config NUM_IRQS
	default 1216 # 960 SPI + 256 LPI

config SYS_CLOCK_HW_CYCLES_PER_SEC
	default $(dt_node_int_prop_int,$(dt_nodelabel_path,arch_timer),clock-frequency)

# Mailbox and SCMI depend on GIC. Set their init priority to GIC's.
# They will be initialized in order according to dts dependencies.
config MBOX_INIT_PRIORITY
	default INTC_INIT_PRIORITY

config ARM_SCMI_SHMEM_INIT_PRIORITY
	default INTC_INIT_PRIORITY

config ARM_SCMI_TRANSPORT_INIT_PRIORITY
	default INTC_INIT_PRIORITY

config CLOCK_CONTROL_INIT_PRIORITY
	default INTC_INIT_PRIORITY

config POWER_DOMAIN_ARM_SCMI_INIT_PRIORITY
	default INTC_INIT_PRIORITY

if PM_DEVICE

config PM_DEVICE_RUNTIME
	default y

config POWER_DOMAIN
	default y

endif # PM_DEVICE

endif # SOC_SERIES_RCAR_GEN5
```

## soc/renesas/rcar/rcar_gen5/Kconfig.soc
```kconfig
# Copyright (c) 2026 BayLibre, SAS
# SPDX-License-Identifier: Apache-2.0

config SOC_SERIES_RCAR_GEN5
	bool
	select SOC_FAMILY_RENESAS_RCAR
	help
	  Support for R-Car Gen5 SoC series

config SOC_R8A78000_R52
	bool
	select SOC_SERIES_RCAR_GEN5
	help
	  Support for R8A78000 R52 core

config SOC_SERIES
	default "rcar_gen5" if SOC_SERIES_RCAR_GEN5

config SOC
	default "r8a78000" if SOC_R8A78000_R52
```

## soc/renesas/rcar/rcar_gen5/r52/Kconfig.defconfig
```kconfig
# Copyright (c) 2026 BayLibre, SAS
# SPDX-License-Identifier: Apache-2.0

if SOC_R8A78000_R52

config NUM_IRQS
	default 992 # SPI (INTIDs 32..991)

endif # SOC_R8A78000_R52
```

## soc/renesas/rh850/Kconfig
```kconfig
# Copyright (c) 2026 Renesas Electronics Corporation
# SPDX-License-Identifier: Apache-2.0

if SOC_FAMILY_RENESAS_RH850

rsource "*/Kconfig"

endif # SOC_FAMILY_RENESAS_RH850
```

## soc/renesas/rh850/rh850u2b/Kconfig
```kconfig
# SPDX-License-Identifier: Apache-2.0

config SOC_SERIES_RH850U2B
	select RH850
	select CPU_G4MH
	select XIP
	select HAS_RENESAS_RH850_FSP
	select SOC_EARLY_INIT_HOOK
	select HAS_FLASH_LOAD_OFFSET
	select CPU_HAS_FPU
	select MULTITHREADING
	select ARCH_HAS_CUSTOM_SWAP_TO_MAIN
	select RH850_RAM_INIT
	select RH850_RAM_INIT_CHECK_RESET
```

## soc/renesas/rx/Kconfig
```kconfig
# Copyright (c) 2024 Renesas Electronics Corporation
# SPDX-License-Identifier: Apache-2.0

config SOC_FAMILY_RENESAS_RX
	select BUILD_OUTPUT_MOT

if SOC_FAMILY_RENESAS_RX

config RENESAS_NONE_USED_PORT_INIT
	bool "Initialize unused ports"
	default y
	help
	  Initialize the unsed pins of RX MCU followed by in the "Handling of
	  Unused Pins" section of PORT chapter of RX MCU of User's manual.
	  Note: please MUST set "BSP_PACKAGE_PINS" definition to your device
	  of pin type in r_bsp_config.h.
	  Otherwise, the port may output without intention.

rsource "*/Kconfig"

endif # SOC_FAMILY_RENESAS_RX
```

## soc/renesas/rx/Kconfig.defconfig
```kconfig
# Copyright (c) 2024 Renesas Electronics Corporation
# SPDX-License-Identifier: Apache-2.0

if SOC_FAMILY_RENESAS_RX

rsource "*/Kconfig.defconfig"

endif
```

## soc/renesas/rx/Kconfig.soc
```kconfig
# Copyright (c) 2024 Renesas Electronics Corporation
# SPDX-License-Identifier: Apache-2.0

config SOC_FAMILY_RENESAS_RX
	bool

config SOC_FAMILY
	default "renesas_rx" if SOC_FAMILY_RENESAS_RX

rsource "*/Kconfig.soc"
```

## soc/renesas/rx/rx130/Kconfig
```kconfig
# Copyright (c) 2024 Renesas Electronics Corporation
# SPDX-License-Identifier: Apache-2.0

config SOC_SERIES_RX130
	select RX
	select CPU_RXV1
	select XIP
	select CLOCK_CONTROL_RENESAS_RX_CGC if CLOCK_CONTROL
	select HAS_RENESAS_RX_RDP
	select CLOCK_CONTROL
	select SOC_EARLY_INIT_HOOK
	select HAS_PM

if SOC_SERIES_RX130
if WDT_RENESAS_RX_IWDT_AUTO_START_MODE

choice
	prompt "IWDT OFS0 Start Mode Select"
	default WDT_RENESAS_RX_STARTMODE_HALT

config WDT_RENESAS_RX_STARTMODE_AUTO_ACTIVATE
	bool "IWDT is automatically activated in auto-start mode after a reset"

config WDT_RENESAS_RX_STARTMODE_HALT
	bool "IWDT is halted after a reset"

endchoice

config WDT_RENESAS_RX_OFS0_IWDTSTRT
	int
	default 0 if WDT_RENESAS_RX_STARTMODE_HALT
	default 1 if WDT_RENESAS_RX_STARTMODE_AUTO_ACTIVATE

choice
	prompt "IWDT Timeout Period Select"
	default WDT_RENESAS_RX_OFS0_TIMEOUT_PERIOD_2048

config WDT_RENESAS_RX_OFS0_TIMEOUT_PERIOD_128
	bool "128 cycles"

config WDT_RENESAS_RX_OFS0_TIMEOUT_PERIOD_512
	bool "512 cycles"

config WDT_RENESAS_RX_OFS0_TIMEOUT_PERIOD_1024
	bool "1024 cycles"

config WDT_RENESAS_RX_OFS0_TIMEOUT_PERIOD_2048
	bool "2048 cycles"

endchoice

config WDT_RENESAS_RX_OFS0_TIMEOUT_IWDTTOPS
	int
	default 0 if WDT_RENESAS_RX_OFS0_TIMEOUT_PERIOD_128
	default 1 if WDT_RENESAS_RX_OFS0_TIMEOUT_PERIOD_512
	default 2 if WDT_RENESAS_RX_OFS0_TIMEOUT_PERIOD_1024
	default 3 if WDT_RENESAS_RX_OFS0_TIMEOUT_PERIOD_2048

choice
	prompt "IWDT Clock Divide Ratio Select"
	default WDT_RENESAS_RX_OFS0_CLKDIV_128

config WDT_RENESAS_RX_OFS0_CLKDIV_1
	bool "No division"

config WDT_RENESAS_RX_OFS0_CLKDIV_16
	bool "Divide-by-16"

config WDT_RENESAS_RX_OFS0_CLKDIV_32
	bool "Divide-by-32"

config WDT_RENESAS_RX_OFS0_CLKDIV_64
	bool "Divide-by-64"

config WDT_RENESAS_RX_OFS0_CLKDIV_128
	bool "Divide-by-128"

config WDT_RENESAS_RX_OFS0_CLKDIV_256
	bool "Divide-by-256"

endchoice

config WDT_RENESAS_RX_OFS0_CLKDIV_IWDTCKS
	int
	default 0 if WDT_RENESAS_RX_OFS0_CLKDIV_1
	default 2 if WDT_RENESAS_RX_OFS0_CLKDIV_16
	default 3 if WDT_RENESAS_RX_OFS0_CLKDIV_32
	default 4 if WDT_RENESAS_RX_OFS0_CLKDIV_64
	default 15 if WDT_RENESAS_RX_OFS0_CLKDIV_128
	default 5 if WDT_RENESAS_RX_OFS0_CLKDIV_256

choice
	prompt "IWDT Window Start Position Select"
	default WDT_RENESAS_RX_OFS0_IWDT_WINDOW_STRT_100

config WDT_RENESAS_RX_OFS0_IWDT_WINDOW_STRT_25
	bool "25%"

config WDT_RENESAS_RX_OFS0_IWDT_WINDOW_STRT_50
	bool "50%"

config WDT_RENESAS_RX_OFS0_IWDT_WINDOW_STRT_75
	bool "75%"

config WDT_RENESAS_RX_OFS0_IWDT_WINDOW_STRT_100
	bool "100% (window start position is not specified.)"

endchoice

config WDT_RENESAS_RX_OFS0_WINDOW_STRT_IWDTRPSS
	int
	default 0 if WDT_RENESAS_RX_OFS0_IWDT_WINDOW_STRT_25
	default 1 if WDT_RENESAS_RX_OFS0_IWDT_WINDOW_STRT_50
	default 2 if WDT_RENESAS_RX_OFS0_IWDT_WINDOW_STRT_75
	default 3 if WDT_RENESAS_RX_OFS0_IWDT_WINDOW_STRT_100

choice
	prompt "IWDT Window End Position Select"
	default WDT_RENESAS_RX_OFS0_IWDT_WINDOW_END_0

config WDT_RENESAS_RX_OFS0_IWDT_WINDOW_END_75
	bool "75%"

config WDT_RENESAS_RX_OFS0_IWDT_WINDOW_END_50
	bool "50%"

config WDT_RENESAS_RX_OFS0_IWDT_WINDOW_END_25
	bool "25%"

config WDT_RENESAS_RX_OFS0_IWDT_WINDOW_END_0
	bool "0% (window end position is not specified.)"

endchoice

config WDT_RENESAS_RX_OFS0_WINDOW_END_IWDTRPES
	int
	default 0 if WDT_RENESAS_RX_OFS0_IWDT_WINDOW_END_75
	default 1 if WDT_RENESAS_RX_OFS0_IWDT_WINDOW_END_50
	default 2 if WDT_RENESAS_RX_OFS0_IWDT_WINDOW_END_25
	default 3 if WDT_RENESAS_RX_OFS0_IWDT_WINDOW_END_0

choice
	prompt "IWDT Reset Interrupt Request Select"
	default WDT_RENESAS_RX_OFS0_IRQ_ENA

config WDT_RENESAS_RX_OFS0_IRQ_ENA
	bool "Non-maskable interrupt request output is enabled."

config WDT_RENESAS_RX_OFS0_RESET_ENA
	bool "Reset output is enabled."

endchoice

config WDT_RENESAS_RX_OFS0_IRQ_SEL_IWDTRSTIRQS
	int
	default 0 if WDT_RENESAS_RX_OFS0_IRQ_ENA
	default 1 if WDT_RENESAS_RX_OFS0_RESET_ENA

choice
	prompt "IWDT Sleep Mode Count Stop Control"
	default WDT_RENESAS_RX_OFS0_COUNT_STOP_DIS

config WDT_RENESAS_RX_OFS0_COUNT_STOP_ENA
	bool "Count stop is disabled"

config WDT_RENESAS_RX_OFS0_COUNT_STOP_DIS
	bool "Count is stopped at a transition to sleep mode, software standby mode, or deep sleep mode."

endchoice

config WDT_RENESAS_RX_OFS0_IWDTSLCSTP
	int "IWDT Sleep Mode Count Stop Control"
	default 0 if WDT_RENESAS_RX_OFS0_COUNT_STOP_DIS
	default 1 if WDT_RENESAS_RX_OFS0_COUNT_STOP_ENA

endif # WDT_RENESAS_RX_IWDT_AUTO_START_MODE
endif # SOC_SERIES_RX130
```

## soc/renesas/rx/rx130/Kconfig.defconfig
```kconfig
# Copyright (c) 2024 Renesas Electronics Corporation
# SPDX-License-Identifier: Apache-2.0

if SOC_SERIES_RX130

# Set the PCLKB/8 frequency to SYS_CLOCK_HW_CYCLES_PER_SEC.
# Because the CMT of Systick Timer divides the source clock of PCLKB by 8-divider.
config SYS_CLOCK_HW_CYCLES_PER_SEC
	default 4000000

# SYS_CLOCK_TICKS_PER_SEC is set to 100 if PCLKB is 48MHz or less.
# (PCLKB = SYS_CLOCK_HW_CYCLES_PER_SEC * 8)
config SYS_CLOCK_TICKS_PER_SEC
	default 100 if SYS_CLOCK_HW_CYCLES_PER_SEC <= 6000000
	default 1000

endif # SOC_SERIES_RX130
```

## soc/renesas/rx/rx130/Kconfig.soc
```kconfig
# Copyright (c) 2024 Renesas Electronics Corporation
# SPDX-License-Identifier: Apache-2.0

config SOC_SERIES_RX130
	bool
	select SOC_FAMILY_RENESAS_RX
	help
	  Renesas RX130 series

config SOC_R5F51308AXFP
	bool
	select SOC_SERIES_RX130
	help
	  R5F51308AXFP

config SOC_SERIES
	default "rx130" if SOC_SERIES_RX130

config SOC
	default "r5f51308axfp" if SOC_R5F51308AXFP
```

## soc/renesas/rx/rx140/Kconfig
```kconfig
# Copyright (c) 2025 Renesas Electronics Corporation
# SPDX-License-Identifier: Apache-2.0

config SOC_SERIES_RX140
	select RX
	select CPU_RXV2
	select XIP
	select CLOCK_CONTROL_RENESAS_RX_CGC if CLOCK_CONTROL
	select HAS_RENESAS_RX_RDP
	select CLOCK_CONTROL
	select SOC_EARLY_INIT_HOOK
```

## soc/renesas/rx/rx140/Kconfig.soc
```kconfig
# Copyright (c) 2025 Renesas Electronics Corporation
# SPDX-License-Identifier: Apache-2.0

config SOC_SERIES_RX140
	bool
	select SOC_FAMILY_RENESAS_RX
	help
	  Renesas RX140 series

config SOC_R5F51406BDFN
	bool
	select SOC_SERIES_RX140
	help
	  R5F51406BDFN

config SOC_R5F51406BGFN
	bool
	select SOC_SERIES_RX140
	help
	  R5F51406BGFN

config SOC_SERIES
	default "rx140" if SOC_SERIES_RX140

config SOC
	default "r5f51406bdfn" if SOC_R5F51406BDFN
	default "r5f51406bgfn" if SOC_R5F51406BGFN
```

## soc/renesas/rx/rx14t/Kconfig
```kconfig
# Copyright (c) 2026 Renesas Electronics Corporation
# SPDX-License-Identifier: Apache-2.0

config SOC_SERIES_RX14T
	select RX
	select CPU_RXV2
	select XIP
	select CLOCK_CONTROL_RENESAS_RX_CGC if CLOCK_CONTROL
	select HAS_RENESAS_RX_RDP
	select CLOCK_CONTROL
	select SOC_EARLY_INIT_HOOK
```
