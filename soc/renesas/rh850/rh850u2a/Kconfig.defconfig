## soc/renesas/rh850/rh850u2a/Kconfig.defconfig
```kconfig
# SPDX-FileCopyrightText: Copyright (c) 2026 Linumiz
#
# SPDX-License-Identifier: Apache-2.0

if SOC_SERIES_RH850U2A

config NUM_IRQS
	default 768

config RH850_MPU_ENTRIES
	default 32

config SYS_CLOCK_HW_CYCLES_PER_SEC
	default $(dt_nodelabel_int_prop,ostm0,clock-frequency)

endif # SOC_SERIES_RH850U2A
```

## soc/renesas/rh850/rh850u2c/Kconfig.defconfig
```kconfig
# SPDX-FileCopyrightText: Copyright (c) 2026 Linumiz
#
# SPDX-License-Identifier: Apache-2.0

if SOC_SERIES_RH850U2C

config NUM_IRQS
	default 630

config RH850_MPU_ENTRIES
	default 24

config SYS_CLOCK_HW_CYCLES_PER_SEC
	default $(dt_nodelabel_int_prop,ostm0,clock-frequency)

endif # SOC_SERIES_RH850U2C
```

## soc/renode/riscv_virtual/Kconfig.defconfig
```kconfig
# Copyright (c) 2023 Meta
# SPDX-License-Identifier: Apache-2.0

if SOC_RISCV_VIRTUAL_RENODE

config RISCV_SOC_INTERRUPT_INIT
	default y

config 1ST_LEVEL_INTERRUPT_BITS
	default 4

config 2ND_LEVEL_INTERRUPT_BITS
	default 11

config 2ND_LVL_ISR_TBL_OFFSET
	default 12

config 2ND_LVL_INTR_00_OFFSET
	default 11

config MAX_IRQ_PER_AGGREGATOR
	default 1023

config NUM_IRQS
	default 1035

endif # SOC_RISCV_VIRTUAL_RENODE
```

## soc/rockchip/rk35/rk3506/Kconfig
```kconfig
# Copyright (c) 2026 Jiaming Zhao
# SPDX-License-Identifier: Apache-2.0

config SOC_RK3506_A7
	select ARM
	select CPU_CORTEX_A7
	select ARM_ARCH_TIMER
	select ARM_AARCH32_MMU
	select ARM_MMU_MAP_VECTORS
	select SYS_CLOCK_EXISTS
	select SOC_RESET_HOOK

config SOC_PART_NUMBER
	default "RK3506" if SOC_RK3506
```

## soc/rockchip/rk35/rk3506/Kconfig.defconfig
```kconfig
# Copyright (c) 2026 Jiaming Zhao
# SPDX-License-Identifier: Apache-2.0

if SOC_RK3506_A7

config NUM_IRQS
	default 192

config SYS_CLOCK_HW_CYCLES_PER_SEC
	default $(dt_node_int_prop_int,/timer,clock-frequency)

configdefault UART_NS16550_DW8250_DW_APB
	default y

configdefault UART_NS16550_ACCESS_WORD_ONLY
	default y

endif # SOC_RK3506_A7
```

## soc/rockchip/rk35/rk3506/Kconfig.soc
```kconfig
# Copyright (c) 2026 Jiaming Zhao
# SPDX-License-Identifier: Apache-2.0

config SOC_RK3506
	bool
	select SOC_SERIES_RK35

config SOC_RK3506_A7
	bool
	select SOC_RK3506
	help
	  Rockchip RK3506 Cortex-A7 cluster

config SOC
	default "rk3506" if SOC_RK3506
```

## soc/rockchip/rk35/rk3566/Kconfig
```kconfig
# SPDX-FileCopyrightText: 2026 Seunghoon Park
# SPDX-License-Identifier: Apache-2.0

config SOC_RK3566
	select ARM64
	select CPU_CORTEX_A55
	select ARM_ARCH_TIMER

config SOC_PART_NUMBER
	default "RK3566" if SOC_RK3566
```

## soc/rockchip/rk35/rk3566/Kconfig.defconfig
```kconfig
# SPDX-FileCopyrightText: 2026 Seunghoon Park
# SPDX-License-Identifier: Apache-2.0

if SOC_RK3566

rsource "Kconfig.defconfig.rk3566"

endif # SOC_RK3566
```

## soc/rockchip/rk35/rk3566/Kconfig.soc
```kconfig
# SPDX-FileCopyrightText: 2026 Seunghoon Park
# SPDX-License-Identifier: Apache-2.0

config SOC_RK3566
	bool
	select SOC_SERIES_RK35

config SOC
	default "rk3566" if SOC_RK3566
```

## soc/ti/simplelink/cc13x4_cc26x4/Kconfig
```kconfig
# Copyright (c) 2026 Texas Instruments
# SPDX-License-Identifier: Apache-2.0

if SOC_SERIES_CC13X4_CC26X4

config SOC_SERIES_CC13X4_CC26X4
	select ARM
	select CPU_CORTEX_M33
	select CPU_HAS_FPU
	select ARMV8_M_DSP
	select CPU_HAS_ARM_MPU
	select CPU_HAS_DSP
	select DYNAMIC_INTERRUPTS
	select CPU_CORTEX_M_HAS_DWT
	select HAS_CC13X4_CC26X4_SDK
	select HAS_TI_CCFG if !BOOTLOADER_MCUBOOT
	select HAS_SEGGER_RTT if ZEPHYR_SEGGER_MODULE
	select HAS_PM
	select HAS_POWEROFF

menu "Customer Configuration (CCFG)"

config SOC_SERIES_CC13X4_CC26X4_BOOTLOADER_ENABLE
	bool "ROM bootloader"
	help
	Enable the serial bootloader in ROM on CC13x4/CC26x4 devices.
	Default disabled per TI production recommendation.

config SOC_SERIES_CC13X4_CC26X4_BOOTLOADER_BACKDOOR_ENABLE
	bool "ROM bootloader backdoor"
	depends on SOC_SERIES_CC13X4_CC26X4_BOOTLOADER_ENABLE

config SOC_SERIES_CC13X4_CC26X4_XOSC_CAPARRAY_DELTA
	hex "Cap array tuning delta"
	range 0 0xFF
	default 0xFF

endmenu

endif # SOC_SERIES_CC13X4_CC26X4
```

## soc/ti/simplelink/cc13x4_cc26x4/Kconfig.defconfig
```kconfig
# Copyright (c) 2026 Texas Instruments
# SPDX-License-Identifier: Apache-2.0

if SOC_SERIES_CC13X4_CC26X4

configdefault SYS_CLOCK_HW_CYCLES_PER_SEC
	default $(dt_node_int_prop_int,/rtc-clock,clock-frequency)

configdefault SYS_CLOCK_TICKS_PER_SEC
	default $(dt_node_int_prop_int,/rtc-clock,clock-frequency)

configdefault NUM_IRQS
	default 43

configdefault CORTEX_M_SYSTICK
	default n

endif
```

## soc/wch/ch32v/qingke_v4a/Kconfig.defconfig
```kconfig
# SPDX-FileCopyrightText: Copyright The Zephyr Project Contributors
# SPDX-License-Identifier: Apache-2.0

if SOC_SERIES_QINGKE_V4A

configdefault SYS_CLOCK_HW_CYCLES_PER_SEC
	default $(dt_node_int_prop_int,/cpus/cpu@0,clock-frequency)

rsource "Kconfig.defconfig.*"

endif # SOC_SERIES_QINGKE_V4A
```

## soc/wch/ch32v/qingke_v4a/Kconfig.defconfig.ch582m
```kconfig
# SPDX-FileCopyrightText: Copyright The Zephyr Project Contributors
# SPDX-License-Identifier: Apache-2.0

if SOC_CH582M

configdefault VECTOR_TABLE_SIZE
	default 35

configdefault NUM_IRQS
	default 36

endif # SOC_CH582M
```

## soc/wch/ch32v/qingke_v4a/Kconfig.soc
```kconfig
# Copyright (c) 2026 Zephyr Project Contributors
# SPDX-License-Identifier: Apache-2.0

config SOC_SERIES_QINGKE_V4A
	bool
	select SOC_FAMILY_CH32V

config SOC_SERIES
	default "qingke_v4a" if SOC_SERIES_QINGKE_V4A

rsource "Kconfig.soc.*"
```

## soc/wch/ch32v/qingke_v4a/Kconfig.soc.ch582m
```kconfig
# Copyright (c) 2026 Zephyr Project Contributors
# SPDX-License-Identifier: Apache-2.0

config SOC_CH582M
	bool
	select SOC_SERIES_QINGKE_V4A

config SOC
	default "ch582m" if SOC_CH582M
```

## soc/wch/ch32v/qingke_v4c/Kconfig.defconfig.ch32x035
```kconfig
# Copyright (c) 2026 Chen Ren
# SPDX-License-Identifier: Apache-2.0

if SOC_CH32X035

config VECTOR_TABLE_SIZE
	default 55

config NUM_IRQS
	default 55

endif # SOC_CH32X035
```

## soc/wch/ch32v/qingke_v4c/Kconfig.soc.ch32x035
```kconfig
# Copyright (c) 2026 Chen Ren
# SPDX-License-Identifier: Apache-2.0

config SOC_CH32X035
	bool
	select SOC_SERIES_QINGKE_V4C

config SOC
	default "ch32x035" if SOC_CH32X035
```

## subsys/bluetooth/services/Kconfig.gap_svc
```kconfig
# GATT Generic Access Service - default implementation
#
# Copyright (c) 2019-2025 Intel Corporation
# Copyright (c) 2025 Koppel Electronic
#
# SPDX-License-Identifier: Apache-2.0

menuconfig BT_GAP_SVC
	bool "GATT Generic Access Service"
	default y
	help
	  Enable the default GATT Generic Access Service.
	  Enabled by default provides basic GAP functionality.
	  If disabled, it is the application responsibility to provide its own
	  implementation of GAP service, otherwise the system is not Bluetooth
	  qualification compliant.

if BT_GAP_SVC

config BT_DEVICE_NAME_GATT_WRITABLE
	bool "Allow to write device name by remote GATT clients"
	depends on BT_DEVICE_NAME_DYNAMIC
	default y
	help
	  Enabling this option allows remote GATT clients to write to device
	  name GAP characteristic.

if BT_DEVICE_NAME_GATT_WRITABLE
choice BT_DEVICE_NAME_GATT_WRITABLE_SECURITY
	prompt "Security requirements"
	default BT_DEVICE_NAME_GATT_WRITABLE_NONE if DEVICE_NAME_GATT_WRITABLE_NONE
	default BT_DEVICE_NAME_GATT_WRITABLE_AUTHEN if DEVICE_NAME_GATT_WRITABLE_AUTHEN
	default BT_DEVICE_NAME_GATT_WRITABLE_ENCRYPT if DEVICE_NAME_GATT_WRITABLE_ENCRYPT
	default BT_DEVICE_NAME_GATT_WRITABLE_ENCRYPT
	help
	  Select security requirements for writing device name by remote GATT
	  clients.

config BT_DEVICE_NAME_GATT_WRITABLE_NONE
	bool "No requirements"

config BT_DEVICE_NAME_GATT_WRITABLE_ENCRYPT
	bool "Encryption required"

config BT_DEVICE_NAME_GATT_WRITABLE_AUTHEN
	bool "Encryption and authentication required"

endchoice  #BT_DEVICE_NAME_GATT_WRITABLE_SECURITY

config DEVICE_NAME_GATT_WRITABLE_NONE
	bool "No requirements [DEPRECATED]"
	select DEPRECATED
	help
	  This option is deprecated. Select BT_DEVICE_NAME_GATT_WRITABLE_NONE instead.

config DEVICE_NAME_GATT_WRITABLE_ENCRYPT
	bool "Encryption required [DEPRECATED]"
	select DEPRECATED
	help
	  This option is deprecated. Select BT_DEVICE_NAME_GATT_WRITABLE_ENCRYPT instead.

config DEVICE_NAME_GATT_WRITABLE_AUTHEN
	bool "Encryption and authentication required [DEPRECATED]"
	select DEPRECATED
	help
	  This option is deprecated. Select BT_DEVICE_NAME_GATT_WRITABLE_AUTHEN instead.

endif #BT_DEVICE_NAME_GATT_WRITABLE

config BT_DEVICE_APPEARANCE_GATT_WRITABLE
	bool "Allow to write GAP Appearance by remote GATT clients"
	depends on BT_DEVICE_APPEARANCE_DYNAMIC
	default y
	help
	  Enabling this option allows remote GATT clients to write to device
	  appearance GAP characteristic.

if BT_DEVICE_APPEARANCE_GATT_WRITABLE
choice BT_DEVICE_APPEARANCE_GATT_WRITABLE_SECURITY
	prompt "Security requirements"
	default BT_DEVICE_APPEARANCE_GATT_WRITABLE_AUTHEN if DEVICE_APPEARANCE_GATT_WRITABLE_AUTHEN
	default BT_DEVICE_APPEARANCE_GATT_WRITABLE_AUTHEN
	help
	  Select security requirements for writing device appearance by remote
	  GATT clients.

config BT_DEVICE_APPEARANCE_GATT_WRITABLE_NONE
	bool "No requirements"

config BT_DEVICE_APPEARANCE_GATT_WRITABLE_ENCRYPT
	bool "Encryption required"

config BT_DEVICE_APPEARANCE_GATT_WRITABLE_AUTHEN
	bool "Encryption and authentication required"

endchoice  #BT_DEVICE_APPEARANCE_GATT_WRITABLE_SECURITY

config DEVICE_APPEARANCE_GATT_WRITABLE_AUTHEN
	bool "Encryption and authentication required [DEPRECATED]"
	select DEPRECATED
	help
	  This option is deprecated. Select BT_DEVICE_APPEARANCE_GATT_WRITABLE_AUTHEN instead.

endif #BT_DEVICE_APPEARANCE_GATT_WRITABLE

config BT_GAP_LE_GATT_SECURITY_LEVELS
	bool "LE GATT Security Levels characteristic [EXPERIMENTAL]" if !BT_TAK
	default y if BT_TAK
	select EXPERIMENTAL
	help
	  Add the LE GATT Security Levels characteristic to the GAP service. Its
	  value is the highest LE security mode 1 level that the permissions of
	  the attributes in the database require, followed by LE security mode 4
	  level 2 if BT_TAK is enabled and every attribute that requires security
	  permits a Transient Application Key. An attribute that requires LE
	  Secure Connections counts as mode 1 level 4, the lowest level that
	  implies them, also when it does not require authentication. Always
	  present in this GAP service with BT_TAK: a device that supports LE
	  security mode 4 has to have the characteristic.

endif #BT_GAP_SVC
```

## subsys/dap/Kconfig
```kconfig
# Copyright (c) 2018-2019 PHYTEC Messtechnik GmbH
# SPDX-License-Identifier: Apache-2.0

menuconfig DAP
	bool "Debug Access Port support [EXPERIMENTAL]"
	select EXPERIMENTAL
	select DP_DRIVER
	help
	  Debug Access Port support (currently CMSIS DAP only)

if DAP

config CMSIS_DAP_PACKET_COUNT
	int "Maximum packet buffers for request and response data."
	default 4
	range 1 $(UINT8_MAX)
	help
	  Maximum packet buffers for request and response data.

config CMSIS_DAP_PROBE_VENDOR
	string "Probe vendor"
	default "Zephyr"

config CMSIS_DAP_PROBE_NAME
	string "Probe name"
	default "CMSIS-DAP"

config CMSIS_DAP_BOARD_VENDOR
	string "Target board vendor"
	default ""

config CMSIS_DAP_BOARD_NAME
	string "Target board name"
	default ""

config CMSIS_DAP_DEVICE_VENDOR
	string "Target device vendor"
	default ""

config CMSIS_DAP_DEVICE_NAME
	string "Target device name"
	default ""

config DAP_BACKEND_USB
	bool "USB backend"
	depends on USB_DEVICE_STACK_NEXT
	help
	  DAP USB backend using bulk endpoints.

config DAP_BACKEND_USB_BUF_COUNT
	int "Number of USB OUT buffers"
	depends on DAP_BACKEND_USB
	default 4
	range 1 16
	help
	  Number of buffers queued on the bulk OUT endpoint. More buffers
	  let the host stream request packets while earlier ones are still
	  being executed, at the cost of RAM (512 bytes each).

module = DAP
module-str = dap
source "subsys/logging/Kconfig.template.log_config"

endif # DAP
```
