## subsys/debug/zassert/Kconfig
```kconfig
# Copyright (c) 2026 Måns Ansgariusson <mansgariusson@gmail.com>
# SPDX-License-Identifier: Apache-2.0

config ASSERT
	bool "Runtime assertion checking (ZASSERT)"
	default y if TEST
	depends on !FORCE_NO_ASSERT
	imply PRINTK
	help
	  This enables the ZASSERT macros.

	  Disabling this option will cause all assertions to compile to nothing,
	  improving performance and system footprint.

config ASSERT_LEVEL
	int "__ASSERT() level [DEPRECATED]"
	default 2
	range 0 2
	help
	  This option specifies the assertion level used by the __ASSERT()
	  macro. It can be set to one of three possible values:

	  Level 0: off
	  Level 1: on + warning in every file that includes __assert.h
	  Level 2: on + no warning

	  Deprecated: configure the system-wide default assertion level instead
	  (CONFIG_ASSERT_DEFAULT_LEVEL_OFF/TERSE/NORMAL/VERBOSE).


config FORCE_NO_ASSERT
	bool "Force-disable no assertions [DEPRECATED]"
	select DEPRECATED
	help
	  This boolean option disables Zephyr assertion testing even
	  in circumstances (twister) where it is enabled via
	  CFLAGS and not Kconfig.  Added solely to be able to work
	  around compiler bugs for specific tests.

	  Deprecated: use CONFIG_ASSERT=n to disable all ZASSERT modules.

config ASSERT_VERBOSE
	bool "Verbose assertions [DEPRECATED]"
	select DEPRECATED
	help
	  This option enables printing an assert message with information about
	  the assertion that occurred. This includes printing the location,
	  the conditional expression and additional message specific to the
	  assert.

	  Deprecated: sets the system-wide default assertion level to Verbose.
	  Configure it directly with CONFIG_ASSERT_DEFAULT_LEVEL_VERBOSE instead.

config ASSERT_NO_FILE_INFO
	bool "Disable file info for asserts [DEPRECATED]"
	select DEPRECATED
	help
	  This option removes the name and the path of the source file
	  in which the assertion occurred. Enabling this will save
	  target code space, and thus may be necessary for tiny targets.

	  Deprecated: sets the system-wide default assertion level to Terse.
	  Configure it directly with CONFIG_ASSERT_DEFAULT_LEVEL_TERSE instead.

config ASSERT_NO_COND_INFO
	bool "Disable condition info for asserts [DEPRECATED]"
	select DEPRECATED
	help
	  This option removes the assert condition from the printed assert
	  message. Enabling this will save target code space, and thus may be
	  necessary for tiny targets. It is recommended to disable condition
	  info before disabling file info since the condition can be found in
	  the source using file info.

	  Deprecated: sets the system-wide default assertion level to Terse.
	  Configure it directly with CONFIG_ASSERT_DEFAULT_LEVEL_TERSE instead.

config ASSERT_NO_MSG_INFO
	bool "Disable message for asserts [DEPRECATED]"
	select DEPRECATED
	help
	  This option removes the additional message from the printed assert.
	  Enabling this will save target code space, and thus may be
	  necessary for tiny targets. It is recommended to disable message
	  before disabling file info since the message can be found in the
	  source using file info.

	  Deprecated: sets the system-wide default assertion level to Terse.
	  Configure it directly with CONFIG_ASSERT_DEFAULT_LEVEL_TERSE instead.

choice
	prompt "Default assertion level for all assert modules"
	depends on ASSERT
	default ASSERT_DEFAULT_LEVEL_OFF if ASSERT_LEVEL = 0
	default ASSERT_DEFAULT_LEVEL_TERSE if !ASSERT_VERBOSE && \
		(ASSERT_NO_COND_INFO || ASSERT_NO_MSG_INFO || ASSERT_NO_FILE_INFO)
	default ASSERT_DEFAULT_LEVEL_VERBOSE
	help
	  System-wide default level used by all assert modules. Each module can still override
	  its own level.

config ASSERT_DEFAULT_LEVEL_OFF
	bool "Off"
	help
	  ZASSERT_LEVEL_OFF: assertions are compiled out.

config ASSERT_DEFAULT_LEVEL_TERSE
	bool "Terse (only check)"
	help
	  ZASSERT_LEVEL_TERSE: assertions are checked but the location, message, and its arguments
	  are not compiled in.

config ASSERT_DEFAULT_LEVEL_NORMAL
	bool "Normal (location only)"
	help
	  ZASSERT_LEVEL_NORMAL: assertions are checked and its location is printed but the message
	  and its arguments are not compiled in.

config ASSERT_DEFAULT_LEVEL_VERBOSE
	bool "Verbose (with message)"
	help
	  ZASSERT_LEVEL_VERBOSE: assertions are checked, location, the message, and its arguments
	  are compiled in.

endchoice

module = DEFAULT
module-str = the DEFAULT assert module
source "subsys/debug/zassert/Kconfig.template.assert"

config ASSERT_TEST
	bool "Assert test mode"
	help
	  This option enables the assert test mode, which allows the assert
	  post action handler to return (i.e. not abort) when the asserted
	  condition is false. The tests that validate the assert feature may
	  select this option to allow the test to proceed by implementing a
	  custom assert post action hook.
```

## subsys/ipc/ipc_service/backends/Kconfig.link
```kconfig
# SPDX-FileCopyrightText: Copyright (c) 2026 Basalte bv
# SPDX-License-Identifier: Apache-2.0

menuconfig IPC_SERVICE_BACKEND_LINK
	bool "IPC link backend [EXPERIMENTAL]"
	select EXPERIMENTAL
	select IPC_SERVICE_LINK
	help
	  IPC service backend over a transport that exchanges frames between
	  two processors. Selected by the transports.

if IPC_SERVICE_BACKEND_LINK

config IPC_SERVICE_BACKEND_LINK_INIT_PRIORITY
	int "Initialization priority"
	default 80
	help
	  Initialization priority of the link instances, after the UART, SPI
	  and GPIO drivers they use. Unlike the backends initialized at
	  IPC_SERVICE_REG_BACKEND_PRIORITY, an instance is only there for
	  code that runs after this priority.

config IPC_SERVICE_BACKEND_LINK_NUM_EP
	int "Endpoints per instance"
	range 1 254
	default 8
	help
	  Number of endpoints an instance can register.

config IPC_SERVICE_BACKEND_LINK_EPT_NAME_MAX
	int "Longest endpoint name"
	range 1 64
	default 32
	help
	  Longest endpoint name in bytes, carried in the bind messages. The
	  peer needs at least the same limit: it drops the bind of a name
	  longer than its own, and the endpoint never binds.

config IPC_SERVICE_BACKEND_LINK_RX_BUFFERS
	int "Receive buffers per instance"
	range 2 8
	default 3
	help
	  Frame buffers to receive into. One is always armed for the next
	  frame, the others hold received frames until their messages are
	  delivered and released: they are the credits given to the peer.
	  One less than this is also the number of payloads sent before the
	  first is acknowledged, as a peer configured alike has no credits
	  for more.

config IPC_SERVICE_BACKEND_LINK_MAX_RETRANSMITS
	int "Timeouts before the session ends"
	range 0 255
	default 10
	help
	  Timeouts in a row without an answer from the peer, while a
	  payload waits for its acknowledgment or for credits, before the
	  session ends, the endpoints are unbound and the link announces
	  its boot again. 0 keeps sending.

# The endpoint callbacks are called from this work queue, shared by all
# instances: a callback that blocks does not stall the system work queue
config IPC_SERVICE_BACKEND_LINK_DEDICATED_WORKQUEUE
	default y

if IPC_SERVICE_BACKEND_LINK_DEDICATED_WORKQUEUE

config IPC_SERVICE_BACKEND_LINK_DEDICATED_WORKQUEUE_STACK_SIZE
	default 2048

config IPC_SERVICE_BACKEND_LINK_DEDICATED_WORKQUEUE_PRIORITY
	default 2

endif # IPC_SERVICE_BACKEND_LINK_DEDICATED_WORKQUEUE

module = IPC_SERVICE_BACKEND_LINK
module-str = IPC link backend
source "kernel/Kconfig.template.workqueue"

config IPC_SERVICE_BACKEND_LINK_SHELL
	bool "Shell commands"
	depends on SHELL
	select IPC_SERVICE_LINK_STATS
	help
	  The ipc_link command shows and clears the counters of the link
	  instances.

module = IPC_SERVICE_BACKEND_LINK
module-str = IPC link backend
module-help = Sets log level for the IPC link backend
source "subsys/logging/Kconfig.template.log_config"

endif # IPC_SERVICE_BACKEND_LINK

config IPC_SERVICE_BACKEND_LINK_UART
	bool "IPC link transport over a UART"
	default y
	depends on DT_HAS_ZEPHYR_IPC_UART_ENABLED
	depends on SERIAL
	depends on UART_ASYNC_API || UART_INTERRUPT_DRIVEN
	select IPC_SERVICE_BACKEND_LINK
	select COBS
	help
	  IPC service instances over a UART, COBS-framed. Uses the
	  asynchronous UART API when enabled and implemented by the UART
	  driver, the interrupt-driven API otherwise.

if IPC_SERVICE_BACKEND_LINK_UART

config IPC_SERVICE_BACKEND_LINK_UART_RX_CHUNK_SIZE
	int "Asynchronous receive buffer size"
	range 8 4096
	default 64
	help
	  Size in bytes of each of the two buffers the asynchronous UART API
	  receives into, per instance. A buffer is handed over when it is
	  full or after the idle timeout, and the frame checks run before
	  the next one is: larger buffers leave them more time at a high
	  baud rate.

config IPC_SERVICE_BACKEND_LINK_UART_RX_IDLE_TIMEOUT_US
	int "Asynchronous receive idle timeout"
	range 1 1000000
	default 1000
	help
	  Time in microseconds without a byte after which the asynchronous
	  UART API hands over what it received.

endif # IPC_SERVICE_BACKEND_LINK_UART

config IPC_SERVICE_BACKEND_LINK_SPI
	bool "IPC link transport over an SPI bus"
	default y
	depends on DT_HAS_ZEPHYR_IPC_SPI_ENABLED || DT_HAS_ZEPHYR_IPC_SPI_PERIPHERAL_ENABLED
	depends on SPI
	depends on GPIO
	depends on (SPI_PERIPHERAL && SPI_ASYNC) || !DT_HAS_ZEPHYR_IPC_SPI_PERIPHERAL_ENABLED
	select IPC_SERVICE_BACKEND_LINK
	help
	  IPC service instances over an SPI bus, one frame each way per
	  transaction, between a controller and a peripheral MCU with a
	  ready and an interrupt line. The peripheral role needs an SPI
	  driver with peripheral mode and the asynchronous API.

if IPC_SERVICE_BACKEND_LINK_SPI

config IPC_SERVICE_BACKEND_LINK_SPI_STACK_SIZE
	int "Transfer thread stack size"
	default 1024
	help
	  Stack of the thread running the transactions.

config IPC_SERVICE_BACKEND_LINK_SPI_PRIORITY
	int "Transfer thread priority"
	default 2
	help
	  Priority of the thread running the transactions.

endif # IPC_SERVICE_BACKEND_LINK_SPI
```

## subsys/led/Kconfig
```kconfig
# Copyright (c) 2026 BayLibre SAS
# SPDX-License-Identifier: Apache-2.0

config LED_PLAYER
	bool "LED player"
	depends on LED && SYS_CLOCK_EXISTS
	help
	  Play on/off animations on LEDs driven by the LED driver API, for
	  example to report a status on a single LED with one blink pattern
	  per status.

if LED_PLAYER

config LED_PLAYER_INIT_PRIORITY
	int "LED player initialization priority"
	default 32
	help
	  Initialization priority of the LED player, at the POST_KERNEL level.
	  The LED player API must not be used before it is initialized.

module = LED_PLAYER
module-str = LED player
source "subsys/logging/Kconfig.template.log_config"

endif # LED_PLAYER
```

## subsys/logging/backends/Kconfig.ble
```kconfig
# Copyright (c) 2023 Victor Chavez
# SPDX-License-Identifier: Apache-2.0

menuconfig LOG_BACKEND_BLE
	bool "Bluetooth Low Energy (LE) backend [EXPERIMENTAL]"
	depends on BT
	depends on LOG_PROCESS_THREAD_STACK_SIZE>=2048
	select EXPERIMENTAL
	help
	  Backend that sends log messages over Bluetooth LE Notifications. This
	  characteristic and its service are compatible with the Nordic UART
	  Service (NUS), from the nRF Connect SDK.
	  This allows to use this BLE Logger directly with a compatible app such
	  as the nRF UART 2.0 or nRF Toolbox app.

if LOG_BACKEND_BLE

choice LOG_BACKEND_BLE_SECURITY
	prompt "Log access security"
	default LOG_BACKEND_BLE_SECURITY_NONE
	help
	  Minimum Bluetooth LE security required to subscribe to and receive
	  log notifications. The application must support a pairing method
	  that meets the selected security level.

config LOG_BACKEND_BLE_SECURITY_NONE
	bool "No security required"

config LOG_BACKEND_BLE_SECURITY_ENCRYPT
	bool "Encryption required"
	depends on BT_SMP

config LOG_BACKEND_BLE_SECURITY_AUTHEN
	bool "Encryption and authentication required"
	depends on BT_SMP

endchoice # LOG_BACKEND_BLE_SECURITY

backend = BLE
backend-str = ble
source "subsys/logging/Kconfig.template.log_format_config"

endif # LOG_BACKEND_BLE
```
