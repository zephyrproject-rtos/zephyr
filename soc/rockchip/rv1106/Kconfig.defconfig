## soc/rockchip/rv1106/Kconfig.defconfig
```kconfig
# Copyright 2026 Patryk Koscik
# SPDX-License-Identifier: Apache-2.0

if SOC_RV1106

config NUM_IRQS
	default 160

config SOC_RESET_HOOK
	default y

config SYS_CLOCK_HW_CYCLES_PER_SEC
	default $(dt_node_int_prop_int,/timer,clock-frequency)

if SERIAL

config UART_NS16550
	default y

config UART_NS16550_DW8250_DW_APB
	default y

config UART_NS16550_ACCESS_WORD_ONLY
	default y

endif # SERIAL

endif # SOC_RV1106
```

## soc/rockchip/rv1106/Kconfig.soc
```kconfig
# Copyright 2026 Patryk Koscik
# SPDX-License-Identifier: Apache-2.0

config SOC_RV1106
	bool
	select SOC_SERIES_RV1106

config SOC_SERIES_RV1106
	bool
	select SOC_FAMILY_ROCKCHIP

config SOC
	default "rv1106" if SOC_RV1106

config SOC_SERIES
	default "rv1106" if SOC_SERIES_RV1106
```

## soc/rocketchip/virt_riscv/Kconfig.soc
```kconfig
# Copyright (c) 2024 Antmicro <www.antmicro.com>
# Copyright (c) 2025 Dima Nikiforov <vnikiforov@berkeley.edu>
# SPDX-License-Identifier: Apache-2.0

config SOC_FAMILY_ROCKETCHIP_VIRT_RISCV
	bool

config SOC_FAMILY
	default "rocketchip_virt_riscv" if SOC_FAMILY_ROCKETCHIP_VIRT_RISCV

config STARTUP_TACIT
    bool "Enable startup tracing from bootup"
    default n
    help
      Enable profiling and tracing at the earliest stage of bootup.


config RTC_CLOCK_DIVIDER_VALUE
    int "Digital top clock divider to RTC"
    default 1000
    help
      Define the clock dividing from digital top clock to the RTC clocking mtime.


rsource "*/Kconfig.soc"
```

## soc/rocketchip/virt_riscv/rocketchip_virt_riscv64/Kconfig.soc
```kconfig
# Copyright (c) 2024 Antmicro <www.antmicro.com>
# SPDX-License-Identifier: Apache-2.0

config SOC_ROCKETCHIP_VIRT_RISCV64
	bool
	select SOC_FAMILY_ROCKETCHIP_VIRT_RISCV

config SOC
	default "spike_rocketchip_riscv64" if SOC_ROCKETCHIP_VIRT_RISCV64
```

## soc/sensry/Kconfig.defconfig
```kconfig
# SPDX-License-Identifier: Apache-2.0
# Copyright (c) 2024 sensry.io

if SOC_FAMILY_GANYMED

rsource "*/Kconfig.defconfig"

endif
```

## soc/sensry/Kconfig.soc
```kconfig
# SPDX-License-Identifier: Apache-2.0
# Copyright (c) 2024 sensry.io

config SOC_FAMILY_GANYMED
	bool

config SOC_FAMILY
	default "ganymed" if SOC_FAMILY_GANYMED

rsource "*/Kconfig.soc"
```

## soc/sensry/ganymed/Kconfig
```kconfig
# SPDX-License-Identifier: Apache-2.0
# Copyright (c) 2024 sensry.io

config SOC_FAMILY_GANYMED
	select BUILD_OUTPUT_BIN

if SOC_SERIES_SY1XX

rsource "*/Kconfig"

endif # SOC_SERIES_SY1XX
```

## soc/sensry/ganymed/Kconfig.defconfig
```kconfig
# SPDX-License-Identifier: Apache-2.0
# Copyright (c) 2024 sensry.io

if SOC_SERIES_SY1XX

rsource "*/Kconfig.defconfig"

endif
```

## soc/sensry/ganymed/Kconfig.soc
```kconfig
# SPDX-License-Identifier: Apache-2.0
# Copyright (c) 2024 sensry.io

rsource "*/Kconfig.soc"
```

## soc/sensry/ganymed/sy1xx/Kconfig
```kconfig
# SPDX-License-Identifier: Apache-2.0
# Copyright (c) 2024 sensry.io

config SOC_SERIES_SY1XX
	select RISCV
	select RISCV_PRIVILEGED
```

## soc/sensry/ganymed/sy1xx/Kconfig.defconfig
```kconfig
# SPDX-License-Identifier: Apache-2.0
# Copyright (c) 2024 sensry.io

if SOC_SERIES_SY1XX

config RISCV_PMP
	default n

config RISCV_HAS_CLIC
	default n

config RISCV_VECTORED_MODE
	default y

config INCLUDE_RESET_VECTOR
	default y

config GEN_IRQ_VECTOR_TABLE
	default y

config RISCV_GENERIC_TOOLCHAIN
	default y if "$(ZEPHYR_TOOLCHAIN_VARIANT)" = "zephyr"

config RV_BOOT_HART
	# default cluster id 0x3e, core 0 (FC) => 0x3e0 == 992
	default 992

config RISCV_SOC_CONTEXT_SAVE
	default n

config RISCV_SOC_OFFSETS
	default n

config NUM_IRQS
	default 32

config RISCV_SOC_INTERRUPT_INIT
	default y

config RISCV_SOC_HAS_ISR_STACKING
	default n

config DYNAMIC_INTERRUPTS
	default y

config GEN_ISR_TABLES
	default y

config RISCV_MCAUSE_EXCEPTION_MASK
	default 0x1F

config SYS_CLOCK_HW_CYCLES_PER_SEC
	default 32768

config SYS_CLOCK_TICKS_PER_SEC
	default 993

config USE_DT_CODE_PARTITION
	default y

config RISCV_SOC_HAS_CUSTOM_IRQ_LOCK_OPS
	default n

config RISCV_SOC_EXCEPTION_FROM_IRQ
	default y

config INIT_STACKS
	default y

config XIP
	default n

config TIMESLICE_SIZE
	default 10

endif
```

## soc/sensry/ganymed/sy1xx/Kconfig.soc
```kconfig
# SPDX-License-Identifier: Apache-2.0
# Copyright (c) 2024 sensry.io

config SOC_SERIES_SY1XX
	bool
	select SOC_FAMILY_GANYMED

config SOC_SERIES
	default "sy1xx" if SOC_SERIES_SY1XX

config SOC_SY120_GBM
	bool
	select SOC_SERIES_SY1XX

config SOC_SY120_GEN1
	bool
	select SOC_SERIES_SY1XX

config SOC
	default "sy120_gbm" if SOC_SY120_GBM
	default "sy120_gen1" if SOC_SY120_GEN1
```

## soc/shakti/Kconfig
```kconfig
# Copyright (c) 2026 RISE Lab, IIT Madras
# SPDX-License-Identifier: Apache-2.0

if SOC_FAMILY_SHAKTI

rsource "*/Kconfig"

endif # SOC_FAMILY_SHAKTI
```

## soc/shakti/Kconfig.soc
```kconfig
# Copyright (c) 2026 RISE Lab, IIT Madras
# SPDX-License-Identifier: Apache-2.0

config SOC_FAMILY_SHAKTI
	bool

config SOC_FAMILY
	default "shakti" if SOC_FAMILY_SHAKTI

rsource "*/Kconfig.soc"
```

## soc/shakti/ganga/Kconfig
```kconfig
# Copyright (c) 2026 RISE Lab, IIT Madras
# SPDX-License-Identifier: Apache-2.0

config SOC_GANGA
	select 64BIT
	select RISCV
	select RISCV_PRIVILEGED
	select RISCV_ISA_RV64I
	select RISCV_ISA_EXT_M
	select RISCV_ISA_EXT_A
	select RISCV_ISA_EXT_C
	select RISCV_ISA_EXT_ZICSR
	select RISCV_ISA_EXT_ZIFENCEI
	select ATOMIC_OPERATIONS_C
	select INCLUDE_RESET_VECTOR
	select RISCV_HAS_PLIC
```

## soc/shakti/ganga/Kconfig.soc
```kconfig
# Copyright (c) 2026 RISE Lab, IIT Madras
# SPDX-License-Identifier: Apache-2.0

config SOC_GANGA
	bool
	select SOC_FAMILY_SHAKTI

config SOC
	default "ganga" if SOC_GANGA
```

## soc/sifive/sifive_freedom/Kconfig.defconfig
```kconfig
# Copyright (c) 2024 Nordic Semiconductor ASA
# Copyright (c) 2024 Antmicro <www.antmicro.com>
# SPDX-License-Identifier: Apache-2.0

if SOC_FAMILY_SIFIVE_FREEDOM

rsource "*/Kconfig.defconfig"

endif # SOC_FAMILY_SIFIVE_FREEDOM
```

## soc/sifive/sifive_freedom/Kconfig.soc
```kconfig
# Copyright (c) 2024 Nordic Semiconductor ASA
# Copyright (c) 2024 Antmicro <www.antmicro.com>
# SPDX-License-Identifier: Apache-2.0

config SOC_FAMILY_SIFIVE_FREEDOM
	bool

config SOC_FAMILY
	default "sifive_freedom" if SOC_FAMILY_SIFIVE_FREEDOM

rsource "*/Kconfig.soc"
```

## soc/sifive/sifive_freedom/fe300/Kconfig
```kconfig
# Copyright (c) 2017 Jean-Paul Etienne <fractalclone@gmail.com>
# Copyright (c) 2024 Antmicro <www.antmicro.com>
# SPDX-License-Identifier: Apache-2.0

config SOC_SERIES_FE300
	select RISCV
	select RISCV_PRIVILEGED
	select RISCV_HAS_PLIC
	select RISCV_SOC_HAS_GP_RELATIVE_ADDRESSING
	select INCLUDE_RESET_VECTOR
	select SOC_EARLY_INIT_HOOK
	imply XIP

config SOC_SERIES_SIFIVE_FREEDOM_FE300
	select DEPRECATED

config SOC_FE310_G002
	select RISCV_PMP

config SOC_SIFIVE_FREEDOM_FE310_G000
	select DEPRECATED

config SOC_SIFIVE_FREEDOM_FE310_G002
	select DEPRECATED
```

## soc/sifive/sifive_freedom/fe300/Kconfig.soc
```kconfig
# Copyright (c) 2024 Antmicro <www.antmicro.com>
# SPDX-License-Identifier: Apache-2.0

config SOC_SERIES_SIFIVE_FREEDOM_FE300
	bool
	select SOC_FAMILY_SIFIVE_FREEDOM

config SOC_SERIES
	default "fe300" if SOC_SERIES_SIFIVE_FREEDOM_FE300

config SOC_SIFIVE_FREEDOM_FE310_G000
	bool
	select SOC_SERIES_SIFIVE_FREEDOM_FE300

config SOC_SIFIVE_FREEDOM_FE310_G002
	bool
	select SOC_SERIES_SIFIVE_FREEDOM_FE300

config SOC
	default "fe310_g000" if SOC_SIFIVE_FREEDOM_FE310_G000
	default "fe310_g002" if SOC_SIFIVE_FREEDOM_FE310_G002
```

## soc/sifive/sifive_freedom/fu500/Kconfig
```kconfig
# Copyright (c) 2017 Jean-Paul Etienne <fractalclone@gmail.com>
# Copyright (c) 2024 Antmicro <www.antmicro.com>
# SPDX-License-Identifier: Apache-2.0

config SOC_SERIES_SIFIVE_FREEDOM_FU500
	bool

	# RISC-V options
	select RISCV
	select RISCV_PRIVILEGED
	select RISCV_HAS_PLIC
	select RISCV_ISA_RV64I
	select RISCV_ISA_EXT_M
	select RISCV_ISA_EXT_A
	select RISCV_ISA_EXT_C
	select RISCV_ISA_EXT_ZICSR
	select RISCV_ISA_EXT_ZIFENCEI
	imply XIP
	select SOC_EARLY_INIT_HOOK
	select 64BIT
	select INCLUDE_RESET_VECTOR
```

## soc/sifive/sifive_freedom/fu500/Kconfig.defconfig
```kconfig
# Copyright (c) 2017 Jean-Paul Etienne <fractalclone@gmail.com>
# Copyright (c) 2024 Antmicro <www.antmicro.com>
# SPDX-License-Identifier: Apache-2.0

if SOC_SERIES_SIFIVE_FREEDOM_FU500

config SYS_CLOCK_HW_CYCLES_PER_SEC
	default 32768

config RISCV_SOC_INTERRUPT_INIT
	default y

config 2ND_LVL_ISR_TBL_OFFSET
	default 12

config 2ND_LVL_INTR_00_OFFSET
	default 11

config MAX_IRQ_PER_AGGREGATOR
	default 52

config NUM_IRQS
	default 64

config FPU
	default y if CPU_HAS_FPU

config RISCV_IMPRECISE_FPU_STATE_TRACKING
	default y if FPU

endif # SOC_SERIES_SIFIVE_FREEDOM_FU500
```

## soc/sifive/sifive_freedom/fu500/Kconfig.soc
```kconfig
# Copyright (c) 2024 Antmicro <www.antmicro.com>
# SPDX-License-Identifier: Apache-2.0

config SOC_SERIES_SIFIVE_FREEDOM_FU500
	bool
	select SOC_FAMILY_SIFIVE_FREEDOM

config SOC_SIFIVE_FREEDOM_FU540
	bool
	select SOC_SERIES_SIFIVE_FREEDOM_FU500

config SOC_SIFIVE_FREEDOM_FU540_E51
	bool
	select SOC_SIFIVE_FREEDOM_FU540

config SOC_SIFIVE_FREEDOM_FU540_U54
	bool
	select SOC_SIFIVE_FREEDOM_FU540

config SOC_SERIES
	default "fu500" if SOC_SERIES_SIFIVE_FREEDOM_FU500

config SOC
	default "fu540" if SOC_SIFIVE_FREEDOM_FU540_E51 || SOC_SIFIVE_FREEDOM_FU540_U54
```

## soc/sifive/sifive_freedom/fu700/Kconfig
```kconfig
# Copyright (c) 2024 Antmicro <www.antmicro.com>
# SPDX-License-Identifier: Apache-2.0

config SOC_SERIES_FU700
	select RISCV
	select RISCV_PRIVILEGED
	select RISCV_HAS_PLIC
	select RISCV_PMP
	select RISCV_SOC_HAS_GP_RELATIVE_ADDRESSING
	select RISCV_ISA_RV64I
	select RISCV_ISA_EXT_M
	select RISCV_ISA_EXT_A
	select RISCV_ISA_EXT_C
	select RISCV_ISA_EXT_ZICSR
	select RISCV_ISA_EXT_ZIFENCEI
	select SOC_EARLY_INIT_HOOK
	select INCLUDE_RESET_VECTOR
	imply XIP

config SOC_SERIES_SIFIVE_FREEDOM_FU700
	select DEPRECATED

config SOC_FU740_U74
	select RISCV_ISA_EXT_G

config SOC_SIFIVE_FREEDOM_FU740
	select DEPRECATED

config SOC_SIFIVE_FREEDOM_FU740_S7
	select DEPRECATED

config SOC_SIFIVE_FREEDOM_FU740_U74
	select DEPRECATED
```

## soc/sifive/sifive_freedom/fu700/Kconfig.soc
```kconfig
# Copyright (c) 2024 Antmicro <www.antmicro.com>
# SPDX-License-Identifier: Apache-2.0

config SOC_SERIES_SIFIVE_FREEDOM_FU700
	bool
	select SOC_FAMILY_SIFIVE_FREEDOM

config SOC_SERIES
	default "fu700" if SOC_SERIES_SIFIVE_FREEDOM_FU700

config SOC_SIFIVE_FREEDOM_FU740
	bool
	select SOC_SERIES_SIFIVE_FREEDOM_FU700

config SOC
	default "fu740" if SOC_SIFIVE_FREEDOM_FU740
```
