## soc/cdns/dc233c/Kconfig
```kconfig
# Copyright (c) 2017, 2023 Intel Corporation
#
# SPDX-License-Identifier: Apache-2.0

config SOC_XTENSA_DC233C
	select XTENSA
	select XTENSA_HAL
	select ARCH_HAS_THREAD_LOCAL_STORAGE
	select CPU_HAS_DCACHE
	select CPU_HAS_ICACHE
	select CPU_HAS_MMU
	select ARCH_HAS_RESERVED_PAGE_FRAMES if XTENSA_MMU
	select ARCH_HAS_USERSPACE if XTENSA_MMU
	select ARCH_SUPPORTS_COREDUMP
	select ARCH_SUPPORTS_COREDUMP_PRIV_STACKS
	select XTENSA_INVALIDATE_MEM_DOMAIN_TLB_ON_SWAP if XTENSA_MMU
```

## soc/cdns/dc233c/Kconfig.defconfig
```kconfig
# Copyright (c) 2016 Open-RnD Sp. z o.o.
# Copyright (c) 2016 Cadence Design Systems, Inc.
# Copyright (c) 2023 Intel Corporation
#
# SPDX-License-Identifier: Apache-2.0

if SOC_XTENSA_DC233C

config XTENSA_MMU_NUM_L2_TABLES
	int
	default 48 if XTENSA_MMU

# Both SRAM_OFFSET and KERNEL_VM_OFFSET are set at 1MB.
# This is to allow VECBASE to be mapped permanently
# via TLB way 4 (which covers 1MB).
config SRAM_OFFSET
	hex
	default 0x100000 if XTENSA_MMU
	default 0x2400

config KERNEL_VM_OFFSET
	hex
	default 0x100000

endif
```

## soc/cdns/dc233c/Kconfig.soc
```kconfig
# Copyright (c) 2017, 2023 Intel Corporation
#
# SPDX-License-Identifier: Apache-2.0

config SOC_XTENSA_DC233C
	bool

config SOC
	default "dc233c" if SOC_XTENSA_DC233C

config SOC_TOOLCHAIN_NAME
	string
	default "dc233c" if SOC_XTENSA_DC233C
```

## soc/cdns/sample_controller32/Kconfig
```kconfig
# Copyright (c) 2024 Intel Corporation
# SPDX-License-Identifier: Apache-2.0

config SOC_XTENSA_SAMPLE_CONTROLLER32
	select XTENSA
	select XTENSA_HAL
	select ATOMIC_OPERATIONS_C
	select CPU_HAS_MPU
	select ARCH_HAS_USERSPACE if XTENSA_MPU
```

## soc/cdns/sample_controller32/Kconfig.defconfig
```kconfig
# Copyright (c) 2025 Antmicro <www.antmicro.com>
# SPDX-License-Identifier: Apache-2.0

if SOC_XTENSA_SAMPLE_CONTROLLER32

# CONFIG_PRIVILEGED_STACK_SIZE must be aligned as specified by XCHAL_MPU_ALIGN.
# For `sample_controller32`, that value is equal to 4096
config PRIVILEGED_STACK_SIZE
	default 4096 if XTENSA_MPU

endif # SOC_XTENSA_SAMPLE_CONTROLLER32
```

## soc/cdns/sample_controller32/Kconfig.soc
```kconfig
# Copyright (c) 2024 Intel Corporation
# SPDX-License-Identifier: Apache-2.0

config SOC_XTENSA_SAMPLE_CONTROLLER32
	bool

config SOC
	default "sample_controller32" if SOC_XTENSA_SAMPLE_CONTROLLER32

config SOC_TOOLCHAIN_NAME
	string
	default "sample_controller32" if SOC_XTENSA_SAMPLE_CONTROLLER32
```

## soc/cdns/swerv/Kconfig
```kconfig
# Copyright (c) 2026 Intel Corporation
#
# SPDX-License-Identifier: Apache-2.0

config SOC_FAMILY_CDNS_SWERV
	select INCLUDE_RESET_VECTOR
	select RISCV

if SOC_FAMILY_CDNS_SWERV

rsource "*/Kconfig"

config SOC_CDNS_SWERV_BOOT_MRAC
	hex "Set MRAC CSR value at boot"
	depends on SOC_S400
	help
	  Setup the MRAC CSR register for region access control
	  on caching and side effect settings.

endif # SOC_FAMILY_CDNS_SWERV
```

## soc/cdns/swerv/Kconfig.defconfig
```kconfig
# Copyright (c) 2026 Intel Corporation
#
# SPDX-License-Identifier: Apache-2.0

orsource "*/Kconfig.defconfig"
```

## soc/cdns/swerv/Kconfig.soc
```kconfig
# Copyright (c) 2026 Intel Corporation
#
# SPDX-License-Identifier: Apache-2.0

config SOC_FAMILY_CDNS_SWERV
	bool

config SOC_FAMILY
	default "cdns_swerv" if SOC_FAMILY_CDNS_SWERV

rsource "*/Kconfig.soc"
```

## soc/cdns/swerv/s400/Kconfig
```kconfig
# Copyright (c) 2026 Intel Corporation
#
# SPDX-License-Identifier: Apache-2.0

config SOC_S400
	select RISCV_SOC_INTERRUPT_INIT
	select ATOMIC_OPERATIONS_C
```

## soc/cdns/swerv/s400/Kconfig.soc
```kconfig
# Copyright (c) 2026 Intel Corporation
#
# SPDX-License-Identifier: Apache-2.0

config SOC_S400
	bool
	select SOC_FAMILY_CDNS_SWERV

config SOC
	default "s400" if SOC_S400
```

## soc/cdns/swerv/s420/Kconfig
```kconfig
# Copyright (c) 2026 Intel Corporation
#
# SPDX-License-Identifier: Apache-2.0

config SOC_S420
	select RISCV_SOC_INTERRUPT_INIT
	select ATOMIC_OPERATIONS_BUILTIN
```

## soc/cdns/swerv/s420/Kconfig.soc
```kconfig
# Copyright (c) 2026 Intel Corporation
#
# SPDX-License-Identifier: Apache-2.0

config SOC_S420
	bool
	select SOC_FAMILY_CDNS_SWERV

config SOC
	default "s420" if SOC_S420
```

## soc/cdns/swerv/s420_64/Kconfig
```kconfig
# Copyright (c) 2026 Intel Corporation
#
# SPDX-License-Identifier: Apache-2.0

config SOC_S420_64
	select 64BIT
	select RISCV_SOC_INTERRUPT_INIT
	select ATOMIC_OPERATIONS_BUILTIN
```

## soc/cdns/swerv/s420_64/Kconfig.defconfig
```kconfig
# Copyright (c) 2026 Intel Corporation
#
# SPDX-License-Identifier: Apache-2.0

if SOC_S420_64

config MP_MAX_NUM_CPUS
	default 2
	range 1 2

config SMP
	default y

config PM_CPU_OPS
	default y

endif # SOC_S420_64
```

## soc/cdns/swerv/s420_64/Kconfig.soc
```kconfig
# Copyright (c) 2026 Intel Corporation
#
# SPDX-License-Identifier: Apache-2.0

config SOC_S420_64
	bool
	select SOC_FAMILY_CDNS_SWERV

config SOC
	default "s420_64" if SOC_S420_64
```

## soc/cdns/xtensa_sample_controller/Kconfig
```kconfig
# Copyright (c) 2017 Intel Corporation
# SPDX-License-Identifier: Apache-2.0

config SOC_XTENSA_SAMPLE_CONTROLLER
	select XTENSA
	select XTENSA_HAL if ("$(ZEPHYR_TOOLCHAIN_VARIANT)" != "xcc" && "$(ZEPHYR_TOOLCHAIN_VARIANT)" != "xt-clang")
	select ARCH_SUPPORTS_COREDUMP
```

## soc/cdns/xtensa_sample_controller/Kconfig.soc
```kconfig
# Copyright (c) 2017 Intel Corporation
# SPDX-License-Identifier: Apache-2.0

config SOC_XTENSA_SAMPLE_CONTROLLER
	bool

config SOC
	default "xtensa_sample_controller" if SOC_XTENSA_SAMPLE_CONTROLLER

config SOC_TOOLCHAIN_NAME
	string
	default "sample_controller" if SOC_XTENSA_SAMPLE_CONTROLLER
```

## soc/common/Kconfig
```kconfig
# Copyright (c) 2024 Nordic Semiconductor ASA
# SPDX-License-Identifier: Apache-2.0

if RISCV_PRIVILEGED

rsource "riscv-privileged/Kconfig"

endif # RISCV_PRIVILEGED
```

## soc/common/riscv-opensbi/Kconfig
```kconfig
# Configuration options for riscv SOCs supporting the riscv openSBI
# interface

# Copyright (c) 2024 sensry.io
# SPDX-License-Identifier: Apache-2.0

config RISCV_OPENSBI
	bool "openSBI support for RISCV SOCs"
	help
	  This is the "master" switch to enable the support
	  for openSBI drivers.
```

## soc/cypress/Kconfig
```kconfig
# Copyright (c) 2018, Cypress
# Copyright (c) 2020, ATL Electronics
# SPDX-License-Identifier: Apache-2.0

if SOC_FAMILY_PSOC6 || SOC_FAMILY_INFINEON_CAT1

rsource "*/Kconfig"

endif # SOC_FAMILY_PSOC6 || SOC_FAMILY_INFINEON_CAT1
```

## soc/cypress/Kconfig.defconfig
```kconfig
# Copyright (c) 2018, Cypress
# SPDX-License-Identifier: Apache-2.0

if SOC_FAMILY_PSOC6 || SOC_FAMILY_INFINEON_CAT1

rsource "*/Kconfig.defconfig"

endif # SOC_FAMILY_PSOC6 || SOC_FAMILY_INFINEON_CAT1
```

## soc/cypress/Kconfig.soc
```kconfig
# Copyright (c) 2018, Cypress
# SPDX-License-Identifier: Apache-2.0

config SOC_FAMILY_PSOC6
	bool

config SOC_FAMILY_INFINEON_CAT1
	bool

config SOC_FAMILY_INFINEON_CAT1A
	bool

config SOC_FAMILY
	default "psoc6" if SOC_FAMILY_PSOC6
	default "infineon_cat1" if SOC_FAMILY_INFINEON_CAT1

rsource "*/Kconfig.soc"
```

## soc/cypress/psoc6/Kconfig
```kconfig
# Cypress Semiconductor PSoC6 series configuration options
# Copyright (c) 2018, Cypress
# Copyright (c) 2020, ATL Electronics
# SPDX-License-Identifier: Apache-2.0

config SOC_SERIES_PSOC62_PSOC63
	bool
	select ARM
	select HAS_CYPRESS_DRIVERS
	select CPU_CORTEX_M0PLUS if SOC_CY8C6247_M0 || SOC_CY8C6347_M0
	select CPU_CORTEX_M_HAS_SYSTICK if SOC_CY8C6247_M0 || SOC_CY8C6347_M0
	select CPU_CORTEX_M_HAS_VTOR if SOC_CY8C6247_M0 || SOC_CY8C6347_M0
	select CPU_HAS_ARM_MPU if SOC_CY8C6247_M0 || SOC_CY8C6347_M0
	select CPU_CORTEX_M4 if SOC_CY8C6247_M4 || SOC_CY8C6347_M4
	select CPU_CORTEX_M_HAS_DWT if SOC_CY8C6247_M4 || SOC_CY8C6347_M4
	select CPU_CORTEX_M_HAS_SYSTICK if SOC_CY8C6247_M4 || SOC_CY8C6347_M4
	select CPU_HAS_ARM_MPU if SOC_CY8C6247_M4 || SOC_CY8C6347_M4
	select CPU_HAS_FPU if SOC_CY8C6247_M4 || SOC_CY8C6347_M4

config SOC_SERIES_PSOC62
	select SOC_SERIES_PSOC62_PSOC63

config SOC_SERIES_PSOC63
	select SOC_SERIES_PSOC62_PSOC63

config SOC_PSOC6_M0_ENABLES_M4
	bool "Dual-core support [activate Cortex-M4]"
	depends on SOC_CY8C6247_M0 || SOC_CY8C6347_M0
	help
	  Cortex-M0 CPU should boot Cortex-M4

config SOC_DIE_PSOC6
	select ARM
	select CPU_CORTEX_M4
	select CPU_HAS_ARM_MPU
	select DYNAMIC_INTERRUPTS
	select CPU_HAS_FPU

if SOC_FAMILY_INFINEON_CAT1A

## PSoC™ 6 Cortex M0+ prebuilt images
choice
	prompt "PSoC™ 6 Cortex M0+ prebuilt images"
	help
	  Choose the prebuilt application image to be executed on the Cortex-M0+ core of the PSoC™ 6
	  dual-core MCU. The image is responsible for booting the Cortex-M4 on the device.

config SOC_PSOC6_CM0P_IMAGE_SLEEP
	bool "DeepSleep"
	help
	  DeepSleep prebuilt application image is executed on the Cortex-M0+ core of the PSoC™ 6 BLE
	  dual-core MCU.The image is provided as C array ready to be compiled as part of the Cortex-M4
	  application. The Cortex-M0+ application code is placed to internal flash by the Cortex-M4
	  linker script.

endchoice

endif # SOC_FAMILY_INFINEON_CAT1A
```

## soc/cypress/psoc6/Kconfig.defconfig
```kconfig
# Cypress Semiconductor PSoC6 series configuration options
# Copyright (c) 2018, Cypress
# Copyright (c) 2020, ATL Electronics
# SPDX-License-Identifier: Apache-2.0

if SOC_SERIES_PSOC62 || SOC_SERIES_PSOC63

config SYS_CLOCK_HW_CYCLES_PER_SEC
	default 50000000

rsource "old/Kconfig.defconfig.psoc*"

endif # SOC_SERIES_PSOC62 || SOC_SERIES_PSOC63

if SOC_FAMILY_INFINEON_CAT1

config SYS_CLOCK_HW_CYCLES_PER_SEC
	default 100000000

config SOC_PSOC6_CM0P_IMAGE_ROM_SIZE
	hex
	default 0x2000 if SOC_PSOC6_CM0P_IMAGE_SLEEP

config SOC_PSOC6_CM0P_IMAGE_RAM_SIZE
	hex
	default 0x2000 if SOC_PSOC6_CM0P_IMAGE_SLEEP

rsource "new/Kconfig.defconfig.psoc6*"

endif # SOC_FAMILY_INFINEON_CAT1
```
