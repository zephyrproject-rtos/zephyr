## soc/aspeed/ast10x0/Kconfig.defconfig
```kconfig
# SPDX-License-Identifier: Apache-2.0
#
# Copyright (c) 2021 ASPEED Technology Inc.

if SOC_SERIES_AST10X0

rsource "Kconfig.defconfig.ast10*0"

configdefault ICACHE_LINE_SIZE
	default 32

configdefault DCACHE_LINE_SIZE
	default 32

choice CACHE_TYPE
	default EXTERNAL_CACHE
endchoice

endif # SOC_SERIES_AST10X0
```

## soc/aspeed/ast10x0/Kconfig.defconfig.ast1030
```kconfig
# SPDX-License-Identifier: Apache-2.0
#
# Copyright (c) 2021 ASPEED Technology Inc.

if SOC_AST1030

config NUM_IRQS
	default 240

DT_NODE_SRAM := /memory@0

config SRAM_NC_SIZE
	default $(dt_node_reg_size_int,$(DT_NODE_SRAM),1,K)

config SRAM_NC_BASE_ADDRESS
	default $(dt_node_reg_addr_hex,$(DT_NODE_SRAM),1)

endif # SOC_AST1030
```

## soc/aspeed/ast10x0/Kconfig.soc
```kconfig
# SPDX-License-Identifier: Apache-2.0
#
# Copyright (c) 2021 ASPEED Technology Inc.

config SOC_SERIES_AST10X0
	bool
	select SOC_FAMILY_ASPEED
	help
	  Enable support for ASPEED AST10X0 series

config SOC_AST1030
	bool
	select SOC_SERIES_AST10X0
	help
	  AST1030

config SOC_SERIES
	default "ast10x0" if SOC_SERIES_AST10X0

config SOC
	default "ast1030" if SOC_AST1030
```

## soc/at/at32/Kconfig.defconfig
```kconfig
# Copyright (c) 2024, Maxjta
# SPDX-License-Identifier: Apache-2.0

if SOC_FAMILY_AT32

rsource "*/Kconfig.defconfig"

config PINCTRL
	default y

config CLOCK_CONTROL
    default y

endif # SOC_FAMILY_AT32
```

## soc/at/at32/Kconfig.soc
```kconfig
# Artery AT32 MCU line

# Copyright (c) 2024, Maxjta
# SPDX-License-Identifier: Apache-2.0

config SOC_FAMILY_AT32
	bool

config SOC_FAMILY
	default "at32" if SOC_FAMILY_AT32

rsource "*/Kconfig.soc"
```

## soc/at/at32/at32f402_405/Kconfig
```kconfig
# Copyright (c) 2021, Teslabs Engineering S.L.
# SPDX-License-Identifier: Apache-2.0

config SOC_SERIES_AT32F402_405
	select ARM
	select CPU_HAS_ARM_MPU
	select CPU_HAS_FPU
	select CPU_CORTEX_M4
	select AT32_HAS_PINMUX
	select AT32_HAS_IRC_32K
	select SOC_EARLY_INIT_HOOK
```

## soc/at/at32/at32f402_405/Kconfig.defconfig
```kconfig
# Copyright (c) 2025 Maxjta
# SPDX-License-Identifier: Apache-2.0

if SOC_SERIES_AT32F402_405

rsource "Kconfig.defconfig.at32*"

endif # SOC_SERIES_AT32F402_405
```

## soc/at/at32/at32f402_405/Kconfig.defconfig.at32f405
```kconfig
# Copyright (c) 2021, ATL Electronics
# SPDX-License-Identifier: Apache-2.0

if SOC_AT32F405

config NUM_IRQS
	default 104

endif # SOC_AT32F405
```

## soc/at/at32/at32f402_405/Kconfig.soc
```kconfig
# Copyright (c) 2024, Maxjta
# SPDX-License-Identifier: Apache-2.0

config SOC_SERIES_AT32F402_405
	bool
	select SOC_FAMILY_AT32
	help
	  Enable support for Artery AT32F402_405 MCU series

config SOC_SERIES
	default "at32f402_405" if SOC_SERIES_AT32F402_405

config SOC_AT32F405
	bool
	select SOC_SERIES_AT32F402_405
	
config SOC_AT32F402
	bool
	select SOC_SERIES_AT32F402_405

config SOC
	default "at32f405" if SOC_AT32F405
	default "at32f402" if SOC_AT32F402
```

## soc/atmel/sam/Kconfig
```kconfig
# Copyright (c) 2024 Gerson Fernando Budke <nandojve@gmail.com>
# SPDX-License-Identifier: Apache-2.0

config SOC_FAMILY_ATMEL_SAM
	select ASF
	select HAS_SEGGER_RTT if ZEPHYR_SEGGER_MODULE

if SOC_FAMILY_ATMEL_SAM

rsource "*/Kconfig"

endif # SOC_FAMILY_ATMEL_SAM
```

## soc/atmel/sam/Kconfig.soc
```kconfig
# Copyright (c) 2024 Gerson Fernando Budke <nandojve@gmail.com>
# SPDX-License-Identifier: Apache-2.0

config SOC_FAMILY_ATMEL_SAM
	bool

config SOC_FAMILY
	default "atmel_sam" if SOC_FAMILY_ATMEL_SAM

rsource "*/Kconfig.soc"
```

## soc/atmel/sam/common/Kconfig
```kconfig
# Atmel SAM MCU series general configuration options

# Copyright (c) 2024 Gerson Fernando Budke <nandojve@gmail.com>
# SPDX-License-Identifier: Apache-2.0

if SOC_FAMILY_ATMEL_SAM && !SOC_SERIES_SAM4L

menu "Clocks"

config SOC_ATMEL_SAM_EXT_SLCK
	bool "Use external crystal oscillator for slow clock"
	help
	  Says y if you want to use external 32 kHz crystal oscillator to drive
	  the slow clock. Note that this adds a few seconds to boot time, as the
	  crystal needs to stabilize after power-up.

	  Says n if you do not need accurate and precise timers. The slow clock
	  will be driven by the internal fast RC oscillator running at 32 kHz.

config SOC_ATMEL_SAM_EXT_MAINCK
	bool "Use external crystal oscillator for main clock"
	default y
	help
	  The main clock is being used to drive the PLL, and thus driving the
	  processor clock.

	  Says y if you want to use external crystal oscillator to drive the
	  main clock. Note that this adds about a second to boot time, as the
	  crystal needs to stabilize after power-up.

	  The crystal used here can be from 3 to 20 MHz.

	  Says n here will use the internal fast RC oscillator running at 12 MHz.

config SOC_ATMEL_SAM_EXT_MAINCK_BYPASS
	bool "Use bypass mode for external crystal oscillator"
	depends on SOC_ATMEL_SAM_EXT_MAINCK
	help
	  When bypass mode is enabled, the external crystal oscillator is bypassed,
	  and the main clock is directly driven by an external clock signal.

	  Says y here if you want to use an external clock signal directly instead
	  of the crystal oscillator.

	  Says n here to use the external crystal oscillator normally.

menu "PLL A"

config SOC_ATMEL_SAM_PLLA_MULA
	int "PLL MULA"
	default  6 if SOC_SERIES_SAM3X
	default  9 if SOC_SERIES_SAM4S  || SOC_SERIES_SAM4E
	default 24 if SOC_SERIES_SAMX7X
	range 1 62
	help
	  This is the multiplier (MULA) used by the PLL.
	  The processor clock is (MAINCK * (MULA + 1) / DIVA).

	  Board config file can override this settings for a particular board.

	  With default of MULA == N, and DIVA == 1 the PLL will run at N+1 times
	  the main clock frequency.

config SOC_ATMEL_SAM_PLLA_DIVA
	int "PLL DIVA"
	default 1
	range 1 $(UINT8_MAX)
	help
	  This is the divider (DIVA) used by the PLL.
	  The processor clock is (MAINCK * (MULA + 1) / DIVA).

	  Board config file can override this settings
	  for a particular board.

	  With default of MULA == N, and DIVA == 1 the PLL will run at N+1 times
	  the main clock frequency.

config SOC_ATMEL_SAM_MDIV
	int "MDIV"
	depends on SOC_SERIES_SAMX7X
	default 2
	range 1 4
	help
	  This divisor defines a ratio between processor clock (HCLK)
	  and master clock (MCK) where the maximum value is 150MHz:
	  MCK = HCLK / MDIV

endmenu # PLL A
endmenu # clocks

config SOC_ATMEL_SAM_WAIT_MODE
	bool "CPU goes to Wait mode instead of Sleep mode"
	depends on SOC_ATMEL_SAM_EXT_MAINCK
	default y if DEBUG
	help
	  For JTAG debugging CPU clock (HCLK) should not stop. In order to
	  achieve this, make CPU go to Wait mode instead of Sleep mode while
	  using external crystal oscillator for main clock.

config SOC_ATMEL_SAM_DISABLE_ERASE_PIN
	bool "Disable ERASE pin"
	help
	  At reset ERASE pin is configured in System IO mode. Asserting the
	  ERASE pin at '1' will completely erase Flash memory. Setting this
	  option will switch the pin to general IO mode giving control of the
	  pin to the GPIO module.

endif # SOC_FAMILY_ATMEL_SAM && !SOC_SERIES_SAM4L
```

## soc/atmel/sam/sam3x/Kconfig
```kconfig
# Atmel SAM3X MCU series

# Copyright (c) 2014-2015 Wind River Systems, Inc.
# Copyright (c) 2016 Intel Corporation.
# Copyright (c) 2017 Justin Watson
# Copyright (c) 2023-2024 Gerson Fernando Budke <nandojve@gmail.com>
# SPDX-License-Identifier: Apache-2.0

config SOC_SERIES_SAM3X
	select ARM
	select CPU_CORTEX_M3
	select CPU_CORTEX_M_HAS_DWT
	select CPU_HAS_ARM_MPU
	select PLATFORM_SPECIFIC_INIT
	select HAS_POWEROFF
```

## soc/atmel/sam/sam3x/Kconfig.defconfig
```kconfig
# Atmel SAM3X MCU series configuration options

# Copyright (c) 2014-2015 Wind River Systems, Inc.
# Copyright (c) 2016 Intel Corporation.
# Copyright (c) 2017 Justin Watson
# Copyright (c) 2024 Gerson Fernando Budke <nandojve@gmail.com>
# SPDX-License-Identifier: Apache-2.0

if SOC_SERIES_SAM3X

config NUM_IRQS
	default 45

endif # SOC_SERIES_SAM3X
```

## soc/atmel/sam/sam3x/Kconfig.soc
```kconfig
# Atmel SAM3X MCU series

# Copyright (c) 2014-2015 Wind River Systems, Inc.
# Copyright (c) 2016 Intel Corporation.
# Copyright (c) 2017 Justin Watson
# Copyright (c) 2024 Gerson Fernando Budke <nandojve@gmail.com>
# SPDX-License-Identifier: Apache-2.0

config SOC_SERIES_SAM3X
	bool
	select SOC_FAMILY_ATMEL_SAM
	help
	  Enable support for Atmel SAM3X MCU Series

config SOC_SERIES
	default "sam3x" if SOC_SERIES_SAM3X

config SOC_SAM3X4C
	bool
	select SOC_SERIES_SAM3X

config SOC_SAM3X4E
	bool
	select SOC_SERIES_SAM3X

config SOC_SAM3X8C
	bool
	select SOC_SERIES_SAM3X

config SOC_SAM3X8E
	bool
	select SOC_SERIES_SAM3X

config SOC_SAM3X8H
	bool
	select SOC_SERIES_SAM3X

config SOC
	default "sam3x4c" if SOC_SAM3X4C
	default "sam3x4e" if SOC_SAM3X4E
	default "sam3x8c" if SOC_SAM3X8C
	default "sam3x8e" if SOC_SAM3X8E
	default "sam3x8h" if SOC_SAM3X8H
```

## soc/atmel/sam/sam4e/Kconfig
```kconfig
# Atmel SAM4E MCU series

# Copyright (c) 2017 Justin Watson
# Copyright (c) 2018 Vincent van der Locht
# Copyright (c) 2019-2024 Gerson Fernando Budke <nandojve@gmail.com>
# SPDX-License-Identifier: Apache-2.0

config SOC_SERIES_SAM4E
	select ARM
	select CPU_CORTEX_M4
	select CPU_CORTEX_M_HAS_DWT
	select CPU_HAS_ARM_MPU
	select CPU_HAS_FPU
	select PLATFORM_SPECIFIC_INIT
	select HAS_POWEROFF
```

## soc/atmel/sam/sam4e/Kconfig.defconfig
```kconfig
# Atmel SAM4E MCU series configuration options

# Copyright (c) 2017 Justin Watson
# Copyright (c) 2018 Vincent van der Locht
# Copyright (c) 2019-2024 Gerson Fernando Budke <nandojve@gmail.com>
# SPDX-License-Identifier: Apache-2.0

if SOC_SERIES_SAM4E

config NUM_IRQS
	default 47

endif # SOC_SERIES_SAM4E
```

## soc/atmel/sam/sam4e/Kconfig.soc
```kconfig
# Atmel SAM4E MCU series

# Copyright (c) 2017 Justin Watson
# Copyright (c) 2018 Vincent van der Locht
# Copyright (c) 2019-2024 Gerson Fernando Budke <nandojve@gmail.com>
# SPDX-License-Identifier: Apache-2.0

config SOC_SERIES_SAM4E
	bool
	select SOC_FAMILY_ATMEL_SAM
	help
	  Enable support for Atmel SAM4E MCU series

config SOC_SERIES
	default "sam4e" if SOC_SERIES_SAM4E

config SOC_SAM4E16E
	bool
	select SOC_SERIES_SAM4E

config SOC_SAM4E16C
	bool
	select SOC_SERIES_SAM4E

config SOC_SAM4E8E
	bool
	select SOC_SERIES_SAM4E

config SOC_SAM4E8C
	bool
	select SOC_SERIES_SAM4E

config SOC
	default "sam4e16e" if SOC_SAM4E16E
	default "sam4e16c" if SOC_SAM4E16C
	default "sam4e8e" if SOC_SAM4E8E
	default "sam4e8c" if SOC_SAM4E8C
```

## soc/atmel/sam/sam4l/Kconfig
```kconfig
# Copyright (c) 2020-2024 Gerson Fernando Budke <nandojve@gmail.com>
# SPDX-License-Identifier: Apache-2.0

config SOC_SERIES_SAM4L
	select ARM
	select CPU_CORTEX_M4
	select CPU_CORTEX_M_HAS_DWT
	select CPU_HAS_ARM_MPU
	select SOC_RESET_HOOK
	select HAS_POWEROFF
```

## soc/atmel/sam/sam4l/Kconfig.defconfig
```kconfig
# Copyright (c) 2020-2024 Gerson Fernando Budke <nandojve@gmail.com>
# SPDX-License-Identifier: Apache-2.0

if SOC_SERIES_SAM4L

config NUM_IRQS
	default 80

endif # SOC_SERIES_SAM4L
```

## soc/atmel/sam/sam4l/Kconfig.soc
```kconfig
# Copyright (c) 2020-2024 Gerson Fernando Budke <nandojve@gmail.com>
# SPDX-License-Identifier: Apache-2.0

config SOC_SERIES_SAM4L
	bool
	select SOC_FAMILY_ATMEL_SAM
	help
	  Enable support for Atmel SAM4L Cortex-M4 microcontrollers.
	  Part No.: SAM4LS8C, SAM4LS8B, SAM4LS8A, SAM4LS4C, SAM4LS4B,
	  SAM4LS4A, SAM4LS2C, SAM4LS2B, SAM4LS2A, SAM4LC8C, SAM4LC8B,
	  SAM4LC8A, SAM4LC4C, SAM4LC4B, SAM4LC4A SAM4LC2C, SAM4LC2B,
	  SAM4LC2A

config SOC_SERIES
	default "sam4l" if SOC_SERIES_SAM4L

config SOC_SAM4LS2A
	bool
	select SOC_SERIES_SAM4L

config SOC_SAM4LS2B
	bool
	select SOC_SERIES_SAM4L

config SOC_SAM4LS2C
	bool
	select SOC_SERIES_SAM4L

config SOC_SAM4LS4A
	bool
	select SOC_SERIES_SAM4L

config SOC_SAM4LS4B
	bool
	select SOC_SERIES_SAM4L

config SOC_SAM4LS4C
	bool
	select SOC_SERIES_SAM4L

config SOC_SAM4LS8A
	bool
	select SOC_SERIES_SAM4L

config SOC_SAM4LS8B
	bool
	select SOC_SERIES_SAM4L

config SOC_SAM4LS8C
	bool
	select SOC_SERIES_SAM4L

config SOC_SAM4LC2A
	bool
	select SOC_SERIES_SAM4L

config SOC_SAM4LC2B
	bool
	select SOC_SERIES_SAM4L

config SOC_SAM4LC2C
	bool
	select SOC_SERIES_SAM4L

config SOC_SAM4LC4A
	bool
	select SOC_SERIES_SAM4L

config SOC_SAM4LC4B
	bool
	select SOC_SERIES_SAM4L

config SOC_SAM4LC4C
	bool
	select SOC_SERIES_SAM4L

config SOC_SAM4LC8A
	bool
	select SOC_SERIES_SAM4L

config SOC_SAM4LC8B
	bool
	select SOC_SERIES_SAM4L

config SOC_SAM4LC8C
	bool
	select SOC_SERIES_SAM4L

config SOC
	default "sam4ls2a" if SOC_SAM4LS2A
	default "sam4ls2b" if SOC_SAM4LS2B
	default "sam4ls2c" if SOC_SAM4LS2C
	default "sam4ls4a" if SOC_SAM4LS4A
	default "sam4ls4b" if SOC_SAM4LS4B
	default "sam4ls4c" if SOC_SAM4LS4C
	default "sam4ls8a" if SOC_SAM4LS8A
	default "sam4ls8b" if SOC_SAM4LS8B
	default "sam4ls8c" if SOC_SAM4LS8C
	default "sam4lc2a" if SOC_SAM4LC2A
	default "sam4lc2b" if SOC_SAM4LC2B
	default "sam4lc2c" if SOC_SAM4LC2C
	default "sam4lc4a" if SOC_SAM4LC4A
	default "sam4lc4b" if SOC_SAM4LC4B
	default "sam4lc4c" if SOC_SAM4LC4C
	default "sam4lc8a" if SOC_SAM4LC8A
	default "sam4lc8b" if SOC_SAM4LC8B
	default "sam4lc8c" if SOC_SAM4LC8C
```

## soc/atmel/sam/sam4s/Kconfig
```kconfig
# Atmel SAM4S MCU series

# Copyright (c) 2017 Justin Watson
# Copyright (c) 2018 Vincent van der Locht
# Copyright (c) 2020-2024 Gerson Fernando Budke <nandojve@gmail.com>
# SPDX-License-Identifier: Apache-2.0

config SOC_SERIES_SAM4S
	select ARM
	select CPU_CORTEX_M4
	select CPU_CORTEX_M_HAS_DWT
	select CPU_HAS_ARM_MPU
	select PLATFORM_SPECIFIC_INIT
	select HAS_POWEROFF
```

## soc/atmel/sam/sam4s/Kconfig.defconfig
```kconfig
# Atmel SAM4S MCU series configuration options

# Copyright (c) 2017 Justin Watson
# Copyright (c) 2018 Vincent van der Locht
# Copyright (c) 2024 Gerson Fernando Budke <nandojve@gmail.com>
# SPDX-License-Identifier: Apache-2.0

if SOC_SERIES_SAM4S

config NUM_IRQS
	default 35

endif # SOC_SERIES_SAM4S
```

## soc/atmel/sam/sam4s/Kconfig.soc
```kconfig
# Atmel SAM4S MCU series

# Copyright (c) 2017 Justin Watson
# Copyright (c) 2018 Vincent van der Locht
# Copyright (c) 2024 Gerson Fernando Budke <nandojve@gmail.com>
# SPDX-License-Identifier: Apache-2.0

config SOC_SERIES_SAM4S
	bool
	select SOC_FAMILY_ATMEL_SAM
	help
	  Enable support for Atmel SAM4S Cortex-M4 microcontrollers.
	  Part No.: SAM4S16C, SAM4S16B, SAM4S8C, SAM4S8B,
	  SAM4S4C, SAM4S4B, SAM4S4A, SAM4S2C, SAM4S2B, SAM4S2A

config SOC_SERIES
	default "sam4s" if SOC_SERIES_SAM4S

config SOC_SAM4S2A
	bool
	select SOC_SERIES_SAM4S

config SOC_SAM4S2B
	bool
	select SOC_SERIES_SAM4S

config SOC_SAM4S2C
	bool
	select SOC_SERIES_SAM4S

config SOC_SAM4S4A
	bool
	select SOC_SERIES_SAM4S

config SOC_SAM4S4B
	bool
	select SOC_SERIES_SAM4S

config SOC_SAM4S4C
	bool
	select SOC_SERIES_SAM4S

config SOC_SAM4S8B
	bool
	select SOC_SERIES_SAM4S

config SOC_SAM4S8C
	bool
	select SOC_SERIES_SAM4S

config SOC_SAM4S16B
	bool
	select SOC_SERIES_SAM4S

config SOC_SAM4S16C
	bool
	select SOC_SERIES_SAM4S

config SOC_SAM4SA16C
	bool
	select SOC_SERIES_SAM4S

config SOC
	default "sam4s2a" if SOC_SAM4S2A
	default "sam4s2b" if SOC_SAM4S2B
	default "sam4s2c" if SOC_SAM4S2C
	default "sam4s4a" if SOC_SAM4S4A
	default "sam4s4b" if SOC_SAM4S4B
	default "sam4s4c" if SOC_SAM4S4C
	default "sam4s8b" if SOC_SAM4S8B
	default "sam4s8c" if SOC_SAM4S8C
	default "sam4s16b" if SOC_SAM4S16B
	default "sam4s16c" if SOC_SAM4S16C
	default "sam4sa16c" if SOC_SAM4SA16C
```

## soc/atmel/sam/same70/Kconfig
```kconfig
# Atmel SAM E70 MCU series

# Copyright (c) 2016 Piotr Mienkowski
# Copyright (c) 2023-2024 Gerson Fernando Budke <nandojve@gmail.com>
# SPDX-License-Identifier: Apache-2.0

config SOC_SERIES_SAME70
	select ARM
	select CPU_CORTEX_M7
	select CPU_CORTEX_M_HAS_DWT
	select CPU_HAS_ARM_MPU
	select CPU_HAS_FPU_DOUBLE_PRECISION
	select CPU_HAS_ICACHE
	select CPU_HAS_DCACHE
	select INIT_ARCH_HW_AT_BOOT
	select SOC_RESET_HOOK
	select HAS_SWO
	select XIP
	select HAS_POWEROFF
	select SOC_EARLY_INIT_HOOK
```
