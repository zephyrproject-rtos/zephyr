## soc/arm64/nxp_imx/mimx8qm/Kconfig.series
```kconfig
# Copyright 2023 NXP
# SPDX-License-Identifier: Apache-2.0

config SOC_SERIES_MIMX8QM_A53
	bool "NXP i.MX8QM A53 Core Series"
	select ARM64
	select SOC_FAMILY_IMX
	help
		Enable support for i.MX8QM A53 Series.
```

## soc/arm64/nxp_imx/mimx8qm/Kconfig.soc
```kconfig
# Copyright 2023 NXP
# SPDX-License-Identifier: Apache-2.0

choice
prompt "NXP i.MX8QM A53 Selection"
depends on SOC_SERIES_MIMX8QM_A53

config SOC_MIMX8QM_A53
	bool "NXP i.MX8QM A53"
	select ARM64
	select CPU_CORTEX_A53
	select ARM_ARCH_TIMER
	select GIC_V3
	select HAS_MCUX

endchoice

config SOC_PART_NUMBER_MIMX8QM6AVUFF
	bool

config SOC_PART_NUMBER_MIMX8QM_A53
	string
	default "MIMX8QM6AVUFF_ca53" if SOC_PART_NUMBER_MIMX8QM6AVUFF
	help
		This string holds the full part number of the SoC. It is a hidden
		option that you should not set directly. The part number selection
		choice defines the default value for this string.

config SOC_PART_NUMBER
	default SOC_PART_NUMBER_MIMX8QM_A53 if SOC_MIMX8QM_A53
```

## soc/arm64/nxp_imx/mimx9/Kconfig.defconfig.series
```kconfig
# Copyright 2022 NXP
# SPDX-License-Identifier: Apache-2.0

if SOC_SERIES_MIMX9_A55

config SOC_SERIES
	default "mimx9"

source "soc/arm64/nxp_imx/mimx9/Kconfig.defconfig.mimx9*"

endif # SOC_SERIES_MIMX9_A55
```

## soc/arm64/nxp_imx/mimx9/Kconfig.series
```kconfig
# Copyright 2022 NXP
# SPDX-License-Identifier: Apache-2.0

config SOC_SERIES_MIMX9_A55
	bool "NXP i.MX9 A55 Core Series"
	select ARM64
	select SOC_FAMILY_IMX
	help
	  Enable support for i.MX9 A55 Series.
```

## soc/arm64/nxp_imx/mimx9/Kconfig.soc
```kconfig
# Copyright 2022 NXP
# SPDX-License-Identifier: Apache-2.0

choice
prompt "NXP i.MX9 A55 Selection"
depends on SOC_SERIES_MIMX9_A55

config SOC_MIMX93_A55
	bool "NXP i.MX93 A55"
	select ARM64
	select CPU_CORTEX_A55
	select ARM_ARCH_TIMER
	select GIC_V3
	select HAS_MCUX if CLOCK_CONTROL
	select HAS_MCUX_CCM if CLOCK_CONTROL
	select HAS_MCUX_IOMUXC if PINCTRL

endchoice

config SOC_PART_NUMBER_MIMX9352CVUXK
	bool

config SOC_PART_NUMBER_MIMX9352DVUXM
	bool

config SOC_PART_NUMBER_MIMX93_A55
	string
	default "MIMX9352CVUXK_ca55" if  SOC_PART_NUMBER_MIMX9352CVUXK
	default "MIMX9352DVUXM_ca55" if  SOC_PART_NUMBER_MIMX9352DVUXM
	help
	  This string holds the full part number of the SoC. It is a hidden option
	  that you should not set directly. The part number selection choice defines
	  the default value for this string.

config SOC_PART_NUMBER
	default SOC_PART_NUMBER_MIMX93_A55 if SOC_MIMX93_A55
```

## soc/arm64/nxp_layerscape/Kconfig
```kconfig
#
# Copyright 2021 NXP
#
# SPDX-License-Identifier: Apache-2.0
#

config SOC_FAMILY_LS
	bool

if SOC_FAMILY_LS

config SOC_FAMILY
	string
	default "nxp_layerscape"

source "soc/arm64/nxp_layerscape/*/Kconfig.soc"

config SOC_PART_NUMBER
	default "LS1046A" if SOC_SERIES_LS1046A

endif # SOC_FAMILY_LS
```

## soc/arm64/nxp_layerscape/Kconfig.soc
```kconfig
#
# Copyright 2021 NXP
#
# SPDX-License-Identifier: Apache-2.0
#

source "soc/arm64/nxp_layerscape/*/Kconfig.series"
```

## soc/arm64/nxp_layerscape/ls1046a/Kconfig.defconfig.ls1046a
```kconfig
#
# Copyright 2021 NXP
#
# SPDX-License-Identifier: Apache-2.0
#

if SOC_LS1046A

config SOC
	default "ls1046a"

config NUM_IRQS
	int
	default 240

config FLASH_SIZE
	default 0

config FLASH_BASE_ADDRESS
	default 0

endif
```

## soc/arm64/nxp_layerscape/ls1046a/Kconfig.defconfig.series
```kconfig
#
# Copyright 2021 NXP
#
# SPDX-License-Identifier: Apache-2.0
#

if SOC_SERIES_LS1046A

config SOC_SERIES
	default "ls1046a"

source "soc/arm64/nxp_layerscape/ls1046a/Kconfig.defconfig.ls1046a"

endif # SOC_SERIES_LS1046A
```

## soc/arm64/nxp_layerscape/ls1046a/Kconfig.series
```kconfig
#
# Copyright 2021 NXP
#
# SPDX-License-Identifier: Apache-2.0
#

config SOC_SERIES_LS1046A
	bool "NXP LS1046A Series"
	select ARM64
	select SOC_FAMILY_LS
	help
	  Enable support for NXP ls1046a Series.
```

## soc/arm64/nxp_layerscape/ls1046a/Kconfig.soc
```kconfig
#
# Copyright 2021 NXP
#
# SPDX-License-Identifier: Apache-2.0
#

choice
prompt "NXP Layerscpae LS1046A SoC"
depends on SOC_SERIES_LS1046A

config SOC_LS1046A
	bool "NXP ls1046a"
	select ARM64
	select CPU_CORTEX_A72
	select ARM_ARCH_TIMER
	select GIC_V2

endchoice
```

## soc/arm64/qemu_cortex_a53/Kconfig.soc
```kconfig
# Copyright (c) 2019 Carlo Caione <ccaione@baylibre.com>
# SPDX-License-Identifier: Apache-2.0

config SOC_QEMU_CORTEX_A53
	bool "QEMU virt platform (cortex-a53)"
	select ARM64
	select CPU_CORTEX_A53
```

## soc/arm64/qemu_cortex_a55/Kconfig.soc
```kconfig
# Copyright 2022 NXP
# SPDX-License-Identifier: Apache-2.0

config SOC_QEMU_CORTEX_A55
	bool "QEMU virt platform (cortex-a55)"
	select ARM64
	select CPU_CORTEX_A55
	select GIC_V3
```

## soc/arm64/qemu_virt_arm64/Kconfig.defconfig
```kconfig
# Copyright (c) 2022 Huawei France Technologies SAS
# SPDX-License-Identifier: Apache-2.0

if SOC_QEMU_VIRT_ARM64

config SOC
	default "qemu_virt_arm64"

config NUM_IRQS
	# must be >= the highest interrupt number used
	# - include the UART interrupts
	# - LPIs (starting at 8192) if GIC_V3_ITS is used
	default 16384 if GIC_V3_ITS
	default 220 if !GIC_V3_ITS

# Dummy value, read at runtime
config SYS_CLOCK_HW_CYCLES_PER_SEC
	default 1

# Workaround for not being able to have commas in macro arguments
DT_CHOSEN_Z_FLASH := zephyr,flash

config FLASH_SIZE
	default $(dt_chosen_reg_size_int,$(DT_CHOSEN_Z_FLASH),0,K)

config FLASH_BASE_ADDRESS
	default $(dt_chosen_reg_addr_hex,$(DT_CHOSEN_Z_FLASH))

endif # SOC_QEMU_VIRT_ARM64
```

## soc/arm64/qemu_virt_arm64/Kconfig.soc
```kconfig
# Copyright (c) 2022 Huawei France Technologies SAS
# SPDX-License-Identifier: Apache-2.0

config SOC_QEMU_VIRT_ARM64
	bool "QEMU virt platform (AArch64 for KVM)"
	select ARM64
	select CPU_CORTEX_A
	select ARMV8_A
```

## soc/arm64/renesas_rcar/Kconfig
```kconfig
# Renesas R-Car SoC line

# Copyright (c) 2023 EPAM Systems
# SPDX-License-Identifier: Apache-2.0

config SOC_FAMILY_RCAR
	bool

if SOC_FAMILY_RCAR

config SOC_FAMILY
	string
	default "renesas_rcar"

source "soc/arm64/renesas_rcar/*/Kconfig.soc"

endif # SOC_FAMILY_RCAR
```

## soc/arm64/renesas_rcar/Kconfig.defconfig
```kconfig
# Copyright (c) 2023 EPAM Systems
# SPDX-License-Identifier: Apache-2.0

source "soc/arm64/renesas_rcar/*/Kconfig.defconfig.series"
```

## soc/arm64/renesas_rcar/gen3/Kconfig.defconfig.r8a77951
```kconfig
# Copyright (c) 2023 EPAM Systems
# SPDX-License-Identifier: Apache-2.0

if SOC_ARM64_R8A77951

config SOC
	default "r8a77951"

endif # SOC_ARM64_R8A77951
```

## soc/arm64/renesas_rcar/gen3/Kconfig.defconfig.r8a77961
```kconfig
# Copyright (c) 2023 EPAM Systems
# SPDX-License-Identifier: Apache-2.0

if SOC_R8A77961

config SOC
	default "r8a77961"

endif # SOC_R8A77961
```

## soc/arm64/renesas_rcar/gen3/Kconfig.series
```kconfig
# Copyright (c) 2023 EPAM Systems
# SPDX-License-Identifier: Apache-2.0

config SOC_SERIES_RCAR_GEN3
	bool "Renesas RCAR Gen3 Cortex A"
	select ARM64
	select CPU_CORTEX_A57
	select SOC_FAMILY_RCAR
	select ARM_ARCH_TIMER if SYS_CLOCK_EXISTS
	select CLOCK_CONTROL_RCAR_CPG_MSSR if CLOCK_CONTROL
	help
	  Enable support for Renesas RCar Gen3 SoC series
```

## soc/arm64/renesas_rcar/gen3/Kconfig.soc
```kconfig
# Copyright (c) 2023 EPAM Systems
# SPDX-License-Identifier: Apache-2.0

choice
	prompt "Renesas RCar SoC Selection"
	depends on SOC_SERIES_RCAR_GEN3

config SOC_ARM64_R8A77951
	bool "R8A77951"

config SOC_R8A77961
	bool "R8A77961"

endchoice
```

## soc/arm64/renesas_rcar/gen4/Kconfig.defconfig.r8a779f0
```kconfig
# Copyright (c) 2023 EPAM Systems
# SPDX-License-Identifier: Apache-2.0

if SOC_R8A779F0

config SOC
	default "r8a779f0"

endif # SOC_R8A779F0
```

## soc/arm64/renesas_rcar/gen4/Kconfig.defconfig.series
```kconfig
# Renesas R-Car Gen3 SoC line
#
# Copyright (c) 2023 EPAM Systems
# SPDX-License-Identifier: Apache-2.0

if SOC_SERIES_RCAR_GEN4

config SOC_SERIES
	default "gen4"

config NUM_IRQS
	int
	default 500

config PINCTRL
	default y

endif # SOC_SERIES_RCAR_GEN4
```

## soc/arm64/renesas_rcar/gen4/Kconfig.series
```kconfig
# Copyright (c) 2023 EPAM Systems
# SPDX-License-Identifier: Apache-2.0

config SOC_SERIES_RCAR_GEN4
	bool "Renesas RCAR Gen4 Cortex A"
	select ARM64
	select CPU_CORTEX_A55
	select SOC_FAMILY_RCAR
	select ARM_ARCH_TIMER
	select CLOCK_CONTROL_RCAR_CPG_MSSR if CLOCK_CONTROL
	help
	  Enable support for Renesas RCar Gen4 SoC series
```

## soc/arm64/renesas_rcar/gen4/Kconfig.soc
```kconfig
# Copyright (c) 2023 EPAM Systems
# SPDX-License-Identifier: Apache-2.0

choice
	prompt "Renesas RCar Gen4 SoC Selection"
	depends on SOC_SERIES_RCAR_GEN4

config SOC_R8A779F0
	bool "R8A779F0"

endchoice
```
