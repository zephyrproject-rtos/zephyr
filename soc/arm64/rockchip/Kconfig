## soc/arm64/rockchip/Kconfig
```kconfig
#
# Copyright 2021 Huawei France Technologies SASU
#
# SPDX-License-Identifier: Apache-2.0
#

config SOC_FAMILY_ROCKCHIP
	bool

if SOC_FAMILY_ROCKCHIP

config SOC_FAMILY
	string
	default "rockchip"

source "soc/arm64/rockchip/*/Kconfig.soc"

config SOC_PART_NUMBER
	default "RK3399" if SOC_SERIES_RK3399

endif # SOC_FAMILY_ROCKCHIP
```

## soc/arm64/rockchip/Kconfig.defconfig
```kconfig
#
# Copyright 2021 Huawei France Technologies SASU
#
# SPDX-License-Identifier: Apache-2.0
#

source "soc/arm64/rockchip/*/Kconfig.defconfig.series"
```

## soc/arm64/rockchip/rk3399/Kconfig.defconfig.rk3399
```kconfig
#
# Copyright 2022 Huawei France Technologies SASU
#
# SPDX-License-Identifier: Apache-2.0
#

if SOC_RK3399

config SOC
	default "rk3399"

config NUM_IRQS
	int
	default 240

config FLASH_SIZE
	default 0

config FLASH_BASE_ADDRESS
	default 0

endif
```

## soc/arm64/rockchip/rk3399/Kconfig.defconfig.series
```kconfig
#
# Copyright 2022 Huawei France Technologies SASU
#
# SPDX-License-Identifier: Apache-2.0
#

if SOC_SERIES_RK3399

config SOC_SERIES
	default "rk3399"

source "soc/arm64/rockchip/rk3399/Kconfig.defconfig.rk3399"

endif # SOC_SERIES_RK3399
```

## soc/arm64/rockchip/rk3399/Kconfig.series
```kconfig
#
# Copyright 2022 Huawei France Technologies SASU
#
# SPDX-License-Identifier: Apache-2.0
#

config SOC_SERIES_RK3399
	bool "Rockchip RK3399 Series"
	select ARM64
	select SOC_FAMILY_ROCKCHIP
	help
	  Enable support for Rockchip RK3399 Series.
```

## soc/arm64/rockchip/rk3399/Kconfig.soc
```kconfig
#
# Copyright 2022 Huawei France Technologies SASU
#
# SPDX-License-Identifier: Apache-2.0
#

choice
prompt "Rockchip RK3399 SoC"
depends on SOC_SERIES_RK3399

config SOC_RK3399
	bool "Rockchip RK3399"
	select ARM64
	select CPU_CORTEX_A53
	select ARM_ARCH_TIMER
	select GIC_V3

endchoice
```

## soc/arm64/rockchip/rk3568/Kconfig.defconfig.rk3568
```kconfig
# Copyright 2022 HNU
# Copyright 2022 openEuler SIG-Zephyr
# SPDX-License-Identifier: Apache-2.0

if SOC_RK3568

config SOC
	default "rk3568"

config FLASH_SIZE
	default $(dt_chosen_reg_size_int,$(DT_CHOSEN_Z_FLASH),0,K)

config FLASH_BASE_ADDRESS
	default $(dt_chosen_reg_addr_hex,$(DT_CHOSEN_Z_FLASH))

config NUM_IRQS
	int
	default 240

config SYS_CLOCK_HW_CYCLES_PER_SEC
	int
	default 24000000

endif
```

## soc/arm64/rockchip/rk3568/Kconfig.defconfig.series
```kconfig
# Copyright 2022 HNU-ESNL
# Copyright 2022 openEuler SIG-Zephyr
# SPDX-License-Identifier: Apache-2.0

if SOC_SERIES_RK3568

config SOC_SERIES
	default "rk3568"

source "soc/arm64/rockchip/rk3568/Kconfig.defconfig.rk3568"

endif # SOC_SERIES_RK3568
```

## soc/arm64/rockchip/rk3568/Kconfig.series
```kconfig
# Copyright 2022 HNU-ESNL
# Copyright 2022 openEuler SIG-Zephyrs
# SPDX-License-Identifier: Apache-2.0

config SOC_SERIES_RK3568
	bool "Rockchip RK3568 Series"
	select ARM64
	select SOC_FAMILY_ROCKCHIP
	help
	  Enable support for RK3568 Series.
```

## soc/arm64/rockchip/rk3568/Kconfig.soc
```kconfig
# Copyright 2022 HNU-ESNL
# Copyright 2022 openEuler SIG-Zephyr
# SPDX-License-Identifier: Apache-2.0

choice
prompt "Rockchip RK3568 SoC"
depends on SOC_SERIES_RK3568

config SOC_RK3568
	bool "Rockchip rk3568"
	select ARM64
	select CPU_CORTEX_A55
	select ARM_ARCH_TIMER
	select GIC_V3

endchoice
```

## soc/arm64/ti_k3/Kconfig
```kconfig
# Texas Instruments Keystone 3 (K3) Family
#
# Copyright (c) 2023 Enphase Energy
# SPDX-License-Identifier: Apache-2.0

config SOC_FAMILY_TI_K3
	bool

if SOC_FAMILY_TI_K3

config SOC_FAMILY
	string
	default "ti_k3"

source "soc/arm64/ti_k3/*/Kconfig.soc"

endif # SOC_FAMILY_TI_K3
```

## soc/arm64/ti_k3/Kconfig.defconfig
```kconfig
# Texas Instruments Keystone 3 (K3) Family
#
# Copyright (c) 2023 Enphase Energy
# SPDX-License-Identifier: Apache-2.0

source "soc/arm64/ti_k3/*/Kconfig.defconfig.series"
```

## soc/arm64/ti_k3/am6x/Kconfig.defconfig.series
```kconfig
# Copyright (c) 2023 Enphase Energy
# SPDX-License-Identifier: Apache-2.0

if SOC_SERIES_AM6X_A53

config SOC_SERIES
	default "am6x"

# Workaround for not being able to have commas in macro arguments
DT_CHOSEN_Z_FLASH := zephyr,flash

config FLASH_SIZE
	default $(dt_chosen_reg_size_int,$(DT_CHOSEN_Z_FLASH),0,K)

config FLASH_BASE_ADDRESS
	default $(dt_chosen_reg_addr_hex,$(DT_CHOSEN_Z_FLASH))

config NUM_IRQS
	int
	default 280

config SYS_CLOCK_HW_CYCLES_PER_SEC
	int
	default 200000000

config PINCTRL
	default y

if SERIAL

config UART_NS16550
	default y

choice UART_NS16550_VARIANT
	default UART_NS16550_VARIANT_NS16750
endchoice

endif # SERIAL

source "soc/arm64/ti_k3/am6x/Kconfig.defconfig.am62*"

endif # SOC_SERIES_AM6X_A53
```

## soc/arm64/ti_k3/am6x/Kconfig.soc
```kconfig
# Copyright (c) 2023 Enphase Energy
# SPDX-License-Identifier: Apache-2.0

choice
prompt "TI AM6X A53 Selection"
depends on SOC_SERIES_AM6X_A53

config SOC_AM6234_A53
	bool "TI AM6234 A53"
	select SOC_PART_NUMBER_AM6234

endchoice

config SOC_PART_NUMBER_AM6234
	bool

config SOC_PART_NUMBER_AM6X_A53
	string
	default "AM6234" if SOC_PART_NUMBER_AM6234
	help
	  This string holds the full part number of the SoC. It is a hidden option
	  that you should not set directly. The part number selection choice defines
	  the default value for this string.

config SOC_PART_NUMBER
	default SOC_PART_NUMBER_AM6X_A53 if SOC_SERIES_AM6X_A53
```

## soc/arm64/ti_sitara/Kconfig
```kconfig
# Copyright (c) 2023 Enphase Energy
# SPDX-License-Identifier: Apache-2.0

config SOC_FAMILY_SITARA
	bool

if SOC_FAMILY_SITARA

config SOC_FAMILY
	string
	default "ti_sitara"

source "soc/arm64/ti_sitara/*/Kconfig.soc"

endif # SOC_FAMILY_SITARA
```

## soc/arm64/ti_sitara/Kconfig.soc
```kconfig
# Copyright (c) 2023 Enphase Energy
# SPDX-License-Identifier: Apache-2.0

source "soc/arm64/ti_sitara/*/Kconfig.series"
```

## soc/arm64/ti_sitara/am6x/Kconfig.defconfig.am6234
```kconfig
# Copyright (c) 2023 Enphase Energy
# SPDX-License-Identifier: Apache-2.0

if SOC_AM6234_A53

config SOC
	default "am6234"

endif # SOC_AM6234_A53
```

## soc/arm64/ti_sitara/am6x/Kconfig.series
```kconfig
# Copyright (c) 2023 Enphase Energy
# SPDX-License-Identifier: Apache-2.0

config SOC_SERIES_AM6X_A53
	bool "TI AM6X A53 Core Series"
	select SOC_FAMILY_SITARA
	select ARM64
	select CPU_CORTEX_A53
	select ARM_ARCH_TIMER
	select GIC_V3
	help
	  Enable support for AM6X A53 Series.
```

## soc/arm64/xenvm/Kconfig.defconfig
```kconfig
# Copyright 2020 EPAM Systems
# SPDX-License-Identifier: Apache-2.0

if SOC_XENVM

config SOC
	default "xenvm"

config NUM_IRQS
	int
	default 500

config SYS_CLOCK_HW_CYCLES_PER_SEC
	int
	default 8320000

# We need at least 16M of virtual address space to map memory of Xen node
# 32M should be enough for basic use-cases
config KERNEL_VM_SIZE
	default 0x2000000

endif
```

## soc/arm64/xenvm/Kconfig.soc
```kconfig
# Copyright 2020 EPAM Systems
# SPDX-License-Identifier: Apache-2.0

config SOC_XENVM
	bool "Xen virtual machine on aarch64"
	select ARM64
	select ARM_ARCH_TIMER if SYS_CLOCK_EXISTS
	select CPU_CORTEX_A72
```

## soc/artery/at32/Kconfig.defconfig
```kconfig
# Copyright (c) 2024, Maxjta
# SPDX-License-Identifier: Apache-2.0

if SOC_FAMILY_AT32

rsource "*/Kconfig.defconfig"

config SYS_CLOCK_HW_CYCLES_PER_SEC
	default $(dt_node_int_prop_int,/clocks/sysclk,clock-frequency)

config CLOCK_CONTROL
	default y

endif # SOC_FAMILY_AT32
```

## soc/aspeed/Kconfig
```kconfig
# SPDX-License-Identifier: Apache-2.0
#
# Copyright (c) 2021 ASPEED Technology Inc.

config SOC_FAMILY_ASPEED
	select PLATFORM_SPECIFIC_INIT

rsource "*/Kconfig"
```

## soc/aspeed/Kconfig.defconfig
```kconfig
# SPDX-License-Identifier: Apache-2.0
#
# Copyright (c) 2021 ASPEED Technology Inc.

if SOC_FAMILY_ASPEED

rsource "*/Kconfig.defconfig"

endif # SOC_FAMILY_ASPEED
```

## soc/aspeed/Kconfig.soc
```kconfig
# SPDX-License-Identifier: Apache-2.0
#
# Copyright (c) 2021 ASPEED Technology Inc.

config SOC_FAMILY_ASPEED
	bool

config SOC_FAMILY
	default "aspeed" if SOC_FAMILY_ASPEED

rsource "*/Kconfig.soc"
```

## soc/aspeed/ast10x0/Kconfig
```kconfig
# SPDX-License-Identifier: Apache-2.0
#
# Copyright (c) 2021 ASPEED Technology Inc.

config SOC_SERIES_AST10X0
	select ARM
	select CPU_CORTEX_M4
	select CPU_HAS_FPU
	select CPU_HAS_ARM_MPU
	select SYSCON
	select CACHE
	select CPU_HAS_DCACHE
	select CPU_HAS_ICACHE
	select CACHE_MANAGEMENT
	select CACHE_ASPEED

if SOC_SERIES_AST10X0

config SRAM_NC_SIZE
	int "noncached SRAM Size in kB"
	help
	  The non-cached SRAM size in kB. The default value comes from reg[1]
	  of /chosen/zephyr,sram in devicetree. The user should generally avoid
	  changing it via menuconfig or in configuration files.

config SRAM_NC_BASE_ADDRESS
	hex "noncached SRAM Base Address"
	help
	  The non-cached SRAM base address. The default value comes from
	  reg[1] of /chosen/zephyr,sram in devicetree. The user should
	  generally avoid changing it via menuconfig or in configuration files.

endif # SOC_SERIES_AST10X0
```
