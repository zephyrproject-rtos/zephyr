## soc/arm64/bcm_vk/Kconfig.defconfig
```kconfig
# SPDX-License-Identifier: Apache-2.0
#
# Copyright 2020 Broadcom.
#

source "soc/arm64/bcm_vk/*/Kconfig.defconfig.series"
```

## soc/arm64/bcm_vk/viper/Kconfig.defconfig.series
```kconfig
# Copyright 2020 Broadcom
# SPDX-License-Identifier: Apache-2.0

if SOC_SERIES_VIPER

config SOC_SERIES
	default "viper"

source "soc/arm64/bcm_vk/viper/Kconfig.defconfig.viper*"

endif # SOC_SERIES_VIPER
```

## soc/arm64/bcm_vk/viper/Kconfig.series
```kconfig
# Copyright 2020 Broadcom
# SPDX-License-Identifier: Apache-2.0

config SOC_SERIES_VIPER
	bool "Broadcom Viper Series"
	select ARM64
	select SOC_FAMILY_BCMVK
	help
	  Enable support for Broadcom Viper Series.
```

## soc/arm64/bcm_vk/viper/Kconfig.soc
```kconfig
# Copyright 2020 Broadcom
# SPDX-License-Identifier: Apache-2.0

choice
prompt "Broadcom Viper SoC"
depends on SOC_SERIES_VIPER

config SOC_BCM58402_A72
	bool "Broadcom BCM58402 A72"
	select ARM64
	select CPU_CORTEX_A72
	select ARM_ARCH_TIMER if SYS_CLOCK_EXISTS

endchoice
```

## soc/arm64/intel_socfpga/Kconfig
```kconfig
# Copyright (c) 2021 Intel Corporation
# SPDX-License-Identifier: Apache-2.0

config SOC_FAMILY_INTEL_SOCFPGA
	bool

if SOC_FAMILY_INTEL_SOCFPGA
config SOC_FAMILY
	string
	default "intel_socfpga"

source "soc/arm64/intel_socfpga/*/Kconfig.soc"
endif
```

## soc/arm64/intel_socfpga/Kconfig.defconfig
```kconfig
# Copyright (c) 2021 Intel Corporation
# SPDX-License-Identifier: Apache-2.0

source "soc/arm64/intel_socfpga/*/Kconfig.defconfig.series"
```

## soc/arm64/intel_socfpga/agilex/Kconfig.defconfig.agilex
```kconfig
# Copyright (c) 2021 Intel Corporation
# SPDX-License-Identifier: Apache-2.0

if SOC_AGILEX

config SOC
	default "intel_socfpga_agilex"

# must be >= the highest interrupt number used
# - include the UART interrupts 173 or 204
config NUM_IRQS
	int
	default 205

config SYS_CLOCK_HW_CYCLES_PER_SEC
	int
	default 25000000

config KERNEL_VM_SIZE
	default 0x40000

endif
```

## soc/arm64/intel_socfpga/agilex/Kconfig.defconfig.series
```kconfig
# Copyright (c) 2021 Intel Corporation
# SPDX-License-Identifier: Apache-2.0

if SOC_SERIES_AGILEX

config SOC_SERIES
	default "agilex"

source "soc/arm64/intel_socfpga/agilex/Kconfig.defconfig.agilex*"

endif # SOC_SERIES_AGILEX
```

## soc/arm64/intel_socfpga/agilex/Kconfig.series
```kconfig
# Copyright (c) 2021 Intel Corporation
# SPDX-License-Identifier: Apache-2.0

config SOC_SERIES_AGILEX
	bool "Intel SoC FPGA Agilex Series"
	select ARM64
	select CPU_CORTEX_A53
	select SOC_FAMILY_INTEL_SOCFPGA
	help
		Enable support for Intel SoC FPGA Series
```

## soc/arm64/intel_socfpga/agilex/Kconfig.soc
```kconfig
# Copyright (c) 2021 Intel Corporation
# SPDX-License-Identifier: Apache-2.0

config SOC_AGILEX
	bool
	help
	  Intel SoC FPGA Agilex
```

## soc/arm64/intel_socfpga/agilex5/Kconfig.defconfig.series
```kconfig
# Copyright (c) 2022 Intel Corporation
# SPDX-License-Identifier: Apache-2.0

if SOC_SERIES_AGILEX5

config SOC_SERIES
	default "agilex5"

source "soc/arm64/intel_socfpga/agilex5/Kconfig.defconfig.agilex5*"

endif # SOC_SERIES_AGILEX5
```

## soc/arm64/intel_socfpga/agilex5/Kconfig.series
```kconfig
# Copyright (c) 2022 Intel Corporation
# SPDX-License-Identifier: Apache-2.0

config SOC_SERIES_AGILEX5
	bool "Intel SoC FPGA Agilex5 Series"
	select ARM64
	select CPU_CORTEX_A76_A55
	select SOC_FAMILY_INTEL_SOCFPGA
	help
		Enable support for Intel SoC FPGA Series
```

## soc/arm64/intel_socfpga/agilex5/Kconfig.soc
```kconfig
# Copyright (c) 2022 Intel Corporation
# SPDX-License-Identifier: Apache-2.0

choice
prompt "Intel SoC FPGA Agilex5"
depends on SOC_SERIES_AGILEX5

config SOC_AGILEX5
	bool "Intel SoC FPGA Agilex5"
endchoice
```

## soc/arm64/nxp_imx/Kconfig
```kconfig
# Copyright (c) 2017-2020, NXP
# SPDX-License-Identifier: Apache-2.0

config SOC_FAMILY_IMX
	bool
	select HAS_SEGGER_RTT

if SOC_FAMILY_IMX

config SOC_FAMILY
	string
	default "nxp_imx"

source "soc/arm64/nxp_imx/*/Kconfig.soc"

endif # SOC_FAMILY_IMX
```

## soc/arm64/nxp_imx/Kconfig.defconfig
```kconfig
# Copyright (c) 2017, NXP
# SPDX-License-Identifier: Apache-2.0

source "soc/arm64/nxp_imx/*/Kconfig.defconfig.series"
```

## soc/arm64/nxp_imx/imx8m/Kconfig.defconfig.imx8mp
```kconfig
# Copyright 2021-2022 NXP
# SPDX-License-Identifier: Apache-2.0

if SOC_MIMX8MP_A53

config SOC
	default "mimx8ml8"

# Workaround for not being able to have commas in macro arguments
DT_CHOSEN_Z_FLASH := zephyr,flash

config FLASH_SIZE
	default $(dt_chosen_reg_size_int,$(DT_CHOSEN_Z_FLASH),0,K)

config FLASH_BASE_ADDRESS
	default $(dt_chosen_reg_addr_hex,$(DT_CHOSEN_Z_FLASH))

config NUM_IRQS
	int
	default 240

config SYS_CLOCK_HW_CYCLES_PER_SEC
	int
	default 8000000

config PINCTRL_IMX
	default y if HAS_MCUX_IOMUXC
	depends on PINCTRL

endif
```

## soc/arm64/nxp_imx/imx8m/Kconfig.defconfig.series
```kconfig
# Copyright 2020 NXP
# SPDX-License-Identifier: Apache-2.0

if SOC_SERIES_IMX8M_A53

config SOC_SERIES
	default "imx8m"

source "soc/arm64/nxp_imx/imx8m/Kconfig.defconfig.imx8m*"

endif # SOC_SERIES_IMX8M_A53
```

## soc/arm64/nxp_imx/imx8m/Kconfig.soc
```kconfig
# Copyright 2020 NXP
# SPDX-License-Identifier: Apache-2.0

choice
prompt "NXP i.MX8M A53 Selection"
depends on SOC_SERIES_IMX8M_A53

config SOC_IMX8MM_A53
	bool "NXP i.MX8MM A53"
	select ARM64
	select CPU_CORTEX_A53
	select ARM_ARCH_TIMER
	select GIC_V3
	select HAS_MCUX if CLOCK_CONTROL
	select HAS_MCUX_CCM if CLOCK_CONTROL

config SOC_MIMX8MP_A53
	bool "NXP i.MX8MP A53"
	select ARM64
	select CPU_CORTEX_A53
	select ARM_ARCH_TIMER
	select GIC_V3
	select HAS_MCUX if CLOCK_CONTROL
	select HAS_MCUX_CCM if CLOCK_CONTROL

endchoice

if SOC_IMX8MM_A53

config SOC_PART_NUMBER_MIMX8MM6DVTLZ
	bool

config SOC_PART_NUMBER
	string
	default "MIMX8MM6DVTLZ" if SOC_PART_NUMBER_MIMX8MM6DVTLZ
	help
	  This string holds the full part number of the SoC. It is a hidden option
	  that you should not set directly. The part number selection choice defines
	  the default value for this string.
endif
```

## soc/arm64/nxp_imx/mcimx8mm_a53/Kconfig.defconfig.mimx8mm_a53
```kconfig
# Copyright 2020 NXP
# SPDX-License-Identifier: Apache-2.0

if SOC_MIMX8MM_A53

config SOC
	default "mimx8mm6"

# Workaround for not being able to have commas in macro arguments
DT_CHOSEN_Z_FLASH := zephyr,flash

config FLASH_SIZE
	default $(dt_chosen_reg_size_int,$(DT_CHOSEN_Z_FLASH),0,K)

config FLASH_BASE_ADDRESS
	default $(dt_chosen_reg_addr_hex,$(DT_CHOSEN_Z_FLASH))

config NUM_IRQS
	int
	default 240

config SYS_CLOCK_HW_CYCLES_PER_SEC
	int
	default 8000000

endif
```

## soc/arm64/nxp_imx/mcimx8mm_a53/Kconfig.defconfig.series
```kconfig
# Copyright 2020 NXP
# SPDX-License-Identifier: Apache-2.0

if SOC_SERIES_IMX8MM_A53

config SOC_SERIES
	default "mcimx8mm_a53"

source "soc/arm64/nxp_imx/mcimx8mm_a53/Kconfig.defconfig.mimx8mm*"

endif # SOC_SERIES_IMX8MM_A53
```

## soc/arm64/nxp_imx/mcimx8mm_a53/Kconfig.series
```kconfig
# Copyright 2020 NXP
# SPDX-License-Identifier: Apache-2.0

config SOC_SERIES_IMX8MM_A53
	bool "NXP i.MX8MM A53 Core Series"
	select ARM64
	select SOC_FAMILY_IMX
	help
	  Enable support for i.MX8MM A53 Series.
```

## soc/arm64/nxp_imx/mimx8m/Kconfig.defconfig.series
```kconfig
# Copyright 2020-2022 NXP
# SPDX-License-Identifier: Apache-2.0

if SOC_SERIES_MIMX8M_A53

config SOC_SERIES
	default "mimx8m"

source "soc/arm64/nxp_imx/mimx8m/Kconfig.defconfig.mimx8m*"

endif # SOC_SERIES_MIMX8M_A53
```

## soc/arm64/nxp_imx/mimx8m/Kconfig.series
```kconfig
# Copyright 2020-2022 NXP
# SPDX-License-Identifier: Apache-2.0

config SOC_SERIES_MIMX8M_A53
	bool "NXP i.MX8M A53 Core Series"
	select ARM64
	select SOC_FAMILY_IMX
	help
	  Enable support for i.MX8M A53 Series.
```

## soc/arm64/nxp_imx/mimx8m/Kconfig.soc
```kconfig
# Copyright 2020-2022 NXP
# SPDX-License-Identifier: Apache-2.0

choice
prompt "NXP i.MX8M A53 Selection"
depends on SOC_SERIES_MIMX8M_A53

config SOC_MIMX8MM_A53
	bool "NXP i.MX8MM A53"
	select ARM64
	select CPU_CORTEX_A53
	select ARM_ARCH_TIMER
	select GIC_V3
	select HAS_MCUX if CLOCK_CONTROL
	select HAS_MCUX_CCM if CLOCK_CONTROL
	select HAS_MCUX_IOMUXC if PINCTRL

config SOC_MIMX8MP_A53
	bool "NXP i.MX8MP A53"
	select ARM64
	select CPU_CORTEX_A53
	select ARM_ARCH_TIMER
	select GIC_V3
	select HAS_MCUX if CLOCK_CONTROL
	select HAS_MCUX_CCM if CLOCK_CONTROL
	select HAS_MCUX_IOMUXC if PINCTRL

endchoice

config SOC_PART_NUMBER_MIMX8ML8DVNLZ
	bool

config SOC_PART_NUMBER_MIMX8MP_A53
	string
	default "MIMX8ML8DVNLZ_ca53" if  SOC_PART_NUMBER_MIMX8ML8DVNLZ
	help
	  This string holds the full part number of the SoC. It is a hidden option
	  that you should not set directly. The part number selection choice defines
	  the default value for this string.

config SOC_PART_NUMBER_MIMX8MM6DVTLZ
	bool

config SOC_PART_NUMBER_MIMX8MM6CVTKZ
	bool

config SOC_PART_NUMBER_MIMX8MM_A53
	string
	default "MIMX8MM6DVTLZ_ca53" if  SOC_PART_NUMBER_MIMX8MM6DVTLZ
	default "MIMX8MM6CVTKZ_ca53" if  SOC_PART_NUMBER_MIMX8MM6CVTKZ
	help
	  This string holds the full part number of the SoC. It is a hidden option
	  that you should not set directly. The part number selection choice defines
	  the default value for this string.

config SOC_PART_NUMBER
	default SOC_PART_NUMBER_MIMX8MP_A53 if SOC_MIMX8MP_A53
	default SOC_PART_NUMBER_MIMX8MM_A53 if SOC_MIMX8MM_A53
```

## soc/arm64/nxp_imx/mimx8qm/Kconfig.defconfig.series
```kconfig
# Copyright 2023 NXP
# SPDX-License-Identifier: Apache-2.0

if SOC_SERIES_MIMX8QM_A53

config SOC_SERIES
	default "mimx8qm"

source "soc/arm64/nxp_imx/mimx8qm/Kconfig.defconfig.mimx8qm*"

endif # SOC_SERIES_MIMX8QM_A53
```
