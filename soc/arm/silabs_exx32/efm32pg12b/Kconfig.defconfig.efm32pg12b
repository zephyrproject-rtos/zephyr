## soc/arm/silabs_exx32/efm32pg12b/Kconfig.defconfig.efm32pg12b
```kconfig
# Silicon Labs EFM32PG-STK3402A platform configuration options

# Copyright (c) 2018 Christian Taedcke
# SPDX-License-Identifier: Apache-2.0

config I2C_GECKO
	default y
	depends on I2C

config SOC_FLASH_GECKO
	default y
	depends on FLASH
```

## soc/arm/silabs_exx32/efm32pg12b/Kconfig.defconfig.series
```kconfig
# Kconfig - EFM32PG12B series configuration options

#
# Copyright (c) 2018 Christian Taedcke
#
# SPDX-License-Identifier: Apache-2.0
#

if SOC_SERIES_EFM32PG12B

config SOC_SERIES
	default "efm32pg12b"

config NUM_IRQS
	int
	# must be >= the highest interrupt number used
	default 50

source "soc/arm/silabs_exx32/efm32pg12b/Kconfig.defconfig.e*"

endif # SOC_SERIES_EFM32PG12B
```

## soc/arm/silabs_exx32/efm32pg12b/Kconfig.series
```kconfig
# EFM32PG12B MCU line

# Copyright (c) 2018 Christian Taedcke
# SPDX-License-Identifier: Apache-2.0

config SOC_SERIES_EFM32PG12B
	bool "EFM32PG12B Series MCU"
	select ARM
	select HAS_SILABS_GECKO
	select HAS_SWO
	select CPU_CORTEX_M4
	select CPU_CORTEX_M_HAS_DWT
	select CPU_HAS_FPU
	select CPU_HAS_ARM_MPU
	select SOC_FAMILY_EXX32
	select SOC_GECKO_HAS_INDIVIDUAL_PIN_LOCATION
	select SOC_GECKO_HAS_HFRCO_FREQRANGE
	select SOC_GECKO_CMU
	select SOC_GECKO_EMU
	select SOC_GECKO_GPIO
	select SOC_GECKO_TRNG
	help
	  Enable support for EFM32 PearlGecko MCU series
```

## soc/arm/silabs_exx32/efm32pg12b/Kconfig.soc
```kconfig
# Kconfig - EFM32PG12B (Pearl Gecko) MCU line
#
# Copyright (c) 2018 Christian Taedcke
#
# SPDX-License-Identifier: Apache-2.0
#

if SOC_SERIES_EFM32PG12B

config SOC_PART_NUMBER_EFM32PG12B500F1024GL125
	bool

endif # SOC_SERIES_EFM32PG12B
```

## soc/arm/silabs_exx32/efm32pg1b/Kconfig.defconfig.efm32pg1b
```kconfig
# Silicon Labs EFM32PG-STK3401A platform configuration options

# Copyright (c) 2020 Rafael Dias Menezes
# SPDX-License-Identifier: Apache-2.0

config SOC_FLASH_GECKO
	default y
	depends on FLASH
```

## soc/arm/silabs_exx32/efm32pg1b/Kconfig.defconfig.series
```kconfig
# EFM32PG1B series configuration options

# Copyright (c) 2020 Rafael Dias Menezes <rdmeneze@gmail.com>
# SPDX-License-Identifier: Apache-2.0

if SOC_SERIES_EFM32PG1B

config SOC_SERIES
	default "efm32pg1b"

config SOC_PART_NUMBER
	default "EFM32PG1B200F256GM48" if SOC_PART_NUMBER_EFM32PG1B200F256GM48

config NUM_IRQS
	# must be >= the highest interrupt number used
	default 34

source "soc/arm/silabs_exx32/efm32pg1b/Kconfig.defconfig.efm32pg1b"

endif # SOC_SERIES_EFM32PG1B
```

## soc/arm/silabs_exx32/efm32pg1b/Kconfig.series
```kconfig
# EFM32PG1B MCU line

# Copyright (c) 2020 Rafael Dias Menezes
# SPDX-License-Identifier: Apache-2.0

config SOC_SERIES_EFM32PG1B
	bool "EFM32PG1B Series MCU"
	select ARM
	select HAS_SILABS_GECKO
	select HAS_SWO
	select CPU_CORTEX_M4
	select CPU_CORTEX_M_HAS_DWT
	select CPU_HAS_FPU
	select CPU_HAS_ARM_MPU
	select SOC_FAMILY_EXX32
	select HAS_POWER_STATE_SLEEP_1
	select HAS_POWER_STATE_SLEEP_2
	select HAS_POWER_STATE_SLEEP_3
	select SOC_GECKO_HAS_INDIVIDUAL_PIN_LOCATION
	select SOC_GECKO_HAS_HFRCO_FREQRANGE
	select SOC_GECKO_CMU
	select SOC_GECKO_EMU
	select SOC_GECKO_GPIO
	help
	  Enable support for EFM32 PearlGecko MCU series
```

## soc/arm/silabs_exx32/efm32pg1b/Kconfig.soc
```kconfig
# EFM32PG1B (Pearl Gecko) MCU line

# Copyright (c) 2018 Christian Taedcke
# SPDX-License-Identifier: Apache-2.0

config SOC_PART_NUMBER_EFM32PG1B200F256GM48
	bool
	depends on SOC_SERIES_EFM32PG1B
```

## soc/arm/silabs_exx32/efm32wg/Kconfig.defconfig.efm32wg
```kconfig
# Silicon Labs EFM32WG-STK3800 platform configuration options

# Copyright (c) 2017 Christian Taedcke
# SPDX-License-Identifier: Apache-2.0

config SOC_FLASH_GECKO
	default y
	depends on FLASH
```

## soc/arm/silabs_exx32/efm32wg/Kconfig.defconfig.series
```kconfig
# EFM32WG series configuration options

# Copyright (c) 2017 Christian Taedcke
# SPDX-License-Identifier: Apache-2.0

if SOC_SERIES_EFM32WG

config SOC_SERIES
	default "efm32wg"

config SOC_PART_NUMBER
	default "EFM32WG990F256" if SOC_PART_NUMBER_EFM32WG990F256

config NUM_IRQS
	# must be >= the highest interrupt number used
	default 39

endif # SOC_SERIES_EFM32WG
```

## soc/arm/silabs_exx32/efm32wg/Kconfig.series
```kconfig
# EFM32WG MCU line

# Copyright (c) 2017 Christian Taedcke
# SPDX-License-Identifier: Apache-2.0

config SOC_SERIES_EFM32WG
	bool "EFM32WG Series MCU"
	select ARM
	select CPU_CORTEX_M4
	select CPU_CORTEX_M_HAS_DWT
	select CPU_HAS_FPU
	select CPU_HAS_ARM_MPU
	select SOC_FAMILY_EXX32
	select HAS_SILABS_GECKO
	select SOC_GECKO_CMU
	select SOC_GECKO_GPIO
	select HAS_PM
	select SOC_GECKO_SERIES0
	help
	  Enable support for EFM32 WonderGecko MCU series
```

## soc/arm/silabs_exx32/efm32wg/Kconfig.soc
```kconfig
# Kconfig - EFM32WG (Wonder Gecko) MCU line
#
# Copyright (c) 2017 Christian Taedcke
#
# SPDX-License-Identifier: Apache-2.0
#

if SOC_SERIES_EFM32WG

config SOC_PART_NUMBER_EFM32WG990F256
	bool

endif # SOC_SERIES_EFM32WG
```

## soc/arm/silabs_exx32/efr32bg13p/Kconfig.defconfig.efr32bg13p
```kconfig
# Silicon Labs EFR32BG13P (Blue Gecko) MCU configuration options

# Copyright (c) 2020 Piotr Mienkowski
# SPDX-License-Identifier: Apache-2.0

config SOC_FLASH_GECKO
	default y
	depends on FLASH
```

## soc/arm/silabs_exx32/efr32bg13p/Kconfig.defconfig.series
```kconfig
# Silicon Labs EFR32BG13P (Blue Gecko) MCU configuration options

# Copyright (c) 2020 Piotr Mienkowski
# SPDX-License-Identifier: Apache-2.0

if SOC_SERIES_EFR32BG13P

config SOC_SERIES
	default "efr32bg13p"

config SOC_PART_NUMBER
	default "EFR32BG13P632F512GM48" if SOC_PART_NUMBER_EFR32BG13P632F512GM48

config NUM_IRQS
	# must be >= the highest interrupt number used
	default 47

endif # SOC_SERIES_EFR32BG13P
```

## soc/arm/silabs_exx32/efr32bg13p/Kconfig.series
```kconfig
# Silicon Labs EFR32BG13P (Blue Gecko) MCU

# Copyright (c) 2020 Piotr Mienkowski
# SPDX-License-Identifier: Apache-2.0

config SOC_SERIES_EFR32BG13P
	bool "EFR32BG13P Series MCU"
	select ARM
	select CPU_CORTEX_M4
	select CPU_CORTEX_M_HAS_DWT
	select CPU_HAS_FPU
	select CPU_HAS_ARM_MPU
	select SOC_FAMILY_EXX32
	select HAS_SILABS_GECKO
	select HAS_SWO
	select HAS_POWER_STATE_SLEEP_1
	select HAS_POWER_STATE_SLEEP_2
	select HAS_POWER_STATE_SLEEP_3
	select SOC_GECKO_HAS_INDIVIDUAL_PIN_LOCATION
	select SOC_GECKO_CMU
	select SOC_GECKO_EMU
	select SOC_GECKO_GPIO
	help
	  Enable support for EFR32BG13P Blue Gecko MCU series
```

## soc/arm/silabs_exx32/efr32bg13p/Kconfig.soc
```kconfig
# Silicon Labs EFR32BG13P (Blue Gecko) MCU series

# Copyright (c) 2020 Piotr Mienkowski
# SPDX-License-Identifier: Apache-2.0

if SOC_SERIES_EFR32BG13P

config SOC_PART_NUMBER_EFR32BG13P632F512GM48
	bool

endif # SOC_SERIES_EFR32BG13P
```

## soc/arm/silabs_exx32/efr32bg22/Kconfig.defconfig.efr32bg22
```kconfig
# Silicon Labs EFR32BG22 (Blue Gecko) MCU configuration options

# Copyright (c) 2021 Sateesh Kotapati
# SPDX-License-Identifier: Apache-2.0

config GPIO_GECKO
	default y
```

## soc/arm/silabs_exx32/efr32bg22/Kconfig.defconfig.series
```kconfig
# Silicon Labs EFR32BG22 (Blue Gecko) MCU configuration options

# Copyright (c) 2021 Sateesh Kotapati
# SPDX-License-Identifier: Apache-2.0

if SOC_SERIES_EFR32BG22

config SOC_SERIES
	default "efr32bg22"

config SOC_PART_NUMBER
	default "EFR32BG22C224F512IM40" if SOC_PART_NUMBER_EFR32BG22C224F512IM40

config NUM_IRQS
	# must be >= the highest interrupt number used
	default 60

config PM
	select COUNTER

source "soc/arm/silabs_exx32/efr32bg22/Kconfig.defconfig.efr32bg22"

endif # SOC_SERIES_EFR32BG22
```

## soc/arm/silabs_exx32/efr32bg22/Kconfig.series
```kconfig
# Silicon Labs EFR32BG22 (Blue Gecko) MCU

# Copyright (c) 2021 Sateesh Kotapati
# SPDX-License-Identifier: Apache-2.0

config SOC_SERIES_EFR32BG22
	bool "EFR32BG22P Series MCU"
	select ARM
	select ARMV8_M_DSP
	select ARM_TRUSTZONE_M
	select CPU_CORTEX_M33
	select CPU_HAS_ARM_MPU
	select CPU_HAS_ARM_SAU
	select CPU_HAS_FPU
	select HAS_SILABS_GECKO
	select HAS_SWO
	select SOC_FAMILY_EXX32
	select SOC_GECKO_CMU
	select SOC_GECKO_CORE
	select SOC_GECKO_DEV_INIT
	help
	  Enable support for EFR32BG22 Blue Gecko MCU series
```

## soc/arm/silabs_exx32/efr32bg22/Kconfig.soc
```kconfig
# Silicon Labs EFR32BG22 (Blue Gecko) MCU series

# Copyright (c) 2021 Sateesh Kotapati
# SPDX-License-Identifier: Apache-2.0

config SOC_PART_NUMBER_EFR32BG22C224F512IM40
	bool
	depends on SOC_SERIES_EFR32BG22
```

## soc/arm/silabs_exx32/efr32bg27/Kconfig.defconfig.efr32bg27
```kconfig
# Silicon Labs EFR32BG27 (Blue Gecko) MCU configuration options

# Copyright (c) 2023 Antmicro <www.antmicro.com>
# SPDX-License-Identifier: Apache-2.0

config GPIO_GECKO
	default y
```

## soc/arm/silabs_exx32/efr32bg27/Kconfig.defconfig.series
```kconfig
# Silicon Labs EFR32BG27 (Blue Gecko) MCU configuration options

# Copyright (c) 2023 Antmicro <www.antmicro.com>
# SPDX-License-Identifier: Apache-2.0

if SOC_SERIES_EFR32BG27

config SOC_SERIES
	default "efr32bg27"

config SOC_PART_NUMBER
	default "EFR32BG27C140F768IM40" if SOC_PART_NUMBER_EFR32BG27C140F768IM40

config NUM_IRQS
	# must be >= the highest interrupt number used
	default 66

config PM
	select COUNTER

source "soc/arm/silabs_exx32/efr32bg27/Kconfig.defconfig.efr32bg27"

endif # SOC_SERIES_EFR32BG27
```

## soc/arm/silabs_exx32/efr32bg27/Kconfig.series
```kconfig
# Silicon Labs EFR32BG27 (Blue Gecko) MCU

# Copyright (c) Antmicro 2023 <www.antmicro.com>
# SPDX-License-Identifier: Apache-2.0

config SOC_SERIES_EFR32BG27
	bool "EFR32BG27 Series MCU"
	select ARM
	select ARMV8_M_DSP
	select ARM_TRUSTZONE_M
	select CPU_CORTEX_M33
	select CPU_HAS_ARM_MPU
	select CPU_HAS_ARM_SAU
	select CPU_HAS_FPU
	select HAS_SILABS_GECKO
	select HAS_SWO
	select SOC_FAMILY_EXX32
	select SOC_GECKO_HAS_RADIO
	select SOC_GECKO_SERIES2
	select SOC_GECKO_CMU
	select SOC_GECKO_CORE
	select SOC_GECKO_DEV_INIT
	select SOC_GECKO_SE
	select HAS_PM
	help
	  Enable support for EFR32BG27 Blue Gecko MCU series
```

## soc/arm/silabs_exx32/efr32bg27/Kconfig.soc
```kconfig
# Silicon Labs EFR32BG27 (Blue Gecko) MCU series

# Copyright (c) 2023 Antmicro <www.antmicro.com>
# SPDX-License-Identifier: Apache-2.0

config SOC_PART_NUMBER_EFR32BG27C140F768IM40
	bool
	depends on SOC_SERIES_EFR32BG27
```

## soc/arm/silabs_exx32/efr32fg13p/Kconfig.defconfig.efr32fg13p
```kconfig
# Silicon Labs EFR32FG13P platform configuration options

# Copyright (c) 2018 Christian Taedcke
# SPDX-License-Identifier: Apache-2.0

config SOC_FLASH_GECKO
	default y
	depends on FLASH
```
