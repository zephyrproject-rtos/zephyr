## soc/arm/silabs_exx32/efr32fg13p/Kconfig.defconfig.series
```kconfig
# EFR32FG13P series configuration options

# Copyright (c) 2018 Christian Taedcke
# SPDX-License-Identifier: Apache-2.0

if SOC_SERIES_EFR32FG13P

config SOC_SERIES
	default "efr32fg13p"

config SOC_PART_NUMBER
	default "EFR32FG13P233F512GM48" if SOC_PART_NUMBER_EFR32FG13P233F512GM48

config NUM_IRQS
	# must be >= the highest interrupt number used
	default 45

source "soc/arm/silabs_exx32/efr32fg13p/Kconfig.defconfig.efr32fg13p"

endif # SOC_SERIES_EFR32FG13P
```

## soc/arm/silabs_exx32/efr32fg13p/Kconfig.soc
```kconfig
# EFR32FG13P (Flex Gecko) MCU line

# Copyright (c) 2018 Christian Taedcke
# SPDX-License-Identifier: Apache-2.0

config SOC_PART_NUMBER_EFR32FG13P233F512GM48
	bool
	depends on SOC_SERIES_EFR32FG13P
```

## soc/arm/silabs_exx32/efr32fg1p/Kconfig.defconfig.efr32fg1p
```kconfig
# Silicon Labs EFR32FG1P platform configuration options

# Copyright (c) 2018 Christian Taedcke
# SPDX-License-Identifier: Apache-2.0

config GPIO_GECKO
	default y
	depends on GPIO

config UART_GECKO
	default y
	depends on SERIAL

config I2C_GECKO
	default y
	depends on I2C

config SOC_FLASH_GECKO
	default y
	depends on FLASH

config SPI_GECKO
	default y
	depends on SPI
```

## soc/arm/silabs_exx32/efr32fg1p/Kconfig.defconfig.series
```kconfig
# Kconfig - EFR32FG1P series configuration options

#
# Copyright (c) 2018 Christian Taedcke
#
# SPDX-License-Identifier: Apache-2.0
#

if SOC_SERIES_EFR32FG1P

config SOC_SERIES
	default "efr32fg1p"

config SOC_PART_NUMBER
	default "EFR32FG1P133F256GM48" if SOC_PART_NUMBER_EFR32FG1P133F256GM48

config NUM_IRQS
	# must be >= the highest interrupt number used
	default 33

source "soc/arm/silabs_exx32/efr32fg1p/Kconfig.defconfig.efr32fg1p"

endif # SOC_SERIES_EFR32FG1P
```

## soc/arm/silabs_exx32/efr32fg1p/Kconfig.series
```kconfig
# EFR32FG1P MCU line

# Copyright (c) 2018 Christian Taedcke
# SPDX-License-Identifier: Apache-2.0

config SOC_SERIES_EFR32FG1P
	bool "EFR32FG1P Series MCU"
	select ARM
	select HAS_SILABS_GECKO
	select HAS_SWO
	select CPU_CORTEX_M4
	select CPU_CORTEX_M_HAS_DWT
	select CPU_HAS_FPU
	select CPU_HAS_ARM_MPU
	select SOC_FAMILY_EXX32
	select SOC_GECKO_HAS_RADIO
	select SOC_GECKO_HAS_INDIVIDUAL_PIN_LOCATION
	select SOC_GECKO_HAS_HFRCO_FREQRANGE
	select SOC_GECKO_CMU
	select SOC_GECKO_GPIO
	select SOC_GECKO_HAS_ERRATA_RTCC_E201
	select HAS_PM
	select SOC_GECKO_SERIES1
	help
	  Enable support for EFR32 FlexGecko MCU series
```

## soc/arm/silabs_exx32/efr32fg1p/Kconfig.soc
```kconfig
# EFR32FG1P (Flex Gecko) MCU line

# Copyright (c) 2018 Christian Taedcke
# SPDX-License-Identifier: Apache-2.0

config SOC_PART_NUMBER_EFR32FG1P133F256GM48
	bool
	depends on SOC_SERIES_EFR32FG1P
```

## soc/arm/silabs_exx32/efr32mg12p/Kconfig.defconfig.efr32mg12p
```kconfig
# Silicon Labs EFR32MG12P platform configuration options

# Copyright (c) 2018 Diego Sueiro
# SPDX-License-Identifier: Apache-2.0

config SOC_FLASH_GECKO
	default y
	depends on FLASH
```

## soc/arm/silabs_exx32/efr32mg12p/Kconfig.defconfig.series
```kconfig
# EFM32WG series configuration options

# Copyright (c) 2018 Diego Sueiro
# SPDX-License-Identifier: Apache-2.0

if SOC_SERIES_EFR32MG12P

config SOC_SERIES
	default "efr32mg12p"

config SOC_PART_NUMBER
	default "EFR32MG12P332F1024GL125" if SOC_PART_NUMBER_EFR32MG12P332F1024GL125
	default "EFR32MG12P433F1024GM68" if SOC_PART_NUMBER_EFR32MG12P433F1024GM68

config NUM_IRQS
	# must be >= the highest interrupt number used
	default 49

endif # SOC_SERIES_EFR32MG12P
```

## soc/arm/silabs_exx32/efr32mg12p/Kconfig.series
```kconfig
# EFR32MG12P MCU line

# Copyright (c) 2018 Diego Sueiro
# SPDX-License-Identifier: Apache-2.0

config SOC_SERIES_EFR32MG12P
	bool "EFR32MG12P Series MCU"
	select ARM
	select CPU_CORTEX_M4
	select CPU_CORTEX_M_HAS_DWT
	select CPU_HAS_FPU
	select CPU_HAS_ARM_MPU
	select SOC_FAMILY_EXX32
	select SOC_GECKO_HAS_RADIO
	select HAS_SILABS_GECKO
	select HAS_SWO
	select SOC_GECKO_HAS_INDIVIDUAL_PIN_LOCATION
	select SOC_GECKO_HAS_HFRCO_FREQRANGE
	select SOC_GECKO_CMU
	select SOC_GECKO_EMU
	select SOC_GECKO_GPIO
	select SOC_GECKO_TRNG
	select HAS_PM
	select SOC_GECKO_SERIES1
	help
	  Enable support for EFR32 Mighty Gecko MCU series
```

## soc/arm/silabs_exx32/efr32mg12p/Kconfig.soc
```kconfig
# EFR32MG12P (Mighty Gecko) MCU line

# Copyright (c) 2018 Diego Sueiro
# SPDX-License-Identifier: Apache-2.0

config SOC_PART_NUMBER_EFR32MG12P332F1024GL125
	bool
	depends on SOC_SERIES_EFR32MG12P
```

## soc/arm/silabs_exx32/efr32mg21/Kconfig.defconfig.efr32mg21
```kconfig
# Silicon Labs EFR32MG21 (Mighty Gecko) MCU configuration options

# Copyright (c) 2020 TriaGnoSys GmbH
# SPDX-License-Identifier: Apache-2.0

config GPIO_GECKO
	default y
	depends on GPIO || LOG_BACKEND_SWO

config UART_GECKO
	default y
	depends on SERIAL

config I2C_GECKO
	default y
	depends on I2C

config SOC_FLASH_GECKO
	default y
	depends on FLASH

config SPI_GECKO
	default y
	depends on SPI
```

## soc/arm/silabs_exx32/efr32mg21/Kconfig.defconfig.series
```kconfig
# Silicon Labs EFR32MG21 (Might Gecko) series configuration options

# Copyright (c) 2020 TriaGnoSys GmbH
# SPDX-License-Identifier: Apache-2.0

if SOC_SERIES_EFR32MG21

config SOC_SERIES
	default "efr32mg21"

config SOC_PART_NUMBER
	default "EFR32MG21A020F1024IM32" if SOC_PART_NUMBER_EFR32MG21A020F1024IM32

config NUM_IRQS
	int
	# must be >= the highest interrupt number used
	default 61

source "soc/arm/silabs_exx32/efr32mg21/Kconfig.defconfig.efr32mg21"

endif # SOC_SERIES_EFR32MG21
```

## soc/arm/silabs_exx32/efr32mg21/Kconfig.series
```kconfig
# Silicon Labs EFR32MG21 (Mighty Gecko) MCU

# Copyright (c) 2020 TriaGnoSys GmbH
# SPDX-License-Identifier: Apache-2.0

config SOC_SERIES_EFR32MG21
	bool "EFR32MG21 Series MCU"
	select ARM
	select CPU_CORTEX_M33
	select CPU_CORTEX_M_HAS_DWT
	select ARMV8_M_DSP
	select CPU_HAS_FPU
	select CPU_HAS_ARM_MPU
	select SOC_FAMILY_EXX32
	select SOC_GECKO_HAS_RADIO
	select SOC_GECKO_SERIES2
	select HAS_SILABS_GECKO
	select HAS_SWO
	select SOC_GECKO_CMU
	select SOC_GECKO_EMU
	select SOC_GECKO_GPIO
	select SOC_GECKO_SE
	select HAS_PM
	help
	  Enable support for EFR32MG21 Mighty Gecko MCU series
```

## soc/arm/silabs_exx32/efr32mg24/Kconfig.defconfig.series
```kconfig
# Silicon Labs EFR32MG24 (Mighty Gecko) MCU configuration options

# Copyright (c) 2021 Sateesh Kotapati
# SPDX-License-Identifier: Apache-2.0

if SOC_SERIES_EFR32MG24

config SOC_SERIES
	default "efr32mg24"

config SOC_PART_NUMBER
	default "EFR32MG24B220F1536IM48" if SOC_PART_NUMBER_EFR32MG24B220F1536IM48
	default "EFR32MG24B310F1536IM48" if SOC_PART_NUMBER_EFR32MG24B310F1536IM48

config NUM_IRQS
	# must be >= the highest interrupt number used
	default 75

config PM
	default n

choice PM_POLICY
	default PM_POLICY_DEFAULT
	depends on PM
endchoice

endif # SOC_SERIES_EFR32MG24
```

## soc/arm/silabs_exx32/efr32mg24/Kconfig.series
```kconfig
# Silicon Labs EFR32MG24 (Mighty Gecko) MCU

# Copyright (c) 2021 Sateesh Kotapati
# SPDX-License-Identifier: Apache-2.0

config SOC_SERIES_EFR32MG24
	bool "EFR32MG24 Series MCU"
	select ARM
	select CPU_CORTEX_M33
	select CPU_HAS_FPU
	select CPU_HAS_ARM_MPU
	select CPU_HAS_ARM_SAU
	select CPU_CORTEX_M_HAS_DWT
	select ARMV8_M_DSP
	select ARM_TRUSTZONE_M
	select SOC_FAMILY_EXX32
	select SOC_GECKO_SERIES2
	select HAS_SILABS_GECKO
	select HAS_SWO
	select SOC_GECKO_CMU
	select SOC_GECKO_EMU
	select SOC_GECKO_GPIO
	select SOC_GECKO_DEV_INIT
	select SOC_GECKO_SE
	help
	  Enable support for EFR32MG24 Mighty Gecko MCU series
```

## soc/arm/silabs_exx32/efr32mg24/Kconfig.soc
```kconfig
# Silicon Labs EFR32MG24 (Mighty Gecko) MCU line

# Copyright (c) 2020 TriaGnoSys GmbH
# SPDX-License-Identifier: Apache-2.0

config SOC_PART_NUMBER_EFR32MG24B310F1536IM48
	bool
	depends on SOC_SERIES_EFR32MG24
```

## soc/arm/silabs_sim3/Kconfig
```kconfig
# Copyright (c) 2023 GARDENA GmbH
#
# SPDX-License-Identifier: Apache-2.0

config SOC_FAMILY_SIM3
	bool
	select HAS_SEGGER_RTT
	select BUILD_OUTPUT_HEX

if SOC_FAMILY_SIM3

config SOC_FAMILY
	string
	default "silabs_sim3"

source "soc/arm/silabs_sim3/*/Kconfig.soc"

endif # SOC_FAMILY_SIM3
```

## soc/arm/silabs_sim3/Kconfig.soc
```kconfig
# Copyright (c) 2023 GARDENA GmbH
#
# SPDX-License-Identifier: Apache-2.0

source "soc/arm/silabs_sim3/*/Kconfig.series"
```

## soc/arm/silabs_sim3/sim3u/Kconfig.defconfig.series
```kconfig
# SIM3U series configuration options

# Copyright (c) 2023 GARDENA GmbH
#
# SPDX-License-Identifier: Apache-2.0

if SOC_SERIES_SIM3U

config SOC_SERIES
	default "sim3u"

config SOC_PART_NUMBER
	default "SIM3U167-A-GM" if SOC_PART_NUMBER_SIM3U167_A_GM

config SYS_CLOCK_HW_CYCLES_PER_SEC
	default $(dt_node_int_prop_int,/cpus/cpu@0,clock-frequency)

config NUM_IRQS
	int
	# must be >= the highest interrupt number used
	default 53

endif # SOC_SERIES_SIM3U
```

## soc/arm/silabs_sim3/sim3u/Kconfig.series
```kconfig
# Copyright (c) 2023 GARDENA GmbH
#
# SPDX-License-Identifier: Apache-2.0

config SOC_SERIES_SIM3U
	bool "SIM3U Series MCU"
	select ARM
	select CPU_CORTEX_M3
	select SOC_FAMILY_SIM3
	select CLOCK_CONTROL
	select CPU_CORTEX_M_HAS_SYSTICK
	select HAS_SILABS_SI32

	help
	  Enable support for SiM3U MCU series
```

## soc/arm/st_stm32/Kconfig
```kconfig
# ST Microelectronics STM32 MCU line

# Copyright (c) 2016 Open-RnD Sp. z o.o.
# SPDX-License-Identifier: Apache-2.0

config SOC_FAMILY_STM32
	bool
	select HAS_SEGGER_RTT if ZEPHYR_SEGGER_MODULE
	select BUILD_OUTPUT_HEX

if SOC_FAMILY_STM32

config SOC_FAMILY
	string
	default "st_stm32"

source "soc/arm/st_stm32/*/Kconfig.soc"

endif # SOC_FAMILY_STM32
```

## soc/arm/st_stm32/Kconfig.defconfig
```kconfig
# SPDX-License-Identifier: Apache-2.0

source "soc/arm/st_stm32/*/Kconfig.defconfig.series"
```

## soc/arm/st_stm32/Kconfig.soc
```kconfig
# Kconfig - ST Microelectronics STM32 MCU line
#
# Copyright (c) 2016 Open-RnD Sp. z o.o.
#
# SPDX-License-Identifier: Apache-2.0
#

source "soc/arm/st_stm32/*/Kconfig.series"
```

## soc/arm/st_stm32/common/Kconfig.defconfig.series
```kconfig
# ST Microelectronics STM32 all MCU lines

# Copyright (c) 2017, I-SENSE group of ICCS
# SPDX-License-Identifier: Apache-2.0

# Here are set all the Kconfig symbols common to the whole STM32 family

if SOC_FAMILY_STM32

config CORTEX_M_SYSTICK
	default n if STM32_LPTIM_TIMER

DT_STM32_RCC_PATH := $(dt_nodelabel_path,rcc)
DT_STM32_RCC_CLOCK_FREQ := $(dt_node_int_prop_int,$(DT_STM32_RCC_PATH),clock-frequency)

config SYS_CLOCK_HW_CYCLES_PER_SEC
	default "$(DT_STM32_RCC_CLOCK_FREQ)" if "$(dt_nodelabel_enabled,rcc)"

# set the tick per sec as a divider of the LPTIM clock source
config SYS_CLOCK_TICKS_PER_SEC
	default 4096 if STM32_LPTIM_TIMER && STM32_LPTIM_CLOCK_LSE
	default 4000 if STM32_LPTIM_TIMER && STM32_LPTIM_CLOCK_LSI

config CLOCK_CONTROL_STM32_CUBE
	default y
	depends on CLOCK_CONTROL

config CLOCK_CONTROL_INIT_PRIORITY
	default 1
	depends on CLOCK_CONTROL

config PINMUX_STM32
	default y
	depends on PINMUX

config MEMC_STM32
	default y
	depends on MEMC

endif # SOC_FAMILY_STM32
```
