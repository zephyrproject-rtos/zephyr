## soc/arm/microchip_mec/mec1701/Kconfig.defconfig.mec1701qsz
```kconfig
# Microchip MEC1701QSZ MCU

# Copyright (c) 2018 Intel Corporation
# SPDX-License-Identifier: Apache-2.0

if SOC_MEC1701_QSZ

config SOC
	default "mec1701qsz"

config SYS_CLOCK_HW_CYCLES_PER_SEC
	default 48000000

endif # SOC_MEC1701_QSZ
```

## soc/arm/microchip_mec/mec1701/Kconfig.defconfig.series
```kconfig
# Microchip MEC MCU series configuration options

# Copyright (c) 2018 Intel Corporation
# SPDX-License-Identifier: Apache-2.0

if SOC_SERIES_MEC1701X

config SOC_SERIES
	default "mec1701"

config NUM_IRQS
	# must be >= the highest interrupt number used
	# - include the UART interrupts
	#for the moment 42 needs to be corrected in terms of devices added
	default 42

source "soc/arm/microchip_mec/mec1701/Kconfig.defconfig.mec1701*"
endif # SOC_SERIES_MEC1701X
```

## soc/arm/microchip_mec/mec1701/Kconfig.series
```kconfig
# Microchip MEC1701 MCU core series

# Copyright (c) 2018 Intel Corporation
# SPDX-License-Identifier: Apache-2.0

config SOC_SERIES_MEC1701X
	bool "Microchip MEC1701X Series"
	select ARM
	select CPU_CORTEX_M4
	select CPU_CORTEX_M_HAS_DWT
	select FP_SP_D16_FP16_FMAC
	select SOC_FAMILY_MEC
	help
	  Enable support for Microchip MEC Cortex-M4 MCU series
```

## soc/arm/microchip_mec/mec1701/Kconfig.soc
```kconfig
# Microchip MEC1701 MCU core series

# Copyright (c) 2018 Intel Corporation
# SPDX-License-Identifier: Apache-2.0

config SOC_MEC1701_QSZ
	bool
	select HAS_MEC_HAL
	help
	  MEC1701_QSZ
```

## soc/arm/microchip_mec/mec172x/Kconfig.defconfig.mec172xnsz
```kconfig
# Microchip MEC172XNSZ MCU

# Copyright (c) 2021 Microchip Technology Inc.
# SPDX-License-Identifier: Apache-2.0

if SOC_MEC172X_NSZ

config SOC
	default "mec172xnsz"

config UART_XEC
	default y
	depends on SERIAL

config GPIO
	default y

config GPIO_XEC_V2
	default y
	depends on GPIO

config PINMUX_XEC
	default y
	depends on PINMUX

config PWM_XEC
	default y
	depends on PWM

config ADC_XEC_V2
	default y
	depends on ADC

config I2C_XEC_V2
	default y
	depends on I2C

config ESPI_XEC_V2
	default y
	depends on ESPI

config SPI_XEC_QMSPI_LDMA
	default y
	depends on SPI

config PECI_XEC
	default y
	depends on PECI

endif # SOC_MEC172X_NSZ
```

## soc/arm/microchip_mec/mec172x/Kconfig.defconfig.series
```kconfig
# Microchip MEC MCU series configuration options

# Copyright (c) 2021 Microchip Technology Inc.
# SPDX-License-Identifier: Apache-2.0

if SOC_SERIES_MEC172X

config SOC_SERIES
	default "mec172x"

config NUM_IRQS
	# must be >= the highest interrupt number used
	# - include the UART interrupts
	# All NVIC external sources.
	default 181

source "soc/arm/microchip_mec/mec172x/Kconfig.defconfig.mec172x*"

config FLASH_SIZE
	default $(dt_node_reg_size_int,/flash@c0000,0)

config FLASH_BASE_ADDRESS
	default $(dt_node_reg_addr_hex,/flash@c0000)

config ROM_START_OFFSET
	default 0 if BOOTLOADER_MCUBOOT

if RTOS_TIMER

config SOC_HAS_TIMING_FUNCTIONS
	default y if !CORTEX_M_DWT

config ARCH_HAS_CUSTOM_BUSY_WAIT
	default y

endif # RTOS_TIMER

config CORTEX_M_SYSTICK
	depends on !RTOS_TIMER

config PS2_XEC
	default y
	depends on PS2

endif # SOC_SERIES_MEC172X
```

## soc/arm/microchip_mec/mec172x/Kconfig.series
```kconfig
# Microchip MEC172X MCU core series

# Copyright (c) 2021 Microchip Technology Inc.
# SPDX-License-Identifier: Apache-2.0

config SOC_SERIES_MEC172X
	bool "Microchip MEC172X Series"
	select ARM
	select CPU_CORTEX_M4
	select CPU_CORTEX_M_HAS_DWT
	select CPU_HAS_FPU
	select CPU_HAS_ARM_MPU
	select SOC_FAMILY_MEC
	select HAS_SWO
	help
	  Enable support for Microchip MEC Cortex-M4F MCU series
```

## soc/arm/microchip_mec/mec172x/Kconfig.soc
```kconfig
# Microchip MEC172x MCU core series

# Copyright (c) 2021 Microchip Technology Inc.
# SPDX-License-Identifier: Apache-2.0

choice
	prompt "MEC172x Selection"
	depends on SOC_SERIES_MEC172X

config SOC_MEC172X_NSZ
	bool "MEC172X_NSZ"
config SOC_MEC172X_NLJ
	bool "MEC172X_NLJ"

endchoice

config RTOS_TIMER
	bool "MEC172x RTOS Timer(32KHz) as kernel timer"

config SOC_MEC172X_PROC_CLK_DIV
	int "PROC_CLK_DIV"
	default 1
	range 1 48
	help
	  This divisor defines a ratio between processor clock (HCLK)
	  and main 96 MHz clock (MCK):
	  HCLK = MCK / PROC_CLK_DIV
	  Allowed divider values: 1, 3, 4, 16, and 48.

choice
	prompt "MEC172x debug interface general configuration"
	default SOC_MEC172X_DEBUG_WITHOUT_TRACING
	depends on SOC_SERIES_MEC172X
	help
	  Select Debug SoC interface support for MEC172X SoC family

	config SOC_MEC172X_DEBUG_DISABLED
		bool "Disable debug support"
		help
		  Debug port is disabled, JTAG/SWD cannot be enabled. JTAG_RST#
		  pin is ignored. All other JTAG pins can be used as GPIOs
		  or other non-JTAG alternate functions.

	config SOC_MEC172X_DEBUG_WITHOUT_TRACING
		bool "Debug support via Serial wire debug"
		help
		  JTAG port in SWD mode. I2C09 and ADC00-03 can be used.

	config SOC_MEC172X_DEBUG_AND_TRACING
		bool "Debug support via Serial wire debug with tracing enabled"
		help
		  JTAG port is enabled in SWD mode. Refer to tracing options
		  to see if ADC00-03 can be used or not.
endchoice

choice
	prompt "MEC172X debug interface trace configuration"
	default SOC_MEC172X_DEBUG_AND_ETM_TRACING
	depends on SOC_MEC172X_DEBUG_AND_TRACING
	help
	  Select tracing mode for debug interface

	config SOC_MEC172X_DEBUG_AND_ETM_TRACING
		bool "Debug support via Serial wire debug"
		help
		  JTAG port in SWD mode and ETM as tracing method.
		  I2C09 can be used, but ADC00-03 cannot.

	config SOC_MEC172X_DEBUG_AND_SWV_TRACING
		bool "debug support via Serial Wire Debug and Viewer"
		help
		  JTAG port in SWD mode and SWV as tracing method.
		  I2C09 cannot be used. ADC00-03 can be used.
endchoice
```

## soc/arm/mps2/Kconfig
```kconfig
# Copyright (c) 2017-2019 Linaro Limited
# SPDX-License-Identifier: Apache-2.0

config SOC_SERIES_MPS2
	select ARM
	select GPIO_MMIO32 if GPIO

config SOC_MPS2_AN521
	select CPU_CORTEX_M33
	select CPU_HAS_ARM_MPU

config SOC_MPS2_AN385
	select CPU_CORTEX_M3
	select CPU_HAS_ARM_MPU

config SOC_MPS2_AN521_CPU0
	select CPU_HAS_ARM_SAU

config SOC_MPS2_AN521_CPU1
	select CPU_HAS_FPU
	select ARMV8_M_DSP
```

## soc/arm/mps2/Kconfig.defconfig.an385
```kconfig
# Copyright (c) 2017 Linaro Limited
# SPDX-License-Identifier: Apache-2.0

if SOC_AN385

config NUM_IRQS
	default 32

endif
```

## soc/arm/mps2/Kconfig.defconfig.an500
```kconfig
# Copyright 2024 Arm Limited and/or its affiliates <open-source-office@arm.com>
# SPDX-License-Identifier: Apache-2.0

if SOC_MPS2_AN500

config NUM_IRQS
	default 32

endif
```

## soc/arm/mps2/Kconfig.soc
```kconfig
# Copyright (c) 2017-2019 Linaro Limited
# Copyright 2024 Arm Limited and/or its affiliates <open-source-office@arm.com>
# SPDX-License-Identifier: Apache-2.0

config SOC_SERIES_MPS2
	bool
	select SOC_FAMILY_ARM
	help
	  Enable support for ARM MPS2 MCU Series

config SOC_MPS2_AN383
	bool
	select SOC_SERIES_MPS2
	help
	  ARM Cortex-M0+ SMM on V2M-MPS2 (Application Note AN383)

config SOC_MPS2_AN385
	bool
	select SOC_SERIES_MPS2
	help
	  ARM Cortex-M3 SMM on V2M-MPS2 (Application Note AN385)

config SOC_MPS2_AN386
	bool
	select SOC_SERIES_MPS2
	help
	  ARM Cortex-M4 SMM on V2M-MPS2 (Application Note AN386)

config SOC_MPS2_AN500
	bool
	select SOC_SERIES_MPS2
	help
	  ARM Cortex-M7 SMM on V2M-MPS2+ (Application Note AN500)

config SOC_MPS2_AN521
	bool
	select SOC_SERIES_MPS2

config SOC_MPS2_AN521_CPU0
	bool
	select SOC_MPS2_AN521
	help
	  ARM Cortex-M33 SMM-SSE-200 on V2M-MPS2+ (AN521) CPU0

config SOC_MPS2_AN521_CPU1
	bool
	select SOC_MPS2_AN521
	help
	  ARM Cortex-M33 SMM-SSE-200 on V2M-MPS2+ (AN521) CPU1

config SOC_SERIES
	default "mps2" if SOC_SERIES_MPS2

config SOC
	default "an383" if SOC_MPS2_AN383
	default "an385" if SOC_MPS2_AN385
	default "an386" if SOC_MPS2_AN386
	default "an500" if SOC_MPS2_AN500
	default "an521" if SOC_MPS2_AN521
```

## soc/arm/mps3/Kconfig
```kconfig
# Copyright (c) 2017-2021 Linaro Limited
# Copyright 2024-2025 Arm Limited and/or its affiliates <open-source-office@arm.com>
# Copyright (c) 2026 Andrei-Edward Popa
# SPDX-License-Identifier: Apache-2.0

config SOC_SERIES_MPS3
	select ARM
	select GPIO_MMIO32 if GPIO

config SOC_CORSTONE300
	select CPU_CORTEX_M55
	select CPU_HAS_ARM_SAU
	select CPU_HAS_ARM_MPU
	select CPU_HAS_FPU
	select ARMV8_M_DSP
	select ARMV8_1_M_MVEI
	select ARMV8_1_M_MVEF
	select ARMV8_1_M_PMU

config SOC_CORSTONE310
	select CPU_CORTEX_M85
	select CPU_HAS_ARM_SAU
	select CPU_HAS_ARM_MPU
	select CPU_HAS_FPU
	select ARMV8_M_DSP
	select ARMV8_1_M_MVEI
	select ARMV8_1_M_MVEF
	select ARMV8_1_M_PMU

config SOC_AN536
	select CPU_CORTEX_R52
	select CPU_HAS_ARM_MPU
	select VFP_DP_D16
	select VFP_DP_D32_FP16_FMAC if !USE_SWITCH
	select GIC_SINGLE_SECURITY_STATE
	select ARM_ARCH_TIMER

config ARMV8_1_M_PMU_EVENTCNT
	int
	default 8 if SOC_CORSTONE300
	default 8 if SOC_CORSTONE310
```

## soc/arm/mps3/Kconfig.defconfig
```kconfig
# Copyright (c) 2021 Linaro Limited
# SPDX-License-Identifier: Apache-2.0

if SOC_SERIES_MPS3

rsource "Kconfig.defconfig.mps3*"

endif # SOC_SERIES_MPS3
```

## soc/arm/mps3/Kconfig.defconfig.mps3_an536
```kconfig
# Copyright (c) 2026 Andrei-Edward Popa
# SPDX-License-Identifier: Apache-2.0

if SOC_AN536

config SYS_CLOCK_HW_CYCLES_PER_SEC
	default $(dt_node_int_prop_int,/timer,clock-frequency)

config NUM_IRQS
	default 128

endif # SOC_AN536
```

## soc/arm/mps3/Kconfig.defconfig.mps3_corstone300
```kconfig
# Copyright (c) 2018-2021 Linaro Limited
# Copyright 2024 Arm Limited and/or its affiliates <open-source-office@arm.com>
# SPDX-License-Identifier: Apache-2.0

if SOC_CORSTONE300

config SYS_CLOCK_HW_CYCLES_PER_SEC
	default $(dt_node_int_prop_int,/soc/peripheral@50000000/system-clock,clock-frequency)

config NUM_IRQS
	default 128

endif
```

## soc/arm/mps3/Kconfig.defconfig.mps3_corstone310
```kconfig
# Copyright 2024 Arm Limited and/or its affiliates <open-source-office@arm.com>
# SPDX-License-Identifier: Apache-2.0

if SOC_CORSTONE310

config SYS_CLOCK_HW_CYCLES_PER_SEC
	default $(dt_node_int_prop_int,/soc/peripheral@50000000/system-clock,clock-frequency)

config NUM_IRQS
	default 128

endif
```

## soc/arm/mps4/Kconfig
```kconfig
# Copyright 2025 Arm Limited and/or its affiliates <open-source-office@arm.com>
# SPDX-License-Identifier: Apache-2.0

config SOC_SERIES_MPS4
	select ARM
	select GPIO_MMIO32 if GPIO

config SOC_MPS4_CORSTONE320
	select CPU_CORTEX_M85
	select CPU_HAS_ARM_SAU
	select CPU_HAS_ARM_MPU
	select CPU_HAS_FPU
	select ARMV8_M_DSP
	select ARMV8_1_M_MVEI
	select ARMV8_1_M_MVEF
	select ARMV8_1_M_PMU
	select ARM_MPU_PXN if ARM_MPU

config ARMV8_1_M_PMU_EVENTCNT
	int
	default 8 if SOC_MPS4_CORSTONE320
```

## soc/arm/mps4/Kconfig.defconfig
```kconfig
# Copyright 2025 Arm Limited and/or its affiliates <open-source-office@arm.com>
# SPDX-License-Identifier: Apache-2.0

if SOC_SERIES_MPS4

config SYS_CLOCK_HW_CYCLES_PER_SEC
	default $(dt_node_int_prop_int,$(dt_nodelabel_path,sysclk),clock-frequency)

rsource "Kconfig.defconfig.mps4*"

endif # SOC_SERIES_MPS4
```

## soc/arm/mps4/Kconfig.defconfig.mps4_corstone320
```kconfig
# Copyright 2025 Arm Limited and/or its affiliates <open-source-office@arm.com>
# SPDX-License-Identifier: Apache-2.0

if SOC_MPS4_CORSTONE320

config NUM_IRQS
	default 232

endif
```

## soc/arm/mps4/Kconfig.soc
```kconfig
# Copyright 2025 Arm Limited and/or its affiliates <open-source-office@arm.com>
# SPDX-License-Identifier: Apache-2.0

config SOC_SERIES_MPS4
	bool
	select SOC_FAMILY_ARM
	help
	  Enable support for ARM MPS4 MCU Series

config SOC_SERIES
	default "mps4" if SOC_SERIES_MPS4

config SOC_MPS4_CORSTONE315
	bool
	select SOC_SERIES_MPS4

config SOC_MPS4_CORSTONE320
	bool
	select SOC_SERIES_MPS4

config SOC
	default "corstone315" if SOC_MPS4_CORSTONE315
	default "corstone320" if SOC_MPS4_CORSTONE320
```

## soc/arm/musca/Kconfig
```kconfig
# Copyright (c) 2019 Linaro Limited
# SPDX-License-Identifier: Apache-2.0

config SOC_SERIES_MUSCA
	select ARM
	select BUILD_OUTPUT_HEX

config SOC_V2M_MUSCA_B1
	select CPU_CORTEX_M33
	select CPU_HAS_ARM_SAU
	select CPU_HAS_ARM_MPU
	select CPU_CORTEX_M_HAS_DWT

config SOC_V2M_MUSCA_S1
	select CPU_CORTEX_M33
	select CPU_HAS_ARM_SAU
	select CPU_HAS_ARM_MPU
	select CPU_CORTEX_M_HAS_DWT
	select CPU_HAS_FPU
	select ARMV8_M_DSP
```

## soc/arm/musca/Kconfig.soc
```kconfig
# Copyright (c) 2019 Linaro Limited
# SPDX-License-Identifier: Apache-2.0

config SOC_SERIES_MUSCA
	bool
	select SOC_FAMILY_ARM
	help
	   ARM v2m MUSCA MCU Series

config SOC_V2M_MUSCA_B1
	bool
	select SOC_SERIES_MUSCA
	help
	  ARM Cortex-M33 SMM-SSE-200 on V2M-MUSCA-B1

config SOC_V2M_MUSCA_S1
	bool
	select SOC_SERIES_MUSCA
	help
	  ARM Cortex-M33 SMM-SSE-200 on V2M-MUSCA-S1

config SOC_SERIES
	default "musca" if SOC_SERIES_MUSCA

config SOC
	default "musca_b1" if SOC_V2M_MUSCA_B1
	default "musca_s1" if SOC_V2M_MUSCA_S1
```

## soc/arm/nanoxplore_ng/Kconfig
```kconfig
# NanoXplore NG SoC line

# Copyright (c) 2021 NanoXplore
# SPDX-License-Identifier: Apache-2.0

config SOC_FAMILY_NG
	bool

if SOC_FAMILY_NG

config SOC_FAMILY
	string
	default "nanoxplore_ng"

source "soc/arm/nanoxplore_ng/*/Kconfig.soc"

endif # SOC_FAMILY_NG
```

## soc/arm/nanoxplore_ng/Kconfig.defconfig
```kconfig
# Copyright (c) 2021 NanoXplore
# SPDX-License-Identifier: Apache-2.0

source "soc/arm/nanoxplore_ng/*/Kconfig.defconfig.series"
```
