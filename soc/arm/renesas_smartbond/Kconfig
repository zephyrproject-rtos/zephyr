## soc/arm/renesas_smartbond/Kconfig
```kconfig
# Copyright (c) 2022 Renesas Electronics Corporation
# SPDX-License-Identifier: Apache-2.0

config SOC_FAMILY_SMARTBOND
	bool
	select ARM
	select CPU_CORTEX_M33
	select CPU_HAS_FPU
	select CPU_HAS_ARM_MPU
	select HAS_SEGGER_RTT

if SOC_FAMILY_SMARTBOND
config SOC_FAMILY
	string
	default "renesas_smartbond"

source "soc/arm/renesas_smartbond/*/Kconfig.soc"

endif # SOC_FAMILY_SMARTBOND
```

## soc/arm/renesas_smartbond/Kconfig.defconfig
```kconfig
# Copyright (c) 2022 Renesas Electronics Corporation
# SPDX-License-Identifier: Apache-2.0

if SOC_FAMILY_SMARTBOND

source "soc/arm/renesas_smartbond/*/Kconfig.defconfig.series"

config PINCTRL
	default y

endif # SOC_FAMILY_SMARTBOND
```

## soc/arm/renesas_smartbond/Kconfig.soc
```kconfig
# Copyright (c) 2022 Renesas Electronics Corporation
# SPDX-License-Identifier: Apache-2.0

source "soc/arm/renesas_smartbond/*/Kconfig.series"
```

## soc/arm/renesas_smartbond/da1469x/Kconfig.defconfig.series
```kconfig
# Copyright (c) 2022 Renesas Electronics Corporation
# SPDX-License-Identifier: Apache-2.0

if SOC_SERIES_DA1469X

source "soc/arm/renesas_smartbond/da1469x/Kconfig.defconfig.da1469*"

config SOC_SERIES
	default "da1469x"

config NUM_IRQS
	default 40

config SYS_CLOCK_HW_CYCLES_PER_SEC
	default $(dt_node_int_prop_int,/cpus/cpu@0,clock-frequency)

config SRAM_VECTOR_TABLE
	default y

config USE_DT_CODE_PARTITION
	default y if MCUBOOT

config FLASH_BASE_ADDRESS
	default $(dt_chosen_reg_addr_hex,$(DT_CHOSEN_Z_FLASH))

config FLASH_LOAD_OFFSET
	default 0x2400 if !USE_DT_CODE_PARTITION

config PLATFORM_SPECIFIC_INIT
	default y

endif # SOC_SERIES_DA1469X
```

## soc/arm/renesas_smartbond/da1469x/Kconfig.series
```kconfig
# Copyright (c) 2022 Renesas Electronics Corporation
# SPDX-License-Identifier: Apache-2.0

config SOC_SERIES_DA1469X
	bool "Renesas SmartBond(tm) DA1469x series MCU"
	select ARM
	select CPU_CORTEX_M33
	select CPU_HAS_FPU
	select CPU_HAS_ARM_MPU
	select CPU_CORTEX_M_HAS_SYSTICK
	select SOC_FAMILY_SMARTBOND
	select HAS_SEGGER_RTT
	help
	  Enable support for Renesas SmartBond(tm) DA1469x MCU series
```

## soc/arm/renesas_smartbond/da1469x/Kconfig.soc
```kconfig
# Copyright (c) 2022 Renesas Electronics Corporation
# SPDX-License-Identifier: Apache-2.0

choice
	prompt "Renesas SmartBond(tm) DA1469x MCU selection"
	depends on SOC_SERIES_DA1469X

config SOC_DA14699
	bool "DA14699"

endchoice
```

## soc/arm/rpi_pico/Kconfig
```kconfig
# Raspberry Pi (RP) MCU line

# Copyright (c) 2021 Nordic Semiconductor ASA
# Copyright (c) 2021 Yonatan Schachter
# SPDX-License-Identifier: Apache-2.0

config SOC_FAMILY_RPI_PICO
	bool

if SOC_FAMILY_RPI_PICO

config SOC_FAMILY
	string
	default "rpi_pico"

source "soc/arm/rpi_pico/*/Kconfig.soc"

endif # SOC_FAMILY_RPI_PICO
```

## soc/arm/rpi_pico/Kconfig.defconfig
```kconfig
# Raspberry Pi (RP) MCU line

# Copyright (c) 2021 Nordic Semiconductor ASA
# SPDX-License-Identifier: Apache-2.0

if SOC_FAMILY_RPI_PICO

source "soc/arm/rpi_pico/*/Kconfig.defconfig.series"

config PINCTRL
	default y

endif # SOC_FAMILY_RPI_PICO
```

## soc/arm/rpi_pico/Kconfig.soc
```kconfig
# Raspberry Pi (RP) MCU line

# Copyright (c) 2021 Nordic Semiconductor ASA
# SPDX-License-Identifier: Apache-2.0

source "soc/arm/rpi_pico/*/Kconfig.series"
```

## soc/arm/rpi_pico/rp2/Kconfig.defconfig.series
```kconfig
# Raspberry Pi RP2XXX MCU line

# Copyright (c) 2021 Nordic Semiconductor ASA
# Copyright (c) 2021 Yonatan Schachter
# SPDX-License-Identifier: Apache-2.0

if SOC_SERIES_RP2XXX

source "soc/arm/rpi_pico/rp2/Kconfig.defconfig.rp2*"

config SOC_SERIES
	default "rp2"

config NUM_IRQS
	default 26

endif # SOC_SERIES_RP2XXX
```

## soc/arm/rpi_pico/rp2/Kconfig.series
```kconfig
# Raspberry Pi RP2XXX MCU line

# Copyright (c) 2021 Nordic Semiconductor ASA
# Copyright (c) 2021 Yonatan Schachter
# SPDX-License-Identifier: Apache-2.0

config SOC_SERIES_RP2XXX
	bool "Raspberry Pi RP2 series MCU"
	select ARM
	select CPU_CORTEX_M0PLUS
	select CPU_CORTEX_M_HAS_SYSTICK
	select CPU_CORTEX_M_HAS_VTOR
	select CPU_HAS_ARM_MPU
	select SOC_FAMILY_RPI_PICO
	select HAS_RPI_PICO
	select HAS_I2C_DW if I2C
	select XIP
	help
	  Enable support for Raspberry Pi RP2 MCU series
```

## soc/arm/silabs_exx32/Kconfig
```kconfig
#
# Copyright (c) 2017 Christian Taedcke
# Copyright (c) 2018 Gil Benkoe
#
# SPDX-License-Identifier: Apache-2.0
#

config SOC_FAMILY_EXX32
	bool
	select HAS_SEGGER_RTT

if SOC_FAMILY_EXX32
config SOC_FAMILY
	string
	default "silabs_exx32"

source "soc/arm/silabs_exx32/*/Kconfig.soc"

config SOC_PART_NUMBER
	string
	help
	  This string holds the full part number of the SoC. It is a hidden option
	  that you should not set directly. The part number selection choice defines
	  the default value for this string.

config SOC_GECKO_CORE
	bool
	help
	  Set if the Core interrupt handling (CORE) HAL module is used.

config SOC_GECKO_CRYOTIMER
	bool
	help
	  Set if the Ultra Low Energy Timer/Counter (CRYOTIMER) HAL module is used.

config SOC_GECKO_EMU
	bool
	help
	  Set if the Energy Management Unit (EMU) HAL module is used.

config SOC_GECKO_GPIO
	bool
	help
	  Set if the General Purpose Input/Output (GPIO) HAL module is used.

config SOC_GECKO_I2C
	bool
	help
	  Set if the Inter-Integrated Circuit Interface (I2C) HAL module is used.

config SOC_GECKO_LETIMER
	bool
	help
	  Set if the Low Energy Timer (LETIMER) HAL module is used.

config SOC_GECKO_LEUART
	bool
	help
	  Set if the Low Energy Universal Asynchronous Receiver/Transmitter (LEUART)
	  HAL module is used.

config SOC_GECKO_MSC
	bool
	help
	  Set if the Memory System Controller (MSC) HAL module is used.

config SOC_GECKO_PRS
	bool
	help
	  Set if the Peripheral Reflex System (PRS) HAL module is used.

config SOC_GECKO_RMU
	bool
	help
	  Set if the Reset Management Unit (RMU) HAL module is used.

config SOC_GECKO_RTC
	bool
	help
	  Set if the Real Time Counter (RTC) HAL module is used.

config SOC_GECKO_RTCC
	bool
	help
	  Set if the Real Time Counter and Calendar (RTCC) HAL module is used.

config SOC_GECKO_TIMER
	bool
	help
	  Set if the Timer/Counter (TIMER) HAL module is used.

config SOC_GECKO_USART
	bool
	help
	  Set if the Universal Synchronous Asynchronous Receiver/Transmitter (USART)
	  HAL module is used.

config SOC_GECKO_WDOG
	bool
	help
	  Set if the Watchdog Timer (WDOG) HAL module is used.

config SOC_GECKO_EMU_DCDC
	bool "Enable SoC DC/DC regulator"
	select SOC_GECKO_EMU
	help
	  Enable the on chip DC/DC regulator

choice SOC_GECKO_EMU_DCDC_MODE
	prompt "DC/DC mode"
	depends on SOC_GECKO_EMU_DCDC
	help
	  Select power configuration mode of the on chip DC/DC converter.

	config SOC_GECKO_EMU_DCDC_MODE_UNCONFIGURED
		bool "Initial / Unconfigured"

	config SOC_GECKO_EMU_DCDC_MODE_ON
		bool "DC/DC On"

	config SOC_GECKO_EMU_DCDC_MODE_OFF
		bool "DC/DC Off"

	config SOC_GECKO_EMU_DCDC_MODE_BYPASS
		bool "Bypass"
endchoice

config SOC_GECKO_CMU
	bool
	help
	  Set if the clock management unit (CMU) is present in the SoC.

if SOC_GECKO_CMU

choice
	prompt "High Frequency Clock Selection"
	default CMU_HFCLK_HFXO

config CMU_HFCLK_HFXO
	bool "External high frequency crystal oscillator"
	help
	  Set this option to use the external high frequency crystal oscillator
	  as high frequency clock.

config CMU_HFCLK_LFXO
	bool "External low frequency crystal oscillator"
	help
	  Set this option to use the external low frequency crystal oscillator
	  as high frequency clock.

config CMU_HFCLK_HFRCO
	bool "Internal high frequency RC oscillator"
	help
	  Set this option to use the internal high frequency RC oscillator as high frequency clock.

endchoice

config CMU_HFXO_FREQ
	int "External high frequency oscillator frequency"
	help
	  Set the external high frequency oscillator frequency in Hz. This should be set by the
	  board's defconfig.

config CMU_LFXO_FREQ
	int "External low frequency oscillator frequency"
	help
	  Set the external low frequency oscillator frequency in Hz. This should be set by the
	  board's defconfig.

endif # SOC_GECKO_CMU

config SOC_GECKO_HAS_INDIVIDUAL_PIN_LOCATION
	bool
	help
	  If enabled, indicates that SoC allows to configure individual pin
	  locations. This is supported by e.g. efr32fg1p, efr32mg12p series.
	  If disabled, indicates that pin locations are configured in groups.
	  This is supported by e.g. efm32hg, efm32wg series.

config SOC_GECKO_HAS_ERRATA_RTCC_E201
	bool
	help
	  Set if the SoC is affected by errata RTCC_E201:
	  "When the RTCC is configured with a prescaler, the CCV1 top value enable
	  feature enabled by setting CCV1TOP in RTCC_CTRL fails to wrap the counter
	  when RTCC_CNT is equal to RTCC_CC1_CCV, as intended."

endif # SOC_FAMILY_EXX32
```

## soc/arm/silabs_exx32/Kconfig.defconfig
```kconfig
# SPDX-License-Identifier: Apache-2.0

if SOC_FAMILY_EXX32

source "soc/arm/silabs_exx32/*/Kconfig.defconfig.series"

config SOC_GECKO_EMU
	default y
	select SOC_GECKO_CORE
	depends on PM

config CORTEX_M_SYSTICK
	default n if GECKO_BURTC_TIMER

# With sl_power_manager, pm_state_set()'s stack footrpting is noticeably
# large, especially with logs enabled. Since it is called from IDLE task,
# its stack size has to be increased
config IDLE_STACK_SIZE
	default 512 if SOC_GECKO_PM_BACKEND_PMGR

endif
```

## soc/arm/silabs_exx32/Kconfig.soc
```kconfig
# Copyright (c) 2017 Christian Taedcke
# SPDX-License-Identifier: Apache-2.0

source "soc/arm/silabs_exx32/*/Kconfig.series"
```

## soc/arm/silabs_exx32/efm32gg11b/Kconfig.defconfig.efm32gg11b
```kconfig
# Silicon Labs EFM32GG-STK3701A platform configuration options
# Copyright (c) 2019 Interay Solutions B.V.
# Copyright (c) 2019 Oane Kingma
# SPDX-License-Identifier: Apache-2.0

config GPIO_GECKO
	default y
	depends on GPIO || LOG_BACKEND_SWO

if SERIAL

config UART_GECKO
	default y

config LEUART_GECKO
	default y

endif # SERIAL

config I2C_GECKO
	default y
	depends on I2C

config SOC_FLASH_GECKO
	default y
	depends on FLASH

config SPI_GECKO
	default y
	depends on SPI
```

## soc/arm/silabs_exx32/efm32gg11b/Kconfig.defconfig.series
```kconfig
# EFM32GG11B series configuration options
# Copyright (c) 2019 Interay Solutions B.V.
# Copyright (c) 2019 Oane Kingma
# SPDX-License-Identifier: Apache-2.0

if SOC_SERIES_EFM32GG11B

config SOC_SERIES
	default "efm32gg11b"

config SOC_PART_NUMBER
	default "EFM32GG11B820F2048GL192" if SOC_PART_NUMBER_EFM32GG11B820F2048GL192
	default "EFM32GG11B820F2048GM64" if SOC_PART_NUMBER_EFM32GG11B820F2048GM64

config NUM_IRQS
	int
	# must be >= the highest interrupt number used
	default 68

source "soc/arm/silabs_exx32/efm32gg11b/Kconfig.defconfig.efm32gg11b"

endif # SOC_SERIES_EFM32GG11B
```

## soc/arm/silabs_exx32/efm32gg12b/Kconfig.defconfig.series
```kconfig
# EFM32GG12B series configuration options
# Copyright (c) 2023 Antmicro <www.antmicro.com>
# SPDX-License-Identifier: Apache-2.0

if SOC_SERIES_EFM32GG12B

config SOC_SERIES
	default "efm32gg12b"

config SOC_PART_NUMBER
	default "EFM32GG12B810F1024GM64" if SOC_PART_NUMBER_EFM32GG12B810F1024GM64

config NUM_IRQS
	int
	# must be >= the highest interrupt number used
	default 68

source "soc/arm/silabs_exx32/efm32gg12b/Kconfig.defconfig.efm32gg12b"

endif # SOC_SERIES_EFM32GG12B
```

## soc/arm/silabs_exx32/efm32gg12b/Kconfig.soc
```kconfig
# EFM32GG12B (Giant Gecko) MCU line
# Copyright (c) 2023 Antmicro <www.antmicro.com>
# SPDX-License-Identifier: Apache-2.0

config SOC_PART_NUMBER_EFM32GG12B810F1024GM64
	bool
	depends on SOC_SERIES_EFM32GG12B
```

## soc/arm/silabs_exx32/efm32hg/Kconfig.defconfig.efm32hg
```kconfig
# Silicon Labs EFM32HG-SLSTK3400A platform configuration options

# Copyright (c) 2018 Marcio Montenegro
# SPDX-License-Identifier: Apache-2.0

config SOC_FLASH_GECKO
	default y
	depends on FLASH
```

## soc/arm/silabs_exx32/efm32hg/Kconfig.defconfig.series
```kconfig
# Kconfig - EFM32HG series configuration options
#
# Copyright (c) 2018 Christian Taedcke
# Copyright (c) 2018 Marcio Montenegro
#
# SPDX-License-Identifier: Apache-2.0
#

if SOC_SERIES_EFM32HG

config SOC_SERIES
	default "efm32hg"

config SOC_PART_NUMBER
	default "EFM32HG322F64" if SOC_PART_NUMBER_EFM32HG322F64

config NUM_IRQS
	# must be >= the highest interrupt number used
	default 20

source "soc/arm/silabs_exx32/efm32hg/Kconfig.defconfig.efm32hg"

endif # SOC_SERIES_EFM32HG
```

## soc/arm/silabs_exx32/efm32hg/Kconfig.series
```kconfig
# EFM32HG MCU line

# Copyright (c) 2018 Marcio Montenegro
# SPDX-License-Identifier: Apache-2.0

config SOC_SERIES_EFM32HG
	bool "EFM32HG Series MCU"
	select ARM
	select CPU_CORTEX_M0PLUS
	select SOC_FAMILY_EXX32
	select CPU_CORTEX_M_HAS_SYSTICK
	select HAS_SILABS_GECKO
	select SOC_GECKO_CMU
	select SOC_GECKO_GPIO
	select HAS_PM
	select SOC_GECKO_SERIES0
	help
	  Enable support for EFM32 Happy Gecko MCU series
```

## soc/arm/silabs_exx32/efm32hg/Kconfig.soc
```kconfig
# Kconfig - EFM32HG (Happy Gecko) MCU line
#
# Copyright (c) 2018 Marcio Montenegro
#
# SPDX-License-Identifier: Apache-2.0
#

if SOC_SERIES_EFM32HG

config SOC_PART_NUMBER_EFM32HG322F64
	bool

endif # SOC_SERIES_EFM32HG
```

## soc/arm/silabs_exx32/efm32jg12b/Kconfig.defconfig.efm32jg12b
```kconfig
# Silicon Labs EFM32JG12B configuration options

# Copyright (c) 2019 Lemonbeat GmbH
# SPDX-License-Identifier: Apache-2.0

config SOC_FLASH_GECKO
	default y
	depends on FLASH
```

## soc/arm/silabs_exx32/efm32jg12b/Kconfig.series
```kconfig
# EFM32JG12B MCU line

# Copyright (c) 2019 Lemonbeat GmbH
# SPDX-License-Identifier: Apache-2.0

config SOC_SERIES_EFM32JG12B
	bool "EFM32JG12B Series MCU"
	select ARM
	select HAS_SILABS_GECKO
	select HAS_SWO
	select CPU_CORTEX_M3
	select CPU_HAS_ARM_MPU
	select SOC_FAMILY_EXX32
	select SOC_GECKO_HAS_INDIVIDUAL_PIN_LOCATION
	select SOC_GECKO_HAS_HFRCO_FREQRANGE
	select SOC_GECKO_SERIES1
	select SOC_GECKO_CMU
	select SOC_GECKO_EMU
	select SOC_GECKO_GPIO
	select SOC_GECKO_TRNG
	select HAS_PM
	help
	  Enable support for EFM32 JadeGecko MCU series
```

## soc/arm/silabs_exx32/efm32jg12b/Kconfig.soc
```kconfig
# EFM32JG12B (Jade Gecko) MCU line

# Copyright (c) 2019 Lemonbeat GmbH
# SPDX-License-Identifier: Apache-2.0

config SOC_PART_NUMBER_EFM32JG12B500F1024GL125
	bool
	depends on SOC_SERIES_EFM32JG12B
```
