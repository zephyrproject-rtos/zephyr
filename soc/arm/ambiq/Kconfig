## soc/arm/ambiq/Kconfig
```kconfig
# SPDX-License-Identifier: Apache-2.0
#
# Copyright (c) 2023 Antmicro <www.antmicro.com>

config SOC_FAMILY_AMBIQ
	bool

if SOC_FAMILY_AMBIQ

config SOC_FAMILY
	string
	default "ambiq"

source "soc/arm/ambiq/*/Kconfig.soc"

endif # SOC_FAMILY_AMBIQ
```

## soc/arm/ambiq/Kconfig.defconfig
```kconfig
# SPDX-License-Identifier: Apache-2.0
#
# Copyright (c) 2023 Antmicro <www.antmicro.com>

source "soc/arm/ambiq/*/Kconfig.defconfig.series"

config CORTEX_M_SYSTICK
	default n if AMBIQ_STIMER_TIMER

config SYS_CLOCK_HW_CYCLES_PER_SEC
	default 32768 if AMBIQ_STIMER_TIMER
```

## soc/arm/ambiq/Kconfig.soc
```kconfig
# SPDX-License-Identifier: Apache-2.0
#
# Copyright (c) 2023 Antmicro <www.antmicro.com>

source "soc/arm/ambiq/*/Kconfig.series"
```

## soc/arm/ambiq/apollo3x/Kconfig.defconfig.apollo3p_blue
```kconfig
# SPDX-License-Identifier: Apache-2.0
#
# Copyright (c) 2023 Ambiq Micro Inc. <www.ambiq.com>

if SOC_APOLLO3P_BLUE

config NUM_IRQS
	default 33

DT_NODE_SRAM := /memory@0

config SRAM_NC_SIZE
	default $(dt_node_reg_size_int,$(DT_NODE_SRAM),1,K)

config SRAM_NC_BASE_ADDRESS
	default $(dt_node_reg_addr_hex,$(DT_NODE_SRAM),1)

endif # SOC_APOLLO3P_BLUE
```

## soc/arm/ambiq/apollo3x/Kconfig.defconfig.series
```kconfig
# SPDX-License-Identifier: Apache-2.0
#
# Copyright (c) 2023 Antmicro <www.antmicro.com>

if SOC_SERIES_APOLLO3X

source "soc/arm/ambiq/apollo3x/Kconfig.defconfig.apollo3*"

config SOC_SERIES
	default "apollo3x"

endif # SOC_SERIES_APOLLO3X
```

## soc/arm/ambiq/apollo3x/Kconfig.series
```kconfig
# SPDX-License-Identifier: Apache-2.0
#
# Copyright (c) 2024 Semios Inc. <www.semios.com>

# Ambiq Apollo4 MCU Series

config SOC_SERIES_APOLLO3X
	bool "Apollo3 Series MCU"
	select ARM
	select CPU_CORTEX_M4
	select CPU_CORTEX_M_HAS_DWT
	select CPU_HAS_FPU
	select SOC_FAMILY_AMBIQ
	select CPU_HAS_ARM_MPU
	select HAS_SWO
	select AMBIQ_HAL
	help
	  Enable support for Apollo3 MCU series
```

## soc/arm/ambiq/apollo3x/Kconfig.soc
```kconfig
# SPDX-License-Identifier: Apache-2.0
#
# Copyright (c) 2024 Semios Inc. <www.semios.com>

choice
	prompt "Ambiq Apollo3X Selection"
	depends on SOC_SERIES_APOLLO3X

config SOC_APOLLO3P_BLUE
	bool "Apollo3 Blue Plus"

endchoice
```

## soc/arm/ambiq/apollo4x/Kconfig.defconfig.apollo4p_blue
```kconfig
# SPDX-License-Identifier: Apache-2.0
#
# Copyright (c) 2023 Ambiq Micro Inc. <www.ambiq.com>

if SOC_APOLLO4P_BLUE

config NUM_IRQS
	default 83

DT_NODE_SRAM := /memory@0

config SRAM_NC_SIZE
	default $(dt_node_reg_size_int,$(DT_NODE_SRAM),1,K)

config SRAM_NC_BASE_ADDRESS
	default $(dt_node_reg_addr_hex,$(DT_NODE_SRAM),1)

endif # SOC_APOLLO4P_BLUE
```

## soc/arm/ambiq/apollo4x/Kconfig.defconfig.series
```kconfig
# SPDX-License-Identifier: Apache-2.0
#
# Copyright (c) 2023 Antmicro <www.antmicro.com>

if SOC_SERIES_APOLLO4X

source "soc/arm/ambiq/apollo4x/Kconfig.defconfig.apollo4*"

config SOC_SERIES
	default "apollo4x"

endif # SOC_SERIES_APOLLO4X
```

## soc/arm/ambiq/apollo4x/Kconfig.series
```kconfig
# SPDX-License-Identifier: Apache-2.0
#
# Copyright (c) 2023 Antmicro <www.antmicro.com>

# Ambiq Apollo4 MCU Series

config SOC_SERIES_APOLLO4X
	bool "Apollo4 Series MCU"
	select ARM
	select CPU_CORTEX_M4
	select CPU_CORTEX_M_HAS_DWT
	select CPU_HAS_FPU
	select SOC_FAMILY_AMBIQ
	select HAS_SWO
	select AMBIQ_HAL
	help
	  Enable support for Apollo4 MCU series
```

## soc/arm/ambiq/apollo4x/Kconfig.soc
```kconfig
# SPDX-License-Identifier: Apache-2.0
#
# Copyright (c) 2023 Antmicro <www.antmicro.com>
# Copyright (c) 2023 Ambiq Micro Inc. <www.ambiq.com>

choice
	prompt "Ambiq Apollo4X Selection"
	depends on SOC_SERIES_APOLLO4X

config SOC_APOLLO4P
	bool "Apollo4P"

config SOC_APOLLO4P_BLUE
	bool "Apollo4 Blue Plus"

endchoice
```

## soc/arm/arm/Kconfig
```kconfig
# ARM LTD SoC configuration options

# Copyright (c) 2016 Linaro Limited
# SPDX-License-Identifier: Apache-2.0

config SOC_FAMILY_ARM
	bool

if SOC_FAMILY_ARM
config SOC_FAMILY
	string
	default "arm"

source "soc/arm/arm/*/Kconfig.soc"
endif # SOC_FAMILY_ARM
```

## soc/arm/arm/Kconfig.soc
```kconfig
# ARM LTD SoC configuration options

# Copyright (c) 2016 Linaro Limited
# SPDX-License-Identifier: Apache-2.0

source "soc/arm/arm/*/Kconfig.series"
```

## soc/arm/arm/beetle/Kconfig.defconfig.series
```kconfig
# ARM LTD Beetle SoC configuration options

# Copyright (c) 2016 Linaro Limited
# SPDX-License-Identifier: Apache-2.0

if SOC_SERIES_BEETLE

source "soc/arm/arm/beetle/Kconfig.defconfig.beetle*"

config SOC_SERIES
	default "beetle"

config NUM_IRQS
	default 45

config SYS_CLOCK_HW_CYCLES_PER_SEC
	default 24000000

config CLOCK_CONTROL_INIT_PRIORITY
	default 1
	depends on CLOCK_CONTROL

endif # SOC_SERIES_BEETLE
```

## soc/arm/arm/beetle/Kconfig.series
```kconfig
# Kconfig - ARM LTD Beetle SoC configuration options

#
# Copyright (c) 2016 Linaro Limited
#
# SPDX-License-Identifier: Apache-2.0
#

config SOC_SERIES_BEETLE
	bool "ARM Beetle MCU Series"
	depends on ARM
	select CPU_CORTEX_M3
	select SOC_FAMILY_ARM
	select CPU_HAS_SYSTICK
	select CPU_HAS_MPU
	help
	 Enable support for Beetle MCU Series
```

## soc/arm/arm/beetle/Kconfig.soc
```kconfig
# ARM LTD Beetle SoC configuration options

# Copyright (c) 2016 Linaro Limited
# SPDX-License-Identifier: Apache-2.0

config SOC_BEETLE_R0
	bool
	help
	  ARM BEETLE R0
```

## soc/arm/arm/designstart/Kconfig.defconfig.cortex_m1
```kconfig
# Copyright (c) 2020 Henrik Brix Andersen <henrik@brixandersen.dk>
# SPDX-License-Identifier: Apache-2.0

if SOC_ARM_DESIGNSTART_FPGA_CORTEX_M1

config SOC
	default "designstart_cortex_m1"

endif # SOC_ARM_DESIGNSTART_FPGA_CORTEX_M1
```

## soc/arm/arm/designstart/Kconfig.defconfig.cortex_m3
```kconfig
# Copyright (c) 2020 Henrik Brix Andersen <henrik@brixandersen.dk>
# SPDX-License-Identifier: Apache-2.0

if SOC_ARM_DESIGNSTART_FPGA_CORTEX_M3

config SOC
	default "designstart_cortex_m3"

endif # SOC_ARM_DESIGNSTART_FPGA_CORTEX_M3
```

## soc/arm/arm/designstart/Kconfig.defconfig.series
```kconfig
# Copyright (c) 2020 Henrik Brix Andersen <henrik@brixandersen.dk>
# SPDX-License-Identifier: Apache-2.0

if SOC_SERIES_ARM_DESIGNSTART

config SOC_SERIES
	default "designstart"

source "soc/arm/arm/designstart/Kconfig.defconfig.cortex*"

endif # SOC_SERIES_ARM_DESIGNSTART
```

## soc/arm/arm/designstart/Kconfig.series
```kconfig
# Copyright (c) 2020 Henrik Brix Andersen <henrik@brixandersen.dk>
# SPDX-License-Identifier: Apache-2.0

config SOC_SERIES_ARM_DESIGNSTART
	bool
	select ARM
	select SOC_FAMILY_ARM
	help
	  Enable support for the ARM DesignStart SoC Series
```

## soc/arm/arm/designstart/Kconfig.soc
```kconfig
# Copyright (c) 2020 Henrik Brix Andersen <henrik@brixandersen.dk>
# SPDX-License-Identifier: Apache-2.0

config SOC_ARM_DESIGNSTART_FPGA_CORTEX_M1
	bool
	select CPU_CORTEX_M1
	imply XIP
	select HAS_SEGGER_RTT
	help
	  ARM Cortex-M1 DesignStart FPGA

config SOC_ARM_DESIGNSTART_FPGA_CORTEX_M3
	bool
	select CPU_CORTEX_M3
	imply XIP
	select HAS_SEGGER_RTT
	help
	  ARM Cortex-M3 DesignStart FPGA
```

## soc/arm/arm/fvp_aemv8r_aarch32/Kconfig.soc
```kconfig
# Copyright (c) 2022 IoT.bzh
# SPDX-License-Identifier: Apache-2.0

config SOC_FVP_AEMV8R_AARCH32
	bool
	select CPU_CORTEX_R52
	select CPU_HAS_ARM_MPU
	select CPU_HAS_MPU
	select GIC_V3
	select GIC_SINGLE_SECURITY_STATE
	help
	  ARM FVP AEMv8R aarch32 simulation
```

## soc/arm/arm/mps2/Kconfig.defconfig.mps2_an519
```kconfig
# Copyright (c) 2018-2019 Linaro Limited
# Copyright (c) 2021 Nordic Semiconductor ASA
# SPDX-License-Identifier: Apache-2.0

if SOC_MPS2_AN519

config SOC
	default "mps2_an519"

config NUM_IRQS
	default 120

endif
```

## soc/arm/arm/mps2/Kconfig.defconfig.mps2_an521
```kconfig
#
# Copyright (c) 2018-2019 Linaro Limited
#
# SPDX-License-Identifier: Apache-2.0
#

if SOC_MPS2_AN521

config SOC
	default "mps2_an521"

config NUM_IRQS
	default 96

endif
```

## soc/arm/arm/mps2/Kconfig.defconfig.series
```kconfig
#
# Copyright (c) 2017 Linaro Limited
#
# SPDX-License-Identifier: Apache-2.0
#

if SOC_SERIES_MPS2

config SOC_SERIES
	default "mps2"

config SYS_CLOCK_HW_CYCLES_PER_SEC
	int
	default 25000000

source "soc/arm/arm/mps2/Kconfig.defconfig.mps2*"

endif # SOC_SERIES_MPS2
```
