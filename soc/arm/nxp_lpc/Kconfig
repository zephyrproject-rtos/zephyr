## soc/arm/nxp_lpc/Kconfig
```kconfig
# Copyright (c) 2017, NXP
# SPDX-License-Identifier: Apache-2.0

config SOC_FAMILY_LPC
	bool
	select HAS_SEGGER_RTT

if SOC_FAMILY_LPC

config SOC_FAMILY
	string
	default "nxp_lpc"

source "soc/arm/nxp_lpc/*/Kconfig.soc"

config SOC_PART_NUMBER
	default SOC_PART_NUMBER_LPC54XXX if SOC_SERIES_LPC54XXX
	default SOC_PART_NUMBER_LPC55XXX if SOC_SERIES_LPC55XXX
	default SOC_PART_NUMBER_LPC11U6X if SOC_SERIES_LPC11U6X
	default SOC_PART_NUMBER_LPC51U68 if SOC_SERIES_LPC51U68

endif # SOC_FAMILY_LPC
```

## soc/arm/nxp_lpc/Kconfig.defconfig
```kconfig
# Copyright (c) 2017, NXP
# SPDX-License-Identifier: Apache-2.0

source "soc/arm/nxp_lpc/*/Kconfig.defconfig.series"

config I2C_MCUX_FLEXCOMM
	default y if HAS_MCUX_FLEXCOMM
	depends on I2C

config SERIAL_INIT_PRIORITY
	default 55
	depends on SERIAL
```

## soc/arm/nxp_lpc/lpc11u6x/Kconfig.defconfig.lpc11u68
```kconfig
# NXP LPC11U68 platform configuration options

# Copyright (c) 2020, Seagate
# SPDX-License-Identifier: Apache-2.0

if SOC_LPC11U68

config SOC
	default "lpc11u68"

endif # SOC_LPC11U68
```

## soc/arm/nxp_lpc/lpc11u6x/Kconfig.defconfig.series
```kconfig
# LPC11U6X series configuration options

# Copyright (c) 2020, Seagate
# SPDX-License-Identifier: Apache-2.0

if SOC_SERIES_LPC11U6X

source "soc/arm/nxp_lpc/lpc11u6x/Kconfig.defconfig.lp*"

config SOC_SERIES
	default "lpc11u6x"

config NUM_IRQS
	# must be >= the highest interrupt number used
	default 40

endif # SOC_SERIES_LPC11U6X
```

## soc/arm/nxp_lpc/lpc11u6x/Kconfig.series
```kconfig
# LPC LPC11U6X MCU line

# Copyright (c) 2020, Seagate
# SPDX-License-Identifier: Apache-2.0

config SOC_SERIES_LPC11U6X
	bool "LPC LPC11U6X Series MCU"
	select ARM
	select CPU_CORTEX_M0PLUS
	select CPU_CORTEX_M_HAS_SYSTICK
	select SOC_FAMILY_LPC
	select PINMUX
	select PINCTRL
	select CLOCK_CONTROL
	help
	  Enable support for LPC LPC11U6X MCU series
```

## soc/arm/nxp_lpc/lpc11u6x/Kconfig.soc
```kconfig
# LPC LPC11U6x MCU line

# Copyright (c) 2020, Seagate
# SPDX-License-Identifier: Apache-2.0

choice
	prompt "LPC LPC11U6X MCU Selection"
	depends on SOC_SERIES_LPC11U6X

config SOC_LPC11U68
	bool "SOC_LPC11U68"

config SOC_LPC11U67
	bool "SOC_LPC11U67"

config SOC_LPC11U66
	bool "SOC_LPC11U66"

endchoice

if SOC_SERIES_LPC11U6X

config SOC_PART_NUMBER_LPC11U66JBD48
	bool
config SOC_PART_NUMBER_LPC11U67JBD48
	bool
config SOC_PART_NUMBER_LPC11U67JBD64
	bool
config SOC_PART_NUMBER_LPC11U67JBD100
	bool
config SOC_PART_NUMBER_LPC11U68JBD48
	bool
config SOC_PART_NUMBER_LPC11U68JBD64
	bool
config SOC_PART_NUMBER_LPC11U68JBD100
	bool

config SOC_PART_NUMBER_LPC11U6X
	string
	default "LPC11U66JBD48" if SOC_PART_NUMBER_LPC11U66JBD48
	default "LPC11U67JBD48" if SOC_PART_NUMBER_LPC11U67JBD48
	default "LPC11U67JBD64" if SOC_PART_NUMBER_LPC11U67JBD64
	default "LPC11U67JBD100" if SOC_PART_NUMBER_LPC11U67JBD100
	default "LPC11U68JBD48" if SOC_PART_NUMBER_LPC11U68JBD48
	default "LPC11U68JBD64" if SOC_PART_NUMBER_LPC11U68JBD64
	default "LPC11U68JBD100" if SOC_PART_NUMBER_LPC11U68JBD100

	help
	  This string holds the full part number of the SoC. It is a hidden
	  option that you should not set directly. The part number selection
	  choice defines the default value for this string.
endif # SOC_SERIES_LPC11U6X
```

## soc/arm/nxp_lpc/lpc51u68/Kconfig.defconfig.series
```kconfig
# LPC51U68 series configuration options

# Copyright (c) 2021 metraTec GmbH
# SPDX-License-Identifier: Apache-2.0

if SOC_SERIES_LPC51U68

config SOC_SERIES
	default "lpc51u68"

config NUM_IRQS
	# must be >= the highest interrupt number used.
	default 32

config SOC
	default "lpc51u68"

config SOC_FLASH_LPC
	default y
	depends on FLASH

endif
```

## soc/arm/nxp_lpc/lpc51u68/Kconfig.series
```kconfig
# LPC LPC51U68 Series

# Copyright (c) 2021 metraTec GmbH
# SPDX-License-Identifier: Apache-2.0

config SOC_SERIES_LPC51U68
	bool "LPC LPC51U68 Series MCU"
	select ARM
	select CPU_CORTEX_M0PLUS
	select HAS_MCUX
	select HAS_MCUX_FLEXCOMM
	select HAS_MCUX_SYSCON
	select HAS_MCUX_SCTIMER
	select SOC_FAMILY_LPC
	select CPU_CORTEX_M_HAS_SYSTICK
	help
	  Enable support for LPC LPC51U68 MCU Series
```

## soc/arm/nxp_lpc/lpc54xxx/Kconfig.defconfig.lpc54114_m0
```kconfig
# NXP LPC54114 M0 platform configuration options

# Copyright (c) 2017, NXP
# SPDX-License-Identifier: Apache-2.0

if SOC_LPC54114_M0

config SOC
	default "lpc54114_m0"

config GPIO
	default n

endif # SOC_LPC54114_M0
```

## soc/arm/nxp_lpc/lpc54xxx/Kconfig.defconfig.lpc54114_m4
```kconfig
# NXP LPC54114 platform configuration options

# Copyright (c) 2017, NXP
# SPDX-License-Identifier: Apache-2.0

if SOC_LPC54114_M4

config SOC
	default "lpc54114"

endif # SOC_LPC54114_M4
```

## soc/arm/nxp_lpc/lpc54xxx/Kconfig.defconfig.series
```kconfig
# LPC54XXX series configuration options

# Copyright (c) 2017, NXP
# SPDX-License-Identifier: Apache-2.0

if SOC_SERIES_LPC54XXX

config SOC_SERIES
	default "lpc54xxx"

config NUM_IRQS
	# must be >= the highest interrupt number used
	default 40

source "soc/arm/nxp_lpc/lpc54xxx/Kconfig.defconfig.lp*"

endif # SOC_SERIES_LPC54XXX
```

## soc/arm/nxp_lpc/lpc54xxx/Kconfig.series
```kconfig
# LPC LPC54XXX MCU line

# Copyright (c) 2017, NXP
# SPDX-License-Identifier: Apache-2.0

config SOC_SERIES_LPC54XXX
	bool "LPC LPC54xxx Series MCU"
	select ARM
	select HAS_MCUX
	select HAS_MCUX_FLEXCOMM
	select HAS_MCUX_SYSCON
	select SOC_FAMILY_LPC
	select CPU_CORTEX_M_HAS_SYSTICK
	help
	  Enable support for LPC LPC54XXX MCU series
```

## soc/arm/nxp_lpc/lpc54xxx/Kconfig.soc
```kconfig
# LPC LPC54XXX MCU line

# Copyright (c) 2017, NXP
# SPDX-License-Identifier: Apache-2.0

choice
	prompt "LPC LPC54XXX MCU Selection"
	depends on SOC_SERIES_LPC54XXX

config SOC_LPC54114_M4
	bool "SOC_LPC54114_M4"
	select CPU_CORTEX_M4
	select CPU_CORTEX_M_HAS_DWT
	select CPU_HAS_ARM_MPU
	select PLATFORM_SPECIFIC_INIT
	select CLOCK_CONTROL
	select HAS_MCUX_IAP_LEGACY

config SOC_LPC54114_M0
	bool "SOC_LPC54114_M0"
	select CPU_CORTEX_M0PLUS
	select CPU_CORTEX_M_HAS_VTOR
	select CLOCK_CONTROL

endchoice

if SOC_SERIES_LPC54XXX

config SOC_PART_NUMBER_LPC54114J256BD64
	bool

config SOC_PART_NUMBER_LPC54XXX
	string
	default "LPC54114J256BD64" if SOC_PART_NUMBER_LPC54114J256BD64

	help
	  This string holds the full part number of the SoC. It is a hidden
	  option that you should not set directly. The part number selection
	  choice defines the default value for this string.

config SECOND_CORE_MCUX
	bool "LPC54114 Cortex-M0 second core"
	depends on HAS_MCUX
	help
	  Driver for second core startup

config SECOND_CORE_BOOT_ADDRESS_MCUX
	depends on SECOND_CORE_MCUX
	hex "Address the second core will boot at"
	default 0x20010000
	help
	  This is the address the second core will boot from. Additionally this
	  address is where we will copy the SECOND_IMAGE to. We default this to
	  the base of SRAM1.

# Workaround for not being able to have commas in macro arguments
DT_CHOSEN_Z_CODE_CPU1_PARTITION := zephyr,code-cpu1-partition

# Move the LMA address of second core into flash
config BUILD_OUTPUT_ADJUST_LMA
	depends on SECOND_CORE_MCUX && SOC_LPC54114_M0
	default "-0x20010000+\
	  $(dt_chosen_reg_addr_hex,$(DT_CHOSEN_Z_CODE_CPU1_PARTITION))"

config BUILD_OUTPUT_INFO_HEADER
	default y
	depends on SECOND_CORE_MCUX && SOC_LPC54114_M0

endif # SOC_SERIES_LPC54XXX
```

## soc/arm/nxp_lpc/lpc55xxx/Kconfig.defconfig.lpc55S06
```kconfig
# NXP LPC55S06 platform configuration options

# Copyright (c) 2022 metraTec
# SPDX-License-Identifier: Apache-2.0

if SOC_LPC55S06

config SOC
	default "lpc55S06"

config LPC55XXX_USB_RAM
	default n

endif # SOC_LPC55S06
```

## soc/arm/nxp_lpc/lpc55xxx/Kconfig.defconfig.lpc55S16
```kconfig
# NXP LPC55S16 platform configuration options

# Copyright (c) 2020 Henrik Brix Andersen <henrik@brixandersen.dk>
# SPDX-License-Identifier: Apache-2.0

if SOC_LPC55S16

config SOC
	default "lpc55S16"

config CAN_MCUX_MCAN
	default y
	depends on CAN

choice USB_MCUX_CONTROLLER_TYPE
	default USB_DC_NXP_LPCIP3511
endchoice

endif # SOC_LPC55S16
```

## soc/arm/nxp_lpc/lpc55xxx/Kconfig.defconfig.lpc55S28
```kconfig
# NXP LPC55S28 platform configuration options

# Copyright (c) 2020 Lemonbeat GmbH
# SPDX-License-Identifier: Apache-2.0

if SOC_LPC55S28

config SOC
	default "lpc55S28"

config PINMUX_MCUX_LPC
	default y
	depends on PINMUX

endif # SOC_LPC55S28
```

## soc/arm/nxp_lpc/lpc55xxx/Kconfig.defconfig.lpc55S36
```kconfig
# NXP LPC55S36 platform configuration options

# Copyright 2022 NXP
# SPDX-License-Identifier: Apache-2.0

if SOC_LPC55S36

config SOC
	default "lpc55S36"

choice USB_MCUX_CONTROLLER_TYPE
	default USB_DC_NXP_LPCIP3511
endchoice

config LPC55XXX_USB_RAM
	default n

endif # SOC_LPC55S36
```

## soc/arm/nxp_lpc/lpc55xxx/Kconfig.defconfig.lpc55S69_cpu0
```kconfig
# NXP LPC55XXX CPU0 platform configuration options

# Copyright (c) 2019, NXP
# SPDX-License-Identifier: Apache-2.0

if SOC_LPC55S69_CPU0

config SOC
	default "lpc55S69_cpu0"

config PINMUX_MCUX_LPC
	default y
	depends on PINMUX

config SOC_FLASH_MCUX
	default y
	depends on FLASH
	depends on !TRUSTED_EXECUTION_NONSECURE

choice USB_MCUX_CONTROLLER_TYPE
	default USB_DC_NXP_LPCIP3511
endchoice

config I2S_MCUX_FLEXCOMM
	select INIT_PLL0

endif # SOC_LPC55S69_CPU0
```

## soc/arm/nxp_lpc/lpc55xxx/Kconfig.defconfig.lpc55S69_cpu1
```kconfig
# NXP LPC55S69 CPU1 platform configuration options

# Copyright (c) 2019, NXP
# SPDX-License-Identifier: Apache-2.0

if SOC_LPC55S69_CPU1

config SOC
	default "lpc55S69_cpu1"

config GPIO
	default y

config SERIAL
	default n

endif # SOC_LPC55S69_CPU1
```

## soc/arm/nxp_lpc/lpc55xxx/Kconfig.defconfig.series
```kconfig
# LPC55XXX series configuration options

# Copyright (c) 2019, NXP
# SPDX-License-Identifier: Apache-2.0

if SOC_SERIES_LPC55XXX

config SOC_SERIES
	default "lpc55xxx"

config NUM_IRQS
	# must be >= the highest interrupt number used
	default 60

source "soc/arm/nxp_lpc/lpc55xxx/Kconfig.defconfig.lp*"

endif # SOC_SERIES_LPC55XXX
```

## soc/arm/nxp_lpc/lpc55xxx/Kconfig.series
```kconfig
# LPC LPC55XXX Series

# Copyright (c) 2019, NXP
# SPDX-License-Identifier: Apache-2.0

config SOC_SERIES_LPC55XXX
	bool "LPC5500 Series Family MCU"
	select ARM
	select HAS_MCUX
	select HAS_MCUX_FLEXCOMM
	select HAS_MCUX_SYSCON
	select HAS_MCUX_WWDT
	select SOC_FAMILY_LPC
	select CPU_CORTEX_M_HAS_SYSTICK
	select CPU_CORTEX_M_HAS_DWT
	help
	  Enable support for LPC5500 Series MCU series
```

## soc/arm/nxp_lpc/lpc55xxx/Kconfig.soc
```kconfig
# LPC LPC55XXX Series

# Copyright 2019, 2023 NXP
# SPDX-License-Identifier: Apache-2.0

choice
	prompt "LPC5500 Series MCU Selection"
	depends on SOC_SERIES_LPC55XXX

config SOC_LPC55S06
	bool "SOC_LPC55S06 M33"
	select CPU_CORTEX_M33
	select CPU_HAS_ARM_SAU
	select CPU_HAS_ARM_MPU
	select CPU_HAS_FPU
	select ARMV8_M_DSP
	select ARM_TRUSTZONE_M
	select CLOCK_CONTROL
	select HAS_MCUX_IAP if !TRUSTED_EXECUTION_NONSECURE
	select HAS_MCUX_RNG

config SOC_LPC55S16
	bool "SOC_LPC55S16 M33"
	select CPU_CORTEX_M33
	select CPU_HAS_ARM_SAU
	select CPU_HAS_ARM_MPU
	select CPU_HAS_FPU
	select ARMV8_M_DSP
	select ARM_TRUSTZONE_M
	select CLOCK_CONTROL
	select HAS_MCUX_IAP if !TRUSTED_EXECUTION_NONSECURE
	select HAS_MCUX_MCAN
	select HAS_MCUX_RNG

config SOC_LPC55S28
	bool "SOC_LPC55S28 M33"
	select CPU_CORTEX_M33
	select CPU_HAS_ARM_MPU
	select CPU_HAS_FPU
	select ARMV8_M_DSP
	select CLOCK_CONTROL
	select HAS_MCUX_IAP
	select HAS_MCUX_LPADC
	select HAS_MCUX_LPC_DMA
	select HAS_MCUX_RNG

config SOC_LPC55S36
	bool "SOC_LPC55S36 M33"
	select CPU_CORTEX_M33
	select CPU_HAS_ARM_SAU
	select CPU_HAS_ARM_MPU
	select CPU_HAS_FPU
	select ARMV8_M_DSP
	select ARM_TRUSTZONE_M
	select CLOCK_CONTROL
	select HAS_MCUX_MCAN
	select HAS_MCUX_PWM

config SOC_LPC55S69_CPU0
	bool "SOC_LPC55S69 M33 [CPU 0]"
	select CPU_CORTEX_M33
	select CPU_HAS_ARM_SAU
	select CPU_HAS_ARM_MPU
	select CPU_HAS_FPU
	select ARMV8_M_DSP
	select ARM_TRUSTZONE_M
	select CLOCK_CONTROL
	select HAS_MCUX_IAP
	select HAS_MCUX_LPADC
	select HAS_MCUX_LPC_DMA
	select HAS_MCUX_USB_LPCIP3511
	select HAS_MCUX_CTIMER
	select HAS_MCUX_SCTIMER
	select HAS_MCUX_RNG

config SOC_LPC55S69_CPU1
	bool "SOC_LPC55S69 M33 [CPU 1]"
	select CPU_CORTEX_M33

endchoice

if SOC_SERIES_LPC55XXX

config SOC_PART_NUMBER_LPC55S06JBD64
	bool

config SOC_PART_NUMBER_LPC55S16JBD64
	bool

config SOC_PART_NUMBER_LPC55S16JBD100
	bool

config SOC_PART_NUMBER_LPC55S28JBD100
	bool

config SOC_PART_NUMBER_LPC55S36JBD100
	bool

config SOC_PART_NUMBER_LPC55S69JBD100
	bool

config SOC_PART_NUMBER_LPC55S69JET98
	bool

config SOC_PART_NUMBER_LPC55XXX
	string
	default "LPC55S06JBD64"  if SOC_PART_NUMBER_LPC55S06JBD64
	default "LPC55S16JBD64" if SOC_PART_NUMBER_LPC55S16JBD64
	default "LPC55S16JBD100" if SOC_PART_NUMBER_LPC55S16JBD100
	default "LPC55S28JBD100" if SOC_PART_NUMBER_LPC55S28JBD100
	default "LPC55S36JBD100" if SOC_PART_NUMBER_LPC55S36JBD100
	default "LPC55S69JBD100" if SOC_PART_NUMBER_LPC55S69JBD100
	default "LPC55S69JET98"  if SOC_PART_NUMBER_LPC55S69JET98

	help
	  This string holds the full part number of the SoC. It is a hidden
	  option that you should not set directly. The part number selection
	  choice defines the default value for this string.

config INIT_PLL0
	bool "Initialize PLL0"

config INIT_PLL1
	bool "Initialize PLL1"
	default "y"
	depends on !(SOC_LPC55S06 || FLASH)
	help
	  In the LPC55XXX Family, this is currently being used to set the
	  core clock value at it's highest frequency which clocks at 150MHz.
	  Note that flash programming operations are limited to 100MHz, and
	  this PLL should not be used as the core clock in those cases.

config SECOND_CORE_MCUX
	bool "LPC55xxx's second core"
	depends on HAS_MCUX
	help
	  Indicates the second core will be enabled, and the part will run
	  in dual core mode.

# Workaround for not being able to have commas in macro arguments
DT_CHOSEN_Z_CODE_CPU1_PARTITION := zephyr,code-cpu1-partition

config SECOND_CORE_BOOT_ADDRESS_MCUX
	depends on SECOND_CORE_MCUX
	hex "Address the second core will boot at"
	default $(dt_chosen_reg_addr_hex,$(DT_CHOSEN_Z_CODE_CPU1_PARTITION))
	help
	  This is the address the second core will boot from.

# Move the LMA for the second core image to be in the flash region of primary
# core, so that JLink flash will load it correctly.
config BUILD_OUTPUT_ADJUST_LMA
	depends on SECOND_CORE_MCUX && SOC_LPC55S69_CPU1
	default "0x10000000"

config LPC55XXX_SRAM_CLOCKS
	bool "CLock LPC SRAM banks"
	default y
	help
	  SRAM controllers 1,2,3, and 4 are disabled at reset.
	  By default, CMSIS SystemInit will enable the clock to these RAM banks.
	  Disable this Kconfig to leave the ram banks untouched out of reset.

config LPC55XXX_USB_RAM
	bool
	default y
	help
	  Some SoC's in the LPC5500 Series do have a dedicated USB RAM.
	  By default, USB RAM is assumed to be present.
	  Disable this Kconfig in case there is no dedicated USB RAM.

endif # SOC_SERIES_LPC55XXX
```
