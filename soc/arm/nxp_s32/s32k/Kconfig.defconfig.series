## soc/arm/qemu_max/Kconfig.defconfig
```kconfig
# Copyright 2024-2025 HNU-ESNL: Guoqi Xie, Chenglai Xiong, Xingyu Hu and etc.
# Copyright 2024-2025 openEuler SIG-Zephyr
# SPDX-License-Identifier: Apache-2.0

if SOC_QEMU_MAX

config NUM_IRQS
	# must be >= the highest interrupt number used
	# - include the UART interrupts
	default 16384 if GIC_V3_ITS
	default 220 if !GIC_V3_ITS

config SYS_CLOCK_HW_CYCLES_PER_SEC
	default 62500000

# Workaround for not being able to have commas in macro arguments
DT_CHOSEN_Z_FLASH := zephyr,flash

config FLASH_SIZE
	default $(dt_chosen_reg_size_int,$(DT_CHOSEN_Z_FLASH),0,K)

config FLASH_BASE_ADDRESS
	default $(dt_chosen_reg_addr_hex,$(DT_CHOSEN_Z_FLASH))

endif # SOC_QEMU_MAX
```

## soc/arm/qemu_virt_arm64/Kconfig
```kconfig
# Copyright (c) 2022 Huawei France Technologies SAS
# SPDX-License-Identifier: Apache-2.0

config SOC_QEMU_VIRT_ARM64
	select ARM64
	select CPU_CORTEX_A
	select ARMV8_A
```
