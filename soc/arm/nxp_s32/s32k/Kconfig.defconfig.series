## soc/arm/nxp_s32/s32k/Kconfig.defconfig.series
```kconfig
# S32 K M7 core series

# Copyright 2023 NXP
# SPDX-License-Identifier: Apache-2.0

if SOC_SERIES_S32K3_M7

config SOC_SERIES
	default "s32k"

config SYS_CLOCK_HW_CYCLES_PER_SEC
	default 2000000

config NUM_IRQS
	# must be >= the highest interrupt number used
	default 239

if !XIP
config FLASH_SIZE
	default 0
config FLASH_BASE_ADDRESS
	default 0
endif

if NET_L2_ETHERNET

config NET_TCP_CHECKSUM
	default n

config NET_UDP_CHECKSUM
	default n

endif # NET_L2_ETHERNET

source "soc/arm/nxp_s32/s32k/Kconfig.defconfig.s32k*"

endif # SOC_SERIES_S32K_M7
```

## soc/arm/nxp_s32/s32k/Kconfig.soc
```kconfig
# NXP S32K MCUs family

# Copyright 2023 NXP
# SPDX-License-Identifier: Apache-2.0

choice
	prompt "NXP S32K MCUs family SoC Selection"
	depends on SOC_SERIES_S32K3_M7

config SOC_S32K344_M7
	bool "SOC_S32K_M7"
	select HAS_NXP_S32_HAL

endchoice

if SOC_SERIES_S32K3_M7

config SOC_PART_NUMBER_S32K344
	bool

config SOC_PART_NUMBER_S32K3
	string
	default "S32K344" if SOC_PART_NUMBER_S32K344
	help
	  This string holds the full part number of the SoC. It is a hidden option
	  that you should not set directly. The part number selection choice defines
	  the default value for this string.

config IVT_HEADER_OFFSET
	hex
	depends on XIP
	default $(dt_node_reg_addr_hex,$(dt_nodelabel_path,ivt_header))
	help
	  The offset address from flash base address for ivt header

config IVT_HEADER_SIZE
	hex
	depends on XIP
	default $(dt_node_reg_size_hex,$(dt_nodelabel_path,ivt_header))
	help
	  Size of ivt header region

config NXP_S32_PMC_LMEN
	bool "Last Mile regulator"
	default y if CLOCK_CONTROL
	help
	  Enables the Last Mile regulator, which regulates an external 1.5V
	  voltage on V15 down to the core and logic supply (V11 power domain),
	  which is typically 1.1V.
	  When enabling PLL as system clock, the PMC last mile regulator should
	  be enabled.

config NXP_S32_PMC_LMBCTLEN
	bool "External BCTL regulator for V15"
	depends on NXP_S32_PMC_LMEN
	help
	  This option must be selected if an external BJT between VDD_HV_A and
	  V15 is used on the PCB. The base of this BJT must be connected to the
	  VRC_CTRL pin and is controlled by the PMC to regulate a voltage of
	  1.5V on V15 pin.

endif
```

## soc/arm/nxp_s32/s32k1/Kconfig.defconfig.series
```kconfig
# NXP S32K1XX MCU series

# Copyright 2023 NXP
# SPDX-License-Identifier: Apache-2.0

if SOC_SERIES_S32K1XX

config SOC_SERIES
	default "s32k1"

config SYS_CLOCK_HW_CYCLES_PER_SEC
	default 80000000

config NUM_IRQS
	default 239 if CPU_CORTEX_M4
	default 47 if CPU_CORTEX_M0PLUS

if !XIP
config FLASH_SIZE
	default 0
config FLASH_BASE_ADDRESS
	default 0
endif

# The S32K1xx have 8 MPU regions, which is not enough for both HW stack protection
# and userspace. Only enable HW stack protection if userspace is not enabled.
config HW_STACK_PROTECTION
	default y if !USERSPACE

source "soc/arm/nxp_s32/s32k1/Kconfig.defconfig.s32k1*"

endif # SOC_SERIES_S32K1XX
```

## soc/arm/nxp_s32/s32k1/Kconfig.series
```kconfig
# NXP S32K1XX MCU series

# Copyright 2023-2024 NXP
# SPDX-License-Identifier: Apache-2.0

config SOC_SERIES_S32K1XX
	bool "NXP S32K1XX MCU series"
	select ARM
	select SOC_FAMILY_NXP_S32
	select HAS_NXP_S32_HAL
	select HAS_MCUX
	select CPU_HAS_NXP_MPU
	select CPU_HAS_CUSTOM_FIXED_SOC_MPU_REGIONS
	select MPU_ALLOW_FLASH_WRITE if !XIP
	select CLOCK_CONTROL
	select HAS_MCUX_LPUART
	select HAS_MCUX_LPI2C
	select HAS_MCUX_LPSPI
	select HAS_MCUX_FTM
	select HAS_MCUX_FLEXCAN
	select HAS_MCUX_WDOG32
	help
	  Enable support for NXP S32K1XX MCU series.
```

## soc/arm/nxp_s32/s32k14x/Kconfig.defconfig.s32k
```kconfig
# NXP S32K platform configuration options

# Copyright (c) 2021, Dung
# SPDX-License-Identifier: Apache-2.0

if SOC_S32K_M4

config SOC
	default "s32k"

endif # SOC_S32K_M4
```

## soc/arm/nxp_s32/s32k14x/Kconfig.defconfig.series
```kconfig
# S32K14X series configuration options

# Copyright (c) 2021, Dung Tran
# SPDX-License-Identifier: Apache-2.0

if SOC_SERIES_S32K14X

config SOC_SERIES
	default "s32k14x"

source "soc/arm/nxp_s32/s32k14x/Kconfig.defconfig.s32k"

endif # SOC_SERIES_S32K14X
```

## soc/arm/nxp_s32/s32k14x/Kconfig.series
```kconfig
# NXP S32K14X MCU line

# Copyright (c) 2021, Dung
# SPDX-License-Identifier: Apache-2.0

config SOC_SERIES_S32K14X
	bool "NXP S32K14x Series MCU"
	select ARM
    select CPU_CORTEX_M4F
    select SOC_FAMILY_S32K1
    select PINMUX
    select CLOCK_CONTROL
	help
	  Enable support for NXP S32K14X MCU series
```

## soc/arm/nxp_s32/s32k14x/Kconfig.soc
```kconfig
# NXP S32K14X MCU line

# Copyright (c) 2021, Dung Tran
# SPDX-License-Identifier: Apache-2.0

choice
	prompt "NXP S32K14X MCU Selection"
	depends on SOC_SERIES_S32K14X

config SOC_S32K144
	bool "SOC_S32K144"
	select HAS_S32K_HAL
	select HAS_S32K_GPIO
	select HAS_S32K_GMAC
	select HAS_S32K_SPI
	select HAS_S32K_UART
	select HAS_S32K_CAN
	select HAS_S32K_LIN

endchoice

config SOC_PART_NUMBER_S32K144
	bool

config SOC_PART_NUMBER_S32K14X
	string
	default "S32K144" if SOC_PART_NUMBER_S32K144
	help
	  This string holds the full part number of the SoC. It is a hidden
	  option that you should not set directly. The part number selection
	  choice defines the default value for this string.

endif # SOC_SERIES_S32K14X
```

## soc/arm/nxp_s32/s32k3/Kconfig.defconfig.s32k344
```kconfig
# S32K344

# Copyright 2023 NXP
# SPDX-License-Identifier: Apache-2.0

if SOC_S32K344_M7

config SOC
	default "s32k344"

config FPU
	default y

endif # SOC_S32K344_M7
```

## soc/arm/nxp_s32/s32k3/Kconfig.defconfig.series
```kconfig
# NXP S32K3XX MCU series

# Copyright 2023 NXP
# SPDX-License-Identifier: Apache-2.0

if SOC_SERIES_S32K3XX

config SOC_SERIES
	default "s32k3"

config SYS_CLOCK_HW_CYCLES_PER_SEC
	default 2000000

config NUM_IRQS
	# must be >= the highest interrupt number used
	default 239

if !XIP
config FLASH_SIZE
	default 0
config FLASH_BASE_ADDRESS
	default 0
endif

if NET_L2_ETHERNET

config NET_TCP_CHECKSUM
	default n

config NET_UDP_CHECKSUM
	default n

endif # NET_L2_ETHERNET

source "soc/arm/nxp_s32/s32k3/Kconfig.defconfig.s32k*"

endif # SOC_SERIES_S32K3XX
```

## soc/arm/nxp_s32/s32k3/Kconfig.series
```kconfig
# NXP S32K3 MCUs family

# Copyright 2023 NXP
# SPDX-License-Identifier: Apache-2.0

config SOC_SERIES_S32K3_M7
	bool "S32K3 M7 Core Series"
	select ARM
	select CPU_CORTEX_M7
	select SOC_FAMILY_NXP_S32
	select CPU_HAS_FPU
	select CPU_HAS_ARM_MPU
	select CPU_HAS_CUSTOM_FIXED_SOC_MPU_REGIONS
	select PLATFORM_SPECIFIC_INIT if XIP
	select USE_DT_CODE_PARTITION if XIP
	select CLOCK_CONTROL
	select HAS_MCUX
	select HAS_MCUX_LPUART
	select HAS_MCUX_FLEXCAN
	select HAS_MCUX_LPI2C
	select HAS_MCUX_LPSPI
	select HAS_MCUX_CACHE
	help
	  Enable support for NXP S32K3 MCUs family on Cortex-M7 cores
```

## soc/arm/nxp_s32/s32k3/Kconfig.soc
```kconfig
# NXP S32K3XX MCU series

# Copyright 2023 NXP
# SPDX-License-Identifier: Apache-2.0

choice
	prompt "NXP S32K3XX MCU selection"
	depends on SOC_SERIES_S32K3XX

config SOC_S32K344
	bool "s32k344"

endchoice

if SOC_SERIES_S32K3XX

config SOC_PART_NUMBER_PS32K344EHVPBS
	bool

config SOC_PART_NUMBER
	string
	default "PS32K344EHVPBS" if SOC_PART_NUMBER_PS32K344EHVPBS
	help
	  This string holds the full part number of the SoC. It is a hidden option
	  that you should not set directly. The part number selection choice defines
	  the default value for this string.

config IVT_HEADER_OFFSET
	hex
	depends on XIP
	default $(dt_node_reg_addr_hex,$(dt_nodelabel_path,ivt_header))
	help
	  The offset address from flash base address for ivt header

config IVT_HEADER_SIZE
	hex
	depends on XIP
	default $(dt_node_reg_size_hex,$(dt_nodelabel_path,ivt_header))
	help
	  Size of ivt header region

config NXP_S32_PMC_LMEN
	bool "Last Mile regulator"
	default y if CLOCK_CONTROL
	help
	  Enables the Last Mile regulator, which regulates an external 1.5V
	  voltage on V15 down to the core and logic supply (V11 power domain),
	  which is typically 1.1V.
	  When enabling PLL as system clock, the PMC last mile regulator should
	  be enabled.

config NXP_S32_PMC_LMBCTLEN
	bool "External BCTL regulator for V15"
	depends on NXP_S32_PMC_LMEN
	help
	  This option must be selected if an external BJT between VDD_HV_A and
	  V15 is used on the PCB. The base of this BJT must be connected to the
	  VRC_CTRL pin and is controlled by the PMC to regulate a voltage of
	  1.5V on V15 pin.

endif
```

## soc/arm/nxp_s32/s32ze/Kconfig.defconfig.series
```kconfig
# NXP S32Z/E MCUs family default configuration

# Copyright 2022 NXP
# SPDX-License-Identifier: Apache-2.0

if SOC_SERIES_S32ZE_R52

config SOC_SERIES
	default "s32ze"

config NUM_IRQS
	# must be >= the highest interrupt number used
	default 991

config FPU
	default y

config SYS_CLOCK_HW_CYCLES_PER_SEC
	default 2000000

config MAIN_STACK_SIZE
	default 1024

if !XIP
config FLASH_SIZE
	default 0

config FLASH_BASE_ADDRESS
	default 0
endif # !XIP

# Ethernet driver must init first because it initializes the
# NETC which is needed for EMDIO functionality
if NET_L2_ETHERNET

config MDIO_INIT_PRIORITY
	default 70

config PHY_INIT_PRIORITY
	default 80

# NETC drops TCP/UDP packets with invalid checksum
config NET_TCP_CHECKSUM
	default n

config NET_UDP_CHECKSUM
	default n

endif # NET_L2_ETHERNET

source "soc/arm/nxp_s32/s32ze/Kconfig.defconfig.s32*"

endif # SOC_SERIES_S32ZE_R52
```

## soc/arm/nxp_s32/s32ze/Kconfig.series
```kconfig
# NXP S32Z/E MCUs family

# Copyright 2022-2023 NXP
# SPDX-License-Identifier: Apache-2.0

config SOC_SERIES_S32ZE_R52
	bool "NXP S32Z/E series"
	select ARM
	select ARM_ARCH_TIMER if SYS_CLOCK_EXISTS
	select CPU_CORTEX_R52
	select CPU_HAS_DCLS
	select CPU_HAS_ARM_MPU
	select GIC_SINGLE_SECURITY_STATE
	select VFP_DP_D16
	select PLATFORM_SPECIFIC_INIT
	select SOC_FAMILY_NXP_S32
	select CLOCK_CONTROL
	select HAS_MCUX
	select HAS_MCUX_PIT
	help
	  Enable support for NXP S32Z/E MCUs family on Cortex-R52 cores.
```

## soc/arm/nxp_s32/s32ze/Kconfig.soc
```kconfig
# NXP S32Z/E MCUs family

# Copyright 2022 NXP
# SPDX-License-Identifier: Apache-2.0

choice
	prompt "NXP S32Z/E MCUs family SoC selection"
	depends on SOC_SERIES_S32ZE_R52

config SOC_S32Z27_R52
	bool "SOC_S32Z27_R52"
	select HAS_NXP_S32_HAL

endchoice

if SOC_SERIES_S32ZE_R52

config SOC_PART_NUMBER_S32Z27
	bool

config SOC_PART_NUMBER_S32ZE_R52
	string
	default "S32Z27" if SOC_PART_NUMBER_S32Z27
	help
	  This string holds the full part number of the SoC. It is a hidden option
	  that you should not set directly. The part number selection choice defines
	  the default value for this string.

config NXP_S32_RTU_INDEX
	int
	range 0 1
	help
	  This option indicates the index of the target RTU (Real-Time Unit) subsystem.

endif # SOC_SERIES_S32ZE_R52
```

## soc/arm/openisa_rv32m1/Kconfig
```kconfig
# Copyright (c) 2018 Foundries.io Ltd
# Copyright (c) 2020 Karsten Koenig
#
# SPDX-License-Identifier: Apache-2.0

# The OpenISA RV32M1 SoC directory in arm supports the ARM Cortex
# cores on OpenISA RV32M1 SoCs.
#
# The Zephyr "soc" abstraction isn't a great fit here. These SoCs (in
# the strict physical sense of "systems on chip") also contain RISC-V
# cores, so this type of "soc" doesn't really belong to a single "arch".
#
# However, due to constraints imposed by Zephyr's file hierarchy
# conventions, those "other" cores are supported under a different soc
# subdirectory, soc/riscv32 instead of soc/arm.

choice
	prompt "OpenISA RV32M1 ARM Core Selection"
	depends on SOC_OPENISA_RV32M1_ARM

config SOC_OPENISA_RV32M1_M4
	bool "OpenISA RV32M1 M4 core"
	select ARM
	select CPU_CORTEX_M4
	select CPU_HAS_FPU

endchoice
```

## soc/arm/openisa_rv32m1/Kconfig.defconfig
```kconfig
# RV32M1 SoC ARM core default configuration values

# Copyright (c) 2018 Foundries.io Ltd
# Copyright (c) 2020 Karsten Koenig

# SPDX-License-Identifier: Apache-2.0

if SOC_OPENISA_RV32M1_ARM

config SOC
	default "openisa_rv32m1"

config NUM_IRQS
	default 128

config XIP
	default y

# We need to disable the watchdog out of reset, as it's enabled by
# default. Use the WDOG_INIT hook for doing that.
config WDOG_INIT
	def_bool y

config SYS_CLOCK_HW_CYCLES_PER_SEC
	default 8000000

config PINMUX_RV32M1
	default y

config GPIO_RV32M1
	default y
	depends on GPIO

config UART_RV32M1_LPUART
	default y
	depends on SERIAL

config I2C_RV32M1_LPI2C
	default y
	depends on I2C

config SPI_RV32M1_LPSPI
	default y
	depends on SPI

config PWM_RV32M1_TPM
	default y
	depends on PWM

if FLASH

config SOC_FLASH_RV32M1
	default y

# Workaround for not being able to have commas in macro arguments
DT_CHOSEN_Z_FLASH := zephyr,flash

config FLASH_BASE_ADDRESS
	default $(dt_chosen_reg_addr_hex,$(DT_CHOSEN_Z_FLASH))

endif # FLASH

config ENTROPY_RV32M1_TRNG
	default y
	depends on ENTROPY_GENERATOR

endif # SOC_OPENISA_RV32M1_RISCV32
```

## soc/arm/openisa_rv32m1/Kconfig.soc
```kconfig
# Copyright (c) 2018 Foundries.io Ltd
# Copyright (c) 2020 Karsten Koenig
#
# SPDX-License-Identifier: Apache-2.0

config SOC_OPENISA_RV32M1_ARM
	bool "OpenISA RV32M1 ARM cores"
	# The following select is due to limitations in the linker script.
	# (We can't make it a 'depends on' without causing a dependency loop).
	select XIP
	select SOC_OPENISA_RV32M1
	select HAS_RV32M1_LPUART
	select HAS_RV32M1_LPI2C
	select HAS_RV32M1_LPSPI
	select HAS_RV32M1_TPM
	select VEGA_SDK_HAL
	select CLOCK_CONTROL
	select HAS_RV32M1_FTFX

	help
	  Enable support for OpenISA RV32M1 ARM processors. Choose
	  this option to target the Cortex-M4 or Cortex-M0+ core. This
	  option should not be used to target either RISC-V core.
```

## soc/arm/qemu_cortex_a53/Kconfig.defconfig
```kconfig
# Copyright (c) 2019 Carlo Caione <ccaione@baylibre.com>
# SPDX-License-Identifier: Apache-2.0

if SOC_QEMU_CORTEX_A53

config NUM_IRQS
	# must be >= the highest interrupt number used
	# - include the UART interrupts
	# - LPIs (starting at 8192) if GIC_V3_ITS is used
	default 16384 if GIC_V3_ITS
	default 220 if !GIC_V3_ITS

config SYS_CLOCK_HW_CYCLES_PER_SEC
	default 62500000

endif # SOC_QEMU_CORTEX_A53
```

## soc/arm/qemu_cortex_a53_aarch32/Kconfig
```kconfig
# Copyright (c) 2026 Realtek Semiconductor Corp.
# SPDX-License-Identifier: Apache-2.0

config SOC_QEMU_CORTEX_A53_AARCH32
	select ARM
	select CPU_CORTEX_A53_AARCH32
	select QEMU_TARGET
```

## soc/arm/qemu_cortex_a53_aarch32/Kconfig.defconfig
```kconfig
# Copyright (c) 2026 Realtek Semiconductor Corp.
# SPDX-License-Identifier: Apache-2.0

if SOC_QEMU_CORTEX_A53_AARCH32

config NUM_IRQS
	default 220

config SYS_CLOCK_HW_CYCLES_PER_SEC
	default 62500000

DT_CHOSEN_Z_FLASH := zephyr,flash

config FLASH_SIZE
	default $(dt_chosen_reg_size_int,$(DT_CHOSEN_Z_FLASH),0,K)

config FLASH_BASE_ADDRESS
	default $(dt_chosen_reg_addr_hex,$(DT_CHOSEN_Z_FLASH))

endif # SOC_QEMU_CORTEX_A53_AARCH32
```

## soc/arm/qemu_cortex_a53_aarch32/Kconfig.soc
```kconfig
# Copyright (c) 2026 Realtek Semiconductor Corp.
# SPDX-License-Identifier: Apache-2.0

config SOC_QEMU_CORTEX_A53_AARCH32
	bool
	select SOC_FAMILY_ARM

config SOC
	default "qemu_cortex_a53_aarch32" if SOC_QEMU_CORTEX_A53_AARCH32
```

## soc/arm/qemu_max/Kconfig
```kconfig
# Copyright 2024-2025 HNU-ESNL: Guoqi Xie, Chenglai Xiong, Xingyu Hu and etc.
# Copyright 2024-2025 openEuler SIG-Zephyr
# SPDX-License-Identifier: Apache-2.0

config SOC_QEMU_MAX
	select ARM64
	select CPU_CORTEX_A55
	select QEMU_TARGET
```
