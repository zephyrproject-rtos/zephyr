## soc/arm/infineon_xmc/4xxx/Kconfig.series
```kconfig
# XMC4xxx MCU series
#
# Copyright (c) 2020 Linumiz
# Author: Parthiban Nallathambi <parthiban@linumiz.com>
# SPDX-License-Identifier: Apache-2.0

config SOC_SERIES_XMC_4XXX
	bool "XMC 4xxx Series MCU"
	select ARM
	select CPU_CORTEX_M4
	select CPU_CORTEX_M_HAS_DWT
	select SOC_FAMILY_XMC
	select CPU_HAS_ARM_MPU
	select CPU_HAS_FPU
	select HAS_XMCLIB_UART
	select HAS_XMCLIB_FLASH
	select HAS_XMCLIB_ERU
	select HAS_XMCLIB_VADC
	select HAS_XMCLIB_DMA
	select HAS_XMCLIB_SPI
	help
	  Enable support for XMC 4xxx MCU series
```

## soc/arm/infineon_xmc/4xxx/Kconfig.soc
```kconfig
# XMC 4xxx MCU line
#
# Copyright (c) 2020 Linumiz
# Author: Parthiban Nallathambi <parthiban@linumiz.com>
# SPDX-License-Identifier: Apache-2.0

choice
	prompt "XMC 4xxx MCU Selection"
	depends on SOC_SERIES_XMC_4XXX

config SOC_XMC4500
	bool "SOC_XMC4500"
	select HAS_XMCLIB

config SOC_XMC4700
	bool "SOC_XMC4700"
	select HAS_XMCLIB

endchoice

if SOC_SERIES_XMC_4XXX

config SOC_PART_NUMBER_F100X1024
	bool

config SOC_PART_NUMBER_F144X2048
	bool

config SOC_PART_NUMBER_XMC_4XXX
	string
	default "F100x1024" if SOC_PART_NUMBER_F100X1024
	default "F144x2048" if SOC_PART_NUMBER_F144X2048
	help
	  This string holds the full part number of the SoC. It is a hidden option
	  that you should not set directly. The part number selection choice defines
	  the default value for this string.

endif # SOC_SERIES_XMC_4XXX
```

## soc/arm/infineon_xmc/Kconfig
```kconfig
# SPDX-License-Identifier: Apache-2.0
#
# Copyright (c) 2020 Linumiz
# Author: Parthiban Nallathambi <parthiban@linumiz.com>

config SOC_FAMILY_XMC
	bool
	select HAS_SEGGER_RTT
	select PLATFORM_SPECIFIC_INIT

if SOC_FAMILY_XMC

config SOC_FAMILY
	string
	default "infineon_xmc"

source "soc/arm/infineon_xmc/*/Kconfig.soc"

config SOC_PART_NUMBER
	default SOC_PART_NUMBER_XMC_4XXX if SOC_SERIES_XMC_4XXX

endif # SOC_FAMILY_XMC
```

## soc/arm/infineon_xmc/Kconfig.defconfig
```kconfig
# SPDX-License-Identifier: Apache-2.0
#
# Copyright (c) 2020 Linumiz
# Author: Parthiban Nallathambi <parthiban@linumiz.com>

source "soc/arm/infineon_xmc/*/Kconfig.defconfig.series"

if SOC_FAMILY_XMC

config PINCTRL
	default y

endif # SOC_FAMILY_XMC
```

## soc/arm/intel_socfpga_std/Kconfig
```kconfig
# Copyright (c) 2022 Intel Corporation
# SPDX-License-Identifier: Apache-2.0
# Description:
# Adding support to Cyclone V SoC FPGA

config SOC_FAMILY_INTEL_SOCFPGA_STD
	bool

if SOC_FAMILY_INTEL_SOCFPGA_STD
config SOC_FAMILY
	string
	default "intel_socfpga_std"

source "soc/arm/intel_socfpga_std/*/Kconfig.soc"
endif
```

## soc/arm/intel_socfpga_std/Kconfig.defconfig
```kconfig
# Copyright (c) 2022 Intel Corporation
# SPDX-License-Identifier: Apache-2.0
# Description:
# Adding support for Cyclone V SoC FPGA

source "soc/arm/intel_socfpga_std/*/Kconfig.defconfig.series"
```

## soc/arm/intel_socfpga_std/Kconfig.soc
```kconfig
# Copyright (c) 2021 Intel Corporation
# SPDX-License-Identifier: Apache-2.0
# Description:
# Adding support for Cyclone V SoC FPGA

source "soc/arm/intel_socfpga_std/*/Kconfig.series"
```

## soc/arm/intel_socfpga_std/cyclonev/Kconfig.defconfig.cyclonev
```kconfig
# Copyright (c) 2022 Intel Corporation
# SPDX-License-Identifier: Apache-2.0
# Description:
# Adding support for Cyclone V SoC FPGA

if SOC_CYCLONE5

config SOC
	default "intel_socfpga_std_cyclonev"

config NUM_IRQS
	int
	default 211

config SYS_CLOCK_HW_CYCLES_PER_SEC
	int
	default 231250000

endif
```

## soc/arm/intel_socfpga_std/cyclonev/Kconfig.defconfig.series
```kconfig
# Copyright (c) 2022 Intel Corporation
# SPDX-License-Identifier: Apache-2.0
# Description:
# Adding support for Cyclone V SoC FPGA

if SOC_SERIES_CYCLONE5

config SOC_SERIES
	default "cyclonev"

source "soc/arm/intel_socfpga_std/cyclonev/Kconfig.defconfig.cyclonev*"

endif # SOC_SERIES_CYCLONE5
```

## soc/arm/intel_socfpga_std/cyclonev/Kconfig.series
```kconfig
# Copyright (c) 2022 Intel Corporation
# SPDX-License-Identifier: Apache-2.0
# Description
# Adding configuration options for Cyclone V SoC FPGA

config SOC_SERIES_CYCLONE5
	bool "Intel SoC FPGA Cyclone5 Series"
	select ARM
	select CPU_CORTEX_A9
	select GIC_V1
	select SOC_FAMILY_INTEL_SOCFPGA_STD
	select ARM_ARCH_TIMER_ERRATUM_740657 if ARM_ARCH_TIMER
	select HAS_I2C_DW if I2C
	select HAS_SPI_DW if SPI
	select ARCH_HAS_RESERVED_PAGE_FRAMES
	help
		Support for Intel SoC FPGA Series
```

## soc/arm/intel_socfpga_std/cyclonev/Kconfig.soc
```kconfig
# Copyright (c) 2021 Intel Corporation
# SPDX-License-Identifier: Apache-2.0
# Description:
# Adding support to Cyclone V SoC FPGA

config SOC_CYCLONE5
	bool
	help
	  Intel SoC FPGA Cyclone5
```

## soc/arm/microchip_cec/Kconfig
```kconfig
choice
	prompt "Microchip CECxxxx MCU Selection"
	depends on SOC_SERIES_CEC

config SOC_CEC1702
	bool "CEC1702"

endchoice
```

## soc/arm/microchip_cec/Kconfig.defconfig
```kconfig
if SOC_SERIES_CEC

config SOC
	string
	default "microchip_cec"

config NUM_IRQS
	int
	# must be >= the highest interrupt number used
	# - include the UART interrupts
	default 42

config SYS_CLOCK_HW_CYCLES_PER_SEC
	int
	default 48000000

endif
```

## soc/arm/microchip_cec/Kconfig.soc
```kconfig
config SOC_SERIES_CEC
	bool "Microchip CECxxxx MCU"
	select CPU_CORTEX_M
	select CPU_CORTEX_M4
	select CPU_HAS_SYSTICK
	select CPU_HAS_FPU
	select HAS_CEC_HAL
	help
	  Enable support for Micochip CEC Cortex-M4 microcontrollers.
```

## soc/arm/microchip_mec/Kconfig
```kconfig
# Kconfig - Microchip MEC MCU line

# Copyright (c) 2018, Intel Corporation
# SPDX-License-Identifier: Apache-2.0

config SOC_FAMILY_MEC
	bool

if SOC_FAMILY_MEC
config SOC_FAMILY
	string
	default "microchip_mec"

# Select SoC Part No. and configuration options
source "soc/arm/microchip_mec/*/Kconfig.soc"

endif # SOC_FAMILY_MEC
```

## soc/arm/microchip_mec/Kconfig.defconfig
```kconfig
# SPDX-License-Identifier: Apache-2.0

source "soc/arm/microchip_mec/*/Kconfig.defconfig.series"
```

## soc/arm/microchip_mec/Kconfig.soc
```kconfig
# Microchip MEC172x, MEC1501 MCU line

# Copyright (c) 2018 Intel Corporation
# SPDX-License-Identifier: Apache-2.0

source "soc/arm/microchip_mec/*/Kconfig.series"
```

## soc/arm/microchip_mec/cec1702/Kconfig.defconfig.cec1702
```kconfig
# Microchip CEC1702

# Copyright (c) 2019 Crypta Labs Ltd.
# SPDX-License-Identifier: Apache-2.0

if SOC_CEC1702

config SOC
	default "cec1702"

config SYS_CLOCK_HW_CYCLES_PER_SEC
	default 48000000

if SERIAL

config UART_NS16550
	default y

endif # SERIAL

endif # SOC_CEC1702
```

## soc/arm/microchip_mec/cec1702/Kconfig.defconfig.series
```kconfig
# Kconfig - Microchip CEC MCU line
#
# Copyright (c) 2019 Crypta Labs Ltd.
#
# SPDX-License-Identifier: Apache-2.0

if SOC_SERIES_CEC1702

config SOC_SERIES
        default "cec1702"

config NUM_IRQS
	int
	# must be >= the highest interrupt number used
	# - include the UART interrupts
	default 42

config CORTEX_M_SYSTICK
	default y

source "soc/arm/microchip_mec/cec1702/Kconfig.defconfig.cec1702*"

endif
```

## soc/arm/microchip_mec/cec1702/Kconfig.series
```kconfig
# Kconfig - Microchip CEC MCU line
#
# Copyright (c) 2019 Crypta Labs Ltd.
#
# SPDX-License-Identifier: Apache-2.0

config SOC_SERIES_CEC1702
	bool "Microchip CEC1702 Series"
	select ARM
	select CPU_CORTEX_M4
	select SOC_FAMILY_MEC
	select CPU_HAS_FPU
	select HAS_MEC_HAL
	help
	  Enable support for Microchip CEC1702 Cortex-M4 MCU series
```

## soc/arm/microchip_mec/cec1702/Kconfig.soc
```kconfig
# Kconfig - Microchip CEC MCU line
#
# Copyright (c) 2019 Crypta Labs Ltd.
#
# SPDX-License-Identifier: Apache-2.0

choice
        prompt "CEC1702 Selection"
        depends on SOC_SERIES_CEC1702

config SOC_CEC1702
        bool "CEC1702"

endchoice
```

## soc/arm/microchip_mec/mec1501/Kconfig.defconfig.mec1501hsz
```kconfig
# Microchip MEC1501HSZ MCU

# Copyright (c) 2018 Intel Corporation
# SPDX-License-Identifier: Apache-2.0

if SOC_MEC1501_HSZ

config SOC
	default "mec1501hsz"

config PINMUX_XEC
	default y
	depends on PINMUX

config GPIO
	default y

config ESPI_XEC
	default y
	depends on ESPI

config PS2_XEC
	default y
	depends on PS2

endif # SOC_MEC1501_HSZ
```

## soc/arm/microchip_mec/mec1501/Kconfig.defconfig.series
```kconfig
# Microchip MEC MCU series configuration options

# Copyright (c) 2018 Intel Corporation
# SPDX-License-Identifier: Apache-2.0

if SOC_SERIES_MEC1501X

config SOC_SERIES
	default "mec1501"

config NUM_IRQS
	# must be >= the highest interrupt number used
	# - include the UART interrupts
	# All NVIC external sources.
	default 174

source "soc/arm/microchip_mec/mec1501/Kconfig.defconfig.mec1501*"

if RTOS_TIMER

config SOC_HAS_TIMING_FUNCTIONS
	default y if !CORTEX_M_DWT

config ARCH_HAS_CUSTOM_BUSY_WAIT
	default y

endif # RTOS_TIMER

config CORTEX_M_SYSTICK
	depends on !RTOS_TIMER

endif # SOC_SERIES_MEC1501X
```

## soc/arm/microchip_mec/mec1501/Kconfig.series
```kconfig
# Microchip MEC1501 MCU core series

# Copyright (c) 2018 Intel Corporation
# SPDX-License-Identifier: Apache-2.0

config SOC_SERIES_MEC1501X
	bool "Microchip MEC1501X Series"
	select ARM
	select CPU_CORTEX_M4
	select CPU_CORTEX_M_HAS_DWT
	select SOC_FAMILY_MEC
	help
	  Enable support for Microchip MEC Cortex-M4 MCU series
```

## soc/arm/microchip_mec/mec1501/Kconfig.soc
```kconfig
# Microchip MEC1501 MCU core series

# Copyright (c) 2018 Intel Corporation
# SPDX-License-Identifier: Apache-2.0

choice
	prompt "MEC1501 Selection"
	depends on SOC_SERIES_MEC1501X

config SOC_MEC1501_HSZ
	bool "MEC1501_HSZ"
	select HAS_MEC_HAL

endchoice

config RTOS_TIMER
	bool "MEC1501 RTOS timer"

config SOC_MEC1501_PROC_CLK_DIV
	int "PROC_CLK_DIV"
	default 1
	range 1 48
	help
	  This divisor defines a ratio between processor clock (HCLK)
	  and master clock (MCK):
	  HCLK = MCK / PROC_CLK_DIV
	  Allowed divider values: 1, 3, 4, 16, and 48.

config SOC_MEC1501_VTR3_1_8V
	bool "VTR3 power rail is tied to 1.8V"
	help
	  Set this is if VTR3 power sourcejumper in the board is changed.

config SOC_MEC1501_VCI_PINS_AS_GPIOS
	bool "Use VCI block pins as GPIOS"
	default y
	help
	  By default these pins are not GPIOs, but HW controlled.
	  Set this if VCI pin block HW logic is not required in the board
	  design.

choice
	prompt "MEC1501 debug interface general configuration"
	default SOC_MEC1501_DEBUG_WITHOUT_TRACING
	depends on SOC_SERIES_MEC1501X
	help
	  Select Debug SoC interface support for MEC15xx SoC family

	config SOC_MEC1501_DEBUG_DISABLED
		bool "Disable debug support"
		help
		  Debug port is disabled, JTAG/SWD cannot be enabled. JTAG_RST#
		  pin is ignored. All other JTAG pins can be used as GPIOs
		  or other non-JTAG alternate functions.

	config SOC_MEC1501_DEBUG_WITHOUT_TRACING
		bool "Debug support via Serial wire debug"
		help
		  JTAG port in SWD mode. UART2 and ADC00-03 can be used.

	config SOC_MEC1501_DEBUG_AND_TRACING
		bool "Debug support via Serial wire debug with tracing enabled"
		help
		  JTAG port is enabled in SWD mode. Refer to tracing options
		  to see if ADC00-03 can be used or not.

endchoice

choice
	prompt "MEC1501 debug interface trace configuration"
	default SOC_MEC1501_DEBUG_AND_ETM_TRACING
	depends on SOC_MEC1501_DEBUG_AND_TRACING
	help
	  Select tracing mode for debug interface

	config SOC_MEC1501_DEBUG_AND_ETM_TRACING
		bool "Debug support via Serial wire debug"
		help
		  JTAG port in SWD mode and SWV as tracing method.
		  UART2 can be used, but ADC00-03 cannot.

	config SOC_MEC1501_DEBUG_AND_SWV_TRACING
		bool "debug support via Serial Wire Debug and Viewer"
		help
		  JTAG port in SWD mode and SWV as tracing method.
		  UART2 cannot be used. ADC00-03 can be used.
endchoice
```
