## soc/arm/arm/mps2/Kconfig.soc
```kconfig
# Copyright (c) 2017-2019 Linaro Limited
# SPDX-License-Identifier: Apache-2.0

config SOC_MPS2_AN521
	bool
	select CPU_CORTEX_M33
	select CPU_HAS_ARM_MPU

choice
	prompt "ARM MPS2 SoCs"
	depends on SOC_SERIES_MPS2

config SOC_MPS2_AN385
	bool "ARM Cortex-M3 SMM on V2M-MPS2 (Application Note AN385)"
	select CPU_CORTEX_M3
	select CPU_HAS_ARM_MPU

config SOC_MPS2_AN521_CPU0
	bool "ARM Cortex-M33 SMM-SSE-200 on V2M-MPS2+ (AN521) CPU0"
	select SOC_MPS2_AN521
	select CPU_HAS_ARM_SAU

config SOC_MPS2_AN521_CPU1
	bool "ARM Cortex-M33 SMM-SSE-200 on V2M-MPS2+ (AN521) CPU1"
	select SOC_MPS2_AN521
	select CPU_HAS_FPU
	select ARMV8_M_DSP

endchoice
```

## soc/arm/arm/mps3/Kconfig.defconfig.mps3_an547
```kconfig
# Copyright (c) 2018-2021 Linaro Limited
# SPDX-License-Identifier: Apache-2.0

if SOC_MPS3_AN547

config SOC
	default "mps3_an547"

config NUM_IRQS
	default 128

endif
```

## soc/arm/arm/mps3/Kconfig.defconfig.series
```kconfig
# Copyright (c) 2021 Linaro Limited
# SPDX-License-Identifier: Apache-2.0

if SOC_SERIES_MPS3

config SOC_SERIES
	default "mps3"

config SYS_CLOCK_HW_CYCLES_PER_SEC
	default 25000000

source "soc/arm/arm/mps3/Kconfig.defconfig.mps3*"

endif # SOC_SERIES_MPS3
```

## soc/arm/arm/mps3/Kconfig.series
```kconfig
# Copyright (c) 2021 Linaro Limited
# SPDX-License-Identifier: Apache-2.0

config SOC_SERIES_MPS3
	bool "Arm MPS3 MCU Series"
	select ARM
	select SOC_FAMILY_ARM
	select GPIO_MMIO32 if GPIO
	help
	  Enable support for ARM MPS3 MCU Series
```

## soc/arm/arm/mps3/Kconfig.soc
```kconfig
# Copyright (c) 2017-2021 Linaro Limited
# SPDX-License-Identifier: Apache-2.0

choice
	prompt "Arm MPS3 SoCs"
	depends on SOC_SERIES_MPS3

config SOC_MPS3_AN547
	bool "Arm Cortex-M55 SSE-300 on MPS3 (AN547)"
	select CPU_CORTEX_M55
	select CPU_CORTEX_M_HAS_CACHE
	select CPU_HAS_ARM_SAU
	select CPU_HAS_ARM_MPU
	select CPU_HAS_FPU
	select ARMV8_M_DSP
	select ARMV8_1_M_MVEI
	select ARMV8_1_M_MVEF

endchoice
```

## soc/arm/arm/musca_a/Kconfig.defconfig.musca_a
```kconfig
# Copyright (c) 2018 Linaro Limited
# SPDX-License-Identifier: Apache-2.0

if SOC_V2M_MUSCA_A

config SOC_DEPRECATED_RELEASE
	default "v2.6.0"

config SOC
	default "musca_a"

config NUM_IRQS
	default 96

endif
```

## soc/arm/arm/musca_a/Kconfig.defconfig.series
```kconfig
#
# Copyright (c) 2018 Linaro Limited
#
# SPDX-License-Identifier: Apache-2.0
#

if SOC_SERIES_MUSCA

config SOC_SERIES
	default "musca_a"

config SYS_CLOCK_HW_CYCLES_PER_SEC
	default 50000000

source "soc/arm/arm/musca_a/Kconfig.defconfig.musca_a"

endif # SOC_SERIES_MUSCA
```

## soc/arm/arm/musca_a/Kconfig.series
```kconfig
#
# Copyright (c) 2018 Linaro Limited
#
# SPDX-License-Identifier: Apache-2.0
#

config SOC_SERIES_MUSCA
	bool "ARM v2m MUSCA MCU Series"
	select SOC_FAMILY_ARM
	select BUILD_OUTPUT_HEX
	help
	  Enable support for ARM MPS2 MCU Series
```

## soc/arm/arm/musca_a/Kconfig.soc
```kconfig
#
# Copyright (c) 2018 Linaro Limited
#
# SPDX-License-Identifier: Apache-2.0
#

choice
prompt "ARM Musca SoCs"
depends on SOC_SERIES_MUSCA

config SOC_V2M_MUSCA_A
	bool "ARM Cortex-M33 SMM-SSE-200 on V2M-MUSCA"
	select CPU_CORTEX_M33
	select CPU_HAS_ARM_SAU
	select CPU_HAS_ARM_MPU

endchoice
```

## soc/arm/arm/musca_b1/Kconfig.defconfig.musca_b1
```kconfig
# Copyright (c) 2019 Linaro Limited
# SPDX-License-Identifier: Apache-2.0

if SOC_V2M_MUSCA_B1

config SOC
	default "musca_b1"

config NUM_IRQS
	default 96

endif
```

## soc/arm/arm/musca_b1/Kconfig.defconfig.series
```kconfig
# Copyright (c) 2019 Linaro Limited
# SPDX-License-Identifier: Apache-2.0

if SOC_SERIES_MUSCA_B1

config SOC_SERIES
	default "musca_b1"

config SYS_CLOCK_HW_CYCLES_PER_SEC
	default 40000000

source "soc/arm/arm/musca_b1/Kconfig.defconfig.musca_b1"

endif # SOC_SERIES_MUSCA_B1
```

## soc/arm/arm/musca_b1/Kconfig.series
```kconfig
#
# Copyright (c) 2019 Linaro Limited
#
# SPDX-License-Identifier: Apache-2.0
#

config SOC_SERIES_MUSCA_B1
	bool "arm v2m MUSCA B1 MCU Series"
	select SOC_FAMILY_ARM
	select BUILD_OUTPUT_HEX
	help
	  Enable support for arm V2M Musca B1 MCU Series
```

## soc/arm/arm/musca_b1/Kconfig.soc
```kconfig
# Copyright (c) 2019 Linaro Limited
# SPDX-License-Identifier: Apache-2.0

config SOC_V2M_MUSCA_B1
	bool
	select CPU_CORTEX_M33
	select CPU_HAS_ARM_SAU
	select CPU_HAS_ARM_MPU
	select CPU_CORTEX_M_HAS_DWT
	help
	  ARM Cortex-M33 SMM-SSE-200 on V2M-MUSCA-B1
```

## soc/arm/arm/musca_s1/Kconfig.defconfig.series
```kconfig
# Copyright (c) 2019-2020 Linaro Limited
# SPDX-License-Identifier: Apache-2.0

if SOC_SERIES_MUSCA_S1

config SOC_SERIES
	default "musca_s1"

config SYS_CLOCK_HW_CYCLES_PER_SEC
	default 50000000

source "soc/arm/arm/musca_s1/Kconfig.defconfig.musca_s1"

endif # SOC_SERIES_MUSCA_S1
```

## soc/arm/arm/musca_s1/Kconfig.series
```kconfig
# Copyright (c) 2019-2020 Linaro Limited
# SPDX-License-Identifier: Apache-2.0

config SOC_SERIES_MUSCA_S1
	bool
	select ARM
	select SOC_FAMILY_ARM
	select BUILD_OUTPUT_HEX
	help
	  Enable support for Arm V2M Musca-S1 MCU Series
```

## soc/arm/arm/musca_s1/Kconfig.soc
```kconfig
# Copyright (c) 2019-2020 Linaro Limited
# SPDX-License-Identifier: Apache-2.0

choice
	prompt "ARM Musca-S1 SoCs"
	depends on SOC_SERIES_MUSCA_S1

config SOC_V2M_MUSCA_S1
	bool "ARM Cortex-M33 SMM-SSE-200 on V2M-MUSCA-S1"
	select CPU_CORTEX_M33
	select CPU_HAS_ARM_SAU
	select CPU_HAS_ARM_MPU
	select CPU_CORTEX_M_HAS_DWT

endchoice
```

## soc/arm/aspeed/Kconfig
```kconfig
# SPDX-License-Identifier: Apache-2.0
#
# Copyright (c) 2021 ASPEED Technology Inc.

config SOC_FAMILY_ASPEED
	select PLATFORM_SPECIFIC_INIT
	bool

if SOC_FAMILY_ASPEED

config SOC_FAMILY
	string
	default "aspeed"

source "soc/arm/aspeed/*/Kconfig.soc"

endif # SOC_FAMILY_ASPEED
```

## soc/arm/aspeed/Kconfig.soc
```kconfig
# SPDX-License-Identifier: Apache-2.0
#
# Copyright (c) 2021 ASPEED Technology Inc.

source "soc/arm/aspeed/*/Kconfig.series"
```

## soc/arm/aspeed/ast10x0/Kconfig.defconfig.series
```kconfig
# SPDX-License-Identifier: Apache-2.0
#
# Copyright (c) 2021 ASPEED Technology Inc.

if SOC_SERIES_AST10X0

source "soc/arm/aspeed/ast10x0/Kconfig.defconfig.ast10*0"

config SOC_SERIES
	default "ast10x0"

config ICACHE_LINE_SIZE
	default 32

config DCACHE_LINE_SIZE
	default 32

choice CACHE_TYPE
	default EXTERNAL_CACHE
endchoice

endif # SOC_SERIES_AST10X0
```

## soc/arm/aspeed/ast10x0/Kconfig.series
```kconfig
# SPDX-License-Identifier: Apache-2.0
#
# Copyright (c) 2021 ASPEED Technology Inc.

config SOC_SERIES_AST10X0
	bool "Aspeed AST10X0 Series"
	select ARM
	select CPU_CORTEX_M4
	select CPU_HAS_FPU
	select CPU_HAS_ARM_MPU
	select SOC_FAMILY_ASPEED
	select SYSCON
	select CACHE
	select CPU_HAS_DCACHE
	select CPU_HAS_ICACHE
	select CACHE_MANAGEMENT
	select CACHE_ASPEED
	help
	  Enable support for ASPEED AST10X0 series
```

## soc/arm/aspeed/ast10x0/Kconfig.soc
```kconfig
# SPDX-License-Identifier: Apache-2.0
#
# Copyright (c) 2021 ASPEED Technology Inc.

choice
	prompt "ASPEED AST10X0 Selection"
	depends on SOC_SERIES_AST10X0

config SOC_AST1030
	bool "AST1030"

endchoice

config SRAM_NC_SIZE
	int "noncached SRAM Size in kB"
	help
	  The non-cached SRAM size in kB. The default value comes from reg[1]
	  of /chosen/zephyr,sram in devicetree. The user should generally avoid
	  changing it via menuconfig or in configuration files.

config SRAM_NC_BASE_ADDRESS
	hex "noncached SRAM Base Address"
	help
	  The non-cached SRAM base address. The default value comes from from
	  reg[1] of /chosen/zephyr,sram in devicetree. The user should
	  generally avoid changing it via menuconfig or in configuration files.
```

## soc/arm/atmel_sam/Kconfig
```kconfig
# Atmel SAM MCU family configuration options

# Copyright (c) 2016 Piotr Mienkowski
# SPDX-License-Identifier: Apache-2.0

config SOC_FAMILY_SAM
	bool
	select HAS_SEGGER_RTT

if SOC_FAMILY_SAM

config SOC_FAMILY
	string
	default "atmel_sam"

# Select SoC Part No. and configuration options
source "soc/arm/atmel_sam/*/Kconfig.soc"

endif # SOC_FAMILY_SAM
```

## soc/arm/atmel_sam/Kconfig.defconfig
```kconfig
# Atmel SAM MCU family default configuration options

# Copyright (c) 2016 Piotr Mienkowski
# SPDX-License-Identifier: Apache-2.0

source "soc/arm/atmel_sam/*/Kconfig.defconfig.series"

if SOC_FAMILY_SAM

config SYS_CLOCK_HW_CYCLES_PER_SEC
	default $(dt_node_int_prop_int,/cpus/cpu@0,clock-frequency)

config PINCTRL
	default y

config WATCHDOG
	default y

endif # SOC_FAMILY_SAM
```

## soc/arm/atmel_sam/Kconfig.soc
```kconfig
# Kconfig - Atmel SAM MCU series selection
#
# Copyright (c) 2016 Piotr Mienkowski
# SPDX-License-Identifier: Apache-2.0
#

source "soc/arm/atmel_sam/*/Kconfig.series"
```

## soc/arm/atmel_sam/sam3u/Kconfig.defconfig.series
```kconfig
# Atmel SAM3U MCU series configuration options

# Copyright (c) 2023 Chen Xingyu <hi@xingrz.me>
# Copyright (c) 2017 Justin Watson
# Copyright (c) 2016 Intel Corporation.
# Copyright (c) 2014-2015 Wind River Systems, Inc.
# SPDX-License-Identifier: Apache-2.0

if SOC_SERIES_SAM3U

config SOC_SERIES
	default "sam3u"

config SOC_PART_NUMBER
	default "sam3u1c" if SOC_PART_NUMBER_SAM3U1C
	default "sam3u1e" if SOC_PART_NUMBER_SAM3U1E
	default "sam3u2c" if SOC_PART_NUMBER_SAM3U2C
	default "sam3u2e" if SOC_PART_NUMBER_SAM3U2E
	default "sam3u4c" if SOC_PART_NUMBER_SAM3U4C
	default "sam3u4e" if SOC_PART_NUMBER_SAM3U4E

#
# SAM3U family has total 30 peripherals capable of
# generating interrupts.
#
config NUM_IRQS
	default 30

endif # SOC_SERIES_SAM3U
```
