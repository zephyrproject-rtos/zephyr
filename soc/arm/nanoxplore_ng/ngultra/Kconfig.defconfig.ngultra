## soc/arm/nordic_nrf/nrf52/Kconfig.defconfig.series
```kconfig
# Nordic Semiconductor nRF52 MCU line

# Copyright (c) 2016-2018 Nordic Semiconductor ASA
# SPDX-License-Identifier: Apache-2.0

if SOC_SERIES_NRF52X

source "soc/arm/nordic_nrf/nrf52/Kconfig.defconfig.nrf52*"

config SOC_SERIES
	default "nrf52"

# If the kernel has timer support, enable the timer
config NRF_RTC_TIMER
	default y if SYS_CLOCK_EXISTS

endif # SOC_SERIES_NRF52X
```

## soc/arm/nordic_nrf/nrf52/Kconfig.series
```kconfig
# Nordic Semiconductor nRF52 MCU line

# Copyright (c) 2016-2018 Nordic Semiconductor ASA
# SPDX-License-Identifier: Apache-2.0

config SOC_SERIES_NRF52X
	bool "Nordic Semiconductor nRF52 series MCU"
	select ARM
	select SOC_COMPATIBLE_NRF52X
	select CPU_CORTEX_M4
	select CPU_HAS_ARM_MPU
	select SOC_FAMILY_NRF
	select XIP
	select HAS_NRFX
	select HAS_NORDIC_DRIVERS
	select HAS_SEGGER_RTT
	help
	  Enable support for NRF52 MCU series
```
