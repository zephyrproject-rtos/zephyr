## soc/arm/nordic_nrf/Kconfig.peripherals
```kconfig
# Nordic Semiconductor nRFx MCU peripherals list.

# Copyright (c) 2018 Nordic Semiconductor ASA
# SPDX-License-Identifier: Apache-2.0

config HAS_HW_NRF_ACL
	def_bool $(dt_compat_enabled,$(DT_COMPAT_NORDIC_NRF_ACL))

config HAS_HW_NRF_ADC
	def_bool $(dt_compat_enabled,$(DT_COMPAT_NORDIC_NRF_ADC))

config HAS_HW_NRF_BPROT
	def_bool $(dt_compat_enabled,$(DT_COMPAT_NORDIC_NRF_BPROT))

config HAS_HW_NRF_CC310
	def_bool $(dt_compat_enabled,$(DT_COMPAT_ARM_CRYPTOCELL_310))

config HAS_HW_NRF_CC312
	def_bool $(dt_compat_enabled,$(DT_COMPAT_ARM_CRYPTOCELL_312))

config HAS_HW_NRF_CCM
	def_bool $(dt_compat_enabled,$(DT_COMPAT_NORDIC_NRF_CCM))

config HAS_HW_NRF_CCM_LFLEN_8BIT
	def_bool $(dt_nodelabel_bool_prop,ccm,length-field-length-8-bits)

config HAS_HW_NRF_CCM_HEADERMASK
	def_bool $(dt_nodelabel_bool_prop,ccm,headermask-supported)

config HAS_HW_NRF_CLOCK
	def_bool $(dt_compat_enabled,$(DT_COMPAT_NORDIC_NRF_CLOCK))

config HAS_HW_NRF_COMP
	def_bool $(dt_compat_enabled,$(DT_COMPAT_NORDIC_NRF_COMP))

config HAS_HW_NRF_CTRLAP
	def_bool $(dt_compat_enabled,$(DT_COMPAT_NORDIC_NRF_CTRLAPPERI))

config HAS_HW_NRF_DCNF
	def_bool $(dt_compat_enabled,$(DT_COMPAT_NORDIC_NRF_DCNF))

config HAS_HW_NRF_DPPIC
	def_bool $(dt_compat_enabled,$(DT_COMPAT_NORDIC_NRF_DPPIC))

config HAS_HW_NRF_ECB
	def_bool $(dt_compat_enabled,$(DT_COMPAT_NORDIC_NRF_ECB))

config HAS_HW_NRF_EGU0
	def_bool $(dt_nodelabel_enabled_with_compat,egu0,$(DT_COMPAT_NORDIC_NRF_EGU))

config HAS_HW_NRF_EGU1
	def_bool $(dt_nodelabel_enabled_with_compat,egu1,$(DT_COMPAT_NORDIC_NRF_EGU))

config HAS_HW_NRF_EGU2
	def_bool $(dt_nodelabel_enabled_with_compat,egu2,$(DT_COMPAT_NORDIC_NRF_EGU))

config HAS_HW_NRF_EGU3
	def_bool $(dt_nodelabel_enabled_with_compat,egu3,$(DT_COMPAT_NORDIC_NRF_EGU))

config HAS_HW_NRF_EGU4
	def_bool $(dt_nodelabel_enabled_with_compat,egu4,$(DT_COMPAT_NORDIC_NRF_EGU))

config HAS_HW_NRF_EGU5
	def_bool $(dt_nodelabel_enabled_with_compat,egu5,$(DT_COMPAT_NORDIC_NRF_EGU))

config HAS_HW_NRF_GPIO0
	def_bool $(dt_nodelabel_enabled_with_compat,gpio0,$(DT_COMPAT_NORDIC_NRF_GPIO))

config HAS_HW_NRF_GPIO1
	def_bool $(dt_nodelabel_enabled_with_compat,gpio1,$(DT_COMPAT_NORDIC_NRF_GPIO))

config HAS_HW_NRF_GPIOTE
	def_bool $(dt_compat_enabled,$(DT_COMPAT_NORDIC_NRF_GPIOTE))

config HAS_HW_NRF_I2S0
	def_bool $(dt_nodelabel_enabled_with_compat,i2s0,$(DT_COMPAT_NORDIC_NRF_I2S))

config HAS_HW_NRF_IPC
	def_bool $(dt_compat_enabled,$(DT_COMPAT_NORDIC_NRF_IPC))

config HAS_HW_NRF_KMU
	def_bool $(dt_compat_enabled,$(DT_COMPAT_NORDIC_NRF_KMU))

config HAS_HW_NRF_LPCOMP
	def_bool $(dt_compat_enabled,$(DT_COMPAT_NORDIC_NRF_LPCOMP))

config HAS_HW_NRF_MPU
	def_bool $(dt_compat_enabled,$(DT_COMPAT_NORDIC_NRF_MPU))

config HAS_HW_NRF_MUTEX
	def_bool $(dt_compat_enabled,$(DT_COMPAT_NORDIC_NRF_MUTEX))

config HAS_HW_NRF_MWU
	def_bool $(dt_compat_enabled,$(DT_COMPAT_NORDIC_NRF_MWU))

config HAS_HW_NRF_NFCT
	def_bool $(dt_compat_enabled,$(DT_COMPAT_NORDIC_NRF_NFCT))

config HAS_HW_NRF_NVMC_PE
	def_bool $(dt_nodelabel_bool_prop,flash_controller,partial-erase)

config HAS_HW_NRF_OSCILLATORS
	def_bool $(dt_compat_enabled,$(DT_COMPAT_NORDIC_NRF_OSCILLATORS))

config HAS_HW_NRF_PDM
	def_bool $(dt_compat_enabled,$(DT_COMPAT_NORDIC_NRF_PDM))

config HAS_HW_NRF_POWER
	def_bool $(dt_compat_enabled,$(DT_COMPAT_NORDIC_NRF_POWER))

config HAS_HW_NRF_PPI
	def_bool $(dt_compat_enabled,$(DT_COMPAT_NORDIC_NRF_PPI))

config HAS_HW_NRF_PWM0
	def_bool $(dt_nodelabel_enabled_with_compat,pwm0,$(DT_COMPAT_NORDIC_NRF_PWM))

config HAS_HW_NRF_PWM1
	def_bool $(dt_nodelabel_enabled_with_compat,pwm1,$(DT_COMPAT_NORDIC_NRF_PWM))

config HAS_HW_NRF_PWM2
	def_bool $(dt_nodelabel_enabled_with_compat,pwm2,$(DT_COMPAT_NORDIC_NRF_PWM))

config HAS_HW_NRF_PWM3
	def_bool $(dt_nodelabel_enabled_with_compat,pwm3,$(DT_COMPAT_NORDIC_NRF_PWM))

config HAS_HW_NRF_QDEC0
	def_bool $(dt_nodelabel_enabled_with_compat,qdec0,$(DT_COMPAT_NORDIC_NRF_QDEC))

config HAS_HW_NRF_QDEC1
	def_bool $(dt_nodelabel_enabled_with_compat,qdec1,$(DT_COMPAT_NORDIC_NRF_QDEC))

config HAS_HW_NRF_QSPI
	def_bool $(dt_compat_enabled,$(DT_COMPAT_NORDIC_NRF_QSPI))

config HAS_HW_NRF_RADIO_BLE_2M
	def_bool $(dt_nodelabel_bool_prop,radio,ble-2mbps-supported)

config HAS_HW_NRF_RADIO_BLE_CODED
	def_bool $(dt_nodelabel_bool_prop,radio,ble-coded-phy-supported)

config HAS_HW_NRF_RADIO_DFE
	def_bool $(dt_nodelabel_bool_prop,radio,dfe-supported)

config HAS_HW_NRF_RADIO_IEEE802154
	def_bool $(dt_nodelabel_bool_prop,radio,ieee802154-supported)

config HAS_HW_NRF_RADIO_TX_PWR_HIGH
	def_bool $(dt_nodelabel_bool_prop,radio,tx-high-power-supported)

config HAS_HW_NRF_REGULATORS
	def_bool $(dt_compat_enabled,$(DT_COMPAT_NORDIC_NRF_REGULATORS))

config HAS_HW_NRF_RESET
	def_bool $(dt_compat_enabled,$(DT_COMPAT_NORDIC_NRF_RESET))

config HAS_HW_NRF_RNG
	def_bool $(dt_compat_enabled,$(DT_COMPAT_NORDIC_NRF_RNG))

config HAS_HW_NRF_RTC0
	def_bool $(dt_nodelabel_enabled_with_compat,rtc0,$(DT_COMPAT_NORDIC_NRF_RTC))

config HAS_HW_NRF_RTC1
	def_bool $(dt_nodelabel_enabled_with_compat,rtc1,$(DT_COMPAT_NORDIC_NRF_RTC))

config HAS_HW_NRF_RTC2
	def_bool $(dt_nodelabel_enabled_with_compat,rtc2,$(DT_COMPAT_NORDIC_NRF_RTC))

config HAS_HW_NRF_SAADC
	def_bool $(dt_compat_enabled,$(DT_COMPAT_NORDIC_NRF_SAADC))

config HAS_HW_NRF_SPI0
	def_bool $(dt_nodelabel_enabled_with_compat,spi0,$(DT_COMPAT_NORDIC_NRF_SPI))

config HAS_HW_NRF_SPI1
	def_bool $(dt_nodelabel_enabled_with_compat,spi1,$(DT_COMPAT_NORDIC_NRF_SPI))

config HAS_HW_NRF_SPI2
	def_bool $(dt_nodelabel_enabled_with_compat,spi2,$(DT_COMPAT_NORDIC_NRF_SPI))

config HAS_HW_NRF_SPIM0
	def_bool $(dt_nodelabel_enabled_with_compat,spi0,$(DT_COMPAT_NORDIC_NRF_SPIM))

config HAS_HW_NRF_SPIM1
	def_bool $(dt_nodelabel_enabled_with_compat,spi1,$(DT_COMPAT_NORDIC_NRF_SPIM))

config HAS_HW_NRF_SPIM2
	def_bool $(dt_nodelabel_enabled_with_compat,spi2,$(DT_COMPAT_NORDIC_NRF_SPIM))

config HAS_HW_NRF_SPIM3
	def_bool $(dt_nodelabel_enabled_with_compat,spi3,$(DT_COMPAT_NORDIC_NRF_SPIM))

config HAS_HW_NRF_SPIM4
	def_bool $(dt_nodelabel_enabled_with_compat,spi4,$(DT_COMPAT_NORDIC_NRF_SPIM))

config HAS_HW_NRF_SPIS0
	def_bool $(dt_nodelabel_enabled_with_compat,spi0,$(DT_COMPAT_NORDIC_NRF_SPIS))

config HAS_HW_NRF_SPIS1
	def_bool $(dt_nodelabel_enabled_with_compat,spi1,$(DT_COMPAT_NORDIC_NRF_SPIS))

config HAS_HW_NRF_SPIS2
	def_bool $(dt_nodelabel_enabled_with_compat,spi2,$(DT_COMPAT_NORDIC_NRF_SPIS))

config HAS_HW_NRF_SPIS3
	def_bool $(dt_nodelabel_enabled_with_compat,spi3,$(DT_COMPAT_NORDIC_NRF_SPIS))

config HAS_HW_NRF_SPU
	def_bool $(dt_compat_enabled,$(DT_COMPAT_NORDIC_NRF_SPU))

config HAS_HW_NRF_SWI0
	def_bool $(dt_nodelabel_enabled_with_compat,swi0,$(DT_COMPAT_NORDIC_NRF_SWI))

config HAS_HW_NRF_SWI1
	def_bool $(dt_nodelabel_enabled_with_compat,swi1,$(DT_COMPAT_NORDIC_NRF_SWI))

config HAS_HW_NRF_SWI2
	def_bool $(dt_nodelabel_enabled_with_compat,swi2,$(DT_COMPAT_NORDIC_NRF_SWI))

config HAS_HW_NRF_SWI3
	def_bool $(dt_nodelabel_enabled_with_compat,swi3,$(DT_COMPAT_NORDIC_NRF_SWI))

config HAS_HW_NRF_SWI4
	def_bool $(dt_nodelabel_enabled_with_compat,swi4,$(DT_COMPAT_NORDIC_NRF_SWI))

config HAS_HW_NRF_SWI5
	def_bool $(dt_nodelabel_enabled_with_compat,swi5,$(DT_COMPAT_NORDIC_NRF_SWI))

config HAS_HW_NRF_TEMP
	def_bool $(dt_compat_enabled,$(DT_COMPAT_NORDIC_NRF_TEMP))

config HAS_HW_NRF_TIMER0
	def_bool $(dt_nodelabel_enabled_with_compat,timer0,$(DT_COMPAT_NORDIC_NRF_TIMER))

config HAS_HW_NRF_TIMER1
	def_bool $(dt_nodelabel_enabled_with_compat,timer1,$(DT_COMPAT_NORDIC_NRF_TIMER))

config HAS_HW_NRF_TIMER2
	def_bool $(dt_nodelabel_enabled_with_compat,timer2,$(DT_COMPAT_NORDIC_NRF_TIMER))

config HAS_HW_NRF_TIMER3
	def_bool $(dt_nodelabel_enabled_with_compat,timer3,$(DT_COMPAT_NORDIC_NRF_TIMER))

config HAS_HW_NRF_TIMER4
	def_bool $(dt_nodelabel_enabled_with_compat,timer4,$(DT_COMPAT_NORDIC_NRF_TIMER))

config HAS_HW_NRF_TWI0
	def_bool $(dt_nodelabel_enabled_with_compat,i2c0,$(DT_COMPAT_NORDIC_NRF_TWI))

config HAS_HW_NRF_TWI1
	def_bool $(dt_nodelabel_enabled_with_compat,i2c1,$(DT_COMPAT_NORDIC_NRF_TWI))

config HAS_HW_NRF_TWIM0
	def_bool $(dt_nodelabel_enabled_with_compat,i2c0,$(DT_COMPAT_NORDIC_NRF_TWIM))

config HAS_HW_NRF_TWIM1
	def_bool $(dt_nodelabel_enabled_with_compat,i2c1,$(DT_COMPAT_NORDIC_NRF_TWIM))

config HAS_HW_NRF_TWIM2
	def_bool $(dt_nodelabel_enabled_with_compat,i2c2,$(DT_COMPAT_NORDIC_NRF_TWIM))

config HAS_HW_NRF_TWIM3
	def_bool $(dt_nodelabel_enabled_with_compat,i2c3,$(DT_COMPAT_NORDIC_NRF_TWIM))

config HAS_HW_NRF_TWIS0
	def_bool $(dt_nodelabel_enabled_with_compat,i2c0,$(DT_COMPAT_NORDIC_NRF_TWIS))

config HAS_HW_NRF_TWIS1
	def_bool $(dt_nodelabel_enabled_with_compat,i2c1,$(DT_COMPAT_NORDIC_NRF_TWIS))

config HAS_HW_NRF_TWIS2
	def_bool $(dt_nodelabel_enabled_with_compat,i2c2,$(DT_COMPAT_NORDIC_NRF_TWIS))

config HAS_HW_NRF_TWIS3
	def_bool $(dt_nodelabel_enabled_with_compat,i2c3,$(DT_COMPAT_NORDIC_NRF_TWIS))

config HAS_HW_NRF_UART0
	def_bool $(dt_nodelabel_enabled_with_compat,uart0,$(DT_COMPAT_NORDIC_NRF_UART))

config HAS_HW_NRF_UARTE0
	def_bool $(dt_nodelabel_enabled_with_compat,uart0,$(DT_COMPAT_NORDIC_NRF_UARTE))

config HAS_HW_NRF_UARTE1
	def_bool $(dt_nodelabel_enabled_with_compat,uart1,$(DT_COMPAT_NORDIC_NRF_UARTE))

config HAS_HW_NRF_UARTE2
	def_bool $(dt_nodelabel_enabled_with_compat,uart2,$(DT_COMPAT_NORDIC_NRF_UARTE))

config HAS_HW_NRF_UARTE3
	def_bool $(dt_nodelabel_enabled_with_compat,uart3,$(DT_COMPAT_NORDIC_NRF_UARTE))

config HAS_HW_NRF_USBD
	def_bool $(dt_compat_enabled,$(DT_COMPAT_NORDIC_NRF_USBD))

config HAS_HW_NRF_USBREG
	def_bool $(dt_compat_enabled,$(DT_COMPAT_NORDIC_NRF_USBREG))

config HAS_HW_NRF_VMC
	def_bool $(dt_compat_enabled,$(DT_COMPAT_NORDIC_NRF_VMC))

config HAS_HW_NRF_WDT0
	def_bool $(dt_nodelabel_enabled_with_compat,wdt0,$(DT_COMPAT_NORDIC_NRF_WDT))

config HAS_HW_NRF_WDT1
	def_bool $(dt_nodelabel_enabled_with_compat,wdt1,$(DT_COMPAT_NORDIC_NRF_WDT))
```

## soc/arm/nordic_nrf/Kconfig.soc
```kconfig
# Nordic Semiconductor nRFx MCU line

# Copyright (c) 2016-2018 Nordic Semiconductor ASA
# SPDX-License-Identifier: Apache-2.0

source "soc/arm/nordic_nrf/*/Kconfig.series"
```

## soc/arm/nordic_nrf/Kconfig.soc.v2
```kconfig
# Copyright (c) 2022 Nordic Semiconductor ASA

# SPDX-License-Identifier: Apache-2.0

config SOC_SERIES
	default "nrf52"
	depends on SOC_SERIES_NRF52X

config SOC_FAMILY_NRF
	bool

config SOC_FAMILY
	string
	default "nordic_nrf"
	depends on SOC_FAMILY_NRF

config SOC_SERIES_NRF51X
	bool
	help
	  Enable support for NRF51 MCU series

config SOC_SERIES_NRF52X
	bool
	select SOC_FAMILY_NRF
	help
	  Enable support for NRF52 MCU series

config SOC_SERIES_NRF53X
	bool
	help
	 Enable support for NRF53 MCU series

config SOC_SERIES_NRF91X
	bool
	help
	  Enable support for NRF91 MCU series

rsource "*/Kconfig.soc.v2"
```

## soc/arm/nordic_nrf/nrf51/Kconfig.defconfig.nrf51822_QFAA
```kconfig
# Nordic Semiconductor nRF51822 MCU

# Copyright (c) 2016 Linaro Limited
# Copyright (c) 2016 Nordic Semiconductor ASA
# SPDX-License-Identifier: Apache-2.0

if SOC_NRF51822_QFAA

config SOC
	default "nRF51822_QFAA"

endif # SOC_NRF51822_QFAA
```

## soc/arm/nordic_nrf/nrf51/Kconfig.defconfig.nrf51822_QFAB
```kconfig
# Nordic Semiconductor nRF51822 MCU

# Copyright (c) 2016 Linaro Limited
# Copyright (c) 2016 Nordic Semiconductor ASA
# SPDX-License-Identifier: Apache-2.0

config SOC
	default "nRF51822_QFAB"
	depends on SOC_NRF51822_QFAB
```

## soc/arm/nordic_nrf/nrf51/Kconfig.defconfig.nrf51822_QFAC
```kconfig
# Nordic Semiconductor nRF51822 MCU

# Copyright (c) 2016 Linaro Limited
# Copyright (c) 2016 Nordic Semiconductor ASA
# SPDX-License-Identifier: Apache-2.0

config SOC
	default "nRF51822_QFAC"
	depends on SOC_NRF51822_QFAC
```

## soc/arm/nordic_nrf/nrf51/Kconfig.defconfig.series
```kconfig
# Nordic Semiconductor nRF51 MCU line

# Copyright (c) 2016 Linaro Limited
# Copyright (c) 2018 Nordic Semiconductor ASA
# SPDX-License-Identifier: Apache-2.0

if SOC_SERIES_NRF51X

source "soc/arm/nordic_nrf/nrf51/Kconfig.defconfig.nrf51*"

config SOC_SERIES
	default "nrf51"

config NUM_IRQS
	default 26

# If the kernel has timer support, enable the timer
config NRF_RTC_TIMER
	default y if SYS_CLOCK_EXISTS

endif # SOC_SERIES_NRF51X
```

## soc/arm/nordic_nrf/nrf51/Kconfig.series
```kconfig
# Nordic Semiconductor nRF51 MCU line

# Copyright (c) 2016 Linaro Limited
# Copyright (c) 2018 Nordic Semiconductor ASA
# SPDX-License-Identifier: Apache-2.0

config SOC_SERIES_NRF51X
	bool "Nordic Semiconductor nRF51 series MCU"
	select ARM
	select CPU_CORTEX_M0
	select SOC_FAMILY_NRF
	select XIP
	select HAS_NRFX
	select HAS_SEGGER_RTT if ZEPHYR_SEGGER_MODULE
	select HAS_POWEROFF
	help
	  Enable support for NRF51 MCU series
```

## soc/arm/nordic_nrf/nrf51/Kconfig.soc
```kconfig
# Nordic Semiconductor nRF51 MCU line

# Copyright (c) 2016 Linaro Limited
# SPDX-License-Identifier: Apache-2.0

choice
	prompt "nRF51x MCU Selection"
	depends on SOC_SERIES_NRF51X

config SOC_NRF51822_QFAA
	bool "NRF51822_QFAA"

config SOC_NRF51822_QFAB
	bool "NRF51822_QFAB"

config SOC_NRF51822_QFAC
	bool "NRF51822_QFAC"

endchoice
```

## soc/arm/nordic_nrf/nrf52/Kconfig.defconfig.nrf52805_CAAA
```kconfig
# Nordic Semiconductor nRF52805 MCU

# Copyright (c) 2020 Nordic Semiconductor ASA
# SPDX-License-Identifier: Apache-2.0

if SOC_NRF52805_CAAA

config SOC
	default "nRF52805_CAAA"

config NUM_IRQS
	default 26

endif # SOC_NRF52805_CAAA
```

## soc/arm/nordic_nrf/nrf52/Kconfig.defconfig.nrf52810_QFAA
```kconfig
# Kconfig.defconfig.nrf52810 - Nordic Semiconductor nRF52810 MCU
#
# Copyright (c) 2018 Nordic Semiconductor ASA
#
# SPDX-License-Identifier: Apache-2.0
#


if SOC_NRF52810_QFAA

config SOC
	default "nRF52810_QFAA"

config NUM_IRQS
	default 30

endif # SOC_NRF52810_QFAA
```

## soc/arm/nordic_nrf/nrf52/Kconfig.defconfig.nrf52811_QFAA
```kconfig
# Nordic Semiconductor nRF52811 MCU

# Copyright (c) 2019 Nordic Semiconductor ASA
# SPDX-License-Identifier: Apache-2.0

if SOC_NRF52811_QFAA

config SOC
	default "nRF52811_QFAA"

config NUM_IRQS
	default 30

config NET_CONFIG_IEEE802154_DEV_NAME
	default IEEE802154_NRF5_DRV_NAME

config IEEE802154_NRF5
	default IEEE802154

endif # SOC_NRF52811_QFAA
```

## soc/arm/nordic_nrf/nrf52/Kconfig.defconfig.nrf52820_QDAA
```kconfig
# Nordic Semiconductor nRF52820 MCU

# Copyright (c) 2020 Nordic Semiconductor ASA
# SPDX-License-Identifier: Apache-2.0

if SOC_NRF52820_QDAA

config SOC
	string
	default "nRF52820_QDAA"

config NUM_IRQS
	int
	default 40

config IEEE802154_NRF5
	default IEEE802154

endif # SOC_NRF52820_QDAA
```

## soc/arm/nordic_nrf/nrf52/Kconfig.defconfig.nrf52832_CIAA
```kconfig
# Kconfig.defconfig.nrf52832 - Nordic Semiconductor nRF52832 MCU
#
# Copyright (c) 2019 Nordic Semiconductor ASA
#
# SPDX-License-Identifier: Apache-2.0
#


if SOC_NRF52832_CIAA

config SOC
	default "nRF52832_CIAA"

config NUM_IRQS
	default 39

endif # SOC_NRF52832_CIAA
```

## soc/arm/nordic_nrf/nrf52/Kconfig.defconfig.nrf52832_QFAA
```kconfig
# Nordic Semiconductor nRF52832 MCU

# Copyright (c) 2016 Nordic Semiconductor ASA
# SPDX-License-Identifier: Apache-2.0

if SOC_NRF52832_QFAA

config SOC
	default "nRF52832_QFAA"

config NUM_IRQS
	default 39

config NRF52_ANOMALY_132_WORKAROUND
	bool
	default y

endif # SOC_NRF52832_QFAA
```

## soc/arm/nordic_nrf/nrf52/Kconfig.defconfig.nrf52833_QIAA
```kconfig
# Nordic Semiconductor nRF52833 MCU

# Copyright (c) 2019 Nordic Semiconductor ASA
# SPDX-License-Identifier: Apache-2.0

if SOC_NRF52833_QIAA

config SOC
	string
	default "nRF52833_QIAA"

config NUM_IRQS
	int
	default 48

config NET_CONFIG_IEEE802154_DEV_NAME
	default "IEEE802154_nrf5"

endif # SOC_NRF52833_QIAA
```

## soc/arm/nordic_nrf/nrf52/Kconfig.defconfig.nrf52840_QIAA
```kconfig
# Nordic Semiconductor nRF52840 MCU

# Copyright (c) 2016 Nordic Semiconductor ASA
# SPDX-License-Identifier: Apache-2.0

if SOC_NRF52840_QIAA

config SOC
	default "nRF52840_QIAA"

config NUM_IRQS
	default 48

endif # SOC_NRF52840_QIAA
```
