## soc/arm/st_stm32/stm32f3/Kconfig.defconfig.series
```kconfig
# ST Microelectronics STM32F3 MCU line

# Copyright (c) 2016 RnDity Sp. z o.o.
# SPDX-License-Identifier: Apache-2.0

# Kconfig symbols common to STM32F3 series

if SOC_SERIES_STM32F3X

source "soc/arm/st_stm32/stm32f3/Kconfig.defconfig.stm32f3*"

config SOC_SERIES
	default "stm32f3"

endif # SOC_SERIES_STM32F3X
```

## soc/arm/st_stm32/stm32f3/Kconfig.defconfig.stm32f302x8
```kconfig
# ST Microelectronics STM32F302X8 MCU

# Copyright (c) 2018 Seitz & Associates
# SPDX-License-Identifier: Apache-2.0

if SOC_STM32F302X8

config SOC
	default "stm32f302x8"

config NUM_IRQS
	default 82

config GPIO_STM32_PORTF
	default y
	depends on GPIO_STM32

endif # SOC_STM32F302X8
```

## soc/arm/st_stm32/stm32f3/Kconfig.defconfig.stm32f303xc
```kconfig
# ST Microelectronics STM32F303XC MCU

# Copyright (c) 2016 RnDity Sp. z o.o.
# SPDX-License-Identifier: Apache-2.0

if SOC_STM32F303XC

config SOC
	default "stm32f303xc"

config NUM_IRQS
	default 82

endif # SOC_STM32F303XC
```

## soc/arm/st_stm32/stm32f3/Kconfig.defconfig.stm32f303xe
```kconfig
# ST Microelectronics STM32F303XC MCU

# Copyright (c) 2020 Paul M. Bendixen
# SPDX-License-Identifier: Apache-2.0

if SOC_STM32F303XE

config SOC
	default "stm32f303xe"

config NUM_IRQS
	default 85

endif # SOC_STM32F303XE
```

## soc/arm/st_stm32/stm32f3/Kconfig.defconfig.stm32f334x8
```kconfig
# Kconfig - ST Microelectronics STM32F334X8 MCU
#
# Copyright (c) 2016 RnDity Sp. z o.o.
#
# SPDX-License-Identifier: Apache-2.0
#

if SOC_STM32F334X8

config SOC
	default "stm32f334x8"

config NUM_IRQS
	default 82

if GPIO_STM32

config GPIO_STM32_PORTF
	default y

endif # GPIO_STM32

endif # SOC_STM32F334X8
```

## soc/arm/st_stm32/stm32f3/Kconfig.series
```kconfig
# Kconfig - ST Microelectronics STM32F3 MCU series
#
# Copyright (c) 2016 RnDity Sp. z o.o.
#
# SPDX-License-Identifier: Apache-2.0
#

config SOC_SERIES_STM32F3X
	bool "STM32F3x Series MCU"
	select CPU_CORTEX_M4
	select SOC_FAMILY_STM32
	select CPU_HAS_FPU
	select HAS_STM32CUBE
	select HAS_SWO
	help
	 Enable support for STM32F3 MCU series
```

## soc/arm/st_stm32/stm32f3/Kconfig.soc
```kconfig
# ST Microelectronics STM32F3 MCU line

# Copyright (c) 2016 RnDity Sp. z o.o.
# SPDX-License-Identifier: Apache-2.0

config SOC_STM32F302X8
	bool
	help
	  STM32F302X8

config SOC_STM32F303X8
	bool
	help
	  STM32F303X8

config SOC_STM32F303XC
	bool
	select CPU_HAS_ARM_MPU
	help
	  STM32F303XC

config SOC_STM32F303XE
	bool
	select CPU_HAS_ARM_MPU
	help
	  STM32F303XE

config SOC_STM32F334X8
	bool
	help
	  STM32F334X8

config SOC_STM32F373XC
	bool
	select CPU_HAS_ARM_MPU
	help
	  STM32F373XC
```

## soc/arm/st_stm32/stm32f4/Kconfig.defconfig.series
```kconfig
# ST Microelectronics STM32F4 MCU line

# Copyright (c) 2016 Linaro Limited
# SPDX-License-Identifier: Apache-2.0

# Kconfig symbols common to STM32F4 series

if SOC_SERIES_STM32F4X

source "soc/arm/st_stm32/stm32f4/Kconfig.defconfig.stm32f4*"

config SOC_SERIES
	default "stm32f4"

# adjust the fallback because of the LSI oscaillator characteristics
config TASK_WDT_HW_FALLBACK_DELAY
	depends on TASK_WDT_HW_FALLBACK
	default 200

if PM

config COUNTER
	default y

config COUNTER_RTC_STM32_SUBSECONDS
	default y if DT_HAS_ST_STM32_RTC_ENABLED

config IDLE_STACK_SIZE
	default 512

endif # PM

endif # SOC_SERIES_STM32F4X
```

## soc/arm/st_stm32/stm32f4/Kconfig.defconfig.stm32f401xc
```kconfig
# ST STM32F401CC MCU configuration options

# Copyright (c) 2019 Linumiz
# SPDX-License-Identifier: Apache-2.0

if SOC_STM32F401XC

config SOC
	default	"stm32f401xc"

endif # SOC_STM32F401XC
```

## soc/arm/st_stm32/stm32f4/Kconfig.defconfig.stm32f407xx
```kconfig
# ST STM32F407XX MCU configuration options

# Copyright (c) 2016 Linaro Limited.
# SPDX-License-Identifier: Apache-2.0

if SOC_STM32F407XE

config SOC
	default "stm32f407xx"

config NUM_IRQS
	default 82

endif # SOC_STM32F407XE

if SOC_STM32F407XG

config SOC
	default "stm32f407xx"

config NUM_IRQS
	default 82

endif # SOC_STM32F407XG
```

## soc/arm/st_stm32/stm32f4/Kconfig.defconfig.stm32f410xx
```kconfig
# ST STM32F410XB MCU configuration options

# Copyright (c) 2020 Hans Unzner
# SPDX-License-Identifier: Apache-2.0

if SOC_STM32F410RX

config SOC
	default "stm32f410rx"

config NUM_IRQS
	default 97

endif # SOC_STM32F410RX
```

## soc/arm/st_stm32/stm32f4/Kconfig.defconfig.stm32f411xe
```kconfig
# ST STM32F411CE MCU configuration options

# Copyright (c) 2016 Linaro Limited.
# SPDX-License-Identifier: Apache-2.0

if SOC_STM32F411XE

config SOC
	default "stm32f411xe"

endif # SOC_STM32F411XE
```

## soc/arm/st_stm32/stm32f4/Kconfig.defconfig.stm32f412cg
```kconfig
# ST STM32F412CG MCU configuration options

# Copyright (c) 2018, I-SENSE group of ICCS
# SPDX-License-Identifier: Apache-2.0

if SOC_STM32F412CG

config SOC
	default "stm32f412cx"

endif # SOC_STM32F412CG
```

## soc/arm/st_stm32/stm32f4/Kconfig.defconfig.stm32f412xx
```kconfig
# ST STM32F412XX MCU configuration options

# Copyright (c) 2021 STMicroelectronics.
# SPDX-License-Identifier: Apache-2.0

if SOC_STM32F412CX

config SOC
	default "stm32f412cx"

config NUM_IRQS
	default 97

endif # SOC_STM32F412CX

if SOC_STM32F412VX

config SOC
	default "stm32f412vx"

config NUM_IRQS
	default 97

endif # SOC_STM32F412VX

if SOC_STM32F412ZX

config SOC
	default "stm32f412zx"

config NUM_IRQS
	default 97

endif # SOC_STM32F412ZX
```

## soc/arm/st_stm32/stm32f4/Kconfig.defconfig.stm32f412zg
```kconfig
# ST STM32F412ZG MCU configuration options

# Copyright (c) 2017 Florian Vaussard, HEIG-VD
# SPDX-License-Identifier: Apache-2.0

if SOC_STM32F412ZG

config SOC
	default "stm32f412zx"

endif # SOC_STM32F412ZG
```

## soc/arm/st_stm32/stm32f4/Kconfig.defconfig.stm32f413xx
```kconfig
# ST STM32F413XX MCU configuration options

# Copyright (c) 2017 Florian Vaussard, HEIG-VD
# SPDX-License-Identifier: Apache-2.0

if SOC_STM32F413XX

config SOC
	default "stm32f413xx"

endif # SOC_STM32F413XX
```

## soc/arm/st_stm32/stm32f4/Kconfig.defconfig.stm32f415xx
```kconfig
# Kconfig - ST STM32F415RG MCU configuration options
#
# Copyright (c) 2019, Kwon Tae-young <tykwon@m2i.co.kr>
#
# SPDX-License-Identifier: Apache-2.0
#

if SOC_STM32F415XX

config SOC
	default "stm32f415xx"

config NUM_IRQS
	default 82

endif # SOC_STM32F415XX
```

## soc/arm/st_stm32/stm32f4/Kconfig.defconfig.stm32f417xx
```kconfig
# ST STM32F417XX MCU configuration options

# Copyright (c) 2016 Linaro Limited.
# SPDX-License-Identifier: Apache-2.0

if SOC_STM32F417XX

config SOC
	default "stm32f417xx"

config NUM_IRQS
	default 82

config CRYPTO_STM32
	default y
	depends on CRYPTO

endif # SOC_STM32F417XX
```

## soc/arm/st_stm32/stm32f4/Kconfig.defconfig.stm32f423xx
```kconfig
# ST STM32F423XX MCU configuration options

# Copyright (c) 2022 Richard Osterloh.
# SPDX-License-Identifier: Apache-2.0

if SOC_STM32F423XX

config SOC
	default "stm32f423xx"

config NUM_IRQS
	default 102

endif # SOC_STM32F423XX
```

## soc/arm/st_stm32/stm32f4/Kconfig.defconfig.stm32f427xx
```kconfig
# ST STM32F427XX MCU configuration options

# Copyright (c) 2020 Linaro Limited.
# SPDX-License-Identifier: Apache-2.0

if SOC_STM32F427XX

config SOC
	default "stm32f427xx"

config NUM_IRQS
	default 91

if ENTROPY_GENERATOR

config ENTROPY_STM32_RNG
	default y

endif # ENTROPY_GENERATOR

endif # SOC_STM32F427XX
```

## soc/arm/st_stm32/stm32f4/Kconfig.defconfig.stm32f429xx
```kconfig
# ST STM32F429XX MCU configuration options

# Copyright (c) 2016 Linaro Limited.
# SPDX-License-Identifier: Apache-2.0

if SOC_STM32F429XX

config SOC
	default "stm32f429xx"

config NUM_IRQS
	default 91

endif # SOC_STM32F429XX
```

## soc/arm/st_stm32/stm32f4/Kconfig.defconfig.stm32f437xx
```kconfig
# ST STM32F437XX MCU configuration options

# Copyright (c) 2019, Markus Fuchs <markus.fuchs@de.sauter-bc.com>
# SPDX-License-Identifier: Apache-2.0

if SOC_STM32F437XX

config SOC
	default "stm32f437xx"

config NUM_IRQS
	default 91

config CRYPTO_STM32
	default y
	depends on CRYPTO

endif # SOC_STM32F437XX
```

## soc/arm/st_stm32/stm32f4/Kconfig.defconfig.stm32f446xe
```kconfig
# Kconfig - ST STM32F446XE MCU configuration options
#
# Copyright (c) 2018 Philemon Jaermann.
#
# SPDX-License-Identifier: Apache-2.0
#

if SOC_STM32F446XE

config SOC
	string
	default "stm32f446xx"

config NUM_IRQS
	int
	default 97

if GPIO_STM32

config GPIO_STM32_PORTE
	default n

config GPIO_STM32_PORTH
	default n

endif # GPIO_STM32

endif # SOC_STM32F446XE
```

## soc/arm/st_stm32/stm32f4/Kconfig.defconfig.stm32f469xi
```kconfig
# Kconfig - ST STM32F469XI MCU configuration options
#
# Copyright (c) 2016 Linaro Limited.
#
# SPDX-License-Identifier: Apache-2.0
#

if SOC_STM32F469XI

config SOC
	string
	default "stm32f469xx"

config NUM_IRQS
	int
	default 93

if GPIO_STM32

config GPIO_STM32_PORTF
	default y

config GPIO_STM32_PORTG
	default y

config GPIO_STM32_PORTI
	default y

config GPIO_STM32_PORTJ
	default y

config GPIO_STM32_PORTK
	default y

endif # GPIO_STM32

if ENTROPY_GENERATOR

config ENTROPY_STM32_RNG
	def_bool y

endif # ENTROPY_GENERATOR

endif # SOC_STM32F469XI
```

## soc/arm/st_stm32/stm32f4/Kconfig.defconfig.stm32f469xx
```kconfig
# ST STM32F469XI MCU configuration options

# Copyright (c) 2016 Linaro Limited.
# SPDX-License-Identifier: Apache-2.0

if SOC_STM32F469XX

config SOC
	default "stm32f469xx"

config NUM_IRQS
	default 93

endif # SOC_STM32F469XX
```
