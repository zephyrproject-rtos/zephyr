## soc/arm/st_stm32/stm32l4/Kconfig.defconfig.stm32l4r5xx
```kconfig
# Kconfig - ST Microelectronics STM32L4R5xx MCU
#
# Copyright (c) 2018 Pushpal Sidhu
#
# SPDX-License-Identifier: Apache-2.0
#

if SOC_STM32L4R5XX

config SOC
	default "stm32l4r5xx"

config NUM_IRQS
	default 95

if GPIO_STM32

config GPIO_STM32_PORTD
	default y

config GPIO_STM32_PORTE
	default y

config GPIO_STM32_PORTF
	default y

config GPIO_STM32_PORTG
	default y

endif # GPIO_STM32

endif # SOC_STM32L4R5XX
```

## soc/arm/st_stm32/stm32l4/Kconfig.defconfig.stm32l4r9xx
```kconfig
# ST Microelectronics STM32L4R9xx MCU

# Copyright (c) 2019 STMicroelectronics
# SPDX-License-Identifier: Apache-2.0

if SOC_STM32L4R9XX

config SOC
	default "stm32l4r9xx"

config NUM_IRQS
	default 95

endif # SOC_STM32L4R9XX
```

## soc/arm/st_stm32/stm32l4/Kconfig.defconfig.stm32l4s5xx
```kconfig
# ST Microelectronics STM32L4S5xx MCU

# Copyright (c) 2020 STMicroelectronics
# SPDX-License-Identifier: Apache-2.0

if SOC_STM32L4S5XX

config SOC
	default "stm32l4s5xx"

config NUM_IRQS
	default 95

endif # SOC_STM32L4S5XX
```

## soc/arm/st_stm32/stm32l4/Kconfig.series
```kconfig
# ST Microelectronics STM32L4 MCU series

# Copyright (c) 2016 Open-RnD Sp. z o.o.
# Copyright (c) 2016 BayLibre, SAS
# SPDX-License-Identifier: Apache-2.0

config SOC_SERIES_STM32L4X
	bool "STM32L4x Series MCU"
	select ARM
	select CPU_CORTEX_M4
	select CPU_CORTEX_M_HAS_DWT
	select CPU_HAS_FPU
	select SOC_FAMILY_STM32
	select HAS_STM32CUBE
	select CPU_HAS_ARM_MPU
	select HAS_SWO
	help
	  Enable support for STM32L4 MCU series
```

## soc/arm/st_stm32/stm32l4/Kconfig.soc
```kconfig
# ST Microelectronics STM32L4 MCU line

# Copyright (c) 2016 Open-RnD Sp. z o.o.
# Copyright (c) 2016 BayLibre, SAS
# Copyright (c) 2019 Centaur Analytics, Inc
# Copyright (c) 2019 STMicroelectronics
# SPDX-License-Identifier: Apache-2.0

choice
	prompt "STM32L4x MCU Selection"
	depends on SOC_SERIES_STM32L4X

config SOC_STM32L476XX
	bool "STM32L476XX"

config SOC_STM32L486XX
	bool "STM32L486XX"

config SOC_STM32L496XX
	bool "STM32L496XX"

config SOC_STM32L4A6XX
	bool "STM32L4A6XX"

config SOC_STM32L412XX
	bool "STM32L412XX"

config SOC_STM32L422XX
	bool "STM32L422XX"

config SOC_STM32L431XX
	bool "STM32L431XX"

config SOC_STM32L432XX
	bool "STM32L432XX"

config SOC_STM32L433XX
	bool "STM32L433XX"

config SOC_STM32L452XX
	bool "STM32L452XX"

config SOC_STM32L462XX
	bool "STM32L462XX"

config SOC_STM32L475XX
	bool "STM32L475XX"

config SOC_STM32L4P5XX
	bool "STM32L4P5XX"

config SOC_STM32L4S5XX
	bool "STM32L4S5XX"

config SOC_STM32L4R5XX
	bool "STM32L4R5XX"

config SOC_STM32L4R9XX
	bool "STM32L4R9XX"

config SOC_STM32L471XX
	bool "STM32L471XX"

endchoice
```

## soc/arm/st_stm32/stm32l5/Kconfig.defconfig.series
```kconfig
# ST Microelectronics STM32L5 MCU line

# Copyright (c) 2020 Linaro Limited
# SPDX-License-Identifier: Apache-2.0

if SOC_SERIES_STM32L5X

source "soc/arm/st_stm32/stm32l5/Kconfig.defconfig.stm32l5*"

config SOC_SERIES
	default "stm32l5"

endif # SOC_SERIES_STM32L5X
```

## soc/arm/st_stm32/stm32l5/Kconfig.series
```kconfig
# ST Microelectronics STM32L5 MCU series

# Copyright (c) 2020 Linaro Limited
# SPDX-License-Identifier: Apache-2.0

config SOC_SERIES_STM32L5X
	bool "STM32L5x Series MCU"
	select ARM
	select CPU_CORTEX_M33
	select SOC_FAMILY_STM32
	select ARM_TRUSTZONE_M
	select CPU_HAS_ARM_SAU
	select CPU_HAS_ARM_MPU
	select CPU_HAS_FPU
	select ARMV8_M_DSP
	select CPU_CORTEX_M_HAS_DWT
	select HAS_STM32CUBE
	select HAS_PM
	help
	  Enable support for STM32L5 MCU series
```

## soc/arm/st_stm32/stm32l5/Kconfig.soc
```kconfig
# ST Microelectronics STM32L5 MCU line

# Copyright (c) 2020 Linaro Limited
# SPDX-License-Identifier: Apache-2.0

config SOC_STM32L552XX
	bool
	help
	  STM32L552XX

config SOC_STM32L562XX
	bool
	help
	  STM32L562XX
```

## soc/arm/st_stm32/stm32mp1/Kconfig.defconfig.series
```kconfig
# ST Microelectronics STM32MP1 MCU/MPU line

# Copyright (c) 2019 STMicroelectronics
# SPDX-License-Identifier: Apache-2.0

if SOC_SERIES_STM32MP1X

source "soc/arm/st_stm32/stm32mp1/Kconfig.defconfig.stm32mp15_m4"

config SOC_SERIES
	default "stm32mp1"

config IPM_STM32_IPCC
	default y
	depends on IPM

endif # SOC_SERIES_STM32MP1X
```

## soc/arm/st_stm32/stm32mp1/Kconfig.defconfig.stm32mp15_m4
```kconfig
# Kconfig - ST Microelectronics STM32MP157C_M4 MCU
#
# Copyright (c) 2019 STMicroelectronics
#
# SPDX-License-Identifier: Apache-2.0
#

if SOC_STM32MP15_M4

config SOC
	default "stm32mp157cxx"

config NUM_IRQS
	default 150

endif # SOC_STM32MP15_M4
```

## soc/arm/st_stm32/stm32mp1/Kconfig.series
```kconfig
# ST Microelectronics STM32MP1 MPU series

# Copyright (c) 2019 STMicroelectronics
# SPDX-License-Identifier: Apache-2.0

config SOC_SERIES_STM32MP1X
	bool "STM32MP15 Series MPU"
	select ARM
	select CPU_CORTEX_M4
	select CPU_CORTEX_M_HAS_DWT
	select SOC_FAMILY_STM32
	select HAS_STM32CUBE
	select CPU_HAS_ARM_MPU
	select OPENAMP_RSC_TABLE if RAM_CONSOLE
	help
	  Enable support for STM32MP1 MPU series
```

## soc/arm/st_stm32/stm32mp1/Kconfig.soc
```kconfig
# ST Microelectronics STM32MP1 MPU line

# Copyright (c) 2019 STMicroelectronics
# SPDX-License-Identifier: Apache-2.0

config SOC_STM32MP15_M4
	bool
	help
	  STM32MP15_M4
```

## soc/arm/st_stm32/stm32u5/Kconfig.defconfig.series
```kconfig
# ST Microelectronics STM32U5 MCU line

# Copyright (c) 2021 Linaro Limited
# SPDX-License-Identifier: Apache-2.0

if SOC_SERIES_STM32U5X

source "soc/arm/st_stm32/stm32u5/Kconfig.defconfig.stm32u5*"

config SOC_SERIES
	default "stm32u5"

config MCUBOOT_EXTRA_IMGTOOL_ARGS
	default "--header-size 1024" if BOOTLOADER_MCUBOOT

endif # SOC_SERIES_STM32U5X
```

## soc/arm/st_stm32/stm32u5/Kconfig.soc
```kconfig
# ST Microelectronics STM32U5 MCU line

# Copyright (c) 2021 Linaro Limited
# Copyright (c) 2023 PSICONTROL nv
# SPDX-License-Identifier: Apache-2.0

choice
prompt "STM32U5x MCU Selection"
depends on SOC_SERIES_STM32U5X

config SOC_STM32U575XX
	bool "STM32U575XX"

config SOC_STM32U585XX
	bool "STM32U585XX"

config SOC_STM32U595XX
	bool "STM32U595XX"

config SOC_STM32U599XX
	bool "STM32U599XX"

endchoice
```

## soc/arm/st_stm32/stm32wb/Kconfig.defconfig.series
```kconfig
# ST Microelectronics STM32WB MCU line

# Copyright (c) 2019 Linaro Limited
# SPDX-License-Identifier: Apache-2.0

if SOC_SERIES_STM32WBX

source "soc/arm/st_stm32/stm32wb/Kconfig.defconfig.stm32wb*"

config SOC_SERIES
	default "stm32wb"

config BT_USER_PHY_UPDATE
	default y if BT

endif # SOC_SERIES_STM32WBX
```

## soc/arm/st_stm32/stm32wb/Kconfig.defconfig.stm32wb55xx
```kconfig
# ST Microelectronics STM32WB55XX MCU

# Copyright (c) 2019 Linaro Limited
# SPDX-License-Identifier: Apache-2.0

if SOC_STM32WB55XX

config SOC
	default "stm32wb55xx"

config NUM_IRQS
	default 63

config DMAMUX_STM32
	default y
	depends on DMA_STM32

endif # SOC_STM32WB55XX
```

## soc/arm/st_stm32/stm32wb/Kconfig.series
```kconfig
# ST Microelectronics STM32WB MCU series

# Copyright (c) 2019 Linaro Limited
# SPDX-License-Identifier: Apache-2.0

config SOC_SERIES_STM32WBX
	bool "STM32WBx Series MCU"
	select ARM
	select CPU_CORTEX_M4
	select CPU_CORTEX_M_HAS_DWT
	select CPU_HAS_FPU
	select SOC_FAMILY_STM32
	select HAS_STM32CUBE
	select CPU_HAS_ARM_MPU
	select HAS_SWO
	select HAS_SYS_POWER_STATE_SLEEP_1
	select HAS_SYS_POWER_STATE_SLEEP_2
	select HAS_SYS_POWER_STATE_SLEEP_3
	help
	  Enable support for STM32WB MCU series
```

## soc/arm/st_stm32/stm32wb/Kconfig.soc
```kconfig
# ST Microelectronics STM32WB MCU line

# Copyright (c) 2019 Linaro Limited
# SPDX-License-Identifier: Apache-2.0

config SOC_STM32WB55XX
	bool
	help
	  STM32WB55XX
```

## soc/arm/st_stm32/stm32wba/Kconfig.defconfig.series
```kconfig
# ST Microelectronics STM32WBA MCU line

# Copyright (c) 2023 STMicroelectronics
# SPDX-License-Identifier: Apache-2.0

if SOC_SERIES_STM32WBAX

source "soc/arm/st_stm32/stm32wba/Kconfig.defconfig.stm32wba*"

config SOC_SERIES
	default "stm32wba"

config STM32_LPTIM_TIMER
	default y if PM

endif # SOC_SERIES_STM32WBAX
```

## soc/arm/st_stm32/stm32wba/Kconfig.soc
```kconfig
# ST Microelectronics STM32WBA MCU line

# Copyright (c) 2023 STMicroelectronics
# SPDX-License-Identifier: Apache-2.0

choice
prompt "STM32WBAx MCU Selection"
depends on SOC_SERIES_STM32WBAX

config SOC_STM32WBA52XX
	bool "STM32WBA52XX"

endchoice
```

## soc/arm/st_stm32/stm32wl/Kconfig.defconfig.series
```kconfig
# STMicroelectronics STM32WL MCU line

# Copyright (c) 2020 STMicroelectronics.
# SPDX-License-Identifier: Apache-2.0

if SOC_SERIES_STM32WLX

source "soc/arm/st_stm32/stm32wl/Kconfig.defconfig.stm32wl*"

config SOC_SERIES
	default "stm32wl"

endif # SOC_SERIES_STM32WLX
```

## soc/arm/st_stm32/stm32wl/Kconfig.defconfig.stm32wl55xx
```kconfig
# STMicroelectronics STM32WL55 MCU

# Copyright (c) 2020 STMicroelectronics.
# SPDX-License-Identifier: Apache-2.0

if SOC_STM32WL55XX

config SOC
	default "stm32wl55xx"

config NUM_IRQS
	default 62

endif # SOC_STM32WL55XX
```

## soc/arm/st_stm32/stm32wl/Kconfig.defconfig.stm32wle4xx
```kconfig
# STMicroelectronics STM32WLE4 MCU

# Copyright (c) 2021 Thomas Stranger
# SPDX-License-Identifier: Apache-2.0

if SOC_STM32WLE4XX

config SOC
	default "stm32wle4xx"

config NUM_IRQS
	default 62

endif # SOC_STM32WLE4XX
```

## soc/arm/st_stm32/stm32wl/Kconfig.series
```kconfig
# STMicroelectronics STM32WL MCU series

# Copyright (c) 2020 STMicroelectronics.
# SPDX-License-Identifier: Apache-2.0

config SOC_SERIES_STM32WLX
	bool "STM32WLx Series MCU"
	select ARM
	select CPU_CORTEX_M4
	select CPU_CORTEX_M_HAS_DWT
	select SOC_FAMILY_STM32
	select HAS_STM32CUBE
	select CPU_HAS_ARM_MPU
	select CLOCK_CONTROL_STM32_CUBE if CLOCK_CONTROL
	select HAS_PM
	select HAS_POWEROFF
	help
	  Enable support for STM32WL MCU series
```

## soc/arm/st_stm32/stm32wl/Kconfig.soc
```kconfig
# STMicroelectronics STM32WL MCU line

# Copyright (c) 2020 STMicroelectronics.
# SPDX-License-Identifier: Apache-2.0

choice
	prompt "STM32WLx MCU Selection"
	depends on SOC_SERIES_STM32WLX

config SOC_STM32WLE4XX
	bool "STM32WLE4XX"

config SOC_STM32WLE5XX
	bool "STM32WLE5XX"

config SOC_STM32WL54XX
	bool "STM32WL54XX"

config SOC_STM32WL55XX
	bool "STM32WL55XX"

endchoice
```
