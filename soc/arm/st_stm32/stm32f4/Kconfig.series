## soc/arm/st_stm32/stm32f4/Kconfig.series
```kconfig
# Kconfig - ST Microelectronics STM32F4 MCU series
#
# Copyright (c) 2016 Linaro Limited
#
# SPDX-License-Identifier: Apache-2.0
#

config SOC_SERIES_STM32F4X
	bool "STM32F4x Series MCU"
	select CPU_CORTEX_M4
	select CPU_HAS_FPU
	select SOC_FAMILY_STM32
	select HAS_STM32CUBE
	select CPU_HAS_ARM_MPU
	select HAS_SWO
	help
	 Enable support for STM32F4 MCU series
```

## soc/arm/st_stm32/stm32f4/Kconfig.soc
```kconfig
# ST Microelectronics STM32F4 MCU line

# Copyright (c) 2016 Linaro Limited.
# SPDX-License-Identifier: Apache-2.0

config SOC_STM32F401XC
	bool
	help
	  STM32F401XC

config SOC_STM32F401XE
	bool
	help
	  STM32F401XE

config SOC_STM32F405XG
	bool
	help
	  STM32F405XG

config SOC_STM32F407XE
	bool
	help
	  STM32F407XE

config SOC_STM32F407XG
	bool
	help
	  STM32F407XG

config SOC_STM32F410RX
	bool
	help
	  STM32F410RX

config SOC_STM32F411XE
	bool
	help
	  STM32F411XE

config SOC_STM32F412CX
	bool
	help
	  STM32F412CX

config SOC_STM32F412RX
	bool
	help
	  STM32F412RX

config SOC_STM32F412VX
	bool
	help
	  STM32F412VX

config SOC_STM32F412ZX
	bool
	help
	  STM32F412ZX

config SOC_STM32F413XX
	bool
	help
	  STM32F413XX

config SOC_STM32F415XX
	bool
	help
	  STM32F415XX

config SOC_STM32F417XX
	bool
	help
	  STM32F417XX

config SOC_STM32F423XX
	bool
	help
	  STM32F423XX

config SOC_STM32F427XX
	bool
	help
	  STM32F427XI

config SOC_STM32F429XX
	bool
	help
	  STM32F429XI

config SOC_STM32F437XX
	bool
	help
	  STM32F437XX

config SOC_STM32F446XX
	bool
	help
	  STM32F446XX

config SOC_STM32F469XX
	bool
	help
	  STM32F469XX
```

## soc/arm/st_stm32/stm32f7/Kconfig.defconfig.series
```kconfig
# ST Microelectronics STM32F7 MCU line

# Copyright (c) 2018 Yurii Hamann
# SPDX-License-Identifier: Apache-2.0

# Kconfig symbols common to STM32F7 series

if SOC_SERIES_STM32F7X

source "soc/arm/st_stm32/stm32f7/Kconfig.defconfig.stm32f7*"

config SOC_SERIES
	default "stm32f7"

config DMA_STM32_V1
	default y
	depends on DMA_STM32

endif # SOC_SERIES_STM32F7X
```

## soc/arm/st_stm32/stm32f7/Kconfig.defconfig.stm32f722xx
```kconfig
# ST STM32F722XE Configuration options
#
# Copyright (c) 2023 Evan Perry Grove
#
# SPDX-License-Identifier: Apache-2.0

if SOC_STM32F722XX

config SOC
	default "stm32f722xx"

config NUM_IRQS
	default 104

endif # SOC_STM32F722XX
```

## soc/arm/st_stm32/stm32f7/Kconfig.defconfig.stm32f723xe
```kconfig
# Kconfig - ST STM32F723XE MCU configuration options
#
# Copyright (c) 2018 Aurelien Jarno
#
# SPDX-License-Identifier: Apache-2.0
#

if SOC_STM32F723XE

config SOC
	string
	default "stm32f723xx"

config NUM_IRQS
	int
	default 104

endif # SOC_STM32F723XE
```

## soc/arm/st_stm32/stm32f7/Kconfig.defconfig.stm32f723xx
```kconfig
# Kconfig - ST STM32F723XE MCU configuration options
#
# Copyright (c) 2018 Aurelien Jarno
#
# SPDX-License-Identifier: Apache-2.0
#

if SOC_STM32F723XX

config SOC
	default "stm32f723xx"

config NUM_IRQS
	default 104

endif # SOC_STM32F723XX
```

## soc/arm/st_stm32/stm32f7/Kconfig.defconfig.stm32f746xg
```kconfig
# Kconfig - ST STM32F746XG MCU configuration options
#
# Copyright (c) 2018 Yurii Hamann
#
# SPDX-License-Identifier: Apache-2.0
#

if SOC_STM32F746XG

config SOC
	string
	default "stm32f746xx"

if GPIO_STM32

config GPIO_STM32_PORTJ
	default y

config GPIO_STM32_PORTK
	default y

endif # GPIO_STM32

config NUM_IRQS
	int
	default 98

endif # SOC_STM32F746XG
```

## soc/arm/st_stm32/stm32f7/Kconfig.defconfig.stm32f746xx
```kconfig
# Kconfig - ST STM32F746XG MCU configuration options
#
# Copyright (c) 2018 Yurii Hamann
#
# SPDX-License-Identifier: Apache-2.0
#

if SOC_STM32F746XX

config SOC
	default "stm32f746xx"

if GPIO_STM32

config GPIO_STM32_PORTJ
	default y

config GPIO_STM32_PORTK
	default y

endif # GPIO_STM32

config NUM_IRQS
	default 98

endif # SOC_STM32F746XX
```

## soc/arm/st_stm32/stm32f7/Kconfig.defconfig.stm32f756xx
```kconfig
# Kconfig - ST STM32F756XX MCU configuration options
#
# Copyright (c) 2018 AJ Palmer
#
# SPDX-License-Identifier: Apache-2.0
#

if SOC_STM32F756XX

config SOC
	default "stm32f756xx"

if GPIO_STM32

config GPIO_STM32_PORTJ
	default y

config GPIO_STM32_PORTK
	default y

endif # GPIO_STM32

config NUM_IRQS
	default 98

endif # SOC_STM32F756XX
```

## soc/arm/st_stm32/stm32f7/Kconfig.defconfig.stm32f767xx
```kconfig
# ST STM32F767ZI MCU configuration options

# Copyright (c) 2019 Roland Ma
# SPDX-License-Identifier: Apache-2.0

if SOC_STM32F767XX

config SOC
	default "stm32f767xx"

config NUM_IRQS
	default 110

if ENTROPY_GENERATOR

config ENTROPY_STM32_RNG
	default y

endif # ENTROPY_GENERATOR

endif # SOC_STM32F767XX
```

## soc/arm/st_stm32/stm32f7/Kconfig.defconfig.stm32f769xi
```kconfig
# Kconfig - ST STM32F769XI MCU configuration options
#
# Copyright (c) 2018  Yong Jin
#
# SPDX-License-Identifier: Apache-2.0
#

if SOC_STM32F769XI

config SOC
	string
	default "stm32f769xx"

if GPIO_STM32

config GPIO_STM32_PORTJ
	default y

config GPIO_STM32_PORTK
	default y

endif # GPIO_STM32

config NUM_IRQS
	int
	default 110

endif # SOC_STM32F769XI
```

## soc/arm/st_stm32/stm32f7/Kconfig.series
```kconfig
# ST Microelectronics STM32F7 MCU series

# Copyright (c) 2018 Yurii Hamann
# SPDX-License-Identifier: Apache-2.0

config SOC_SERIES_STM32F7X
	bool "STM32F7x Series MCU"
	select ARM
	select CPU_CORTEX_M7
	select CPU_CORTEX_M_HAS_CACHE
	select CPU_CORTEX_M_HAS_DWT
	select CPU_HAS_FPU
	select SOC_FAMILY_STM32
	select HAS_STM32CUBE
	select CPU_HAS_ARM_MPU
	select HAS_SWO
	help
	  Enable support for STM32F7 MCU series
```

## soc/arm/st_stm32/stm32f7/Kconfig.soc
```kconfig
# ST Microelectronics STM32F7 MCU line

# Copyright (c) 2018 Yurii Hamann
# Copyright (c) 2022, Rtone.
# SPDX-License-Identifier: Apache-2.0

choice
	prompt "STM32F7x MCU Selection"
	depends on SOC_SERIES_STM32F7X

config SOC_STM32F723XX
	bool "STM32F723XX"

config SOC_STM32F745XX
	bool "STM32F745XX"

config SOC_STM32F746XX
	bool "STM32F746XX"

config SOC_STM32F756XX
	bool "STM32F756XX"

config SOC_STM32F750XX
	bool "STM32F750XX"

config SOC_STM32F767XX
	bool "STM32F767XX"
	select CPU_HAS_FPU_DOUBLE_PRECISION

config SOC_STM32F769XX
	bool "STM32F769XX"
	select CPU_HAS_FPU_DOUBLE_PRECISION

endchoice
```

## soc/arm/st_stm32/stm32g0/Kconfig.defconfig.series
```kconfig
# STMicroelectronics STM32G0 MCU line

# Copyright (c) 2019 Philippe Retornaz <philippe@shapescale.com>
# Copyright (c) 2019 STMicroelectronics
# Copyright (c) 2021 G-Technologies Sdn. Bhd.
# SPDX-License-Identifier: Apache-2.0

if SOC_SERIES_STM32G0X

source "soc/arm/st_stm32/stm32g0/Kconfig.defconfig.stm32g0*"

config SOC_SERIES
	default "stm32g0"

endif # SOC_SERIES_STM32G0X
```

## soc/arm/st_stm32/stm32g0/Kconfig.defconfig.stm32g030xx
```kconfig
# STMicroelectronics STM32G030xx MCU

# Copyright (c) 2020 Thomas Stranger
# SPDX-License-Identifier: Apache-2.0

if SOC_STM32G030XX

config SOC
	default "stm32g030xx"

config NUM_IRQS
	default 29

endif # SOC_STM32G030XX
```

## soc/arm/st_stm32/stm32g0/Kconfig.defconfig.stm32g031xx
```kconfig
# STMicroelectronics STM32G031xx MCU

# Copyright (c) 2019 SEAL AG
# SPDX-License-Identifier: Apache-2.0

if SOC_STM32G031XX

config SOC
	string
	default "stm32g031xx"

config NUM_IRQS
	int
	default 30

config CLOCK_STM32_PLL_Q_DIVISOR
	int "PLL Q Divisor"
	depends on CLOCK_STM32_SYSCLK_SRC_PLL
	default 2
	range 2 8
	help
	  PLL Q VCO divisor, allowed values: 2-8.

endif # SOC_STM32G031XX
```

## soc/arm/st_stm32/stm32g0/Kconfig.defconfig.stm32g051xx
```kconfig
# STMicroelectronics STM32G051xx MCU

# Copyright (c) 2020 Thomas Stranger
# SPDX-License-Identifier: Apache-2.0

if SOC_STM32G051XX

config SOC
	default "stm32g051xx"

config NUM_IRQS
	default 30

endif # SOC_STM32G051XX
```

## soc/arm/st_stm32/stm32g0/Kconfig.defconfig.stm32g070xx
```kconfig
# STMicroelectronics STM32G070xx MCU

# Copyright (c) 2019 Sierra Wireless
# SPDX-License-Identifier: Apache-2.0

if SOC_STM32G070XX

config SOC
	default "stm32g070xx"

config NUM_IRQS
	default 30

endif # SOC_STM32G070XX
```

## soc/arm/st_stm32/stm32g0/Kconfig.defconfig.stm32g071rb
```kconfig
# Kconfig - STMicroelectronics STM32G071RB MCU
#
# Copyright (c) 2019 Philippe Retornaz <philippe@shapescale.com>
# Copyright (c) 2019 STMicroelectronics
#
# SPDX-License-Identifier: Apache-2.0
#

if SOC_STM32G071XX

config SOC
	default "stm32g071xx"

config NUM_IRQS
	default 32

if GPIO_STM32

endif # GPIO_STM32
endif # SOC_STM32G071XX
```

## soc/arm/st_stm32/stm32g0/Kconfig.defconfig.stm32g071xx
```kconfig
# STMicroelectronics STM32G071xx MCU

# Copyright (c) 2019 Philippe Retornaz <philippe@shapescale.com>
# Copyright (c) 2019 STMicroelectronics
# SPDX-License-Identifier: Apache-2.0

if SOC_STM32G071XX

config SOC
	default "stm32g071xx"

config NUM_IRQS
	default 34

config MAX_IRQ_PER_AGGREGATOR
	default 2

config NUM_2ND_LEVEL_AGGREGATORS
	default 1

config 2ND_LVL_ISR_TBL_OFFSET
	default 32

config 2ND_LVL_INTR_00_OFFSET
	default 8

endif # SOC_STM32G071XX
```

## soc/arm/st_stm32/stm32g0/Kconfig.defconfig.stm32g081xx
```kconfig
# STMicroelectronics STM32G081xx MCU

# Copyright (c) 2019 STMicroelectronics
# Copyright (c) 2021 Thomas Stranger
# SPDX-License-Identifier: Apache-2.0

if SOC_STM32G081XX

config SOC
	default "stm32g081xx"

config NUM_IRQS
	default 34

config MAX_IRQ_PER_AGGREGATOR
	default 2

config NUM_2ND_LEVEL_AGGREGATORS
	default 1

config 2ND_LVL_ISR_TBL_OFFSET
	default 32

config 2ND_LVL_INTR_00_OFFSET
	default 8

endif # SOC_STM32G081XX
```

## soc/arm/st_stm32/stm32g0/Kconfig.defconfig.stm32g0b0xx
```kconfig
# STMicroelectronics STM32G0B0xx MCU

# Copyright (c) 2020 Thomas Stranger
# SPDX-License-Identifier: Apache-2.0

if SOC_STM32G0B0XX

config SOC
	default "stm32g0b0xx"

config NUM_IRQS
	default 30

endif # SOC_STM32G0B0XX
```

## soc/arm/st_stm32/stm32g0/Kconfig.defconfig.stm32g0b1xx
```kconfig
# STMicroelectronics STM32G0B1xx MCU

# Copyright (c) 2020 Thomas Stranger
# SPDX-License-Identifier: Apache-2.0

if SOC_STM32G0B1XX

config SOC
	default "stm32g0b1xx"

config NUM_IRQS
	default 31

endif # SOC_STM32G0B1XX
```

## soc/arm/st_stm32/stm32g0/Kconfig.defconfig.stm32g0c1xx
```kconfig
# STMicroelectronics STM32G0C1xx MCU

# Copyright (c) 2021 Thomas Stranger
# SPDX-License-Identifier: Apache-2.0

if SOC_STM32G0C1XX

config SOC
	default "stm32g0c1xx"

config NUM_IRQS
	default 36

config MAX_IRQ_PER_AGGREGATOR
	default 2

config NUM_2ND_LEVEL_AGGREGATORS
	default 2

config 2ND_LVL_ISR_TBL_OFFSET
	default 32

config 2ND_LVL_INTR_00_OFFSET
	default 24

config 2ND_LVL_INTR_01_OFFSET
	default 26

endif # SOC_STM32G0C1XX
```

## soc/arm/st_stm32/stm32g0/Kconfig.series
```kconfig
# STMicroelectronics STM32G0 MCU series

# Copyright (c) 2019 Philippe Retornaz <philippe@shapescale.com>
# Copyright (c) 2019 STMicroelectronics
# SPDX-License-Identifier: Apache-2.0

config SOC_SERIES_STM32G0X
	bool "STM32G0x Series MCU"
	select ARM
	select CPU_CORTEX_M0PLUS
	select CPU_CORTEX_M_HAS_VTOR
	select CPU_HAS_ARM_MPU
	select SOC_FAMILY_STM32
	select HAS_STM32CUBE
	select CPU_CORTEX_M_HAS_SYSTICK
	help
	  Enable support for STM32G0 MCU series
```
