## soc/arm/st_stm32/stm32g0/Kconfig.soc
```kconfig
# STMicroelectronics STM32G0 MCU line

# Copyright (c) 2019 Philippe Retornaz <philippe@shapescale.com>
# Copyright (c) 2019 STMicroelectronics
# Copyright (c) 2020 Thomas Stranger
# SPDX-License-Identifier: Apache-2.0

config SOC_STM32G030XX
	bool
	help
	  STM32G030XX

config SOC_STM32G031XX
	bool
	help
	  STM32G031XX

config SOC_STM32G041XX
	bool
	help
	  STM32G041XX

config SOC_STM32G050XX
	bool
	help
	  STM32G050XX

config SOC_STM32G051XX
	bool
	help
	  STM32G051XX

config SOC_STM32G061XX
	bool
	help
	  STM32G061XX

config SOC_STM32G070XX
	bool
	help
	  STM32G070XX

config SOC_STM32G071XX
	bool
	help
	  STM32G071XX

config SOC_STM32G081XX
	bool
	help
	  STM32G081XX

config SOC_STM32G0B0XX
	bool
	help
	  STM32G0B0XX

config SOC_STM32G0B1XX
	bool
	help
	  STM32G0B1XX

config SOC_STM32G0C1XX
	bool
	help
	  STM32G0C1XX
```

## soc/arm/st_stm32/stm32g4/Kconfig.defconfig.series
```kconfig
# STMicroelectronics STM32G4 MCU line

# Copyright (c) 2019 Richard Osterloh <richard.osterloh@gmail.com>
# SPDX-License-Identifier: Apache-2.0

if SOC_SERIES_STM32G4X

source "soc/arm/st_stm32/stm32g4/Kconfig.defconfig.stm32g4*"

config SOC_SERIES
	default "stm32g4"

if PM
config PM_DEVICE
	default y

config STM32_LPTIM_TIMER
	default y
endif # PM

endif # SOC_SERIES_STM32G4X
```

## soc/arm/st_stm32/stm32g4/Kconfig.defconfig.stm32g441xx
```kconfig
# STMicroelectronics STM32G441XX MCU

# Copyright (c) 2021 Guðni Már Gilbert
# SPDX-License-Identifier: Apache-2.0

if SOC_STM32G441XX

config SOC
	default "stm32g441xx"

config NUM_IRQS
	default 102

endif # SOC_STM32G441XX
```

## soc/arm/st_stm32/stm32g4/Kconfig.defconfig.stm32g473xx
```kconfig
# STMicroelectronics STM32G473XX MCU

# Copyright (c) 2021 Guðni Már Gilbert
# SPDX-License-Identifier: Apache-2.0

if SOC_STM32G473XX

config SOC
	default "stm32g473xx"

config NUM_IRQS
	default 102

endif # SOC_STM32G473XX
```

## soc/arm/st_stm32/stm32g4/Kconfig.defconfig.stm32g474re
```kconfig
# STMicroelectronics STM32G474RE MCU

# Copyright (c) 2019 STMicroelectronics.
# SPDX-License-Identifier: Apache-2.0

if SOC_STM32G474XX

config SOC
	default "stm32g474xx"

config NUM_IRQS
	default 102

endif # SOC_STM32G474XX
```

## soc/arm/st_stm32/stm32g4/Kconfig.defconfig.stm32g491xx
```kconfig
# STMicroelectronics STM32G491XX MCU

# Copyright (c) 2021 Guðni Már Gilbert
# SPDX-License-Identifier: Apache-2.0

if SOC_STM32G491XX

config SOC
	default "stm32g491xx"

config NUM_IRQS
	default 102

endif # SOC_STM32G491XX
```

## soc/arm/st_stm32/stm32g4/Kconfig.defconfig.stm32g4a1xx
```kconfig
# STMicroelectronics STM32G4A1XX MCU

# Copyright (c) 2021 Guðni Már Gilbert
# SPDX-License-Identifier: Apache-2.0

if SOC_STM32G4A1XX

config SOC
	default "stm32g4a1xx"

config NUM_IRQS
	default 102

endif # SOC_STM32G4A1XX
```

## soc/arm/st_stm32/stm32g4/Kconfig.series
```kconfig
# STMicroelectronics STM32G4 MCU series

# Copyright (c) 2019 Richard Osterloh <richard.osterloh@gmail.com>
# SPDX-License-Identifier: Apache-2.0

config SOC_SERIES_STM32G4X
	bool "STM32G4x Series MCU"
	select ARM
	select CPU_CORTEX_M4
	select CPU_CORTEX_M_HAS_DWT
	select CPU_HAS_FPU
	select SOC_FAMILY_STM32
	select HAS_STM32CUBE
	select CPU_HAS_ARM_MPU
	select CLOCK_CONTROL_STM32_CUBE if CLOCK_CONTROL
	help
	  Enable support for STM32G4 MCU series
```

## soc/arm/st_stm32/stm32g4/Kconfig.soc
```kconfig
# STMicroelectronics STM32G4 MCU line

# Copyright (c) 2019 Richard Osterloh <richard.osterloh@gmail.com>
# SPDX-License-Identifier: Apache-2.0

choice
	prompt "STM32G4x MCU Selection"
	depends on SOC_SERIES_STM32G4X

config SOC_STM32G4A1XX
	bool "STM32G4A1XX"

config SOC_STM32G431XX
	bool "STM32G431XX"

config SOC_STM32G441XX
	bool "STM32G441XX"

config SOC_STM32G473XX
	bool "STM32G473XX"

config SOC_STM32G474XX
	bool "STM32G474XX"

config SOC_STM32G483XX
	bool "STM32G483XX"

config SOC_STM32G484XX
	bool "STM32G484XX"

config SOC_STM32G491XX
	bool "STM32G491XX"

endchoice
```

## soc/arm/st_stm32/stm32h5/Kconfig.defconfig.series
```kconfig
# ST Microelectronics STM32H5 MCU line

# Copyright (c) 2023 STMicroelectronics
# SPDX-License-Identifier: Apache-2.0

if SOC_SERIES_STM32H5X

source "soc/arm/st_stm32/stm32h5/Kconfig.defconfig.stm32h5*"

config SOC_SERIES
	default "stm32h5"

config ROM_START_OFFSET
	default 0x400 if BOOTLOADER_MCUBOOT

endif # SOC_SERIES_STM32H5X
```

## soc/arm/st_stm32/stm32h5/Kconfig.defconfig.stm32h562xx
```kconfig
# STMicroelectronics STM32H562XX MCU

# Copyright (c) 2023 STMicroelectronics
# SPDX-License-Identifier: Apache-2.0

if SOC_STM32H562XX

config SOC
	default "stm32h562xx"

config NUM_IRQS
	default 131

endif # SOC_STM32H562XX
```

## soc/arm/st_stm32/stm32h5/Kconfig.defconfig.stm32h563xx
```kconfig
# STMicroelectronics STM32H563XX MCU

# Copyright (c) 2023 STMicroelectronics
# SPDX-License-Identifier: Apache-2.0

if SOC_STM32H563XX

config SOC
	default "stm32h563xx"

config NUM_IRQS
	default 131

endif # SOC_STM32H563XX
```

## soc/arm/st_stm32/stm32h7/Kconfig.defconfig.series
```kconfig
# ST Microelectronics STM32H7 MCU line

# Copyright (c) 2019 Linaro  Limited
# Copyright (c) 2022 SILA Embedded Solutions GmbH <office@embedded-solutions.at>
# SPDX-License-Identifier: Apache-2.0

# Kconfig symbols common to STM32H7 series

if SOC_SERIES_STM32H7X

source "soc/arm/st_stm32/stm32h7/Kconfig.defconfig.stm32h7*"

config SOC_SERIES
	default "stm32h7"

config ROM_START_OFFSET
	default 0x400 if BOOTLOADER_MCUBOOT
	default 0x0   if !BOOTLOADER_MCUBOOT

config STM32_LPTIM_TIMER
	default y if PM

if ENTROPY_GENERATOR

config ENTROPY_STM32_RNG
	default y

endif # ENTROPY_GENERATOR

endif # SOC_SERIES_STM32H7X
```

## soc/arm/st_stm32/stm32h7/Kconfig.defconfig.stm32h723xx
```kconfig
# ST STM32H723X MCU configuration options

# Copyright (c) 2020 Alexander Kozhinov <AlexanderKozhinov@yandex.com>
# SPDX-License-Identifier: Apache-2.0

if SOC_STM32H723XX

config SOC
	default "stm32h723xx"

config NUM_IRQS
	default 150

endif # SOC_STM32H723XX
```

## soc/arm/st_stm32/stm32h7/Kconfig.defconfig.stm32h725xx
```kconfig
# ST STM32H725X MCU configuration options

# Copyright (c) 2021 Esco Medical ApS
# SPDX-License-Identifier: Apache-2.0

if SOC_STM32H725XX

config SOC
	default "stm32h725xx"

config NUM_IRQS
	default 163

endif # SOC_STM32H725XX
```

## soc/arm/st_stm32/stm32h7/Kconfig.defconfig.stm32h730xx
```kconfig
# ST STM32H730X MCU configuration options

# Copyright (c) 2022 Georgij Cernysiov <geo.cgv@gmail.com>
# SPDX-License-Identifier: Apache-2.0

if SOC_STM32H730XX

config SOC
	default "stm32h730xx"

config NUM_IRQS
	default 163

endif # SOC_STM32H730XX
```

## soc/arm/st_stm32/stm32h7/Kconfig.defconfig.stm32h743xx
```kconfig
# ST STM32H743X MCU configuration options

# Copyright (c) 2020 Teslabs Engineering S.L.
# SPDX-License-Identifier: Apache-2.0

if SOC_STM32H743XX

config SOC
	default "stm32h743xx"

config NUM_IRQS
	default 150

endif # SOC_STM32H743XX
```

## soc/arm/st_stm32/stm32h7/Kconfig.defconfig.stm32h745xx
```kconfig
# ST STM32H745X MCU configuration options

# Copyright (c) 2020 Alexander Kozhinov <AlexanderKozhinov@yandex.com>
# Copyright (c) 2022 SILA Embedded Solutions GmbH <office@embedded-solutions.at>
# SPDX-License-Identifier: Apache-2.0

if SOC_STM32H745XX

config SOC
	default "stm32h745xx"

config NUM_IRQS
	default 150

choice VOS0_SWITCH_METHOD_CHOICE
	default VOS0_SWITCH_METHOD_ODEN

endchoice

endif # SOC_STM32H745XX
```

## soc/arm/st_stm32/stm32h7/Kconfig.defconfig.stm32h747xx
```kconfig
# ST STM32H747X MCU configuration options

# Copyright (c) 2019 Linaro Limited
# Copyright (c) 2022 SILA Embedded Solutions GmbH <office@embedded-solutions.at>
# SPDX-License-Identifier: Apache-2.0

if SOC_STM32H747XX

config SOC
	default "stm32h747xx"

config NUM_IRQS
	default 150

choice VOS0_SWITCH_METHOD_CHOICE
	default VOS0_SWITCH_METHOD_ODEN

endchoice

endif # SOC_STM32H747XX
```

## soc/arm/st_stm32/stm32h7/Kconfig.defconfig.stm32h750xx
```kconfig
# ST STM32H750XX MCU configuration options

# Copyright (c) 2020 Teslabs Engineering S.L.
# Copyright (c) 2022 SILA Embedded Solutions GmbH <office@embedded-solutions.at>
# SPDX-License-Identifier: Apache-2.0

if SOC_STM32H750XX

config SOC
	default "stm32h750xx"

config NUM_IRQS
	default 150

choice VOS0_SWITCH_METHOD_CHOICE
	default VOS0_SWITCH_METHOD_ODEN

endchoice

endif # SOC_STM32H750XX
```

## soc/arm/st_stm32/stm32h7/Kconfig.defconfig.stm32h753xx
```kconfig
# ST STM32H753X MCU configuration options

# Copyright (c) 2020 Petri Oksanen <petri@iote.ai>
# Copyright (c) 2022 SILA Embedded Solutions GmbH <office@embedded-solutions.at>
# SPDX-License-Identifier: Apache-2.0

if SOC_STM32H753XX

config SOC
	default "stm32h753xx"

config NUM_IRQS
	default 150

choice VOS0_SWITCH_METHOD_CHOICE
	default VOS0_SWITCH_METHOD_ODEN

endchoice

endif # SOC_STM32H753XX
```

## soc/arm/st_stm32/stm32h7/Kconfig.defconfig.stm32h7a3xx
```kconfig
# ST STM32H7A3X MCU configuration options

# Copyright (c) 2021 Electrolance Solutions
# SPDX-License-Identifier: Apache-2.0

if SOC_STM32H7A3XX

config SOC
	default "stm32h7a3xx"

config NUM_IRQS
	default 155

endif # SOC_STM32H7A3XX
```

## soc/arm/st_stm32/stm32h7/Kconfig.defconfig.stm32h7b0xx
```kconfig
# ST STM32H7B0XX MCU configuration options

# Copyright (c) 2023 Charles Dias <charlesdias.cd@outlook.com>
# SPDX-License-Identifier: Apache-2.0

if SOC_STM32H7B0XX || SOC_STM32H7B0XXQ

config SOC
	default "stm32h7b0xxQ" if SOC_STM32H7B0XXQ
	default "stm32h7b0xx" if SOC_STM32H7B0XX

config NUM_IRQS
	default 155

endif # SOC_STM32H7B0XX || SOC_STM32H7B0XXQ
```

## soc/arm/st_stm32/stm32h7/Kconfig.series
```kconfig
# ST Microelectronics STM32H7 MCU series

# Copyright (c) 2019 Linaro Limited
# SPDX-License-Identifier: Apache-2.0

config SOC_SERIES_STM32H7X
	bool "STM32H7x Series MCU"
	select ARM
	select CPU_CORTEX_M_HAS_DWT
	select CPU_HAS_FPU
	select SOC_FAMILY_STM32
	select HAS_STM32CUBE
	select CPU_HAS_ARM_MPU
	select HAS_SWO
	select USE_STM32_HAL_CORTEX
	help
	  Enable support for STM32H7 MCU series

config STM32H7_DUAL_CORE
	bool "Enable Dual Core"
	depends on SOC_SERIES_STM32H7X
```

## soc/arm/st_stm32/stm32h7/Kconfig.soc
```kconfig
# ST Microelectronics STM32H7 MCU line

# Copyright (c) 2019 Linaro Limited
# Copyright (c) 2020 Teslabs Engineering S.L.
# Copyright (c) 2021 Electrolance Solutions
# SPDX-License-Identifier: Apache-2.0

config STM32H7_DUAL_CORE
	bool "Dual Core"
	depends on SOC_SERIES_STM32H7X

choice
	prompt "STM32H7x MCU Selection"
	depends on SOC_SERIES_STM32H7X

config SOC_STM32H723XX
	bool "STM32H723XX"
	select CPU_CORTEX_M7
	select CPU_HAS_FPU_DOUBLE_PRECISION

config SOC_STM32H725XX
	bool "STM32H725XX"
	select CPU_CORTEX_M7
	select CPU_HAS_FPU_DOUBLE_PRECISION

config SOC_STM32H730XX
	bool "STM32H730XX"
	select CPU_CORTEX_M7
	select CPU_HAS_FPU_DOUBLE_PRECISION

config SOC_STM32H730XXQ
	bool "STM32H730XXQ"
	select CPU_CORTEX_M7
	select CPU_HAS_FPU_DOUBLE_PRECISION

config SOC_STM32H735XX
	bool "STM32H735XX"
	select CPU_CORTEX_M7
	select CPU_HAS_FPU_DOUBLE_PRECISION

config SOC_STM32H743XX
	bool "STM32H743XX"
	select CPU_CORTEX_M7
	select CPU_HAS_FPU_DOUBLE_PRECISION

config SOC_STM32H745XX
	bool "STM32H745XX"
	select CPU_HAS_FPU_DOUBLE_PRECISION if CPU_CORTEX_M7
	select STM32H7_DUAL_CORE

config SOC_STM32H747XX
	bool "STM32H747XX"
	select CPU_HAS_FPU_DOUBLE_PRECISION if CPU_CORTEX_M7
	select STM32H7_DUAL_CORE

config SOC_STM32H750XX
	bool "STM32H750XX"
	select CPU_CORTEX_M7
	select CPU_HAS_FPU_DOUBLE_PRECISION

config SOC_STM32H753XX
	bool "STM32H753XX"
	select CPU_CORTEX_M7
	select CPU_HAS_FPU_DOUBLE_PRECISION

config SOC_STM32H7A3XX
	bool "STM32H7A3XX"
	select CPU_CORTEX_M7
	select CPU_HAS_FPU_DOUBLE_PRECISION

config SOC_STM32H7A3XXQ
	bool "STM32H7A3XXQ"
	select CPU_CORTEX_M7
	select CPU_HAS_FPU_DOUBLE_PRECISION

config SOC_STM32H7B3XX
	bool "STM32H7B3XX"
	select CPU_CORTEX_M7
	select CPU_HAS_FPU_DOUBLE_PRECISION

config SOC_STM32H7B3XXQ
	bool "STM32H7B3XXQ"
	select CPU_CORTEX_M7
	select CPU_HAS_FPU_DOUBLE_PRECISION

endchoice
```
