## soc/arm/st_stm32/stm32l0/Kconfig.defconfig.series
```kconfig
# ST Microelectronics STM32L0 MCU line

# Copyright (c) 2018 Endre Karlson <endre.karlson@gmail.com>
# SPDX-License-Identifier: Apache-2.0

# Kconfig symbols common to STM32L0 series

if SOC_SERIES_STM32L0X

source "soc/arm/st_stm32/stm32l0/Kconfig.defconfig.stm32l0*"

config SOC_SERIES
	default "stm32l0"

if PM
config PM_DEVICE
	default y

config STM32_LPTIM_TIMER
	default y
endif # PM

endif # SOC_SERIES_STM32L0X
```

## soc/arm/st_stm32/stm32l0/Kconfig.defconfig.stm32l010xb
```kconfig
# ST Microelectronics STM32L010XX MCU
#
# Copyright (c) 2021 Wouter Cappelle <wouter.cappelle@crodeon.com>
# SPDX-License-Identifier: Apache-2.0

if SOC_STM32L010XB

config SOC
	default "stm32l010xb"

config NUM_IRQS
	default 32

endif # SOC_STM32L010XB
```

## soc/arm/st_stm32/stm32l0/Kconfig.defconfig.stm32l011xx
```kconfig
# ST Microelectronics STM32L011XX MCU
#
# Copyright (c) 2019-2020 Grinn
# SPDX-License-Identifier: Apache-2.0

if SOC_STM32L011XX

config SOC
	default "stm32l011xx"

config NUM_IRQS
	default 32

endif # SOC_STM32L011XX
```

## soc/arm/st_stm32/stm32l0/Kconfig.defconfig.stm32l051xx
```kconfig
# ST Microelectronics STM32L051XX MCU

# Copyright (c) 2021 Nomono AS
# SPDX-License-Identifier: Apache-2.0

if SOC_STM32L051XX

config SOC
	default "stm32l051xx"

config NUM_IRQS
	default 32

endif # SOC_STM32L051XX
```

## soc/arm/st_stm32/stm32l0/Kconfig.defconfig.stm32l071xx
```kconfig
# ST Microelectronics STM32L071XX MCU

# Copyright (c) 2020 Alexander Mihajlovic <a@abxy.se>
# SPDX-License-Identifier: Apache-2.0

if SOC_STM32L071XX

config SOC
	default "stm32l071xx"

config NUM_IRQS
	default 30

endif # SOC_STM32L071XX
```

## soc/arm/st_stm32/stm32l0/Kconfig.defconfig.stm32l073xx
```kconfig
# ST Microelectronics STM32L073XZ MCU

# Copyright (c) 2018 Ilya Tagunov <tagunil@gmail.com>
# SPDX-License-Identifier: Apache-2.0

if SOC_STM32L073XX

config SOC
	default "stm32l073xx"

config NUM_IRQS
	default 32

endif # SOC_STM32L073XX
```

## soc/arm/st_stm32/stm32l0/Kconfig.series
```kconfig
# ST Microelectronics STM32L0 MCU series

# Copyright (c) 2018 Endre Karlson <endre.karlson@gmail.com>
# SPDX-License-Identifier: Apache-2.0

config SOC_SERIES_STM32L0X
	bool "STM32L0x Series MCU"
	select ARM
	select CPU_CORTEX_M0PLUS
	select CPU_CORTEX_M_HAS_VTOR
	select SOC_FAMILY_STM32
	select HAS_STM32CUBE
	select CPU_CORTEX_M_HAS_SYSTICK
	help
	  Enable support for STM32L0 MCU series
```

## soc/arm/st_stm32/stm32l0/Kconfig.soc
```kconfig
# ST Microelectronics STM32L0 MCU line

# Copyright (c) 2018 Endre Karlson <endre.karlson@gmail.com>
# Copyright (c) 2021 Nomono AS
#
# SPDX-License-Identifier: Apache-2.0

config SOC_STM32L010XB
	bool
	help
	  STM32L010XB

config SOC_STM32L011XX
	bool
	help
	  STM32L011XX

config SOC_STM32L031XX
	bool
	help
	  STM32L031XX

config SOC_STM32L051XX
	bool
	select CPU_HAS_ARM_MPU
	help
	  STM32L051XX

config SOC_STM32L053XX
	bool
	select CPU_HAS_ARM_MPU
	help
	  STM32L053XX

config SOC_STM32L071XX
	bool
	select CPU_HAS_ARM_MPU
	help
	  STM32L071XX

config SOC_STM32L072XX
	bool
	select CPU_HAS_ARM_MPU
	help
	  STM32L072XX

config SOC_STM32L073XX
	bool
	select CPU_HAS_ARM_MPU
	help
	  STM32L073XX
```

## soc/arm/st_stm32/stm32l1/Kconfig.defconfig.series
```kconfig
# ST Microelectronics STM32L1 MCU line

# Copyright (c) 2019 Linaro Ltd.
# SPDX-License-Identifier: Apache-2.0

if SOC_SERIES_STM32L1X

source "soc/arm/st_stm32/stm32l1/Kconfig.defconfig.stm32l1*"

config SOC_SERIES
	default "stm32l1"

# adjust the fallback because of the LSI oscaillator characteristics
config TASK_WDT_HW_FALLBACK_DELAY
	depends on TASK_WDT_HW_FALLBACK
	default 200

endif # SOC_SERIES_STM32L1X
```

## soc/arm/st_stm32/stm32l1/Kconfig.defconfig.stm32l151x8a
```kconfig
# ST Microelectronics STM32L151X8-A MCU

# Copyright (c) 2019 eTactica ehf
# SPDX-License-Identifier: Apache-2.0

if SOC_STM32L151X8A

config SOC
	default "stm32l151x8a"

config NUM_IRQS
	default 45

endif # SOC_STM32L151X8A
```

## soc/arm/st_stm32/stm32l1/Kconfig.defconfig.stm32l151xb
```kconfig
# ST Microelectronics STM32L151XB MCU

# Copyright (c) 2019 Linaro Ltd.
# SPDX-License-Identifier: Apache-2.0

if SOC_STM32L151XB

config SOC
	default "stm32l151xb"

config NUM_IRQS
	default 45

endif # SOC_STM32L151XB
```

## soc/arm/st_stm32/stm32l1/Kconfig.defconfig.stm32l151xba
```kconfig
# ST Microelectronics STM32L151XB-A MCU

# Copyright (c) 2019 Linaro Ltd.
# SPDX-License-Identifier: Apache-2.0

if SOC_STM32L151XBA

config SOC
	default "stm32l151xba"

config NUM_IRQS
	default 45

endif # SOC_STM32L151XBA
```

## soc/arm/st_stm32/stm32l1/Kconfig.series
```kconfig
# ST Microelectronics STM32L1 MCU series

# Copyright (c) 2019 Linaro Ltd.
# SPDX-License-Identifier: Apache-2.0

config SOC_SERIES_STM32L1X
	bool "STM32L1x Series MCU"
	select ARM
	select CPU_CORTEX_M3
	select CPU_CORTEX_M_HAS_DWT
	select SOC_FAMILY_STM32
	select HAS_STM32CUBE
	select HAS_SWO
	select CPU_HAS_ARM_MPU
	help
	  Enable support for STM32L1 MCU series
```

## soc/arm/st_stm32/stm32l1/Kconfig.soc
```kconfig
# ST Microelectronics STM32L1 MCU line

# Copyright (c) 2019 Linaro Ltd.
# SPDX-License-Identifier: Apache-2.0

config SOC_STM32L151X8A
	bool
	help
	  STM32L151X8A

config SOC_STM32L151XB
	bool
	help
	  STM32L151XB

config SOC_STM32L151XBA
	bool
	help
	  STM32L151XBA

config SOC_STM32L151XC
	bool
	help
	  STM32L151XC

config SOC_STM32L152XC
	bool
	help
	  STM32L152XC

config SOC_STM32L152XE
	bool
	help
	  STM32L152XE
```

## soc/arm/st_stm32/stm32l4/Kconfig.defconfig.series
```kconfig
# ST Microelectronics STM32L4 MCU line

# Copyright (c) 2016 Open-RnD Sp. z o.o.
# Copyright (c) 2016 BayLibre, SAS
# SPDX-License-Identifier: Apache-2.0

# Kconfig symbols common to STM32L4 series

if SOC_SERIES_STM32L4X

source "soc/arm/st_stm32/stm32l4/Kconfig.defconfig.stm32l4*"

config SOC_SERIES
	default "stm32l4"

config STM32_LPTIM_TIMER
	bool
	default y
	depends on PM

endif # SOC_SERIES_STM32L4X
```

## soc/arm/st_stm32/stm32l4/Kconfig.defconfig.stm32l422xx
```kconfig
# ST Microelectronics STM32L422XX MCU

# Copyright (c) 2020 Aurelien Jarno
# SPDX-License-Identifier: Apache-2.0

if SOC_STM32L422XX

config SOC
	default "stm32l422xx"

config NUM_IRQS
	default 83

endif # SOC_STM32L422XX
```

## soc/arm/st_stm32/stm32l4/Kconfig.defconfig.stm32l432xx
```kconfig
# Kconfig - ST Microelectronics STM32L432XX MCU
#
# Copyright (c) 2016 Open-RnD Sp. z o.o.
# Copyright (c) 2016 BayLibre, SAS
#
# SPDX-License-Identifier: Apache-2.0
#

if SOC_STM32L432XC

config SOC
	string
	default "stm32l432xx"

config NUM_IRQS
	int
	default 83

if GPIO_STM32

config GPIO_STM32_PORTH
	default y

endif # GPIO_STM32

endif # SOC_STM32L432XC
```

## soc/arm/st_stm32/stm32l4/Kconfig.defconfig.stm32l433xx
```kconfig
# Kconfig - ST Microelectronics STM32L433XX MCU
#
# Copyright (c) 2018 David Lamparter
#
# SPDX-License-Identifier: Apache-2.0
#

if SOC_STM32L433XX

config SOC
	default "stm32l433xx"

config NUM_IRQS
	default 83

if GPIO_STM32

config GPIO_STM32_PORTD
	default y

config GPIO_STM32_PORTE
	default y

endif # GPIO_STM32

endif # SOC_STM32L433XX
```

## soc/arm/st_stm32/stm32l4/Kconfig.defconfig.stm32l452xx
```kconfig
# Kconfig - ST Microelectronics STM32L452XX MCU
#
# Copyright (c) 2018 Georgij Cernysiov
#
# SPDX-License-Identifier: Apache-2.0
#

if SOC_STM32L452XX

config SOC
	default "stm32l452xx"

config NUM_IRQS
	default 85

if GPIO_STM32

config GPIO_STM32_PORTD
	default y

config GPIO_STM32_PORTE
	default y

endif # GPIO_STM32

endif # SOC_STM32L452XX
```

## soc/arm/st_stm32/stm32l4/Kconfig.defconfig.stm32l475xg
```kconfig
# Kconfig - ST Microelectronics STM32L475xG MCU
#
# Copyright (c) 2017 Linaro Limited
#
# SPDX-License-Identifier: Apache-2.0
#

if SOC_STM32L475XG

config SOC
	string
	default "stm32l475xx"

config NUM_IRQS
	int
	default 82

if GPIO_STM32

config GPIO_STM32_PORTD
	def_bool y

config GPIO_STM32_PORTE
	default y

config GPIO_STM32_PORTF
	default y

config GPIO_STM32_PORTG
	default y

config GPIO_STM32_PORTH
	default y

endif # GPIO_STM32

endif # SOC_STM32L475XG
```

## soc/arm/st_stm32/stm32l4/Kconfig.defconfig.stm32l475xx
```kconfig
# ST Microelectronics STM32L475xG MCU

# Copyright (c) 2017 Linaro Limited
# SPDX-License-Identifier: Apache-2.0

if SOC_STM32L475XX

config SOC
	default "stm32l475xx"

config NUM_IRQS
	default 82

endif # SOC_STM32L475XX
```

## soc/arm/st_stm32/stm32l4/Kconfig.defconfig.stm32l476xx
```kconfig
# Kconfig - ST Microelectronics STM32L476RG MCU
#
# Copyright (c) 2016 Open-RnD Sp. z o.o.
# Copyright (c) 2016 BayLibre, SAS
#
# SPDX-License-Identifier: Apache-2.0
#

if SOC_STM32L476XX

config SOC
	default "stm32l476xx"

config NUM_IRQS
	default 82

if GPIO_STM32

config GPIO_STM32_PORTD
	default y

config GPIO_STM32_PORTE
	default y

config GPIO_STM32_PORTF
	default y

config GPIO_STM32_PORTG
	default y

endif # GPIO_STM32

endif # SOC_STM32L476XX
```

## soc/arm/st_stm32/stm32l4/Kconfig.defconfig.stm32l496xx
```kconfig
# Kconfig - ST Microelectronics STM32L496xx MCU
#
# Copyright (c) 2016 Open-RnD Sp. z o.o.
# Copyright (c) 2016 BayLibre, SAS
# Copyright (c) 2019 Centaur Analytics, Inc
#
# SPDX-License-Identifier: Apache-2.0
#

if SOC_STM32L496XX

config SOC
	default "stm32l496xx"

config NUM_IRQS
	default 91

if GPIO_STM32

config GPIO_STM32_PORTD
	default y

config GPIO_STM32_PORTE
	default y

config GPIO_STM32_PORTF
	default y

config GPIO_STM32_PORTG
	default y

config GPIO_STM32_PORTI
	default y

endif # GPIO_STM32

endif # SOC_STM32L496XX
```

## soc/arm/st_stm32/stm32l4/Kconfig.defconfig.stm32l4p5xx
```kconfig
# ST Microelectronics STM32L4R5xx MCU

# Copyright (c) 2018 Pushpal Sidhu
# SPDX-License-Identifier: Apache-2.0

if SOC_STM32L4P5XX

config SOC
	default "stm32l4p5xx"

config NUM_IRQS
	default 95

endif # SOC_STM32L4P5XX
```

## soc/arm/st_stm32/stm32l4/Kconfig.defconfig.stm32l4q5xx
```kconfig
# ST Microelectronics STM32L4Q5xx MCU

# Copyright (c) 2023 Marcin Zapolski
# SPDX-License-Identifier: Apache-2.0

if SOC_STM32L4Q5XX

config SOC
	default "stm32l4q5xx"

config NUM_IRQS
	default 95

endif # SOC_STM32L4Q5XX
```
