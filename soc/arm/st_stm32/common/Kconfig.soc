## soc/arm/st_stm32/common/Kconfig.soc
```kconfig
# ST Microelectronics Common Kconfig

# Copyright (c) 2019 Linaro Ltd.
# SPDX-License-Identifier: Apache-2.0

# Workaround for not being able to have commas in macro arguments
DT_CHOSEN_Z_CCM := zephyr,ccm

config STM32_CCM
	def_bool $(dt_chosen_enabled,$(DT_CHOSEN_Z_CCM))

config STM32_BACKUP_SRAM
	bool "STM32 Backup SRAM"
	depends on SOC_SERIES_STM32F2X || SOC_SERIES_STM32F4X || \
		   SOC_SERIES_STM32F7X || SOC_SERIES_STM32H7X
	help
	  Enable support for STM32 backup SRAM.

config USE_STM32_ASSERT
	depends on ASSERT
	bool "STM32Cube HAL and LL drivers asserts"
	help
	  Enable asserts in STM32Cube HAL and LL drivers.

choice POWER_SUPPLY_CHOICE
	prompt "STM32 power supply configuration"
	default POWER_SUPPLY_LDO
	depends on SOC_SERIES_STM32H7X

config POWER_SUPPLY_LDO
	bool "LDO supply"

config POWER_SUPPLY_DIRECT_SMPS
	bool "Direct SMPS supply"

config POWER_SUPPLY_SMPS_1V8_SUPPLIES_LDO
	bool "SMPS 1.8V supplies LDO (no external supply)"

config POWER_SUPPLY_SMPS_2V5_SUPPLIES_LDO
	bool "SMPS 2.5V supplies LDO (no external supply)"

config POWER_SUPPLY_SMPS_1V8_SUPPLIES_EXT_AND_LDO
	bool "External SMPS 1.8V supply, supplies LDO"

config POWER_SUPPLY_SMPS_2V5_SUPPLIES_EXT_AND_LDO
	bool "External SMPS 2.5V supply, supplies LDO"

config POWER_SUPPLY_SMPS_1V8_SUPPLIES_EXT
	bool "External SMPS 1.8V supply and bypass"

config POWER_SUPPLY_SMPS_2V5_SUPPLIES_EXT
	bool "External SMPS 2.5V supply and bypass"

config POWER_SUPPLY_EXTERNAL_SOURCE
	bool "Bypass"

endchoice
```

## soc/arm/st_stm32/stm32c0/Kconfig.defconfig.series
```kconfig
# STMicroelectronics STM32C0 MCU line

# Copyright (c) 2023 Benjamin Björnsson <benjamin.bjornsson@gmail.com>
# SPDX-License-Identifier: Apache-2.0

if SOC_SERIES_STM32C0X

source "soc/arm/st_stm32/stm32c0/Kconfig.defconfig.stm32c0*"

config SOC_SERIES
	default "stm32c0"

endif # SOC_SERIES_STM32C0X
```

## soc/arm/st_stm32/stm32c0/Kconfig.defconfig.stm32c031xx
```kconfig
# STMicroelectronics STM32C031xx MCU

# Copyright (c) 2023 Benjamin Björnsson <benjamin.bjornsson@gmail.com>
# SPDX-License-Identifier: Apache-2.0

if SOC_STM32C031XX

config SOC
	default "stm32c031xx"

config NUM_IRQS
	default 29

endif # SOC_STM32C031XX
```

## soc/arm/st_stm32/stm32c0/Kconfig.series
```kconfig
# STMicroelectronics STM32C0 MCU series

# Copyright (c) 2023 Benjamin Björnsson <benjamin.bjornsson@gmail.com>
# SPDX-License-Identifier: Apache-2.0

config SOC_SERIES_STM32C0X
	bool "STM32C0x Series MCU"
	select ARM
	select CPU_CORTEX_M0PLUS
	select CPU_CORTEX_M_HAS_VTOR
	select CPU_HAS_ARM_MPU
	select SOC_FAMILY_STM32
	select HAS_STM32CUBE
	select CPU_CORTEX_M_HAS_SYSTICK
	help
	  Enable support for STM32C0 MCU series
```

## soc/arm/st_stm32/stm32f0/Kconfig.defconfig.series
```kconfig
# ST Microelectronics STM32F0 MCU line

# Copyright (c) 2017 RnDity Sp. z o.o.
# SPDX-License-Identifier: Apache-2.0

# Kconfig symbols common to STM32F0 series

if SOC_SERIES_STM32F0X

source "soc/arm/st_stm32/stm32f0/Kconfig.defconfig.stm32f0*"

config SOC_SERIES
	default "stm32f0"

config SRAM_VECTOR_TABLE
	default y

# adjust the fallback because of the LSI oscaillator characteristics
config TASK_WDT_HW_FALLBACK_DELAY
	depends on TASK_WDT_HW_FALLBACK
	default 100

endif # SOC_SERIES_STM32F0X
```

## soc/arm/st_stm32/stm32f0/Kconfig.defconfig.stm32f030x4
```kconfig
#
# Copyright (c) 2019 Antony Pavlov <antonynpavlov@gmail.com>
#
# SPDX-License-Identifier: Apache-2.0
#

if SOC_STM32F030X4

# STM32F0 Cube package advises to use 'stm32f030x6' code
# for both STM32F030x4 and STM32F030x6 SoC variants.
config SOC
	default "stm32f030x6"

config NUM_IRQS
	default 29

endif # SOC_STM32F030X4
```

## soc/arm/st_stm32/stm32f0/Kconfig.defconfig.stm32f030x6
```kconfig
# Copyright (c) 2022 William MARTIN <william.martin@power-lan.com>
# SPDX-License-Identifier: Apache-2.0

if SOC_STM32F030X6

config SOC
	default "stm32f030x6"

config NUM_IRQS
	default 28

endif # SOC_STM32F030X6
```

## soc/arm/st_stm32/stm32f0/Kconfig.defconfig.stm32f030x8
```kconfig
# Kconfig - ST Microelectronics STM32F030X8 MCU
#
# Copyright (c) 2017 RnDity Sp. z o.o.
#
# SPDX-License-Identifier: Apache-2.0
#

if SOC_STM32F030X8

config SOC
	default "stm32f030x8"

config NUM_IRQS
	default 29

endif # SOC_STM32F030X8
```

## soc/arm/st_stm32/stm32f0/Kconfig.defconfig.stm32f030xc
```kconfig
# Copyright (c) 2020 Brian Kubisiak <brian@kubisiak.com>
# SPDX-License-Identifier: Apache-2.0

if SOC_STM32F030XC

config SOC
	default "stm32f030xc"

config NUM_IRQS
	default 31

endif # SOC_STM32F030XC
```

## soc/arm/st_stm32/stm32f0/Kconfig.defconfig.stm32f051x8
```kconfig
# Kconfig - ST Microelectronics STM32F051X8 MCU
#
# Copyright (c) 2018 Nathan Tsoi
#
# SPDX-License-Identifier: Apache-2.0
#

if SOC_STM32F051X8

config SOC
	string
	default "stm32f051x8"

config NUM_IRQS
	int
	default 31

endif # SOC_STM32F051X8
```

## soc/arm/st_stm32/stm32f0/Kconfig.defconfig.stm32f072xb
```kconfig
# ST Microelectronics STM32F072XB MCU

# Copyright (c) 2017 BayLibre, SAS
# SPDX-License-Identifier: Apache-2.0

if SOC_STM32F072XB

config SOC
	default "stm32f072xb"

config NUM_IRQS
	default 32

endif # SOC_STM32F072XB
```

## soc/arm/st_stm32/stm32f0/Kconfig.defconfig.stm32f091xc
```kconfig
# ST Microelectronics STM32F091XC MCU

# Copyright (c) 2017 b0661n0e17e@gmail.com
# SPDX-License-Identifier: Apache-2.0

if SOC_STM32F091XC

config SOC
	default "stm32f091xc"

config NUM_IRQS
	default 31

endif # SOC_STM32F091XC
```

## soc/arm/st_stm32/stm32f0/Kconfig.defconfig.stm32f098xx
```kconfig
# ST Microelectronics STM32F098XX MCU

# Copyright (c) 2019 The Chromium OS Authors
# SPDX-License-Identifier: Apache-2.0

if SOC_STM32F098XX

config SOC
	default "stm32f098xx"

config NUM_IRQS
	default 31

endif # SOC_STM32F098xx
```

## soc/arm/st_stm32/stm32f0/Kconfig.series
```kconfig
# ST Microelectronics STM32F0 MCU series

# Copyright (c) 2017 RnDity Sp. z o.o.
# SPDX-License-Identifier: Apache-2.0

config SOC_SERIES_STM32F0X
	bool "STM32F0x Series MCU"
	select ARM
	select CPU_CORTEX_M0
	select CPU_CORTEX_M0_HAS_VECTOR_TABLE_REMAP
	select SOC_FAMILY_STM32
	select CPU_CORTEX_M_HAS_SYSTICK
	select HAS_STM32CUBE
	help
	  Enable support for STM32F0 MCU series
```

## soc/arm/st_stm32/stm32f0/Kconfig.soc
```kconfig
# ST Microelectronics STM32F0 MCU line

# Copyright (c) 2017 RnDity Sp. z o.o.
# SPDX-License-Identifier: Apache-2.0

config SOC_STM32F030X4
	bool
	help
	  STM32F030X4

config SOC_STM32F030X8
	bool
	help
	  STM32F030X8

config SOC_STM32F030XC
	bool
	help
	  STM32F030XC

config SOC_STM32F031X6
	bool
	help
	  STM32F031X6

config SOC_STM32F051X8
	bool
	help
	  STM32F051X8

config SOC_STM32F070XB
	bool
	help
	  STM32F070XB

config SOC_STM32F072XB
	bool
	help
	  STM32F072XB

config SOC_STM32F091XC
	bool
	help
	  STM32F091XC

config SOC_STM32F098XX
	bool
	help
	  STM32F098XX
```

## soc/arm/st_stm32/stm32f1/Kconfig.defconfig.series
```kconfig
# ST Microelectronics STM32F1 MCU line

# Copyright (c) 2016 Open-RnD Sp. z o.o.
# SPDX-License-Identifier: Apache-2.0

# Kconfig symbols common to STM32F1 series

if SOC_SERIES_STM32F1X

source "soc/arm/st_stm32/stm32f1/Kconfig.defconfig.stm32f1*"

config SOC_SERIES
	default "stm32f1"

# adjust the fallback because of the LSI oscaillator characteristics
config TASK_WDT_HW_FALLBACK_DELAY
	depends on TASK_WDT_HW_FALLBACK
	default 200

endif # SOC_SERIES_STM32F1X
```

## soc/arm/st_stm32/stm32f1/Kconfig.defconfig.stm32f103xx
```kconfig
# ST Microelectronics STM32F103XX MCU

# Copyright (c) 2017, embedjournal.com
# SPDX-License-Identifier: Apache-2.0

if SOC_STM32F103XB || SOC_STM32F103X8

config SOC
	default "stm32f103xb"

config NUM_IRQS
	default 43

endif # SOC_STM32F103XB || SOC_STM32F103X8

if SOC_STM32F103XE

config SOC
	default "stm32f103xe"

config NUM_IRQS
	default 60

endif # SOC_STM32F103XE
```

## soc/arm/st_stm32/stm32f1/Kconfig.defconfig.stm32f105xc
```kconfig
# ST Microelectronics STM32F105XC MCU

# Copyright (c) 2019 Argentum Systems Ltd.
# SPDX-License-Identifier: Apache-2.0

if SOC_STM32F105XC

config SOC
	string
	default "stm32f105xc"

config NUM_IRQS
	int
	default 68

endif # SOC_STM32F105XC
```

## soc/arm/st_stm32/stm32f1/Kconfig.defconfig.stm32f107xc
```kconfig
# Kconfig - ST Microelectronics STM32F107XC MCU
#
# Copyright (c) 2016 RnDity Sp. z o.o.
#
# SPDX-License-Identifier: Apache-2.0
#

if SOC_STM32F107XC

config SOC
	default "stm32f107xc"

config NUM_IRQS
	default 68

if GPIO_STM32

config GPIO_STM32_PORTE
	default y

endif # GPIO_STM32

endif # SOC_STM32F107XC
```

## soc/arm/st_stm32/stm32f1/Kconfig.series
```kconfig
# ST Microelectronics STM32F1 MCU series

# Copyright (c) 2016 Open-RnD Sp. z o.o.
# SPDX-License-Identifier: Apache-2.0

config SOC_SERIES_STM32F1X
	bool "STM32F1x Series MCU"
	select ARM
	select CPU_CORTEX_M3
	select CPU_CORTEX_M_HAS_DWT
	select SOC_FAMILY_STM32
	select HAS_STM32CUBE
	select HAS_SWO
	help
	  Enable support for STM32F1 MCU series
```

## soc/arm/st_stm32/stm32f1/Kconfig.soc
```kconfig
# ST Microelectronics STM32F1 MCU line

# Copyright (c) 2016 Open-RnD Sp. z o.o.
# Copyright (c) RnDity Sp. z o.o.
# SPDX-License-Identifier: Apache-2.0

config SOC_STM32F100XB
	bool
	help
	  STM32F100XB

config SOC_STM32F100XE
	bool
	help
	  STM32F100XE

config SOC_STM32F103XE
	bool
	select SOC_STM32F10X_DENSITY_DEVICE
	help
	  STM32F103XE

config SOC_STM32F103XB
	bool
	select SOC_STM32F10X_DENSITY_DEVICE
	help
	  STM32F103XB

config SOC_STM32F103X8
	bool
	select SOC_STM32F10X_DENSITY_DEVICE
	help
	  STM32F103X8

config SOC_STM32F105XC
	bool
	select SOC_STM32F10X_CONNECTIVITY_LINE_DEVICE
	help
	  STM32F105XC

config SOC_STM32F107XC
	bool
	select SOC_STM32F10X_CONNECTIVITY_LINE_DEVICE
	help
	  STM32F107XC

config SOC_STM32F10X_DENSITY_DEVICE
	bool
	help
	  STM32F101xx, STM32F102xx, STM32F103xx:
	  * Low density Value line devices
	  * Medium density Value line devices
	  * High density Value line devices
	  * XL-density devices Value line devices

config SOC_STM32F10X_CONNECTIVITY_LINE_DEVICE
	bool
	help
	  Connectivity line devices are STM32F105xx and STM32F107xx
	  microcontrollers.  They are intended for applications where
	  connectivity and real-time performances are required such as
	  industrial control, control panels for security applications, UPS or
	  home audio.  For STM32F107xx also the Ethernet MAC is available.
```

## soc/arm/st_stm32/stm32f2/Kconfig.defconfig.series
```kconfig
# ST Microelectronics STM32F2 MCU line

# Copyright (c) 2018 qianfan Zhao <qianfanguijin@163.com>
# SPDX-License-Identifier: Apache-2.0

# Kconfig symbols common to STM32F2 series

if SOC_SERIES_STM32F2X

source "soc/arm/st_stm32/stm32f2/Kconfig.defconfig.stm32f2*"

config SOC_SERIES
	default "stm32f2"

endif # SOC_SERIES_STM32F2X
```

## soc/arm/st_stm32/stm32f2/Kconfig.defconfig.stm32f207xx
```kconfig
# Kconfig - ST Microelectronics stm32f207 MCU
#
# Copyright (c) 2018 qianfan Zhao <qianfanguijin@163.com>
#
# SPDX-License-Identifier: Apache-2.0
#

if SOC_STM32F207XX

config SOC
	default "STM32F207xx"

config NUM_IRQS
	default 81

endif
```

## soc/arm/st_stm32/stm32f2/Kconfig.series
```kconfig
# ST Microelectronics STM32F2X MCU series

# Copyright (c) 2018 qianfan Zhao <qianfanguijin@163.com>
# SPDX-License-Identifier: Apache-2.0

config SOC_SERIES_STM32F2X
	bool "stm32f2x Series MCU"
	select ARM
	select CPU_CORTEX_M3
	select CPU_CORTEX_M_HAS_DWT
	select SOC_FAMILY_STM32
	select HAS_STM32CUBE
	select HAS_SWO
	select CPU_HAS_ARM_MPU
	help
	  Enable support for stm32f2 MCU series
```

## soc/arm/st_stm32/stm32f2/Kconfig.soc
```kconfig
# ST Microelectronics stm32f2 MCU line

# Copyright (c) 2018 qianfan Zhao <qianfanguijin@163.com>
# SPDX-License-Identifier: Apache-2.0

config SOC_STM32F207XX
	bool
	help
	  STM32F207XX

config SOC_STM32F205XX
	bool
	help
	  STM32F205XX
```
