## soc/arm/xenvm/Kconfig.defconfig
```kconfig
# Copyright 2020 EPAM Systems
# SPDX-License-Identifier: Apache-2.0

if SOC_XENVM

config SOC
	default "xenvm"

config NUM_IRQS
	int
	default 500

config SYS_CLOCK_HW_CYCLES_PER_SEC
	int
	default 8320000

endif
```

## soc/arm/xenvm/Kconfig.soc
```kconfig
# Copyright 2020 EPAM Systems
# SPDX-License-Identifier: Apache-2.0

config SOC_XENVM
	bool "Xen virtual machine on aarch64"
	select ARM
	select ARM64
	select ARM_ARCH_TIMER
	select GIC_V2
	select CPU_CORTEX_A72
```

## soc/arm/xilinx_zynq7000/Kconfig
```kconfig
#
# Copyright (c) 2021 Weidmueller Interface GmbH & Co. KG
# SPDX-License-Identifier: Apache-2.0
#

config SOC_FAMILY_XILINX_ZYNQ7000
	bool

if SOC_FAMILY_XILINX_ZYNQ7000

config SOC_FAMILY
	string
	default "xilinx_zynq7000"

source "soc/arm/xilinx_zynq7000/*/Kconfig.soc"

endif # SOC_FAMILY_XILINX_ZYNQ7000
```

## soc/arm/xilinx_zynq7000/Kconfig.defconfig
```kconfig
#
# Copyright (c) 2021 Weidmueller Interface GmbH & Co. KG
# SPDX-License-Identifier: Apache-2.0
#

if SOC_XILINX_ZYNQ7000 || SOC_XILINX_ZYNQ7000S

config SOC
	default "xilinx_zynq7000"

config NUM_IRQS
	int
	# must be >= the highest interrupt number used
	default 96

# Workaround for not being able to have commas in macro arguments
DT_CHOSEN_Z_FLASH := zephyr,flash

config FLASH_SIZE
	default $(dt_chosen_reg_size_int,$(DT_CHOSEN_Z_FLASH),0,K)

config FLASH_BASE_ADDRESS
	default $(dt_chosen_reg_addr_hex,$(DT_CHOSEN_Z_FLASH))

endif
```

## soc/arm/xilinx_zynq7000/Kconfig.soc
```kconfig
#
# Copyright (c) 2021 Weidmueller Interface GmbH & Co. KG
# SPDX-License-Identifier: Apache-2.0
#

source "soc/arm/xilinx_zynq7000/*/Kconfig.series"
```

## soc/arm/xilinx_zynq7000/xc7zxxx/Kconfig.defconfig.series
```kconfig
#
# Copyright (c) 2021 Weidmueller Interface GmbH & Co. KG
# SPDX-License-Identifier: Apache-2.0
#

if SOC_SERIES_XILINX_XC7ZXXX

rsource "Kconfig.defconfig.xc7z*"

config SOC_SERIES
	default "xc7zxxx"

# Zephyr does not support SMP on aarch32 yet, so we default to 1 CPU core
config MP_NUM_CPUS
	default 1

endif # SOC_SERIES_XILINX_XC7ZXXX
```

## soc/arm/xilinx_zynq7000/xc7zxxx/Kconfig.defconfig.xc7z035
```kconfig
#
# Copyright (c) 2021 Weidmueller Interface GmbH & Co. KG
# SPDX-License-Identifier: Apache-2.0
#

config SOC
	default "XC7Z035"
	depends on SOC_XILINX_XC7Z035
```

## soc/arm/xilinx_zynq7000/xc7zxxx/Kconfig.defconfig.xc7z100
```kconfig
#
# Copyright (c) 2021 Weidmueller Interface GmbH & Co. KG
# SPDX-License-Identifier: Apache-2.0
#

config SOC
	default "XC7Z100"
	depends on SOC_XILINX_XC7Z100
```

## soc/arm/xilinx_zynq7000/xc7zxxx/Kconfig.series
```kconfig
#
# Copyright (c) 2021 Weidmueller Interface GmbH & Co. KG
# SPDX-License-Identifier: Apache-2.0
#

config SOC_SERIES_XILINX_XC7ZXXX
	bool "Xilinx Zynq-7000 (XC7Zxxx) SoC series"
	select SOC_FAMILY_XILINX_ZYNQ7000
	select ARM
	select CPU_CORTEX_A9
	select ARM_ARCH_TIMER_ERRATUM_740657 if ARM_ARCH_TIMER
	help
	  Enable support for the Xilinx Zynq-7000 (XC7Zxxx)
	  SoC series (dual core ARM Cortex-A9).
```

## soc/arm/xilinx_zynq7000/xc7zxxx/Kconfig.soc
```kconfig
#
# Copyright (c) 2021 Weidmueller Interface GmbH & Co. KG
# SPDX-License-Identifier: Apache-2.0
#
# Device data: comp.
# https://www.xilinx.com/products/silicon-devices/soc/zynq-7000.html#productTable
#

config SOC_XILINX_XC7Z010
	bool
	help
	  XC7Z010: 2 ARM Cortex-A9 cores up to 866 MHz, Artix-7 programmable logic,
	  28k logic cells, 2.1Mb block RAM, 800 DSP slices, up to 100 I/O pins.

config SOC_XILINX_XC7Z015
	bool
	help
	  XC7Z015: 2 ARM Cortex-A9 cores up to 866 MHz, Artix-7 programmable logic,
	  74k logic cells, 3.3Mb block RAM, 160 DSP slices, up to 150 I/O pins,
	  up to 4 transceivers.

config SOC_XILINX_XC7Z020
	bool
	help
	  XC7Z020: 2 ARM Cortex-A9 cores up to 866 MHz, Artix-7 programmable logic,
	  85k logic cells, 4.9Mb block RAM, 220 DSP slices, up to 200 I/O pins.

config SOC_XILINX_XC7Z030
	bool
	help
	XC7Z030: 2 ARM Cortex-A9 cores up to 1 GHz, Kintex-7 programmable logic,
	  125k logic cells, 9.3Mb block RAM, 400 DSP slices, up to 250 I/O pins,
	  up to 4 transceivers.

config SOC_XILINX_XC7Z035
	bool
	help
	  XC7Z035: 2 ARM Cortex-A9 cores up to 1 GHz, Kintex-7 programmable logic,
	  275k logic cells, 17.6Mb block RAM, 900 DSP slices, up to 362 I/O pins,
	  up to 16 transceivers.

config SOC_XILINX_XC7Z045
	bool
	help
	  XC7Z045: 2 ARM Cortex-A9 cores up to 1 GHz, Kintex-7 programmable logic,
	  350k logic cells, 19.1Mb block RAM, 900 DSP slices, up to 362 I/O pins,
	  up to 16 transceivers.

config SOC_XILINX_XC7Z100
	bool
	help
	  XC7Z100: 2 ARM Cortex-A9 cores up to 1 GHz, Kintex-7 programmable logic,
	  444k logic cells, 26.5Mb block RAM, 2020 DSP slices, up to 400 I/O pins,
	  up to 16 transceivers.
```

## soc/arm/xilinx_zynq7000/xc7zxxxs/Kconfig.defconfig.series
```kconfig
#
# Copyright (c) 2021 Weidmueller Interface GmbH & Co. KG
# SPDX-License-Identifier: Apache-2.0
#

if SOC_SERIES_XILINX_XC7ZXXXS

rsource "Kconfig.defconfig.xc7z*"

config SOC_SERIES
	default "xc7zxxxs"

config MP_MAX_NUM_CPUS
	default 1

endif # SOC_SERIES_XILINX_XC7ZXXXS
```

## soc/arm/xilinx_zynq7000/xc7zxxxs/Kconfig.defconfig.xc7z007s
```kconfig
#
# Copyright (c) 2021 Weidmueller Interface GmbH & Co. KG
# SPDX-License-Identifier: Apache-2.0
#

config SOC
	default "XC7Z007S"
	depends on SOC_XILINX_XC7Z007S
```

## soc/arm/xilinx_zynq7000/xc7zxxxs/Kconfig.series
```kconfig
#
# Copyright (c) 2021 Weidmueller Interface GmbH & Co. KG
# SPDX-License-Identifier: Apache-2.0
#

config SOC_SERIES_XILINX_XC7ZXXXS
	bool "Xilinx Zynq-7000S (XC7ZxxxS) SoC series"
	select SOC_FAMILY_XILINX_ZYNQ7000
	select ARM
	select CPU_CORTEX_A9
	select GIC_V1
	select ARM_ARCH_TIMER_ERRATUM_740657 if ARM_ARCH_TIMER
	help
	  Enable support for the Xilinx Zynq-7000S (XC7ZxxxS)
	  SoC series (single core ARM Cortex-A9).
```

## soc/arm/xilinx_zynq7000/xc7zxxxs/Kconfig.soc
```kconfig
#
# Copyright (c) 2021 Weidmueller Interface GmbH & Co. KG
# SPDX-License-Identifier: Apache-2.0
#
# Device data: comp.
# https://www.xilinx.com/products/silicon-devices/soc/zynq-7000.html#productTable
#

config SOC_XILINX_XC7Z007S
	bool
	help
	  XC7Z007S: 1 ARM Cortex-A9 core up to 766 MHz, Artix-7 programmable logic,
	  23k logic cells, 1.8 Mb block RAM, 60 DSP slices, up to 100 I/O pins.

config SOC_XILINX_XC7Z012S
	bool
	help
	  XC7Z012S: 1 ARM Cortex-A9 core up to 766 MHz, Artix-7 programmable logic,
	  55k logic cells, 2.5Mb block RAM, 120 DSP slices, up to 150 I/O pins,
	  up to 4 transceivers.

config SOC_XILINX_XC7Z014S
	bool
	help
	  XC7Z014S: 1 ARM Cortex-A9 core up to 766 MHz, Artix-7 programmable logic,
	  65k logic cells, 3.8Mb block RAM, 170 DSP slices, up to 200 I/O pins.
```

## soc/arm/xilinx_zynqmp/Kconfig
```kconfig
# Copyright (c) 2019 Stephanos Ioannidis <root@stephanos.io>
# SPDX-License-Identifier: Apache-2.0

config SOC_XILINX_ZYNQMP
	bool
```

## soc/arm/xilinx_zynqmp/Kconfig.defconfig
```kconfig
# Copyright (c) 2019 Lexmark International, Inc.
#
# SPDX-License-Identifier: Apache-2.0

if SOC_XILINX_ZYNQMP

config SOC
	default "xilinx_zynqmp"

config NUM_IRQS
	# must be >= the highest interrupt number used
	# - include the UART interrupts
	default 220

config 2ND_LVL_ISR_TBL_OFFSET
	default 1

config MAX_IRQ_PER_AGGREGATOR
	default 219

config NUM_2ND_LEVEL_AGGREGATORS
	default 1

config SYS_CLOCK_HW_CYCLES_PER_SEC
	default 12000000

# Workaround for not being able to have commas in macro arguments
DT_CHOSEN_Z_FLASH := zephyr,flash

config FLASH_SIZE
	default $(dt_chosen_reg_size_int,$(DT_CHOSEN_Z_FLASH),0,K)

config FLASH_BASE_ADDRESS
	default $(dt_chosen_reg_addr_hex,$(DT_CHOSEN_Z_FLASH))

endif
```

## soc/arm/xilinx_zynqmp/Kconfig.soc
```kconfig
# Copyright (c) 2019 Lexmark International, Inc.
# Copyright (c) 2019 Stephanos Ioannidis <root@stephanos.io>
# SPDX-License-Identifier: Apache-2.0

config SOC_XILINX_ZYNQMP_RPU
	bool "Xilinx ZynqMP RPU"
	select ARM
	select CPU_CORTEX_R5
	select SOC_XILINX_ZYNQMP
	select GIC_V1
	select PLATFORM_SPECIFIC_INIT
	select CPU_HAS_ARM_MPU
	select VFP_DP_D16
```

## soc/arm64/arm/Kconfig
```kconfig
# ARM LTD SoC configuration options

# Copyright (c) 2016 Linaro Limited
# Copyright (c) 2021 Arm Limited (or its affiliates). All rights reserved.
# SPDX-License-Identifier: Apache-2.0

config SOC_FAMILY_ARM64
	bool

if SOC_FAMILY_ARM64
config SOC_FAMILY
	string
	default "arm"

source "soc/arm64/arm/*/Kconfig.soc"
endif # SOC_FAMILY_ARM
```

## soc/arm64/arm/Kconfig.soc
```kconfig
# ARM LTD SoC configuration options

# Copyright (c) 2016 Linaro Limited
# Copyright (c) 2021 Arm Limited (or its affiliates). All rights reserved.
# SPDX-License-Identifier: Apache-2.0

source "soc/arm64/arm/*/Kconfig.series"
```

## soc/arm64/arm/fvp_aemv8a/Kconfig.series
```kconfig
# Copyright (c) 2021 Carlo Caione <ccaione@baylibre.com>
# SPDX-License-Identifier: Apache-2.0

config SOC_SERIES_FVP_AEMV8A
	bool "ARM FVP AEMv8A AArch64 Series"
	select ARM64
	select SOC_FAMILY_ARM64
	help
	  Enable support for ARM FVP AEMv8A AArch64 Series
```

## soc/arm64/arm/fvp_aemv8a/Kconfig.soc
```kconfig
# Copyright (c) 2021 Carlo Caione <ccaione@baylibre.com>
# SPDX-License-Identifier: Apache-2.0

choice
	prompt "ARM FVP AEMv8A AArch64 SoCs"
	depends on SOC_SERIES_FVP_AEMV8A

config SOC_FVP_BASE_REVC_2XAEMV8A
	bool "ARM FVP Base RevC 2xAEMv8A AArch64 simulation"
	select CPU_CORTEX_A53

endchoice
```

## soc/arm64/arm/fvp_aemv8r/Kconfig.series
```kconfig
# Copyright (c) 2021 Arm Limited (or its affiliates). All rights reserved.
# SPDX-License-Identifier: Apache-2.0

config SOC_SERIES_FVP_AEMV8R
	bool "ARM FVP AEMv8R AArch64 Series"
	select ARM64
	select SOC_FAMILY_ARM64
	help
	  Enable support for ARM FVP AEMv8R AArch64 Series
```

## soc/arm64/arm/fvp_aemv8r/Kconfig.soc
```kconfig
# Copyright (c) 2021 Arm Limited (or its affiliates). All rights reserved.
# SPDX-License-Identifier: Apache-2.0

choice
	prompt "ARM FVP AEMv8R AArch64 SoCs"
	depends on SOC_SERIES_FVP_AEMV8R

config SOC_FVP_AEMV8R_AARCH64
	bool "ARM FVP AEMv8R aarch64 simulation"
	select CPU_CORTEX_R82
	select CPU_HAS_MPU
	select GIC_SINGLE_SECURITY_STATE

endchoice

config SOC_FVP_AEMV8R_SIMULATE_CPU_PM
	bool "Simulate CPU Power Management for FVP_BaseR_AEMv8R"
	default n
	help
	  It simulates the cpu power management function for
	  FVP_BaseR_AEMv8R. When zephyr kernel try to bring up secondary
	  core through pm_cpu_on(), it always succeeds because
	  it indeed bring up secondary core successfully.
```

## soc/arm64/bcm2711/Kconfig.defconfig
```kconfig
# Copyright 2023 honglin leng <a909204013@gmail.com>
# SPDX-License-Identifier: Apache-2.0

if SOC_BCM2711

config SOC
	default "bcm2711"

config NUM_IRQS
	int
	default 260

config SYS_CLOCK_HW_CYCLES_PER_SEC
	int
	default 54000000

endif
```

## soc/arm64/bcm2711/Kconfig.soc
```kconfig
# Copyright 2023 honglin leng <a909204013@gmail.com>
# SPDX-License-Identifier: Apache-2.0

config SOC_BCM2711
	bool "bcm2711"
	select ARM64
	select CPU_CORTEX_A72
	select ARM_ARCH_TIMER if SYS_CLOCK_EXISTS
```
