## soc/arm/infineon_xmc/1xxx/Kconfig.soc
```kconfig
# XMC 1xxx MCU line
#
# Copyright (c) 2021 Linumiz
# Author: Parthiban Nallathambi <parthiban@linumiz.com>
# SPDX-License-Identifier: Apache-2.0

choice
	prompt "XMC 1xxx MCU Selection"
	depends on SOC_SERIES_XMC_1XXX

config SOC_XMC1400
	bool "SOC_XMC1400"
	select HAS_XMCLIB

endchoice

if SOC_SERIES_XMC_1XXX

config SOC_PART_NUMBER_T038X0200
	bool

config SOC_PART_NUMBER_XMC_1XXX
	string
	default "T038x0200" if SOC_PART_NUMBER_T038X0200
	help
	  This string holds the full part number of the SoC. It is a hidden option
	  that you should not set directly. The part number selection choice defines
	  the default value for this string.

endif # SOC_SERIES_XMC_1XXX
```

## soc/arm/infineon_xmc/4xxx/Kconfig.defconfig.series
```kconfig
# SPDX-License-Identifier: Apache-2.0
#
# XMC 4xxx series configuration options
# Copyright (c) 2020 Linumiz
# Author: Parthiban Nallathambi <parthiban@linumiz.com>

if SOC_SERIES_XMC_4XXX

config SOC_SERIES
	default "4xxx"

config NUM_IRQS
	default 112

config UART_XMC4XXX
	default y
	depends on SERIAL

source "soc/arm/infineon_xmc/4xxx/Kconfig.defconfig.xmc*"

endif # SOC_SERIES_XMC_4XXX
```

## soc/arm/infineon_xmc/4xxx/Kconfig.defconfig.xmc4800
```kconfig
# Infineon XMC4800 platform configuration options
#
# Copyright (c) 2022 Andriy Gelman <andriy.gelman@gmail.com>
# SPDX-License-Identifier: Apache-2.0

if SOC_XMC4800

config SOC
	default "XMC4800"

config SYS_CLOCK_HW_CYCLES_PER_SEC
	default 144000000

config NUM_IRQS
	default 112

endif # SOC_XMC4800
```
