## soc/arm/gigadevice_gd32/Kconfig.soc
```kconfig
# ST Microelectronics STM32 MCU line

# Copyright (c) 2016 Open-RnD Sp. z o.o.
# SPDX-License-Identifier: Apache-2.0

source "soc/arm/gigadevice_gd32/*/Kconfig.series"
```

## soc/arm/gigadevice_gd32/common/Kconfig.defconfig.series
```kconfig
# GD Microelectronics GD32 all MCU lines

# Copyright (c) 2017, I-SENSE group of ICCS
# SPDX-License-Identifier: Apache-2.0

# Here are set all the Kconfig symbols common to the whole GD32 family

if SOC_FAMILY_GD32

config CORTEX_M_SYSTICK
	default n if GD32_LPTIM_TIMER

DT_GD32_RCC_PATH := $(dt_nodelabel_path,rcc)
DT_GD32_RCC_CLOCK_FREQ := $(dt_node_int_prop_int,$(DT_GD32_RCC_PATH),clock-frequency)

config SYS_CLOCK_HW_CYCLES_PER_SEC
	default "$(DT_GD32_RCC_CLOCK_FREQ)" if "$(dt_nodelabel_enabled,rcc)"

# set the tick per sec as a divider of the LPTIM clock source
config SYS_CLOCK_TICKS_PER_SEC
	default 4096 if GD32_LPTIM_TIMER && GD32_LPTIM_CLOCK_LSE
	default 4000 if GD32_LPTIM_TIMER && GD32_LPTIM_CLOCK_LSI

# config CLOCK_CONTROL_GD32_CUBE
# 	default y
# 	depends on CLOCK_CONTROL

# config UART_GD32
# 	default y
# 	depends on SERIAL

if GPIO

config GPIO_GD32
	bool "GPIO_GD32"
	default y

endif # GPIO

config PINMUX_GD32
	bool "PINMUX_GD32"
	default y
	depends on PINMUX

# config PWM_GD32
#	default y
#	depends on PWM

# config SPI_GD32
#	default y
#	depends on SPI

# config I2S_GD32
#	default y
#	depends on I2S

# config USB_DC_GD32
#	default y
#	depends on USB

# config COUNTER_RTC_GD32
#	default y
#	depends on COUNTER

# config ADC_GD32
#	default y
#	depends on ADC

if DMA

# config DMA_GD32
#	default y

endif # DMA

# config MEMC_GD32
#	default y
#	depends on MEMC

endif # SOC_FAMILY_GD32
```

## soc/arm/gigadevice_gd32/gd32e1/Kconfig.defconfig.gd32e103vb
```kconfig
# ST STM32F401CC MCU configuration options

# Copyright (c) 2019 Linumiz
# SPDX-License-Identifier: Apache-2.0

if SOC_GD32E103VB

config SOC
	default	"gd32e103vb"

config NUM_IRQS
	default 85

endif # SOC_GD32E103VB
```

## soc/arm/gigadevice_gd32/gd32e1/Kconfig.defconfig.series
```kconfig
# ST Microelectronics STM32F4 MCU line

# Copyright (c) 2016 Linaro Limited
# SPDX-License-Identifier: Apache-2.0

# Kconfig symbols common to STM32F4 series

if SOC_SERIES_GD32E1X

source "soc/arm/gigadevice_gd32/gd32e1/Kconfig.defconfig.gd32e1*"

config SOC_SERIES
	default "gd32e1"

endif # SOC_SERIES_GD32E1X
```

## soc/arm/gigadevice_gd32/gd32e1/Kconfig.series
```kconfig
# ST Microelectronics STM32F4 MCU series

# Copyright (c) 2016 Linaro Limited
# SPDX-License-Identifier: Apache-2.0

config SOC_SERIES_GD32E1X
	bool "GD32E1x Series MCU"
	select ARM
	select CPU_CORTEX_M4
	select CPU_CORTEX_M_HAS_DWT
	select CPU_HAS_FPU
	select SOC_FAMILY_GD32
	select HAS_GD32CUBE
	#select CPU_HAS_ARM_MPU
	select HAS_SWO
	help
	  Enable support for GD32E1 MCU series
```

## soc/arm/gigadevice_gd32/gd32e1/Kconfig.soc
```kconfig
# ST Microelectronics STM32F4 MCU line

# Copyright (c) 2016 Linaro Limited.
# SPDX-License-Identifier: Apache-2.0

choice
	prompt "GD32E1x MCU Selection"
	depends on SOC_SERIES_GD32E1X

config SOC_GD32E103VB
	bool "GD32E103VB"

endchoice
```

## soc/arm/infineon_cat1/Kconfig
```kconfig
# Copyright (c) 2021 Cypress Semiconductor Corporation (an Infineon company) or
# an affiliate of Cypress Semiconductor Corporation
# SPDX-License-Identifier: Apache-2.0


config SOC_FAMILY_INFINEON_CAT1
	bool

config SOC_FAMILY_INFINEON_CAT1A
	bool

if SOC_FAMILY_INFINEON_CAT1
source "soc/arm/infineon_cat1/*/Kconfig.soc"

config SOC_FAMILY
	string
	default "infineon_cat1"

endif # SOC_FAMILY_INFINEON_CAT1
```

## soc/arm/infineon_cat1/Kconfig.defconfig
```kconfig
# Copyright (c) 2021 Cypress Semiconductor Corporation (an Infineon company) or
# an affiliate of Cypress Semiconductor Corporation
# SPDX-License-Identifier: Apache-2.0

source "soc/arm/infineon_cat1/*/Kconfig.defconfig"
```

## soc/arm/infineon_cat1/Kconfig.soc
```kconfig
# Copyright (c) 2021, Cypress
# SPDX-License-Identifier: Apache-2.0

source "soc/arm/infineon_cat1/*/Kconfig.series"
```

## soc/arm/infineon_cat1/psoc6/Kconfig.defconfig
```kconfig
# Copyright (c) 2021 Cypress Semiconductor Corporation (an Infineon company) or
# an affiliate of Cypress Semiconductor Corporation
# SPDX-License-Identifier: Apache-2.0

if SOC_FAMILY_INFINEON_CAT1
source "soc/arm/infineon_cat1/psoc6/Kconfig.defconfig.soc.*"

config SOC_SERIES
	default "psoc6"

config SYS_CLOCK_HW_CYCLES_PER_SEC
	default 100000000

config SOC_PSOC6_CM0P_IMAGE_ROM_SIZE
	hex
	default 0x2000 if SOC_PSOC6_CM0P_IMAGE_SLEEP

config SOC_PSOC6_CM0P_IMAGE_RAM_SIZE
	hex
	default 0x2000 if SOC_PSOC6_CM0P_IMAGE_SLEEP

endif # SOC_FAMILY_INFINEON_CAT1A
```

## soc/arm/infineon_cat1/psoc6/Kconfig.defconfig.soc.psoc6_01
```kconfig
# Copyright (c) 2022 Cypress Semiconductor Corporation (an Infineon company) or
# an affiliate of Cypress Semiconductor Corporation
# SPDX-License-Identifier: Apache-2.0

# Infineon PSoC6_01 based MCU default configuration

if SOC_DIE_PSOC6_01

config NUM_IRQS
	default 32 if CPU_CORTEX_M0PLUS
	default 147 if CPU_CORTEX_M4

config SOC
	default "CY8C6036BZI_F04" if SOC_CY8C6036BZI_F04
	default "CY8C6016BZI_F04" if SOC_CY8C6016BZI_F04
	default "CY8C6116BZI_F54" if SOC_CY8C6116BZI_F54
	default "CY8C6136BZI_F14" if SOC_CY8C6136BZI_F14
	default "CY8C6136BZI_F34" if SOC_CY8C6136BZI_F34
	default "CY8C6137BZI_F14" if SOC_CY8C6137BZI_F14
	default "CY8C6137BZI_F34" if SOC_CY8C6137BZI_F34
	default "CY8C6137BZI_F54" if SOC_CY8C6137BZI_F54
	default "CY8C6117BZI_F34" if SOC_CY8C6117BZI_F34
	default "CY8C6246BZI_D04" if SOC_CY8C6246BZI_D04
	default "CY8C6247BZI_D44" if SOC_CY8C6247BZI_D44
	default "CY8C6247BZI_D34" if SOC_CY8C6247BZI_D34
	default "CY8C6247BZI_D54" if SOC_CY8C6247BZI_D54
	default "CY8C6336BZI_BLF03" if SOC_CY8C6336BZI_BLF03
	default "CY8C6316BZI_BLF03" if SOC_CY8C6316BZI_BLF03
	default "CY8C6316BZI_BLF53" if SOC_CY8C6316BZI_BLF53
	default "CY8C6336BZI_BLD13" if SOC_CY8C6336BZI_BLD13
	default "CY8C6347BZI_BLD43" if SOC_CY8C6347BZI_BLD43
	default "CY8C6347BZI_BLD33" if SOC_CY8C6347BZI_BLD33
	default "CY8C6347BZI_BLD53" if SOC_CY8C6347BZI_BLD53
	default "CY8C6347FMI_BLD13" if SOC_CY8C6347FMI_BLD13
	default "CY8C6347FMI_BLD43" if SOC_CY8C6347FMI_BLD43
	default "CY8C6347FMI_BLD33" if SOC_CY8C6347FMI_BLD33
	default "CY8C6347FMI_BLD53" if SOC_CY8C6347FMI_BLD53
	default "CY8C6137FDI_F02" if SOC_CY8C6137FDI_F02
	default "CY8C6117FDI_F02" if SOC_CY8C6117FDI_F02
	default "CY8C6247FDI_D02" if SOC_CY8C6247FDI_D02
	default "CY8C6247FDI_D32" if SOC_CY8C6247FDI_D32
	default "CY8C6336BZI_BUD13" if SOC_CY8C6336BZI_BUD13
	default "CY8C6347BZI_BUD43" if SOC_CY8C6347BZI_BUD43
	default "CY8C6347BZI_BUD33" if SOC_CY8C6347BZI_BUD33
	default "CY8C6347BZI_BUD53" if SOC_CY8C6347BZI_BUD53
	default "CY8C6337BZI_BLF13" if SOC_CY8C6337BZI_BLF13
	default "CY8C6136FDI_F42" if SOC_CY8C6136FDI_F42
	default "CY8C6247FDI_D52" if SOC_CY8C6247FDI_D52
	default "CY8C6136FTI_F42" if SOC_CY8C6136FTI_F42
	default "CY8C6247FTI_D52" if SOC_CY8C6247FTI_D52
	default "CY8C6247BZI_AUD54" if SOC_CY8C6247BZI_AUD54
	default "CY8C6336BZI_BLF04" if SOC_CY8C6336BZI_BLF04
	default "CY8C6316BZI_BLF04" if SOC_CY8C6316BZI_BLF04
	default "CY8C6316BZI_BLF54" if SOC_CY8C6316BZI_BLF54
	default "CY8C6336BZI_BLD14" if SOC_CY8C6336BZI_BLD14
	default "CY8C6347BZI_BLD44" if SOC_CY8C6347BZI_BLD44
	default "CY8C6347BZI_BLD34" if SOC_CY8C6347BZI_BLD34
	default "CY8C6347BZI_BLD54" if SOC_CY8C6347BZI_BLD54
	default "CY8C6247BFI_D54" if SOC_CY8C6247BFI_D54
	default "CYBLE_416045_02_device" if SOC_CYBLE_416045_02
	default "CY8C6347FMI_BUD53" if SOC_CY8C6347FMI_BUD53
	default "CY8C6347FMI_BUD13" if SOC_CY8C6347FMI_BUD13
	default "CY8C6347FMI_BUD43" if SOC_CY8C6347FMI_BUD43
	default "CY8C6347FMI_BUD33" if SOC_CY8C6347FMI_BUD33
	default "CY8C6137WI_F54" if SOC_CY8C6137WI_F54
	default "CY8C6117WI_F34" if SOC_CY8C6117WI_F34
	default "CY8C6247WI_D54" if SOC_CY8C6247WI_D54
	default "CY8C6336LQI_BLF02" if SOC_CY8C6336LQI_BLF02
	default "CY8C6336LQI_BLF42" if SOC_CY8C6336LQI_BLF42
	default "CY8C6347LQI_BLD52" if SOC_CY8C6347LQI_BLD52
	default "CYB06447BZI_BLD54" if SOC_CYB06447BZI_BLD54
	default "CYB06447BZI_BLD53" if SOC_CYB06447BZI_BLD53
	default "CYB06447BZI_D54" if SOC_CYB06447BZI_D54

# add additional die specific params

endif # SOC_DIE_PSOC6_01
```

## soc/arm/infineon_cat1/psoc6/Kconfig.defconfig.soc.psoc6_02
```kconfig
# Copyright (c) 2022 Cypress Semiconductor Corporation (an Infineon company) or
# an affiliate of Cypress Semiconductor Corporation
# SPDX-License-Identifier: Apache-2.0

# Infineon PSoC6_02 based MCU default configuration

if SOC_DIE_PSOC6_02

config NUM_IRQS
	default 32 if CPU_CORTEX_M0PLUS
	default 168 if CPU_CORTEX_M4

config SOC
	default "CYB0644ABZI_S2D44" if SOC_CYB0644ABZI_S2D44
	default "CYS0644ABZI_S2D44" if SOC_CYS0644ABZI_S2D44
	default "CY8C624ABZI_S2D44A0" if SOC_CY8C624ABZI_S2D44A0
	default "CY8C624ABZI_S2D44" if SOC_CY8C624ABZI_S2D44
	default "CY8C624AAZI_S2D44" if SOC_CY8C624AAZI_S2D44
	default "CY8C624AFNI_S2D43" if SOC_CY8C624AFNI_S2D43
	default "CY8C624ABZI_S2D04" if SOC_CY8C624ABZI_S2D04
	default "CY8C624ABZI_S2D14" if SOC_CY8C624ABZI_S2D14
	default "CY8C624AAZI_S2D14" if SOC_CY8C624AAZI_S2D14
	default "CY8C6248AZI_S2D14" if SOC_CY8C6248AZI_S2D14
	default "CY8C6248BZI_S2D44" if SOC_CY8C6248BZI_S2D44
	default "CY8C6248AZI_S2D44" if SOC_CY8C6248AZI_S2D44
	default "CY8C6248FNI_S2D43" if SOC_CY8C6248FNI_S2D43
	default "CY8C614ABZI_S2F04" if SOC_CY8C614ABZI_S2F04
	default "CY8C614AAZI_S2F04" if SOC_CY8C614AAZI_S2F04
	default "CY8C614AFNI_S2F03" if SOC_CY8C614AFNI_S2F03
	default "CY8C614AAZI_S2F14" if SOC_CY8C614AAZI_S2F14
	default "CY8C614ABZI_S2F44" if SOC_CY8C614ABZI_S2F44
	default "CY8C614AAZI_S2F44" if SOC_CY8C614AAZI_S2F44
	default "CY8C614AFNI_S2F43" if SOC_CY8C614AFNI_S2F43
	default "CY8C6148BZI_S2F44" if SOC_CY8C6148BZI_S2F44
	default "CY8C6148AZI_S2F44" if SOC_CY8C6148AZI_S2F44
	default "CY8C6148FNI_S2F43" if SOC_CY8C6148FNI_S2F43
	default "CY8C624ABZI_D44" if SOC_CY8C624ABZI_D44
	default "CY8C624ALQI_S2D42" if SOC_CY8C624ALQI_S2D42
	default "CY8C624ALQI_S2D02" if SOC_CY8C624ALQI_S2D02
	default "CY8C6248LQI_S2D42" if SOC_CY8C6248LQI_S2D42
	default "CY8C6248LQI_S2D02" if SOC_CY8C6248LQI_S2D02
	default "CY8C614ALQI_S2F42" if SOC_CY8C614ALQI_S2F42
	default "CY8C614ALQI_S2F02" if SOC_CY8C614ALQI_S2F02
	default "CY8C6148LQI_S2F42" if SOC_CY8C6148LQI_S2F42
	default "CY8C6148LQI_S2F02" if SOC_CY8C6148LQI_S2F02

# add additional die specific params

endif # SOC_DIE_PSOC6_02
```

## soc/arm/infineon_cat1/psoc6/Kconfig.defconfig.soc.psoc6_03
```kconfig
# Copyright (c) 2022 Cypress Semiconductor Corporation (an Infineon company) or
# an affiliate of Cypress Semiconductor Corporation
# SPDX-License-Identifier: Apache-2.0

# Infineon PSoC6_03 based MCU default configuration

if SOC_DIE_PSOC6_03

config NUM_IRQS
	default 32 if CPU_CORTEX_M0PLUS
	default 138 if CPU_CORTEX_M4

config SOC
	default "CY8C6245AZI_S3D72" if SOC_CY8C6245AZI_S3D72
	default "CY8C6245LQI_S3D72" if SOC_CY8C6245LQI_S3D72
	default "CY8C6245FNI_S3D71" if SOC_CY8C6245FNI_S3D71
	default "CY8C6245AZI_S3D62" if SOC_CY8C6245AZI_S3D62
	default "CY8C6245LQI_S3D62" if SOC_CY8C6245LQI_S3D62
	default "CY8C6245AZI_S3D42" if SOC_CY8C6245AZI_S3D42
	default "CY8C6245LQI_S3D42" if SOC_CY8C6245LQI_S3D42
	default "CYB06445LQI_S3D42" if SOC_CYB06445LQI_S3D42
	default "CY8C6245FNI_S3D41" if SOC_CY8C6245FNI_S3D41
	default "CY8C6245AZI_S3D12" if SOC_CY8C6245AZI_S3D12
	default "CY8C6245LQI_S3D12" if SOC_CY8C6245LQI_S3D12
	default "CY8C6245FNI_S3D11" if SOC_CY8C6245FNI_S3D11
	default "CY8C6245AZI_S3D02" if SOC_CY8C6245AZI_S3D02
	default "CY8C6245LQI_S3D02" if SOC_CY8C6245LQI_S3D02
	default "CY8C6145AZI_S3F72" if SOC_CY8C6145AZI_S3F72
	default "CY8C6145LQI_S3F72" if SOC_CY8C6145LQI_S3F72
	default "CY8C6145FNI_S3F71" if SOC_CY8C6145FNI_S3F71
	default "CY8C6145AZI_S3F62" if SOC_CY8C6145AZI_S3F62
	default "CY8C6145LQI_S3F62" if SOC_CY8C6145LQI_S3F62
	default "CY8C6145AZI_S3F42" if SOC_CY8C6145AZI_S3F42
	default "CY8C6145LQI_S3F42" if SOC_CY8C6145LQI_S3F42
	default "CY8C6145FNI_S3F41" if SOC_CY8C6145FNI_S3F41
	default "CY8C6145AZI_S3F12" if SOC_CY8C6145AZI_S3F12
	default "CY8C6145LQI_S3F12" if SOC_CY8C6145LQI_S3F12
	default "CY8C6145FNI_S3F11" if SOC_CY8C6145FNI_S3F11
	default "CY8C6145AZI_S3F02" if SOC_CY8C6145AZI_S3F02
	default "CY8C6145LQI_S3F02" if SOC_CY8C6145LQI_S3F02

# add additional die specific params

endif # SOC_DIE_PSOC6_03
```

## soc/arm/infineon_cat1/psoc6/Kconfig.defconfig.soc.psoc6_04
```kconfig
# Copyright (c) 2022 Cypress Semiconductor Corporation (an Infineon company) or
# an affiliate of Cypress Semiconductor Corporation
# Copyright (c) David Ullmann
# SPDX-License-Identifier: Apache-2.0

# Infineon PSoC6_04 based MCU default configuration

if SOC_DIE_PSOC6_04

config NUM_IRQS
	default 16 if CPU_CORTEX_M0PLUS
	default 175 if CPU_CORTEX_M4

config SOC
	default "CY8C6244AZI_S4D92" if SOC_CY8C6244AZI_S4D92
	default "CY8C6244LQI_S4D92" if SOC_CY8C6244LQI_S4D92
	default "CY8C6244AZI_S4D93" if SOC_CY8C6244AZI_S4D93
	default "CY8C6244AZI_S4D82" if SOC_CY8C6244AZI_S4D82
	default "CY8C6244LQI_S4D82" if SOC_CY8C6244LQI_S4D82
	default "CY8C6244AZI_S4D83" if SOC_CY8C6244AZI_S4D83
	default "CY8C6244AZI_S4D62" if SOC_CY8C6244AZI_S4D62
	default "CY8C6244LQI_S4D62" if SOC_CY8C6244LQI_S4D62
	default "CY8C6244AZI_S4D12" if SOC_CY8C6244AZI_S4D12
	default "CY8C6244LQI_S4D12" if SOC_CY8C6244LQI_S4D12
	default "CY8C6144AZI_S4F92" if SOC_CY8C6144AZI_S4F92
	default "CY8C6144LQI_S4F92" if SOC_CY8C6144LQI_S4F92
	default "CY8C6144AZI_S4F93" if SOC_CY8C6144AZI_S4F93
	default "CY8C6144AZI_S4F82" if SOC_CY8C6144AZI_S4F82
	default "CY8C6144LQI_S4F82" if SOC_CY8C6144LQI_S4F82
	default "CY8C6144AZI_S4F83" if SOC_CY8C6144AZI_S4F83
	default "CY8C6144AZI_S4F62" if SOC_CY8C6144AZI_S4F62
	default "CY8C6144LQI_S4F62" if SOC_CY8C6144LQI_S4F62
	default "CY8C6144AZI_S4F12" if SOC_CY8C6144AZI_S4F12
	default "CY8C6144LQI_S4F12" if SOC_CY8C6144LQI_S4F12


endif # SOC_DIE_PSOC6_04
```
