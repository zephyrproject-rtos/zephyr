## soc/arm/infineon_cat1/psoc6/Kconfig.soc
```kconfig
# Copyright (c) 2021 Cypress Semiconductor Corporation (an Infineon company) or
# an affiliate of Cypress Semiconductor Corporation
# SPDX-License-Identifier: Apache-2.0

# Infineon PSoC6 die
config SOC_DIE_PSOC6
	bool
	select ARM
	select CPU_CORTEX_M4
	select CPU_HAS_ARM_MPU
	select SOC_FAMILY_INFINEON_CAT1A
	select DYNAMIC_INTERRUPTS
	select CPU_HAS_FPU

# Infineon PSoC6_01 die
config SOC_DIE_PSOC6_01
	bool
	select SOC_DIE_PSOC6

# Infineon PSoC6_02 die
config SOC_DIE_PSOC6_02
	bool
	select SOC_DIE_PSOC6

# Infineon PSoC6_03 die
config SOC_DIE_PSOC6_03
	bool
	select SOC_DIE_PSOC6

# Infineon PSoC6_04 die
config SOC_DIE_PSOC6_04
	bool
	select SOC_DIE_PSOC6

# Infineon soc packages
config SOC_PACKAGE_PSOC6_01_124_BGA
	bool

config SOC_PACKAGE_PSOC6_01_116_BGA_BLE
	bool

config SOC_PACKAGE_PSOC6_01_104_M_CSP_BLE
	bool

config SOC_PACKAGE_PSOC6_01_80_WLCSP
	bool

config SOC_PACKAGE_PSOC6_01_116_BGA_USB
	bool

config SOC_PACKAGE_PSOC6_01_124_BGA_SIP
	bool

config SOC_PACKAGE_PSOC6_01_43_SMT
	bool

config SOC_PACKAGE_PSOC6_01_104_M_CSP_BLE_USB
	bool

config SOC_PACKAGE_PSOC6_01_68_QFN_BLE
	bool

config SOC_PACKAGE_PSOC6_02_124_BGA
	bool

config SOC_PACKAGE_PSOC6_02_128_TQFP
	bool

config SOC_PACKAGE_PSOC6_02_100_WLCSP
	bool

config SOC_PACKAGE_PSOC6_02_68_QFN
	bool

config SOC_PACKAGE_PSOC6_03_100_TQFP
	bool

config SOC_PACKAGE_PSOC6_03_68_QFN
	bool

config SOC_PACKAGE_PSOC6_03_49_WLCSP
	bool

config SOC_PACKAGE_PSOC6_04_64_TQFP
	bool

config SOC_PACKAGE_PSOC6_04_68_QFN
	bool

config SOC_PACKAGE_PSOC6_04_80_TQFP
	bool

## Infineon MCUs
choice
	prompt "MPN"
	osource "soc/arm/infineon_cat1/psoc6/Kconfig.soc.psoc6_*"
endchoice

if SOC_FAMILY_INFINEON_CAT1A
## PSoC™ 6 Cortex M0+ prebuilt images
choice
	prompt "PSoC™ 6 Cortex M0+ prebuilt images"
	help
	  Choose the prebuilt application image to be executed on the Cortex-M0+ core of the PSoC™ 6
	  dual-core MCU. The image is responsible for booting the Cortex-M4 on the device.

config SOC_PSOC6_CM0P_IMAGE_SLEEP
	bool "DeepSleep"
	help
	  DeepSleep prebuilt application image is executed on the Cortex-M0+ core of the PSoC™ 6 BLE
	  dual-core MCU.The image is provided as C array ready to be compiled as part of the Cortex-M4
	  application. The Cortex-M0+ application code is placed to internal flash by the Cortex-M4
	  linker script.

endchoice

endif # SOC_FAMILY_INFINEON_CAT1A
```

## soc/arm/infineon_cat1/psoc6/Kconfig.soc.psoc6_02
```kconfig
# Copyright (c) 2022 Cypress Semiconductor Corporation (an Infineon company) or
# an affiliate of Cypress Semiconductor Corporation
# SPDX-License-Identifier: Apache-2.0

# Infineon PSoC6_02 series MCUs

config SOC_CYB0644ABZI_S2D44
	bool "CYB0644ABZI_S2D44"
	select SOC_DIE_PSOC6_02
	select SOC_PACKAGE_PSOC6_02_124_BGA
	depends on SOC_SERIES_PSOC_64

config SOC_CYS0644ABZI_S2D44
	bool "CYS0644ABZI_S2D44"
	select SOC_DIE_PSOC6_02
	select SOC_PACKAGE_PSOC6_02_124_BGA
	depends on SOC_SERIES_PSOC_64

config SOC_CY8C624ABZI_S2D44A0
	bool "CY8C624ABZI_S2D44A0"
	select SOC_DIE_PSOC6_02
	select SOC_PACKAGE_PSOC6_02_124_BGA
	depends on SOC_SERIES_PSOC_62

config SOC_CY8C624ABZI_S2D44
	bool "CY8C624ABZI_S2D44"
	select SOC_DIE_PSOC6_02
	select SOC_PACKAGE_PSOC6_02_124_BGA
	depends on SOC_SERIES_PSOC_62

config SOC_CY8C624AAZI_S2D44
	bool "CY8C624AAZI_S2D44"
	select SOC_DIE_PSOC6_02
	select SOC_PACKAGE_PSOC6_02_128_TQFP
	depends on SOC_SERIES_PSOC_62

config SOC_CY8C624AFNI_S2D43
	bool "CY8C624AFNI_S2D43"
	select SOC_DIE_PSOC6_02
	select SOC_PACKAGE_PSOC6_02_100_WLCSP
	depends on SOC_SERIES_PSOC_62

config SOC_CY8C624ABZI_S2D04
	bool "CY8C624ABZI_S2D04"
	select SOC_DIE_PSOC6_02
	select SOC_PACKAGE_PSOC6_02_124_BGA
	depends on SOC_SERIES_PSOC_62

config SOC_CY8C624ABZI_S2D14
	bool "CY8C624ABZI_S2D14"
	select SOC_DIE_PSOC6_02
	select SOC_PACKAGE_PSOC6_02_124_BGA
	depends on SOC_SERIES_PSOC_62

config SOC_CY8C624AAZI_S2D14
	bool "CY8C624AAZI_S2D14"
	select SOC_DIE_PSOC6_02
	select SOC_PACKAGE_PSOC6_02_128_TQFP
	depends on SOC_SERIES_PSOC_62

config SOC_CY8C6248AZI_S2D14
	bool "CY8C6248AZI_S2D14"
	select SOC_DIE_PSOC6_02
	select SOC_PACKAGE_PSOC6_02_128_TQFP
	depends on SOC_SERIES_PSOC_62

config SOC_CY8C6248BZI_S2D44
	bool "CY8C6248BZI_S2D44"
	select SOC_DIE_PSOC6_02
	select SOC_PACKAGE_PSOC6_02_124_BGA
	depends on SOC_SERIES_PSOC_62

config SOC_CY8C6248AZI_S2D44
	bool "CY8C6248AZI_S2D44"
	select SOC_DIE_PSOC6_02
	select SOC_PACKAGE_PSOC6_02_128_TQFP
	depends on SOC_SERIES_PSOC_62

config SOC_CY8C6248FNI_S2D43
	bool "CY8C6248FNI_S2D43"
	select SOC_DIE_PSOC6_02
	select SOC_PACKAGE_PSOC6_02_100_WLCSP
	depends on SOC_SERIES_PSOC_62

config SOC_CY8C614ABZI_S2F04
	bool "CY8C614ABZI_S2F04"
	select SOC_DIE_PSOC6_02
	select SOC_PACKAGE_PSOC6_02_124_BGA
	depends on SOC_SERIES_PSOC_61

config SOC_CY8C614AAZI_S2F04
	bool "CY8C614AAZI_S2F04"
	select SOC_DIE_PSOC6_02
	select SOC_PACKAGE_PSOC6_02_128_TQFP
	depends on SOC_SERIES_PSOC_61

config SOC_CY8C614AFNI_S2F03
	bool "CY8C614AFNI_S2F03"
	select SOC_DIE_PSOC6_02
	select SOC_PACKAGE_PSOC6_02_100_WLCSP
	depends on SOC_SERIES_PSOC_61

config SOC_CY8C614AAZI_S2F14
	bool "CY8C614AAZI_S2F14"
	select SOC_DIE_PSOC6_02
	select SOC_PACKAGE_PSOC6_02_128_TQFP
	depends on SOC_SERIES_PSOC_61

config SOC_CY8C614ABZI_S2F44
	bool "CY8C614ABZI_S2F44"
	select SOC_DIE_PSOC6_02
	select SOC_PACKAGE_PSOC6_02_124_BGA
	depends on SOC_SERIES_PSOC_61

config SOC_CY8C614AAZI_S2F44
	bool "CY8C614AAZI_S2F44"
	select SOC_DIE_PSOC6_02
	select SOC_PACKAGE_PSOC6_02_128_TQFP
	depends on SOC_SERIES_PSOC_61

config SOC_CY8C614AFNI_S2F43
	bool "CY8C614AFNI_S2F43"
	select SOC_DIE_PSOC6_02
	select SOC_PACKAGE_PSOC6_02_100_WLCSP
	depends on SOC_SERIES_PSOC_61

config SOC_CY8C6148BZI_S2F44
	bool "CY8C6148BZI_S2F44"
	select SOC_DIE_PSOC6_02
	select SOC_PACKAGE_PSOC6_02_124_BGA
	depends on SOC_SERIES_PSOC_61

config SOC_CY8C6148AZI_S2F44
	bool "CY8C6148AZI_S2F44"
	select SOC_DIE_PSOC6_02
	select SOC_PACKAGE_PSOC6_02_128_TQFP
	depends on SOC_SERIES_PSOC_61

config SOC_CY8C6148FNI_S2F43
	bool "CY8C6148FNI_S2F43"
	select SOC_DIE_PSOC6_02
	select SOC_PACKAGE_PSOC6_02_100_WLCSP
	depends on SOC_SERIES_PSOC_61

config SOC_CY8C624ABZI_D44
	bool "CY8C624ABZI_D44"
	select SOC_DIE_PSOC6_02
	select SOC_PACKAGE_PSOC6_02_124_BGA
	depends on SOC_SERIES_PSOC_62

config SOC_CY8C624ALQI_S2D42
	bool "CY8C624ALQI_S2D42"
	select SOC_DIE_PSOC6_02
	select SOC_PACKAGE_PSOC6_02_68_QFN
	depends on SOC_SERIES_PSOC_62

config SOC_CY8C624ALQI_S2D02
	bool "CY8C624ALQI_S2D02"
	select SOC_DIE_PSOC6_02
	select SOC_PACKAGE_PSOC6_02_68_QFN
	depends on SOC_SERIES_PSOC_62

config SOC_CY8C6248LQI_S2D42
	bool "CY8C6248LQI_S2D42"
	select SOC_DIE_PSOC6_02
	select SOC_PACKAGE_PSOC6_02_68_QFN
	depends on SOC_SERIES_PSOC_62

config SOC_CY8C6248LQI_S2D02
	bool "CY8C6248LQI_S2D02"
	select SOC_DIE_PSOC6_02
	select SOC_PACKAGE_PSOC6_02_68_QFN
	depends on SOC_SERIES_PSOC_62

config SOC_CY8C614ALQI_S2F42
	bool "CY8C614ALQI_S2F42"
	select SOC_DIE_PSOC6_02
	select SOC_PACKAGE_PSOC6_02_68_QFN
	depends on SOC_SERIES_PSOC_61

config SOC_CY8C614ALQI_S2F02
	bool "CY8C614ALQI_S2F02"
	select SOC_DIE_PSOC6_02
	select SOC_PACKAGE_PSOC6_02_68_QFN
	depends on SOC_SERIES_PSOC_61

config SOC_CY8C6148LQI_S2F42
	bool "CY8C6148LQI_S2F42"
	select SOC_DIE_PSOC6_02
	select SOC_PACKAGE_PSOC6_02_68_QFN
	depends on SOC_SERIES_PSOC_61

config SOC_CY8C6148LQI_S2F02
	bool "CY8C6148LQI_S2F02"
	select SOC_DIE_PSOC6_02
	select SOC_PACKAGE_PSOC6_02_68_QFN
	depends on SOC_SERIES_PSOC_61
```

## soc/arm/infineon_cat1/psoc6/Kconfig.soc.psoc6_03
```kconfig
# Copyright (c) 2022 Cypress Semiconductor Corporation (an Infineon company) or
# an affiliate of Cypress Semiconductor Corporation
# SPDX-License-Identifier: Apache-2.0

# Infineon PSoC6_03 series MCUs

config SOC_CY8C6245AZI_S3D72
	bool "CY8C6245AZI_S3D72"
	select SOC_DIE_PSOC6_03
	select SOC_PACKAGE_PSOC6_03_100_TQFP
	depends on SOC_SERIES_PSOC_62

config SOC_CY8C6245LQI_S3D72
	bool "CY8C6245LQI_S3D72"
	select SOC_DIE_PSOC6_03
	select SOC_PACKAGE_PSOC6_03_68_QFN
	depends on SOC_SERIES_PSOC_62

config SOC_CY8C6245FNI_S3D71
	bool "CY8C6245FNI_S3D71"
	select SOC_DIE_PSOC6_03
	select SOC_PACKAGE_PSOC6_03_49_WLCSP
	depends on SOC_SERIES_PSOC_62

config SOC_CY8C6245AZI_S3D62
	bool "CY8C6245AZI_S3D62"
	select SOC_DIE_PSOC6_03
	select SOC_PACKAGE_PSOC6_03_100_TQFP
	depends on SOC_SERIES_PSOC_62

config SOC_CY8C6245LQI_S3D62
	bool "CY8C6245LQI_S3D62"
	select SOC_DIE_PSOC6_03
	select SOC_PACKAGE_PSOC6_03_68_QFN
	depends on SOC_SERIES_PSOC_62

config SOC_CY8C6245AZI_S3D42
	bool "CY8C6245AZI_S3D42"
	select SOC_DIE_PSOC6_03
	select SOC_PACKAGE_PSOC6_03_100_TQFP
	depends on SOC_SERIES_PSOC_62

config SOC_CY8C6245LQI_S3D42
	bool "CY8C6245LQI_S3D42"
	select SOC_DIE_PSOC6_03
	select SOC_PACKAGE_PSOC6_03_68_QFN
	depends on SOC_SERIES_PSOC_62

config SOC_CYB06445LQI_S3D42
	bool "CYB06445LQI_S3D42"
	select SOC_DIE_PSOC6_03
	select SOC_PACKAGE_PSOC6_03_68_QFN
	depends on SOC_SERIES_PSOC_64

config SOC_CY8C6245FNI_S3D41
	bool "CY8C6245FNI_S3D41"
	select SOC_DIE_PSOC6_03
	select SOC_PACKAGE_PSOC6_03_49_WLCSP
	depends on SOC_SERIES_PSOC_62

config SOC_CY8C6245AZI_S3D12
	bool "CY8C6245AZI_S3D12"
	select SOC_DIE_PSOC6_03
	select SOC_PACKAGE_PSOC6_03_100_TQFP
	depends on SOC_SERIES_PSOC_62

config SOC_CY8C6245LQI_S3D12
	bool "CY8C6245LQI_S3D12"
	select SOC_DIE_PSOC6_03
	select SOC_PACKAGE_PSOC6_03_68_QFN
	depends on SOC_SERIES_PSOC_62

config SOC_CY8C6245FNI_S3D11
	bool "CY8C6245FNI_S3D11"
	select SOC_DIE_PSOC6_03
	select SOC_PACKAGE_PSOC6_03_49_WLCSP
	depends on SOC_SERIES_PSOC_62

config SOC_CY8C6245AZI_S3D02
	bool "CY8C6245AZI_S3D02"
	select SOC_DIE_PSOC6_03
	select SOC_PACKAGE_PSOC6_03_100_TQFP
	depends on SOC_SERIES_PSOC_62

config SOC_CY8C6245LQI_S3D02
	bool "CY8C6245LQI_S3D02"
	select SOC_DIE_PSOC6_03
	select SOC_PACKAGE_PSOC6_03_68_QFN
	depends on SOC_SERIES_PSOC_62

config SOC_CY8C6145AZI_S3F72
	bool "CY8C6145AZI_S3F72"
	select SOC_DIE_PSOC6_03
	select SOC_PACKAGE_PSOC6_03_100_TQFP
	depends on SOC_SERIES_PSOC_61

config SOC_CY8C6145LQI_S3F72
	bool "CY8C6145LQI_S3F72"
	select SOC_DIE_PSOC6_03
	select SOC_PACKAGE_PSOC6_03_68_QFN
	depends on SOC_SERIES_PSOC_61

config SOC_CY8C6145FNI_S3F71
	bool "CY8C6145FNI_S3F71"
	select SOC_DIE_PSOC6_03
	select SOC_PACKAGE_PSOC6_03_49_WLCSP
	depends on SOC_SERIES_PSOC_61

config SOC_CY8C6145AZI_S3F62
	bool "CY8C6145AZI_S3F62"
	select SOC_DIE_PSOC6_03
	select SOC_PACKAGE_PSOC6_03_100_TQFP
	depends on SOC_SERIES_PSOC_61

config SOC_CY8C6145LQI_S3F62
	bool "CY8C6145LQI_S3F62"
	select SOC_DIE_PSOC6_03
	select SOC_PACKAGE_PSOC6_03_68_QFN
	depends on SOC_SERIES_PSOC_61

config SOC_CY8C6145AZI_S3F42
	bool "CY8C6145AZI_S3F42"
	select SOC_DIE_PSOC6_03
	select SOC_PACKAGE_PSOC6_03_100_TQFP
	depends on SOC_SERIES_PSOC_61

config SOC_CY8C6145LQI_S3F42
	bool "CY8C6145LQI_S3F42"
	select SOC_DIE_PSOC6_03
	select SOC_PACKAGE_PSOC6_03_68_QFN
	depends on SOC_SERIES_PSOC_61

config SOC_CY8C6145FNI_S3F41
	bool "CY8C6145FNI_S3F41"
	select SOC_DIE_PSOC6_03
	select SOC_PACKAGE_PSOC6_03_49_WLCSP
	depends on SOC_SERIES_PSOC_61

config SOC_CY8C6145AZI_S3F12
	bool "CY8C6145AZI_S3F12"
	select SOC_DIE_PSOC6_03
	select SOC_PACKAGE_PSOC6_03_100_TQFP
	depends on SOC_SERIES_PSOC_61

config SOC_CY8C6145LQI_S3F12
	bool "CY8C6145LQI_S3F12"
	select SOC_DIE_PSOC6_03
	select SOC_PACKAGE_PSOC6_03_68_QFN
	depends on SOC_SERIES_PSOC_61

config SOC_CY8C6145FNI_S3F11
	bool "CY8C6145FNI_S3F11"
	select SOC_DIE_PSOC6_03
	select SOC_PACKAGE_PSOC6_03_49_WLCSP
	depends on SOC_SERIES_PSOC_61

config SOC_CY8C6145AZI_S3F02
	bool "CY8C6145AZI_S3F02"
	select SOC_DIE_PSOC6_03
	select SOC_PACKAGE_PSOC6_03_100_TQFP
	depends on SOC_SERIES_PSOC_61

config SOC_CY8C6145LQI_S3F02
	bool "CY8C6145LQI_S3F02"
	select SOC_DIE_PSOC6_03
	select SOC_PACKAGE_PSOC6_03_68_QFN
	depends on SOC_SERIES_PSOC_61
```

## soc/arm/infineon_cat1/psoc6/Kconfig.soc.psoc6_04
```kconfig
# Copyright (c) 2021 Cypress Semiconductor Corporation.
# SPDX-License-Identifier: Apache-2.0

# Infineon PSoC6_04 series MCUs
config SOC_CY8C6244AZI_S4D92
    bool "CY8C6244AZI_S4D92"
    select SOC_DIE_PSOC6_04
    depends on SOC_SERIES_PSOC_62

config SOC_CY8C6244LQI_S4D92
    bool "CY8C6244LQI_S4D92"
    select SOC_DIE_PSOC6_04
    depends on SOC_SERIES_PSOC_62

config SOC_CY8C6244AZI_S4D93
    bool "CY8C6244AZI_S4D93"
    select SOC_DIE_PSOC6_04
    depends on SOC_SERIES_PSOC_62

config SOC_CY8C6244AZI_S4D82
    bool "CY8C6244AZI_S4D82"
    select SOC_DIE_PSOC6_04
    depends on SOC_SERIES_PSOC_62

config SOC_CY8C6244LQI_S4D82
    bool "CY8C6244LQI_S4D82"
    select SOC_DIE_PSOC6_04
    depends on SOC_SERIES_PSOC_62

config SOC_CY8C6244AZI_S4D83
    bool "CY8C6244AZI_S4D83"
    select SOC_DIE_PSOC6_04
    depends on SOC_SERIES_PSOC_62

config SOC_CY8C6244AZI_S4D62
    bool "CY8C6244AZI_S4D62"
    select SOC_DIE_PSOC6_04
    depends on SOC_SERIES_PSOC_62

config SOC_CY8C6244LQI_S4D62
    bool "CY8C6244LQI_S4D62"
    select SOC_DIE_PSOC6_04
    depends on SOC_SERIES_PSOC_62

config SOC_CY8C6244AZI_S4D12
    bool "CY8C6244AZI_S4D12"
    select SOC_DIE_PSOC6_04
    depends on SOC_SERIES_PSOC_62

config SOC_CY8C6244LQI_S4D12
    bool "CY8C6244LQI_S4D12"
    select SOC_DIE_PSOC6_04
    depends on SOC_SERIES_PSOC_62

config SOC_CY8C6144AZI_S4F92
    bool "CY8C6144AZI_S4F92"
    select SOC_DIE_PSOC6_04
    depends on SOC_SERIES_PSOC_61

config SOC_CY8C6144LQI_S4F92
    bool "CY8C6144LQI_S4F92"
    select SOC_DIE_PSOC6_04
    depends on SOC_SERIES_PSOC_61

config SOC_CY8C6144AZI_S4F93
    bool "CY8C6144AZI_S4F93"
    select SOC_DIE_PSOC6_04
    depends on SOC_SERIES_PSOC_61

config SOC_CY8C6144AZI_S4F82
    bool "CY8C6144AZI_S4F82"
    select SOC_DIE_PSOC6_04
    depends on SOC_SERIES_PSOC_61

config SOC_CY8C6144LQI_S4F82
    bool "CY8C6144LQI_S4F82"
    select SOC_DIE_PSOC6_04
    depends on SOC_SERIES_PSOC_61

config SOC_CY8C6144AZI_S4F83
    bool "CY8C6144AZI_S4F83"
    select SOC_DIE_PSOC6_04
    depends on SOC_SERIES_PSOC_61

config SOC_CY8C6144AZI_S4F62
    bool "CY8C6144AZI_S4F62"
    select SOC_DIE_PSOC6_04
    depends on SOC_SERIES_PSOC_61

config SOC_CY8C6144LQI_S4F62
    bool "CY8C6144LQI_S4F62"
    select SOC_DIE_PSOC6_04
    depends on SOC_SERIES_PSOC_61

config SOC_CY8C6144AZI_S4F12
    bool "CY8C6144AZI_S4F12"
    select SOC_DIE_PSOC6_04
    depends on SOC_SERIES_PSOC_61

config SOC_CY8C6144LQI_S4F12
    bool "CY8C6144LQI_S4F12"
    select SOC_DIE_PSOC6_04
    depends on SOC_SERIES_PSOC_61
```

## soc/arm/infineon_xmc/1xxx/Kconfig.defconfig.series
```kconfig
# SPDX-License-Identifier: Apache-2.0
#
# XMC 1xxx series configuration options
# Copyright (c) 2021 Linumiz
# Author: Parthiban Nallathambi <parthiban@linumiz.com>

if SOC_SERIES_XMC_1XXX

config SOC_SERIES
	default "1xxx"

config NUM_IRQS
	default 31

config UART_XMC
	default y
	depends on SERIAL

source "soc/arm/infineon_xmc/1xxx/Kconfig.defconfig.xmc*"

endif # SOC_SERIES_XMC_1XXX
```

## soc/arm/infineon_xmc/1xxx/Kconfig.defconfig.xmc1400
```kconfig
# Infineon XMC1400 arduino kit platform configuration options
#
# Copyright (c) 2021 Linumiz
# Author: Parthiban Nallathambi <parthiban@linumiz.com>
# SPDX-License-Identifier: Apache-2.0

if SOC_XMC1400

config SOC
	default "XMC1400"

config SYS_CLOCK_HW_CYCLES_PER_SEC
	default 48000000

config NUM_IRQS
	default 31

endif # SOC_XMC1400
```

## soc/arm/infineon_xmc/1xxx/Kconfig.series
```kconfig
# XMC1xxx MCU series
#
# Copyright (c) 2021 Linumiz
# Author: Parthiban Nallathambi <parthiban@linumiz.com>
# SPDX-License-Identifier: Apache-2.0

config SOC_SERIES_XMC_1XXX
	bool "XMC 1xxx Series MCU"
	select ARM
	select CPU_CORTEX_M0
	select SOC_FAMILY_XMC
	select CPU_HAS_FPU
	select HAS_XMCLIB_UART
	help
	  Enable support for XMC 1xxx MCU series
```
