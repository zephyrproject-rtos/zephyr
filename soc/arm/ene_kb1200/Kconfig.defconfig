## soc/arm/ene_kb1200/Kconfig.defconfig
```kconfig
# SPDX-License-Identifier: Apache-2.0

# Copyright (c) 2020 ENE Technology Corporation.
# SPDX-License-Identifier: Apache-2.0

if SOC_ENE_KB1200

config SOC
	default "ene_kb1200"

config NUM_IRQS
	default 64

config SYS_CLOCK_HW_CYCLES_PER_SEC
	default 48000000

config CORTEX_M_SYSTICK
	default y

endif # SOC_ENE_KB1200
```

## soc/arm/ene_kb1200/Kconfig.soc
```kconfig
# ENE Cortex-M4 Embedded Controller

# Copyright (c) 2020 ENE Technology Corporation.
# SPDX-License-Identifier: Apache-2.0

config SOC_ENE_KB1200
	bool "ENE KB1200"
	select ARM
	select CPU_CORTEX_M4
	select CPU_HAS_ARM_MPU
	select CPU_CORTEX_M_HAS_DWT
	select CPU_HAS_FPU
	help
	  Enable support for ENE KB1200
```

## soc/arm/fvp_aem/Kconfig.defconfig
```kconfig
# Copyright (c) 2021 Carlo Caione <ccaione@baylibre.com>
# SPDX-License-Identifier: Apache-2.0

if SOC_SERIES_FVP_AEM

config SYS_CLOCK_HW_CYCLES_PER_SEC
	default 100000000

config NUM_IRQS
	default 16384 if GIC_V3_ITS
	default 128 if !GIC_V3_ITS

# Workaround for not being able to have commas in macro arguments
DT_CHOSEN_Z_FLASH := zephyr,flash

config FLASH_SIZE
	default $(dt_chosen_reg_size_int,$(DT_CHOSEN_Z_FLASH),0,K)

config FLASH_BASE_ADDRESS
	default $(dt_chosen_reg_addr_hex,$(DT_CHOSEN_Z_FLASH))

endif # SOC_SERIES_FVP_AEM
```

## soc/arm/fvp_aem/Kconfig.soc
```kconfig
# Copyright (c) 2021 Carlo Caione <ccaione@baylibre.com>
# SPDX-License-Identifier: Apache-2.0

config SOC_SERIES_FVP_AEM
	bool

config SOC_V8A
	bool
	select SOC_SERIES_FVP_AEM
	select SOC_FAMILY_ARM64

config SOC_V9A
	bool
	select SOC_SERIES_FVP_AEM
	select SOC_FAMILY_ARM64

config SOC_A320
	bool
	select SOC_SERIES_FVP_AEM
	select SOC_FAMILY_ARM64

config SOC_V8A_AARCH32
	bool
	select SOC_SERIES_FVP_AEM
	select SOC_FAMILY_ARM

config SOC
	default "v8a" if SOC_V8A
	default "v9a" if SOC_V9A
	default "a320" if SOC_A320
	default "v8a_aarch32" if SOC_V8A_AARCH32

config SOC_SERIES
	default "fvp_aem" if SOC_SERIES_FVP_AEM
```

## soc/arm/fvp_aemv8a/Kconfig
```kconfig
# Copyright (c) 2021 Carlo Caione <ccaione@baylibre.com>
# SPDX-License-Identifier: Apache-2.0

config SOC_SERIES_FVP_AEMV8A
	select ARM64

config SOC_FVP_BASE_REVC_2XAEMV8A
	select CPU_CORTEX_A53
```

## soc/arm/fvp_aemv8a/Kconfig.defconfig
```kconfig
# Copyright (c) 2021 Carlo Caione <ccaione@baylibre.com>
# SPDX-License-Identifier: Apache-2.0

if SOC_SERIES_FVP_AEMV8A

config SYS_CLOCK_HW_CYCLES_PER_SEC
	default 100000000

config NUM_IRQS
	default 16384 if GIC_V3_ITS
	default 128 if !GIC_V3_ITS

endif # SOC_SERIES_FVP_AEMV8A
```

## soc/arm/fvp_aemv8a/Kconfig.soc
```kconfig
# Copyright (c) 2021 Carlo Caione <ccaione@baylibre.com>
# SPDX-License-Identifier: Apache-2.0

config SOC_SERIES_FVP_AEMV8A
	bool
	select SOC_FAMILY_ARM64

config SOC_FVP_BASE_REVC_2XAEMV8A
	bool

config SOC
	default "fvp_base_revc_2xaemv8a" if SOC_FVP_BASE_REVC_2XAEMV8A

config SOC_SERIES
	default "fvp_aemv8a" if SOC_SERIES_FVP_AEMV8A
```

## soc/arm/fvp_aemv8r/Kconfig
```kconfig
# Copyright (c) 2021 Arm Limited (or its affiliates). All rights reserved.
# SPDX-License-Identifier: Apache-2.0

config SOC_FVP_AEMV8R_AARCH64
	select CPU_CORTEX_R82
	select CPU_HAS_MPU
	select GIC_SINGLE_SECURITY_STATE
	select ARM64

config SOC_FVP_AEMV8R_AARCH32
	select CPU_CORTEX_R52
	select CPU_HAS_ARM_MPU
	select CPU_HAS_MPU
	select VFP_DP_D32_FP16_FMAC if !USE_SWITCH
	select GIC_SINGLE_SECURITY_STATE
	select PLATFORM_SPECIFIC_INIT
	select ARM
```

## soc/arm/fvp_aemv8r/Kconfig.defconfig
```kconfig
# Copyright (c) 2021 Arm Limited (or its affiliates). All rights reserved.
# SPDX-License-Identifier: Apache-2.0

if SOC_SERIES_FVP_AEMV8R

config SYS_CLOCK_HW_CYCLES_PER_SEC
	default 100000000

config NUM_IRQS
	default 128

# Workaround for not being able to have commas in macro arguments
DT_CHOSEN_Z_FLASH := zephyr,flash

config FLASH_SIZE
	default $(dt_chosen_reg_size_int,$(DT_CHOSEN_Z_FLASH),0,K)

config FLASH_BASE_ADDRESS
	default $(dt_chosen_reg_addr_hex,$(DT_CHOSEN_Z_FLASH))

config MAX_DOMAIN_PARTITIONS
	default 8 if SOC_FVP_AEMV8R_AARCH64
	default 24 if USERSPACE && SOC_FVP_AEMV8R_AARCH32

endif # SOC_SERIES_FVP_AEMV8R
```

## soc/arm/fvp_aemv8r/Kconfig.soc
```kconfig
# Copyright (c) 2021 Arm Limited (or its affiliates). All rights reserved.
# SPDX-License-Identifier: Apache-2.0

config SOC_SERIES_FVP_AEMV8R
	bool
	help
	  Enable support for ARM FVP AEMv8R AArch64 Series

config SOC_FVP_AEMV8R_AARCH64
	bool
	select SOC_SERIES_FVP_AEMV8R
	select SOC_FAMILY_ARM64

config SOC_FVP_AEMV8R_AARCH32
	bool
	select SOC_SERIES_FVP_AEMV8R
	select SOC_FAMILY_ARM

config SOC_FVP_AEMV8R_SIMULATE_CPU_PM
	bool "Simulate CPU Power Management for FVP_BaseR_AEMv8R"
	depends on SOC_FVP_AEMV8R_AARCH64
	help
	  It simulates the cpu power management function for
	  FVP_BaseR_AEMv8R. When zephyr kernel try to bring up secondary
	  core through pm_cpu_on(), it always succeeds because
	  it indeed bring up secondary core successfully.

config SOC_SERIES
	default "fvp_aemv8r" if SOC_SERIES_FVP_AEMV8R

config SOC
	default "fvp_aemv8r_aarch64" if SOC_FVP_AEMV8R_AARCH64
	default "fvp_aemv8r_aarch32" if SOC_FVP_AEMV8R_AARCH32
```

## soc/arm/gd_gd32/Kconfig.soc
```kconfig
# Copyright (c) 2021, ATL Electronics
# SPDX-License-Identifier: Apache-2.0

source "soc/arm/gd_gd32/*/Kconfig.series"
```

## soc/arm/gd_gd32/gd32a50x/Kconfig.defconfig.gd32a503
```kconfig
# Copyright (c) 2022 YuLong Yao <feilongphone@gmail.com>
# SPDX-License-Identifier: Apache-2.0

config SOC
	default "gd32a503"

config SYS_CLOCK_HW_CYCLES_PER_SEC
	default $(dt_node_int_prop_int,/cpus/cpu@0,clock-frequency)

config NUM_IRQS
	default 82
```

## soc/arm/gd_gd32/gd32a50x/Kconfig.soc
```kconfig
# Copyright (c) 2022 YuLong Yao <feilongphone@gmail.com>
# SPDX-License-Identifier: Apache-2.0

choice
	prompt "GigaDevice GD32A50X MCU Selection"
	depends on SOC_SERIES_GD32A50X

	config SOC_GD32A503
		bool "gd32a503"

endchoice
```

## soc/arm/gd_gd32/gd32f3x0/Kconfig.soc
```kconfig
# Copyright (c) 2021 BrainCo Inc.
# SPDX-License-Identifier: Apache-2.0

choice
	prompt "GigaDevice GD32F3X0 MCU Selection"
	depends on SOC_SERIES_GD32F3X0

	config SOC_GD32F350
		bool "gd32f350"
endchoice
```

## soc/arm/gd_gd32/gd32f403/Kconfig.defconfig.gd32f403
```kconfig
# Copyright (c) 2021, ATL Electronics
# SPDX-License-Identifier: Apache-2.0

config SOC
	default "gd32f403"

config SYS_CLOCK_HW_CYCLES_PER_SEC
	default $(dt_node_int_prop_int,/cpus/cpu@0,clock-frequency)

config NUM_IRQS
	default 68
```

## soc/arm/gd_gd32/gd32f403/Kconfig.soc
```kconfig
# Copyright (c) 2021, ATL Electronics
# SPDX-License-Identifier: Apache-2.0

choice
	prompt "GigaDevice GD32F403 MCU Selection"
	depends on SOC_SERIES_GD32F403

	config SOC_GD32F403
		bool "gd32f403"

endchoice
```

## soc/arm/gd_gd32/gd32l23x/Kconfig.soc
```kconfig
# Copyright (c) 2022 BrainCo Inc.
# SPDX-License-Identifier: Apache-2.0

choice
	prompt "GigaDevice GD32L23X MCU Selection"
	depends on SOC_SERIES_GD32L23X

	config SOC_GD32L233
		bool "gd32l233"
endchoice
```

## soc/arm/gigadevice/Kconfig
```kconfig
# Copyright (c) 2021, ATL Electronics
# SPDX-License-Identifier: Apache-2.0

config SOC_FAMILY_GD32
	bool
	select HAS_GD32_HAL
	select BUILD_OUTPUT_HEX
	select HAS_SEGGER_RTT if ZEPHYR_SEGGER_MODULE

config SOC_FAMILY
	string
	default "gigadevice"
	depends on SOC_FAMILY_GD32

config SOC_FAMILY_GD32_ARM
	bool
	select SOC_FAMILY_GD32

if SOC_FAMILY_GD32_ARM

source "soc/arm/gigadevice/*/Kconfig.soc"

endif # SOC_FAMILY_GD32_ARM
```

## soc/arm/gigadevice/Kconfig.defconfig
```kconfig
# Copyright (c) 2021, ATL Electronics
# SPDX-License-Identifier: Apache-2.0

if SOC_FAMILY_GD32

source "soc/arm/gigadevice/*/Kconfig.defconfig.series"

config PINCTRL
	default y

config RESET
	default y

config CLOCK_CONTROL
	default y

endif # SOC_FAMILY_GD32
```

## soc/arm/gigadevice/Kconfig.soc
```kconfig
# Copyright (c) 2021, ATL Electronics
# SPDX-License-Identifier: Apache-2.0

source "soc/arm/gigadevice/*/Kconfig.series"
```

## soc/arm/gigadevice/gd32a50x/Kconfig.defconfig.series
```kconfig
# Copyright (c) 2022 YuLong Yao <feilongphone@gmail.com>
# SPDX-License-Identifier: Apache-2.0

if SOC_SERIES_GD32A50X

source "soc/arm/gigadevice/gd32a50x/Kconfig.defconfig.gd32*"

config SOC_SERIES
	default "gd32a50x"

endif # SOC_SERIES_GD32A50X
```

## soc/arm/gigadevice/gd32e10x/Kconfig.defconfig.gd32e103
```kconfig
# Copyright (c) 2021 YuLong Yao <feilongphone@gmail.com>
# SPDX-License-Identifier: Apache-2.0

config SOC
	default "gd32e103"

config SYS_CLOCK_HW_CYCLES_PER_SEC
	default $(dt_node_int_prop_int,/cpus/cpu@0,clock-frequency)

config NUM_IRQS
	default 83
```

## soc/arm/gigadevice/gd32e10x/Kconfig.defconfig.series
```kconfig
# Copyright (c) 2021 YuLong Yao <feilongphone@gmail.com>
# SPDX-License-Identifier: Apache-2.0

if SOC_SERIES_GD32E10X

source "soc/arm/gigadevice/gd32e10x/Kconfig.defconfig.gd32*"

config SOC_SERIES
	default "gd32e10x"

endif # SOC_SERIES_GD32E10X
```

## soc/arm/gigadevice/gd32e10x/Kconfig.series
```kconfig
# Copyright (c) 2021 YuLong Yao <feilongphone@gmail.com>
# SPDX-License-Identifier: Apache-2.0

config SOC_SERIES_GD32E10X
	bool
	select ARM
	select CPU_HAS_FPU
	select CPU_CORTEX_M4
	select CPU_CORTEX_M_HAS_SYSTICK
	select CPU_CORTEX_M_HAS_VTOR
	select SOC_FAMILY_GD32_ARM
	select GD32_HAS_AFIO_PINMUX
	help
	  Enable support for GigaDevice GD32E10X MCU series
```

## soc/arm/gigadevice/gd32e10x/Kconfig.soc
```kconfig
# Copyright (c) 2021 YuLong Yao <feilongphone@gmail.com>
# SPDX-License-Identifier: Apache-2.0

choice
	prompt "GigaDevice GD32E103 MCU Selection"
	depends on SOC_SERIES_GD32E10X

	config SOC_GD32E103
		bool "gd32e103"
endchoice
```
