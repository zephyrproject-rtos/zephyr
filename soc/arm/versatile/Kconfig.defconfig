## soc/arm/versatile/Kconfig.defconfig
```kconfig
# Copyright (c) 2026 Takayuki Goto
# SPDX-License-Identifier: Apache-2.0

if SOC_SERIES_VERSATILE

config NUM_IRQS
	default 32

endif # SOC_SERIES_VERSATILE
```

## soc/arm/versatile/Kconfig.soc
```kconfig
# Copyright (c) 2026 Takayuki Goto
# SPDX-License-Identifier: Apache-2.0

config SOC_SERIES_VERSATILE
	bool
	select SOC_FAMILY_ARM
	help
	  ARM Versatile platform baseboards

config SOC_VERSATILEPB
	bool
	select SOC_SERIES_VERSATILE
	help
	  ARM Versatile/PB with an ARM926EJ-S core

config SOC_SERIES
	default "versatile" if SOC_SERIES_VERSATILE

config SOC
	default "versatilepb" if SOC_VERSATILEPB
```

## soc/aspeed/ast27xx/Kconfig
```kconfig
# SPDX-License-Identifier: Apache-2.0
#
# Copyright (c) 2026 ASPEED Technology Inc.

config SOC_AST2700_BOOTMCU
	select RISCV
	select RISCV_PRIVILEGED
	select RISCV_SOC_HAS_GP_RELATIVE_ADDRESSING
	select RISCV_VECTORED_MODE
	select GEN_IRQ_VECTOR_TABLE
	select INCLUDE_RESET_VECTOR
```

## soc/aspeed/ast27xx/Kconfig.soc
```kconfig
# SPDX-License-Identifier: Apache-2.0
#
# Copyright (c) 2026 ASPEED Technology Inc.

config SOC_SERIES_AST27XX
	bool
	select SOC_FAMILY_ASPEED
	help
	  Enable support for ASPEED AST27XX series.

config SOC_SERIES
	default "ast27xx" if SOC_SERIES_AST27XX

config SOC_AST2700
	bool
	select SOC_SERIES_AST27XX
	help
	  AST2700

config SOC_AST2700_BOOTMCU
	bool
	select SOC_AST2700
	help
	  Enable support for the AST2700 BootMCU RISC-V core.

config SOC
	default "ast2700" if SOC_AST2700
```

## soc/atmel/sam/Kconfig.defconfig
```kconfig
# Atmel SAM MCU family default configuration options

# Copyright (c) 2016 Piotr Mienkowski
# Copyright (c) 2024 Gerson Fernando Budke <nandojve@gmail.com>
# SPDX-License-Identifier: Apache-2.0

if SOC_FAMILY_ATMEL_SAM

rsource "*/Kconfig.defconfig"

config CLOCK_CONTROL
	default y

config GPIO
	default y

config SYS_CLOCK_HW_CYCLES_PER_SEC
	default $(dt_node_int_prop_int,/cpus/cpu@0,clock-frequency)

config WATCHDOG
	default y

if SOC_ATMEL_SAM_HAS_CMCC

configdefault CACHE_MANAGEMENT
	default y

# The CMCC line is 4 words
configdefault ICACHE_LINE_SIZE
	default 16

choice CACHE_TYPE
	default EXTERNAL_CACHE
endchoice

endif # SOC_ATMEL_SAM_HAS_CMCC

endif # SOC_FAMILY_ATMEL_SAM
```

## soc/atmel/sam0/samd51/Kconfig.defconfig
```kconfig
# Atmel SAMD51 MCU series configuration options

# Copyright (c) 2019 ML!PA Consulting GmbH
# Copyright (c) 2024 Gerson Fernando Budke <nandojve@gmail.com>
# SPDX-License-Identifier: Apache-2.0

if SOC_SERIES_SAMD51

config NUM_IRQS
	default 137

config BUILD_OUTPUT_UF2_FAMILY_ID
	default "0x55114460"

endif # SOC_SERIES_SAMD51
```

## soc/beken/Kconfig.defconfig
```kconfig
# Copyright (c) 2026 Beken Corporation
# SPDX-License-Identifier: Apache-2.0

if SOC_FAMILY_BEKEN_ARM

rsource "*/Kconfig.defconfig"

endif # SOC_FAMILY_BEKEN_ARM
```

## soc/beken/Kconfig.soc
```kconfig
# Copyright (c) 2026 Beken Corporation
# SPDX-License-Identifier: Apache-2.0

config SOC_FAMILY_BEKEN_ARM
	bool
	help
	  Beken SoC family based on Arm Cortex-M.

config SOC_FAMILY
	default "beken" if SOC_FAMILY_BEKEN_ARM

rsource "*/Kconfig.soc"
```

## soc/beken/bk7258/Kconfig
```kconfig
# Copyright (c) 2026 Embracecactus
# SPDX-License-Identifier: Apache-2.0

config SOC_BK7258
	select ARM
	select CPU_CORTEX_M33
	select CPU_CORTEX_M_HAS_SYSTICK
	select CPU_HAS_FPU
	select CPU_HAS_ARM_SAU
	select ARMV8_M_DSP
	select PINCTRL
	select SOC_EARLY_INIT_HOOK
	select SOC_RESET_HOOK
	imply XIP
```

## soc/beken/bk7258/Kconfig.soc
```kconfig
# Copyright (c) 2026 Embracecactus
# SPDX-License-Identifier: Apache-2.0

config SOC_BK7258
	bool

config SOC_BK7258_CPU0
	bool
	select SOC_BK7258

config SOC
	default "bk7258" if SOC_BK7258
```

## soc/bflb/Kconfig.defconfig
```kconfig
# Copyright (c) 2021-2025 ATL Electronics
#
# SPDX-License-Identifier: Apache-2.0

if SOC_FAMILY_BFLB

config MAIN_STACK_SIZE
	default 4096

DT_CHOSEN_BFLB_HEAP_RAM_EARLY := bflb,heap-ram-early
DT_CHOSEN_BFLB_HEAP_RAM_LATE := bflb,heap-ram-late

configdefault MBEDTLS_HEAP_CUSTOM_SECTION
	default y if $(dt_chosen_enabled,$(DT_CHOSEN_BFLB_HEAP_RAM_EARLY))
	default y if $(dt_chosen_enabled,$(DT_CHOSEN_BFLB_HEAP_RAM_LATE)) && MEMC

rsource "*/Kconfig.defconfig"

endif # SOC_FAMILY_BFLB
```

## soc/bflb/bl808/Kconfig
```kconfig
# Copyright The Zephyr Project Contributors
#
# SPDX-License-Identifier: Apache-2.0

config SOC_SERIES_BL808_M0
	select CACHE_MANAGEMENT
	select CLOCK_CONTROL
	select CPU_HAS_DCACHE
	select CPU_HAS_ICACHE
	select CPU_XUANTIE_E907
	select OTP
	select RISCV
	select SOC_EARLY_INIT_HOOK
	select SOC_PREP_HOOK
	select USE_DT_CODE_PARTITION
	imply CODE_DATA_RELOCATION
	imply FLASH
	imply FPU
	imply REGULATOR
	imply XIP

config SOC_SERIES_BL808_D0
	select CACHE_MANAGEMENT
	select CLOCK_CONTROL
	select CPU_HAS_DCACHE
	select CPU_HAS_ICACHE
	select CPU_XUANTIE_C906
	select OTP
	select RISCV
	select SOC_EARLY_INIT_HOOK
	select USE_DT_CODE_PARTITION
	imply CODE_DATA_RELOCATION
	imply FPU
	imply XIP

# The E902 on BL808 has no cache
config SOC_SERIES_BL808_LP
	select CLOCK_CONTROL
	select CPU_XUANTIE_E902
	select OTP
	select RISCV
	select USE_DT_CODE_PARTITION
	imply CODE_DATA_RELOCATION
	imply XIP

if SOC_SERIES_BL808

DT_CHOSEN_BFLB_D0_PARTITION := bflb,d0-partition
DT_CHOSEN_BFLB_LP_PARTITION := bflb,lp-partition

config SOC_SERIES_BL808_D0_START
	bool "Start D0 C906 core"
	depends on $(dt_chosen_enabled,$(DT_CHOSEN_BFLB_D0_PARTITION))
	depends on SOC_SERIES_BL808_M0
	select SOC_LATE_INIT_HOOK
	help
	  The M0 CPU core starts the D0 CPU at the chosen partition offset once its initialization
	  is completed.

config SOC_SERIES_BL808_LP_START
	bool "Start LP E902 core"
	depends on $(dt_chosen_enabled,$(DT_CHOSEN_BFLB_LP_PARTITION))
	depends on SOC_SERIES_BL808_M0
	select SOC_LATE_INIT_HOOK
	help
	  The M0 CPU core starts the LP CPU at the chosen partition offset once its initialization
	  is completed.

endif
```

## soc/bflb/bl808/Kconfig.defconfig
```kconfig
# Copyright The Zephyr Project Contributors
#
# SPDX-License-Identifier: Apache-2.0

if SOC_SERIES_BL808

config ARCH_SW_ISR_TABLE_ALIGN
	default 64

if SOC_SERIES_BL808_M0

config SYS_CLOCK_TICKS_PER_SEC
	default 5000

config SOC_RESET_HOOK
	default y

config NUM_IRQS
	default 80

config RISCV_MCAUSE_EXCEPTION_MASK
	default 0xFFF

endif # SOC_SERIES_BL808_M0

if SOC_SERIES_BL808_D0

config SYS_CLOCK_TICKS_PER_SEC
	default 5000

config 2ND_LVL_INTR_00_OFFSET
	default 11

config 2ND_LVL_ISR_TBL_OFFSET
	default 16

config MAX_IRQ_PER_AGGREGATOR
	default 66

config NUM_IRQS
	default 82

config RISCV_MCAUSE_EXCEPTION_MASK
	default 0x7FFFFFFFFFFFFFFF

endif # SOC_SERIES_BL808_D0

if SOC_SERIES_BL808_LP

config SYS_CLOCK_TICKS_PER_SEC
	default 1000

# The real limit is 48
config NUM_IRQS
	default 80

config RISCV_MCAUSE_EXCEPTION_MASK
	default 0xFFF

endif # SOC_SERIES_BL808_LP

endif # SOC_SERIES_BL808
```

## soc/bflb/bl808/Kconfig.soc
```kconfig
# Copyright The Zephyr Project Contributors
#
# SPDX-License-Identifier: Apache-2.0

config SOC_SERIES_BL808
	bool
	select SOC_FAMILY_BFLB
	help
	  Enable support for BouffaloLab BL808 MCU series

config SOC_SERIES
	default "bl808" if SOC_SERIES_BL808

config SOC_SERIES_BL808_M0
	bool
	help
	  BL808 M0 core (T-Head E907, RV32IMAFC)

config SOC_SERIES_BL808_D0
	bool
	help
	  BL808 D0 core (T-Head C906, RV64IMAFDC)

config SOC_SERIES_BL808_LP
	bool
	help
	  BL808 LP core (T-Head E902, RV32EMC)

config SOC_BL808C09Q2I
	bool
	select SOC_SERIES_BL808

config SOC_BL808D09Q2I
	bool
	select SOC_SERIES_BL808

config SOC_BL808C09Q2I_M0
	bool
	select SOC_BL808C09Q2I
	select SOC_SERIES_BL808_M0

config SOC_BL808C09Q2I_D0
	bool
	select SOC_BL808C09Q2I
	select SOC_SERIES_BL808_D0

config SOC_BL808C09Q2I_LP
	bool
	select SOC_BL808C09Q2I
	select SOC_SERIES_BL808_LP

config SOC_BL808D09Q2I_M0
	bool
	select SOC_BL808D09Q2I
	select SOC_SERIES_BL808_M0

config SOC_BL808D09Q2I_D0
	bool
	select SOC_BL808D09Q2I
	select SOC_SERIES_BL808_D0

config SOC_BL808D09Q2I_LP
	bool
	select SOC_BL808D09Q2I
	select SOC_SERIES_BL808_LP

config SOC
	default "bl808c09q2i" if SOC_BL808C09Q2I
	default "bl808d09q2i" if SOC_BL808D09Q2I
```

## soc/brcm/bcm2711/Kconfig
```kconfig
# Copyright 2023 honglin leng <a909204013@gmail.com>
# SPDX-License-Identifier: Apache-2.0

config SOC_BCM2711
	select ARM64
	select CPU_CORTEX_A72
	select ARM_ARCH_TIMER if SYS_CLOCK_EXISTS
	select CLOCK_CONTROL_FIXED_RATE_CLOCK if DT_HAS_FIXED_CLOCK_ENABLED
```

## soc/brcm/bcmvk/valkyrie/Kconfig.defconfig
```kconfig
# SPDX-License-Identifier: Apache-2.0
#
# Copyright 2020 Broadcom.
#

if SOC_SERIES_VALKYRIE

config NUM_IRQS
	default 240

endif # SOC_SERIES_VALKYRIE
```

## soc/brcm/bcmvk/viper/Kconfig.defconfig.viper_bcm58402_a72
```kconfig
# Copyright 2020 Broadcom
# SPDX-License-Identifier: Apache-2.0

if SOC_BCM58402_A72

config NUM_IRQS
	default 260

endif
```

## soc/brcm/bcmvk/viper/Kconfig.defconfig.viper_bcm58402_m7
```kconfig
# Copyright 2020 Broadcom
# SPDX-License-Identifier: Apache-2.0

if SOC_BCM58402_M7

config NUM_IRQS
	default 240

endif
```
