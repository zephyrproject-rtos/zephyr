## soc/arm/atmel_sam/same70/Kconfig.soc
```kconfig
# Kconfig - Atmel SAM E70 MCU series
#
# Copyright (c) 2016 Piotr Mienkowski
# SPDX-License-Identifier: Apache-2.0
#

choice
	prompt "Atmel SAME70 MCU Selection"
	depends on SOC_SERIES_SAME70

	config SOC_PART_NUMBER_SAME70Q21
		bool "SAME70Q21"

	config SOC_PART_NUMBER_SAME70Q20
		bool "SAME70Q20"

	config SOC_PART_NUMBER_SAME70Q19
		bool "SAME70Q19"

	config SOC_PART_NUMBER_SAME70N21
		bool "SAME70N21"

	config SOC_PART_NUMBER_SAME70N20
		bool "SAME70N20"

	config SOC_PART_NUMBER_SAME70N19
		bool "SAME70N19"

	config SOC_PART_NUMBER_SAME70J21
		bool "SAME70J21"

	config SOC_PART_NUMBER_SAME70J20
		bool "SAME70J20"

	config SOC_PART_NUMBER_SAME70J19
		bool "SAME70J19"

	config SOC_PART_NUMBER_SAME70Q21B
		bool "SAME70Q21B"
		select SOC_ATMEL_SAME70_REVB

	config SOC_PART_NUMBER_SAME70Q20B
		bool "SAME70Q20B"
		select SOC_ATMEL_SAME70_REVB

	config SOC_PART_NUMBER_SAME70Q19B
		bool "SAME70Q19B"
		select SOC_ATMEL_SAME70_REVB

	config SOC_PART_NUMBER_SAME70N21B
		bool "SAME70N21B"
		select SOC_ATMEL_SAME70_REVB

	config SOC_PART_NUMBER_SAME70N20B
		bool "SAME70N20B"
		select SOC_ATMEL_SAME70_REVB

	config SOC_PART_NUMBER_SAME70N19B
		bool "SAME70N19B"
		select SOC_ATMEL_SAME70_REVB

	config SOC_PART_NUMBER_SAME70J21B
		bool "SAME70J21B"
		select SOC_ATMEL_SAME70_REVB

	config SOC_PART_NUMBER_SAME70J20B
		bool "SAME70J20B"
		select SOC_ATMEL_SAME70_REVB

	config SOC_PART_NUMBER_SAME70J19B
		bool "SAME70J19B"
		select SOC_ATMEL_SAME70_REVB
endchoice

if SOC_SERIES_SAME70

config SOC_ATMEL_SAME70_REVB
	bool

config SOC_ATMEL_SAME70_EXT_SLCK
	bool "Use external crystal oscillator for slow clock"
	help
	  Say y if you want to use external 32 kHz crystal
	  oscillator to drive the slow clock. Note that this
	  adds a few seconds to boot time, as the crystal
	  needs to stabilize after power-up.

	  Says n if you do not need accurate and precise timers.
	  The slow clock will be driven by the internal fast
	  RC oscillator running at 32 kHz.

config SOC_ATMEL_SAME70_EXT_MAINCK
	bool "Use external crystal oscillator for main clock"
	help
	  The main clock is being used to drive the PLL, and
	  thus driving the processor clock.

	  Say y if you want to use external crystal oscillator
	  to drive the main clock. Note that this adds about
	  a second to boot time, as the crystal needs to
	  stabilize after power-up.

	  The crystal used here can be from 3 to 20 MHz.

	  Says n here will use the internal fast RC oscillator
	  running at 12 MHz.

config SOC_ATMEL_SAME70_MDIV
	int "MDIV"
	default 2
	range 1 4
	help
	  This divisor defines a ratio between processor clock (HCLK)
	  and master clock (MCK):
	  MCK = HCLK / MDIV

config SOC_ATMEL_SAME70_PLLA_MULA
	int "PLL MULA"
	default 24
	range 1 62
	help
	  This is the multiplier MULA used by the PLL.
	  The processor clock is (MAINCK * (MULA + 1) / DIVA).

	  Board config file can override this settings
	  for a particular board.

	  Setting MULA=0 would disable PLL at boot, this is currently
	  not supported.

	  With default of MULA == 24, and DIVA == 1,
	  PLL is running at 25 times the main clock frequency.

config SOC_ATMEL_SAME70_PLLA_DIVA
	int "PLL DIVA"
	default 1
	range 1 255
	help
	  This is the divider DIVA used by the PLL.
	  The processor clock is (MAINCK * (MULA + 1) / DIVA).

	  Board config file can override this settings
	  for a particular board.

	  Setting DIVA=0 would disable PLL at boot, this is currently
	  not supported.

	  With default of MULA == 24, and DIVA == 1,
	  PLL is running at 25 times the main clock frequency.

config SOC_ATMEL_SAME70_WAIT_MODE
	bool "Go to Wait mode instead of Sleep mode"
	depends on SOC_ATMEL_SAME70_EXT_MAINCK
	default y if DEBUG
	help
	  For JTAG debugging CPU clock (HCLK) should not stop. In order
	  to achieve this, make CPU go to Wait mode instead of Sleep
	  mode while using external crystal oscillator for main clock.

config SOC_ATMEL_SAME70_DISABLE_ERASE_PIN
	bool "Disable ERASE pin"
	default 0
	help
	  At reset ERASE pin is configured in System IO mode. Asserting the ERASE
	  pin at '1' will completely erase Flash memory. Setting this option will
	  switch the pin to general IO mode giving control of the pin to the GPIO
	  module.

endif # SOC_SERIES_SAME70
```

## soc/arm/atmel_sam/sams70/Kconfig.defconfig.series
```kconfig
# Atmel SAM S70 MCU series configuration options

# Copyright (c) 2022 RIC Electronics
# Copyright (c) 2019 Gerson Fernando Budke
# Copyright (c) 2016 Piotr Mienkowski
# SPDX-License-Identifier: Apache-2.0

if SOC_SERIES_SAMS70

config SOC_SERIES
	default "sams70"

config SOC_PART_NUMBER
	default "sams70q21" if SOC_PART_NUMBER_SAMS70Q21
	default "sams70q20" if SOC_PART_NUMBER_SAMS70Q20
	default "sams70q19" if SOC_PART_NUMBER_SAMS70Q19
	default "sams70n21" if SOC_PART_NUMBER_SAMS70N21
	default "sams70n20" if SOC_PART_NUMBER_SAMS70N20
	default "sams70n19" if SOC_PART_NUMBER_SAMS70N19
	default "sams70j21" if SOC_PART_NUMBER_SAMS70J21
	default "sams70j20" if SOC_PART_NUMBER_SAMS70J20
	default "sams70j19" if SOC_PART_NUMBER_SAMS70J19
	default "sams70q21b" if SOC_PART_NUMBER_SAMS70Q21B
	default "sams70q20b" if SOC_PART_NUMBER_SAMS70Q20B
	default "sams70q19b" if SOC_PART_NUMBER_SAMS70Q19B
	default "sams70n21b" if SOC_PART_NUMBER_SAMS70N21B
	default "sams70n20b" if SOC_PART_NUMBER_SAMS70N20B
	default "sams70n19b" if SOC_PART_NUMBER_SAMS70N19B
	default "sams70j21b" if SOC_PART_NUMBER_SAMS70J21B
	default "sams70j20b" if SOC_PART_NUMBER_SAMS70J20B
	default "sams70j19b" if SOC_PART_NUMBER_SAMS70J19B

#
# SAM S70 family has in total 74 interrupts
# Note that 70S devices do not have ethernet or can so there will actually be less
#
config NUM_IRQS
	default 74

# Configure default device drivers. If a feature is supported by more than one
# device driver the default configuration will be placed in the board defconfig
# file.

config DMA_SAM_XDMAC
	default y
	depends on DMA

config GPIO_SAM
	default y
	depends on GPIO

config ADC_SAM_AFEC
	default y
	depends on ADC

config I2C_SAM_TWIHS
	default y
	depends on I2C

config I2S_SAM_SSC
	default y
	depends on I2S

config SPI_SAM
	default y
	depends on SPI

config USB_DC_SAM_USBHS
	default y
	depends on USB_DEVICE_DRIVER

config ENTROPY_SAM_RNG
	default y
	depends on ENTROPY_GENERATOR

config SOC_FLASH_SAM
	default y
	depends on FLASH

config PWM_SAM
	default y
	depends on PWM

endif # SOC_SERIES_SAMS70
```

## soc/arm/atmel_sam/sams70/Kconfig.series
```kconfig
# Atmel SAM S70 MCU series

# Copyright (c) 2021 RIC Electronics
# Copyright (c) 2019 Gerson Fernando Budke
# Copyright (c) 2016 Piotr Mienkowski
# SPDX-License-Identifier: Apache-2.0

config SOC_SERIES_SAMS70
	bool "Atmel SAMS70 MCU"
	select ARM
	select CPU_CORTEX_M7
	select SOC_FAMILY_SAM
	select CPU_HAS_FPU_DOUBLE_PRECISION
	select CPU_CORTEX_M_HAS_DWT
	select ASF
	select XIP
	select CPU_HAS_ARM_MPU
	select HAS_SWO
	help
	  Enable support for Atmel SAM S70 ARM Cortex-M7 Microcontrollers.
	  Part No.: SAMS70J19B, SAMS70J20B,
	  SAMS70J21B, SAMS70N19B, SAMS70N20B, SAMS70N21B, SAMS70Q19B,
	  SAMS70Q20B, SAMS70Q21B
```

## soc/arm/atmel_sam/samv70/Kconfig.defconfig.series
```kconfig
# Atmel SAM V70 MCU series configuration options

# Copyright (c) 2019 Gerson Fernando Budke
# Copyright (c) 2016 Piotr Mienkowski
# SPDX-License-Identifier: Apache-2.0

if SOC_SERIES_SAMV70

config SOC_SERIES
	default "samv70"

config SOC_PART_NUMBER
	default "samv70q20" if SOC_PART_NUMBER_SAMV70Q20
	default "samv70q19" if SOC_PART_NUMBER_SAMV70Q19
	default "samv70n20" if SOC_PART_NUMBER_SAMV70N20
	default "samv70n19" if SOC_PART_NUMBER_SAMV70N19
	default "samv70j20" if SOC_PART_NUMBER_SAMV70J20
	default "samv70j19" if SOC_PART_NUMBER_SAMV70J19
	default "samv70q20b" if SOC_PART_NUMBER_SAMV70Q20B
	default "samv70q19b" if SOC_PART_NUMBER_SAMV70Q19B
	default "samv70n20b" if SOC_PART_NUMBER_SAMV70N20B
	default "samv70n19b" if SOC_PART_NUMBER_SAMV70N19B
	default "samv70j20b" if SOC_PART_NUMBER_SAMV70J20B
	default "samv70j19b" if SOC_PART_NUMBER_SAMV70J19B

#
# SAM V70 family has in total 71 peripherals capable of generating interrupts
# for the revision A and 74 for the revision B (not all Peripheral Identifiers
# are used).
#
config NUM_IRQS
	default 74 if SOC_ATMEL_SAMV70_REVB
	default 71

# Configure default device drivers. If a feature is supported by more than one
# device driver the default configuration will be placed in the board defconfig
# file.

config DMA_SAM_XDMAC
	default y
	depends on DMA

config ADC_SAM_AFEC
	default y
	depends on ADC

config I2C_SAM_TWIHS
	default y
	depends on I2C

config I2S_SAM_SSC
	default y
	depends on I2S

config USB_DC_SAM_USBHS
	default y
	depends on USB_DEVICE_DRIVER

config ENTROPY_SAM_RNG
	default y
	depends on ENTROPY_GENERATOR

config SOC_FLASH_SAM
	default y
	depends on FLASH

config PWM_SAM
	default y
	depends on PWM

endif # SOC_SERIES_SAMV70
```

## soc/arm/atmel_sam/samv70/Kconfig.series
```kconfig
# Atmel SAM V70 MCU series

# Copyright (c) 2019 Gerson Fernando Budke
# Copyright (c) 2016 Piotr Mienkowski
# SPDX-License-Identifier: Apache-2.0

config SOC_SERIES_SAMV70
	bool "Atmel SAMV70 MCU"
	select ARM
	select CPU_CORTEX_M7
	select SOC_FAMILY_SAM
	select CPU_HAS_FPU_DOUBLE_PRECISION
	select CPU_CORTEX_M_HAS_CACHE
	select CPU_CORTEX_M_HAS_DWT
	select ASF
	select XIP
	select CPU_HAS_ARM_MPU
	select HAS_SWO
	help
	  Enable support for Atmel SAM V70 ARM Cortex-M7 Microcontrollers.
	  Part No.: SAMV70J19, SAMV70J20, SAMV70N19, SAMV70N20, SAMV70Q19, SAMV70Q20,
	  SAMV70J19B, SAMV70J20B, SAMV70N19B, SAMV70N20B, SAMV70Q19B, SAMV70Q20B
```

## soc/arm/atmel_sam/samv71/Kconfig.defconfig.series
```kconfig
# Atmel SAM V71 MCU series configuration options

# Copyright (c) 2019 Gerson Fernando Budke
# Copyright (c) 2016 Piotr Mienkowski
# SPDX-License-Identifier: Apache-2.0

if SOC_SERIES_SAMV71

config SOC_SERIES
	default "samv71"

config SOC_PART_NUMBER
	default "samv71q21" if SOC_PART_NUMBER_SAMV71Q21
	default "samv71q20" if SOC_PART_NUMBER_SAMV71Q20
	default "samv71q19" if SOC_PART_NUMBER_SAMV71Q19
	default "samv71n21" if SOC_PART_NUMBER_SAMV71N21
	default "samv71n20" if SOC_PART_NUMBER_SAMV71N20
	default "samv71n19" if SOC_PART_NUMBER_SAMV71N19
	default "samv71j21" if SOC_PART_NUMBER_SAMV71J21
	default "samv71j20" if SOC_PART_NUMBER_SAMV71J20
	default "samv71j19" if SOC_PART_NUMBER_SAMV71J19
	default "samv71q21b" if SOC_PART_NUMBER_SAMV71Q21B
	default "samv71q20b" if SOC_PART_NUMBER_SAMV71Q20B
	default "samv71q19b" if SOC_PART_NUMBER_SAMV71Q19B
	default "samv71n21b" if SOC_PART_NUMBER_SAMV71N21B
	default "samv71n20b" if SOC_PART_NUMBER_SAMV71N20B
	default "samv71n19b" if SOC_PART_NUMBER_SAMV71N19B
	default "samv71j21b" if SOC_PART_NUMBER_SAMV71J21B
	default "samv71j20b" if SOC_PART_NUMBER_SAMV71J20B
	default "samv71j19b" if SOC_PART_NUMBER_SAMV71J19B

#
# SAM V71 family has in total 71 peripherals capable of generating interrupts
# for the revision A and 74 for the revision B (not all Peripheral Identifiers
# are used).
#
config NUM_IRQS
	default 74 if SOC_ATMEL_SAMV71_REVB
	default 71

endif # SOC_SERIES_SAMV71
```

## soc/arm/atmel_sam/samv71/Kconfig.series
```kconfig
# Atmel SAM V71 MCU series

# Copyright (c) 2016 Piotr Mienkowski
# Copyright (c) 2019-2023 Gerson Fernando Budke <nandojve@gmail.com>
# SPDX-License-Identifier: Apache-2.0

config SOC_SERIES_SAMV71
	bool "Atmel SAMV71 MCU"
	select ARM
	select CPU_CORTEX_M7
	select CPU_CORTEX_M_HAS_DWT
	select CPU_HAS_ARM_MPU
	select CPU_HAS_FPU_DOUBLE_PRECISION
	select SOC_FAMILY_SAM
	select PLATFORM_SPECIFIC_INIT
	select ASF
	select HAS_SWO
	select XIP
	help
	  Enable support for Atmel SAM V71 ARM Cortex-M7 Microcontrollers.
	  Part No.: SAMV71J19, SAMV71J20, SAMV71J21, SAMV71N19, SAMV71N20,
	  SAMV71N21, SAMV71Q19, SAMV71Q20, SAMV71Q21, SAMV71J19B, SAMV71J20B,
	  SAMV71J21B, SAMV71N19B, SAMV71N20B, SAMV71N21B, SAMV71Q19B,
	  SAMV71Q20B, SAMV71Q21B
```
