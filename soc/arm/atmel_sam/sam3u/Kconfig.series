## soc/arm/atmel_sam/sam3u/Kconfig.series
```kconfig
# Atmel SAM3U MCU series

# Copyright (c) 2023 Chen Xingyu <hi@xingrz.me>
# Copyright (c) 2017 Justin Watson
# Copyright (c) 2016 Intel Corporation.
# Copyright (c) 2014-2015 Wind River Systems, Inc.
# SPDX-License-Identifier: Apache-2.0

config SOC_SERIES_SAM3U
	bool "Atmel SAM3U MCU"
	select ARM
	select CPU_CORTEX_M3
	select SOC_FAMILY_SAM
	select CPU_HAS_ARM_MPU
	select CPU_CORTEX_M_HAS_DWT
	select ASF
	help
	  Enable support for Atmel SAM3U Cortex-M3 microcontrollers.
	  Part No.: SAM3U1C, SAM3U1E, SAM3U2C, SAM3U2E, SAM3U4C, SAM3U4E
```

## soc/arm/atmel_sam/sam3u/Kconfig.soc
```kconfig
# Atmel SAM3U MCU series

# Copyright (c) 2023 Chen Xingyu <hi@xingrz.me>
# Copyright (c) 2017 Justin Watson
# Copyright (c) 2016 Intel Corporation.
# Copyright (c) 2014-2015 Wind River Systems, Inc.
# SPDX-License-Identifier: Apache-2.0

choice
	prompt "Atmel SAM3U MCU Selection"
	depends on SOC_SERIES_SAM3U

	config SOC_PART_NUMBER_SAM3U1C
		bool "SAM3U1C"
	config SOC_PART_NUMBER_SAM3U1E
		bool "SAM3U1E"
	config SOC_PART_NUMBER_SAM3U2C
		bool "SAM3U2C"
	config SOC_PART_NUMBER_SAM3U2E
		bool "SAM3U2E"
	config SOC_PART_NUMBER_SAM3U4C
		bool "SAM3U4C"
	config SOC_PART_NUMBER_SAM3U4E
		bool "SAM3U4E"
endchoice
```

## soc/arm/atmel_sam/sam3x/Kconfig.defconfig.series
```kconfig
# Kconfig - Atmel SAM3X MCU series configuration options
#
# Copyright (c) 2017 Justin Watson
# Copyright (c) 2016 Intel Corporation.
# Copyright (c) 2014-2015 Wind River Systems, Inc.
# SPDX-License-Identifier: Apache-2.0
#

if SOC_SERIES_SAM3X

config SOC_SERIES
	default "sam3x"

config SOC_PART_NUMBER
	default "sam3x4c" if SOC_PART_NUMBER_SAM3X4C
	default "sam3x4e" if SOC_PART_NUMBER_SAM3X4E
	default "sam3x8c" if SOC_PART_NUMBER_SAM3X8C
	default "sam3x8e" if SOC_PART_NUMBER_SAM3X8E
	default "sam3x8h" if SOC_PART_NUMBER_SAM3X8H

#
# SAM3 family has total 45 peripherals capable of
# generating interrupts.
#
config NUM_IRQS
	default 45

config SYS_CLOCK_HW_CYCLES_PER_SEC
	default 84000000

endif # SOC_SERIES_SAM3X
```

## soc/arm/atmel_sam/sam3x/Kconfig.series
```kconfig
# Atmel SAM3X MCU series

# Copyright (c) 2014-2015 Wind River Systems, Inc.
# Copyright (c) 2016 Intel Corporation.
# Copyright (c) 2017 Justin Watson
# Copyright (c) 2023 Gerson Fernando Budke <nandojve@gmail.com>
# SPDX-License-Identifier: Apache-2.0

config SOC_SERIES_SAM3X
	bool "Atmel SAM3X MCU"
	select ARM
	select CPU_CORTEX_M3
	select CPU_CORTEX_M_HAS_DWT
	select CPU_HAS_ARM_MPU
	select SOC_FAMILY_SAM
	select PLATFORM_SPECIFIC_INIT
	select ASF
	help
	  Enable support for Atmel SAM3X Cortex-M3 microcontrollers.
	  Part No.: SAM3X8E
```

## soc/arm/atmel_sam/sam3x/Kconfig.soc
```kconfig
# Kconfig - Atmel SAM3X MCU series
#
# Copyright (c) 2017 Justin Watson
# Copyright (c) 2016 Intel Corporation.
# Copyright (c) 2014-2015 Wind River Systems, Inc.
#
# SPDX-License-Identifier: Apache-2.0
#

choice
	prompt "Atmel SAM3X MCU Selection"
	depends on SOC_SERIES_SAM3X

	config SOC_PART_NUMBER_SAM3X4C
		bool "SAM3X4C"
	config SOC_PART_NUMBER_SAM3X4E
		bool "SAM3X4E"
	config SOC_PART_NUMBER_SAM3X8C
		bool "SAM3X8C"
	config SOC_PART_NUMBER_SAM3X8E
		bool "SAM3X8E"
	config SOC_PART_NUMBER_SAM3X8H
		bool "SAM3X8H"
endchoice

if SOC_SERIES_SAM3X

config SOC_ATMEL_SAM3X_EXT_SLCK
	bool "Atmel SAM3 to use external crystal oscillator for slow clock"
	help
	  Says y if you want to use external 32 kHz crystal
	  oscillator to drive the slow clock. Note that this
	  adds a few seconds to boot time, as the crystal
	  needs to stabilize after power-up.

	  Says n if you do not need accurate and precise timers.
	  The slow clock will be driven by the internal fast
	  RC oscillator running at 32 kHz.

config SOC_ATMEL_SAM3X_EXT_MAINCK
	bool "Atmel SAM3 to use external crystal oscillator for main clock"
	help
	  The main clock is being used to drive the PLL, and
	  thus driving the processor clock.

	  Says y if you want to use external crystal oscillator
	  to drive the main clock. Note that this adds about
	  a second to boot time, as the crystal needs to
	  stabilize after power-up.

	  The crystal used here can be from 3 to 20 MHz.

	  Says n here will use the internal fast RC oscillator
	  running at 12 MHz.

config SOC_ATMEL_SAM3X_PLLA_MULA
	hex
	default 0x06
	help
	  This is the multiplier (MULA) used by the PLL.
	  The processor clock is (MAINCK * (MULA + 1) / DIVA).

	  Board config file can override this settings
	  for a particular board.

	  With default of MULA == 6, and DIVA == 1,
	  PLL is running at 7 times of main clock.

config SOC_ATMEL_SAM3X_PLLA_DIVA
	hex
	default 0x01
	help
	  This is the divider (DIVA) used by the PLL.
	  The processor clock is (MAINCK * (MULA + 1) / DIVA).

	  Board config file can override this settings
	  for a particular board.

	  With default of MULA == 6, and DIVA == 1,
	  PLL is running at 7 times of main clock.

config SOC_ATMEL_SAM3X_WAIT_MODE
	bool "Atmel SAM3 goes to Wait mode instead of Sleep mode"
	depends on SOC_ATMEL_SAM3X_EXT_MAINCK
	default y if DEBUG
	help
	  For JTAG debugging CPU clock (HCLK) should not stop. In order
	  to achieve this, make CPU go to Wait mode instead of Sleep
	  mode while using external crystal oscillator for main clock.

endif # SOC_SERIES_SAM3X
```

## soc/arm/atmel_sam/sam4e/Kconfig.defconfig.series
```kconfig
# Atmel SAM4E MCU series configuration options

# Copyright (c) 2017 Justin Watson
# Copyright (c) 2018 Vincent van der Locht
# Copyright (c) 2019 Gerson Fernando Budke
# SPDX-License-Identifier: Apache-2.0

if SOC_SERIES_SAM4E

config SOC_SERIES
	default "sam4e"

config SOC_PART_NUMBER
	default "sam4e16e" if SOC_PART_NUMBER_SAM4E16E
	default "sam4e16c" if SOC_PART_NUMBER_SAM4E16C
	default "sam4e8e" if SOC_PART_NUMBER_SAM4E8E
	default "sam4e8c" if SOC_PART_NUMBER_SAM4E8C

#
# SAM4E family has total 47 peripherals capable of
# generating interrupts.
#
config NUM_IRQS
	default 47

if NETWORKING

config NET_L2_ETHERNET
	default y

config ETH_SAM_GMAC
	default y if NET_L2_ETHERNET

endif # NETWORKING

endif # SOC_SERIES_SAM4E
```

## soc/arm/atmel_sam/sam4e/Kconfig.series
```kconfig
# Atmel SAM4E MCU series

# Copyright (c) 2017 Justin Watson
# Copyright (c) 2018 Vincent van der Locht
# Copyright (c) 2019-2023 Gerson Fernando Budke <nandojve@gmail.com>
# SPDX-License-Identifier: Apache-2.0

config SOC_SERIES_SAM4E
	bool "Atmel SAM4E MCU"
	select ARM
	select CPU_CORTEX_M4
	select CPU_CORTEX_M_HAS_DWT
	select CPU_HAS_ARM_MPU
	select CPU_HAS_FPU
	select SOC_FAMILY_SAM
	select PLATFORM_SPECIFIC_INIT
	select ASF
	help
	  Enable support for Atmel SAM4E Cortex-M4 microcontrollers.
	  Part No.: SAM4E16E, SAM4E16C, SAM4E8E, SAM4E8C
```

## soc/arm/atmel_sam/sam4l/Kconfig.series
```kconfig
# Copyright (c) 2020 Gerson Fernando Budke <nandojve@gmail.com>
# SPDX-License-Identifier: Apache-2.0

config SOC_SERIES_SAM4L
	bool "Atmel SAM4L MCU"
	select ARM
	select CPU_CORTEX_M4
	select CPU_CORTEX_M_HAS_DWT
	select CPU_HAS_ARM_MPU
	select SOC_FAMILY_SAM
	select ASF
	help
	  Enable support for Atmel SAM4L Cortex-M4 microcontrollers.
	  Part No.: SAM4LS8C, SAM4LS8B, SAM4LS8A, SAM4LS4C, SAM4LS4B,
	  SAM4LS4A, SAM4LS2C, SAM4LS2B, SAM4LS2A, SAM4LC8C, SAM4LC8B,
	  SAM4LC8A, SAM4LC4C, SAM4LC4B, SAM4LC4A SAM4LC2C, SAM4LC2B,
	  SAM4LC2A
```

## soc/arm/atmel_sam/sam4l/Kconfig.soc
```kconfig
# Copyright (c) 2020 Gerson Fernando Budke <nandojve@gmail.com>
# SPDX-License-Identifier: Apache-2.0

config SOC_PART_NUMBER_SAM4LS8C
	bool
	help
	  SAM4LS8C

config SOC_PART_NUMBER_SAM4LS8B
	bool
	help
	  SAM4LS8B

config SOC_PART_NUMBER_SAM4LS8A
	bool
	help
	  SAM4LS8A

config SOC_PART_NUMBER_SAM4LS4C
	bool
	help
	  SAM4LS4C

config SOC_PART_NUMBER_SAM4LS4B
	bool
	help
	  SAM4LS4B

config SOC_PART_NUMBER_SAM4LS4A
	bool
	help
	  SAM4LS4A

config SOC_PART_NUMBER_SAM4LS2C
	bool
	help
	  SAM4LS2C

config SOC_PART_NUMBER_SAM4LS2B
	bool
	help
	  SAM4LS2B

config SOC_PART_NUMBER_SAM4LS2A
	bool
	help
	  SAM4LS2A

config SOC_PART_NUMBER_SAM4LC8C
	bool
	help
	  SAM4LC8C

config SOC_PART_NUMBER_SAM4LC8B
	bool
	help
	  SAM4LC8B

config SOC_PART_NUMBER_SAM4LC8A
	bool
	help
	  SAM4LC8A

config SOC_PART_NUMBER_SAM4LC4C
	bool
	help
	  SAM4LC4C

config SOC_PART_NUMBER_SAM4LC4B
	bool
	help
	  SAM4LC4B

config SOC_PART_NUMBER_SAM4LC4A
	bool
	help
	  SAM4LC4A

config SOC_PART_NUMBER_SAM4LC2C
	bool
	help
	  SAM4LC2C

config SOC_PART_NUMBER_SAM4LC2B
	bool
	help
	  SAM4LC2B

config SOC_PART_NUMBER_SAM4LC2A
	bool
	help
	  SAM4LC2A
```

## soc/arm/atmel_sam/sam4s/Kconfig.defconfig.series
```kconfig
# Atmel SAM4S MCU series configuration options

# Copyright (c) 2017 Justin Watson
# Copyright (c) 2018 Vincent van der Locht
# SPDX-License-Identifier: Apache-2.0

if SOC_SERIES_SAM4S

config SOC_SERIES
	default "sam4s"

config SOC_PART_NUMBER
	default "sam4s16c" if SOC_PART_NUMBER_SAM4S16C
	default "sam4s16b" if SOC_PART_NUMBER_SAM4S16B
	default "sam4s8c" if SOC_PART_NUMBER_SAM4S8C
	default "sam4s8b" if SOC_PART_NUMBER_SAM4S8B
	default "sam4s4c" if SOC_PART_NUMBER_SAM4S4C
	default "sam4s4b" if SOC_PART_NUMBER_SAM4S4B
	default "sam4s4a" if SOC_PART_NUMBER_SAM4S4A
	default "sam4s2c" if SOC_PART_NUMBER_SAM4S2C
	default "sam4s2b" if SOC_PART_NUMBER_SAM4S2B
	default "sam4s2a" if SOC_PART_NUMBER_SAM4S2A

#
# SAM4S family has total 35 peripherals capable of
# generating interrupts.
#
config NUM_IRQS
	default 35

config SYS_CLOCK_HW_CYCLES_PER_SEC
	default 120000000

config GPIO_SAM
	default y
	depends on GPIO

config I2C_SAM_TWI
	default y
	depends on I2C

config SPI_SAM
	default y
	depends on SPI

endif # SOC_SERIES_SAM4S
```

## soc/arm/atmel_sam/sam4s/Kconfig.series
```kconfig
# Kconfig - Atmel SAM4S MCU series
#
# Copyright (c) 2017 Justin Watson
# Copyright (c) 2018 Vincent van der Locht
#
# SPDX-License-Identifier: Apache-2.0
#

config SOC_SERIES_SAM4S
	bool "Atmel SAM4S MCU"
	select CPU_CORTEX_M4
	select SOC_FAMILY_SAM
	select ASF
	help
	  Enable support for Atmel SAM4S Cortex-M4 microcontrollers.
	  Part No.: SAM4S16C, SAM4S16B, SAM4S8C, SAM4S8B,
	  SAM4S4C, SAM4S4B, SAM4S4A, SAM4S2C, SAM4S2B, SAM4S2A
```

## soc/arm/atmel_sam/sam4s/Kconfig.soc
```kconfig
# Kconfig - Atmel SAM4S MCU series
#
# Copyright (c) 2017 Justin Watson
#
# SPDX-License-Identifier: Apache-2.0
#

choice
	prompt "Atmel SAM4S MCU Selection"
	depends on SOC_SERIES_SAM4S

	config SOC_PART_NUMBER_SAM4S16C
		bool "SAM4S16C"
endchoice

if SOC_SERIES_SAM4S

config SOC_ATMEL_SAM4S_EXT_SLCK
	bool "Atmel SAM4S to use external crystal oscillator for slow clock"
	help
	  Says y if you want to use external 32 kHz crystal
	  oscillator to drive the slow clock. Note that this
	  adds a few seconds to boot time, as the crystal
	  needs to stabilize after power-up.

	  Says n if you do not need accurate and precise timers.
	  The slow clock will be driven by the internal fast
	  RC oscillator running at 32 kHz.

config SOC_ATMEL_SAM4S_EXT_MAINCK
	bool "Atmel SAM4S to use external crystal oscillator for main clock"
	help
	  The main clock is being used to drive the PLL, and
	  thus driving the processor clock.

	  Says y if you want to use external crystal oscillator
	  to drive the main clock. Note that this adds about
	  a second to boot time, as the crystal needs to
	  stabilize after power-up.

	  The crystal used here can be from 3 to 20 MHz.

	  Says n here will use the internal fast RC oscillator
	  running at 12 MHz.

config SOC_ATMEL_SAM4S_PLLA_MULA
	hex "PLL MULA"
	default 0x09
	help
	  This is the multiplier (MULA) used by the PLL.
	  The processor clock is (MAINCK * (MULA + 1) / DIVA).

	  Board config file can override this settings
	  for a particular board.

	  With default of MULA == 9, and DIVA == 1,
	  PLL is running at 10 times of main clock.

config SOC_ATMEL_SAM4S_PLLA_DIVA
	hex "PLL DIVA"
	default 0x01
	help
	  This is the divider (DIVA) used by the PLL.
	  The processor clock is (MAINCK * (MULA + 1) / DIVA).

	  Board config file can override this settings
	  for a particular board.

	  With default of MULA == 9, and DIVA == 1,
	  PLL is running at 10 times of main clock.

config SOC_ATMEL_SAM4S_WAIT_MODE
	bool "Atmel SAM4S goes to Wait mode instead of Sleep mode"
	depends on SOC_ATMEL_SAM4S_EXT_MAINCK
	default y if DEBUG
	help
	  For JTAG debugging CPU clock (HCLK) should not stop. In order
	  to achieve this, make CPU go to Wait mode instead of Sleep
	  mode while using external crystal oscillator for main clock.

endif # SOC_SERIES_SAM4S
```

## soc/arm/atmel_sam/same70/Kconfig.defconfig.series
```kconfig
# Atmel SAM E70 MCU series configuration options

# Copyright (c) 2016 Piotr Mienkowski
# Copyright (c) 2023 Gerson Fernando Budke <nandojve@gmail.com>
# SPDX-License-Identifier: Apache-2.0

if SOC_SERIES_SAME70

config SOC_SERIES
	default "same70"

config SOC_PART_NUMBER
	default "same70q21" if SOC_PART_NUMBER_SAME70Q21
	default "same70q20" if SOC_PART_NUMBER_SAME70Q20
	default "same70q19" if SOC_PART_NUMBER_SAME70Q19
	default "same70n21" if SOC_PART_NUMBER_SAME70N21
	default "same70n20" if SOC_PART_NUMBER_SAME70N20
	default "same70n19" if SOC_PART_NUMBER_SAME70N19
	default "same70j21" if SOC_PART_NUMBER_SAME70J21
	default "same70j20" if SOC_PART_NUMBER_SAME70J20
	default "same70j19" if SOC_PART_NUMBER_SAME70J19
	default "same70q21b" if SOC_PART_NUMBER_SAME70Q21B
	default "same70q20b" if SOC_PART_NUMBER_SAME70Q20B
	default "same70q19b" if SOC_PART_NUMBER_SAME70Q19B
	default "same70n21b" if SOC_PART_NUMBER_SAME70N21B
	default "same70n20b" if SOC_PART_NUMBER_SAME70N20B
	default "same70n19b" if SOC_PART_NUMBER_SAME70N19B
	default "same70j21b" if SOC_PART_NUMBER_SAME70J21B
	default "same70j20b" if SOC_PART_NUMBER_SAME70J20B
	default "same70j19b" if SOC_PART_NUMBER_SAME70J19B

#
# SAM E70 family has in total 71 peripherals capable of generating interrupts
# for the revision A and 74 for the revision B (not all Peripheral Identifiers
# are used).
#
config NUM_IRQS
	default 74 if SOC_ATMEL_SAME70_REVB
	default 71

endif # SOC_SERIES_SAME70
```

## soc/arm/atmel_sam/same70/Kconfig.series
```kconfig
# Atmel SAM E70 MCU series

# Copyright (c) 2016 Piotr Mienkowski
# Copyright (c) 2023 Gerson Fernando Budke <nandojve@gmail.com>
# SPDX-License-Identifier: Apache-2.0

config SOC_SERIES_SAME70
	bool "Atmel SAME70 MCU"
	select ARM
	select CPU_CORTEX_M7
	select CPU_CORTEX_M_HAS_DWT
	select CPU_HAS_ARM_MPU
	select CPU_HAS_FPU_DOUBLE_PRECISION
	select SOC_FAMILY_SAM
	select PLATFORM_SPECIFIC_INIT
	select ASF
	select HAS_SWO
	select XIP
	help
	  Enable support for Atmel SAM E70 ARM Cortex-M7 Microcontrollers.
	  Part No.: SAME70J19, SAME70J20, SAME70J21, SAME70N19, SAME70N20,
	  SAME70N21, SAME70Q19, SAME70Q20, SAME70Q21, SAME70J19B, SAME70J20B,
	  SAME70J21B, SAME70N19B, SAME70N20B, SAME70N21B, SAME70Q19B,
	  SAME70Q20B, SAME70Q21B
```
